## ext/hal/microchip/Kconfig
```kconfig
# Kconfig - Microchip MEC HAL drivers configuration
#
# SPDX-License-Identifier: Apache-2.0

menuconfig HAS_MEC_HAL
	bool "Microchip MEC HAL drivers support"
	default n
```

## ext/hal/mips/Kconfig
```kconfig
#
# Copyright (c) 2017 Imagination Technologies
#
# SPDX-License-Identifier: Apache-2.0
#

config HAS_MIPS_HAL
	bool
```

## ext/hal/nordic/Kconfig
```kconfig
#
# Copyright (c) 2016 Nordic Semiconductor ASA
#
# SPDX-License-Identifier: Apache-2.0
#

config HAS_NORDIC_DRIVERS
	bool

config HAS_NRFX
	bool

config NRFX_PRS
	bool

config NRFX_ADC
	bool

config NRFX_CLOCK
	bool

config NRFX_GPIOTE
	bool

config NRFX_NFCT
	bool
	select NRFX_TIMER4

config NRFX_PPI
	bool

config NRFX_PWM
	bool

config NRFX_QDEC
	bool

config NRFX_RTC
	bool

config NRFX_SAADC
	bool

config NRFX_RTC
	bool

config NRFX_RTC0
	bool

config NRFX_RTC1
	bool

config NRFX_RTC2
	bool

config NRFX_SPI
	bool

config NRFX_SPIM
	bool

config NRFX_SPIS
	bool

config NRFX_SYSTICK
	bool

config NRFX_TIMER
	bool

config NRFX_TIMER0
	bool
	select NRFX_TIMER

config NRFX_TIMER1
	bool
	select NRFX_TIMER

config NRFX_TIMER2
	bool
	select NRFX_TIMER

config NRFX_TIMER3
	bool
	select NRFX_TIMER

config NRFX_TIMER4
	bool
	select NRFX_TIMER

config NRFX_TWI
	bool

config NRFX_TWIM
	bool

config NRFX_UART
	bool

config NRFX_UARTE
	bool

config NRFX_UARTE0
	bool
	select NRFX_UARTE

config NRFX_UARTE1
	bool
	select NRFX_UARTE

config NRFX_USBD
	bool
	select NRFX_SYSTICK

config NRFX_WDT
	bool
```

## ext/hal/nxp/imx/Kconfig
```kconfig
# Kconfig - IMX M4 Core SDK
#
# Copyright (c) 2018, NXP
#
# SPDX-License-Identifier: Apache-2.0
#


config HAS_IMX_HAL
	bool
	select HAS_CMSIS
	depends on  SOC_FAMILY_IMX

if HAS_IMX_HAL

config HAS_IMX_RDC
	bool
	help
	  Set if the RDC module is present in the SoC.

config HAS_IMX_CCM
	bool
	help
	  Set if the CCM module is present in the SoC.

config HAS_IMX_GPIO
	bool
	help
	  Set if the GPIO module is present in the SoC.

config HAS_IMX_I2C
	bool
	help
	  Set if the I2C module is present in the SoC.

endif # HAS_IMX_HAL
```

## ext/hal/nxp/mcux/Kconfig
```kconfig
# Kconfig - MCUXpresso SDK
#
# Copyright (c) 2016, Freescale Semiconductor, Inc.
#
# SPDX-License-Identifier: Apache-2.0
#

config HAS_MCUX
	bool
	select HAS_CMSIS
	depends on SOC_FAMILY_KINETIS || SOC_FAMILY_IMX || SOC_FAMILY_LPC

if HAS_MCUX

config HAS_MCUX_ADC16
	bool
	help
	  Set if the 16-bit ADC (ADC16) module is present in the SoC.

config HAS_MCUX_CACHE
	bool
	help
	  Set if the L1 or L2 cache is present in the SoC.

config HAS_MCUX_CCM
	bool
	help
	  Set if the clock control module (CCM) module is present in the SoC.

config HAS_MCUX_PCC
	bool
	help
	  Set if the peripheral clock controller module (PCC) module is
	  present in the SoC.

config HAS_MCUX_ELCDIF
	bool
	help
	  Set if the enhanced LCD interface (eLCDIF) module is present in the
	  SoC.

config HAS_MCUX_ENET
	bool
	help
	  Set if the ethernet (ENET) module is present in the SoC.

config HAS_MCUX_FTFX
	bool
	help
	  Set if the flash memory (FTFA, FTFE, or FTFL) module is present in
	  the SoC.

config HAS_MCUX_FTM
	bool
	help
	  Set if the FlexTimer (FTM) module is present in the SoC.

config HAS_MCUX_IGPIO
	bool
	help
	  Set if the iMX GPIO (IGPIO) module is present in the SoC.

config HAS_MCUX_LPI2C
	bool
	help
	  Set if the low power I2C (LPI2C) module is present in the SoC.

config HAS_MCUX_LPSCI
	bool
	help
	  Set if the low power uart (LPSCI) module is present in the SoC.

config HAS_MCUX_LPSPI
	bool
	help
	  Set if the low power SPI (LPSPI) module is present in the SoC.

config HAS_MCUX_LPUART
	bool
	help
	  Set if the low power uart (LPUART) module is present in the SoC.

config HAS_MCUX_RNGA
	bool
	help
	  Set if the random number generator accelerator (RNGA) module is
	  present in the SoC.

config HAS_MCUX_RTC
	bool
	help
	  Set if the real time clock (RTC) modules is present in the SoC.

config HAS_MCUX_SIM
	bool
	help
	  Set if the system integration module (SIM) module is present in the
	  SoC.

config HAS_MCUX_TRNG
	bool
	help
	  Set if the true random number generator (TRNG) module is present in
	  the SoC.

config HAS_MCUX_USB_EHCI
	bool
	help
	  Set if the USB controller EHCI module is present in the SoC.

endif # HAS_MCUX
```

## ext/hal/qmsi/Kconfig
```kconfig
# Kconfig - QMSI drivers configuration options

#
# Copyright (c) 2015 Intel Corporation
#
# SPDX-License-Identifier: Apache-2.0
#

config HAS_QMSI
	bool

menuconfig QMSI
	bool "QMSI driver support"
	depends on HAS_QMSI
	help
	  Enable QMSI driver support.
```

## ext/hal/rda/rda5981a/Kconfig
```kconfig
#
# Copyright (c) 2017 RDA
#
# SPDX-License-Identifier: Apache-2.0
#

config HAS_RDA5981A_HAL
	bool "rda HAL driver"
	default n

config HAS_RDA5981A_SDMMC
	bool "rda SDMMC"
	default n
```

## ext/hal/st/lib/Kconfig
```kconfig
# Kconfig - STLIB config
#
# Copyright (c) 2019 STMicroelectronics
#
# SPDX-License-Identifier: Apache-2.0

config HAS_STLIB
    bool
    imply NEWLIB_LIBC
    imply NEWLIB_LIBC_FLOAT_PRINTF
```

## ext/hal/st/stm32cube/Kconfig
```kconfig
# Kconfig - STM32CUBE HAL config

# Copyright (c) 2016 Linaro Limited.
#
# SPDX-License-Identifier: Apache-2.0

config HAS_STM32CUBE
    bool
    select HAS_CMSIS
    depends on SOC_FAMILY_STM32

if HAS_STM32CUBE

config USE_STM32_HAL_ADC
	bool
	default n

config USE_STM32_HAL_ADC_EX
	bool
	default n

config USE_STM32_HAL_CAN
	bool
	default n

config USE_STM32_HAL_CEC
	bool
	default n

config USE_STM32_HAL_COMP
	bool
	default n

config USE_STM32_HAL_CORTEX
	bool
	default n

config USE_STM32_HAL_CRC
	bool
	default n

config USE_STM32_HAL_CRC_EX
	bool
	default n

config USE_STM32_HAL_CRYPT
	bool
	default n

config USE_STM32_HAL_CRYPT_EX
	bool
	default n

config USE_STM32_HAL_DAC
	bool
	default n

config USE_STM32_HAL_DAC_EX
	bool
	default n

config USE_STM32_HAL_DCMI
	bool
	default n

config USE_STM32_HAL_DCMI_EX
	bool
	default n

config USE_STM32_HAL_DFSDM
	bool
	default n

config USE_STM32_HAL_DFSDM_EX
	bool
	default n

config USE_STM32_HAL_DMA
	bool
	default n

config USE_STM32_HAL_DMA2D
	bool
	default n

config USE_STM32_HAL_DMA_EX
	bool
	default n

config USE_STM32_HAL_DSI
	bool
	default n

config USE_STM32_HAL_ETH
	bool
	default n

config USE_STM32_HAL_FIREWALL
	bool
	default n

config USE_STM32_HAL_FLASH
	bool
	default n

config USE_STM32_HAL_FLASH_EX
	bool
	default n

config USE_STM32_HAL_FLASH_RAMFUNC
	bool
	default n

config USE_STM32_HAL_FMPI2C
	bool
	default n

config USE_STM32_HAL_FMPI2C_EX
	bool
	default n

config USE_STM32_HAL_GFXMMU
	bool
	default n

config USE_STM32_HAL_GPIO
	bool
	default n

config USE_STM32_HAL_GPIO_EX
	bool
	default n

config USE_STM32_HAL_HASH
	bool
	default n

config USE_STM32_HAL_HASH_EX
	bool
	default n

config USE_STM32_HAL_HCD
	bool
	default n

config USE_STM32_HAL_HRTIM
	bool
	default n

config USE_STM32_HAL_I2C
	bool
	default n

config USE_STM32_HAL_I2C_EX
	bool
	default n

config USE_STM32_HAL_I2S
	bool
	default n

config USE_STM32_HAL_I2S_EX
	bool
	default n

config USE_STM32_HAL_IRDA
	bool
	default n

config USE_STM32_HAL_IWDG
	bool
	default n

config USE_STM32_HAL_JPEG
	bool
	default n

config USE_STM32_HAL_LCD
	bool
	default n

config USE_STM32_HAL_LPTIM
	bool
	default n

config USE_STM32_HAL_LTDC
	bool
	default n

config USE_STM32_HAL_LTDC_EX
	bool
	default n

config USE_STM32_HAL_MDIOS
	bool
	default n

config USE_STM32_HAL_MMC
	bool
	default n

config USE_STM32_HAL_NAND
	bool
	default n

config USE_STM32_HAL_NOR
	bool
	default n

config USE_STM32_HAL_OPAMP
	bool
	default n

config USE_STM32_HAL_OPAMP_EX
	bool
	default n

config USE_STM32_HAL_OSPI
	bool
	default n

config USE_STM32_HAL_PCCARD
	bool
	default n

config USE_STM32_HAL_PCD
	bool
	default n

config USE_STM32_HAL_PCD_EX
	bool
	default n

config USE_STM32_HAL_PWR
	bool
	default n

config USE_STM32_HAL_PWR_EX
	bool
	default n

config USE_STM32_HAL_QSPI
	bool
	default n

config USE_STM32_HAL_RCC
	bool
	default n

config USE_STM32_HAL_RCC_EX
	bool
	default n

config USE_STM32_HAL_RNG
	bool
	default n

config USE_STM32_HAL_RTC
	bool
	default n

config USE_STM32_HAL_RTC_EX
	bool
	default n

config USE_STM32_HAL_SAI
	bool
	default n

config USE_STM32_HAL_SAI_EX
	bool
	default n

config USE_STM32_HAL_SD
	bool
	default n

config USE_STM32_HAL_SDADC
	bool
	default n

config USE_STM32_HAL_SD_EX
	bool
	default n

config USE_STM32_HAL_SDRAM
	bool
	default n

config USE_STM32_HAL_SMARTCARD
	bool
	default n

config USE_STM32_HAL_SMARTCARD_EX
	bool
	default n

config USE_STM32_HAL_SMBUS
	bool
	default n

config USE_STM32_HAL_SPDIFRX
	bool
	default n

config USE_STM32_HAL_SPI
	bool
	default n

config USE_STM32_HAL_SPI_EX
	bool
	default n

config USE_STM32_HAL_SRAM
	bool
	default n

config USE_STM32_HAL_SWPMI
	bool
	default n

config USE_STM32_HAL_TIM
	bool
	default n

config USE_STM32_HAL_TIME_EX
	bool
	default n

config USE_STM32_HAL_TIM_EX
	bool
	default n

config USE_STM32_HAL_TSC
	bool
	default n

config USE_STM32_HAL_UART
	bool
	default n

config USE_STM32_HAL_UART_EX
	bool
	default n

config USE_STM32_HAL_USART
	bool
	default n

config USE_STM32_HAL_USART_EX
	bool
	default n

config USE_STM32_HAL_WWDG
	bool
	default n

config USE_STM32_LL_ADC
	bool
	default n

config USE_STM32_LL_COMP
	bool
	default n

config USE_STM32_LL_CRC
	bool
	default n

config USE_STM32_LL_CRS
	bool
	default n

config USE_STM32_LL_DAC
	bool
	default n

config USE_STM32_LL_DMA
	bool
	default n

config USE_STM32_LL_DMA2D
	bool
	default n

config USE_STM32_LL_EXTI
	bool
	default n

config USE_STM32_LL_FMC
	bool
	default n

config USE_STM32_LL_FSMC
	bool
	default n

config USE_STM32_LL_GPIO
	bool
	default n

config USE_STM32_LL_HRTIM
	bool
	default n

config USE_STM32_LL_I2C
	bool
	default n

config USE_STM32_LL_LPTIM
	bool
	default n

config USE_STM32_LL_LPUART
	bool
	default n

config USE_STM32_LL_OPAMP
	bool
	default n

config USE_STM32_LL_PWR
	bool
	default n

config USE_STM32_LL_RCC
	bool
	default n

config USE_STM32_LL_RNG
	bool
	default n

config USE_STM32_LL_RTC
	bool
	default n

config USE_STM32_LL_SDMMC
	bool
	default n

config USE_STM32_LL_SPI
	bool
	default n

config USE_STM32_LL_SWPMI
	bool
	default n

config USE_STM32_LL_TIM
	bool
	default n

config USE_STM32_LL_USART
	bool
	default n

config USE_STM32_LL_USB
	bool
	default n

config USE_STM32_LL_UTILS
	bool
	default n

endif
```

## ext/hal/ti/cc3200sdk/Kconfig
```kconfig
# Kconfig - CC3200 SDK HAL configuration

config HAS_CC3200SDK
	bool

menuconfig CC3200SDK
	bool "TI CC3200 SDK support"
	default n
	depends on HAS_CC3200SDK
	help
	Set when CC3200SDK_BUILTIN or CC3200SDK_LIBRARY

if HAS_CC3200SDK

config CC3200SDK_BUILTIN
        bool "Enable building the CC3200 SDK files stored in the Zephyr tree"
        default n
        select CC3200SDK
        help
        Link with local CC3200 SDK driverlib sources.

config CC3200SDK_ROM_DRIVERLIB
        bool "Use the Peripheral Driver library functions in ROM"
        default n
        select CC3200SDK
        help
        Vector to CC3200 SDK driverlib APIs in ROM.

endif
```

## ext/hal/ti/msp432p4xxsdk/Kconfig
```kconfig
# Kconfig - MSP432P4XX SDK HAL configuration

config HAS_MSP432P4XXSDK
	bool

menuconfig MSP432P4XXSDK
	bool "TI MSP432P4XX SDK support"
	default n
	select HAS_CMSIS
	depends on HAS_MSP432P4XXSDK
	help
	Set when MSP432P4XXSDK_BUILTIN or MSP432P4XXSDK_ROM_DRIVERLIB

if HAS_MSP432P4XXSDK

config MSP432P4XXSDK_BUILTIN
        bool "Enable building the MSP432P4XX SDK files stored in the Zephyr tree"
        default n
        select MSP432P4XXSDK
        help
        Link with local MSP432P4XX SDK driverlib sources.

config MSP432P4XXSDK_ROM_DRIVERLIB
        bool "Use the Peripheral Driver library functions in ROM"
        default n
        select MSP432P4XXSDK
        help
        Vector to MSP432P4XX SDK driverlib APIs in ROM.

endif
```

## ext/hal/ti/simplelink/Kconfig
```kconfig
# Kconfig - CC3220 SDK HAL configuration

config HAS_CC3220SDK
	bool

# Notes:
# SimpleLink drivers require types (stdint.h) from NEWLIB_LIBC
# Selecting ERRNO lets host driver use Zephyr's __errno
config SIMPLELINK_HOST_DRIVER
	bool "Build the SimpleLink WiFi Host Driver"
	depends on HAS_CC3220SDK
	depends on MULTITHREADING
	select NEWLIB_LIBC
	select ERRNO
	help
	  Build the SimpleLink host driver

# Kconfig - MSP432 SDK HAL configuration

config HAS_MSP432P4XXSDK
        bool
        select HAS_CMSIS
```

## ext/hal/unisoc/Kconfig
```kconfig
config HAS_UWP566x
	bool
	depends on SOC_FAMILY_UWP

if HAS_UWP566x

config USE_UWP566x_HAL_UART
	bool
	default y

config USE_UWP566x_HAL_SFC
   bool
   default y

endif
```

## ext/hal/unisoc/uwp/Kconfig
```kconfig
config HAS_UWP
	bool "Enable uwp hal library"
	help
	  Enable UNISOC uwp5 hal libraries with register definitions
	  and helper functions.

module = UWP_HAL
module-dep = LOG
module-str = Log level for UWP HAL
module-help = Sets log level for UWP HAL.
source "subsys/logging/Kconfig.template.log_config"

if HAS_UWP

config USE_UWP_HAL_CACHE
	bool
	default y
	help
	  Provide interfaces to enable or disable icache/dcache in
	  CM4.

config USE_UWP_HAL_GNSS
	bool
	default y
	help
	  Provide interfaces to initial cp2.
	  
config USE_UWP_HAL_FW
	bool
	default y
	help
	  Provide interfaces to download firmware for another CM4.

config USE_UWP_HAL_SRAM
	bool
	default y
	help
	  Provide interfaces to initialize SRAM.

config SIPC
	bool "UNISOC sipc lib"
	default n
	help
		enbale sipc feature

config BT_UWP5661
	bool "UNISOC bt"
	depends on BT
	default n
	help
      enbale bt feature

config USE_UWP_HAL_SFC
	bool
	default y
	help
	  Provide interfaces to operate SFC.
endif
```

## ext/hal/unisoc/uwp/drivers/src/sfc/Kconfig
```kconfig
config USE_UWP_HAL_SFC
	bool
	default y
	help
	  Provide interfaces to operate SFC.
```

## ext/hal/unisoc/uwp5661/Kconfig
```kconfig
config HAS_UWP
	bool "Enable uwp hal library"
	help
	  Enable UNISOC uwp5 hal libraries with register definitions
	  and helper functions.

if HAS_UWP

config USE_UWP_HAL_CACHE
	bool
	default y
	help
	  Provide interfaces to enable or disable icache/dcache in
	  CM4.

config USE_UWP_HAL_GNSS
	bool
	default y
	help
	  Provide interfaces to initial cp2.
	  
config USE_UWP_HAL_FW
	bool
	default y
	help
	  Provice interfaces to download firmware for another CM4._

endif
```

## ext/lib/base64/Kconfig
```kconfig
# Kconfig - base64 library support configuration options
#
# Copyright (c) 2017 Nordic Semiconductor ASA
#
# SPDX-License-Identifier: Apache-2.0
#

#
# BASE64
#

config BASE64
	bool
	prompt "mbedtls base64"
	help
	  Enable support for RFC 1521 base64 encoding/decoding.
	  This module can by used only in case base64 module bundled
	  in the mbedtls library is not enabled.
```

## ext/lib/cborattr/Kconfig
```kconfig
# Kconfig - tinycbor library support configuration options
#
# Copyright (c) 2017 Nordic Semiconductor ASA
#
# SPDX-License-Identifier: Apache-2.0
#

#
# CBORATTR
#

menuconfig CBORATTR
	prompt "cbor attribute parser"
	bool
	depends on TINYCBOR
	help
	  Attribute based decoding basing on tinycbor.

config CBORATTR_MAX_SIZE
	int "maximum cbor attribute size"
	default 512
	depends on CBORATTR
```

## ext/lib/crypto/Kconfig
```kconfig
#
# Copyright (c) 2016 Intel Corporation
#
# SPDX-License-Identifier: Apache-2.0
#

menu "Cryptography"

source "ext/lib/crypto/tinycrypt/Kconfig"

endmenu
```
