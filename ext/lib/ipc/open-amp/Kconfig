## ext/lib/ipc/open-amp/Kconfig
```kconfig
#
# Copyright (c) 2018 Linaro Limited
#
# SPDX-License-Identifier: Apache-2.0
#

config OPENAMP
	bool
	prompt "OpenAMP Support"
	select LIBMETAL
	default n
	help
	  This option enables the OpenAMP IPC library
```

## ext/lib/ipc/rpmsg_lite/Kconfig
```kconfig
#
# Copyright 2019 NXP
#
# SPDX-License-Identifier: Apache-2.0
#

config RPMSG_LITE
	bool
	prompt "Enable Remote Processor Messaging Lite library"
	default n
	help
	Remote Processor Messaging Lite library implementation.
```

## ext/lib/mgmt/mcumgr/Kconfig
```kconfig
# Licensed to the Apache Software Foundation (ASF) under one
# or more contributor license agreements.  See the NOTICE file
# distributed with this work for additional information
# regarding copyright ownership.  The ASF licenses this file
# to you under the Apache License, Version 2.0 (the
# "License"); you may not use this file except in compliance
# with the License.  You may obtain a copy of the License at
# 
#  http://www.apache.org/licenses/LICENSE-2.0
# 
# Unless required by applicable law or agreed to in writing,
# software distributed under the License is distributed on an
# "AS IS" BASIS, WITHOUT WARRANTIES OR CONDITIONS OF ANY
# KIND, either express or implied.  See the License for the
# specific language governing permissions and limitations
# under the License.

config MCUMGR
    bool "mcumgr Support"
    select TINYCBOR
    help
      This option enables the mcumgr management library.

if MCUMGR
source "ext/lib/mgmt/mcumgr/cmd/Kconfig"

config APP_LINK_WITH_MCUMGR
	bool "Link 'app' with MCUMGR"
	default y
	help
	  Add MCUMGR header files to the 'app' include path. It may be
	  disabled if the include paths for MCUMGR are causing aliasing
	  issues for 'app'.

endif
```

## ext/lib/mgmt/mcumgr/cmd/fs_mgmt/Kconfig
```kconfig
# Licensed to the Apache Software Foundation (ASF) under one
# or more contributor license agreements.  See the NOTICE file
# distributed with this work for additional information
# regarding copyright ownership.  The ASF licenses this file
# to you under the Apache License, Version 2.0 (the
# "License"); you may not use this file except in compliance
# with the License.  You may obtain a copy of the License at
# 
#  http://www.apache.org/licenses/LICENSE-2.0
# 
# Unless required by applicable law or agreed to in writing,
# software distributed under the License is distributed on an
# "AS IS" BASIS, WITHOUT WARRANTIES OR CONDITIONS OF ANY
# KIND, either express or implied.  See the License for the
# specific language governing permissions and limitations
# Under the License.

menuconfig MCUMGR_CMD_FS_MGMT
    bool "Enable mcumgr handlers for file management"
    depends on FILE_SYSTEM
    help
      Enables mcumgr handlers for file management

if MCUMGR_CMD_FS_MGMT
config FS_MGMT_UL_CHUNK_SIZE
    int "Maximum chunk size for file uploads"
    default 512
    help
      Limits the maximum chunk size for file uploads, in bytes.  A buffer of
      this size gets allocated on the stack during handling of a file upload command.

config FS_MGMT_DL_CHUNK_SIZE
    int "Maximum chunk size for file downloads"
    default 512
    help
      Limits the maximum chunk size for file downloads, in bytes.  A buffer of
      this size gets allocated on the stack during handling of a file download
      command.

config FS_MGMT_PATH_SIZE
    int "Maximum file path length"
    default 64
    help
      Limits the maximum path length for file operations, in bytes.  A buffer
      of this size gets allocated on the stack during handling of file upload
      and download commands.
endif
```

## ext/lib/mgmt/mcumgr/cmd/img_mgmt/Kconfig
```kconfig
# Licensed to the Apache Software Foundation (ASF) under one
# or more contributor license agreements.  See the NOTICE image
# distributed with this work for additional information
# regarding copyright ownership.  The ASF licenses this image
# to you under the Apache License, Version 2.0 (the
# "License"); you may not use this image except in compliance
# with the License.  You may obtain a copy of the License at
# 
#  http://www.apache.org/licenses/LICENSE-2.0
# 
# Unless required by applicable law or agreed to in writing,
# software distributed under the License is distributed on an
# "AS IS" BASIS, WITHOUT WARRANTIES OR CONDITIONS OF ANY
# KIND, either express or implied.  See the License for the
# specific language governing permissions and limitations
# Under the License.

menuconfig MCUMGR_CMD_IMG_MGMT
    bool "Enable mcumgr handlers for image management"
    select FLASH
    select MPU_ALLOW_FLASH_WRITE if CPU_HAS_MPU
    select IMG_MANAGER
    help
      Enables mcumgr handlers for image management

if MCUMGR_CMD_IMG_MGMT
config IMG_MGMT_UL_CHUNK_SIZE
    int "Maximum chunk size for image uploads"
    default 512
    help
      Limits the maximum chunk size for image uploads, in bytes.  A buffer of
      this size gets allocated on the stack during handling of a image upload
      command.
endif
```

## ext/lib/mgmt/mcumgr/cmd/log_mgmt/Kconfig
```kconfig
# Licensed to the Apache Software Foundation (ASF) under one
# or more contributor license agreements.  See the NOTICE log
# distributed with this work for additional information
# regarding copyright ownership.  The ASF licenses this log
# to you under the Apache License, Version 2.0 (the
# "License"); you may not use this log except in compliance
# with the License.  You may obtain a copy of the License at
# 
#  http://www.apache.org/licenses/LICENSE-2.0
# 
# Unless required by applicable law or agreed to in writing,
# software distributed under the License is distributed on an
# "AS IS" BASIS, WITHOUT WARRANTIES OR CONDITIONS OF ANY
# KIND, either express or implied.  See the License for the
# specific language governing permissions and limitations
# Under the License.

menuconfig MCUMGR_CMD_LOG_MGMT
    bool "Enable mcumgr handlers for log management"
    help
      Enables mcumgr handlers for log management

if MCUMGR_CMD_LOG_MGMT
config LOG_MGMT_CHUNK_SIZE
    int "Maximum chunk size for log downloads"
    default 512
    help
      Limits the maximum chunk size for log downloads, in bytes.  A buffer of
      this size gets allocated on the stack during handling of the log show command.

config LOG_MGMT_NAME_LEN
    int "Maximum log name length"
    default 64
    help
      Limits the maximum length of log names, in bytes.  If a log's name length
      exceeds this number, it gets truncated in management responses.  A buffer
      of this size gets allocated on the stack during handling of all log
      management commands.

config LOG_MGMT_BODY_LEN
    int "Maximum log body length"
    default 128
    help
      Limits the maximum length of log entry bodies, in bytes.  If a log
      entry's body length exceeds this number, it gets truncated in management
      responses.  A buffer of this size gets allocated on the stack during
      handling of the log show command.
endif
```

## ext/lib/mgmt/mcumgr/cmd/os_mgmt/Kconfig
```kconfig
# Licensed to the Apache Software Foundation (ASF) under one
# or more contributor license agreements.  See the NOTICE image
# distributed with this work for additional information
# regarding copyright ownership.  The ASF licenses this image
# to you under the Apache License, Version 2.0 (the
# "License"); you may not use this image except in compliance
# with the License.  You may obtain a copy of the License at
# 
#  http://www.apache.org/licenses/LICENSE-2.0
# 
# Unless required by applicable law or agreed to in writing,
# software distributed under the License is distributed on an
# "AS IS" BASIS, WITHOUT WARRANTIES OR CONDITIONS OF ANY
# KIND, either express or implied.  See the License for the
# specific language governing permissions and limitations
# Under the License.

menuconfig MCUMGR_CMD_OS_MGMT
    bool "Enable mcumgr handlers for OS management"
    select REBOOT
    help
      Enables mcumgr handlers for OS management

if MCUMGR_CMD_OS_MGMT
config OS_MGMT_RESET_MS
    int "Delay before executing reset command (ms)"
    default 250
    help
      When a reset command is received, the system waits this many milliseconds
      before performing the reset.  This delay allows time for the mcumgr
      response to be delivered.
endif
```

## ext/lib/mgmt/mcumgr/cmd/stat_mgmt/Kconfig
```kconfig
# Licensed to the Apache Software Foundation (ASF) under one
# or more contributor license agreements.  See the NOTICE log
# distributed with this work for additional information
# regarding copyright ownership.  The ASF licenses this log
# to you under the Apache License, Version 2.0 (the
# "License"); you may not use this log except in compliance
# with the License.  You may obtain a copy of the License at
# 
#  http://www.apache.org/licenses/LICENSE-2.0
# 
# Unless required by applicable law or agreed to in writing,
# software distributed under the License is distributed on an
# "AS IS" BASIS, WITHOUT WARRANTIES OR CONDITIONS OF ANY
# KIND, either express or implied.  See the License for the
# specific language governing permissions and limitations
# Under the License.

menuconfig MCUMGR_CMD_STAT_MGMT
    bool "Enable mcumgr handlers for statistics management"
    depends on STATS
    help
      Enables mcumgr handlers for statistics management.

if MCUMGR_CMD_STAT_MGMT
config STAT_MGMT_MAX_NAME_LEN
    int "Maximum stat group name length"
    default 32
    help
      Limits the maximum stat group name length in mcumgr requests, in bytes.
      A buffer of this size gets allocated on the stack during handling of all
      stat read commands.  If a stat group's name exceeds this limit, it will
      be impossible to retrieve its values with a stat show command.
endif
```

## ext/lib/tinycbor/Kconfig
```kconfig
# Kconfig - tinycbor library support configuration options
#
# Copyright (c) 2017 Nordic Semiconductor ASA
#
# SPDX-License-Identifier: Apache-2.0
#

#
# DFU
#

config TINYCBOR
	bool
	prompt "tinycbor"
	select NEWLIB_LIBC
	help
	  Enable support for CBOR using tinycbor library.
```

## ext/tfm/Kconfig
```kconfig
# Kconfig - TF-M/PSA Related
#
# Copyright (c) 2019 Linaro Limited
#
# SPDX-License-Identifier: Apache-2.0
#

config BUILD_WITH_TFM
	bool "Build with TF-M for Secure Execution"
```

## fs/Kconfig
```kconfig
#
# Copyright (c) 2016 Intel Corporation
#
# Licensed under the Apache License, Version 2.0 (the "License");
# you may not use this file except in compliance with the License.
# You may obtain a copy of the License at
#
#     http://www.apache.org/licenses/LICENSE-2.0
#
# Unless required by applicable law or agreed to in writing, software
# distributed under the License is distributed on an "AS IS" BASIS,
# WITHOUT WARRANTIES OR CONDITIONS OF ANY KIND, either express or implied.
# See the License for the specific language governing permissions and
# limitations under the License.
#

menu "File System"

config FILE_SYSTEM
	bool "File system support"
	default n
	help
	Enables support for file system.

config FILE_SYSTEM_FAT
	bool "FAT file system support"
	default y
	depends on FILE_SYSTEM
	help
	Enables FAT file system support.

choice
	prompt "Select file system storage device"
	depends on FILE_SYSTEM_FAT
	default FS_FAT_RAM_DISK
	help
	The storage device where the file system
	resides

config FS_FAT_RAM_DISK
	bool
	prompt "RAM Disk"
	help
	RAM buffer used to emulate storage disk.
	This option can used to test the file
	system.

endchoice

if FS_FAT_RAM_DISK

config FS_VOLUME_SIZE
	hex
	default 0x18000
	help
	This is the file system volume size in bytes.

config FS_BLOCK_SIZE
	hex
	default 0x1000
	help
	This is typically the minimum block size that
	is erased at one time in flash storage.

endif # FS_RAM_DISK

endmenu
```
