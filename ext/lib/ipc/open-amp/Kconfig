## kernel/Kconfig.device
```kconfig
# Copyright (c) 2014-2015 Wind River Systems, Inc.
# Copyright (c) 2024 Intel Corp.
# SPDX-License-Identifier: Apache-2.0
#
menu "Device Options"

config DEVICE_DEPS
	bool "Store device dependencies"
	help
	  When enabled, device dependencies will be stored so that they can be
	  queried at runtime. Device dependencies are typically inferred from
	  devicetree. Enabling this option will increase ROM usage (or RAM if
	  dynamic device dependencies are enabled).

config DEVICE_DEPS_DYNAMIC
	bool "Dynamic device dependencies"
	depends on DEVICE_DEPS
	help
	  Option that makes it possible to manipulate device dependencies at
	  runtime.

config DEVICE_MUTABLE
	bool "Mutable devices [EXPERIMENTAL]"
	select EXPERIMENTAL
	help
	  Support mutable devices. Mutable devices are instantiated in SRAM
	  instead of Flash and are runtime modifiable in kernel mode.

config DEVICE_DT_METADATA
	bool "Store additional devicetree metadata for each device"
	help
	  If enabled, additional data from the devicetree will be stored for
	  each device. This allows you to use device_get_by_dt_nodelabel(),
	  device_get_dt_metadata(), etc.

endmenu

menu "Initialization Priorities"

config KERNEL_INIT_PRIORITY_OBJECTS
	int "Kernel objects initialization priority"
	default 30
	help
	  Kernel objects use this priority for initialization. This
	  priority needs to be higher than minimal default initialization
	  priority.

config KERNEL_INIT_PRIORITY_LIBC
	int "LIBC initialization priority"
	default 35
	help
	  LIBC uses this priority for initialization. This
	  priority needs to be higher than minimal default initialization
	  priority.

config KERNEL_INIT_PRIORITY_DEFAULT
	int "Default init priority"
	default 40
	help
	  Default minimal init priority for each init level.

config KERNEL_INIT_PRIORITY_DEVICE
	int "Default init priority for device drivers"
	default 50
	help
	  Device driver, that depends on common components, such as
	  interrupt controller, but does not depend on other devices,
	  uses this init priority.

config APPLICATION_INIT_PRIORITY
	int "Default init priority for application level drivers"
	default 90
	help
	  This priority level is for end-user drivers such as sensors and display
	  which have no inward dependencies.


endmenu
```

## kernel/Kconfig.event_logger
```kconfig
#
# Copyright (c) 2014-2015 Wind River Systems, Inc.
#
# SPDX-License-Identifier: Apache-2.0
#

menuconfig KERNEL_EVENT_LOGGER
	bool
	prompt "Enable kernel event logger features"
	select RING_BUFFER
	help
	  This feature enables the usage of the profiling logger. Provides the
	  logging of sleep events (either entering or leaving low power conditions),
	  context switch events, interrupt events, boot events and a method to
	  collect these event messages.

if KERNEL_EVENT_LOGGER
config KERNEL_EVENT_LOGGER_BUFFER_SIZE
	int
	prompt "Kernel event logger buffer size"
	default 128
	help
	  Buffer size in 32-bit words.

config KERNEL_EVENT_LOGGER_DYNAMIC
	bool
	prompt "Kernel event logger dynamic enabling"
	help
	  If enabled, kernel event logger is not logging any data to the ring buffer
	  It is up to the application to set the appropriate flags to enable/disable the
	  logging of each event type.

config KERNEL_EVENT_LOGGER_CUSTOM_TIMESTAMP
	bool
	prompt "Kernel event logger custom timestamp"
	help
	  This flag enables the possibility to set the timer function to be used to
	  populate kernel event logger timestamp. This has to be done at runtime by
	  calling sys_k_event_logger_set_timer and providing the function callback.

menu "Kernel event logging points"

config KERNEL_EVENT_LOGGER_CONTEXT_SWITCH
	bool
	prompt "Context switch event logging point"
	help
	  Enable the context switch event messages.

config KERNEL_EVENT_LOGGER_INTERRUPT
	bool
	prompt "Interrupt event logging point"
	help
	  Enable interrupt event messages. These messages provide the following
	  information: The time when interrupts occur.

config KERNEL_EVENT_LOGGER_SLEEP
	bool
	prompt "Sleep event logging point"
	depends on SYS_POWER_MANAGEMENT
	help
	  Enable low power condition event messages. These messages provide the
	  following information:

		- When the CPU went to sleep mode.
		- When the CPU woke up.
		- The ID of the interrupt that woke the CPU up.

config KERNEL_EVENT_LOGGER_THREAD
	bool
	prompt "Thread event logging point"
	help
	  Enable thread event messages. These messages provide the following
	  information:

		- When threads are marked as ready to be executed.
		- When threads are marked as pending.
		- When threads end.

	  Context switching messages should be enabled by enabling the
	  CONFIG_KERNEL_EVENT_LOGGER_CONTEXT_SWITCH setting instead.

endmenu

endif
```

## kernel/Kconfig.idle
```kconfig
# Copyright (c) 2025 Nordic Semiconductor ASA
# SPDX-License-Identifier: Apache-2.0

menu "Kernel idle options"

config IDLE_ENTER_HOOK
	bool
	help
	  Execute idle_enter_hook() when entering idle
	  idle thread.

config IDLE_ROUTINE_DEFAULT
	bool
	depends on !IDLE_ENTER_HOOK
	default y
	help
	  Run default idle routine from idle thread.

config IDLE_STACK_SIZE
	int "Size of stack for idle thread"
	default 2048 if COVERAGE_GCOV
	default 1024 if XTENSA
	default 512 if RISCV
	default 384 if DYNAMIC_OBJECTS
	default 320 if ARC || (ARM && CPU_HAS_FPU) || (X86 && MMU)
	default 256
	help
	  Depending on the work that the idle task must do, most likely due to
	  power management but possibly to other features like system event
	  logging (e.g. logging when the system goes to sleep), the idle thread
	  may need more stack space than the default value.

endmenu
```

## kernel/Kconfig.init
```kconfig
# Kernel init hook options

# Copyright (c) 2024 Intel Corporation
# SPDX-License-Identifier: Apache-2.0


menu "SoC and Board Hooks"

config SOC_EARLY_RESET_HOOK
	bool "Run SoC-specific early reset hook"
	help
	  Run a SoC-specific hook early in the reset/startup code (__start).
	  A custom hook soc_early_reset_hook() will be executed at the beginning
	  of the architecture-specific startup code, after hardware has been
	  configured (as required by CONFIG_INIT_ARCH_HW_AT_BOOT) but before
	  architecture's own resume logic.

	  Returning from this hook is not mandatory: it can be used to implement
	  special logic to resume execution in some scenarios (for example, when
	  a bootloader is used).

	  The stack pointer register should be considered as not initialized upon
	  call to this hook. In particular, this means that the hook is NOT allowed
	  to "push" any data using this stack pointer value. However, the hook may
	  use an implementation-specific area as stack if desired; in such case,
	  the original value of the stack pointer needs not to be "restored" before
	  returning control to the hook's caller.

	  Additional constraints may be imposed on the hook by the architecture.

config SOC_RESET_HOOK
	bool "Run SoC-specific reset hook"
	help
	  Run a SoC-specific hook in the reset/startup code (__start).

	  A custom hook soc_reset_hook() will be executed near the beginning
	  of the architecture-specific startup code, after hardware has been
	  configured (as required by CONFIG_INIT_ARCH_HW_AT_BOOT), a stack
	  pointer has been loaded and the architecture's own resume logic
	  has executed (if CONFIG_PM_S2RAM is enabled). Because this hook
	  runs after the resume logic, it is not called when the system
	  resumes from a suspend-to-RAM power state.

config SOC_PREP_HOOK
	bool "Run early SoC preparation hook"
	help
	  Run an early SoC preparation hook.

	  A custom hook soc_prep_hook() is executed at the beginning of the
	  c prep code (prep_c). soc_prep_hook() must be implemented by the SoC.

config SOC_EARLY_INIT_HOOK
	bool "Run early SoC hook"
	help
	  Run an early SoC initialization hook.

	  A custom SoC hook soc_early_init_hook() is executed before the kernel and
	  devices are initialized

config SOC_LATE_INIT_HOOK
	bool "Run late SoC hook"
	help
	  Run a late SoC initialization hook.

	  A custom SoC hook soc_late_init_hook() is executed after the kernel and
	  devices are initialized

config SOC_PER_CORE_INIT_HOOK
	bool "Run SoC per-core initialization hook"
	help
	  Run an SoC initialization hook for every core

	  A custom SoC hook soc_per_core_init_hook() is executeds at the end of
	  arch_kernel_init() for the primary core, and at the end of arch_secondary_cpu_init()
	  for secondary cores.

config BOARD_EARLY_INIT_HOOK
	bool "Run early board hook"
	help
	  Run an early board initialization hook.

	  A custom board hook board_early_init_hook() is executed before the kernel and
	  devices are initialized

config BOARD_LATE_INIT_HOOK
	bool "Run late board hook"
	help
	  Run a late board initialization hook.

	  A custom board hook board_late_init_hook() is executed after the kernel and
	  devices are initialized

endmenu
```

## kernel/Kconfig.irq
```kconfig
# Copyright (c) 2024 Bjarki Arge Andreasen
# SPDX-License-Identifier: Apache-2.0

config SYS_IRQ
	bool "System IRQ subsystem"
	depends on INTC

if SYS_IRQ

config SYS_IRQ_LOG_SPURIOUS
	bool "Log spurious IRQs"
	depends on LOG

config SYS_IRQ_DYNAMIC
	bool "Dynamic IRQ"

endif
```

## kernel/Kconfig.mem_domain
```kconfig
# Kernel configuration options

# Copyright (c) 2014-2015 Wind River Systems, Inc.
# SPDX-License-Identifier: Apache-2.0

menu "Memory Domains"

config MAX_DOMAIN_PARTITIONS
	int "Maximum number of partitions per memory domain"
	default 16
	range 0 255
	depends on USERSPACE
	help
	  Configure the maximum number of partitions per memory domain.

config ARCH_MEM_DOMAIN_DATA
	bool
	depends on USERSPACE
	help
	  This hidden option is selected by the target architecture if
	  architecture-specific data is needed on a per memory domain basis.
	  If so, the architecture defines a 'struct arch_mem_domain' which is
	  embedded within every struct k_mem_domain. The architecture
	  must also define the arch_mem_domain_init() function to set this up
	  when a memory domain is created.

	  Typical uses might be a set of page tables for that memory domain.

config ARCH_MEM_DOMAIN_SYNCHRONOUS_API
	bool
	depends on USERSPACE
	help
	  This hidden option is selected by the target architecture if
	  modifying a memory domain's partitions at runtime, or changing
	  a memory domain's thread membership requires synchronous calls
	  into the architecture layer.

	  If enabled, the architecture layer must implement the following
	  APIs:

	  arch_mem_domain_thread_add
	  arch_mem_domain_thread_remove
	  arch_mem_domain_partition_remove
	  arch_mem_domain_partition_add

	  It's important to note that although supervisor threads can be
	  members of memory domains, they have no implications on supervisor
	  thread access to memory. Memory domain APIs may only be invoked from
	  supervisor mode.

	  For these reasons, on uniprocessor systems unless memory access
	  policy is managed in separate software constructions like page
	  tables, these APIs don't need to be implemented as the underlying
	  memory management hardware will be reprogrammed on context switch
	  anyway.

config ARCH_MEM_DOMAIN_SUPPORTS_ISOLATED_STACKS
	bool
	help
	  This hidden option is selected by the target architecture if
	  the architecture supports isolating thread stacks for threads
	  within the same memory domain.

config MEM_DOMAIN_ISOLATED_STACKS
	bool
	default y
	depends on (MMU || MPU) && ARCH_MEM_DOMAIN_SUPPORTS_ISOLATED_STACKS
	help
	  If enabled, thread stacks within the same memory domains are
	  isolated which means threads within the same memory domains
	  have no access to others threads' stacks.

	  If disabled, threads within the same memory domains can access
	  other threads' stacks.

	  Regardless of this settings, threads cannot access the stacks of
	  threads outside of their domains.

endmenu
```

## kernel/Kconfig.platform
```kconfig
# Copyright (c) 2021 Intel Corporation
#
# SPDX-License-Identifier: Apache-2.0

menu "Platform Abstract Support"

config PLATFORM_ABST_SUPPORT
	bool "enable Platform Abstract Support"
	default n
	help
	  Option to enable Platform Abstract Support.

if PLATFORM_ABST_SUPPORT

config PLATFORM_SPECIFIC_DEV_INIT
	bool "Enable platform specifc initialize Support"
	default n
	help
	  Option to enable platform specifc initialize Support.

endif # PLATFORM_ABST_SUPPORT

endmenu # Platform Abstract Support
```

## kernel/Kconfig.power_mgmt
```kconfig
#
# Copyright (c) 2014-2015 Wind River Systems, Inc.
# Copyright (c) 2016 Intel Corporation
#
# SPDX-License-Identifier: Apache-2.0
#

menuconfig SYS_POWER_MANAGEMENT
	bool "System Power management"
	select TICKLESS_IDLE
	help
	  This option enables the board to implement extra power management
	  policies whenever the kernel becomes idle. The kernel informs the
	  power management subsystem of the number of ticks until the next kernel
	  timer is due to expire.

if SYS_POWER_MANAGEMENT
config SYS_POWER_SLEEP_STATES
	bool "Low Power states"
	depends on HAS_SYS_POWER_STATE_SLEEP_1 || \
	           HAS_SYS_POWER_STATE_SLEEP_2 || \
	           HAS_SYS_POWER_STATE_SLEEP_3
	help
	  This option enables the kernel to interface with a power manager
	  application.  This permits the system to enter a custom CPU low power
	  state when the kernel becomes idle. The low power state could be any of
	  the CPU low power states supported by the processor.  Generally the one
	  saving most power.

config SYS_POWER_DEEP_SLEEP_STATES
	bool "Deep Sleep states"
	depends on HAS_SYS_POWER_STATE_DEEP_SLEEP_1 || \
	           HAS_SYS_POWER_STATE_DEEP_SLEEP_2 || \
	           HAS_SYS_POWER_STATE_DEEP_SLEEP_3
	help
	  This option enables the kernel to interface with a power manager
	  application. This permits the system to enter a Deep sleep state
	  supported by the SOC where the system clock is turned off while RAM is
	  retained. This state would be entered when the kernel becomes idle for
	  extended periods and would have a high wake latency.  Resume would be
	  from the reset vector same as cold boot. The interface allows
	  restoration of states that were saved at the time of suspend.

source "subsys/power/Kconfig"

endif # SYS_POWER_MANAGEMENT

config DEVICE_POWER_MANAGEMENT
	bool "Device power management"
	help
	  This option enables the device power management interface.  The
	  interface consists of hook functions implemented by device drivers
	  that get called by the power manager application when the system
	  is going to suspend state or resuming from suspend state. This allows
	  device drivers to do any necessary power management operations
	  like turning off device clocks and peripherals. The device drivers
	  may also save and restore states in these hook functions.
```
