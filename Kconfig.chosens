## arch/riscv/custom/andes/Kconfig.core
```kconfig
# Copyright (c) 2026 Andes Technology Corporation
# SPDX-License-Identifier: Apache-2.0

config CPU_ANDES_N22
	def_bool DT_HAS_ANDESTECH_N22_ENABLED
	select RISCV_PRIVILEGED
	select RISCV_SOC_HAS_GP_RELATIVE_ADDRESSING
	select CPU_HAS_ANDES_EXECIT
	select CPU_HAS_ANDES_HSP
	select CPU_HAS_ANDES_NMI
	select CPU_HAS_ANDES_PFT
	select CPU_HAS_ICACHE
	imply RISCV_PMP

config CPU_ANDES_N225
	def_bool DT_HAS_ANDESTECH_N225_ENABLED
	select RISCV_PRIVILEGED
	select RISCV_SMRNMI_ENABLE_NMI_DELIVERY
	select RISCV_SOC_HAS_GP_RELATIVE_ADDRESSING
	select CPU_HAS_ANDES_EXECIT
	select CPU_HAS_ANDES_HSP
	select CPU_HAS_ANDES_PFT
	imply RISCV_PMP
	imply RISCV_CUSTOM_CSR_ANDES_NEXECIT

config CPU_ANDES_D23
	def_bool DT_HAS_ANDESTECH_D23_ENABLED
	select RISCV_PRIVILEGED
	select RISCV_SMRNMI_ENABLE_NMI_DELIVERY
	select RISCV_SOC_HAS_GP_RELATIVE_ADDRESSING
	select CPU_HAS_ANDES_EXECIT
	select CPU_HAS_ANDES_HSP
	select CPU_HAS_ANDES_HWDSP
	select CPU_HAS_ANDES_PFT
	select CPU_HAS_ANDES_PMA
	select CPU_HAS_DCACHE
	select CPU_HAS_ICACHE
	imply RISCV_PMP
	imply RISCV_CUSTOM_CSR_ANDES_NEXECIT

config CPU_ANDES_N25F
	def_bool DT_HAS_ANDESTECH_N25F_ENABLED
	select RISCV_PRIVILEGED
	select RISCV_SOC_HAS_GP_RELATIVE_ADDRESSING
	select CPU_HAS_ANDES_EXECIT
	select CPU_HAS_ANDES_HSP
	select CPU_HAS_ANDES_NMI
	select CPU_HAS_ANDES_PFT
	select CPU_HAS_DCACHE
	select CPU_HAS_ICACHE
	imply RISCV_PMP

config CPU_ANDES_D25F
	def_bool DT_HAS_ANDESTECH_D25F_ENABLED
	select RISCV_PRIVILEGED
	select RISCV_SOC_HAS_GP_RELATIVE_ADDRESSING
	select CPU_HAS_ANDES_EXECIT
	select CPU_HAS_ANDES_HSP
	select CPU_HAS_ANDES_HWDSP
	select CPU_HAS_ANDES_NMI
	select CPU_HAS_ANDES_PFT
	select CPU_HAS_DCACHE
	select CPU_HAS_ICACHE
	imply RISCV_PMP

config CPU_ANDES_A25
	def_bool DT_HAS_ANDESTECH_A25_ENABLED
	select RISCV_PRIVILEGED
	select RISCV_SOC_HAS_GP_RELATIVE_ADDRESSING
	select CPU_HAS_ANDES_EXECIT
	select CPU_HAS_ANDES_HSP
	select CPU_HAS_ANDES_HWDSP
	select CPU_HAS_ANDES_NMI
	select CPU_HAS_ANDES_PFT
	select CPU_HAS_DCACHE
	select CPU_HAS_ICACHE
	imply RISCV_PMP

config CPU_ANDES_NX25F
	def_bool DT_HAS_ANDESTECH_NX25F_ENABLED
	select RISCV_PRIVILEGED
	select RISCV_SOC_HAS_GP_RELATIVE_ADDRESSING
	select CPU_HAS_ANDES_EXECIT
	select CPU_HAS_ANDES_HSP
	select CPU_HAS_ANDES_NMI
	select CPU_HAS_ANDES_PFT
	select CPU_HAS_DCACHE
	select CPU_HAS_ICACHE
	imply RISCV_PMP

config CPU_ANDES_AX25
	def_bool DT_HAS_ANDESTECH_AX25_ENABLED
	select RISCV_PRIVILEGED
	select RISCV_SOC_HAS_GP_RELATIVE_ADDRESSING
	select CPU_HAS_ANDES_EXECIT
	select CPU_HAS_ANDES_HSP
	select CPU_HAS_ANDES_HWDSP
	select CPU_HAS_ANDES_NMI
	select CPU_HAS_ANDES_PFT
	select CPU_HAS_DCACHE
	select CPU_HAS_ICACHE
	imply RISCV_PMP

config CPU_ANDES_A27
	def_bool DT_HAS_ANDESTECH_A27_ENABLED
	select RISCV_PRIVILEGED
	select RISCV_SOC_HAS_GP_RELATIVE_ADDRESSING
	select CPU_HAS_ANDES_EXECIT
	select CPU_HAS_ANDES_HSP
	select CPU_HAS_ANDES_HWDSP
	select CPU_HAS_ANDES_NMI
	select CPU_HAS_ANDES_PFT
	select CPU_HAS_ANDES_PMA
	select CPU_HAS_DCACHE
	select CPU_HAS_ICACHE
	imply RISCV_PMP

config CPU_ANDES_AX27
	def_bool DT_HAS_ANDESTECH_AX27_ENABLED
	select RISCV_PRIVILEGED
	select RISCV_SOC_HAS_GP_RELATIVE_ADDRESSING
	select CPU_HAS_ANDES_EXECIT
	select CPU_HAS_ANDES_HSP
	select CPU_HAS_ANDES_HWDSP
	select CPU_HAS_ANDES_NMI
	select CPU_HAS_ANDES_PFT
	select CPU_HAS_ANDES_PMA
	select CPU_HAS_DCACHE
	select CPU_HAS_ICACHE
	imply RISCV_PMP

config CPU_ANDES_N45
	def_bool DT_HAS_ANDESTECH_N45_ENABLED
	select RISCV_PRIVILEGED
	select RISCV_SOC_HAS_GP_RELATIVE_ADDRESSING
	select CPU_HAS_ANDES_EXECIT
	select CPU_HAS_ANDES_HSP
	select CPU_HAS_ANDES_NMI
	select CPU_HAS_ANDES_PFT
	select CPU_HAS_ANDES_PMA
	select CPU_HAS_DCACHE
	select CPU_HAS_ICACHE
	imply RISCV_PMP

config CPU_ANDES_D45
	def_bool DT_HAS_ANDESTECH_D45_ENABLED
	select RISCV_PRIVILEGED
	select RISCV_SOC_HAS_GP_RELATIVE_ADDRESSING
	select CPU_HAS_ANDES_EXECIT
	select CPU_HAS_ANDES_HSP
	select CPU_HAS_ANDES_HWDSP
	select CPU_HAS_ANDES_NMI
	select CPU_HAS_ANDES_PFT
	select CPU_HAS_ANDES_PMA
	select CPU_HAS_DCACHE
	select CPU_HAS_ICACHE
	imply RISCV_PMP

config CPU_ANDES_A45
	def_bool DT_HAS_ANDESTECH_A45_ENABLED
	select RISCV_PRIVILEGED
	select RISCV_SOC_HAS_GP_RELATIVE_ADDRESSING
	select CPU_HAS_ANDES_EXECIT
	select CPU_HAS_ANDES_HSP
	select CPU_HAS_ANDES_HWDSP
	select CPU_HAS_ANDES_NMI
	select CPU_HAS_ANDES_PFT
	select CPU_HAS_ANDES_PMA
	select CPU_HAS_DCACHE
	select CPU_HAS_ICACHE
	imply RISCV_PMP

config CPU_ANDES_NX45
	def_bool DT_HAS_ANDESTECH_NX45_ENABLED
	select RISCV_PRIVILEGED
	select RISCV_SOC_HAS_GP_RELATIVE_ADDRESSING
	select CPU_HAS_ANDES_EXECIT
	select CPU_HAS_ANDES_HSP
	select CPU_HAS_ANDES_NMI
	select CPU_HAS_ANDES_PFT
	select CPU_HAS_ANDES_PMA
	select CPU_HAS_DCACHE
	select CPU_HAS_ICACHE
	imply RISCV_PMP

config CPU_ANDES_AX45
	def_bool DT_HAS_ANDESTECH_AX45_ENABLED
	select RISCV_PRIVILEGED
	select RISCV_SOC_HAS_GP_RELATIVE_ADDRESSING
	select CPU_HAS_ANDES_EXECIT
	select CPU_HAS_ANDES_HSP
	select CPU_HAS_ANDES_HWDSP
	select CPU_HAS_ANDES_NMI
	select CPU_HAS_ANDES_PFT
	select CPU_HAS_ANDES_PMA
	select CPU_HAS_DCACHE
	select CPU_HAS_ICACHE
	imply RISCV_PMP

config CPU_ANDES_A46
	def_bool DT_HAS_ANDESTECH_A46_ENABLED
	select RISCV_PRIVILEGED
	select RISCV_SOC_HAS_GP_RELATIVE_ADDRESSING
	select CPU_HAS_ANDES_EXECIT
	select CPU_HAS_ANDES_HSP
	select CPU_HAS_ANDES_HWDSP
	select CPU_HAS_ANDES_NMI
	select CPU_HAS_ANDES_PFT
	select CPU_HAS_ANDES_PMA
	select CPU_HAS_DCACHE
	select CPU_HAS_ICACHE
	imply RISCV_PMP
	imply RISCV_CUSTOM_CSR_ANDES_NEXECIT

config CPU_ANDES_AX46
	def_bool DT_HAS_ANDESTECH_AX46_ENABLED
	select RISCV_PRIVILEGED
	select RISCV_SOC_HAS_GP_RELATIVE_ADDRESSING
	select CPU_HAS_ANDES_EXECIT
	select CPU_HAS_ANDES_HSP
	select CPU_HAS_ANDES_HWDSP
	select CPU_HAS_ANDES_NMI
	select CPU_HAS_ANDES_PFT
	select CPU_HAS_ANDES_PMA
	select CPU_HAS_DCACHE
	select CPU_HAS_ICACHE
	imply RISCV_PMP
	imply RISCV_CUSTOM_CSR_ANDES_NEXECIT

config CPU_ANDES_AX65
	def_bool DT_HAS_ANDESTECH_AX65_ENABLED
	select RISCV_PRIVILEGED
	select RISCV_SOC_HAS_GP_RELATIVE_ADDRESSING
	select CPU_HAS_ANDES_NMI
	select CPU_HAS_ANDES_PFT
	select CPU_HAS_ANDES_PMA
	select CPU_HAS_DCACHE
	select CPU_HAS_ICACHE
	imply RISCV_PMP
```

## arch/tricore/Kconfig
```kconfig
# SPDX-FileCopyrightText: Copyright (c) 2024 Infineon Technologies AG,
# SPDX-FileCopyrightText: or an affiliate of Infineon Technologies AG. All rights reserved.
# SPDX-FileCopyrightText: Copyright (c) 2026 Linumiz
#
# SPDX-License-Identifier: Apache-2.0

menu "TriCore Architecture Options"
	depends on TRICORE

config ARCH
	string
	default "tricore"

config CPU_TC162
	bool
	select CPU_HAS_FPU
	imply FPU

config CPU_TC18
	bool

config TRICORE_CSA_COUNT
	int "Number of Context Save Areas allocated"
	default 256
	help
	  This option controls the number of Context Save Areas (CSAs) allocated by the
	  kernel. CSAs are used to store the upper and lower context information during
	  function calls and interrupts. The default value of 256 is typically sufficient
	  for most applications, but it can be increased if your application has a large
	  number of nested function calls, interrupts or threads.

config TRICORE_CSA_FCD_RESERVE
	int "Context save areas reserved below LCX for the FCD trap handler"
	default 64
	help
	  Number of Context Save Areas kept between the LCX limit register and
	  the end of the free list. When a context save reaches LCX the FCD
	  (Free Context list Depletion) trap fires and its handler runs out of
	  this reserve. The ISA requires at least two, plus one per call the
	  handler makes. The default leaves room for the fault and thread-abort
	  path so depletion is recovered instead of cascading into the
	  non-recoverable FCU trap.

config TRICORE_RESET_TRAMPOLINE
	bool "Trampoline to jump to cached address"
	default y
	help
	  Enable startup trampoline function which jumps from
	  any address (e.g. no cached) to the actual startup
	  function.

menu "TriCore Processor Options"

config CPU_HAS_CUSTOM_FIXED_SOC_MPU_REGIONS
	bool "Custom fixed SoC MPU region definition"
	help
	  If enabled, the SoC defines and configures its own fixed MPU regions in
	  the SoC layer. These fixed MPU regions are programmed at boot time and
	  typically set the default access policies for flash and SRAM.

config TRICORE_MPU
	bool "TriCore MPU Support"
	select THREAD_STACK_INFO
	select CPU_HAS_MPU
	select MPU
	select MPU_REQUIRES_POWER_OF_TWO_ALIGNMENT
	select SRAM_REGION_PERMISSIONS
	help
	  Enable the TriCore Memory Protection Unit. The MPU enforces per-region
	  read, write and execute access permissions.

if TRICORE_MPU

config TRICORE_MPU_CODE_REGIONS
	int "Number of MPU code regions"
	default 8
	help
	  Number of code-protection regions (CPRs) supported by the MPU on this
	  SoC. Used to bound region allocation tables at compile time.

config TRICORE_MPU_DATA_REGIONS
	int "Number of MPU data regions"
	default 16
	help
	  Number of data-protection regions (DPRs) supported by the MPU on this
	  SoC.

config TRICORE_MPU_PROTECTION_SETS
	int "Number of MPU protection sets"
	default 4
	help
	  Number of protection sets (PRS) supported by the MPU on this SoC. PRS 0
	  is used by kernel and ISR contexts.

endif # TRICORE_MPU

config CPU_HAS_TRICORE_VIRTUALIZATION
	bool
	depends on CPU_TC18
	help
	  Selected by SoCs whose TriCore 1.8 core implements the hypervisor
	  extension. The core leaves virtualization mode at reset.

endmenu

config GEN_ISR_TABLES
	default y

config GEN_IRQ_VECTOR_TABLE
	default n

config NUM_IRQ_PRIORITIES
	int
	default 256

endmenu
```

## boards/3dr/control_n1/Kconfig.control_n1
```kconfig
# SPDX-FileCopyrightText: Copyright The Zephyr Project Contributors
# SPDX-License-Identifier: Apache-2.0

config BOARD_CONTROL_N1
	select SOC_STM32H743XX
```

## boards/3dr/control_n1/board.yml
```yaml
# SPDX-FileCopyrightText: Copyright The Zephyr Project Contributors
# SPDX-License-Identifier: Apache-2.0

board:
  name: control_n1
  full_name: Control N1
  vendor: 3dr
  socs:
    - name: stm32h743xx
      variants:
        - name: bare
```

## boards/Kconfig.v2
```kconfig
# Copyright (c) 2022-2024 Nordic Semiconductor ASA

# SPDX-License-Identifier: Apache-2.0

BOARD_STRING := $(normalize_upper,$(BOARD))
BOARD_TARGET_STRING := $(normalize_upper,$(BOARD)/$(BOARD_QUALIFIERS))

config BOARD_$(BOARD_STRING)
	def_bool y
	help
	  Kconfig symbol identifying the board.

config BOARD_$(BOARD_TARGET_STRING)
	def_bool y
	help
	  Kconfig symbol identifying the board target.

config BOARD_QUALIFIERS
	string
	default "$(BOARD_QUALIFIERS)"
	help
	  Contains the qualifiers of the board being used without the name of the board itself.

	  For example, if building for ``nrf5340dk/nrf5340/cpuapp`` then this will contain the
	  value ``nrf5340/cpuapp``.

config BOARD_SELECTOR
	bool
	default y
	help
	  This is a common Kconfig to all boards that allows board directories containing multiple
	  boards to select Kconfigs from a common base Kconfig. This Kconfig is for usage inside
	  of board folders only and must not be used outside of it.

osource "$(KCONFIG_BOARD_DIR)/Kconfig.$(BOARD)"
```

## boards/abov/a31xxxx/a31c15x/stk_a31c156_rln_a/Kconfig.stk_a31c156_rln_a
```kconfig
# Copyright (c) 2026 ABOV Semiconductor Co., Ltd.
# SPDX-License-Identifier: Apache-2.0

config BOARD_STK_A31C156_RLN_A
	select SOC_A31C156
```

## boards/abov/a31xxxx/a31c15x/stk_a31c156_rln_a/board.yml
```yaml
board:
  name: stk_a31c156_rln_a
  full_name: STK-A31C156-RLN-A
  vendor: abov
  socs:
    - name: a31c156
```

## boards/adafruit/feather_esp32s2/Kconfig.defconfig
```kconfig
# Copyright (c) 2025 Philipp Steiner
# SPDX-License-Identifier: Apache-2.0

if BOARD_ADAFRUIT_FEATHER_ESP32S2_TFT || BOARD_ADAFRUIT_FEATHER_ESP32S2_TFT_REVERSE

if DISPLAY

if LVGL

choice LV_COLOR_FORMAT_DEFAULT
	default LV_COLOR_FORMAT_RGB565
endchoice

config LV_COLOR_16_SWAP
	default y

endif # LVGL

endif # DISPLAY

endif # BOARD_ADAFRUIT_FEATHER_ESP32S2_TFT || BOARD_ADAFRUIT_FEATHER_ESP32S2_TFT_REVERSE
```

## boards/adafruit/feather_esp32s3/Kconfig.defconfig
```kconfig
#
# Copyright The Zephyr Project Contributors
#
# SPDX-License-Identifier: Apache-2.0
#

configdefault MAIN_STACK_SIZE
	default 2048
```

## boards/adafruit/feather_rfm95_rp2040/Kconfig.defconfig
```kconfig
# Copyright (c) 2022 Peter Johanson
# SPDX-License-Identifier: Apache-2.0

if BOARD_ADAFRUIT_FEATHER_RFM95_RP2040

if I2C_DW

config I2C_DW_CLOCK_SPEED
	default 125

endif # I2C_DW

endif # BOARD_ADAFRUIT_FEATHER_RFM95_RP2040
```

## boards/adafruit/macropad_rp2040/Kconfig.defconfig
```kconfig
# Copyright (c) 2025 Benjamin Cabé <benjamin@zephyrproject.org>
# SPDX-License-Identifier: Apache-2.0

if BOARD_ADAFRUIT_MACROPAD_RP2040

if I2C_DW

config I2C_DW_CLOCK_SPEED
	default 125

endif # I2C_DW

endif # BOARD_ADAFRUIT_MACROPAD_RP2040
```

## boards/adafruit/qt_py_esp32s3/adafruit_qt_py_esp32s3_appcpu_psram_defconfig
```kconfig
# Copyright (c) 2024 Ian Wakely
# SPDX-License-Identifier: Apache-2.0

CONFIG_ESP_SPIRAM=y
```
