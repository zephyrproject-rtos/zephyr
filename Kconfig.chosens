## arch/arm/core/arm9/Kconfig
```kconfig
# ARM9 platform configuration options

# Copyright (C) 2025-2026 Microchip Technology Inc. and its subsidiaries

# SPDX-License-Identifier: Apache-2.0

config CPU_ARM926EJ_S
	bool
	select ARMV5TEJ
	select CPU_AARCH32_ARM9
	select CPU_HAS_MMU
	help
	  This option signifies the use of a ARM926EJ-S CPU.

config CPU_XSCALE
	bool
	select ARMV5TE
	select CPU_AARCH32_ARM9
	select CPU_HAS_MMU
	help
	  This option signifies the use of an Intel/Marvell XScale (PXA2xx,
	  PXA3xx, IXP) CPU. XScale implements ARMv5TE with an ARM926-compatible
	  CP15 programmer's model, but adds its own cache and coprocessor 0
	  extensions.

config ARMV5TEJ
	bool
	select ARMV5TE
	help
	  This option signifies the use of a ARMv5TEJ CPU.

config ARMV5TE
	bool
	select ARMV5T
	help
	  This option signifies the use of a ARMv5TE CPU.

config ARMV5T
	bool
	select ARMV5
	help
	  This option signifies the use of a ARMv5T CPU.

config ARMV5
	bool
	help
	  This option signifies the use of a ARMv5 CPU.

if ARMV5

config ARMV5_EXCEPTION_STACK_SIZE
	int "Undefined Instruction and Abort stack size (in bytes)"
	default 256
	help
	  This option specifies the size of the stack used by the undefined
	  instruction and data abort exception handlers.

config ARMV5_FIQ_STACK_SIZE
	int "FIQ stack size (in bytes)"
	default 256
	help
	  This option specifies the size of the stack used by the FIQ handler.

config ARMV5_SVC_STACK_SIZE
	int "SVC stack size (in bytes)"
	default 512
	help
	  This option specifies the size of the stack used by the SVC handler.

config ARMV5_SYS_STACK_SIZE
	int "SYS stack size (in bytes)"
	default 1024
	help
	  This option specifies the size of the stack used by the system mode.

config GEN_ISR_TABLES
	default y

config GEN_IRQ_VECTOR_TABLE
	default n

config DCACHE_LINE_SIZE
	depends on CPU_HAS_DCACHE
	default 32

config ICACHE_LINE_SIZE
	depends on CPU_HAS_ICACHE
	default 32

config ARMV5_FLAT_MMU
	bool "Flat ARMv5 MMU mapping"
	depends on CPU_HAS_MMU && !ARM_AARCH32_MMU
	default y
	help
	  Build a flat (identity) translation table out of 1 MB sections and
	  turn the MMU on during boot. The MMU is what gives memory its
	  cacheability attributes, so the data and instruction caches can only
	  be used when this is enabled.

	  This is deliberately *not* the full Zephyr memory management layer
	  (CONFIG_ARM_AARCH32_MMU): there is no arch_mem_map(), no demand
	  paging and no per-region permissions, just a fixed map described by
	  the SoC. Turn it off, and enable CONFIG_ARM_AARCH32_MMU instead,
	  once the VMSA-v5 back end of arch/arm/core/mmu grows an ARMv5
	  implementation.

	  It is also required for CONFIG_ARMV5_HIGH_VECTORS, since the
	  0xFFFF0000 vector page has to be mapped somewhere.

config ARMV5_HIGH_VECTORS
	bool "Place the exception vectors at 0xFFFF0000"
	depends on ARMV5_FLAT_MMU
	help
	  ARMv5 cores fetch their exception vectors from either 0x00000000 or
	  0xFFFF0000, selected by SCTLR.V. Enable this on SoCs where address
	  0x00000000 is read-only (mask ROM or NOR flash) and therefore cannot
	  hold a vector table, which is the case for most XScale designs.

	  When disabled, the vector block is installed at 0x00000000, which
	  requires RAM to be present (or aliased) there.

config CPU_HAS_DCACHE
	default y

config CPU_HAS_ICACHE
	default y

config ARMV5_IRQ_NESTING
	bool "Allow interrupts to nest"
	help
	  Unmask IRQs while an ISR runs, so that a second interrupt can
	  preempt it.

	  This is only safe when the SoC's interrupt controller masks the
	  active source between z_soc_irq_get_active() and z_soc_irq_eoi(),
	  the way a GIC does. Level sensitive controllers such as the ARM
	  PL190 or the PXA2xx ICU keep the line asserted until the peripheral
	  itself is serviced, so unmasking early would re-enter the handler
	  immediately and recurse until the interrupt stack overflows.

config MP_MAX_NUM_CPUS
	default 1

config STACK_ALIGN_DOUBLE_WORD
	default y

endif # ARMV5
```

## arch/arm64/core/efi/Kconfig
```kconfig
# Copyright (c) 2026 BayLibre SAS
# SPDX-License-Identifier: Apache-2.0

config ARM64_EFI_MEMMAP_SIZE
	int "Size of the UEFI memory map buffer"
	depends on BUILD_OUTPUT_EFI
	default 8192
	help
	  The EFI stub stores the UEFI memory map in a buffer of this size
	  before calling ExitBootServices(). arm64_efi_boot_info_get() returns
	  it. The stub returns to UEFI with an error if the map does not fit.
```

## arch/hexagon/Kconfig
```kconfig
# SPDX-License-Identifier: Apache-2.0
# Copyright (c) Qualcomm Technologies, Inc. and/or its subsidiaries.

menu "Hexagon Options"
	depends on HEXAGON

config ARCH
	string
	default "hexagon"

config GEN_IRQ_VECTOR_TABLE
	default n

config ARCH_HAS_STACKWALK
	bool
	default y
	help
	  Internal config to indicate that the arch_stack_walk() API is implemented
	  and it can be enabled.

source "arch/hexagon/core/Kconfig"

endmenu
```

## arch/openrisc/Kconfig
```kconfig
#
# Copyright (c) 2025 NVIDIA Corporation <jholdsworth@nvidia.com>
#
# SPDX-License-Identifier: Apache-2.0
#

menu "OpenRISC Options"
	depends on OPENRISC

config ARCH
	string
	default "openrisc"

config GEN_ISR_TABLES
	default y

config GEN_IRQ_VECTOR_TABLE
	default n

config GEN_SW_ISR_TABLE
	default y
	depends on GEN_ISR_TABLES

config ARCH_HAS_SINGLE_THREAD_SUPPORT
	default y if !SMP

config OPENRISC_SOC_IRQ_DISPATCH
	bool
	depends on GEN_SW_ISR_TABLE
	help
	  Selected by SoCs whose external interrupt controller is not the
	  core PIC. The external interrupt exception calls
	  z_soc_irq_dispatch() instead of reading PICSR, and irq_enable(),
	  irq_disable() and irq_is_enabled() call z_soc_irq_enable(),
	  z_soc_irq_disable() and z_soc_irq_is_enabled(). PICMR is not used.

config OPENRISC_SOC_NUM_IRQS
	int "Number of SoC interrupt lines"
	default 32
	depends on OPENRISC_SOC_IRQ_DISPATCH
	help
	  Number of interrupt lines handled by the SoC dispatcher. This is
	  the size of the software ISR table.

endmenu
```

## arch/rh850/Kconfig
```kconfig
# SPDX-FileCopyrightText: Copyright (c) 2026 Linumiz
#
# SPDX-License-Identifier: Apache-2.0

menu "RH850 Architecture Options"
	depends on RH850

config ARCH
	string
	default "rh850"

config CPU_G4KH
	bool
	select CPU_HAS_FPU_DOUBLE_PRECISION
	help
	  RH850 G4KH CPU core (RH850/U2C).

config CPU_G4MH
	bool
	select CPU_HAS_FPU_DOUBLE_PRECISION
	help
	  RH850 G4MH CPU core (RH850/U2A, RH850/U2B).

config CPU_HAS_FXU
	bool
	depends on CPU_G4MH
	help
	  The CPU has the extended floating-point unit (FXU).

config FXU
	bool "Extended floating-point unit (FXU)"
	depends on FPU && CPU_HAS_FXU
	default y
	help
	  Build with -mfxu. A thread gets FXU access with its first FXU
	  instruction; from then on its wr0-wr31, FXSR and FXXC are saved and
	  restored at context switches. FXU use in interrupt context is a
	  fatal error.

config GEN_ISR_TABLES
	default y

config GEN_IRQ_VECTOR_TABLE
	default n

config NUM_IRQ_PRIO_LEVELS
	int
	range 1 64
	default 64 if CPU_G4MH
	default 16
	help
	  Number of interrupt priority levels. With more than 16 the CPU runs
	  with the priority level extension (INTCFG.EPL = 1).

config RH850_MPU_ENTRIES
	int
	range 1 32
	help
	  Number of MPU entries of the CPU (MPCFG.NMPUE + 1). The reset code
	  initializes all of them.

endmenu
```

## arch/riscv/custom/andes/Kconfig
```kconfig
# Copyright (c) 2025 Andes Technology Corporation
# SPDX-License-Identifier: Apache-2.0

config CPU_HAS_ANDES_EXECIT
	bool
	help
	  The AndesCore supports EXEC.IT instruction.

config RISCV_CUSTOM_CSR_ANDES_EXECIT
	bool "Andes V5 EXEC.IT extension"
	depends on CPU_HAS_ANDES_EXECIT
	depends on RISCV_ISA_EXT_C
	depends on !RISCV_GENERIC_TOOLCHAIN
	depends on !LINKER_USE_NO_RELAX
	help
	  The EXEC.IT extension (Execution on Instruction Table) generate
	  a look-up table and replaces suitable 32-bit instructions with
	  the 16-bit "exec.it <INDEX>".

config RISCV_CUSTOM_CSR_ANDES_NEXECIT
	bool "Andes V5 New EXEC.IT opcode encoding"
	depends on RISCV_CUSTOM_CSR_ANDES_EXECIT
	help
	  The New EXEC.IT instruction is an alias of EXEC.IT with different
	  opcode encoding.

config CPU_HAS_ANDES_HWDSP
	bool
	help
	  The AndesCore supports hardware DSP extension.

config RISCV_CUSTOM_CSR_ANDES_HWDSP
	bool "AndeStar V5 DSP ISA"
	depends on CPU_HAS_ANDES_HWDSP
	depends on !RISCV_GENERIC_TOOLCHAIN
	help
	  This option enables the AndeStar v5 hardware DSP, in order to
	  support using the DSP instructions.

config CPU_HAS_ANDES_PFT
	bool
	help
	  The AndesCore supports PowerBrake extension.

config RISCV_CUSTOM_CSR_ANDES_PFT
	bool "Andes V5 PowerBrake extension"
	depends on CPU_HAS_ANDES_PFT
	help
	  The PowerBrake extension throttles performance by reducing instruction
	  executing rate.

config CPU_HAS_ANDES_PMA
	bool
	help
	  The AndesCore supports Programmable PMA.

config RISCV_CUSTOM_CSR_ANDES_PMA
	bool "Andes V5 Physical Memory Attribute (PMA)"
	depends on CPU_HAS_ANDES_PMA
	select ARCH_HAS_NOCACHE_MEMORY_SUPPORT
	help
	  This option enables the Andes V5 PMA, in order to support SW to
	  configure physical memory attribute by PMA CSRs. The address
	  matching of Andes V5 PMA is like RISC-V PMP NAPOT mode
	  (power-of-two alignment).

config RISCV_CUSTOM_CSR_ANDES_PMA_NAPOT_GRANULARITY
	int
	depends on RISCV_CUSTOM_CSR_ANDES_PMA
	default 4096
	help
	  Minimum size (and alignment) of an PMA region. Use this symbol
	  to guarantee minimum size and alignment of PMA regions.

config CPU_HAS_ANDES_HSP
	bool
	help
	  The AndesCore supports StackSafe extension.

config RISCV_CUSTOM_CSR_ANDES_HSP
	bool "Andes V5 StackSafe extension"
	depends on CPU_HAS_ANDES_HSP
	select ARCH_HAS_STACK_PROTECTION
	select RISCV_HAS_CUSTOM_STACK_GUARD
	help
	  This option enables the Andes V5 StackSafe hardware stack protection,
	  in order to support custom stack guard.

config CPU_HAS_ANDES_NMI
	bool
	help
	  The AndesCore supports the Andes NMI extension.

config RISCV_CUSTOM_CSR_ANDES_NMI
	bool "Andes V5 NMI extension"
	depends on CPU_HAS_ANDES_NMI
	help
	  On AndeStar V5 cores such as N25/N25F the NMI vector base address
	  register (mnvec) is read-only and reads back the reset_vector input
	  signal, so an NMI enters at __reset and the boot path destroys the
	  state the NMI was raised to let software examine.

	  Enable this to tell a reset (mcause and mepc both 0) from an NMI
	  (mcause 1, interrupted PC in mepc) and branch to _andes_nmi_entry.

	  A SoC enabling NMIs is expected to provide its own _andes_nmi_entry,
	  overriding the weak one, and to set up what that handler needs, such
	  as an NMI stack in mscratch, before enabling any NMI source. The weak
	  default only parks the core.

config RISCV_CUSTOM_ANDES_PLIC_IPI
	bool "Andes PLIC-SWINT based IPI"
	depends on RISCV_SMP_IPI_CUSTOM
	depends on $(dt_nodelabel_enabled_with_compat,plic_sw,$(DT_COMPAT_ANDESTECH_NCEPLIC100))
	depends on PLIC_SUPPORTS_SOFT_INTERRUPT
	select PLIC_IRQ_AFFINITY if MP_MAX_NUM_CPUS > 1
	select DYNAMIC_INTERRUPTS
	help
	  Use PLIC-SWINT (PLIC-based software interrupts) for the custom
	  Inter-Processor Interrupt implementation on Andes cores.

config RISCV_CUSTOM_ANDES_MORE_SPIN_RELAX_NOPS
	bool "Use Andes specific arch_spin_relax() with more NOPs"
	depends on RISCV_CUSTOM_ANDES_PLIC_IPI
	depends on MP_MAX_NUM_CPUS > 1
	help
	  Add some NOPs after failure to lock a spinlock. This gives
	  the bus extra time to synchronize the RCW transaction
	  among CPUs.

config RISCV_CUSTOM_ANDES_NUM_SPIN_RELAX_NOPS
	int "Number of NOPs to be used in Andes specific arch_spin_relax()"
	depends on RISCV_CUSTOM_ANDES_MORE_SPIN_RELAX_NOPS
	default 128 if MP_MAX_NUM_CPUS = 2
	default 192 if MP_MAX_NUM_CPUS = 3
	default 256 if MP_MAX_NUM_CPUS = 4
	default 320 if MP_MAX_NUM_CPUS = 5
	default 384 if MP_MAX_NUM_CPUS = 6
	default 448 if MP_MAX_NUM_CPUS = 7
	default 512
	help
	  Specify the number of NOPs in Andes specific arch_spin_relax().

config RISCV_CUSTOM_ANDES_SPIN_RELAX_NOPS_JITTER
	bool "Add jitter to the NOPs in Andes specific arch_spin_relax()"
	depends on RISCV_CUSTOM_ANDES_MORE_SPIN_RELAX_NOPS
	help
	  Add a bounded jitter derived from mcycle to the number of NOPs in
	  arch_spin_relax(). This staggers the RCW retries of the CPUs to
	  further avoid them hitting the RCW transactions at the same time.
```
