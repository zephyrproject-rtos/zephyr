## tests/unit/bluetooth/at/testcase.yaml
```yaml
tests:
  test:
    build_only: true
    min_ram: 16
    platform_whitelist: qemu_x86_iamcu qemu_cortex_m3
    tags: bluetooth
```

## tests/unit/cbprintf/testcase.yaml
```yaml
common:
  tags: cbprintf
  type: unit

tests:
  utilities.prf.m32v00: # REDUCED
    extra_args: M64_MODE=0
    extra_configs:
      - CONFIG_CBPRINTF_REDUCED_INTEGRAL=y

  utilities.prf.m32v01: # FULL
    extra_args: M64_MODE=0
    extra_configs:
      - CONFIG_CBPRINTF_FULL_INTEGRAL=y

  utilities.prf.m32v02: # REDUCED + FP
    extra_args: M64_MODE=0
    extra_configs:
      - CONFIG_CBPRINTF_REDUCED_INTEGRAL=y
      - CONFIG_CBPRINTF_FP_SUPPORT=y

  utilities.prf.m32v03: # FULL + FP
    extra_args: M64_MODE=0
    extra_configs:
      - CONFIG_CBPRINTF_FULL_INTEGRAL=y
      - CONFIG_CBPRINTF_FP_SUPPORT=y

  utilities.prf.m32v07: # FULL + FP + FP_A
    extra_args: M64_MODE=0
    extra_configs:
      - CONFIG_CBPRINTF_FULL_INTEGRAL=y
      - CONFIG_CBPRINTF_FP_SUPPORT=y
      - CONFIG_CBPRINTF_FP_A_SUPPORT=y

  utilities.prf.m32v08: # %n
    extra_args: M64_MODE=0
    extra_configs:
      - CONFIG_CBPRINTF_REDUCED_INTEGRAL=y
      - CONFIG_CBPRINTF_N_SPECIFIER=y

  utilities.prf.m32v80: # NANO
    extra_args: M64_MODE=0
    extra_configs:
      - CONFIG_CBPRINTF_REDUCED_INTEGRAL=y
      - CONFIG_CBPRINTF_NANO=y

  utilities.prf.m32v101: # FULL + LIBC
    extra_args: M64_MODE=0
    extra_configs:
      - CONFIG_CBPRINTF_FULL_INTEGRAL=y
      - CONFIG_CBPRINTF_LIBC_SUBSTS=y

  utilities.prf.m32v181: # NANO + FULL + LIBC
    extra_args: M64_MODE=0
    extra_configs:
      - CONFIG_CBPRINTF_FULL_INTEGRAL=y
      - CONFIG_CBPRINTF_NANO=y
      - CONFIG_CBPRINTF_LIBC_SUBSTS=y


  utilities.prf.m32v200: # PACKAGED REDUCED
    extra_args: M64_MODE=0 EXTRA_CPPFLAGS=-DVIA_TWISTER=0x200
    extra_configs:
      - CONFIG_CBPRINTF_REDUCED_INTEGRAL=y

  utilities.prf.m32v201: # PACKAGED FULL
    extra_args: M64_MODE=0 EXTRA_CPPFLAGS=-DVIA_TWISTER=0x200
    extra_configs:
      - CONFIG_CBPRINTF_FULL_INTEGRAL=y

  utilities.prf.m32v207: # PACKAGED FULL + FP + FP_A
    extra_args: M64_MODE=0 EXTRA_CPPFLAGS=-DVIA_TWISTER=0x200
    extra_configs:
      - CONFIG_CBPRINTF_FULL_INTEGRAL=y
      - CONFIG_CBPRINTF_FP_SUPPORT=y
      - CONFIG_CBPRINTF_FP_A_SUPPORT=y

  utilities.prf.m32v208: # PACKAGED %n
    extra_args: M64_MODE=0 EXTRA_CPPFLAGS=-DVIA_TWISTER=0x200
    extra_configs:
      - CONFIG_CBPRINTF_REDUCED_INTEGRAL=y

  utilities.prf.m32v281: # PACKAGED NANO + FULL
    extra_args: M64_MODE=0 EXTRA_CPPFLAGS=-DVIA_TWISTER=0x200
    extra_configs:
      - CONFIG_CBPRINTF_FULL_INTEGRAL=y
      - CONFIG_CBPRINTF_NANO=y

  utilities.prf.m32v1207: # PACKAGED FULL + FP + FP_A + PACKAGE_ALIGN_OFFSET
    extra_args: M64_MODE=0 EXTRA_CPPFLAGS=-DVIA_TWISTER=0x1200
    extra_configs:
      - CONFIG_CBPRINTF_FULL_INTEGRAL=y
      - CONFIG_CBPRINTF_FP_SUPPORT=y
      - CONFIG_CBPRINTF_FP_A_SUPPORT=y

  utilities.prf.m32va00: # PACKAGED REDUCED + AVOID_C_GENERIC
    extra_args: M64_MODE=0 EXTRA_CPPFLAGS=-DVIA_TWISTER=0xa00
    extra_configs:
      - CONFIG_CBPRINTF_REDUCED_INTEGRAL=y

  utilities.prf.m32va01: # PACKAGED FULL + AVOID_C_GENERIC
    extra_args: M64_MODE=0 EXTRA_CPPFLAGS=-DVIA_TWISTER=0xa00
    extra_configs:
      - CONFIG_CBPRINTF_FULL_INTEGRAL=y

  utilities.prf.m32va07: # PACKAGED FULL + FP + FP_A + AVOID_C_GENERIC
    extra_args: M64_MODE=0 EXTRA_CPPFLAGS=-DVIA_TWISTER=0xa00
    extra_configs:
      - CONFIG_CBPRINTF_FULL_INTEGRAL=y
      - CONFIG_CBPRINTF_FP_SUPPORT=y
      - CONFIG_CBPRINTF_FP_A_SUPPORT=y

  utilities.prf.m32va08: # PACKAGED %n + AVOID_C_GENERIC
    extra_args: M64_MODE=0 EXTRA_CPPFLAGS=-DVIA_TWISTER=0xa00
    extra_configs:
      - CONFIG_CBPRINTF_REDUCED_INTEGRAL=y

  utilities.prf.m32va81: # PACKAGED NANO + FULL + AVOID_C_GENERIC
    extra_args: M64_MODE=0 EXTRA_CPPFLAGS=-DVIA_TWISTER=0xa00
    extra_configs:
      - CONFIG_CBPRINTF_FULL_INTEGRAL=y
      - CONFIG_CBPRINTF_NANO=y

  utilities.prf.m64v00: # m64
    extra_args: M64_MODE=1
    extra_configs:
      - CONFIG_CBPRINTF_REDUCED_INTEGRAL=y

  utilities.prf.m64v01: # m64 FULL
    extra_args: M64_MODE=1
    extra_configs:
      - CONFIG_CBPRINTF_FULL_INTEGRAL=y

  utilities.prf.m64v03: # m64 FULL & FP
    extra_args: M64_MODE=1
    extra_configs:
      - CONFIG_CBPRINTF_FULL_INTEGRAL=y
      - CONFIG_CBPRINTF_FP_SUPPORT=y

  utilities.prf.m64v17: # m64 FULL & FP & FP_A
    extra_args: M64_MODE=1
    extra_configs:
      - CONFIG_CBPRINTF_FULL_INTEGRAL=y
      - CONFIG_CBPRINTF_FP_SUPPORT=y
      - CONFIG_CBPRINTF_FP_A_SUPPORT=y

  utilities.prf.m64v80: # NANO
    extra_args: M64_MODE=1
    extra_configs:
      - CONFIG_CBPRINTF_REDUCED_INTEGRAL=y
      - CONFIG_CBPRINTF_NANO=y

  utilities.prf.m64v101: # FULL + LIBC
    extra_args: M64_MODE=1
    extra_configs:
      - CONFIG_CBPRINTF_FULL_INTEGRAL=y
      - CONFIG_CBPRINTF_LIBC_SUBSTS=y

  utilities.prf.m64v181: # NANO + FULL + LIBC
    extra_args: M64_MODE=1
    extra_configs:
      - CONFIG_CBPRINTF_FULL_INTEGRAL=y
      - CONFIG_CBPRINTF_NANO=y
      - CONFIG_CBPRINTF_LIBC_SUBSTS=y

  utilities.prf.m64v200: # PACKAGED REDUCED
    extra_args: M64_MODE=1 EXTRA_CPPFLAGS=-DVIA_TWISTER=0x200
    extra_configs:
      - CONFIG_CBPRINTF_REDUCED_INTEGRAL=y

  utilities.prf.m64v201: # PACKAGED FULL
    extra_args: M64_MODE=1 EXTRA_CPPFLAGS=-DVIA_TWISTER=0x200
    extra_configs:
      - CONFIG_CBPRINTF_FULL_INTEGRAL=y

  utilities.prf.m64v207: # PACKAGED FULL + FP + FP_A
    extra_args: M64_MODE=1 EXTRA_CPPFLAGS=-DVIA_TWISTER=0x200
    extra_configs:
      - CONFIG_CBPRINTF_FULL_INTEGRAL=y
      - CONFIG_CBPRINTF_FP_SUPPORT=y
      - CONFIG_CBPRINTF_FP_A_SUPPORT=y

  utilities.prf.m64v208: # PACKAGED %n
    extra_args: M64_MODE=1 EXTRA_CPPFLAGS=-DVIA_TWISTER=0x200
    extra_configs:
      - CONFIG_CBPRINTF_REDUCED_INTEGRAL=y
      - CONFIG_CBPRINTF_N_SPECIFIER=y

  utilities.prf.m64v281: # PACKAGED NANO + FULL
    extra_args: M64_MODE=1 EXTRA_CPPFLAGS=-DVIA_TWISTER=0x200
    extra_configs:
      - CONFIG_CBPRINTF_FULL_INTEGRAL=y
      - CONFIG_CBPRINTF_NANO=y

  utilities.prf.m64v600: # PACKAGED REDUCED + LONG_DOUBLE PACKAGING
    extra_args: M64_MODE=1 EXTRA_CPPFLAGS=-DVIA_TWISTER=0x200
    extra_configs:
      - CONFIG_CBPRINTF_REDUCED_INTEGRAL=y
      - CONFIG_CBPRINTF_PACKAGE_LONGDOUBLE=y

  utilities.prf.m64v601: # PACKAGED FULL + LONG_DOUBLE PACKAGING
    extra_args: M64_MODE=1 EXTRA_CPPFLAGS=-DVIA_TWISTER=0x200
    extra_configs:
      - CONFIG_CBPRINTF_FULL_INTEGRAL=y
      - CONFIG_CBPRINTF_PACKAGE_LONGDOUBLE=y

  utilities.prf.m64v607: # PACKAGED FULL + FP + FP_A + LONG_DOUBLE PACKAGING
    extra_args: M64_MODE=1 EXTRA_CPPFLAGS=-DVIA_TWISTER=0x200
    extra_configs:
      - CONFIG_CBPRINTF_FULL_INTEGRAL=y
      - CONFIG_CBPRINTF_FP_SUPPORT=y
      - CONFIG_CBPRINTF_FP_A_SUPPORT=y
      - CONFIG_CBPRINTF_PACKAGE_LONGDOUBLE=y

  utilities.prf.m64v608: # PACKAGED %n + LONG_DOUBLE PACKAGING
    extra_args: M64_MODE=1 EXTRA_CPPFLAGS=-DVIA_TWISTER=0x200
    extra_configs:
      - CONFIG_CBPRINTF_REDUCED_INTEGRAL=y
      - CONFIG_CBPRINTF_N_SPECIFIER=y
      - CONFIG_CBPRINTF_PACKAGE_LONGDOUBLE=y

  utilities.prf.m64v681: # PACKAGED NANO + FULL + LONG_DOUBLE PACKAGING
    extra_args: M64_MODE=1 EXTRA_CPPFLAGS=-DVIA_TWISTER=0x200
    extra_configs:
      - CONFIG_CBPRINTF_FULL_INTEGRAL=y
      - CONFIG_CBPRINTF_NANO=y
      - CONFIG_CBPRINTF_PACKAGE_LONGDOUBLE=y

  # PACKAGED FULL + FP + FP_A + LONG_DOUBLE PACKAGING + PACKAGE_ALIGN_OFFSET
  utilities.prf.m64v1607:
    extra_args: M64_MODE=1 EXTRA_CPPFLAGS=-DVIA_TWISTER=0x1200
    extra_configs:
      - CONFIG_CBPRINTF_FULL_INTEGRAL=y
      - CONFIG_CBPRINTF_FP_SUPPORT=y
      - CONFIG_CBPRINTF_FP_A_SUPPORT=y
      - CONFIG_CBPRINTF_PACKAGE_LONGDOUBLE=y

  utilities.prf.m64va00: # PACKAGED REDUCED + AVOID_C_GENERIC
    extra_args: M64_MODE=1 EXTRA_CPPFLAGS=-DVIA_TWISTER=0xa00
    extra_configs:
      - CONFIG_CBPRINTF_REDUCED_INTEGRAL=y

  utilities.prf.m64va01: # PACKAGED FULL + AVOID_C_GENERIC
    extra_args: M64_MODE=1 EXTRA_CPPFLAGS=-DVIA_TWISTER=0xa00
    extra_configs:
      - CONFIG_CBPRINTF_FULL_INTEGRAL=y

  utilities.prf.m64va07: # PACKAGED FULL + FP + FP_A + AVOID_C_GENERIC
    extra_args: M64_MODE=1 EXTRA_CPPFLAGS=-DVIA_TWISTER=0xa00
    extra_configs:
      - CONFIG_CBPRINTF_FULL_INTEGRAL=y
      - CONFIG_CBPRINTF_FP_SUPPORT=y
      - CONFIG_CBPRINTF_FP_A_SUPPORT=y

  utilities.prf.m64va08: # PACKAGED %n + AVOID_C_GENERIC
    extra_args: M64_MODE=1 EXTRA_CPPFLAGS=-DVIA_TWISTER=0xa00
    extra_configs:
      - CONFIG_CBPRINTF_REDUCED_INTEGRAL=y
      - CONFIG_CBPRINTF_N_SPECIFIER=y

  utilities.prf.m64va81: # PACKAGED NANO + FULL + AVOID_C_GENERIC
    extra_args: M64_MODE=1 EXTRA_CPPFLAGS=-DVIA_TWISTER=0xa00
    extra_configs:
      - CONFIG_CBPRINTF_FULL_INTEGRAL=y
      - CONFIG_CBPRINTF_NANO=y

  utilities.prf.m64v2200: # PACKAGED REDUCED + CBPRINTF_PACKAGE_ADD_STRING_IDXS
    extra_args: M64_MODE=1 EXTRA_CPPFLAGS=-DVIA_TWISTER=0x2200
    extra_configs:
      - CONFIG_CBPRINTF_REDUCED_INTEGRAL=y

  utilities.prf.m64v2201: # PACKAGED FULL + CBPRINTF_PACKAGE_ADD_STRING_IDXS
    extra_args: M64_MODE=1 EXTRA_CPPFLAGS=-DVIA_TWISTER=0x2200
    extra_configs:
      - CONFIG_CBPRINTF_FULL_INTEGRAL=y

  utilities.prf.m64v2207: # PACKAGED FULL + FP + FP_A + CBPRINTF_PACKAGE_ADD_STRING_IDXS
    extra_args: M64_MODE=1 EXTRA_CPPFLAGS=-DVIA_TWISTER=0x2200
    extra_configs:
      - CONFIG_CBPRINTF_FULL_INTEGRAL=y
      - CONFIG_CBPRINTF_FP_SUPPORT=y
      - CONFIG_CBPRINTF_FP_A_SUPPORT=y

  utilities.prf.m64v2208: # PACKAGED %n + CBPRINTF_PACKAGE_ADD_STRING_IDXS
    extra_args: M64_MODE=1 EXTRA_CPPFLAGS=-DVIA_TWISTER=0x2200
    extra_configs:
      - CONFIG_CBPRINTF_REDUCED_INTEGRAL=y
      - CONFIG_CBPRINTF_N_SPECIFIER=y

  utilities.prf.m64v2281: # PACKAGED NANO + FULL + CBPRINTF_PACKAGE_ADD_STRING_IDXS
    extra_args: M64_MODE=1 EXTRA_CPPFLAGS=-DVIA_TWISTER=0x2200
    extra_configs:
      - CONFIG_CBPRINTF_FULL_INTEGRAL=y
      - CONFIG_CBPRINTF_NANO=y
```

## tests/unit/crc/testcase.yaml
```yaml
tests:
  utilities.crc:
    tags:
      - crc
    type: unit
  utilities.crc.table256:
    tags:
      - crc
    type: unit
    extra_configs:
      - CONFIG_CRC32_K_4_2_TABLE_256=y
```

## tests/unit/i2c_dw_target_con/testcase.yaml
```yaml
tests:
  drivers.i2c.dw.target_con:
    tags:
      - drivers
      - i2c
    type: unit
```

## tests/unit/nhpot/testcase.yaml
```yaml
# Copyright 2023 Meta
# SPDX-License-Identifier: Apache-2.0

tests:
  utilities.nhpot:
    tags: nhpot
    type: unit
```

## tests/unit/pot/testcase.yaml
```yaml
# Copyright 2023 Meta
# SPDX-License-Identifier: Apache-2.0

tests:
  utilities.powers_of_two:
    tags: pot
    type: unit
```

## tests/unit/prf/testcase.yaml
```yaml
common:
  tags: prf
  type: unit

tests:
  utilities.prf-m32:
    extra_args: M64_MODE=0

  utilities.prf.m32ll:
    extra_args: M64_MODE=0 EXTRA_CPPFLAGS=-DCONFIG_LIB_OS_PRF_LL_SUPPORT

  utilities.prf.m64:
    extra_args: M64_MODE=1 EXTRA_CPPFLAGS=-DCONFIG_LIB_OS_PRF_LL_SUPPORT
```

## tests/unit/scripts/extract_dts_includes/testcase.yaml
```yaml
tests:
    test:
      tags: extract_dts_includes
      timeout: 5
      type: unit
```

## tests/unit/time_units/testcase.yaml
```yaml
common:
  tags: time_units
  type: unit
tests:
  utilities.time_units.z_tmcvt: {}
```

## tests/unit/timeutil/testcase.yaml
```yaml
common:
  tags: timeutil
  type: unit

tests:
  utilities.time:
    extra_args: M64_MODE=0

  utilities.time.64bit:
    extra_args: M64_MODE=1

  utilities.time.timeout32:
    extra_configs:
      - CONFIG_TIMEOUT_64BIT=n

  utilities.time.timeout64:
    extra_configs:
      - CONFIG_TIMEOUT_64BIT=y
```

## tests/uwb/testcase.yaml
```yaml
tests:
	uwb.api.native_sim:
		platform_allow:
			- native_sim
			- native_sim/native/64
		tags:
			- uwb
			- native_sim
		timeout: 60
		harness: ztest
		harness_config:
			type: one_line
			regex:
				- "PASS - test_device_reset"
				- "PASS - test_get_device_capabilities"
				- "PASS - test_get_device_info"
				- "PASS - test_get_device_state"
				- "PASS - test_session_state"
```

## tests/ztest/Kconfig
```kconfig
#
# Copyright (c) 2016 Intel Corporation
#
# SPDX-License-Identifier: Apache-2.0
#

config ZTEST
	bool "Zephyr testing framework"
	select TEST
	help
	  Enable the Zephyr testing framework. You should enable this only
	  if you're writing automated tests.

config ZTEST_STACKSIZE
	int "Test function thread stack size"
	depends on ZTEST
	default 1024

config ZTEST_FAIL_FAST
	bool "Abort on first failing test"
	depends on ZTEST
	help
	  Stop and abort on first failing test. Do not continue with other
	  tests that might be in the queue.

config ZTEST_ASSERT_VERBOSE
	int "Assertion verbosity level"
	depends on ZTEST
	default 1
	help
	  Set verbosity level for assertions.
	  Assertion verbosity levels:
	  0 Write only file and line for failed assertions
	  1 Write file, line number, function and reason for failed assertions
	  2 Log also successful assertions

config ZTEST_MOCKING
	bool "Mocking support functions"
	depends on ZTEST
	help
	  Enable mocking support for Ztest. This allows the test to set
	  return values and expected parameters to functions.

config ZTEST_PARAMETER_COUNT
	int "Count of parameters or return values reserved"
	depends on ZTEST_MOCKING
	default 1
	help
	  Maximum amount of concurrent return values / expected parameters.
```
