## CMakeLists.txt
```
# SPDX-License-Identifier: Apache-2.0

cmake_minimum_required(VERSION 3.28.0)
find_package(Zephyr REQUIRED HINTS $ENV{ZEPHYR_BASE})

# verify information from dependencies is available to extensions
add_library(dependency INTERFACE)
target_compile_definitions(dependency INTERFACE GLOBAL_OPT="set")

project(llext_edk_test LANGUAGES C)

target_sources(app PRIVATE src/main.c src/foo.c)
zephyr_include_directories(include)
zephyr_include_directories(${ZEPHYR_BASE}/boards/native/common)
target_link_libraries(app PUBLIC dependency)

if(EXTENSION_DIR)
    target_include_directories(app PRIVATE ${EXTENSION_DIR})
    target_compile_definitions(app PRIVATE LOAD_AND_RUN_EXTENSION)
endif()
```

## prj.conf
```kconfig
CONFIG_APPLICATION_DEFINED_SYSCALL=y
CONFIG_LLEXT=y
CONFIG_USERSPACE=y

CONFIG_MAIN_STACK_SIZE=2048
```

## src/main.c
```c
/*
 * Copyright (c) 2024 Intel Corporation
 *
 * SPDX-License-Identifier: Apache-2.0
 */

#include <app_api.h>

#include <zephyr/kernel.h>
#include <zephyr/llext/llext.h>
#include <zephyr/llext/buf_loader.h>
#include <zephyr/app_memory/mem_domain.h>

#ifdef LOAD_AND_RUN_EXTENSION
static const unsigned char extension_llext[] __aligned(8) = {
	#include <extension.inc>
};
static const size_t extension_llext_len = ARRAY_SIZE(extension_llext);
#endif

#define STACK_SIZE 1024
#define HEAP_SIZE 1024

#ifdef LOAD_AND_RUN_EXTENSION
struct k_thread kernel_thread, user_thread;

K_THREAD_STACK_DEFINE(stack_kernel, STACK_SIZE);
K_THREAD_STACK_DEFINE(stack_user, STACK_SIZE);

K_HEAP_DEFINE(heap_kernel, HEAP_SIZE);
K_HEAP_DEFINE(heap_user, HEAP_SIZE);

static void thread_entry(void *p1, void *p2, void *p3)
{
	int bar;
	int (*start_fn)(int) = p1;

	printk("Calling extension from %s\n",
	       k_is_user_context() ? "user" : "kernel");

	if (k_is_user_context()) {
		bar = 42;
	} else {
		bar = 43;
	}

	start_fn(bar);
}

void load_and_run_extension(int thread_flags, struct k_thread *thread,
			    struct k_mem_domain *domain,
			    k_thread_stack_t *stack, struct k_heap *heap,
			    struct llext **ext)
{
	struct llext_buf_loader buf_loader = LLEXT_BUF_LOADER(extension_llext,
							      extension_llext_len);
	struct llext_loader *loader = &buf_loader.loader;
	struct llext_load_param ldr_parm = LLEXT_LOAD_PARAM_DEFAULT;
	int (*start_fn)(int bar);

	llext_load(loader, "extension", ext, &ldr_parm);
	start_fn = llext_find_sym(&(*ext)->exp_tab, "start");

	llext_add_domain(*ext, domain);

	k_thread_create(thread, stack, STACK_SIZE,
			thread_entry, start_fn, NULL, NULL, -1,
			K_INHERIT_PERMS | thread_flags,
			K_FOREVER);
	k_mem_domain_add_thread(domain, thread);
	k_thread_heap_assign(thread, heap);

	k_thread_start(thread);
	k_thread_join(thread, K_FOREVER);

	llext_unload(ext);
}
#endif

int main(void)
{
#ifdef LOAD_AND_RUN_EXTENSION
	struct k_mem_domain domain_kernel, domain_user;
	struct llext *ext_kernel, *ext_user;

	k_mem_domain_init(&domain_kernel, 0, NULL);
	k_mem_domain_init(&domain_user, 0, NULL);

	load_and_run_extension(0, &kernel_thread, &domain_kernel,
			       stack_kernel, &heap_kernel, &ext_kernel);
	load_and_run_extension(K_USER, &user_thread, &domain_user,
			       stack_user, &heap_user, &ext_user);

	printk("Done\n");
#else
	printk("Extension not loaded\n");
#endif
	return 0;
}
```

## include/app_api.h
```c
/*
 * Copyright (c) 2024 Intel Corporation
 *
 * SPDX-License-Identifier: Apache-2.0
 */

#ifndef _TEST_EDK_H_
#define _TEST_EDK_H_
#include <zephyr/kernel.h>

#ifdef __cplusplus
extern "C" {
#endif

__syscall int foo(int bar);

#ifdef __cplusplus
}
#endif

#include <zephyr/syscalls/app_api.h>
#endif /* _TEST_EDK_H_ */
```

## src/foo.c
```c
/*
 * Copyright (c) 2024 Intel Corporation
 *
 * SPDX-License-Identifier: Apache-2.0
 */

#include <app_api.h>
#include <app_api.h>

int z_impl_foo(int bar)
{
	return bar * bar;
}
EXPORT_SYMBOL(z_impl_foo);

#ifdef CONFIG_USERSPACE
static inline int z_vrfy_foo(int bar)
{
	/* Nothing to verify */
	return z_impl_foo(bar);
}
#include <zephyr/syscalls/foo_mrsh.c>
#endif
```
