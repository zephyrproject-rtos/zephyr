## CMakeLists.txt
```
# SPDX-License-Identifier: Apache-2.0

cmake_minimum_required(VERSION 3.28.0)
find_package(Zephyr REQUIRED HINTS $ENV{ZEPHYR_BASE})
project(iterable_sections)

FILE(GLOB app_sources src/*.c)
target_sources(app PRIVATE ${app_sources})

zephyr_linker_sources(DATA_SECTIONS sections-ram.ld)
zephyr_iterable_section(NAME test_ram GROUP DATA_REGION ${XIP_ALIGN_WITH_INPUT})
zephyr_iterable_section(NAME test_ram2 GROUP DATA_REGION ${XIP_ALIGN_WITH_INPUT})
zephyr_iterable_section(NAME test_ram_named GROUP DATA_REGION ${XIP_ALIGN_WITH_INPUT})
zephyr_iterable_section(NAME test_ram_numeric NUMERIC GROUP DATA_REGION ${XIP_ALIGN_WITH_INPUT})
zephyr_iterable_section(NAME ramn_alt GROUP DATA_REGION ${XIP_ALIGN_WITH_INPUT})

zephyr_linker_sources(SECTIONS sections-rom.ld)
zephyr_iterable_section(NAME test_rom KVMA RAM_REGION GROUP RODATA_REGION)
zephyr_iterable_section(NAME test_rom2 KVMA RAM_REGION GROUP RODATA_REGION)
zephyr_iterable_section(NAME test_rom_named KVMA RAM_REGION GROUP RODATA_REGION)
zephyr_iterable_section(NAME test_rom_numeric NUMERIC KVMA RAM_REGION GROUP RODATA_REGION)
zephyr_iterable_section(NAME romn_alt KVMA RAM_REGION GROUP RODATA_REGION)

zephyr_linker_sources(SECTIONS sections-rom-large.ld)
zephyr_iterable_section(NAME test_rom_large KVMA RAM_REGION GROUP RODATA_REGION)
```

## Kconfig
```
# Copyright The Zephyr Project Contributors
# SPDX-License-Identifier: Apache-2.0

config TEST_LARGE_ROM_SECTION
	bool "Link a multi-page iterable ROM section"
	help
	  Add two 4 KiB entries to the test_rom_large iterable section, so
	  that the section ends at least one MMU page past the sections
	  linked before it.

source "Kconfig.zephyr"
```

## prj.conf
```kconfig
CONFIG_ZTEST=y
CONFIG_ZTEST_NEW_API=y
CONFIG_COMMON_LIBC_MALLOC_ARENA_SIZE=0
```

## src/main.c
```c
/*
 * Copyright (c) 2021 Google LLC
 *
 * SPDX-License-Identifier: Apache-2.0
 */

#include <zephyr/ztest.h>
#include <zephyr/sys/iterable_sections.h>

struct test_ram {
	long i;
};

struct test_ram_named {
	long i;
};

struct test_ram_numeric {
	long i;
};

#define CHECK_BIT 0x80

/* declare in random order to check that the linker is sorting by name */
STRUCT_SECTION_ITERABLE(test_ram, ram3) = {0x03};
STRUCT_SECTION_ITERABLE(test_ram, ram2) = {0x02};
STRUCT_SECTION_ITERABLE(test_ram, ram4) = {0x04};
STRUCT_SECTION_ITERABLE(test_ram, ram1) = {0x01};

#define RAM_EXPECT 0x01020304
#define RAM_EXPECT_REVERSE 0x04030201

/* iterable section items can also be static */
static const STRUCT_SECTION_ITERABLE_ALTERNATE(test_ram2, test_ram, ram5) = {RAM_EXPECT};

/* declare in random order to check that the linker is sorting by custom name */
const STRUCT_SECTION_ITERABLE_NAMED(test_ram_named, A, ram6) = {0x01};
const STRUCT_SECTION_ITERABLE_NAMED(test_ram_named, C, ram7) = {0x03};
const STRUCT_SECTION_ITERABLE_NAMED(test_ram_named, D, ram8) = {0x04};
const STRUCT_SECTION_ITERABLE_NAMED(test_ram_named, B, ram9) = {0x02};

/* declare in random order to check that the linker is sorting numerically */
const STRUCT_SECTION_ITERABLE(test_ram_numeric, ramn_3) = {0x02};
const STRUCT_SECTION_ITERABLE(test_ram_numeric, ramn_1) = {0x01};
const STRUCT_SECTION_ITERABLE(test_ram_numeric, ramn_99999) = {0x04};
const STRUCT_SECTION_ITERABLE(test_ram_numeric, ramn_11) = {0x03};

#define NAMED_ALT_EXPECT 0x4273
#define NAMED_ALT_EXPECT_REVERSE 0x7342

/* alternate naming */
const STRUCT_SECTION_ITERABLE_NAMED_ALTERNATE(test_ram_named, ramn_alt, R, ramn_42) = {0x42};
const STRUCT_SECTION_ITERABLE_NAMED_ALTERNATE(test_ram_named, ramn_alt, W, ramn_73) = {0x73};

/**
 *
 * @brief Test iterable in read write section.
 *
 */
ZTEST(iterable_sections, test_ram)
{
	int out = 0;

	STRUCT_SECTION_FOREACH(test_ram, t) {
		out = (out << 8) | t->i;
		t->i |= CHECK_BIT;
	}

	zassert_equal(out, RAM_EXPECT, "Check value incorrect (got: 0x%08x)", out);

	zassert_equal(ram1.i & CHECK_BIT, CHECK_BIT,
		      "ram1.i check bit incorrect (got: 0x%x)", (int)ram1.i);
	zassert_equal(ram2.i & CHECK_BIT, CHECK_BIT,
		      "ram2.i check bit incorrect (got: 0x%x)", (int)ram2.i);
	zassert_equal(ram3.i & CHECK_BIT, CHECK_BIT,
		      "ram3.i check bit incorrect (got: 0x%x)", (int)ram3.i);
	zassert_equal(ram4.i & CHECK_BIT, CHECK_BIT,
		      "ram4.i check bit incorrect (got: 0x%x)", (int)ram4.i);

	out = 0;
	STRUCT_SECTION_FOREACH_ALTERNATE(test_ram2, test_ram, t) {
		out = (out << 8) | t->i;
	}

	zassert_equal(out, RAM_EXPECT, "Check value incorrect (got: 0x%08x)", out);

	out = 0;
	STRUCT_SECTION_FOREACH(test_ram_named, t) {
		out = (out << 8) | t->i;
	}

	zassert_equal(out, RAM_EXPECT, "Check value incorrect (got: 0x%x)", out);

	out = 0;
	STRUCT_SECTION_FOREACH(test_ram_numeric, t) {
		out = (out << 8) | t->i;
	}

	zassert_equal(out, RAM_EXPECT, "Check value incorrect (got: 0x%x)", out);

	out = 0;
	STRUCT_SECTION_FOREACH_ALTERNATE(ramn_alt, test_ram_named, t) {
		out = (out << 8) | t->i;
	}

	zassert_equal(out, NAMED_ALT_EXPECT, "Check value incorrect (got: 0x%x)", out);

	out = 0;
	STRUCT_SECTION_FOREACH_REVERSE(test_ram, t)
	{
		out = (out << 8) | (t->i & ~CHECK_BIT);
	}

	zassert_equal(out, RAM_EXPECT_REVERSE, "Reverse check value incorrect (got: 0x%08x)", out);

	out = 0;
	STRUCT_SECTION_FOREACH_ALTERNATE_REVERSE(test_ram2, test_ram, t)
	{
		out = (out << 8) | t->i;
	}

	zassert_equal(out, RAM_EXPECT, "Reverse check value incorrect (got: 0x%08x)", out);

	out = 0;
	STRUCT_SECTION_FOREACH_REVERSE(test_ram_named, t)
	{
		out = (out << 8) | t->i;
	}

	zassert_equal(out, RAM_EXPECT_REVERSE, "Reverse check value incorrect (got: 0x%x)", out);

	out = 0;
	STRUCT_SECTION_FOREACH_REVERSE(test_ram_numeric, t)
	{
		out = (out << 8) | t->i;
	}

	zassert_equal(out, RAM_EXPECT_REVERSE, "Reverse check value incorrect (got: 0x%x)", out);

	out = 0;
	STRUCT_SECTION_FOREACH_ALTERNATE_REVERSE(ramn_alt, test_ram_named, t)
	{
		out = (out << 8) | t->i;
	}

	zassert_equal(out, NAMED_ALT_EXPECT_REVERSE, "Reverse check value incorrect (got: 0x%x)",
		      out);
}

struct test_rom {
	long i;
};

struct test_rom_named {
	long i;
};

struct test_rom_numeric {
	long i;
};

/* declare in random order to check that the linker is sorting by name */
const STRUCT_SECTION_ITERABLE(test_rom, rom1) = {0x10};
const STRUCT_SECTION_ITERABLE(test_rom, rom3) = {0x30};
const STRUCT_SECTION_ITERABLE(test_rom, rom4) = {0x40};
const STRUCT_SECTION_ITERABLE(test_rom, rom2) = {0x20};

#define ROM_EXPECT 0x10203040
#define ROM_EXPECT_REVERSE 0x40302010

/* iterable section items can also be static */
static const STRUCT_SECTION_ITERABLE_ALTERNATE(test_rom2, test_rom, rom5) = {ROM_EXPECT};

/* declare in random order to check that the linker is sorting by custom name */
const STRUCT_SECTION_ITERABLE_NAMED(test_rom_named, A, rom6) = {0x10};
const STRUCT_SECTION_ITERABLE_NAMED(test_rom_named, C, rom7) = {0x30};
const STRUCT_SECTION_ITERABLE_NAMED(test_rom_named, D, rom8) = {0x40};
const STRUCT_SECTION_ITERABLE_NAMED(test_rom_named, B, rom9) = {0x20};

/* declare in random order to check that the linker is sorting numerically */
const STRUCT_SECTION_ITERABLE(test_rom_numeric, romn_3) = {0x20};
const STRUCT_SECTION_ITERABLE(test_rom_numeric, romn_1) = {0x10};
const STRUCT_SECTION_ITERABLE(test_rom_numeric, romn_99999) = {0x40};
const STRUCT_SECTION_ITERABLE(test_rom_numeric, romn_11) = {0x30};

/* alternate naming */
const STRUCT_SECTION_ITERABLE_NAMED_ALTERNATE(test_rom_named, romn_alt, R, romn_73) = {0x73};
const STRUCT_SECTION_ITERABLE_NAMED_ALTERNATE(test_rom_named, romn_alt, O, romn_42) = {0x42};

/**
 *
 * @brief Test iterable in read only section.
 *
 */
ZTEST(iterable_sections, test_rom)
{
	int out = 0;

	STRUCT_SECTION_FOREACH(test_rom, t) {
		out = (out << 8) | t->i;
	}

	zassert_equal(out, ROM_EXPECT, "Check value incorrect (got: 0x%x)", out);

	out = 0;
	STRUCT_SECTION_FOREACH_ALTERNATE(test_rom2, test_rom, t) {
		out = (out << 8) | t->i;
	}

	zassert_equal(out, ROM_EXPECT, "Check value incorrect (got: 0x%x)", out);

	out = 0;
	STRUCT_SECTION_FOREACH(test_rom_named, t) {
		out = (out << 8) | t->i;
	}

	zassert_equal(out, ROM_EXPECT, "Check value incorrect (got: 0x%x)", out);

	out = 0;
	STRUCT_SECTION_FOREACH(test_rom_numeric, t) {
		out = (out << 8) | t->i;
	}

	zassert_equal(out, ROM_EXPECT, "Check value incorrect (got: 0x%x)", out);

	out = 0;
	STRUCT_SECTION_FOREACH_ALTERNATE(romn_alt, test_rom_named, t) {
		out = (out << 8) | t->i;
	}

	zassert_equal(out, NAMED_ALT_EXPECT, "Check value incorrect (got: 0x%x)", out);

	out = 0;
	STRUCT_SECTION_FOREACH_REVERSE(test_rom, t)
	{
		out = (out << 8) | t->i;
	}

	zassert_equal(out, ROM_EXPECT_REVERSE, "Reverse check value incorrect (got: 0x%x)", out);

	out = 0;
	STRUCT_SECTION_FOREACH_ALTERNATE_REVERSE(test_rom2, test_rom, t)
	{
		out = (out << 8) | t->i;
	}

	zassert_equal(out, ROM_EXPECT, "Reverse check value incorrect (got: 0x%x)", out);

	out = 0;
	STRUCT_SECTION_FOREACH_REVERSE(test_rom_named, t)
	{
		out = (out << 8) | t->i;
	}

	zassert_equal(out, ROM_EXPECT_REVERSE, "Reverse check value incorrect (got: 0x%x)", out);

	out = 0;
	STRUCT_SECTION_FOREACH_REVERSE(test_rom_numeric, t)
	{
		out = (out << 8) | t->i;
	}

	zassert_equal(out, ROM_EXPECT_REVERSE, "Reverse check value incorrect (got: 0x%x)", out);

	out = 0;
	STRUCT_SECTION_FOREACH_ALTERNATE_REVERSE(romn_alt, test_rom_named, t)
	{
		out = (out << 8) | t->i;
	}

	zassert_equal(out, NAMED_ALT_EXPECT_REVERSE, "Reverse check value incorrect (got: 0x%x)",
		      out);
}

struct test_rom_large {
	uint32_t data[1024];
};

#ifdef CONFIG_TEST_LARGE_ROM_SECTION
const STRUCT_SECTION_ITERABLE(test_rom_large, rom_large2) = {.data = {[1023] = 0x02}};
const STRUCT_SECTION_ITERABLE(test_rom_large, rom_large1) = {.data = {[1023] = 0x01}};
#endif

/**
 *
 * @brief Test reading the end of an iterable section spanning several pages.
 *
 */
ZTEST(iterable_sections, test_rom_large)
{
	uint32_t out = 0U;

	Z_TEST_SKIP_IFNDEF(CONFIG_TEST_LARGE_ROM_SECTION);

	STRUCT_SECTION_FOREACH(test_rom_large, t) {
		out = (out << 8) | t->data[ARRAY_SIZE(t->data) - 1];
	}

	zassert_equal(out, 0x0102U, "Check value incorrect (got: 0x%x)", out);
}

ZTEST_SUITE(iterable_sections, NULL, NULL, NULL, NULL, NULL);
```
