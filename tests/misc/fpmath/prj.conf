## CMakeLists.txt
```
# Copyright (c) 2022 Google Inc
# SPDX-License-Identifier: Apache-2.0

cmake_minimum_required(VERSION 3.20.0)
find_package(Zephyr REQUIRED HINTS $ENV{ZEPHYR_BASE})

project(fpmath)
target_sources(app
  PRIVATE
    src/main.cpp
)
target_sources_ifdef(CONFIG_MATH_UTIL_FLOAT app
  PRIVATE
    src/float_tests.cpp
)
target_sources_ifndef(CONFIG_MATH_UTIL_FLOAT app
  PRIVATE
    "src/fixed_tests_${CONFIG_MATH_UTIL_FP_BITS}bit.cpp"
)
```

## prj.conf
```kconfig
CONFIG_ZTEST=y
CONFIG_ZTEST_NEW_API=y
CONFIG_ZTEST_ASSERT_HOOK=y
CONFIG_ASSERT_TEST=y
```

## src/main.cpp
```c
/* Copyright (c) 2022 Google Inc
 * SPDX-License-Identifier: Apache-2.0
 */

#include <zephyr/math/fp.h>
#include <zephyr/ztest.h>

#ifdef CONFIG_MATH_UTIL_FLOAT
#define TEST_EPSILON (1.0e-6f)
#else
/* For every 2 bits of float precision double the epsilon */
#define TEST_EPSILON (INT32_C(1) << (CONFIG_MATH_UTIL_FP_BITS / 2))
#endif

ZTEST_SUITE(fpmath, nullptr, nullptr, nullptr, nullptr, nullptr);

ZTEST(fpmath, test_int_addition)
{
	fp_t expect;
	fp_t result;

	expect = INT_TO_FP(22);
	result = INT_TO_FP(5) + INT_TO_FP(17);
	zassert_within(expect, result, TEST_EPSILON,
		       "Expected %" PRIf " to be within %" PRIf " of %" PRIf, PRIf_ARG(result),
		       PRIf_ARG(TEST_EPSILON), PRIf_ARG(expect));

	expect = INT_TO_FP(126);
	result = INT_TO_FP(100) + INT_TO_FP(26);
	zassert_within(expect, result, TEST_EPSILON,
		       "Expected %" PRIf " to be within %" PRIf " of %" PRIf, PRIf_ARG(result),
		       PRIf_ARG(TEST_EPSILON), PRIf_ARG(expect));

	expect = INT_TO_FP(-17);
	result = INT_TO_FP(30) - INT_TO_FP(47);
	zassert_within(expect, result, TEST_EPSILON,
		       "Expected %" PRIf " to be within %" PRIf " of %" PRIf, PRIf_ARG(result),
		       PRIf_ARG(TEST_EPSILON), PRIf_ARG(expect));
}

ZTEST(fpmath, test_int_negation)
{
	fp_t expect;
	fp_t result;

	expect = INT_TO_FP(7);
	result = -INT_TO_FP(-7);
	zassert_within(expect, result, TEST_EPSILON,
		       "Expected %" PRIf " to be within %" PRIf " of %" PRIf, PRIf_ARG(result),
		       PRIf_ARG(TEST_EPSILON), PRIf_ARG(expect));

	expect = INT_TO_FP(-102);
	result = -INT_TO_FP(102);
	zassert_within(expect, result, TEST_EPSILON,
		       "Expected %" PRIf " to be within %" PRIf " of %" PRIf, PRIf_ARG(result),
		       PRIf_ARG(TEST_EPSILON), PRIf_ARG(expect));
}

ZTEST(fpmath, test_fp_addition)
{
	fp_t expect;
	fp_t result;

	expect = FLOAT_TO_FP(22.63f);
	result = FLOAT_TO_FP(5.3f) + FLOAT_TO_FP(17.33f);
	zassert_within(expect, result, TEST_EPSILON,
		       "Expected %" PRIf " to be within %" PRIf " of %" PRIf, PRIf_ARG(result),
		       PRIf_ARG(TEST_EPSILON), PRIf_ARG(expect));

	expect = FLOAT_TO_FP(126.778f);
	result = FLOAT_TO_FP(100.17f) + FLOAT_TO_FP(26.608f);
	zassert_within(expect, result, TEST_EPSILON,
		       "Expected %" PRIf " to be within %" PRIf " of %" PRIf, PRIf_ARG(result),
		       PRIf_ARG(TEST_EPSILON), PRIf_ARG(expect));

	expect = FLOAT_TO_FP(-17.33f);
	result = FLOAT_TO_FP(30.7f) - FLOAT_TO_FP(48.03f);
	zassert_within(expect, result, TEST_EPSILON,
		       "Expected %" PRIf " to be within %" PRIf " of %" PRIf, PRIf_ARG(result),
		       PRIf_ARG(TEST_EPSILON), PRIf_ARG(expect));
}

ZTEST(fpmath, test_fp_negation)
{
	fp_t expect;
	fp_t result;

	expect = FLOAT_TO_FP(52.43f);
	result = -FLOAT_TO_FP(-52.43f);
	zassert_within(expect, result, TEST_EPSILON,
		       "Expected %" PRIf " to be within %" PRIf " of %" PRIf, PRIf_ARG(result),
		       PRIf_ARG(TEST_EPSILON), PRIf_ARG(expect));

	expect = FLOAT_TO_FP(-72.77f);
	result = -FLOAT_TO_FP(72.77f);
	zassert_within(expect, result, TEST_EPSILON,
		       "Expected %" PRIf " to be within %" PRIf " of %" PRIf, PRIf_ARG(result),
		       PRIf_ARG(TEST_EPSILON), PRIf_ARG(expect));
}

ZTEST(fpmath, test_fp_to_int)
{
	int32_t expect;
	int32_t result;

	expect = (int32_t)3.75f;
	result = FP_TO_INT(FLOAT_TO_FP(3.75f));
	zassert_equal(expect, result, "Expected %d, but got %d", expect, result);

	expect = (int32_t)7.5f;
	result = FP_TO_INT(FLOAT_TO_FP(7.5f));
	zassert_equal(expect, result, "Expected %d, but got %d", expect, result);

	expect = (int32_t)12.25f;
	result = FP_TO_INT(FLOAT_TO_FP(12.25f));
	zassert_equal(expect, result, "Expected %d, but got %d", expect, result);

	expect = (int32_t)-3.75f;
	result = FP_TO_INT(FLOAT_TO_FP(-3.75f));
	zassert_equal(expect, result, "Expected %d, but got %d", expect, result);

	expect = (int32_t)-7.5f;
	result = FP_TO_INT(FLOAT_TO_FP(-7.5f));
	zassert_equal(expect, result, "Expected %d, but got %d", expect, result);

	expect = (int32_t)-12.25f;
	result = FP_TO_INT(FLOAT_TO_FP(-12.25f));
	zassert_equal(expect, result, "Expected %d, but got %d", expect, result);
}

ZTEST(fpmath, test_multiply)
{
	fp_t expect;
	fp_t result;

	expect = FLOAT_TO_FP(3.5f * 2.6f);
	result = fp_mul(FLOAT_TO_FP(3.5f), FLOAT_TO_FP(2.6f));
	zassert_within(expect, result, TEST_EPSILON,
		       "Expected %" PRIf " to be within %" PRIf " of %" PRIf, PRIf_ARG(result),
		       PRIf_ARG(TEST_EPSILON), PRIf_ARG(expect));

	expect = FLOAT_TO_FP(5.2f * -4.33f);
	result = fp_mul(FLOAT_TO_FP(5.2f), FLOAT_TO_FP(-4.33f));
	zassert_within(expect, result, TEST_EPSILON,
		       "Expected %" PRIf " to be within %" PRIf " of %" PRIf, PRIf_ARG(result),
		       PRIf_ARG(TEST_EPSILON), PRIf_ARG(expect));

	expect = FLOAT_TO_FP(-7.812f * -3.135f);
	result = fp_mul(FLOAT_TO_FP(-7.812f), FLOAT_TO_FP(-3.135f));
	zassert_within(expect, result, TEST_EPSILON,
		       "Expected %" PRIf " to be within %" PRIf " of %" PRIf, PRIf_ARG(result),
		       PRIf_ARG(TEST_EPSILON), PRIf_ARG(expect));
}

ZTEST(fpmath, test_divide)
{
	fp_t expect;
	fp_t result;

	expect = FLOAT_TO_FP(52.35f / 2.6f);
	result = fp_div(FLOAT_TO_FP(52.35f), FLOAT_TO_FP(2.6f));
	zassert_within(expect, result, TEST_EPSILON,
		       "Expected %" PRIf " to be within %" PRIf " of %" PRIf, PRIf_ARG(result),
		       PRIf_ARG(TEST_EPSILON), PRIf_ARG(expect));

	expect = FLOAT_TO_FP(78.52f / -4.33f);
	result = fp_div(FLOAT_TO_FP(78.52f), FLOAT_TO_FP(-4.33f));
	zassert_within(expect, result, TEST_EPSILON,
		       "Expected %" PRIf " to be within %" PRIf " of %" PRIf, PRIf_ARG(result),
		       PRIf_ARG(TEST_EPSILON), PRIf_ARG(expect));

	expect = FLOAT_TO_FP(-17.812f / -3.135f);
	result = fp_div(FLOAT_TO_FP(-17.812f), FLOAT_TO_FP(-3.135f));
	zassert_within(expect, result, TEST_EPSILON,
		       "Expected %" PRIf " to be within %" PRIf " of %" PRIf, PRIf_ARG(result),
		       PRIf_ARG(TEST_EPSILON), PRIf_ARG(expect));
}
```

## src/common.c
```c
/* Copyright (c) 2022 Google Inc
 * SPDX-License-Identifier: Apache-2.0
 */

#include <zephyr/ztest_error_hook.h>

void ztest_post_assert_fail_hook(void) {}
```

## src/fixed_tests_16bit.cpp
```c
/* Copyright (c) 2022 Google Inc
 * SPDX-License-Identifier: Apache-2.0
 */

#include <string.h>

#include <zephyr/math/fp.h>
#include <zephyr/sys/util.h>
#include <zephyr/ztest.h>

ZTEST(fpmath, test_printing_positive_value)
{
	const char *expect_buffer = "4660.337890";
	const fp_t value = FLOAT_TO_FP(4660.337769f);
	char buffer[128] = {0};
	sprintf(buffer, "%" PRIf, PRIf_ARG(value));

	zassert_ok(strcmp(expect_buffer, buffer), "Expected '%s', but got '%s'", expect_buffer,
		   buffer);
}

ZTEST(fpmath, test_printing_negative_value)
{
	const char *expect_buffer = "-3532.337890";
	const fp_t value = FLOAT_TO_FP(-3532.337769f);
	char buffer[128] = {0};
	sprintf(buffer, "%" PRIf, PRIf_ARG(value));

	zassert_ok(strcmp(expect_buffer, buffer), "Expected '%s', but got '%s'", expect_buffer,
		   buffer);
}
```

## src/fixed_tests_24bit.cpp
```c
/* Copyright (c) 2022 Google Inc
 * SPDX-License-Identifier: Apache-2.0
 */

#include <string.h>

#include <zephyr/math/fp.h>
#include <zephyr/sys/util.h>
#include <zephyr/ztest.h>

ZTEST(fpmath, test_printing_positive_value)
{
	const char *expect_buffer = "18.20444488";
	const fp_t value = FLOAT_TO_FP(18.20444441f);
	char buffer[128] = {0};
	sprintf(buffer, "%" PRIf, PRIf_ARG(value));

	zassert_ok(strcmp(expect_buffer, buffer), "Expected '%s', but got '%s'", expect_buffer, buffer);
}

ZTEST(fpmath, test_printing_negative_value)
{
	const char *expect_buffer = "-14.20444488";
	const fp_t value = FLOAT_TO_FP(-14.20444441f);
	char buffer[128] = {0};
	sprintf(buffer, "%" PRIf, PRIf_ARG(value));

	zassert_ok(strcmp(expect_buffer, buffer), "Expected '%s', but got '%s'", expect_buffer, buffer);
}
```

## src/fixed_tests_8bit.cpp
```c
/* Copyright (c) 2022 Google Inc
 * SPDX-License-Identifier: Apache-2.0
 */

#include <string.h>

#include <zephyr/math/fp.h>
#include <zephyr/sys/util.h>
#include <zephyr/ztest.h>
#include <stdio.h>

ZTEST(fpmath, test_convert_positive_float_to_fp)
{
	const fp_t value = FLOAT_TO_FP(1193046.46875f);
	const int32_t int_val = INT32_C(0x12345680);

	zassert_equal(value, int_val, "Expected 0x%x, but got 0x%x", int_val, value);
}

ZTEST(fpmath, test_convert_negative_float_to_fp)
{
	const fp_t value = FLOAT_TO_FP(-904106.5f);
	const int32_t int_val = INT32_C(0xf2345580);

	zassert_equal(value, int_val, "Expected 0x%x, but got 0x%x", int_val, value);
}

ZTEST(fpmath, test_printing_positive_value)
{
	const char *expect_buffer = "1193046.500000";
	const fp_t value = FLOAT_TO_FP(1193046.46875f);
	char buffer[128] = {0};
	sprintf(buffer, "%" PRIf, PRIf_ARG(value));

	zassert_ok(strcmp(expect_buffer, buffer), "Expected '%s', but got '%s'", expect_buffer, buffer);
}

ZTEST(fpmath, test_printing_negative_value)
{
	const char *expect_buffer = "-904106.500000";
	const fp_t value = FLOAT_TO_FP(-904106.46875f);
	char buffer[128] = {0};
	sprintf(buffer, "%" PRIf, PRIf_ARG(value));

	zassert_ok(strcmp(expect_buffer, buffer), "Expected '%s', but got '%s'", expect_buffer, buffer);
}
```

## src/float_tests.cpp
```c
/* Copyright (c) 2022 Google Inc
 * SPDX-License-Identifier: Apache-2.0
 */

#include <stdio.h>
#include <string.h>

#include <zephyr/math/fp.h>
#include <zephyr/ztest.h>

ZTEST(fpmath, test_printing)
{
	const fp_t value = FLOAT_TO_FP(1.23456789f);
	char expected_string[128] = {0};
	char buffer[128] = {0};
	int expected_num_chars_written = sprintf(
		expected_string, "%." STRINGIFY(CONFIG_MATH_UTIL_PRIf_PRECISION) "f", value);
	int num_chars_written = sprintf(buffer, "%" PRIf, PRIf_ARG(value));

	zassert_equal(expected_num_chars_written, num_chars_written,
		      "Expected to write %d characters, but wrote %d", expected_num_chars_written,
		      num_chars_written);
	zassert_equal(2 + CONFIG_MATH_UTIL_PRIf_PRECISION, num_chars_written,
		      "Expected to write %d characters, but wrote %d",
		      2 + CONFIG_MATH_UTIL_PRIf_PRECISION, num_chars_written);
	zassert_true(strcmp(expected_string, buffer) == 0,
		     "Expected string to be '%s', but was '%s'", expected_string, buffer);
}
```

## src/q1_0_31.c
```c
/* Copyright (c) 2022 Google Inc
 * SPDX-License-Identifier: Apache-2.0
 */

#include <zephyr/math/fp.h>
#include <zephyr/ztest.h>
#include <zephyr/ztest_error_hook.h>

#include "fpmath/common.h"

ZTEST_SUITE(q1_0_31, NULL, NULL, NULL, NULL, NULL);

ZTEST(q1_0_31, test_identity_out_of_bounds)
{
	q1_0_31_t q;

	ztest_set_assert_valid(true);
	q_assign(q, 1);

	ztest_set_assert_valid(true);
	q_assign(q, 1.5);

	ztest_set_assert_valid(true);
	q_assign(q, q_static(q1_15_16_t, 3.7));

	ztest_set_assert_valid(true);
	q_assign(q, -1);

	ztest_set_assert_valid(true);
	q_assign(q, -1.5f);

	ztest_set_assert_valid(true);
	q_assign(q, q_static(q1_23_8_t, -3.7));
}

ZTEST(q1_0_31, test_additive_out_of_bounds)
{
	q1_0_31_t q = q_static(q1_0_31_t, 0.75);

	ztest_set_assert_valid(true);
	q_add(q, 0.75);

	q_assign(q, -0.5);
	ztest_set_assert_valid(true);
	q_sub(q, 0.95f);
}

ZTEST(q1_0_31, test_multiplicitive_out_of_bounds)
{
	q1_0_31_t q = q_static(q1_0_31_t, 0.75);

	ztest_set_assert_valid(true);
	q_mul(q, 2);

	ztest_set_assert_valid(true);
	q_div(q, -0.5);
}

ZTEST(q1_0_31, test_identity_float)
{
	q1_0_31_t q = {0};

	q_assign(q, 0.55f);
	qassert(0x46666680, q);

	q_assign(q, -0.75);
	qassert(0xa0000000, q);
}

ZTEST(q1_0_31, test_identity_q)
{
	q1_0_31_t q = {0};

	q_assign(q, ((q1_23_8_t){.value = 0x78}));
	qassert(0x3c000000, q);

	q_assign(q, ((q1_15_16_t){.value = (int32_t)(0xffffffd5)}));
	qassert(0xffea8000, q);
}

ZTEST(q1_0_31, test_add_float)
{
	q1_0_31_t q = q_static(q1_0_31_t, 0.5);

	q_add(q, 0.25);
	qassert(0x60000000, q);

	q_add(q, -1);
	qassert(0xe0000000, q);
}

ZTEST(q1_0_31, test_add_q)
{
	q1_0_31_t q = {0};

	q_add(q, q_static(q1_23_8_t, 0.25));
	qassert(0x20000000, q);

	q_add(q, q_static(q1_15_16_t, -0.33));
	qassert(0xf5c28000, q);
}

ZTEST(q1_0_31, test_sub_float)
{
	q1_0_31_t q = q_static(q1_0_31_t, 0.5);

	q_sub(q, 0.25);
	qassert(0x20000000, q);

	q_sub(q, -0.5f);
	qassert(0x60000000, q);
}

ZTEST(q1_0_31, test_sub_q)
{
	q1_0_31_t q = {0};

	q_sub(q, q_static(q1_23_8_t, 0.25));
	qassert(0xe0000000, q);

	q_sub(q, q_static(q1_15_16_t, -0.33));
	qassert(0xa3d8000, q);
}

ZTEST(q1_0_31, test_mul_int)
{
	q1_0_31_t q = q_static(q1_0_31_t, 0.25);

	q_mul(q, 2);
	qassert(0x40000000, q);

	q_mul(q, -1);
	qassert(0xc0000000, q);
}

ZTEST(q1_0_31, test_mul_float)
{
	q1_0_31_t q = q_static(q1_0_31_t, 0.25);

	q_mul(q, 1.5);
	qassert(0x30000000, q);

	q_mul(q, -2.33);
	qassert(0x9028f5c2, q);
}

ZTEST(q1_0_31, test_mul_q)
{
	q1_0_31_t q = q_static(q1_0_31_t, 0.25);

	q_mul(q, q_static(q1_23_8_t, 1.5));
	qassert(0x30000000, q);

	q_mul(q, q_static(q1_15_16_t, -2.33));
	qassert(0x9028f000, q);
}

ZTEST(q1_0_31, test_div_int)
{
	q1_0_31_t q = q_static(q1_0_31_t, 0.25);

	q_div(q, 2);
	qassert(0x10000000, q);

	q_div(q, -1);
	qassert(0xf0000000, q);
}

ZTEST(q1_0_31, test_div_float)
{
	q1_0_31_t q = q_static(q1_0_31_t, 0.25);

	q_div(q, 0.5);
	qassert(0x40000000, q);

	q_div(q, -7.33);
	qassert(0xf744cd5c, q);
}

ZTEST(q1_0_31, test_div_q)
{
	q1_0_31_t q = q_static(q1_0_31_t, 0.25);

	q_div(q, q_static(q1_23_8_t, 1.0 / 3.0));
	qassert(0x60606060, q);

	q_div(q, q_static(q1_15_16_t, -15.33));
	qassert(0xf9b69511, q);
}
```

## src/q1_15_16.c
```c
/* Copyright (c) 2022 Google Inc
 * SPDX-License-Identifier: Apache-2.0
 */

#include <zephyr/math/fp.h>
#include <zephyr/ztest.h>
#include <zephyr/ztest_error_hook.h>

#include "fpmath/common.h"

ZTEST_SUITE(q1_15_16, NULL, NULL, NULL, NULL, NULL);

ZTEST(q1_15_16, test_identity_out_of_bounds)
{
	q1_15_16_t q;

	ztest_set_assert_valid(true);
	q_assign(q, 32768);

	ztest_set_assert_valid(true);
	q_assign(q, 32768.75);

	ztest_set_assert_valid(true);
	q_assign(q, q_static(q1_23_8_t, 62768.7));

	ztest_set_assert_valid(true);
	q_assign(q, -32769);

	ztest_set_assert_valid(true);
	q_assign(q, -32769.5f);

	ztest_set_assert_valid(true);
	q_assign(q, q_static(q1_23_8_t, -62768.7));
}

ZTEST(q1_15_16, test_additive_out_of_bounds)
{
	q1_15_16_t q = q_static(q1_15_16_t, 30000);

	ztest_set_assert_valid(true);
	q_add(q, 5000.75);

	q_assign(q, -31000);
	ztest_set_assert_valid(true);
	q_sub(q, 7823.95f);
}

ZTEST(q1_15_16, test_multiplicitive_out_of_bounds)
{
	q1_15_16_t q = q_static(q1_15_16_t, 17123.75);

	ztest_set_assert_valid(true);
	q_mul(q, 2);

	ztest_set_assert_valid(true);
	q_div(q, -3.5);
}

ZTEST(q1_15_16, test_identity_uint)
{
	q1_15_16_t q = {0};

	q_assign(q, UINT8_C(5));
	qassert(5 << 16, q);

	q_assign(q, UINT16_C(87));
	qassert(87 << 16, q);

	q_assign(q, UINT32_C(122));
	qassert(122 << 16, q);
}

ZTEST(q1_15_16, test_identity_int)
{
	q1_15_16_t q = {0};

	q_assign(q, INT8_C(-5));
	qassert(0xfffb0000, q);

	q_assign(q, INT16_C(-87));
	qassert(0xffa90000, q);

	q_assign(q, INT32_C(-122));
	qassert(0xff860000, q);
}

ZTEST(q1_15_16, test_identity_float)
{
	q1_15_16_t q = {0};

	q_assign(q, 5.5f);
	qassert(0x58000, q);

	q_assign(q, 14.75);
	qassert(0xec000, q);
}

ZTEST(q1_15_16, test_identity_q)
{
	q1_15_16_t q = {0};

	q_assign(q, ((q1_23_8_t){
			    .value = 0x51234,
		    }));
	qassert(0x5123400, q);

	q_assign(q, ((q1_0_31_t){
			    .value = 0x71234567,
		    }));
	qassert(0xe246, q);
}

ZTEST(q1_15_16, test_add_int)
{
	q1_15_16_t q = {
		.value = 0,
	};

	/* 0 + 3, expect 3 */
	q_add(q, 3);
	qassert(0x30000, q);

	/* 3 + -1, expect 2 */
	q_add(q, -1);
	qassert(0x20000, q);

	/* 2 + -5, expect -3 */
	q_add(q, -5);
	qassert(0xfffd0000, q);

	/* -3 + 10, expect 7 */
	q_add(q, 10);
	qassert(0x70000, q);
}

ZTEST(q1_15_16, test_add_float)
{
	q1_15_16_t q = {
		.value = 0,
	};

	/* 0 + 3.5, expect 3.5 */
	q_add(q, 3.5f);
	qassert(0x38000, q);

	/* 3.5 + -1.3, expect 2.2 */
	q_add(q, -1.3);
	qassert(0x23333, q);

	/* 2.2 + -17.33, expect -15.13 */
	q_add(q, -17.33f);
	qassert(0xfff0deb8, q);

	/* -15.13 + 22.7, expect 7.57 */
	q_add(q, 22.7);
	qassert(0x791eb, q);
}

ZTEST(q1_15_16, test_add_q)
{
	q1_15_16_t q = {
		.value = 0,
	};

	q_add(q, ((q1_23_8_t){
			 .value = 0x123,
		 }));
	qassert(0x12300, q);

	q.value = 0;
	q_add(q, ((q1_15_16_t){
			 .value = 0x12345,
		 }));
	qassert(0x12345, q);

	q.value = 0;
	q_add(q, ((q1_0_31_t){
			 .value = 0x12345678,
		 }));
	qassert(0x2468, q);
}

ZTEST(q1_15_16, test_sub_int)
{
	q1_15_16_t q = {
		.value = 0,
	};

	/* 0 - -3, expect 3 */
	q_sub(q, -3);
	qassert(0x30000, q);

	/* 3 - 1, expect 2 */
	q_sub(q, 1);
	qassert(0x20000, q);

	/* 2 - 5, expect -3 */
	q_sub(q, 5);
	qassert(0xfffd0000, q);

	/* -3 - -10, expect 7 */
	q_sub(q, -10);
	qassert(0x70000, q);
}

ZTEST(q1_15_16, test_sub_float)
{
	q1_15_16_t q = {
		.value = 0,
	};

	/* 0 - -3.5, expect 3.5 */
	q_sub(q, -3.5f);
	qassert(0x38000, q);

	/* 3.5 - 1.3, expect 2.2 */
	q_sub(q, 1.3);
	qassert(0x23334, q);

	/* 2.2 - 17.33, expect -15.13 */
	q_sub(q, 17.33f);
	qassert(0xfff0deba, q);

	/* -15.13 - -22.7, expect 7.57 */
	q_sub(q, -22.7);
	qassert(0x791ee, q);
}

ZTEST(q1_15_16, test_sub_q)
{
	q1_15_16_t q = {
		.value = 0,
	};

	q_sub(q, ((q1_23_8_t){
			 .value = 0x123,
		 }));
	qassert(0xfffedd00, q);

	q.value = 0;
	q_sub(q, ((q1_15_16_t){
			 .value = 0x12345,
		 }));
	qassert(0xfffedcbb, q);

	q.value = 0;
	q_sub(q, ((q1_0_31_t){
			 .value = 0x12345678,
		 }));
	qassert(0xffffdb98, q);
}

ZTEST(q1_15_16, test_mul_int)
{
	q1_15_16_t q = q_static(q1_15_16_t, 1);

	/* 1 * 3, expect 3 */
	q_mul(q, 3);
	qassert(0x30000, q);

	/* 3 * 2, expect 6 */
	q_mul(q, 2);
	qassert(0x60000, q);

	/* 6 * -5, expect -30 */
	q_mul(q, -5);
	qassert(0xffe20000, q);

	/* -30 * -2, expect 60 */
	q_mul(q, -2);
	qassert(0x3c0000, q);
}

ZTEST(q1_15_16, test_mul_float)
{
	q1_15_16_t q = q_static(q1_15_16_t, 1);

	/* 1 * 3.5, expect 3.5 */
	q_mul(q, 3.5f);
	qassert(0x38000, q);

	/* 3.5 * 1.3, expect 4.55 */
	q_mul(q, 1.3);
	qassert(0x48cca, q);

	/* 4.55 * -3.2, expect -14.56 */
	q_mul(q, -3.2f);
	qassert(0xfff170a9, q);

	/* -14.56 * -2.27, expect 33.0512 */
	q_mul(q, -2.27);
	qassert(0x210d13, q);
}

ZTEST(q1_15_16, test_mul_q)
{
	q1_15_16_t q = q_static(q1_15_16_t, 2);

	/* 2 * 3.2 , expected 6.4*/
	q_mul(q, q_static(q1_23_8_t, 3.2));
	qassert(0x66600, q);

	/* 6.4 * -2.23456, expected -14 76/255 (−14.301184)*/
	q_mul(q, q_static(q1_15_16_t, -2.23456));
	qassert(0xfff1b3c4, q);

	/* -14 76/255 * -0.1234, expected 1 202/255 */
	q_mul(q, q_static(q1_0_31_t, -0.1234));
	qassert(0x1c3b8, q);
}

ZTEST(q1_15_16, test_div_int)
{
	q1_15_16_t q = q_static(q1_15_16_t, 1);

	/* 1 / 2, expect 0.5 */
	q_div(q, 2);
	qassert(0x8000, q);

	/* 0.5 / -4, expect -0.125 */
	q_div(q, -4);
	qassert(0xffffe000, q);

	/* -0.125 / -1, expect 0.125 */
	q_div(q, -1);
	qassert(0x2000, q);
}

ZTEST(q1_15_16, test_div_float)
{
	q1_15_16_t q = q_static(q1_15_16_t, 5.0);

	/* 5 / 2.5, expect 2 */
	q_div(q, 2.5);
	qassert(0x20000, q);

	/* 2 / 1.5, expect 1.33... */
	q_div(q, 1.5f);
	qassert(0x15555, q);

	/* 4/3 / 1/3, expect 4 (with 3/255 error) */
	q_div(q, (1.0 / 3.0));
	qassert(0x40003, q);
}

ZTEST(q1_15_16, test_div_q)
{
	q1_15_16_t q = q_static(q1_15_16_t, 5.0);

	/* 5 / 2.5, expect 2 */
	q_div(q, q_static(q1_23_8_t, 2.5));
	qassert(0x20000, q);

	/* 2 / 1.5, expect 1.33... */
	q_div(q, q_static(q1_15_16_t , 1.5f));
	qassert(0x15555, q);

	/* 4/3 / 1/3, expect 4 (with 3/255 error) */
	q_div(q, q_static(q1_0_31_t, (1.0 / 3.0)));
	qassert(0x40003, q);
}
```

## src/q1_23_8.c
```c
/* Copyright (c) 2022 Google Inc
 * SPDX-License-Identifier: Apache-2.0
 */

#include <zephyr/math/fp.h>
#include <zephyr/ztest.h>
#include <zephyr/ztest_error_hook.h>

#include "fpmath/common.h"

ZTEST_SUITE(q1_23_8, NULL, NULL, NULL, NULL, NULL);

ZTEST(q1_23_8, test_identity_out_of_bounds)
{
	q1_23_8_t q;

	ztest_set_assert_valid(true);
	q_assign(q, 8388608);

	ztest_set_assert_valid(true);
	q_assign(q, 8388608.75);

	ztest_set_assert_valid(true);
	q_assign(q, -8388609);

	ztest_set_assert_valid(true);
	q_assign(q, -8388609.5f);
}

ZTEST(q1_23_8, test_additive_out_of_bounds)
{
	q1_23_8_t q = q_static(q1_23_8_t, 8123456);

	ztest_set_assert_valid(true);
	q_add(q, 345678.75);

	q_assign(q, -8123456);
	ztest_set_assert_valid(true);
	q_sub(q, 765432.95f);
}

ZTEST(q1_23_8, test_multiplicitive_out_of_bounds)
{
	q1_23_8_t q = q_static(q1_23_8_t, 8123456.75);

	ztest_set_assert_valid(true);
	q_mul(q, 2);

	ztest_set_assert_valid(true);
	q_div(q, -3.5);
}

ZTEST(q1_23_8, test_identity_uint)
{
	q1_23_8_t q = {0};

	q_assign(q, UINT8_C(5));
	qassert(5 << 8, q);

	q_assign(q, UINT16_C(87));
	qassert(87 << 8, q);

	q_assign(q, UINT32_C(122));
	qassert(122 << 8, q);
}

ZTEST(q1_23_8, test_identity_int)
{
	q1_23_8_t q = {0};

	q_assign(q, INT8_C(-5));
	qassert(0xfffffb00, q);

	q_assign(q, INT16_C(-87));
	qassert(0xffffa900, q);

	q_assign(q, INT32_C(-122));
	qassert(0xffff8600, q);
}

ZTEST(q1_23_8, test_identity_float)
{
	q1_23_8_t q = {0};

	q_assign(q, 5.5f);
	qassert(0x580, q);

	q_assign(q, 14.75);
	qassert(0xec0, q);
}

ZTEST(q1_23_8, test_identity_q)
{
	q1_23_8_t q = {0};

	q_assign(q, ((q1_15_16_t){
			    .value = 0x51234,
		    }));
	qassert(0x512, q);

	q_assign(q, ((q1_0_31_t){
			    .value = 0x71234567,
		    }));
	qassert(0xe2, q);
}

ZTEST(q1_23_8, test_add_int)
{
	q1_23_8_t q = {
		.value = 0,
	};

	/* 0 + 3, expect 3 */
	q_add(q, 3);
	qassert(0x300, q);

	/* 3 + -1, expect 2 */
	q_add(q, -1);
	qassert(0x200, q);

	/* 2 + -5, expect -3 */
	q_add(q, -5);
	qassert(0xfffffd00, q);

	/* -3 + 10, expect 7 */
	q_add(q, 10);
	qassert(0x700, q);
}

ZTEST(q1_23_8, test_add_float)
{
	q1_23_8_t q = {
		.value = 0,
	};

	/* 0 + 3.5, expect 3.5 */
	q_add(q, 3.5f);
	qassert(0x380, q);

	/* 3.5 + -1.3, expect 2.2 */
	q_add(q, -1.3);
	qassert(0x233, q);

	/* 2.2 + -17.33, expect -15.13 */
	q_add(q, -17.33f);
	qassert(0xfffff0de, q);

	/* -15.13 + 22.7, expect 7.57 */
	q_add(q, 22.7);
	qassert(0x791, q);
}

ZTEST(q1_23_8, test_add_q)
{
	q1_23_8_t q = {
		.value = 0,
	};

	q_add(q, ((q1_23_8_t){
			 .value = 0x123,
		 }));
	qassert(0x123, q);

	q.value = 0;
	q_add(q, ((q1_15_16_t){
			 .value = 0x12345,
		 }));
	qassert(0x123, q);

	q.value = 0;
	q_add(q, ((q1_0_31_t){
			 .value = 0x12345678,
		 }));
	qassert(0x24, q);
}

ZTEST(q1_23_8, test_sub_int)
{
	q1_23_8_t q = {
		.value = 0,
	};

	/* 0 - -3, expect 3 */
	q_sub(q, -3);
	qassert(0x300, q);

	/* 3 - 1, expect 2 */
	q_sub(q, 1);
	qassert(0x200, q);

	/* 2 - 5, expect -3 */
	q_sub(q, 5);
	qassert(0xfffffd00, q);

	/* -3 - -10, expect 7 */
	q_sub(q, -10);
	qassert(0x700, q);
}

ZTEST(q1_23_8, test_sub_float)
{
	q1_23_8_t q = {
		.value = 0,
	};

	/* 0 - -3.5, expect 3.5 */
	q_sub(q, -3.5f);
	qassert(0x380, q);

	/* 3.5 - 1.3, expect 2.2 */
	q_sub(q, 1.3);
	qassert(0x234, q);

	/* 2.2 - 17.33, expect -15.13 */
	q_sub(q, 17.33f);
	qassert(0xfffff0e0, q);

	/* -15.13 - -22.7, expect 7.57 */
	q_sub(q, -22.7);
	qassert(0x794, q);
}

ZTEST(q1_23_8, test_sub_q)
{
	q1_23_8_t q = {
		.value = 0,
	};

	q_sub(q, ((q1_23_8_t){
			 .value = 0x123,
		 }));
	qassert(0xfffffedd, q);

	q.value = 0;
	q_sub(q, ((q1_15_16_t){
			 .value = 0x12345,
		 }));
	qassert(0xfffffedd, q);

	q.value = 0;
	q_sub(q, ((q1_0_31_t){
			 .value = 0x12345678,
		 }));
	qassert(0xffffffdc, q);
}

ZTEST(q1_23_8, test_mul_int)
{
	q1_23_8_t q = q_static(q1_23_8_t, 1);

	/* 1 * 3, expect 3 */
	q_mul(q, 3);
	qassert(0x300, q);

	/* 3 * 2, expect 6 */
	q_mul(q, 2);
	qassert(0x600, q);

	/* 6 * -5, expect -30 */
	q_mul(q, -5);
	qassert(0xffffe200, q);

	/* -30 * -2, expect 60 */
	q_mul(q, -2);
	qassert(0x3c00, q);
}

ZTEST(q1_23_8, test_mul_float)
{
	q1_23_8_t q = q_static(q1_23_8_t, 1);

	/* 1 * 3.5, expect 3.5 */
	q_mul(q, 3.5f);
	qassert(0x380, q);

	/* 3.5 * 1.3, expect 4.55 */
	q_mul(q, 1.3);
	qassert(0x48a, q);

	/* 4.55 * -3.2, expect -14.56 */
	q_mul(q, -3.2f);
	qassert(0xfffff175, q);

	/* -14.56 * -2.27, expect 33.0512 */
	q_mul(q, -2.27);
	qassert(0x2110, q);
}

ZTEST(q1_23_8, test_mul_q)
{
	q1_23_8_t q = q_static(q1_23_8_t, 2);

	/* 2 * 3.2 , expected 6.4*/
	q_mul(q, q_static(q1_23_8_t, 3.2));
	qassert(0x666, q);

	/* 6.4 * -2.23456, expected -14 76/255 (−14.301184)*/
	q_mul(q, q_static(q1_15_16_t, -2.23456));
	qassert(0xfffff1ad, q);

	/* -14 76/255 * -0.1234, expected 1 202/255 */
	q_mul(q, q_static(q1_0_31_t, -0.1234));
	qassert(0x1ca, q);
}

ZTEST(q1_23_8, test_div_int)
{
	q1_23_8_t q = q_static(q1_23_8_t, 1);

	/* 1 / 2, expect 0.5 */
	q_div(q, 2);
	qassert(0x80, q);

	/* 0.5 / -4, expect -0.125 */
	q_div(q, -4);
	qassert(0xffffffe0, q);

	/* -0.125 / -1, expect 0.125 */
	q_div(q, -1);
	qassert(0x20, q);
}

ZTEST(q1_23_8, test_div_float)
{
	q1_23_8_t q = q_static(q1_23_8_t, 5.0);

	/* 5 / 2.5, expect 2 */
	q_div(q, 2.5);
	qassert(0x200, q);

	/* 2 / 1.5, expect 1.33... */
	q_div(q, 1.5f);
	qassert(0x155, q);

	/* 4/3 / 1/3, expect 4 (with 3/255 error) */
	q_div(q, (1.0 / 3.0));
	qassert(0x403, q);
}

ZTEST(q1_23_8, test_div_q)
{
	q1_23_8_t q = q_static(q1_23_8_t, 5.0);

	/* 5 / 2.5, expect 2 */
	q_div(q, q_static(q1_23_8_t, 2.5));
	qassert(0x200, q);

	/* 2 / 1.5, expect 1.33... */
	q_div(q, q_static(q1_15_16_t , 1.5f));
	qassert(0x155, q);

	/* 4/3 / 1/3, expect 4 (with 3/255 error) */
	q_div(q, q_static(q1_0_31_t, (1.0 / 3.0)));
	qassert(0x403, q);
}
```
