## tests/misc/default_board_config/testcase.yaml
```yaml
tests:
  default_board_config:
    build_only: true
    build_on_all: true
    tags: default_board_config
    filter: not USING_OUT_OF_TREE_BOARD
```

## tests/misc/fpmath/testcase.yaml
```yaml
# Copyright (c) 2022 Google Inc
# SPDX-License-Identifier: Apache-2.0

common:
  integration_platforms:
    - native_posix
    - qemu_cortex_a53
    - qemu_riscv32
    - nsim_hs_mpuv6
    - frdm_k64f
    - qemu_x86_64
tests:
  math.fp.fixed.8:
    tags: util fpmath
    extra_configs:
      - CONFIG_MATH_UTIL_FLOAT=n
      - CONFIG_MATH_UTIL_FP_BITS=8
  math.fp.fixed.16:
    tags: util fpmath
    extra_configs:
      - CONFIG_MATH_UTIL_FLOAT=n
      - CONFIG_MATH_UTIL_FP_BITS=16
  math.fp.fixed.24:
    tags: util fpmath
    extra_configs:
      - CONFIG_MATH_UTIL_FLOAT=n
      - CONFIG_MATH_UTIL_FP_BITS=24
  math.fp.float.8:
    tags: util fpmath
    filter: CONFIG_CPU_HAS_FPU
    extra_configs:
      - CONFIG_FPU=y
      - CONFIG_MATH_UTIL_FLOAT=y
      - CONFIG_MATH_UTIL_FP_BITS=8
  math.fp.float.16:
    tags: util fpmath
    filter: CONFIG_CPU_HAS_FPU
    extra_configs:
      - CONFIG_FPU=y
      - CONFIG_MATH_UTIL_FLOAT=y
      - CONFIG_MATH_UTIL_FP_BITS=16
  math.fp.float.24:
    tags: util fpmath
    filter: CONFIG_CPU_HAS_FPU
    extra_configs:
      - CONFIG_FPU=y
      - CONFIG_MATH_UTIL_FLOAT=y
      - CONFIG_MATH_UTIL_FP_BITS=24
```

## tests/misc/iterable_sections/testcase.yaml
```yaml
tests:
  linker.iterable_sections:
    tags: iterable_sections
    arch_exclude: xtensa
```

## tests/misc/kconfigoptions/Kconfig
```kconfig
# Copyright (c) 2022 Nordic Semiconductor
#
# SPDX-License-Identifier: Apache-2.0
#

DT_FLASH_CONTROLLER := $(dt_nodelabel_path,flashcontroller0)

config FLASH_CONTROLLER_ADDRESS
	int
	default $(dt_node_array_prop_int,$(DT_FLASH_CONTROLLER),reg,0)

config FLASH_CONTROLLER_SIZE
	int
	default $(dt_node_array_prop_int,$(DT_FLASH_CONTROLLER),reg,1)

config FLASH_CONTROLLER_ADDR_INT_NODELABEL
	int
	default $(dt_nodelabel_reg_addr_int,flashcontroller0)

config FLASH_CONTROLLER_ADDR_HEX_NODELABEL
	hex
	default $(dt_nodelabel_reg_addr_hex,flashcontroller0)

config FLASH_CONTROLLER_SIZE_INT_NODELABEL
	int
	default $(dt_nodelabel_reg_size_int,flashcontroller0)

config FLASH_CONTROLLER_SIZE_HEX_NODELABEL
	hex
	default $(dt_nodelabel_reg_size_hex,flashcontroller0)

menu "Zephyr Kernel"
source "Kconfig.zephyr"
endmenu
```

## tests/misc/kconfigoptions/testcase.yaml
```yaml
tests:
  kconfig.kconfigoptions:
    tags: kconfigoptions
    platform_allow: native_posix
```

## tests/misc/llext-edk/testcase.yaml
```yaml
tests:
  misc.edk.pytest:
    harness: pytest
    tags:
      - pytest
      - edk
    platform_allow:
      - qemu_cortex_r5
    toolchain_exclude: llvm
```

## tests/misc/print_format/testcase.yaml
```yaml
common:
  harness: console
  harness_config:
    type: multi_line
    ordered: true
    regex:
    - "d8"
    - "d16"
    - "d32"
    - "d64"
    - "i8"
    - "i16"
    - "i32"
    - "i64"
    - "o10"
    - "o20"
    - "o40"
    - "o100"
    - "u8"
    - "u16"
    - "u32"
    - "u64"
    - "x8"
    - "x10"
    - "x20"
    - "x40"
    - "X8"
    - "X10"
    - "X20"
    - "X40"

tests:
  printk.format:
    tags: clib
  printk.format_newlib:
    tags: clib newlib
    filter: TOOLCHAIN_HAS_NEWLIB == 1
    extra_configs:
    - CONFIG_NEWLIB_LIBC=y
  printk.format.picolibc:
    tags: clib picolibc
    filter: CONFIG_PICOLIBC_SUPPORTED
    extra_configs:
    - CONFIG_PICOLIBC=y
```

## tests/misc/sys_reboot/testcase.yaml
```yaml
tests:
  misc.sys.sys_reboot:
    platform_allow: nrf52840dk_nrf52840 nrf52dk_nrf52832
    tags: sys_reboot
```

## tests/misc/test_build/testcase.yaml
```yaml
tests:
  buildsystem.debug.build:
    platform_exclude:
      - lpcxpresso55s69/lpc55s69/cpu0/ns
      - nrf9160dk/nrf9160/ns
      - nrf5340dk/nrf5340/cpuapp/ns
    build_only: true
    extra_args: CONF_FILE=debug.conf
    tags: debug
    integration_platforms:
      - native_sim
    filter: CONFIG_CONSOLE_HAS_DRIVER
  bootloader.mcuboot.build:
    tags: mcuboot
    build_only: true
    platform_allow:
      - nrf51dk/nrf51822
      - nrf52dk/nrf52832
    extra_configs:
      - CONFIG_BOOTLOADER_MCUBOOT=y
    integration_platforms:
      - nrf51dk/nrf51822
      - nrf52dk/nrf52832
  buildsystem.kconfig.utf8_in_values:
    build_only: true
    tags: kconfig
    integration_platforms:
      - native_sim
    extra_configs:
      - CONFIG_KERNEL_BIN_NAME="A_kconfig_value_with_a_utf8_char_in_it_Bøe_"
```

## tests/modules/nanopb/testcase.yaml
```yaml
tests:
  libraries.nanopb:
    modules:
      - nanopb
    tags:
      - nanopb
    integration_platforms:
      - native_sim
      - native_sim/native/64
      - qemu_malta/qemu_malta/be # Test on Big Endian platform
```

## tests/modules/tf-m/regression/boards/max32657evkit_max32657_ns.conf
```kconfig
# Copyright (c) 2025 Analog Devices, Inc.
#
# SPDX-License-Identifier: Apache-2.0
#

# MAX32657 only contains one UART.
# It is allocated to NS.
# Therefore, disable S side regression test.
CONFIG_TFM_REGRESSION_S=n

# MAX32657 currently only supports SFN
# and isolation level 1
CONFIG_TFM_SFN=y
CONFIG_TFM_ISOLATION_LEVEL=1
```

## tests/modules/tf-m/regression/testcase.yaml
```yaml
common:
  tags:
    - trusted-firmware-m
    - mcuboot
  modules:
    - tf-m-tests
  filter: CONFIG_BUILD_WITH_TFM
  integration_platforms:
    - mps2/an521/cpu0/ns
  harness: console
  harness_config:
    type: multi_line
    ordered: true
    regex:
      # There's an ANSI escape code between has and  PASSED: \x1b[32m (green color). The log file
      # strips ANSI sequences, which is why it looks clean there. But harness.handle() receives
      # the raw line with ANSI codes — so has PASSED never matches as a literal string.
      - "Test suite 'PSA protected storage NS interface tests.*' has.*PASSED"
      - "Test suite 'PSA internal trusted storage NS interface tests.*' has.*PASSED"
      - "Test suite 'Crypto non-secure interface test.*' has.*PASSED"
      - "Test suite 'Platform Service Non-Secure interface tests.*' has.*PASSED"

tests:
  tf-m.regression.ipc.lvl1:
    extra_args:
      - CONFIG_TFM_IPC=y
      - CONFIG_TFM_ISOLATION_LEVEL=1
    timeout: 200

  tf-m.regression.ipc.lvl2:
    extra_args:
      - CONFIG_TFM_IPC=y
      - CONFIG_TFM_ISOLATION_LEVEL=2
    timeout: 200

  tf-m.regression.sfn:
    extra_args:
      - CONFIG_TFM_SFN=y
      - CONFIG_TFM_ISOLATION_LEVEL=1
    timeout: 200
```

## tests/modules/thrift/ThriftTest/Kconfig
```kconfig
# SPDX-License-Identifier: Apache-2.0
# Copyright (c) 2022 Meta

source "Kconfig.zephyr"

config THRIFTTEST_SERVER_STACK_SIZE
	int "ThriftTest Server stack size"
	default 2048

config THRIFTTEST_LOG_LEVEL
	int "ThriftTest log level"
	default 4

config THRIFT_COMPACT_PROTOCOL
	bool "Use TCompactProtocol for tests"
	depends on THRIFT
	default y
	help
	  Enable this option to include TCompactProtocol in tests
```

## tests/modules/thrift/ThriftTest/testcase.yaml
```yaml
common:
  build_only: true
  tags:
    - thrift
    - cpp
  modules:
    - thrift
  filter: CONFIG_FULL_LIBC_SUPPORTED
  # qemu_x86 exluded due to missing long double functions in SDK
  # See https://github.com/zephyrproject-rtos/sdk-ng/issues/603
  platform_allow:
    - mps2/an385
    - qemu_cortex_a53
    - qemu_riscv32
    - qemu_riscv64
    - qemu_x86_64
tests:
  thrift.ThriftTest.newlib.binaryProtocol: {}
  thrift.ThriftTest.newlib.compactProtocol:
    extra_configs:
      - CONFIG_THRIFT_COMPACT_PROTOCOL=y
  thrift.ThriftTest.newlib.tlsTransport:
    extra_args: EXTRA_CONF_FILE="overlay-tls.conf"
```

## tests/modules/uoscore/testcase.yaml
```yaml
tests:
  libraries.uoscore:
    min_flash: 240
    modules:
      - uoscore-uedhoc
    tags:
      - net
      - crypto
      - uoscore
      - uoscore-uedhoc
    integration_platforms:
      - qemu_x86
```

## tests/net/6lo/testcase.yaml
```yaml
common:
  tags:
    - net
    - 6loWPAN
  min_ram: 32
  depends_on: netif
tests:
  net.6lo:
    extra_configs:
      - CONFIG_NET_TC_THREAD_COOPERATIVE=y
  net.6lo.preempt:
    extra_configs:
      - CONFIG_NET_TC_THREAD_PREEMPTIVE=y
  net.6lo.variable_buf_size:
    extra_configs:
      - CONFIG_NET_BUF_VARIABLE_DATA_SIZE=y
      - CONFIG_NET_BUF_DATA_POOL_SIZE=4096
```

## tests/net/all/testcase.yaml
```yaml
common:
  # Only used for compile testing so it is enough to use one platform here.
  build_only: true
  min_ram: 32
  tags:
    - net
    - net-all
tests:
  net.build:
    platform_allow: qemu_x86
    extra_configs:
      - CONFIG_NET_TC_THREAD_COOPERATIVE=y
  net.build.preempt:
    platform_allow: qemu_x86
    extra_configs:
      - CONFIG_NET_TC_THREAD_PREEMPTIVE=y
  net.build.no_compat_namespacing:
    platform_allow: qemu_x86
    extra_configs:
      - CONFIG_NET_NAMESPACE_COMPAT_MODE=n
      - CONFIG_POSIX_API=n
  net.build.compat_namespacing:
    platform_allow: qemu_x86
    extra_configs:
      - CONFIG_NET_NAMESPACE_COMPAT_MODE=y
  # Compile test CANBUS
  net.build.no_compat_namespacing_canbus:
    platform_allow: qemu_x86
    tags: can
    depends_on: can
    extra_configs:
      - CONFIG_NET_NAMESPACE_COMPAT_MODE=n
      - CONFIG_POSIX_API=n
      - CONFIG_NET_CANBUS=y
      - CONFIG_CAN=y
      - CONFIG_NET_SOCKETS_CAN=y
      - CONFIG_NET_L2_IEEE802154=n
  # Compile test OpenThread
  net.build.no_compat_namespacing_openthread:
    tags:
      - net
      - openthread
    depends_on: openthread
    platform_allow:
      - frdm_rw612
    extra_configs:
      - CONFIG_NET_NAMESPACE_COMPAT_MODE=n
      - CONFIG_POSIX_API=n
      - CONFIG_NET_L2_OPENTHREAD=y
      - CONFIG_CPP=y
      - CONFIG_NET_SLIP_TAP=n
      - CONFIG_NET_QEMU_SLIP=n
      - CONFIG_LWM2M_RESOURCE_DATA_CACHE_SUPPORT=n
      - CONFIG_LWM2M_RW_JSON_SUPPORT=n
      - CONFIG_USERSPACE=y
      - CONFIG_NXP_MONOLITHIC_NBU=n
      - CONFIG_NXP_MONOLITHIC_WIFI=n
      - CONFIG_NVS=y
      - CONFIG_NXP_RF_IMU=y
      - CONFIG_NXP_FW_LOADER=y
      - CONFIG_HDLC_RCP_IF=y
      - CONFIG_OPENTHREAD_MANUAL_START=y
      - CONFIG_OPENTHREAD_ZEPHYR_BORDER_ROUTER=y
      - CONFIG_OPENTHREAD_RCP_RESTORATION_MAX_COUNT=10
      - CONFIG_OPENTHREAD_ZEPHYR_BORDER_ROUTER_VENDOR_NAME="Zephyr"
      - CONFIG_OPENTHREAD_ZEPHYR_BORDER_ROUTER_BASE_SERVICE_NAME="Zephyr-BorderRouter"
      - CONFIG_OPENTHREAD_BACKBONE_ROUTER_MULTICAST_ROUTING=y
      - CONFIG_OPENTHREAD_SLAAC=y
      - CONFIG_OPENTHREAD_ENABLE_SERVICE=y
      - CONFIG_OPENTHREAD_BORDER_ROUTER=y
      - CONFIG_OPENTHREAD_BORDER_ROUTING=y
      - CONFIG_OPENTHREAD_BORDER_ROUTING_COUNTERS=y
      - CONFIG_OPENTHREAD_BORDER_AGENT=y
      - CONFIG_OPENTHREAD_BORDER_AGENT_ID=y
      - CONFIG_OPENTHREAD_NETDATA_PUBLISHER=y
      - CONFIG_OPENTHREAD_BACKBONE_ROUTER=y
      - CONFIG_OPENTHREAD_NAT64_TRANSLATOR=y
      - CONFIG_OPENTHREAD_NAT64_BORDER_ROUTING=y
      - CONFIG_OPENTHREAD_DNSSD_SERVER=y
      - CONFIG_OPENTHREAD_EXTERNAL_HEAP=y
      - CONFIG_OPENTHREAD_JOINER=y
      - CONFIG_OPENTHREAD_COMMISSIONER=y
      - CONFIG_OPENTHREAD_PLATFORM_UDP=y
      - CONFIG_OPENTHREAD_MULTICAST_DNS=y
      - CONFIG_OPENTHREAD_MAX_STATECHANGE_HANDLERS=3
      - CONFIG_OPENTHREAD_INTERFACE_EARLY_UP=y
      - CONFIG_OPENTHREAD_ECDSA=y
      - CONFIG_OPENTHREAD_IP6_FRAGM=y
      - CONFIG_OPENTHREAD_COAP=y
      - CONFIG_OPENTHREAD_SETTINGS_RAM=y
      - CONFIG_OPENTHREAD_BORDER_AGENT_EPHEMERAL_KEY_ENABLE=y
      - CONFIG_OPENTHREAD_VERHOEFF_CHECKSUM=y
      - CONFIG_OPENTHREAD_BORDER_AGENT_MESHCOP_SERVICE=y
      - CONFIG_OPENTHREAD_TREL=y
      - CONFIG_OPENTHREAD_TREL_MANAGE_DNSSD=y
      - CONFIG_OPENTHREAD_BORDER_ROUTING_DHCP6_PD=y
      - CONFIG_OPENTHREAD_BORDER_ROUTING_DHCP6_PD_CLIENT=y
      - CONFIG_OPENTHREAD_DHCP6_CLIENT=y
      - CONFIG_OPENTHREAD_DHCP6_SERVER=y
      - CONFIG_OPENTHREAD_DNS_UPSTREAM_QUERY=y
      - CONFIG_OPENTHREAD_SRP_CLIENT=y
      - CONFIG_OPENTHREAD_SRP_SERVER=y
      - CONFIG_OPENTHREAD_SRP_ADV_PROXY=y
      - CONFIG_OPENTHREAD_DNSSD_DISCOVERY_PROXY=y
      - CONFIG_OPENTHREAD_PING_SENDER=y
      - CONFIG_OPENTHREAD_LINK_METRICS_INITIATOR=y
      - CONFIG_OPENTHREAD_DUA=y
      - CONFIG_OPENTHREAD_MLR=y
      - CONFIG_OPENTHREAD_DNS_CLIENT=y
      - CONFIG_OPENTHREAD_DNS_CLIENT_OVER_TCP=y
      - CONFIG_OPENTHREAD_TCP_ENABLE=y
      - CONFIG_OPENTHREAD_NETDIAG_VENDOR_INFO=y
      - CONFIG_OPENTHREAD_LINK_METRICS_SUBJECT=y
      - CONFIG_OPENTHREAD_LINK_METRICS_MANAGER=y
      - CONFIG_OPENTHREAD_LINK_METRICS_INITIATOR=y
      - CONFIG_OPENTHREAD_MAC_FILTER=y
      - CONFIG_NET_SOCKETS_INET_RAW=y
      - CONFIG_OPENTHREAD_THREAD_VERSION_1_4=y
      - CONFIG_NET_IPV6_PE=n
      - CONFIG_NET_L2_IEEE802154=n
      - CONFIG_NET_ROUTE_MCAST=y
      - CONFIG_OPENTHREAD_SHELL=y
      - CONFIG_DNS_RESOLVER_PACKET_FORWARDING=y
```

## tests/net/app/testcase.yaml
```yaml
common:
  depends_on: netif
  platform_whitelist: native_posix qemu_x86 qemu_cortex_m3
tests:
  net.app:
    min_ram: 32
    tags: net
  net.app.no-ipv4:
    extra_args: CONF_FILE=prj-no-ipv4.conf
    min_ram: 32
    tags: net
  net.app.no-ipv6:
    extra_args: CONF_FILE=prj-no-ipv6.conf
    min_ram: 32
    tags: net
  net.app.with-dns:
    extra_args: CONF_FILE=prj-with-dns.conf
    min_ram: 32
    tags: net dns
```

## tests/net/arp/testcase.yaml
```yaml
common:
  depends_on: netif
  min_ram: 16
  tags: net arp
tests:
  net.arp:
    extra_configs:
      - CONFIG_NET_TC_THREAD_COOPERATIVE=y
  net.arp.preempt:
    extra_configs:
      - CONFIG_NET_TC_THREAD_PREEMPTIVE=y
```

## tests/net/automatic_testing/Kconfig
```kconfig
# Kconfig - Private config options for network testing app

#
# Copyright (c) 2018 Intel Corporation
#
# SPDX-License-Identifier: Apache-2.0
#

mainmenu "Networking test application"

config ZEPHYR_BASE
	string
	option env="ZEPHYR_BASE"

source "$ZEPHYR_BASE/Kconfig.zephyr"

config NET_DEBUG_TEST_APP
	bool "Enable debugging for this test application"
	default n
	depends on NET_LOG
	help
	  Enable debugging output from this test application.
	  The used log level is the CONFIG_SYS_LOG_NET_LEVEL option.

config SAMPLE_VLAN_TAG_1
	int "Virtual lan tag used in this app"
	default 100
	range 0 4094
	depends on NET_VLAN
	help
	  Set virtual lan tag (id) that is used in this application.

config SAMPLE_VLAN_TAG_2
	int "Second VLAN tag used in this app"
	default 200
	range 0 4094
	depends on NET_VLAN
	help
	  Set virtual lan tag (id) that is used in this application.

config SAMPLE_IPV6_ADDR_1
	string "My IPv6 address for a network interface"
	help
	  The value depends on your network setup.

config SAMPLE_IPV4_ADDR_1
	string "My IPv4 address for a network interface"
	help
	  The value depends on your network setup.

config SAMPLE_IPV4_GW_1
	string "My IPv4 gateway for a network interface"
	help
	  The value depends on your network setup.

config SAMPLE_IPV4_NETMASK_1
	string "My IPv4 netmask for a network interface"
	default "255.255.255.0"
	help
	  Static netmask to use if not overridden by DHCP. Use empty value to
	  skip setting static value.

config SAMPLE_IPV6_ADDR_2
	string "My IPv6 address for another network interface"
	help
	  The value depends on your network setup.

config SAMPLE_IPV4_ADDR_2
	string "My IPv4 address for another network interface"
	help
	  The value depends on your network setup.

config SAMPLE_IPV4_GW_2
	string "My IPv4 gateway for another network interface"
	help
	  The value depends on your network setup.

config SAMPLE_IPV4_NETMASK_2
	string "My IPv4 netmask for another network interface"
	default "255.255.255.0"
	help
	  Static netmask to use if not overridden by DHCP. Use empty value to
	  skip setting static value.
```

## tests/net/automatic_testing/sample.yaml
```yaml
common:
  harness: net
  tags: net net_automatic_testing vlan traffic_class
sample:
  description: Test network functionality via automatic scripts
  name: Network automatic testing app
tests:
  test:
    min_ram: 32
    depends_on: netif
```
