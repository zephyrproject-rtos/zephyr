## CMakeLists.txt
```
# SPDX-License-Identifier: Apache-2.0

cmake_minimum_required(VERSION 3.28.0)

find_package(Zephyr REQUIRED HINTS $ENV{ZEPHYR_BASE})

project(bluetooth_ascs)

target_include_directories(app PRIVATE
  ${ZEPHYR_BASE}/subsys/bluetooth/

  ${ZEPHYR_BASE}/tests/bluetooth/audio/ascs/include
  ${ZEPHYR_BASE}/tests/bluetooth/audio/mocks/include
  )

target_sources(app PRIVATE
  # Test source files
  src/main.c
  src/test_ase_control_params.c
  src/test_ase_register.c
  src/test_ase_state_transition_invalid.c
  src/test_ase_state_transition.c
  src/test_common.c

  # UUT files
  uut/bap_unicast_client.c
  uut/ascs.c

  # Stack source file
  ${ZEPHYR_BASE}/subsys/bluetooth/audio/ascs.c
  ${ZEPHYR_BASE}/subsys/bluetooth/audio/audio.c
  ${ZEPHYR_BASE}/subsys/bluetooth/audio/bap_iso.c
  ${ZEPHYR_BASE}/subsys/bluetooth/audio/bap_stream.c
  ${ZEPHYR_BASE}/subsys/bluetooth/common/bt_str.c
  ${ZEPHYR_BASE}/subsys/bluetooth/host/uuid.c
  ${ZEPHYR_BASE}/lib/uuid/uuid.c

  # Mock files
  ${ZEPHYR_BASE}/tests/bluetooth/audio/mocks/src/bap_stream.c
  ${ZEPHYR_BASE}/tests/bluetooth/audio/mocks/src/conn.c
  ${ZEPHYR_BASE}/tests/bluetooth/audio/mocks/src/gatt.c
  ${ZEPHYR_BASE}/tests/bluetooth/audio/mocks/src/iso.c
  ${ZEPHYR_BASE}/tests/bluetooth/audio/mocks/src/pacs.c
)
```

## Kconfig
```
# Copyright (c) 2025 Nordic Semiconductor ASA
# SPDX-License-Identifier: Apache-2.0

config BT_ATT_PREPARE_COUNT
	int
	default 1

config BT_AUDIO
	bool
	default y

config BT_BONDABLE
	bool
	default y

config BT_BUF_ACL_RX_SIZE
	int
	default 69

config BT_BUF_ACL_TX_COUNT
	int
	default 5

config BT_BUF_EVT_RX_COUNT
	int
	default 10

config BT_CONN
	bool
	default y

config BT_MAX_PAIRED
	int
	default 1

config BT_GATT_DYNAMIC_DB
	bool
	default y

config BT_ISO_PERIPHERAL
	bool
	default y

config BT_ISO_MAX_CHAN
	int
	default 10

config BT_L2CAP_TX_MTU
	int
	default 65

config BT_LOG
	bool
	default y

config BT_MAX_CONN
	int
	default 1

config BT_PERIPHERAL
	bool
	default y

config BT_SMP
	bool
	default y

# Include Zephyr's Kconfig.
source "Kconfig"
source "subsys/bluetooth/audio/Kconfig"
source "subsys/bluetooth/Kconfig.logging"
```

## prj.conf
```kconfig
CONFIG_ZTEST=y

CONFIG_NET_BUF=y

CONFIG_BT_ASCS=y
CONFIG_BT_PAC_SNK=y
CONFIG_BT_ASCS_MAX_ASE_SNK_COUNT=2
CONFIG_BT_PAC_SRC=y
CONFIG_BT_ASCS_MAX_ASE_SRC_COUNT=2
CONFIG_BT_ASCS_MAX_ACTIVE_ASES=1

CONFIG_LOG=y
CONFIG_BT_ASCS_LOG_LEVEL_DBG=y
CONFIG_BT_BAP_ISO_LOG_LEVEL_DBG=y
CONFIG_BT_BAP_STREAM_LOG_LEVEL_DBG=y

CONFIG_ASSERT=y
CONFIG_ASSERT_ON_ERRORS=y
```

## src/main.c
```c
/* main.c - Application main entry point */

/*
 * Copyright (c) 2023 Codecoup
 * Copyright (c) 2024 Demant A/S
 * Copyright (c) 2024-2026 Nordic Semiconductor ASA
 *
 * SPDX-License-Identifier: Apache-2.0
 */

#include <errno.h>
#include <stdbool.h>
#include <stdint.h>
#include <stdlib.h>
#include <string.h>

#include <zephyr/bluetooth/audio/ascs.h>
#include <zephyr/bluetooth/gap.h>
#include <zephyr/bluetooth/iso.h>
#include <zephyr/fff.h>
#include <zephyr/kernel.h>
#include <zephyr/bluetooth/audio/audio.h>
#include <zephyr/bluetooth/audio/bap.h>
#include <zephyr/bluetooth/audio/pacs.h>
#include <zephyr/bluetooth/conn.h>
#include <zephyr/bluetooth/hci_types.h>
#include <zephyr/bluetooth/gatt.h>
#include <zephyr/bluetooth/uuid.h>
#include <zephyr/net_buf.h>
#include <zephyr/sys/util.h>
#include <zephyr/sys/util_macro.h>
#include <zephyr/toolchain.h>
#include <zephyr/ztest_assert.h>
#include <zephyr/ztest_test.h>
#include <sys/types.h>

#include "assert.h"
#include "ascs.h"
#include "audio/ascs_internal.h"
#include "ascs_expects.h"
#include "bap_stream.h"
#include "bap_stream_expects.h"
#include "conn.h"
#include "gatt.h"
#include "gatt_expects.h"
#include "iso.h"

#include "test_common.h"

DEFINE_FFF_GLOBALS;

static void mock_init_rule_before(const struct ztest_unit_test *test, void *fixture)
{
	ARG_UNUSED(test);
	ARG_UNUSED(fixture);

	test_mocks_init();
}

static void mock_destroy_rule_after(const struct ztest_unit_test *test, void *fixture)
{
	ARG_UNUSED(test);
	ARG_UNUSED(fixture);

	test_mocks_cleanup();
}

ZTEST_RULE(mock_rule, mock_init_rule_before, mock_destroy_rule_after);

struct ascs_test_suite_fixture {
	const struct bt_gatt_attr *ase_cp;
	struct bt_bap_stream stream;
	struct bt_conn conn;
	struct {
		uint8_t id;
		const struct bt_gatt_attr *attr;
	} ase_snk, ase_src;
};

static void ascs_test_suite_fixture_init(struct ascs_test_suite_fixture *fixture)
{
	struct bt_ascs_register_param param = {
		.snk_cnt = CONFIG_BT_ASCS_MAX_ASE_SNK_COUNT,
		.src_cnt = CONFIG_BT_ASCS_MAX_ASE_SRC_COUNT,
		.cb = &mock_ascs_cb,
	};
	int err;

	memset(fixture, 0, sizeof(*fixture));

	err = bt_ascs_register(&param);
	zassert_equal(err, 0, "Unexpected err response %d", err);

	fixture->ase_cp = test_ase_control_point_get();

	test_conn_init(&fixture->conn);

	test_ase_snk_get(CONFIG_BT_ASCS_MAX_ASE_SNK_COUNT, &fixture->ase_snk.attr);
	if (fixture->ase_snk.attr != NULL) {
		fixture->ase_snk.id = test_ase_id_get(fixture->ase_snk.attr);
	}

	test_ase_src_get(CONFIG_BT_ASCS_MAX_ASE_SRC_COUNT, &fixture->ase_src.attr);
	if (fixture->ase_src.attr != NULL) {
		fixture->ase_src.id = test_ase_id_get(fixture->ase_src.attr);
	}
}

static void *ascs_test_suite_setup(void)
{
	struct ascs_test_suite_fixture *fixture;

	fixture = malloc(sizeof(*fixture));
	zassert_not_null(fixture);

	return fixture;
}

static void ascs_test_suite_before(void *f)
{
	memset(f, 0, sizeof(struct ascs_test_suite_fixture));
	ascs_test_suite_fixture_init(f);
}

static void ascs_test_suite_teardown(void *f)
{
	free(f);
}

static void ascs_test_suite_after(void *f)
{
	struct ascs_test_suite_fixture *fixture = (struct ascs_test_suite_fixture *)f;
	int err;

	if (fixture->conn.info.state == BT_CONN_STATE_CONNECTED) {
		mock_bt_conn_disconnected(&fixture->conn, BT_HCI_ERR_LOCALHOST_TERM_CONN);
	}

	err = bt_ascs_unregister();
	zassert_true(err == 0 || err == -EALREADY, "Unexpected err response %d", err);
}

ZTEST_SUITE(ascs_test_suite, NULL, ascs_test_suite_setup, ascs_test_suite_before,
	    ascs_test_suite_after, ascs_test_suite_teardown);

ZTEST_F(ascs_test_suite, test_has_sink_ase_chrc)
{
	Z_TEST_SKIP_IFNDEF(CONFIG_BT_ASCS_ASE_SNK);

	zassert_not_null(fixture->ase_snk.attr);
}

ZTEST_F(ascs_test_suite, test_has_source_ase_chrc)
{
	Z_TEST_SKIP_IFNDEF(CONFIG_BT_ASCS_ASE_SRC);

	zassert_not_null(fixture->ase_src.attr);
}

ZTEST_F(ascs_test_suite, test_has_control_point_chrc)
{
	zassert_not_null(fixture->ase_cp);
}

ZTEST_F(ascs_test_suite, test_sink_ase_read_state_idle)
{
	const struct bt_gatt_attr *ase = fixture->ase_snk.attr;
	struct bt_conn *conn = &fixture->conn;
	struct test_ase_chrc_value_hdr hdr = { 0xff };
	ssize_t ret;

	Z_TEST_SKIP_IFNDEF(CONFIG_BT_ASCS_ASE_SNK);
	zexpect_not_null(fixture->ase_snk.attr);

	ret = ase->read(conn, ase, &hdr, sizeof(hdr), 0);
	zassert_false(ret < 0, "attr->read returned unexpected (err 0x%02x)",
		      (uint8_t)BT_GATT_ERR(ret));
	zassert_equal(0x00, hdr.ase_state, "unexpected ASE_State 0x%02x", hdr.ase_state);
}

ZTEST_F(ascs_test_suite, test_release_ase_on_unregister)
{
	const struct bt_gatt_attr *ase;
	struct bt_bap_stream *stream = &fixture->stream;
	struct bt_conn *conn = &fixture->conn;
	uint8_t ase_id;
	int err;

	if (IS_ENABLED(CONFIG_BT_ASCS_ASE_SNK)) {
		ase = fixture->ase_snk.attr;
		ase_id = fixture->ase_snk.id;
	} else {
		ase = fixture->ase_src.attr;
		ase_id = fixture->ase_src.id;
	}

	zexpect_not_null(ase);
	zexpect_true(ase_id != 0x00U);

	/* Set ASE to non-idle state */
	test_ase_control_client_config_codec(conn, ase_id, stream);

	/* Reset mock, as we expect ASE notification to be sent */
	bt_gatt_notify_cb_reset();

	err = bt_ascs_unregister();
	zassert_equal(err, 0, "Unexpected err response %d", err);

	/* Expected to notify the upper layers */
	expect_bt_bap_stream_ops_released_called(1, (const struct bt_bap_stream **)&stream);
}

ZTEST_F(ascs_test_suite, test_abort_client_operation_if_callback_not_registered)
{
	const struct test_ase_cp_chrc_value_param *param;
	const struct test_ase_cp_chrc_value_hdr *hdr;
	const struct bt_gatt_attr *ase_cp = fixture->ase_cp;
	struct bt_bap_stream *stream = &fixture->stream;
	struct bt_conn *conn = &fixture->conn;
	struct bt_gatt_notify_params *notify_params;
	uint8_t ase_id;

	mock_ascs_cb.config = NULL;

	if (IS_ENABLED(CONFIG_BT_ASCS_ASE_SNK)) {
		ase_id = fixture->ase_snk.id;
	} else {
		ase_id = fixture->ase_src.id;
	}

	zexpect_not_null(ase_cp);
	zexpect_true(ase_id != 0x00U);

	/* Set ASE to non-idle state */
	test_ase_control_client_config_codec(conn, ase_id, stream);

	/* Expected ASE Control Point notification with Unspecified Error was sent */
	expect_bt_gatt_notify_cb_called_once(conn, BT_UUID_ASCS_ASE_CP, ase_cp,
					     EMPTY, TEST_ASE_CP_CHRC_VALUE_SIZE(1));

	notify_params = mock_bt_gatt_notify_cb_fake.arg1_val;
	hdr = (void *)notify_params->data;
	zassert_equal(0x01, hdr->opcode, "unexpected Opcode 0x%02x", hdr->opcode);
	zassert_equal(0x01, hdr->number_of_ases, "unexpected Number_of_ASEs 0x%02x",
		      hdr->number_of_ases);
	param = (void *)hdr->params;
	zassert_equal(ase_id, param->ase_id, "unexpected ASE_ID 0x%02x", param->ase_id);
	/* Expect Unspecified Error */
	zassert_equal(0x0E, param->response_code, "unexpected Response_Code 0x%02x",
		      param->response_code);
	zassert_equal(0x00, param->reason, "unexpected Reason 0x%02x", param->reason);
}

ZTEST_F(ascs_test_suite, test_release_ase_on_acl_disconnection)
{
	struct bt_bap_stream *stream = &fixture->stream;
	struct bt_conn *conn = &fixture->conn;
	const struct bt_gatt_attr *ase;
	struct bt_iso_chan *chan;
	uint8_t ase_id;

	if (IS_ENABLED(CONFIG_BT_ASCS_ASE_SNK)) {
		ase = fixture->ase_snk.attr;
		ase_id = fixture->ase_snk.id;
	} else {
		ase = fixture->ase_src.attr;
		ase_id = fixture->ase_src.id;
	}

	zexpect_not_null(ase);
	zexpect_true(ase_id != 0x00U);

	/* Set ASE to non-idle state */
	test_preamble_state_streaming(conn, ase_id, stream, &chan,
				      !IS_ENABLED(CONFIG_BT_ASCS_ASE_SNK));

	/* Mock ACL disconnection */
	mock_bt_conn_disconnected(conn, BT_HCI_ERR_CONN_TIMEOUT);

	/* Expected to notify the upper layers */
	expect_bt_bap_stream_ops_released_called(1, (const struct bt_bap_stream **)&stream);

	/* Mock CIS disconnection */
	mock_bt_iso_disconnected(chan, BT_HCI_ERR_CONN_TIMEOUT);
}

ZTEST_F(ascs_test_suite, test_release_ase_pair_on_acl_disconnection)
{
	const struct bt_gatt_attr *ase_snk, *ase_src;
	struct bt_bap_stream snk_stream, src_stream;
	struct bt_conn *conn = &fixture->conn;
	uint8_t ase_snk_id, ase_src_id;
	struct bt_iso_chan *chan;
	int err;

	if (CONFIG_BT_ASCS_MAX_ACTIVE_ASES < 2) {
		ztest_test_skip();
	}

	Z_TEST_SKIP_IFNDEF(CONFIG_BT_ASCS_ASE_SNK);
	memset(&snk_stream, 0, sizeof(snk_stream));
	ase_snk = fixture->ase_snk.attr;
	zexpect_not_null(ase_snk);
	ase_snk_id = fixture->ase_snk.id;
	zexpect_true(ase_snk_id != 0x00U);

	Z_TEST_SKIP_IFNDEF(CONFIG_BT_ASCS_ASE_SRC);
	memset(&src_stream, 0, sizeof(src_stream));
	ase_src = fixture->ase_src.attr;
	zexpect_not_null(ase_src);
	ase_src_id = fixture->ase_src.id;
	zexpect_true(ase_src_id != 0x00U);

	test_ase_control_client_config_codec(conn, ase_snk_id, &snk_stream);
	test_ase_control_client_config_qos(conn, ase_snk_id);
	test_ase_control_client_enable(conn, ase_snk_id);

	test_ase_control_client_config_codec(conn, ase_src_id, &src_stream);
	test_ase_control_client_config_qos(conn, ase_src_id);
	test_ase_control_client_enable(conn, ase_src_id);

	err = mock_bt_iso_accept(conn, 0x01, 0x01, &chan);
	zassert_equal(0, err, "Failed to connect iso: err %d", err);

	test_ase_control_client_receiver_start_ready(conn, ase_src_id);

	err = bt_ascs_start_ase(snk_stream.ep);
	zassert_equal(0, err, "bt_ascs_start_ase err %d", err);

	test_mocks_reset();

	/* Mock ACL disconnection */
	mock_bt_conn_disconnected(conn, BT_HCI_ERR_CONN_TIMEOUT);

	/* Expected to notify the upper layers */
	const struct bt_bap_stream *streams[] = { &snk_stream, &src_stream };

	expect_bt_bap_stream_ops_released_called(ARRAY_SIZE(streams), streams);

	/* Mock CIS disconnection */
	mock_bt_iso_disconnected(chan, BT_HCI_ERR_CONN_TIMEOUT);
}

ZTEST_F(ascs_test_suite, test_recv_in_streaming_state)
{
	struct bt_bap_stream *stream = &fixture->stream;
	struct bt_conn *conn = &fixture->conn;
	uint8_t ase_id = fixture->ase_snk.id;
	struct bt_iso_recv_info info = {
		.seq_num = 1,
		.flags = BT_ISO_FLAGS_VALID,
	};
	struct bt_iso_chan *chan;
	struct net_buf buf;

	Z_TEST_SKIP_IFNDEF(CONFIG_BT_ASCS_ASE_SNK);

	test_preamble_state_streaming(conn, ase_id, stream, &chan, false);

	chan->ops->recv(chan, &info, &buf);

	/* Verification */
	expect_bt_bap_stream_ops_recv_called(1, &stream, &info, &buf);
}

ZTEST_F(ascs_test_suite, test_recv_in_enabling_state)
{
	struct bt_bap_stream *stream = &fixture->stream;
	struct bt_conn *conn = &fixture->conn;
	uint8_t ase_id = fixture->ase_snk.id;
	struct bt_iso_recv_info info = {
		.seq_num = 1,
		.flags = BT_ISO_FLAGS_VALID,
	};
	struct bt_iso_chan *chan;
	struct net_buf buf;
	int err;

	Z_TEST_SKIP_IFNDEF(CONFIG_BT_ASCS_ASE_SNK);

	test_preamble_state_enabling(conn, ase_id, stream);

	err = mock_bt_iso_accept(conn, 0x01, 0x01, &chan);
	zassert_equal(0, err, "Failed to connect iso: err %d", err);

	test_mocks_reset();

	chan->ops->recv(chan, &info, &buf);

	/* Verification */
	expect_bt_bap_stream_ops_recv_called(0, NULL, NULL, NULL);
}

ZTEST_F(ascs_test_suite, test_cis_link_loss_in_streaming_state)
{
	struct bt_bap_stream *stream = &fixture->stream;
	struct bt_conn *conn = &fixture->conn;
	const struct bt_gatt_attr *ase;
	struct bt_iso_chan *chan;
	uint8_t ase_id;

	if (IS_ENABLED(CONFIG_BT_ASCS_ASE_SNK)) {
		ase = fixture->ase_snk.attr;
		ase_id = fixture->ase_snk.id;
	} else {
		ase = fixture->ase_src.attr;
		ase_id = fixture->ase_src.id;
	}
	zexpect_not_null(ase);
	zexpect_true(ase_id != 0x00U);

	test_preamble_state_streaming(conn, ase_id, stream, &chan,
				      !IS_ENABLED(CONFIG_BT_ASCS_ASE_SNK));

	/* Mock CIS disconnection */
	mock_bt_iso_disconnected(chan, BT_HCI_ERR_CONN_TIMEOUT);

	test_drain_syswq(); /* Ensure that state transitions are completed */

	/* Expected to notify the upper layers */
	expect_bt_bap_stream_ops_qos_configured_called(1, &stream);
	expect_bt_bap_stream_ops_disabled_called(1, &stream);
	expect_bt_bap_stream_ops_released_called(0, NULL);
	expect_bt_bap_stream_ops_disconnected_called(1, (const struct bt_bap_stream **)&stream);
}

static void test_cis_link_loss_in_disabling_state(struct ascs_test_suite_fixture *fixture,
						  bool streaming)
{
	struct bt_bap_stream *stream = &fixture->stream;
	struct bt_conn *conn = &fixture->conn;
	const struct bt_gatt_attr *ase;
	struct bt_iso_chan *chan;
	uint8_t ase_id;
	int err;

	Z_TEST_SKIP_IFNDEF(CONFIG_BT_ASCS_ASE_SRC);

	ase = fixture->ase_src.attr;
	ase_id = fixture->ase_src.id;
	zexpect_not_null(ase);
	zexpect_true(ase_id != 0x00U);

	test_preamble_state_enabling(conn, ase_id, stream);
	err = mock_bt_iso_accept(conn, 0x01, 0x01, &chan);
	zassert_equal(0, err, "Failed to connect iso: err %d", err);

	if (streaming) {
		test_ase_control_client_receiver_start_ready(conn, ase_id);
	}

	test_ase_control_client_disable(conn, ase_id);

	expect_bt_bap_stream_ops_disabled_called(1, &stream);

	test_mocks_reset();

	/* Mock CIS disconnection */
	mock_bt_iso_disconnected(chan, BT_HCI_ERR_CONN_TIMEOUT);

	test_drain_syswq(); /* Ensure that state transitions are completed */

	/* Expected to notify the upper layers */
	expect_bt_bap_stream_ops_qos_configured_called(1, &stream);
	expect_bt_bap_stream_ops_disabled_called(0, NULL);
	expect_bt_bap_stream_ops_released_called(0, NULL);
	expect_bt_bap_stream_ops_disconnected_called(1, (const struct bt_bap_stream **)&stream);
}

ZTEST_F(ascs_test_suite, test_cis_link_loss_in_disabling_state_v1)
{
	/* Enabling -> Streaming -> Disabling */
	test_cis_link_loss_in_disabling_state(fixture, true);
}

ZTEST_F(ascs_test_suite, test_cis_link_loss_in_disabling_state_v2)
{
	/* Enabling -> Disabling */
	test_cis_link_loss_in_disabling_state(fixture, false);
}

ZTEST_F(ascs_test_suite, test_cis_link_loss_in_enabling_state)
{
	struct bt_bap_stream *stream = &fixture->stream;
	struct bt_conn *conn = &fixture->conn;
	const struct bt_gatt_attr *ase;
	struct bt_iso_chan *chan;
	uint8_t ase_id;
	int err;

	if (IS_ENABLED(CONFIG_BT_ASCS_ASE_SNK)) {
		ase = fixture->ase_snk.attr;
		ase_id = fixture->ase_snk.id;
	} else {
		ase = fixture->ase_src.attr;
		ase_id = fixture->ase_src.id;
	}
	zexpect_not_null(ase);
	zexpect_true(ase_id != 0x00U);

	test_preamble_state_enabling(conn, ase_id, stream);
	err = mock_bt_iso_accept(conn, 0x01, 0x01, &chan);
	zassert_equal(0, err, "Failed to connect iso: err %d", err);

	/* Mock CIS disconnection */
	mock_bt_iso_disconnected(chan, BT_HCI_ERR_CONN_TIMEOUT);

	test_drain_syswq(); /* Ensure that state transitions are completed */

	/* Expected no change in ASE state */
	expect_bt_bap_stream_ops_qos_configured_called(0, NULL);
	expect_bt_bap_stream_ops_released_called(0, NULL);
	expect_bt_bap_stream_ops_disconnected_called(1, (const struct bt_bap_stream **)&stream);

	err = bt_ascs_disable_ase(stream->ep);
	zassert_equal(0, err, "Failed to disable stream: err %d", err);

	test_drain_syswq(); /* Ensure that state transitions are completed */

	if (IS_ENABLED(CONFIG_BT_ASCS_ASE_SNK)) {
		expect_bt_bap_stream_ops_qos_configured_called(1, &stream);
		expect_bt_bap_stream_ops_disabled_called(1, &stream);
	} else {
		/* Server-initiated disable operation that shall not cause transition to QoS */
		expect_bt_bap_stream_ops_qos_configured_called(0, NULL);
	}
}

ZTEST_F(ascs_test_suite, test_cis_link_loss_in_enabling_state_client_retries)
{
	struct bt_bap_stream *stream = &fixture->stream;
	struct bt_conn *conn = &fixture->conn;
	const struct bt_gatt_attr *ase;
	struct bt_iso_chan *chan;
	uint8_t ase_id;
	int err;

	if (IS_ENABLED(CONFIG_BT_ASCS_ASE_SNK)) {
		ase = fixture->ase_snk.attr;
		ase_id = fixture->ase_snk.id;
	} else {
		ase = fixture->ase_src.attr;
		ase_id = fixture->ase_src.id;
	}
	zexpect_not_null(ase);
	zexpect_true(ase_id != 0x00U);

	test_preamble_state_enabling(conn, ase_id, stream);
	err = mock_bt_iso_accept(conn, 0x01, 0x01, &chan);
	zassert_equal(0, err, "Failed to connect iso: err %d", err);
	expect_bt_bap_stream_ops_connected_called(1, (const struct bt_bap_stream **)&stream);

	/* Mock CIS disconnection */
	mock_bt_iso_disconnected(chan, BT_HCI_ERR_CONN_FAIL_TO_ESTAB);

	test_drain_syswq(); /* Ensure that state transitions are completed */

	/* Expected to not notify the upper layers */
	expect_bt_bap_stream_ops_qos_configured_called(0, NULL);
	expect_bt_bap_stream_ops_released_called(0, NULL);
	expect_bt_bap_stream_ops_disconnected_called(1, (const struct bt_bap_stream **)&stream);

	/* Client retries to establish CIS */
	err = mock_bt_iso_accept(conn, 0x01, 0x01, &chan);
	zassert_equal(0, err, "Failed to connect iso: err %d", err);
	if (!IS_ENABLED(CONFIG_BT_ASCS_ASE_SNK)) {
		test_ase_control_client_receiver_start_ready(conn, ase_id);
	} else {
		err = bt_ascs_start_ase(stream->ep);
		zassert_equal(0, err, "bt_ascs_start_ase err %d", err);
	}

	test_drain_syswq(); /* Ensure that state transitions are completed */

	const struct bt_bap_stream *streams[] = { stream, stream };

	expect_bt_bap_stream_ops_connected_called(ARRAY_SIZE(streams), streams);
	expect_bt_bap_stream_ops_started_called(1, &stream);
}

static struct bt_bap_stream *stream_allocated;
static const struct bt_bap_qos_cfg_pref qos_pref =
	BT_BAP_QOS_CFG_PREF(true, BT_GAP_LE_PHY_2M, 0x02U, 10U, 40000U, 40000U, 40000U, 40000U);

static int ascs_cb_config_custom_fake(struct bt_conn *conn, const struct bt_bap_ep *ep,
				      enum bt_audio_dir dir,
				      const struct bt_audio_codec_cfg *codec_cfg,
				      struct bt_bap_stream **stream,
				      struct bt_bap_qos_cfg_pref *const pref,
				      struct bt_bap_ascs_rsp *rsp)
{
	ARG_UNUSED(conn);
	ARG_UNUSED(ep);
	ARG_UNUSED(dir);
	ARG_UNUSED(codec_cfg);

	*stream = stream_allocated;
	*pref = qos_pref;
	*rsp = BT_BAP_ASCS_RSP(BT_BAP_ASCS_RSP_CODE_SUCCESS, BT_BAP_ASCS_REASON_NONE);

	bt_bap_stream_cb_register(*stream, &mock_bap_stream_ops);

	return 0;
}

ZTEST_F(ascs_test_suite, test_ase_state_notification_retry)
{
	struct bt_bap_stream *stream = &fixture->stream;
	struct bt_conn *conn = &fixture->conn;
	const struct bt_gatt_attr *ase, *cp;
	struct bt_conn_info info;
	uint8_t ase_id;
	int err;

	if (IS_ENABLED(CONFIG_BT_ASCS_ASE_SNK)) {
		ase = fixture->ase_snk.attr;
		ase_id = fixture->ase_snk.id;
	} else {
		ase = fixture->ase_src.attr;
		ase_id = fixture->ase_src.id;
	}

	zexpect_not_null(ase);
	zassert_not_equal(ase_id, 0x00U);

	cp = test_ase_control_point_get();
	zexpect_not_null(cp);

	stream_allocated = stream;
	mock_ascs_cb_config_fake.custom_fake = ascs_cb_config_custom_fake;

	/* Mock out of buffers case */
	mock_bt_gatt_notify_cb_fake.return_val = -ENOMEM;

	const uint8_t buf[] = {
		0x01U,          /* Opcode = Config Codec */
		0x01U,          /* Number_of_ASEs */
		ase_id,         /* ASE_ID[0] */
		0x01U,          /* Target_Latency[0] = Target low latency */
		0x02U,          /* Target_PHY[0] = LE 2M PHY */
		0x06U,          /* Codec_ID[0].Coding_Format = LC3 */
		0x00U, 0x00U,   /* Codec_ID[0].Company_ID */
		0x00U, 0x00U,   /* Codec_ID[0].Vendor_Specific_Codec_ID */
		0x00U,          /* Codec_Specific_Configuration_Length[0] */
	};

	cp->write(conn, cp, (void *)buf, sizeof(buf), 0, 0);

	/* Verification */
	expect_bt_bap_stream_ops_codec_configured_called(0, NULL, NULL);

	mock_bt_gatt_notify_cb_fake.return_val = 0;

	err = bt_conn_get_info(conn, &info);
	zassert_equal(err, 0);

	/* Wait for ASE state notification retry */
	k_sleep(K_USEC(info.le.interval_us));

	expect_bt_bap_stream_ops_codec_configured_called(1, &stream, NULL);
}
```

## include/ascs.h
```c
/*
 * Copyright (c) 2023 Codecoup
 * Copyright (c) 2026 Nordic Semiconductor ASA
 *
 * SPDX-License-Identifier: Apache-2.0
 */

#ifndef MOCKS_ASCS_H_
#define MOCKS_ASCS_H_
#include <stddef.h>
#include <stdint.h>

#include <zephyr/bluetooth/audio/ascs.h>
#include <zephyr/bluetooth/audio/audio.h>
#include <zephyr/bluetooth/conn.h>
#include <zephyr/fff.h>
#include <zephyr/bluetooth/audio/bap.h>

extern struct bt_ascs_cb mock_ascs_cb;

void mock_ascs_init(void);
void mock_ascs_cleanup(void);

DECLARE_FAKE_VALUE_FUNC(int, mock_ascs_cb_config, struct bt_conn *, const struct bt_bap_ep *,
			enum bt_audio_dir, const struct bt_audio_codec_cfg *,
			struct bt_bap_stream **, struct bt_bap_qos_cfg_pref *const,
			struct bt_bap_ascs_rsp *);
DECLARE_FAKE_VALUE_FUNC(int, mock_ascs_cb_reconfig, struct bt_bap_stream *, enum bt_audio_dir,
			const struct bt_audio_codec_cfg *, struct bt_bap_qos_cfg_pref *const,
			struct bt_bap_ascs_rsp *);
DECLARE_FAKE_VALUE_FUNC(int, mock_ascs_cb_qos, struct bt_bap_stream *,
			const struct bt_bap_qos_cfg *, struct bt_bap_ascs_rsp *);
DECLARE_FAKE_VALUE_FUNC(int, mock_ascs_cb_enable, struct bt_bap_stream *, const uint8_t *, size_t,
			struct bt_bap_ascs_rsp *);
DECLARE_FAKE_VALUE_FUNC(int, mock_ascs_cb_start, struct bt_bap_stream *, struct bt_bap_ascs_rsp *);
DECLARE_FAKE_VALUE_FUNC(int, mock_ascs_cb_metadata, struct bt_bap_stream *, const uint8_t *, size_t,
			struct bt_bap_ascs_rsp *);
DECLARE_FAKE_VALUE_FUNC(int, mock_ascs_cb_disable, struct bt_bap_stream *,
			struct bt_bap_ascs_rsp *);
DECLARE_FAKE_VALUE_FUNC(int, mock_ascs_cb_stop, struct bt_bap_stream *, struct bt_bap_ascs_rsp *);
DECLARE_FAKE_VALUE_FUNC(int, mock_ascs_cb_release, struct bt_bap_stream *,
			struct bt_bap_ascs_rsp *);

#endif /* MOCKS_ASCS_H_ */
```

## include/ascs_expects.h
```c
/*
 * Copyright (c) 2023 Codecoup
 * Copyright (c) 2026 Nordic Semiconductor ASA
 *
 * SPDX-License-Identifier: Apache-2.0
 */

#ifndef MOCKS_ASCS_EXPECTS_H_
#define MOCKS_ASCS_EXPECTS_H_

#include <zephyr/bluetooth/audio/audio.h>
#include <zephyr/bluetooth/audio/bap.h>
#include <zephyr/bluetooth/conn.h>
#include <zephyr/ztest_assert.h>

#include "ascs.h"
#include <expects_util.h>

static inline void expect_bt_ascs_cb_config_called(unsigned int expected_count,
						   struct bt_conn *conns[], struct bt_bap_ep *eps[],
						   enum bt_audio_dir dirs[], void *codec[])
{
	const char *func_name = "bt_ascs_cb.config";

	zexpect_call_count(func_name, expected_count, mock_ascs_cb_config_fake.call_count);

	for (unsigned int i = 0U; i < mock_ascs_cb_config_fake.call_count; i++) {
		zassert_equal_ptr(conns[i], mock_ascs_cb_config_fake.arg0_history[i],
				  "'%s()' was called with incorrect 'conn[%i]' value", func_name,
				  i);
		if (eps != NULL) {
			zassert_equal_ptr(eps[i], mock_ascs_cb_config_fake.arg1_history[i],
					  "'%s()' was called with incorrect 'ep[%i]' value",
					  func_name, i);
		}
		zassert_equal(dirs[i], mock_ascs_cb_config_fake.arg2_history[i],
			      "'%s()' was called with incorrect 'dir[%i]' value", func_name, i);
	}

	if (codec != NULL) {
		/* TODO */
		zassert_unreachable("Not implemented");
	}
}

static inline void expect_bt_ascs_cb_reconfig_called(unsigned int expected_count,
						     struct bt_bap_stream *streams[],
						     const enum bt_audio_dir dirs[], void *codec[])
{
	const char *func_name = "bt_ascs_cb.reconfig";

	zexpect_call_count(func_name, expected_count, mock_ascs_cb_reconfig_fake.call_count);

	for (unsigned int i = 0U; i < mock_ascs_cb_reconfig_fake.call_count; i++) {
		zassert_equal_ptr(streams[i], mock_ascs_cb_reconfig_fake.arg0_history[i],
				  "'%s()' was called with incorrect 'stream[%i]' value", func_name,
				  i);
		zassert_equal(dirs[i], mock_ascs_cb_reconfig_fake.arg1_history[i],
			      "'%s()' was called with incorrect 'dir[%i]' value", func_name, i);
	}

	if (codec != NULL) {
		/* TODO */
		zassert_unreachable("Not implemented");
	}
}

static inline void expect_bt_ascs_cb_qos_called(unsigned int expected_count,
						struct bt_bap_stream *streams[], void *qos[])
{
	const char *func_name = "bt_ascs_cb.qos";

	zexpect_call_count(func_name, expected_count, mock_ascs_cb_qos_fake.call_count);

	for (unsigned int i = 0U; i < mock_ascs_cb_qos_fake.call_count; i++) {
		zassert_equal_ptr(streams[i], mock_ascs_cb_qos_fake.arg0_history[i],
				  "'%s()' was called with incorrect 'stream[%i]' value", func_name,
				  i);
	}

	if (qos != NULL) {
		/* TODO */
		zassert_unreachable("Not implemented");
	}
}

static inline void expect_bt_ascs_cb_enable_called(unsigned int expected_count,
						   struct bt_bap_stream *streams[], void *meta[],
						   void *meta_len[])
{
	const char *func_name = "bt_ascs_cb.enable";

	zexpect_call_count(func_name, expected_count, mock_ascs_cb_enable_fake.call_count);

	for (unsigned int i = 0U; i < mock_ascs_cb_enable_fake.call_count; i++) {
		zassert_equal_ptr(streams[i], mock_ascs_cb_enable_fake.arg0_history[i],
				  "'%s()' was called with incorrect 'stream[%i]' value", func_name,
				  i);
	}

	if (meta != NULL) {
		/* TODO */
		zassert_unreachable("Not implemented");
	}

	if (meta_len != NULL) {
		/* TODO */
		zassert_unreachable("Not implemented");
	}
}

static inline void expect_bt_ascs_cb_metadata_called(unsigned int expected_count,
						     struct bt_bap_stream *streams[], void *meta[],
						     void *meta_len[])
{
	const char *func_name = "bt_ascs_cb.metadata";

	zexpect_call_count(func_name, expected_count, mock_ascs_cb_metadata_fake.call_count);

	for (unsigned int i = 0U; i < mock_ascs_cb_metadata_fake.call_count; i++) {
		zassert_equal_ptr(streams[i], mock_ascs_cb_metadata_fake.arg0_history[i],
				  "'%s()' was called with incorrect 'stream[%i]' value", func_name,
				  i);
	}

	if (meta != NULL) {
		/* TODO */
		zassert_unreachable("Not implemented");
	}

	if (meta_len != NULL) {
		/* TODO */
		zassert_unreachable("Not implemented");
	}
}

static inline void expect_bt_ascs_cb_disable_called(unsigned int expected_count,
						    struct bt_bap_stream *streams[])
{
	const char *func_name = "bt_ascs_cb.disable";

	zexpect_call_count(func_name, expected_count, mock_ascs_cb_disable_fake.call_count);

	for (unsigned int i = 0U; i < mock_ascs_cb_disable_fake.call_count; i++) {
		zassert_equal_ptr(streams[i], mock_ascs_cb_disable_fake.arg0_history[i],
				  "'%s()' was called with incorrect 'stream[%i]' value", func_name,
				  i);
	}
}

static inline void expect_bt_ascs_cb_release_called(unsigned int expected_count,
						    struct bt_bap_stream *streams[])
{
	const char *func_name = "bt_ascs_cb.release";

	zexpect_call_count(func_name, expected_count, mock_ascs_cb_release_fake.call_count);

	for (unsigned int i = 0U; i < mock_ascs_cb_release_fake.call_count; i++) {
		zassert_equal_ptr(streams[i], mock_ascs_cb_release_fake.arg0_history[i],
				  "'%s()' was called with incorrect 'stream[%i]' value", func_name,
				  i);
	}
}

static inline void expect_bt_ascs_cb_start_called(unsigned int expected_count,
						  struct bt_bap_stream *streams[])
{
	const char *func_name = "bt_ascs_cb.start";

	zexpect_call_count(func_name, expected_count, mock_ascs_cb_start_fake.call_count);

	for (unsigned int i = 0U; i < mock_ascs_cb_start_fake.call_count; i++) {
		zassert_equal_ptr(streams[i], mock_ascs_cb_start_fake.arg0_history[i],
				  "'%s()' was called with incorrect 'stream[%i]' value", func_name,
				  i);
	}
}

static inline void expect_bt_ascs_cb_stop_called(unsigned int expected_count,
						 struct bt_bap_stream *streams[])
{
	const char *func_name = "bt_ascs_cb.stop";

	zexpect_call_count(func_name, expected_count, mock_ascs_cb_stop_fake.call_count);

	for (unsigned int i = 0U; i < mock_ascs_cb_stop_fake.call_count; i++) {
		zassert_equal_ptr(streams[i], mock_ascs_cb_stop_fake.arg0_history[i],
				  "'%s()' was called with incorrect 'stream[%i]' value", func_name,
				  i);
	}
}

#endif /* MOCKS_ASCS_EXPECTS_H_ */
```

## include/bap_unicast_server.h
```c
/*
 * Copyright (c) 2023 Codecoup
 *
 * SPDX-License-Identifier: Apache-2.0
 */

#ifndef MOCKS_BAP_UNICAST_SERVER_H_
#define MOCKS_BAP_UNICAST_SERVER_H_
#include <stddef.h>
#include <stdint.h>

#include <zephyr/bluetooth/audio/audio.h>
#include <zephyr/bluetooth/conn.h>
#include <zephyr/fff.h>
#include <zephyr/bluetooth/audio/bap.h>

extern const struct bt_bap_unicast_server_cb mock_bap_unicast_server_cb;

void mock_bap_unicast_server_init(void);
void mock_bap_unicast_server_cleanup(void);

DECLARE_FAKE_VALUE_FUNC(int, mock_bap_unicast_server_cb_config, struct bt_conn *,
			const struct bt_bap_ep *, enum bt_audio_dir,
			const struct bt_audio_codec_cfg *, struct bt_bap_stream **,
			struct bt_bap_qos_cfg_pref *const, struct bt_bap_ascs_rsp *);
DECLARE_FAKE_VALUE_FUNC(int, mock_bap_unicast_server_cb_reconfig, struct bt_bap_stream *,
			enum bt_audio_dir, const struct bt_audio_codec_cfg *,
			struct bt_bap_qos_cfg_pref *const, struct bt_bap_ascs_rsp *);
DECLARE_FAKE_VALUE_FUNC(int, mock_bap_unicast_server_cb_qos, struct bt_bap_stream *,
			const struct bt_bap_qos_cfg *, struct bt_bap_ascs_rsp *);
DECLARE_FAKE_VALUE_FUNC(int, mock_bap_unicast_server_cb_enable, struct bt_bap_stream *,
			const uint8_t *, size_t, struct bt_bap_ascs_rsp *);
DECLARE_FAKE_VALUE_FUNC(int, mock_bap_unicast_server_cb_start, struct bt_bap_stream *,
			struct bt_bap_ascs_rsp *);
DECLARE_FAKE_VALUE_FUNC(int, mock_bap_unicast_server_cb_metadata, struct bt_bap_stream *,
			const uint8_t *, size_t, struct bt_bap_ascs_rsp *);
DECLARE_FAKE_VALUE_FUNC(int, mock_bap_unicast_server_cb_disable, struct bt_bap_stream *,
			struct bt_bap_ascs_rsp *);
DECLARE_FAKE_VALUE_FUNC(int, mock_bap_unicast_server_cb_stop, struct bt_bap_stream *,
			struct bt_bap_ascs_rsp *);
DECLARE_FAKE_VALUE_FUNC(int, mock_bap_unicast_server_cb_release, struct bt_bap_stream *,
			struct bt_bap_ascs_rsp *);

#endif /* MOCKS_BAP_UNICAST_SERVER_H_ */
```

## include/bap_unicast_server_expects.h
```c
/*
 * Copyright (c) 2023 Codecoup
 *
 * SPDX-License-Identifier: Apache-2.0
 */

#ifndef MOCKS_BAP_UNICAST_SERVER_EXPECTS_H_
#define MOCKS_BAP_UNICAST_SERVER_EXPECTS_H_

#include <zephyr/bluetooth/audio/audio.h>
#include <zephyr/bluetooth/audio/bap.h>
#include <zephyr/bluetooth/conn.h>
#include <zephyr/ztest_assert.h>

#include "bap_unicast_server.h"
#include "expects_util.h"

static inline void expect_bt_bap_unicast_server_cb_config_called(
	unsigned int expected_count,
	struct bt_conn *conns[],
	struct bt_bap_ep *eps[],
	enum bt_audio_dir dirs[],
	void *codec[])
{
	const char *func_name = "bt_bap_unicast_server_cb.config";

	zexpect_call_count(func_name,
		expected_count, mock_bap_unicast_server_cb_config_fake.call_count);

	for (unsigned int i = 0; i < mock_bap_unicast_server_cb_config_fake.call_count; i++) {
		zassert_equal_ptr(conns[i],
			mock_bap_unicast_server_cb_config_fake.arg0_history[i],
			"'%s()' was called with incorrect 'conn[%i]' value", func_name, i);
		if (eps) {
			zassert_equal_ptr(eps[i],
				mock_bap_unicast_server_cb_config_fake.arg1_history[i],
				"'%s()' was called with incorrect 'ep[%i]' value", func_name, i);
		}
		zassert_equal(dirs[i],
			mock_bap_unicast_server_cb_config_fake.arg2_history[i],
			"'%s()' was called with incorrect 'dir[%i]' value", func_name, i);
	}

	if (codec) {
		/* TODO */
		zassert_unreachable("Not implemented");
	}
}

static inline void expect_bt_bap_unicast_server_cb_reconfig_called(
	unsigned int expected_count,
	struct bt_bap_stream *streams[],
	const enum bt_audio_dir dirs[],
	void *codec[])
{
	const char *func_name = "bt_bap_unicast_server_cb.reconfig";

	zexpect_call_count(func_name,
		expected_count, mock_bap_unicast_server_cb_reconfig_fake.call_count);

	for (unsigned int i = 0; i < mock_bap_unicast_server_cb_reconfig_fake.call_count; i++) {
		zassert_equal_ptr(streams[i],
			mock_bap_unicast_server_cb_reconfig_fake.arg0_history[i],
			"'%s()' was called with incorrect 'stream[%i]' value", func_name, i);
		zassert_equal(dirs[i],
			mock_bap_unicast_server_cb_reconfig_fake.arg1_history[i],
			"'%s()' was called with incorrect 'dir[%i]' value", func_name, i);
	}

	if (codec) {
		/* TODO */
		zassert_unreachable("Not implemented");
	}
}

static inline void expect_bt_bap_unicast_server_cb_qos_called(
	unsigned int expected_count,
	struct bt_bap_stream *streams[],
	void *qos[])
{
	const char *func_name = "bt_bap_unicast_server_cb.qos";

	zexpect_call_count(func_name,
		expected_count, mock_bap_unicast_server_cb_qos_fake.call_count);

	for (unsigned int i = 0; i < mock_bap_unicast_server_cb_qos_fake.call_count; i++) {
		zassert_equal_ptr(streams[i],
			mock_bap_unicast_server_cb_qos_fake.arg0_history[i],
			"'%s()' was called with incorrect 'stream[%i]' value", func_name, i);
	}

	if (qos) {
		/* TODO */
		zassert_unreachable("Not implemented");
	}
}

static inline void expect_bt_bap_unicast_server_cb_enable_called(
	unsigned int expected_count,
	struct bt_bap_stream *streams[],
	void *meta[],
	void *meta_len[])
{
	const char *func_name = "bt_bap_unicast_server_cb.enable";

	zexpect_call_count(func_name,
		expected_count, mock_bap_unicast_server_cb_enable_fake.call_count);

	for (unsigned int i = 0; i < mock_bap_unicast_server_cb_enable_fake.call_count; i++) {
		zassert_equal_ptr(streams[i],
			mock_bap_unicast_server_cb_enable_fake.arg0_history[i],
			"'%s()' was called with incorrect 'stream[%i]' value", func_name, i);
	}

	if (meta) {
		/* TODO */
		zassert_unreachable("Not implemented");
	}

	if (meta_len) {
		/* TODO */
		zassert_unreachable("Not implemented");
	}
}

static inline void expect_bt_bap_unicast_server_cb_metadata_called(
	unsigned int expected_count,
	struct bt_bap_stream *streams[],
	void *meta[],
	void *meta_len[])
{
	const char *func_name = "bt_bap_unicast_server_cb.enable";

	zexpect_call_count(func_name,
		expected_count, mock_bap_unicast_server_cb_metadata_fake.call_count);

	for (unsigned int i = 0; i < mock_bap_unicast_server_cb_metadata_fake.call_count; i++) {
		zassert_equal_ptr(streams[i],
			mock_bap_unicast_server_cb_metadata_fake.arg0_history[i],
			"'%s()' was called with incorrect 'stream[%i]' value", func_name, i);
	}

	if (meta) {
		/* TODO */
		zassert_unreachable("Not implemented");
	}

	if (meta_len) {
		/* TODO */
		zassert_unreachable("Not implemented");
	}
}

static inline void expect_bt_bap_unicast_server_cb_disable_called(
	unsigned int expected_count,
	struct bt_bap_stream *streams[])
{
	const char *func_name = "bt_bap_unicast_server_cb.disable";

	zexpect_call_count(func_name,
		expected_count, mock_bap_unicast_server_cb_disable_fake.call_count);

	for (unsigned int i = 0; i < mock_bap_unicast_server_cb_disable_fake.call_count; i++) {
		zassert_equal_ptr(streams[i],
			mock_bap_unicast_server_cb_disable_fake.arg0_history[i],
			"'%s()' was called with incorrect 'stream[%i]' value", func_name, i);
	}
}

static inline void expect_bt_bap_unicast_server_cb_release_called(
	unsigned int expected_count,
	struct bt_bap_stream *streams[])
{
	const char *func_name = "bt_bap_unicast_server_cb.release";

	zexpect_call_count(func_name,
		expected_count, mock_bap_unicast_server_cb_release_fake.call_count);

	for (unsigned int i = 0; i < mock_bap_unicast_server_cb_release_fake.call_count; i++) {
		zassert_equal_ptr(streams[i],
			mock_bap_unicast_server_cb_release_fake.arg0_history[i],
			"'%s()' was called with incorrect 'stream[%i]' value", func_name, i);
	}
}

static inline void expect_bt_bap_unicast_server_cb_start_called(
	unsigned int expected_count,
	struct bt_bap_stream *streams[])
{
	const char *func_name = "bt_bap_unicast_server_cb.start";

	zexpect_call_count(func_name,
		expected_count, mock_bap_unicast_server_cb_start_fake.call_count);

	for (unsigned int i = 0; i < mock_bap_unicast_server_cb_start_fake.call_count; i++) {
		zassert_equal_ptr(streams[i],
			mock_bap_unicast_server_cb_start_fake.arg0_history[i],
			"'%s()' was called with incorrect 'stream[%i]' value", func_name, i);
	}
}

static inline void expect_bt_bap_unicast_server_cb_stop_called(
	unsigned int expected_count,
	struct bt_bap_stream *streams[])
{
	const char *func_name = "bt_bap_unicast_server_cb.stop";

	zexpect_call_count(func_name,
		expected_count, mock_bap_unicast_server_cb_stop_fake.call_count);

	for (unsigned int i = 0; i < mock_bap_unicast_server_cb_stop_fake.call_count; i++) {
		zassert_equal_ptr(streams[i],
			mock_bap_unicast_server_cb_stop_fake.arg0_history[i],
			"'%s()' was called with incorrect 'stream[%i]' value", func_name, i);
	}
}

#endif /* MOCKS_BAP_UNICAST_SERVER_EXPECTS_H_ */
```

## include/test_common.h
```c
/*
 * Copyright (c) 2023 Codecoup
 *
 * SPDX-License-Identifier: Apache-2.0
 */
#include <stdbool.h>
#include <stdint.h>

#include <zephyr/bluetooth/audio/bap.h>
#include <zephyr/bluetooth/conn.h>
#include <zephyr/bluetooth/gatt.h>
#include <zephyr/bluetooth/iso.h>
#include <zephyr/bluetooth/uuid.h>

#define test_ase_snk_get(_num_ase, ...) test_ase_get(BT_UUID_ASCS_ASE_SNK, _num_ase, __VA_ARGS__)
#define test_ase_src_get(_num_ase, ...) test_ase_get(BT_UUID_ASCS_ASE_SRC, _num_ase, __VA_ARGS__)

struct test_ase_chrc_value_hdr {
	uint8_t ase_id;
	uint8_t ase_state;
	uint8_t params[0];
} __packed;

struct test_ase_cp_chrc_value_param {
	uint8_t ase_id;
	uint8_t response_code;
	uint8_t reason;
} __packed;

struct test_ase_cp_chrc_value_hdr {
	uint8_t opcode;
	uint8_t number_of_ases;
	struct test_ase_cp_chrc_value_param params[0];
} __packed;

#define TEST_ASE_CP_CHRC_VALUE_SIZE(number_of_ases)                                                \
	(sizeof(struct test_ase_cp_chrc_value_hdr) +                                               \
	 number_of_ases * sizeof(struct test_ase_cp_chrc_value_param))

void test_mocks_init(void);
void test_mocks_cleanup(void);
void test_mocks_reset(void);
void test_drain_syswq(void);

/* Initialize connection object for test */
void test_conn_init(struct bt_conn *conn);
uint8_t test_ase_get(const struct bt_uuid *uuid, int num_ase, ...);
uint8_t test_ase_id_get(const struct bt_gatt_attr *ase);
const struct bt_gatt_attr *test_ase_control_point_get(void);

/* client-initiated ASE Control Operations */
void test_ase_control_client_config_codec(struct bt_conn *conn, uint8_t ase_id,
					  struct bt_bap_stream *stream);
void test_ase_control_client_config_qos(struct bt_conn *conn, uint8_t ase_id);
void test_ase_control_client_enable(struct bt_conn *conn, uint8_t ase_id);
void test_ase_control_client_disable(struct bt_conn *conn, uint8_t ase_id);
void test_ase_control_client_release(struct bt_conn *conn, uint8_t ase_id);
void test_ase_control_client_update_metadata(struct bt_conn *conn, uint8_t ase_id);
void test_ase_control_client_receiver_start_ready(struct bt_conn *conn, uint8_t ase_id);
void test_ase_control_client_receiver_stop_ready(struct bt_conn *conn, uint8_t ase_id);

/* preambles */
void test_preamble_state_codec_configured(struct bt_conn *conn, uint8_t ase_id,
					  struct bt_bap_stream *stream);
void test_preamble_state_qos_configured(struct bt_conn *conn, uint8_t ase_id,
					struct bt_bap_stream *stream);
void test_preamble_state_enabling(struct bt_conn *conn, uint8_t ase_id,
				  struct bt_bap_stream *stream);
void test_preamble_state_streaming(struct bt_conn *conn, uint8_t ase_id,
				   struct bt_bap_stream *stream, struct bt_iso_chan **chan,
				   bool source);
void test_preamble_state_disabling(struct bt_conn *conn, uint8_t ase_id,
				   struct bt_bap_stream *stream, struct bt_iso_chan **chan);
void test_preamble_state_releasing(struct bt_conn *conn, uint8_t ase_id,
				   struct bt_bap_stream *stream, struct bt_iso_chan **chan,
				   bool source);
```

## src/test_ase_register.c
```c
/* main.c - Application main entry point */

/*
 * Copyright (c) 2024 Demant A/S
 * Copyright (c) 2024-2026 Nordic Semiconductor ASA
 *
 * SPDX-License-Identifier: Apache-2.0
 */

#include <errno.h>

#include <zephyr/autoconf.h>
#include <zephyr/bluetooth/audio/ascs.h>
#include <zephyr/fff.h>
#include <zephyr/kernel.h>
#include <zephyr/bluetooth/audio/audio.h>
#include <zephyr/bluetooth/audio/bap.h>
#include <zephyr/bluetooth/audio/pacs.h>
#include <zephyr/bluetooth/conn.h>
#include <zephyr/bluetooth/hci_types.h>
#include <zephyr/bluetooth/gatt.h>
#include <zephyr/bluetooth/uuid.h>
#include <zephyr/sys/util_macro.h>
#include <zephyr/toolchain.h>
#include <zephyr/ztest_assert.h>
#include <zephyr/ztest_test.h>

#include "ascs.h"
#include "bap_stream.h"

#include "test_common.h"

static void ascs_register_test_suite_after(void *f)
{
	ARG_UNUSED(f);

	(void)bt_ascs_unregister();
}

ZTEST_SUITE(ascs_register_test_suite, NULL, NULL, NULL, ascs_register_test_suite_after, NULL);

static ZTEST(ascs_register_test_suite, test_ascs_register_with_null_param)
{
	int err;

	err = bt_ascs_register(NULL);
	zassert_equal(err, -EINVAL, "Unexpected err response %d", err);
}

static ZTEST(ascs_register_test_suite, test_ascs_register_twice)
{
	int err;
	struct bt_ascs_register_param param = {
		CONFIG_BT_ASCS_MAX_ASE_SNK_COUNT,
		CONFIG_BT_ASCS_MAX_ASE_SRC_COUNT,
	};

	/* Setup already registered once, so calling once here should be sufficient */
	err = bt_ascs_register(&param);
	zassert_equal(err, 0, "Unexpected err response %d", err);

	/* Setup already registered once, so calling once here should be sufficient */
	err = bt_ascs_register(&param);
	zassert_equal(err, -EALREADY, "Unexpected err response %d", err);

	err = bt_ascs_unregister();
	zassert_equal(err, 0, "Unexpected err response %d", err);
}

static ZTEST(ascs_register_test_suite, test_ascs_register_too_many_sinks)
{
	int err;
	struct bt_ascs_register_param param = {
		CONFIG_BT_ASCS_MAX_ASE_SNK_COUNT + 1,
		CONFIG_BT_ASCS_MAX_ASE_SRC_COUNT,
	};

	err = bt_ascs_register(&param);
	zassert_equal(err, -EINVAL, "Unexpected err response %d", err);
}

static ZTEST(ascs_register_test_suite, test_ascs_register_too_many_sources)
{
	int err;
	struct bt_ascs_register_param param = {
		CONFIG_BT_ASCS_MAX_ASE_SNK_COUNT,
		CONFIG_BT_ASCS_MAX_ASE_SRC_COUNT + 1,
	};

	err = bt_ascs_register(&param);
	zassert_equal(err, -EINVAL, "Unexpected err response %d", err);
}

static ZTEST(ascs_register_test_suite, test_ascs_register_zero_ases)
{
	int err;
	struct bt_ascs_register_param param = {0, 0};

	err = bt_ascs_register(&param);
	zassert_equal(err, -EINVAL, "Unexpected err response %d", err);
}

static ZTEST(ascs_register_test_suite, test_ascs_register_fewer_than_max_ases)
{
	int err;
	struct bt_ascs_register_param param = {
		CONFIG_BT_ASCS_MAX_ASE_SNK_COUNT > 0 ? CONFIG_BT_ASCS_MAX_ASE_SNK_COUNT - 1 : 0,
		CONFIG_BT_ASCS_MAX_ASE_SRC_COUNT > 0 ? CONFIG_BT_ASCS_MAX_ASE_SRC_COUNT - 1 : 0,
	};

	err = bt_ascs_register(&param);
	zassert_equal(err, 0, "Unexpected err response %d", err);
}

static ZTEST(ascs_register_test_suite, test_ascs_unregister_without_register)
{
	int err;

	err = bt_ascs_unregister();
	zassert_equal(err, -EALREADY, "Unexpected err response %d", err);
}
```
