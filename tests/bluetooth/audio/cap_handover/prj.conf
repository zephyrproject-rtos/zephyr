## CMakeLists.txt
```
# SPDX-License-Identifier: Apache-2.0

cmake_minimum_required(VERSION 3.28.0)

find_package(Zephyr REQUIRED HINTS $ENV{ZEPHYR_BASE})
project(bluetooth_cap_handover)

target_include_directories(app PRIVATE
  ${ZEPHYR_BASE}/subsys/bluetooth/

  ${ZEPHYR_BASE}/tests/bluetooth/audio/cap_handover/include
  ${ZEPHYR_BASE}/tests/bluetooth/audio/mocks/include
)

target_sources(app PRIVATE
  # Test source files
  src/broadcast_to_unicast.c
  src/callbacks.c
  src/cancel.c
  src/unicast_to_broadcast.c
  src/test_common.c

  # UUT files
  uut/bap_broadcast_assistant.c
  uut/cap_handover.c
  uut/cap_initiator.c
  uut/csip.c

  # Stack source file
  ${ZEPHYR_BASE}/subsys/bluetooth/audio/audio.c
  ${ZEPHYR_BASE}/subsys/bluetooth/audio/codec.c
  ${ZEPHYR_BASE}/subsys/bluetooth/audio/bap_broadcast_source.c
  ${ZEPHYR_BASE}/subsys/bluetooth/audio/bap_iso.c
  ${ZEPHYR_BASE}/subsys/bluetooth/audio/bap_stream.c
  ${ZEPHYR_BASE}/subsys/bluetooth/audio/cap_commander.c
  ${ZEPHYR_BASE}/subsys/bluetooth/audio/cap_handover.c
  ${ZEPHYR_BASE}/subsys/bluetooth/audio/cap_initiator.c
  ${ZEPHYR_BASE}/subsys/bluetooth/audio/cap_common.c
  ${ZEPHYR_BASE}/subsys/bluetooth/audio/cap_stream.c
  ${ZEPHYR_BASE}/subsys/bluetooth/audio/ccid.c
  ${ZEPHYR_BASE}/subsys/bluetooth/common/addr.c
  ${ZEPHYR_BASE}/subsys/bluetooth/common/bt_str.c
  ${ZEPHYR_BASE}/subsys/bluetooth/host/uuid.c

  # Mock files
  ${ZEPHYR_BASE}/tests/bluetooth/audio/mocks/src/adv.c
  ${ZEPHYR_BASE}/tests/bluetooth/audio/mocks/src/bap_unicast_client.c
  ${ZEPHYR_BASE}/tests/bluetooth/audio/mocks/src/conn.c
  ${ZEPHYR_BASE}/tests/bluetooth/audio/mocks/src/gatt.c
  ${ZEPHYR_BASE}/tests/bluetooth/audio/mocks/src/iso.c
)
```

## Kconfig
```
# Copyright (c) 2025 Nordic Semiconductor ASA
# SPDX-License-Identifier: Apache-2.0

config BT_ATT_PREPARE_COUNT
	int
	default 1

config BT_AUDIO
	bool
	default y

config BT_AUDIO_CODEC_CFG_MAX_METADATA_SIZE
	int
	default 20

config BT_BAP_BROADCAST_ASSISTANT
	bool
	default y

config BT_BAP_BROADCAST_SOURCE
	bool
	default y

config BT_BAP_BROADCAST_SRC_STREAM_COUNT
	int
	default 2

config BT_BAP_SCAN_DELEGATOR
	bool
	default y

config BT_BAP_STREAM
	bool
	default y

config BT_BAP_UNICAST_CLIENT
	bool
	default y

config BT_BAP_UNICAST_CLIENT_GROUP_COUNT
	int
	default 1

config BT_BAP_UNICAST_CLIENT_GROUP_CIS_COUNT
	int
	default 4

config BT_BAP_UNICAST_CLIENT_ASE_SNK_COUNT
	int
	default 2

config BT_BONDABLE
	bool
	default y

config BT_BUF_ACL_RX_SIZE
	int
	default 69

config BT_BUF_ACL_TX_COUNT
	int
	default 5

config BT_BUF_EVT_RX_COUNT
	int
	default 10

config BT_CONN
	bool
	default y

config BT_CSIP_SET_COORDINATOR
	bool
	default y

config BT_ISO_MAX_BIG
	int
	default 1

config BT_ISO_MAX_CIG
	int
	default 1

config BT_ISO_MAX_CHAN
	int
	default 4

config BT_MAX_PAIRED
	int
	default 1

config BT_L2CAP_TX_MTU
	int
	default 65

config BT_LOG
	bool
	default y

config BT_MAX_CONN
	int
	default 2

config BT_SMP
	bool
	default y

# Include Zephyr's Kconfig.
source "Kconfig"
source "subsys/bluetooth/audio/Kconfig"
source "subsys/bluetooth/Kconfig.logging"
```

## prj.conf
```kconfig
CONFIG_ZTEST=y

CONFIG_NET_BUF=y

CONFIG_BT_CAP_INITIATOR=y
CONFIG_BT_CAP_COMMANDER=y
CONFIG_BT_CAP_HANDOVER=y

CONFIG_ASSERT=y

CONFIG_LOG=y
CONFIG_BT_BAP_ISO_LOG_LEVEL_DBG=y
CONFIG_BT_BAP_STREAM_LOG_LEVEL_DBG=y
CONFIG_BT_CAP_COMMON_LOG_LEVEL_DBG=y
CONFIG_BT_CAP_COMMANDER_LOG_LEVEL_DBG=y
CONFIG_BT_CAP_HANDOVER_LOG_LEVEL_DBG=y
CONFIG_BT_CAP_INITIATOR_LOG_LEVEL_DBG=y
CONFIG_BT_BAP_BROADCAST_SOURCE_LOG_LEVEL_DBG=y
```

## src/main.c
```c
/* main.c - Application main entry point */

/*
 * Copyright (c) 2025 Nordic Semiconductor ASA
 *
 * SPDX-License-Identifier: Apache-2.0
 */

#include <errno.h>
#include <stddef.h>
#include <stdlib.h>
#include <string.h>

#include <zephyr/autoconf.h>
#include <zephyr/bluetooth/audio/cap.h>
#include <zephyr/bluetooth/hci_types.h>
#include <zephyr/fff.h>
#include <zephyr/sys/util.h>

#include "cap_initiator.h"
#include "conn.h"
#include "test_common.h"
#include "ztest_assert.h"
#include "ztest_test.h"

static void mock_init_rule_before(const struct ztest_unit_test *test, void *fixture)
{
	test_mocks_init();
}

static void mock_destroy_rule_after(const struct ztest_unit_test *test, void *fixture)
{
	test_mocks_cleanup();
}

ZTEST_RULE(mock_rule, mock_init_rule_before, mock_destroy_rule_after);

struct cap_handover_test_suite_fixture {
	struct bt_conn conns[CONFIG_BT_MAX_CONN];
};

static void cap_handover_test_suite_fixture_init(struct cap_handover_test_suite_fixture *fixture)
{
	for (size_t i = 0; i < ARRAY_SIZE(fixture->conns); i++) {
		test_conn_init(&fixture->conns[i]);
	}
}

static void *cap_handover_test_suite_setup(void)
{
	struct cap_handover_test_suite_fixture *fixture;

	fixture = malloc(sizeof(*fixture));
	zassert_not_null(fixture);

	return fixture;
}

static void cap_handover_test_suite_before(void *f)
{
	int err;

	memset(f, 0, sizeof(struct cap_handover_test_suite_fixture));
	cap_handover_test_suite_fixture_init(f);

	err = bt_cap_initiator_register_cb(&mock_cap_initiator_cb);
	zassert_equal(0, err, "Unexpected return value %d", err);
}

static void cap_handover_test_suite_after(void *f)
{
	struct cap_handover_test_suite_fixture *fixture = f;

	bt_cap_initiator_unregister_cb(&mock_cap_initiator_cb);

	for (size_t i = 0; i < ARRAY_SIZE(fixture->conns); i++) {
		mock_bt_conn_disconnected(&fixture->conns[i], BT_HCI_ERR_REMOTE_USER_TERM_CONN);
	}
}

static void cap_handover_test_suite_teardown(void *f)
{
	free(f);
}

ZTEST_SUITE(cap_handover_test_suite, NULL, cap_handover_test_suite_setup,
	    cap_handover_test_suite_before, cap_handover_test_suite_after,
	    cap_handover_test_suite_teardown);

ZTEST_F(cap_handover_test_suite, test_handover_register_cb)
{
	int err = 0;

	zassert_equal(0, err, "Unexpected return value %d", err);
}
```

## include/cap_handover.h
```c
/*
 * Copyright (c) 2025 Nordic Semiconductor ASA
 *
 * SPDX-License-Identifier: Apache-2.0
 */

#ifndef MOCKS_CAP_HANDOVER_H_
#define MOCKS_CAP_HANDOVER_H_

#include <zephyr/bluetooth/audio/cap.h>
#include <zephyr/bluetooth/audio/csip.h>
#include <zephyr/bluetooth/bluetooth.h>
#include <zephyr/fff.h>

extern const struct bt_cap_handover_cb mock_cap_handover_cb;

void mock_cap_handover_init(void);

DECLARE_FAKE_VOID_FUNC(mock_unicast_to_broadcast_complete_cb, int, struct bt_conn *,
		       struct bt_cap_unicast_group *, struct bt_cap_broadcast_source *);

#endif /* MOCKS_CAP_HANDOVER_H_ */
```

## include/cap_initiator.h
```c
/*
 * Copyright (c) 2025 Nordic Semiconductor ASA
 *
 * SPDX-License-Identifier: Apache-2.0
 */

#ifndef MOCKS_CAP_INITIATOR_H_
#define MOCKS_CAP_INITIATOR_H_

#include <zephyr/bluetooth/audio/cap.h>
#include <zephyr/bluetooth/audio/csip.h>
#include <zephyr/bluetooth/bluetooth.h>
#include <zephyr/fff.h>

extern const struct bt_cap_initiator_cb mock_cap_initiator_cb;

void mock_cap_initiator_init(void);

DECLARE_FAKE_VOID_FUNC(mock_unicast_start_complete_cb, int, struct bt_conn *);

#endif /* MOCKS_CAP_INITIATOR_H_ */
```

## include/test_common.h
```c
/* test_common.h */

/*
 * Copyright (c) 2025 Nordic Semiconductor ASA
 *
 * SPDX-License-Identifier: Apache-2.0
 */
#include <stdint.h>

#include <zephyr/autoconf.h>
#include <zephyr/bluetooth/audio/bap.h>
#include <zephyr/bluetooth/audio/bap_lc3_preset.h>
#include <zephyr/bluetooth/audio/cap.h>
#include <zephyr/bluetooth/conn.h>

#include "conn.h"

void test_mocks_init(void);
void test_mocks_cleanup(void);
void mock_bt_csip_cleanup(void);

void test_conn_init(struct bt_conn *conn, uint8_t index);

void test_unicast_set_state(struct bt_cap_stream *cap_stream, struct bt_conn *conn,
			    struct bt_bap_ep *ep, struct bt_bap_lc3_preset *preset,
			    enum bt_bap_ep_state state);

void mock_unicast_client_discover(
	struct bt_conn *conn, struct bt_bap_ep *snk_eps[CONFIG_BT_BAP_UNICAST_CLIENT_ASE_SNK_COUNT],
	struct bt_bap_ep *src_eps[CONFIG_BT_BAP_UNICAST_CLIENT_ASE_SRC_COUNT]);
```

## src/broadcast_to_unicast.c
```c
/*
 * Copyright (c) 2025 Nordic Semiconductor ASA
 *
 * SPDX-License-Identifier: Apache-2.0
 */

#include <errno.h>
#include <stdbool.h>
#include <stddef.h>
#include <stdlib.h>
#include <string.h>

#include <zephyr/autoconf.h>
#include <zephyr/bluetooth/addr.h>
#include <zephyr/bluetooth/assigned_numbers.h>
#include <zephyr/bluetooth/audio/audio.h>
#include <zephyr/bluetooth/audio/bap.h>
#include <zephyr/bluetooth/audio/bap_lc3_preset.h>
#include <zephyr/bluetooth/audio/cap.h>
#include <zephyr/bluetooth/bluetooth.h>
#include <zephyr/bluetooth/byteorder.h>
#include <zephyr/bluetooth/hci_types.h>
#include <zephyr/bluetooth/iso.h>
#include <zephyr/fff.h>
#include <zephyr/sys/byteorder.h>
#include <zephyr/sys/util.h>
#include <zephyr/toolchain.h>
#include <zephyr/ztest_assert.h>
#include <zephyr/ztest_test.h>

#include "audio/bap_endpoint.h"
#include "audio/bap_iso.h"
#include "bluetooth.h"
#include "cap_initiator.h"
#include "cap_handover.h"
#include "conn.h"
#include "expects_util.h"
#include "test_common.h"

static void mock_init_rule_before(const struct ztest_unit_test *test, void *fixture)
{
	ARG_UNUSED(test);
	ARG_UNUSED(fixture);

	test_mocks_init();
}

static void mock_destroy_rule_after(const struct ztest_unit_test *test, void *fixture)
{
	ARG_UNUSED(test);
	ARG_UNUSED(fixture);

	test_mocks_cleanup();
}

ZTEST_RULE(mock_rule, mock_init_rule_before, mock_destroy_rule_after);

#define MAX_STREAMS 2
BUILD_ASSERT(CONFIG_BT_BAP_UNICAST_CLIENT_ASE_SNK_COUNT >= MAX_STREAMS);
BUILD_ASSERT(CONFIG_BT_BAP_UNICAST_CLIENT_GROUP_CIS_COUNT >= MAX_STREAMS);
BUILD_ASSERT(CONFIG_BT_BAP_BROADCAST_SRC_STREAM_COUNT >= MAX_STREAMS);

struct cap_handover_broadcast_to_unicast_test_suite_fixture {
	struct bt_cap_unicast_audio_start_stream_param
		unicast_audio_start_stream_params[MAX_STREAMS];
	struct bt_cap_commander_broadcast_reception_stop_member_param
		stop_member_params[CONFIG_BT_MAX_CONN];
	struct bt_bap_ep *snk_eps[CONFIG_BT_MAX_CONN][CONFIG_BT_BAP_UNICAST_CLIENT_ASE_SNK_COUNT];
	struct bt_cap_unicast_group_stream_pair_param unicast_group_stream_pair_params[MAX_STREAMS];
	struct bt_cap_initiator_broadcast_stream_param broadcast_stream_params[MAX_STREAMS];
	struct bt_cap_unicast_group_stream_param unicast_group_stream_params[MAX_STREAMS];
	struct bt_cap_handover_broadcast_to_unicast_param broadcast_to_unicast_param;
	struct bt_cap_commander_broadcast_reception_stop_param reception_stop_param;
	struct bt_cap_initiator_broadcast_create_param broadcast_create_param;
	struct bt_cap_unicast_audio_start_param unicast_audio_start_param;
	struct bt_cap_initiator_broadcast_subgroup_param subgroup_params;
	struct bt_bap_lc3_preset unicast_presets[MAX_STREAMS];
	struct bt_cap_unicast_group_param unicast_group_param;
	struct bt_cap_broadcast_source *broadcast_source;
	struct bt_cap_stream cap_streams[MAX_STREAMS];
	struct bt_bap_lc3_preset broadcast_preset;
	struct bt_conn conns[CONFIG_BT_MAX_CONN];
	struct bt_le_ext_adv ext_adv;
};

static void *cap_handover_broadcast_to_unicast_test_suite_setup(void)
{
	struct cap_handover_broadcast_to_unicast_test_suite_fixture *fixture;

	fixture = malloc(sizeof(*fixture));
	zassert_not_null(fixture);

	return fixture;
}

static void cap_handover_broadcast_to_unicast_test_suite_before(void *f)
{
	struct cap_handover_broadcast_to_unicast_test_suite_fixture *fixture = f;
	int err;

	(void)memset(fixture, 0, sizeof(*fixture));

	err = bt_cap_initiator_register_cb(&mock_cap_initiator_cb);
	zassert_equal(0, err, "Unexpected return value %d", err);

	err = bt_cap_handover_register_cb(&mock_cap_handover_cb);
	zassert_equal(0, err, "Unexpected return value %d", err);

	ARRAY_FOR_EACH(fixture->conns, i) {
		test_conn_init(&fixture->conns[i], i);
		err = bt_bap_broadcast_assistant_discover(&fixture->conns[i]);
		zassert_equal(err, 0, "Unexpected return value %d", err);

		mock_unicast_client_discover(&fixture->conns[i], fixture->snk_eps[i], NULL);
	}

	/* Create advertising set */
	fixture->ext_adv.ext_adv_state = BT_LE_EXT_ADV_STATE_ENABLED;
	fixture->ext_adv.per_adv_state = BT_LE_PER_ADV_STATE_ENABLED;

	fixture->broadcast_preset = (struct bt_bap_lc3_preset)BT_BAP_LC3_BROADCAST_PRESET_16_2_1(
		BT_AUDIO_LOCATION_MONO_AUDIO, BT_AUDIO_CONTEXT_TYPE_UNSPECIFIED);

	fixture->broadcast_create_param.subgroup_count = 1U;
	fixture->broadcast_create_param.subgroup_params = &fixture->subgroup_params;
	fixture->broadcast_create_param.qos = &fixture->broadcast_preset.qos;
	fixture->broadcast_create_param.packing = BT_ISO_PACKING_SEQUENTIAL;
	fixture->broadcast_create_param.encryption = false;

	fixture->subgroup_params.stream_count = ARRAY_SIZE(fixture->cap_streams);
	fixture->subgroup_params.stream_params = fixture->broadcast_stream_params;
	fixture->subgroup_params.codec_cfg = &fixture->broadcast_preset.codec_cfg;

	ARRAY_FOR_EACH(fixture->cap_streams, i) {
		fixture->broadcast_stream_params[i].stream = &fixture->cap_streams[i];
	}

	/* Start broadcast source */
	err = bt_cap_initiator_broadcast_audio_create(&fixture->broadcast_create_param,
						      &fixture->broadcast_source);
	zassert_equal(err, 0, "Unexpected return value %d", err);
	err = bt_cap_initiator_broadcast_audio_start(fixture->broadcast_source, &fixture->ext_adv);
	zassert_equal(err, 0, "Unexpected return value %d", err);
	zexpect_call_count("bt_cap_initiator_cb.broadcast_start_cb", 1,
			   mock_broadcast_start_cb_fake.call_count);

	/* Prepare default handover parameters including unicast group create parameters */
	ARRAY_FOR_EACH(fixture->unicast_presets, i) {
		fixture->unicast_presets[i] =
			(struct bt_bap_lc3_preset)BT_BAP_LC3_UNICAST_PRESET_16_2_1(
				BT_AUDIO_LOCATION_MONO_AUDIO, BT_AUDIO_CONTEXT_TYPE_UNSPECIFIED);
	}

	ARRAY_FOR_EACH(fixture->cap_streams, i) {
		struct bt_cap_unicast_audio_start_stream_param *start_stream_param =
			&fixture->unicast_audio_start_stream_params[i];
		struct bt_cap_unicast_group_stream_param *group_stream_param =
			&fixture->unicast_group_stream_params[i];

		/* Distribute the streams like
		 * [0]: conn[0] snk[0]
		 * [1]: conn[1] snk[0]
		 * [2]: conn[0] snk[1]
		 * [3]: conn[1] snk[1]
		 */
		const size_t conn_index = i % ARRAY_SIZE(fixture->conns);
		const size_t ep_index = i / ARRAY_SIZE(fixture->conns);

		start_stream_param->stream = &fixture->cap_streams[i];
		start_stream_param->codec_cfg = &fixture->unicast_presets[i].codec_cfg;

		start_stream_param->member.member = &fixture->conns[conn_index];
		start_stream_param->ep = fixture->snk_eps[conn_index][ep_index];
		group_stream_param->stream = &fixture->cap_streams[i];
		group_stream_param->qos_cfg = &fixture->unicast_presets[i].qos;

		fixture->unicast_group_stream_pair_params[i].tx_param = group_stream_param;
	}

	fixture->unicast_audio_start_param.type = BT_CAP_SET_TYPE_AD_HOC;
	fixture->unicast_audio_start_param.count = ARRAY_SIZE(fixture->cap_streams);
	fixture->unicast_audio_start_param.stream_params =
		fixture->unicast_audio_start_stream_params;

	fixture->unicast_group_param.packing = BT_ISO_PACKING_SEQUENTIAL;
	fixture->unicast_group_param.params_count = ARRAY_SIZE(fixture->cap_streams);
	fixture->unicast_group_param.params = fixture->unicast_group_stream_pair_params;

	fixture->broadcast_to_unicast_param.broadcast_id = TEST_COMMON_BROADCAST_ID;
	fixture->broadcast_to_unicast_param.adv_sid = TEST_COMMON_ADV_SID;
	fixture->broadcast_to_unicast_param.adv_type = TEST_COMMON_ADV_TYPE;
	fixture->broadcast_to_unicast_param.broadcast_source = fixture->broadcast_source;
	fixture->broadcast_to_unicast_param.unicast_group_param = &fixture->unicast_group_param;
	fixture->broadcast_to_unicast_param.unicast_start_param =
		&fixture->unicast_audio_start_param;

	/* Prepare reception start parameters */
	fixture->reception_stop_param.type = fixture->unicast_audio_start_param.type;
	fixture->reception_stop_param.param = fixture->stop_member_params;
	fixture->reception_stop_param.count = ARRAY_SIZE(fixture->stop_member_params);

	ARRAY_FOR_EACH(fixture->stop_member_params, i) {
		fixture->stop_member_params[i].member.member = &fixture->conns[i];
		fixture->stop_member_params[i].src_id = TEST_COMMON_SRC_ID;
		fixture->stop_member_params[i].num_subgroups =
			fixture->broadcast_create_param.subgroup_count;
	}
}

static void cap_handover_broadcast_to_unicast_test_suite_after(void *f)
{
	struct cap_handover_broadcast_to_unicast_test_suite_fixture *fixture = f;
	int err;

	err = bt_cap_initiator_unregister_cb(&mock_cap_initiator_cb);
	zassert_true(err == 0 || err == -EINVAL, "Unexpected error: %d", err);

	err = bt_cap_handover_unregister_cb(&mock_cap_handover_cb);
	zassert_true(err == 0 || err == -EINVAL, "Unexpected error: %d", err);

	for (size_t i = 0; i < ARRAY_SIZE(fixture->conns); i++) {
		mock_bt_conn_disconnected(&fixture->conns[i], BT_HCI_ERR_REMOTE_USER_TERM_CONN);
	}

	/* In the case of a test failing, we cancel the procedure so that subsequent won't fail */
	err = bt_cap_initiator_unicast_audio_cancel();
	/* May fail if no CAP procedure is in progress */
	zassert_true(err == 0 || err == -EALREADY, "Unexpected error: %d", err);

	/* In the case of a test failing, we delete the source so that subsequent tests won't fail
	 */
	if (fixture->broadcast_source != NULL) {
		err = bt_cap_initiator_broadcast_audio_stop(fixture->broadcast_source);
		zassert_true(err == 0 || err == -EALREADY || err == -EBADMSG,
			     "Unexpected error: %d", err);
		err = bt_cap_initiator_broadcast_audio_delete(fixture->broadcast_source);
		zassert_true(err == 0, "Unexpected error: %d", err);
		fixture->broadcast_source = NULL;
	}

	/* If a unicast group was created it exists as the 4th parameter in the callback */
	if (mock_broadcast_to_unicast_complete_cb_fake.arg3_history[0] != NULL) {
		struct bt_cap_unicast_group *unicast_group =
			mock_broadcast_to_unicast_complete_cb_fake.arg3_history[0];
		struct bt_cap_stream *cap_stream_ptrs[MAX_STREAMS];

		const struct bt_cap_unicast_audio_stop_param param = {
			.type = BT_CAP_SET_TYPE_AD_HOC,
			.count = ARRAY_SIZE(fixture->cap_streams),
			.streams = cap_stream_ptrs,
			.release = true,
		};

		ARRAY_FOR_EACH(cap_stream_ptrs, idx) {
			cap_stream_ptrs[idx] = &fixture->cap_streams[idx];
		}

		err = bt_cap_initiator_unicast_audio_stop(&param);
		zassert_true(err == 0 || err == -EALREADY, "Unexpected error: %d", err);

		err = bt_cap_unicast_group_delete(unicast_group);
		zassert_true(err == 0, "Unexpected error: %d", err);
	}
}

static void cap_handover_broadcast_to_unicast_test_suite_teardown(void *f)
{
	free(f);
}

ZTEST_SUITE(cap_handover_broadcast_to_unicast_test_suite, NULL,
	    cap_handover_broadcast_to_unicast_test_suite_setup,
	    cap_handover_broadcast_to_unicast_test_suite_before,
	    cap_handover_broadcast_to_unicast_test_suite_after,
	    cap_handover_broadcast_to_unicast_test_suite_teardown);

static void validate_handover_callback(void)
{
	zexpect_call_count("bt_cap_initiator_cb.broadcast_to_unicast_complete_cb", 1,
			   mock_broadcast_to_unicast_complete_cb_fake.call_count);
	zassert_equal(0, mock_broadcast_to_unicast_complete_cb_fake.arg0_history[0]);
	zassert_equal_ptr(NULL, mock_broadcast_to_unicast_complete_cb_fake.arg1_history[0]);
	zassert_equal_ptr(NULL, mock_broadcast_to_unicast_complete_cb_fake.arg2_history[0]);
	zassert_not_equal(NULL, mock_broadcast_to_unicast_complete_cb_fake.arg3_history[0]);
}

static ZTEST_F(cap_handover_broadcast_to_unicast_test_suite, test_handover_broadcast_to_unicast)
{
	int err;

	err = bt_cap_handover_broadcast_to_unicast(&fixture->broadcast_to_unicast_param);
	zassert_equal(err, 0, "Unexpected return value %d", err);
	validate_handover_callback();
	fixture->broadcast_source = NULL;
}

static ZTEST_F(cap_handover_broadcast_to_unicast_test_suite,
	       test_handover_broadcast_to_unicast_reception_stop)
{
	int err;

	fixture->broadcast_to_unicast_param.reception_stop_param = &fixture->reception_stop_param;

	err = bt_cap_handover_broadcast_to_unicast(&fixture->broadcast_to_unicast_param);
	zassert_equal(err, 0, "Unexpected return value %d", err);
	validate_handover_callback();
	fixture->broadcast_source = NULL;
}

static ZTEST(cap_handover_broadcast_to_unicast_test_suite,
	     test_handover_broadcast_to_unicast_inval_null_param)
{
	int err;

	err = bt_cap_handover_broadcast_to_unicast(NULL);
	zassert_equal(err, -EINVAL, "Unexpected return value %d", err);
}

static ZTEST_F(cap_handover_broadcast_to_unicast_test_suite,
	       test_handover_broadcast_to_unicast_inval_reception_stop_param_type)
{
	int err;

	/* Mismatch between unicast_start_param and this */
	fixture->reception_stop_param.type = BT_CAP_SET_TYPE_CSIP;

	fixture->broadcast_to_unicast_param.reception_stop_param = &fixture->reception_stop_param;

	err = bt_cap_handover_broadcast_to_unicast(&fixture->broadcast_to_unicast_param);
	zassert_equal(err, -EINVAL, "Unexpected return value %d", err);
}

static ZTEST_F(cap_handover_broadcast_to_unicast_test_suite,
	       test_handover_broadcast_to_unicast_inval_reception_stop_missing_conn)
{
	int err;

	if (fixture->reception_stop_param.count == 1U) {
		ztest_test_skip();
	}

	fixture->reception_stop_param.count--;
	fixture->broadcast_to_unicast_param.reception_stop_param = &fixture->reception_stop_param;

	err = bt_cap_handover_broadcast_to_unicast(&fixture->broadcast_to_unicast_param);
	zassert_equal(err, -EINVAL, "Unexpected return value %d", err);
}

static ZTEST_F(cap_handover_broadcast_to_unicast_test_suite,
	       test_handover_broadcast_to_unicast_inval_broadcast_id)
{
	int err;

	fixture->broadcast_to_unicast_param.broadcast_id = 0xFFFFFFFFU;

	err = bt_cap_handover_broadcast_to_unicast(&fixture->broadcast_to_unicast_param);
	zassert_equal(err, -EINVAL, "Unexpected return value %d", err);
}

static ZTEST_F(cap_handover_broadcast_to_unicast_test_suite,
	       test_handover_broadcast_to_unicast_inval_adv_sid)
{
	int err;

	fixture->broadcast_to_unicast_param.adv_sid = 0xFFU;

	err = bt_cap_handover_broadcast_to_unicast(&fixture->broadcast_to_unicast_param);
	zassert_equal(err, -EINVAL, "Unexpected return value %d", err);
}

static ZTEST_F(cap_handover_broadcast_to_unicast_test_suite,
	       test_handover_broadcast_to_unicast_inval_adv_type)
{
	int err;

	fixture->broadcast_to_unicast_param.adv_type = 0xFFU;

	err = bt_cap_handover_broadcast_to_unicast(&fixture->broadcast_to_unicast_param);
	zassert_equal(err, -EINVAL, "Unexpected return value %d", err);
}

static ZTEST_F(cap_handover_broadcast_to_unicast_test_suite,
	       test_handover_broadcast_to_unicast_inval_null_broadcast_source)
{
	int err;

	fixture->broadcast_to_unicast_param.broadcast_source = NULL;

	err = bt_cap_handover_broadcast_to_unicast(&fixture->broadcast_to_unicast_param);
	zassert_equal(err, -EINVAL, "Unexpected return value %d", err);
}

static ZTEST_F(cap_handover_broadcast_to_unicast_test_suite,
	       test_handover_broadcast_to_unicast_inval_null_unicast_group_param)
{
	int err;

	fixture->broadcast_to_unicast_param.unicast_group_param = NULL;

	err = bt_cap_handover_broadcast_to_unicast(&fixture->broadcast_to_unicast_param);
	zassert_equal(err, -EINVAL, "Unexpected return value %d", err);
}

static ZTEST_F(cap_handover_broadcast_to_unicast_test_suite,
	       test_handover_broadcast_to_unicast_inval_null_unicast_start_param)
{
	int err;

	fixture->broadcast_to_unicast_param.unicast_start_param = NULL;

	err = bt_cap_handover_broadcast_to_unicast(&fixture->broadcast_to_unicast_param);
	zassert_equal(err, -EINVAL, "Unexpected return value %d", err);
}

static ZTEST_F(cap_handover_broadcast_to_unicast_test_suite,
	       test_handover_broadcast_to_unicast_inval_unicast_stream)
{
	struct bt_cap_stream cap_stream = {0};
	int err;

	/* Attempt to use a stream not in the broadcast source */
	fixture->unicast_audio_start_stream_params[0].stream = &cap_stream;

	err = bt_cap_handover_broadcast_to_unicast(&fixture->broadcast_to_unicast_param);
	zassert_equal(err, -EINVAL, "Unexpected return value %d", err);
}

static ZTEST_F(cap_handover_broadcast_to_unicast_test_suite,
	       test_handover_broadcast_to_unicast_inval_stream_state)
{
	int err;

	/* Attempt to use a stream not in the broadcast source */
	fixture->unicast_audio_start_stream_params[0].stream->bap_stream.ep->state =
		BT_BAP_EP_STATE_QOS_CONFIGURED;

	err = bt_cap_handover_broadcast_to_unicast(&fixture->broadcast_to_unicast_param);
	zassert_equal(err, -EINVAL, "Unexpected return value %d", err);
}

static ZTEST_F(cap_handover_broadcast_to_unicast_test_suite,
	       test_handover_broadcast_to_unicast_inval_stream_group)
{
	int err;
	void *group = fixture->unicast_audio_start_stream_params[0].stream->bap_stream.group;

	/* Attempt to use a stream not in the broadcast source */
	fixture->unicast_audio_start_stream_params[0].stream->bap_stream.group =
		UINT_TO_POINTER(0x12345678U);

	err = bt_cap_handover_broadcast_to_unicast(&fixture->broadcast_to_unicast_param);
	zassert_equal(err, -EINVAL, "Unexpected return value %d", err);

	/* Restore group to support proper cleanup after the test */
	fixture->unicast_audio_start_stream_params[0].stream->bap_stream.group = group;
}

static ZTEST_F(cap_handover_broadcast_to_unicast_test_suite,
	       test_handover_broadcast_to_unicast_inval_unicast_start_stream_cnt)
{
	int err;

	if (fixture->unicast_audio_start_param.count == 1) {
		ztest_test_skip();
	}

	/* Attempt to use a stream not in the broadcast source */
	fixture->unicast_audio_start_param.count -= 1;

	err = bt_cap_handover_broadcast_to_unicast(&fixture->broadcast_to_unicast_param);
	zassert_equal(err, -EINVAL, "Unexpected return value %d", err);
}
```

## src/callbacks.c
```c
/*
 * Copyright (c) 2025 Nordic Semiconductor ASA
 *
 * SPDX-License-Identifier: Apache-2.0
 */

#include <errno.h>
#include <stddef.h>

#include <zephyr/bluetooth/audio/cap.h>
#include <zephyr/fff.h>
#include <zephyr/sys/util.h>
#include <zephyr/toolchain.h>
#include <zephyr/ztest_assert.h>
#include <zephyr/ztest_test.h>

#include <cap_handover.h>
#include <test_common.h>

static void cap_handover_callbacks_test_suite_after(void *f)
{
	int err;

	ARG_UNUSED(f);

	err = bt_cap_handover_unregister_cb(&mock_cap_handover_cb);
	zassert_true(err == 0 || err == -EINVAL, "Unexpected error: %d", err);
}

ZTEST_SUITE(cap_handover_callbacks_test_suite, NULL, NULL, NULL,
	    cap_handover_callbacks_test_suite_after, NULL);

static ZTEST(cap_handover_callbacks_test_suite, test_handover_register_cb)
{
	int err;

	err = bt_cap_handover_register_cb(&mock_cap_handover_cb);
	zassert_equal(0, err, "Unexpected return value %d", err);
}

static ZTEST(cap_handover_callbacks_test_suite, test_handover_register_cb_inval_param_null)
{
	int err;

	err = bt_cap_handover_register_cb(NULL);
	zassert_equal(-EINVAL, err, "Unexpected return value %d", err);
}

static ZTEST(cap_handover_callbacks_test_suite, test_handover_register_cb_inval_double_register)
{
	int err;

	err = bt_cap_handover_register_cb(&mock_cap_handover_cb);
	zassert_equal(0, err, "Unexpected return value %d", err);

	err = bt_cap_handover_register_cb(&mock_cap_handover_cb);
	zassert_equal(-EALREADY, err, "Unexpected return value %d", err);
}

static ZTEST(cap_handover_callbacks_test_suite, test_handover_unregister_cb)
{
	int err;

	err = bt_cap_handover_register_cb(&mock_cap_handover_cb);
	zassert_equal(0, err, "Unexpected return value %d", err);

	err = bt_cap_handover_unregister_cb(&mock_cap_handover_cb);
	zassert_equal(0, err, "Unexpected return value %d", err);
}

static ZTEST(cap_handover_callbacks_test_suite, test_handover_unregister_cb_inval_param_null)
{
	int err;

	err = bt_cap_handover_unregister_cb(NULL);
	zassert_equal(-EINVAL, err, "Unexpected return value %d", err);
}

static ZTEST(cap_handover_callbacks_test_suite, test_handover_unregister_cb_inval_double_unregister)
{
	int err;

	err = bt_cap_handover_register_cb(&mock_cap_handover_cb);
	zassert_equal(0, err, "Unexpected return value %d", err);

	err = bt_cap_handover_unregister_cb(&mock_cap_handover_cb);
	zassert_equal(0, err, "Unexpected return value %d", err);

	err = bt_cap_handover_unregister_cb(&mock_cap_handover_cb);
	zassert_equal(-EINVAL, err, "Unexpected return value %d", err);
}
```

## src/cancel.c
```c
/* cancel.c - unit test for bt_cap_handover_cancel */

/*
 * Copyright (c) 2026 Nordic Semiconductor ASA
 *
 * SPDX-License-Identifier: Apache-2.0
 */
#include <errno.h>
#include <stdbool.h>
#include <stdlib.h>
#include <string.h>

#include <zephyr/autoconf.h>
#include <zephyr/bluetooth/addr.h>
#include <zephyr/bluetooth/audio/bap.h>
#include <zephyr/bluetooth/audio/cap.h>
#include <zephyr/bluetooth/hci_types.h>
#include <zephyr/fff.h>
#include <zephyr/sys/atomic.h>
#include <zephyr/sys/util.h>
#include <zephyr/sys/util_macro.h>
#include <zephyr/ztest_assert.h>
#include <zephyr/ztest_test.h>

#include "audio/cap_internal.h"
#include "cap_handover.h"
#include "expects_util.h"
#include "test_common.h"

#define FFF_GLOBALS

struct cap_handover_test_cancel_fixture {
	struct bt_cap_common_proc *active_proc;
};

static void *cap_handover_test_cancel_setup(void)
{
	struct cap_handover_test_cancel_fixture *fixture;

	fixture = malloc(sizeof(*fixture));
	zassert_not_null(fixture);

	return fixture;
}

static void cap_handover_test_cancel_before(void *f)
{
	struct cap_handover_test_cancel_fixture *fixture = f;
	int err;

	(void)memset(f, 0, sizeof(struct cap_handover_test_cancel_fixture));

	fixture->active_proc = bt_cap_common_get_active_proc();

	atomic_set_bit(fixture->active_proc->proc_state_flags, BT_CAP_COMMON_PROC_STATE_ACTIVE);
	atomic_set_bit(fixture->active_proc->proc_state_flags, BT_CAP_COMMON_PROC_STATE_HANDOVER);

	bt_cap_common_unlock_proc();

	err = bt_cap_handover_register_cb(&mock_cap_handover_cb);
	zassert_equal(0, err, "Unexpected return value %d", err);
}

static void cap_handover_test_cancel_after(void *f)
{
	struct cap_handover_test_cancel_fixture *fixture = f;
	int err;

	(void)memset(fixture->active_proc, 0, sizeof(*fixture->active_proc));

	err = bt_cap_handover_unregister_cb(&mock_cap_handover_cb);
	zassert_true(err == 0, "Unexpected error: %d", err);
}

static void cap_handover_test_cancel_teardown(void *f)
{
	free(f);
}

static void test_cancel(struct cap_handover_test_cancel_fixture *fixture)
{
	/* Get this value before cancel, as cancel will clear the active proc */
	const bool is_unicast_to_broadcast =
		fixture->active_proc->proc_param.handover.is_unicast_to_broadcast;
	int err;

	err = bt_cap_handover_cancel();
	zassert_equal(0, err, "Unexpected return value %d", err);

	if (is_unicast_to_broadcast) {
		zexpect_call_count("bt_cap_handover_cb.unicast_to_broadcast_complete", 1,
				   mock_unicast_to_broadcast_complete_cb_fake.call_count);
		zassert_equal(-ECANCELED,
			      mock_unicast_to_broadcast_complete_cb_fake.arg0_history[0]);
	} else {
		zexpect_call_count("bt_cap_handover_cb.broadcast_to_unicast_complete", 1,
				   mock_broadcast_to_unicast_complete_cb_fake.call_count);
		zassert_equal(-ECANCELED,
			      mock_broadcast_to_unicast_complete_cb_fake.arg0_history[0]);
	}
}

ZTEST_SUITE(cap_handover_test_cancel, NULL, cap_handover_test_cancel_setup,
	    cap_handover_test_cancel_before, cap_handover_test_cancel_after,
	    cap_handover_test_cancel_teardown);

static ZTEST_F(cap_handover_test_cancel, test_handover_cancel_broadcast_to_unicast)
{
	fixture->active_proc->proc_param.handover.is_unicast_to_broadcast = false;
	test_cancel(fixture);
}

static ZTEST_F(cap_handover_test_cancel, test_handover_cancel_unicast_to_broadcast)
{
	fixture->active_proc->proc_param.handover.is_unicast_to_broadcast = true;
	test_cancel(fixture);
}

static ZTEST_F(cap_handover_test_cancel, test_handover_cancel_double)
{
	int err;

	test_cancel(fixture);

	err = bt_cap_handover_cancel();
	zassert_equal(-EALREADY, err, "Unexpected return value %d", err);
}

static ZTEST_F(cap_handover_test_cancel, test_handover_cancel_not_active)
{
	int err;

	atomic_clear_bit(fixture->active_proc->proc_state_flags, BT_CAP_COMMON_PROC_STATE_ACTIVE);

	err = bt_cap_handover_cancel();
	zassert_equal(-EALREADY, err, "Unexpected return value %d", err);
}

static ZTEST_F(cap_handover_test_cancel, test_handover_cancel_not_handover)
{
	int err;

	atomic_clear_bit(fixture->active_proc->proc_state_flags, BT_CAP_COMMON_PROC_STATE_HANDOVER);

	err = bt_cap_handover_cancel();
	zassert_equal(-EOPNOTSUPP, err, "Unexpected return value %d", err);
}
```

## src/test_common.c
```c
/* test_common.c - common procedures for unit test of CAP handover */

/*
 * Copyright (c) 2025 Nordic Semiconductor ASA
 *
 * SPDX-License-Identifier: Apache-2.0
 */
#include <stddef.h>
#include <stdint.h>

#include <zephyr/autoconf.h>
#include <zephyr/bluetooth/audio/audio.h>
#include <zephyr/bluetooth/audio/bap.h>
#include <zephyr/bluetooth/audio/bap_lc3_preset.h>
#include <zephyr/bluetooth/audio/cap.h>
#include <zephyr/bluetooth/conn.h>
#include <zephyr/bluetooth/hci_types.h>
#include <zephyr/fff.h>
#include <zephyr/sys/printk.h>
#include <zephyr/ztest_assert.h>

#include "audio/bap_endpoint.h"
#include "cap_initiator.h"
#include "cap_handover.h"
#include "conn.h"
#include "expects_util.h"
#include "test_common.h"

DEFINE_FFF_GLOBALS;

void test_mocks_init(void)
{
	mock_cap_initiator_init();
	mock_cap_handover_init();
}

void test_mocks_cleanup(void)
{
	mock_bt_csip_cleanup();
}

void test_conn_init(struct bt_conn *conn, uint8_t index)
{
	conn->index = index;
	conn->info.type = BT_CONN_TYPE_LE;
	conn->info.role = BT_CONN_ROLE_CENTRAL;
	conn->info.state = BT_CONN_STATE_CONNECTED;
	conn->info.security.level = BT_SECURITY_L2;
	conn->info.security.enc_key_size = BT_ENC_KEY_SIZE_MAX;
	conn->info.security.flags = BT_SECURITY_FLAG_OOB | BT_SECURITY_FLAG_SC;
}

void test_unicast_set_state(struct bt_cap_stream *cap_stream, struct bt_conn *conn,
			    struct bt_bap_ep *ep, struct bt_bap_lc3_preset *preset,
			    enum bt_bap_ep_state state)
{
	struct bt_bap_stream *bap_stream = &cap_stream->bap_stream;

	printk("Setting stream %p to state %d\n", bap_stream, state);

	if (state == BT_BAP_EP_STATE_IDLE) {
		return;
	}

	zassert_not_null(cap_stream);
	zassert_not_null(conn);
	zassert_not_null(ep);
	zassert_not_null(preset);

	bap_stream->conn = conn;
	bap_stream->ep = ep;
	bap_stream->qos = &preset->qos;
	bap_stream->codec_cfg = &preset->codec_cfg;
	bap_stream->ep->state = state;
}

DECLARE_FAKE_VOID_FUNC(mock_bap_discover_endpoint, struct bt_conn *, enum bt_audio_dir,
		       struct bt_bap_ep *);
DEFINE_FAKE_VOID_FUNC(mock_bap_discover_endpoint, struct bt_conn *, enum bt_audio_dir,
		      struct bt_bap_ep *);

void mock_unicast_client_discover(
	struct bt_conn *conn, struct bt_bap_ep *snk_eps[CONFIG_BT_BAP_UNICAST_CLIENT_ASE_SNK_COUNT],
	struct bt_bap_ep *src_eps[CONFIG_BT_BAP_UNICAST_CLIENT_ASE_SRC_COUNT])
{
	struct bt_bap_unicast_client_cb unicast_client_cb = {
		.endpoint = mock_bap_discover_endpoint,
	};
	int err;

	err = bt_bap_unicast_client_register_cb(&unicast_client_cb);
	zassert_equal(0, err, "Unexpected return value %d", err);

	if (snk_eps != NULL) {
		RESET_FAKE(mock_bap_discover_endpoint);

		err = bt_bap_unicast_client_discover(conn, BT_AUDIO_DIR_SINK);
		zassert_equal(0, err, "Unexpected return value %d", err);

		zexpect_call_count("unicast_client_cb.bap_discover_endpoint",
				   CONFIG_BT_BAP_UNICAST_CLIENT_ASE_SNK_COUNT,
				   mock_bap_discover_endpoint_fake.call_count);
		for (size_t i = 0U; i < mock_bap_discover_endpoint_fake.call_count; i++) {
			/* Verify conn */
			zassert_equal(mock_bap_discover_endpoint_fake.arg0_history[i], conn, "%p",
				      mock_bap_discover_endpoint_fake.arg0_history[i]);

			/* Verify dir */
			zassert_equal(mock_bap_discover_endpoint_fake.arg1_history[i],
				      BT_AUDIO_DIR_SINK, "%d",
				      mock_bap_discover_endpoint_fake.arg1_history[i]);

			/* Verify and store ep */
			zassert_not_equal(mock_bap_discover_endpoint_fake.arg2_history[i], NULL,
					  "%p", mock_bap_discover_endpoint_fake.arg2_history[i]);

			snk_eps[i] = mock_bap_discover_endpoint_fake.arg2_history[i];

			zassert_equal(bt_bap_ep_get_conn(snk_eps[i]), conn,
				      "Unexpected conn %p != %p", bt_bap_ep_get_conn(snk_eps[i]),
				      conn);
		}
	}

	if (src_eps != NULL) {
		RESET_FAKE(mock_bap_discover_endpoint);
		err = bt_bap_unicast_client_discover(conn, BT_AUDIO_DIR_SOURCE);
		zassert_equal(0, err, "Unexpected return value %d", err);

		zexpect_call_count("unicast_client_cb.bap_discover_endpoint",
				   CONFIG_BT_BAP_UNICAST_CLIENT_ASE_SRC_COUNT,
				   mock_bap_discover_endpoint_fake.call_count);
		for (size_t i = 0U; i < mock_bap_discover_endpoint_fake.call_count; i++) {
			/* Verify conn */
			zassert_equal(mock_bap_discover_endpoint_fake.arg0_history[i], conn, "%p",
				      mock_bap_discover_endpoint_fake.arg0_history[i]);

			/* Verify dir */
			zassert_equal(mock_bap_discover_endpoint_fake.arg1_history[i],
				      BT_AUDIO_DIR_SOURCE, "%d",
				      mock_bap_discover_endpoint_fake.arg1_history[i]);

			/* Verify and store ep */
			zassert_not_equal(mock_bap_discover_endpoint_fake.arg2_history[i], NULL,
					  "%p", mock_bap_discover_endpoint_fake.arg2_history[i]);

			src_eps[i] = mock_bap_discover_endpoint_fake.arg2_history[i];

			zassert_equal(bt_bap_ep_get_conn(src_eps[i]), conn,
				      "Unexpected conn %p != %p", bt_bap_ep_get_conn(src_eps[i]),
				      conn);
		}
	}

	/* We don't need the callbacks anymore */
	err = bt_bap_unicast_client_unregister_cb(&unicast_client_cb);
	zassert_equal(0, err, "Unexpected return value %d", err);
}
```
