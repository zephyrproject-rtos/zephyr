## CMakeLists.txt
```
# SPDX-License-Identifier: Apache-2.0

cmake_minimum_required(VERSION 3.28.0)

find_package(Zephyr REQUIRED HINTS $ENV{ZEPHYR_BASE})
project(bluetooth_ccp_client)

target_include_directories(app PRIVATE
  ${ZEPHYR_BASE}/subsys/bluetooth/

  ${ZEPHYR_BASE}/tests/bluetooth/audio/ccp_call_control_client/include
  ${ZEPHYR_BASE}/tests/bluetooth/audio/mocks/include
)

target_sources(app PRIVATE
  # Test source files
  src/main.c
  src/test_common.c
  src/test_procedures.c

  # UUT files
  uut/tbs_client.c

  # Stack source file
  ${ZEPHYR_BASE}/subsys/bluetooth/audio/ccp_call_control_client.c

  # Mock files
  ${ZEPHYR_BASE}/tests/bluetooth/audio/mocks/src/conn.c
  ${ZEPHYR_BASE}/tests/bluetooth/audio/mocks/src/gatt.c
)
```

## Kconfig
```
# Copyright (c) 2025 Nordic Semiconductor ASA
# SPDX-License-Identifier: Apache-2.0

config BT_AUDIO
	bool
	default y

config BT_BONDABLE
	bool
	default y

config BT_BUF_ACL_RX_SIZE
	int
	default 69

config BT_BUF_ACL_TX_COUNT
	int
	default 5

config BT_BUF_EVT_RX_COUNT
	int
	default 10

config BT_CONN
	bool
	default y

config BT_EXT_ADV
	bool
	default y

config BT_L2CAP_TX_MTU
	int
	default 65

config BT_LOG
	bool
	default y

config BT_MAX_CONN
	int
	default 1

config BT_MAX_PAIRED
	int
	default 1

config BT_SMP
	bool
	default y

config BT_TBS_CLIENT
	bool
	default y

config BT_TBS_CLIENT_GTBS
	bool
	default y

config BT_TBS_CLIENT_TBS
	bool
	default y

config BT_TBS_CLIENT_BEARER_PROVIDER_NAME
	bool
	default y

config BT_TBS_CLIENT_BEARER_UCI
	bool
	default y

# Include Zephyr's Kconfig.
source "Kconfig"
source "subsys/bluetooth/audio/Kconfig"
source "subsys/bluetooth/Kconfig.logging"
```

## prj.conf
```kconfig
CONFIG_ZTEST=y

CONFIG_BT_CCP_CALL_CONTROL_CLIENT=y
CONFIG_BT_CCP_CALL_CONTROL_CLIENT_BEARER_COUNT=2
CONFIG_BT_CCP_CALL_CONTROL_CLIENT_CB_USER_DATA=y
CONFIG_UTF8=y

CONFIG_ASSERT=y

CONFIG_LOG=y
CONFIG_BT_CCP_CALL_CONTROL_CLIENT_LOG_LEVEL_DBG=y
```

## src/main.c
```c
/* main.c - Application main entry point */

/*
 * Copyright (c) 2024-2025 Nordic Semiconductor ASA
 *
 * SPDX-License-Identifier: Apache-2.0
 */

#include <errno.h>
#include <stdlib.h>
#include <string.h>

#include <zephyr/autoconf.h>
#include <zephyr/bluetooth/audio/ccp.h>
#include <zephyr/bluetooth/conn.h>
#include <zephyr/bluetooth/hci_types.h>
#include <zephyr/sys/util_macro.h>
#include <zephyr/ztest_test.h>
#include <zephyr/ztest_assert.h>

#include "conn.h"
#include "expects_util.h"
#include "test_common.h"

struct ccp_call_control_client_test_suite_fixture {
	struct bt_ccp_call_control_client_cb client_cbs;
	struct bt_ccp_call_control_client *client;
	struct bt_conn conn;

	/* Callback values */
	/** Need 1 additional bearer than the max to trigger some corner cases */
	struct bt_ccp_call_control_client_bearer
		*bearers[CONFIG_BT_CCP_CALL_CONTROL_CLIENT_BEARER_COUNT + 1];
};

static void discover_cb(struct bt_ccp_call_control_client *client, int err,
			struct bt_ccp_call_control_client_bearers *bearers, void *user_data)
{
	struct ccp_call_control_client_test_suite_fixture *fixture = user_data;

	zassert_not_null(client);
	zassert_equal(err, 0);
	zassert_not_null(bearers);
	zassert_not_null(user_data);
	zassert_is_null(fixture->bearers[0]); /* expect only a single call */

#if defined(CONFIG_BT_TBS_CLIENT_GTBS)
	zassert_not_null(bearers->gtbs_bearer);
	fixture->bearers[0] = bearers->gtbs_bearer;
#endif /* CONFIG_BT_TBS_CLIENT_GTBS */

#if defined(CONFIG_BT_TBS_CLIENT_TBS)
	zassert_equal(CONFIG_BT_TBS_CLIENT_MAX_TBS_INSTANCES, bearers->tbs_count);
	for (size_t i = 0U; i < bearers->tbs_count; i++) {
		zassert_not_null(bearers->tbs_bearers[i]);
		fixture->bearers[i + IS_ENABLED(CONFIG_BT_TBS_CLIENT_GTBS)] =
			bearers->tbs_bearers[i];
	}
#endif /* CONFIG_BT_TBS_CLIENT_TBS */
}

static void *ccp_call_control_client_test_suite_setup(void)
{
	struct ccp_call_control_client_test_suite_fixture *fixture;

	fixture = malloc(sizeof(*fixture));
	zassert_not_null(fixture);

	return fixture;
}

static void ccp_call_control_client_test_suite_before(void *f)
{
	struct ccp_call_control_client_test_suite_fixture *fixture = f;

	memset(fixture, 0, sizeof(*fixture));
	test_conn_init(&fixture->conn);

	fixture->client_cbs.discover = discover_cb;
	fixture->client_cbs.user_data = fixture;
}

static void ccp_call_control_client_test_suite_after(void *f)
{
	struct ccp_call_control_client_test_suite_fixture *fixture = f;

	(void)bt_ccp_call_control_client_unregister_cb(&fixture->client_cbs);
	mock_bt_conn_disconnected(&fixture->conn, BT_HCI_ERR_REMOTE_USER_TERM_CONN);
}

static void ccp_call_control_client_test_suite_teardown(void *f)
{
	free(f);
}

ZTEST_SUITE(ccp_call_control_client_test_suite, NULL, ccp_call_control_client_test_suite_setup,
	    ccp_call_control_client_test_suite_before, ccp_call_control_client_test_suite_after,
	    ccp_call_control_client_test_suite_teardown);

static ZTEST_F(ccp_call_control_client_test_suite, test_ccp_call_control_client_register_cb)
{
	int err;

	err = bt_ccp_call_control_client_register_cb(&fixture->client_cbs);
	zassert_equal(0, err, "Unexpected return value %d", err);
}

static ZTEST_F(ccp_call_control_client_test_suite,
	       test_ccp_call_control_client_register_cb_inval_param_null)
{
	int err;

	err = bt_ccp_call_control_client_register_cb(NULL);
	zassert_equal(-EINVAL, err, "Unexpected return value %d", err);
}

static ZTEST_F(ccp_call_control_client_test_suite,
	       test_ccp_call_control_client_register_cb_inval_double_register)
{
	int err;

	err = bt_ccp_call_control_client_register_cb(&fixture->client_cbs);
	zassert_equal(0, err, "Unexpected return value %d", err);

	err = bt_ccp_call_control_client_register_cb(&fixture->client_cbs);
	zassert_equal(-EEXIST, err, "Unexpected return value %d", err);
}

static ZTEST_F(ccp_call_control_client_test_suite, test_ccp_call_control_client_unregister_cb)
{
	int err;

	err = bt_ccp_call_control_client_register_cb(&fixture->client_cbs);
	zassert_equal(0, err, "Unexpected return value %d", err);

	err = bt_ccp_call_control_client_unregister_cb(&fixture->client_cbs);
	zassert_equal(0, err, "Unexpected return value %d", err);
}

static ZTEST_F(ccp_call_control_client_test_suite,
	       test_ccp_call_control_client_unregister_cb_inval_param_null)
{
	int err;

	err = bt_ccp_call_control_client_unregister_cb(NULL);
	zassert_equal(-EINVAL, err, "Unexpected return value %d", err);
}

static ZTEST_F(ccp_call_control_client_test_suite,
	       test_ccp_call_control_client_unregister_cb_inval_double_unregister)
{
	int err;

	err = bt_ccp_call_control_client_register_cb(&fixture->client_cbs);
	zassert_equal(0, err, "Unexpected return value %d", err);

	err = bt_ccp_call_control_client_unregister_cb(&fixture->client_cbs);
	zassert_equal(0, err, "Unexpected return value %d", err);

	err = bt_ccp_call_control_client_unregister_cb(&fixture->client_cbs);
	zassert_equal(-EALREADY, err, "Unexpected return value %d", err);
}

static ZTEST_F(ccp_call_control_client_test_suite, test_ccp_call_control_client_discover)
{
	int err;

	err = bt_ccp_call_control_client_register_cb(&fixture->client_cbs);
	zassert_equal(0, err, "Unexpected return value %d", err);

	err = bt_ccp_call_control_client_discover(&fixture->conn, &fixture->client);
	zassert_equal(0, err, "Unexpected return value %d", err);
}

static ZTEST_F(ccp_call_control_client_test_suite,
	       test_ccp_call_control_client_discover_inval_param_null_conn)
{
	int err;

	err = bt_ccp_call_control_client_register_cb(&fixture->client_cbs);
	zassert_equal(0, err, "Unexpected return value %d", err);

	err = bt_ccp_call_control_client_discover(NULL, &fixture->client);
	zassert_equal(-EINVAL, err, "Unexpected return value %d", err);
}

static ZTEST_F(ccp_call_control_client_test_suite,
	       test_ccp_call_control_client_discover_inval_param_null_client)
{
	int err;

	err = bt_ccp_call_control_client_register_cb(&fixture->client_cbs);
	zassert_equal(0, err, "Unexpected return value %d", err);

	err = bt_ccp_call_control_client_discover(&fixture->conn, NULL);
	zassert_equal(-EINVAL, err, "Unexpected return value %d", err);
}

static ZTEST_F(ccp_call_control_client_test_suite, test_ccp_call_control_client_get_bearers)
{
	struct bt_ccp_call_control_client_bearers bearers;
	int err;

	err = bt_ccp_call_control_client_register_cb(&fixture->client_cbs);
	zassert_equal(0, err, "Unexpected return value %d", err);

	err = bt_ccp_call_control_client_discover(&fixture->conn, &fixture->client);
	zassert_equal(0, err, "Unexpected return value %d", err);

	err = bt_ccp_call_control_client_get_bearers(fixture->client, &bearers);
	zassert_equal(0, err, "Unexpected return value %d", err);

#if defined(CONFIG_BT_TBS_CLIENT_GTBS)
	zassert_not_null(bearers.gtbs_bearer);
#endif /* CONFIG_BT_TBS_CLIENT_GTBS */

#if defined(CONFIG_BT_TBS_CLIENT_TBS)
	zassert_equal(CONFIG_BT_TBS_CLIENT_MAX_TBS_INSTANCES, bearers.tbs_count);
	for (size_t i = 0U; i < bearers.tbs_count; i++) {
		zassert_not_null(bearers.tbs_bearers[i]);
	}
#endif /* CONFIG_BT_TBS_CLIENT_TBS */
}
```

## include/ccp_call_control_client.h
```c
/*
 * Copyright (c) 2024-2026 Nordic Semiconductor ASA
 *
 * SPDX-License-Identifier: Apache-2.0
 */

#ifndef MOCKS_CCP_CALL_CONTROL_CLIENT_H_
#define MOCKS_CCP_CALL_CONTROL_CLIENT_H_

#include <zephyr/bluetooth/assigned_numbers.h>
#include <zephyr/bluetooth/audio/ccp.h>
#include <zephyr/bluetooth/conn.h>
#include <zephyr/fff.h>

extern struct bt_ccp_call_control_client_cb mock_ccp_call_control_client_cb;

void mock_ccp_call_control_client_init(void);
void mock_ccp_call_control_client_cleanup(void);

DECLARE_FAKE_VOID_FUNC(mock_ccp_call_control_client_discover_cb,
		       struct bt_ccp_call_control_client *, int,
		       struct bt_ccp_call_control_client_bearers *);
DECLARE_FAKE_VOID_FUNC(mock_ccp_call_control_client_bearer_provider_name_cb,
		       struct bt_ccp_call_control_client_bearer *, int, const char *);
DECLARE_FAKE_VOID_FUNC(mock_ccp_call_control_client_bearer_uci_cb,
		       struct bt_ccp_call_control_client_bearer *, int, const char *);
DECLARE_FAKE_VOID_FUNC(mock_ccp_call_control_client_bearer_tech_cb,
		       struct bt_ccp_call_control_client_bearer *, int, enum bt_bearer_tech);
DECLARE_FAKE_VOID_FUNC(mock_ccp_call_control_client_bearer_uri_schemes_cb,
		       struct bt_ccp_call_control_client_bearer *, int, const char *);

#endif /* MOCKS_CCP_CALL_CONTROL_CLIENT_H_ */
```

## include/test_common.h
```c
/* test_common.h */

/*
 * Copyright (c) 2024 Nordic Semiconductor ASA
 *
 * SPDX-License-Identifier: Apache-2.0
 */

#include <zephyr/bluetooth/audio/bap.h>
#include <zephyr/bluetooth/audio/bap_lc3_preset.h>
#include <zephyr/bluetooth/audio/cap.h>
#include <zephyr/bluetooth/conn.h>

void test_mocks_init(void);
void test_mocks_cleanup(void);

void test_conn_init(struct bt_conn *conn);
```

## src/test_common.c
```c
/* test_common.c - Common functions */

/*
 * Copyright (c) 2024-2025 Nordic Semiconductor ASA
 *
 * SPDX-License-Identifier: Apache-2.0
 */

#include <zephyr/bluetooth/conn.h>
#include <zephyr/bluetooth/hci_types.h>

#include "conn.h"

void test_conn_init(struct bt_conn *conn)
{
	conn->index = 0U;
	conn->info.type = BT_CONN_TYPE_LE;
	conn->info.role = BT_CONN_ROLE_CENTRAL;
	conn->info.state = BT_CONN_STATE_CONNECTED;
	conn->info.security.level = BT_SECURITY_L2;
	conn->info.security.enc_key_size = BT_ENC_KEY_SIZE_MAX;
	conn->info.security.flags = BT_SECURITY_FLAG_OOB | BT_SECURITY_FLAG_SC;

	mock_bt_conn_connected(conn, BT_HCI_ERR_SUCCESS);
}
```

## src/test_procedures.c
```c
/* test_procedures.c - Testing of CCP procedures  */

/*
 * Copyright (c) 2024-2026 Nordic Semiconductor ASA
 *
 * SPDX-License-Identifier: Apache-2.0
 */

#include <errno.h>
#include <stdlib.h>
#include <string.h>

#include <zephyr/autoconf.h>
#include <zephyr/bluetooth/assigned_numbers.h>
#include <zephyr/bluetooth/att.h>
#include <zephyr/bluetooth/audio/ccp.h>
#include <zephyr/bluetooth/audio/tbs.h>
#include <zephyr/bluetooth/conn.h>
#include <zephyr/bluetooth/hci_types.h>
#include <zephyr/sys/util.h>
#include <zephyr/sys/util_macro.h>
#include <zephyr/sys/util_utf8.h>
#include <zephyr/ztest_test.h>
#include <zephyr/ztest_assert.h>

#include "conn.h"
#include "test_common.h"

struct ccp_call_control_client_procedures_test_suite_fixture {
	struct bt_ccp_call_control_client_cb client_cbs;
	struct bt_ccp_call_control_client *client;
	struct bt_conn conn;

	/* Callback values */
	struct bt_ccp_call_control_client_bearer
		*bearers[CONFIG_BT_CCP_CALL_CONTROL_CLIENT_BEARER_COUNT];
	char bearer_name[CONFIG_BT_TBS_MAX_PROVIDER_NAME_LENGTH + sizeof((char)'\0')];
	char bearer_uci[BT_TBS_MAX_UCI_SIZE];
	char bearer_uri_schemes[BT_ATT_MAX_ATTRIBUTE_LEN + sizeof((char)'\0')];
	enum bt_bearer_tech tech;
};

static void discover_cb(struct bt_ccp_call_control_client *client, int err,
			struct bt_ccp_call_control_client_bearers *bearers, void *user_data)
{
	struct ccp_call_control_client_procedures_test_suite_fixture *fixture = user_data;

	zassert_not_null(client);
	zassert_equal(err, 0);
	zassert_not_null(bearers);
	zassert_not_null(user_data);
	zassert_is_null(fixture->bearers[0]); /* expect only a single call */

#if defined(CONFIG_BT_TBS_CLIENT_GTBS)
	zassert_not_null(bearers->gtbs_bearer);
	fixture->bearers[0] = bearers->gtbs_bearer;
#endif /* CONFIG_BT_TBS_CLIENT_GTBS */

#if defined(CONFIG_BT_TBS_CLIENT_TBS)
	zassert_equal(CONFIG_BT_TBS_CLIENT_MAX_TBS_INSTANCES, bearers->tbs_count);
	for (size_t i = 0U; i < bearers->tbs_count; i++) {
		zassert_not_null(bearers->tbs_bearers[i]);
		fixture->bearers[i + IS_ENABLED(CONFIG_BT_TBS_CLIENT_GTBS)] =
			bearers->tbs_bearers[i];
	}
#endif /* CONFIG_BT_TBS_CLIENT_TBS */
}

static void bearer_provider_name_cb(struct bt_ccp_call_control_client_bearer *bearer, int err,
				    const char *name, void *user_data)
{
	struct ccp_call_control_client_procedures_test_suite_fixture *fixture = user_data;

	zassert_not_null(bearer);
	zassert_equal(err, 0);
	zassert_not_null(name);
	zassert_not_null(user_data);
	zassert_true(strlen(name) <= CONFIG_BT_TBS_MAX_PROVIDER_NAME_LENGTH);
	zassert_true(strlen(fixture->bearer_name) == 0U); /* expect only a single call */
	utf8_lcpy(fixture->bearer_name, name, sizeof(fixture->bearer_name));
}

static void bearer_uci_cb(struct bt_ccp_call_control_client_bearer *bearer, int err,
			  const char *uci, void *user_data)
{
	struct ccp_call_control_client_procedures_test_suite_fixture *fixture = user_data;

	zassert_not_null(bearer);
	zassert_equal(err, 0);

	zassert_not_null(uci);
	zassert_not_null(user_data);
	zassert_true(strlen(uci) < BT_TBS_MAX_UCI_SIZE);
	zassert_true(strlen(fixture->bearer_uci) == 0U); /* expect only a single call */

	utf8_lcpy(fixture->bearer_uci, uci, BT_TBS_MAX_UCI_SIZE);
}

static void bearer_tech_cb(struct bt_ccp_call_control_client_bearer *bearer, int err,
			   enum bt_bearer_tech tech, void *user_data)
{
	struct ccp_call_control_client_procedures_test_suite_fixture *fixture = user_data;

	zassert_not_null(bearer);
	zassert_equal(err, 0);

	zassert_not_null(user_data);

	fixture->tech = tech;
}

static void bearer_uri_schemes_cb(struct bt_ccp_call_control_client_bearer *bearer, int err,
				  const char *uri_schemes, void *user_data)
{
	struct ccp_call_control_client_procedures_test_suite_fixture *fixture = user_data;

	zassert_not_null(bearer);
	zassert_equal(err, 0);

	zassert_not_null(user_data);
	zassert_not_null(uri_schemes);

	zassert_true(strlen(uri_schemes) < sizeof(fixture->bearer_uri_schemes));
	zassert_true(strlen(fixture->bearer_uri_schemes) == 0U); /* expect only a single call */
	utf8_lcpy(fixture->bearer_uri_schemes, uri_schemes, sizeof(fixture->bearer_uri_schemes));
}

static void *ccp_call_control_client_procedures_test_suite_setup(void)
{
	struct ccp_call_control_client_procedures_test_suite_fixture *fixture;

	fixture = malloc(sizeof(*fixture));
	zassert_not_null(fixture);

	return fixture;
}

static void ccp_call_control_client_procedures_test_suite_before(void *f)
{
	struct ccp_call_control_client_procedures_test_suite_fixture *fixture = f;
	int err;

	memset(fixture, 0, sizeof(*fixture));
	test_conn_init(&fixture->conn);

	fixture->client_cbs.discover = discover_cb;
	fixture->client_cbs.bearer_provider_name = bearer_provider_name_cb;
	fixture->client_cbs.bearer_uci = bearer_uci_cb;
	fixture->client_cbs.bearer_tech = bearer_tech_cb;
	fixture->client_cbs.bearer_uri_schemes = bearer_uri_schemes_cb;
	fixture->client_cbs.user_data = fixture;

	err = bt_ccp_call_control_client_register_cb(&fixture->client_cbs);
	zassert_equal(err, 0, "Unexpected return value %d", err);

	err = bt_ccp_call_control_client_discover(&fixture->conn, &fixture->client);
	zassert_equal(err, 0, "Unexpected return value %d", err);

	zassert_not_null(fixture->bearers[0]);
}

static void ccp_call_control_client_procedures_test_suite_after(void *f)
{
	struct ccp_call_control_client_procedures_test_suite_fixture *fixture = f;

	(void)bt_ccp_call_control_client_unregister_cb(&fixture->client_cbs);
	mock_bt_conn_disconnected(&fixture->conn, BT_HCI_ERR_REMOTE_USER_TERM_CONN);
}

static void ccp_call_control_client_procedures_test_suite_teardown(void *f)
{
	free(f);
}

ZTEST_SUITE(ccp_call_control_client_procedures_test_suite, NULL,
	    ccp_call_control_client_procedures_test_suite_setup,
	    ccp_call_control_client_procedures_test_suite_before,
	    ccp_call_control_client_procedures_test_suite_after,
	    ccp_call_control_client_procedures_test_suite_teardown);

static ZTEST_F(ccp_call_control_client_procedures_test_suite,
	       test_ccp_call_control_client_read_bearer_provider_name)
{
	int err;

	err = bt_ccp_call_control_client_read_bearer_provider_name(fixture->bearers[0]);
	zassert_equal(err, 0, "Unexpected return value %d", err);

	zassert_true(strlen(fixture->bearer_name) > 0U);
}

static ZTEST_F(ccp_call_control_client_procedures_test_suite,
	       test_ccp_call_control_client_read_bearer_provider_name_inval_null_bearer)
{
	int err;

	err = bt_ccp_call_control_client_read_bearer_provider_name(NULL);
	zassert_equal(err, -EINVAL, "Unexpected return value %d", err);
}

static ZTEST_F(ccp_call_control_client_procedures_test_suite,
	       test_ccp_call_control_client_read_bearer_provider_name_inval_not_discovered)
{
	int err;

	/* Fake disconnection to clear the discovered value for the bearers */
	mock_bt_conn_disconnected(&fixture->conn, BT_HCI_ERR_REMOTE_USER_TERM_CONN);
	/* Mark as connected again but without discovering */
	test_conn_init(&fixture->conn);

	err = bt_ccp_call_control_client_read_bearer_provider_name(fixture->bearers[0]);
	zassert_equal(err, -EFAULT, "Unexpected return value %d", err);
}

static ZTEST_F(ccp_call_control_client_procedures_test_suite,
	       test_ccp_call_control_client_read_bearer_provider_name_inval_bearer)
{
	struct bt_ccp_call_control_client_bearer *invalid_bearer =
		(struct bt_ccp_call_control_client_bearer *)0xdeadbeefU;
	int err;

	err = bt_ccp_call_control_client_read_bearer_provider_name(invalid_bearer);
	zassert_equal(err, -EEXIST, "Unexpected return value %d", err);
}

static ZTEST_F(ccp_call_control_client_procedures_test_suite,
	       test_ccp_call_control_client_read_bearer_uci)
{
	int err;

	err = bt_ccp_call_control_client_read_bearer_uci(fixture->bearers[0]);
	zassert_equal(err, 0, "Unexpected return value %d", err);

	zassert_true(strlen(fixture->bearer_uci) > 0U);
}

static ZTEST_F(ccp_call_control_client_procedures_test_suite,
	       test_ccp_call_control_client_read_bearer_uci_inval_null_bearer)
{
	int err;

	err = bt_ccp_call_control_client_read_bearer_uci(NULL);
	zassert_equal(err, -EINVAL, "Unexpected return value %d", err);
}

static ZTEST_F(ccp_call_control_client_procedures_test_suite,
	       test_ccp_call_control_client_read_bearer_uci_inval_not_discovered)
{
	int err;

	/* Fake disconnection to clear the discovered value for the bearers */
	mock_bt_conn_disconnected(&fixture->conn, BT_HCI_ERR_REMOTE_USER_TERM_CONN);
	/* Mark as connected again but without discovering */
	test_conn_init(&fixture->conn);

	err = bt_ccp_call_control_client_read_bearer_uci(fixture->bearers[0]);
	zassert_equal(err, -EFAULT, "Unexpected return value %d", err);
}

static ZTEST_F(ccp_call_control_client_procedures_test_suite,
	       test_ccp_call_control_client_read_bearer_uci_inval_bearer)
{
	struct bt_ccp_call_control_client_bearer *invalid_bearer =
		(struct bt_ccp_call_control_client_bearer *)0xdeadbeefU;
	int err;

	err = bt_ccp_call_control_client_read_bearer_uci(invalid_bearer);
	zassert_equal(err, -EEXIST, "Unexpected return value %d", err);
}

static ZTEST_F(ccp_call_control_client_procedures_test_suite,
	       test_ccp_call_control_client_read_bearer_tech)
{
	int err;

	err = bt_ccp_call_control_client_read_bearer_tech(fixture->bearers[0]);
	zassert_equal(err, 0, "Unexpected return value %d", err);

	zassert_true(fixture->tech != 0);
}

static ZTEST_F(ccp_call_control_client_procedures_test_suite,
	       test_ccp_call_control_client_read_bearer_tech_inval_null_bearer)
{
	int err;

	err = bt_ccp_call_control_client_read_bearer_tech(NULL);
	zassert_equal(err, -EINVAL, "Unexpected return value %d", err);
}

static ZTEST_F(ccp_call_control_client_procedures_test_suite,
	       test_ccp_call_control_client_read_bearer_tech_inval_not_discovered)
{
	int err;

	/* Fake disconnection to clear the discovered value for the bearers */
	mock_bt_conn_disconnected(&fixture->conn, BT_HCI_ERR_REMOTE_USER_TERM_CONN);
	/* Mark as connected again but without discovering */
	test_conn_init(&fixture->conn);

	err = bt_ccp_call_control_client_read_bearer_tech(fixture->bearers[0]);
	zassert_equal(err, -EFAULT, "Unexpected return value %d", err);
}

static ZTEST_F(ccp_call_control_client_procedures_test_suite,
	       test_ccp_call_control_client_read_bearer_tech_inval_bearer)
{
	struct bt_ccp_call_control_client_bearer *invalid_bearer =
		(struct bt_ccp_call_control_client_bearer *)0xdeadbeefU;
	int err;

	err = bt_ccp_call_control_client_read_bearer_tech(invalid_bearer);
	zassert_equal(err, -EEXIST, "Unexpected return value %d", err);
}

static ZTEST_F(ccp_call_control_client_procedures_test_suite,
	       test_ccp_call_control_client_read_bearer_uri_schemes)
{
	int err;

	err = bt_ccp_call_control_client_read_bearer_uri_schemes(fixture->bearers[0]);
	zassert_equal(err, 0, "Unexpected return value %d", err);

	zassert_true(strlen(fixture->bearer_uri_schemes) > 0U);
}

static ZTEST_F(ccp_call_control_client_procedures_test_suite,
	       test_ccp_call_control_client_read_bearer_uri_schemes_inval_null_bearer)
{
	int err;

	err = bt_ccp_call_control_client_read_bearer_uri_schemes(NULL);
	zassert_equal(err, -EINVAL, "Unexpected return value %d", err);
}

static ZTEST_F(ccp_call_control_client_procedures_test_suite,
	       test_ccp_call_control_client_read_bearer_uri_schemes_inval_not_discovered)
{
	int err;

	/* Fake disconnection to clear the discovered value for the bearers*/
	mock_bt_conn_disconnected(&fixture->conn, BT_HCI_ERR_REMOTE_USER_TERM_CONN);
	/* Mark as connected again but without discovering */
	test_conn_init(&fixture->conn);

	err = bt_ccp_call_control_client_read_bearer_uri_schemes(fixture->bearers[0]);
	zassert_equal(err, -EFAULT, "Unexpected return value %d", err);
}

static ZTEST_F(ccp_call_control_client_procedures_test_suite,
	       test_ccp_call_control_client_read_bearer_uri_schemes_inval_bearer)
{
	struct bt_ccp_call_control_client_bearer *invalid_bearer =
		(struct bt_ccp_call_control_client_bearer *)0xdeadbeefU;
	int err;

	err = bt_ccp_call_control_client_read_bearer_uri_schemes(invalid_bearer);
	zassert_equal(err, -EEXIST, "Unexpected return value %d", err);
}
```
