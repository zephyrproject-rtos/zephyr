## CMakeLists.txt
```
# SPDX-License-Identifier: Apache-2.0

cmake_minimum_required(VERSION 3.20.0)

project(bluetooth_ccp)
find_package(Zephyr COMPONENTS unittest HINTS $ENV{ZEPHYR_BASE})

add_subdirectory(${ZEPHYR_BASE}/tests/bluetooth/audio/ccp_client/uut uut)

target_link_libraries(testbinary PRIVATE uut)

target_include_directories(testbinary PRIVATE include)

target_sources(testbinary
  PRIVATE
    src/main.c
)
```

## prj.conf
```kconfig
CONFIG_ZTEST=y

CONFIG_BT=y
CONFIG_BT_EXT_ADV=y
CONFIG_BT_SMP=y
CONFIG_BT_PERIPHERAL=y
CONFIG_BT_AUDIO=y
CONFIG_BT_CCP_CLIENT=y
CONFIG_BT_CCP_CLIENT_BEARER_COUNT=2
CONFIG_BT_TBS_CLIENT_TBS=y
CONFIG_BT_TBS_CLIENT_GTBS=y
CONFIG_UTF8=y

CONFIG_ASSERT=y
CONFIG_ASSERT_LEVEL=2
CONFIG_ASSERT_VERBOSE=y

CONFIG_LOG=y
CONFIG_BT_CCP_CLIENT_LOG_LEVEL_DBG=y
```

## src/main.c
```c
/* main.c - Application main entry point */

/*
 * Copyright (c) 2024 Nordic Semiconductor ASA
 *
 * SPDX-License-Identifier: Apache-2.0
 */

#include <errno.h>
#include <stdlib.h>
#include <string.h>

#include <zephyr/autoconf.h>
#include <zephyr/bluetooth/audio/ccp.h>
#include <zephyr/bluetooth/conn.h>
#include <zephyr/bluetooth/hci_types.h>
#include <zephyr/fff.h>
#include <zephyr/sys/util_macro.h>
#include <zephyr/ztest_test.h>
#include <zephyr/ztest_assert.h>

#include "conn.h"
#include "ccp_client.h"
#include "expects_util.h"
#include "test_common.h"

DEFINE_FFF_GLOBALS;

struct ccp_client_test_suite_fixture {
	/** Need 1 additional bearer than the max to trigger some corner cases */
	struct bt_ccp_client_bearer *bearers[CONFIG_BT_CCP_CLIENT_BEARER_COUNT + 1];
	struct bt_ccp_client *client;
	struct bt_conn conn;
};

static void mock_init_rule_before(const struct ztest_unit_test *test, void *fixture)
{
	test_mocks_init();
}

static void mock_destroy_rule_after(const struct ztest_unit_test *test, void *fixture)
{
	test_mocks_cleanup();
}

ZTEST_RULE(mock_rule, mock_init_rule_before, mock_destroy_rule_after);

static void *ccp_client_test_suite_setup(void)
{
	struct ccp_client_test_suite_fixture *fixture;

	fixture = malloc(sizeof(*fixture));
	zassert_not_null(fixture);

	return fixture;
}

static void ccp_client_test_suite_before(void *f)
{
	struct ccp_client_test_suite_fixture *fixture = f;

	memset(fixture, 0, sizeof(*fixture));
	test_conn_init(&fixture->conn);
}

static void ccp_client_test_suite_after(void *f)
{
	struct ccp_client_test_suite_fixture *fixture = f;

	(void)bt_ccp_client_unregister_cb(&mock_ccp_client_cb);
	mock_bt_conn_disconnected(&fixture->conn, BT_HCI_ERR_REMOTE_USER_TERM_CONN);
}

static void ccp_client_test_suite_teardown(void *f)
{
	free(f);
}

ZTEST_SUITE(ccp_client_test_suite, NULL, ccp_client_test_suite_setup, ccp_client_test_suite_before,
	    ccp_client_test_suite_after, ccp_client_test_suite_teardown);

static ZTEST_F(ccp_client_test_suite, test_ccp_client_register_cb)
{
	int err;

	err = bt_ccp_client_register_cb(&mock_ccp_client_cb);
	zassert_equal(0, err, "Unexpected return value %d", err);
}

static ZTEST_F(ccp_client_test_suite, test_ccp_client_register_cb_inval_param_null)
{
	int err;

	err = bt_ccp_client_register_cb(NULL);
	zassert_equal(-EINVAL, err, "Unexpected return value %d", err);
}

static ZTEST_F(ccp_client_test_suite, test_ccp_client_register_cb_inval_double_register)
{
	int err;

	err = bt_ccp_client_register_cb(&mock_ccp_client_cb);
	zassert_equal(0, err, "Unexpected return value %d", err);

	err = bt_ccp_client_register_cb(&mock_ccp_client_cb);
	zassert_equal(-EEXIST, err, "Unexpected return value %d", err);
}

static ZTEST_F(ccp_client_test_suite, test_ccp_client_unregister_cb)
{
	int err;

	err = bt_ccp_client_register_cb(&mock_ccp_client_cb);
	zassert_equal(0, err, "Unexpected return value %d", err);

	err = bt_ccp_client_unregister_cb(&mock_ccp_client_cb);
	zassert_equal(0, err, "Unexpected return value %d", err);
}

static ZTEST_F(ccp_client_test_suite, test_ccp_client_unregister_cb_inval_param_null)
{
	int err;

	err = bt_ccp_client_unregister_cb(NULL);
	zassert_equal(-EINVAL, err, "Unexpected return value %d", err);
}

static ZTEST_F(ccp_client_test_suite, test_ccp_client_unregister_cb_inval_double_unregister)
{
	int err;

	err = bt_ccp_client_register_cb(&mock_ccp_client_cb);
	zassert_equal(0, err, "Unexpected return value %d", err);

	err = bt_ccp_client_unregister_cb(&mock_ccp_client_cb);
	zassert_equal(0, err, "Unexpected return value %d", err);

	err = bt_ccp_client_unregister_cb(&mock_ccp_client_cb);
	zassert_equal(-EALREADY, err, "Unexpected return value %d", err);
}

static ZTEST_F(ccp_client_test_suite, test_ccp_client_discover)
{
	int err;

	err = bt_ccp_client_register_cb(&mock_ccp_client_cb);
	zassert_equal(0, err, "Unexpected return value %d", err);

	err = bt_ccp_client_discover(&fixture->conn, &fixture->client);
	zassert_equal(0, err, "Unexpected return value %d", err);

	/* Validate that we got the callback with valid values */
	zexpect_call_count("bt_ccp_client_cb.discover", 1,
			   mock_ccp_client_discover_cb_fake.call_count);
	zassert_not_null(mock_ccp_client_discover_cb_fake.arg0_history[0]);
	zassert_equal(0, mock_ccp_client_discover_cb_fake.arg1_history[0]);
	zassert_not_null(mock_ccp_client_discover_cb_fake.arg2_history[0]);

#if defined(CONFIG_BT_TBS_CLIENT_GTBS)
	zassert_not_null(mock_ccp_client_discover_cb_fake.arg2_history[0]->gtbs_bearer);
#endif /* CONFIG_BT_TBS_CLIENT_GTBS */

#if defined(CONFIG_BT_TBS_CLIENT_TBS)
	zassert_equal(CONFIG_BT_TBS_CLIENT_MAX_TBS_INSTANCES,
		      mock_ccp_client_discover_cb_fake.arg2_history[0]->tbs_count);
	zassert_not_null(mock_ccp_client_discover_cb_fake.arg2_history[0]->tbs_bearers);
#endif /* CONFIG_BT_TBS_CLIENT_TBS */
}

static ZTEST_F(ccp_client_test_suite, test_ccp_client_discover_inval_param_null_conn)
{
	int err;

	err = bt_ccp_client_register_cb(&mock_ccp_client_cb);
	zassert_equal(0, err, "Unexpected return value %d", err);

	err = bt_ccp_client_discover(NULL, &fixture->client);
	zassert_equal(-EINVAL, err, "Unexpected return value %d", err);
}

static ZTEST_F(ccp_client_test_suite, test_ccp_client_discover_inval_param_null_client)
{
	int err;

	err = bt_ccp_client_register_cb(&mock_ccp_client_cb);
	zassert_equal(0, err, "Unexpected return value %d", err);

	err = bt_ccp_client_discover(&fixture->conn, NULL);
	zassert_equal(-EINVAL, err, "Unexpected return value %d", err);
}

static ZTEST_F(ccp_client_test_suite, test_ccp_client_get_bearers)
{
	struct bt_ccp_client_bearers bearers;
	int err;

	err = bt_ccp_client_register_cb(&mock_ccp_client_cb);
	zassert_equal(0, err, "Unexpected return value %d", err);

	err = bt_ccp_client_discover(&fixture->conn, &fixture->client);
	zassert_equal(0, err, "Unexpected return value %d", err);

	err = bt_ccp_client_get_bearers(fixture->client, &bearers);
	zassert_equal(0, err, "Unexpected return value %d", err);

#if defined(CONFIG_BT_TBS_CLIENT_GTBS)
	zassert_not_null(bearers.gtbs_bearer);
#endif /* CONFIG_BT_TBS_CLIENT_GTBS */

#if defined(CONFIG_BT_TBS_CLIENT_TBS)
	zassert_equal(CONFIG_BT_TBS_CLIENT_MAX_TBS_INSTANCES, bearers.tbs_count);
	zassert_not_null(bearers.tbs_bearers);
#endif /* CONFIG_BT_TBS_CLIENT_TBS */
}
```

## include/ccp_client.h
```c
/*
 * Copyright (c) 2024 Nordic Semiconductor ASA
 *
 * SPDX-License-Identifier: Apache-2.0
 */

#ifndef MOCKS_CCP_CLIENT_H_
#define MOCKS_CCP_CLIENT_H_

#include <stdint.h>

#include <zephyr/bluetooth/audio/ccp.h>
#include <zephyr/bluetooth/conn.h>
#include <zephyr/fff.h>

extern struct bt_ccp_client_cb mock_ccp_client_cb;

void mock_ccp_client_init(void);
void mock_ccp_client_cleanup(void);

DECLARE_FAKE_VOID_FUNC(mock_ccp_client_discover_cb, struct bt_ccp_client *, int,
		       struct bt_ccp_client_bearers *);
DECLARE_FAKE_VOID_FUNC(mock_ccp_client_bearer_provider_name_cb, struct bt_ccp_client_bearer *, int,
		       const char *);
DECLARE_FAKE_VOID_FUNC(mock_ccp_client_bearer_uci_cb, struct bt_ccp_client_bearer *, int,
		       const char *);

#endif /* MOCKS_CCP_CLIENT_H_ */
```

## src/test_common.c
```c
/* common.c - Common functions */

/*
 * Copyright (c) 2024 Nordic Semiconductor ASA
 *
 * SPDX-License-Identifier: Apache-2.0
 */

#include <zephyr/bluetooth/conn.h>
#include <zephyr/bluetooth/hci_types.h>
#include <zephyr/ztest_test.h>

#include "ccp_client.h"
#include "conn.h"

void test_mocks_init(const struct ztest_unit_test *test, void *fixture)
{
	mock_ccp_client_init();
}

void test_mocks_cleanup(const struct ztest_unit_test *test, void *fixture)
{
	mock_ccp_client_cleanup();
}

void test_conn_init(struct bt_conn *conn)
{
	conn->index = 0;
	conn->info.type = BT_CONN_TYPE_LE;
	conn->info.role = BT_CONN_ROLE_CENTRAL;
	conn->info.state = BT_CONN_STATE_CONNECTED;
	conn->info.security.level = BT_SECURITY_L2;
	conn->info.security.enc_key_size = BT_ENC_KEY_SIZE_MAX;
	conn->info.security.flags = BT_SECURITY_FLAG_OOB | BT_SECURITY_FLAG_SC;

	mock_bt_conn_connected(conn, BT_HCI_ERR_SUCCESS);
}
```

## src/test_procedures.c
```c
/* test_procedures.c - Testing of CCP procedures  */

/*
 * Copyright (c) 2024 Nordic Semiconductor ASA
 *
 * SPDX-License-Identifier: Apache-2.0
 */

#include <errno.h>
#include <stdlib.h>
#include <string.h>

#include <zephyr/autoconf.h>
#include <zephyr/bluetooth/audio/ccp.h>
#include <zephyr/bluetooth/conn.h>
#include <zephyr/bluetooth/hci_types.h>
#include <zephyr/fff.h>
#include <zephyr/sys/util.h>
#include <zephyr/sys/util_macro.h>
#include <zephyr/ztest_test.h>
#include <zephyr/ztest_assert.h>

#include "conn.h"
#include "ccp_client.h"
#include "expects_util.h"
#include "test_common.h"

struct ccp_client_procedures_test_suite_fixture {
	/** Need 1 additional bearer than the max to trigger some corner cases */
	struct bt_ccp_client_bearer *bearers[CONFIG_BT_CCP_CLIENT_BEARER_COUNT];
	struct bt_ccp_client *client;
	struct bt_conn conn;
};

static void mock_init_rule_before(const struct ztest_unit_test *test, void *fixture)
{
	test_mocks_init();
}

static void mock_destroy_rule_after(const struct ztest_unit_test *test, void *fixture)
{
	test_mocks_cleanup();
}

ZTEST_RULE(mock_rule, mock_init_rule_before, mock_destroy_rule_after);

static void *ccp_client_procedures_test_suite_setup(void)
{
	struct ccp_client_procedures_test_suite_fixture *fixture;

	fixture = malloc(sizeof(*fixture));
	zassert_not_null(fixture);

	return fixture;
}

static void ccp_client_procedures_test_suite_before(void *f)
{
	struct ccp_client_procedures_test_suite_fixture *fixture = f;
	struct bt_ccp_client_bearers *bearers;
	size_t i = 0U;
	int err;

	memset(fixture, 0, sizeof(*fixture));
	test_conn_init(&fixture->conn);

	err = bt_ccp_client_register_cb(&mock_ccp_client_cb);
	zassert_equal(0, err, "Unexpected return value %d", err);

	err = bt_ccp_client_discover(&fixture->conn, &fixture->client);
	zassert_equal(0, err, "Unexpected return value %d", err);

	zexpect_call_count("bt_ccp_client_cb.discover", 1,
			   mock_ccp_client_discover_cb_fake.call_count);
	zassert_not_null(mock_ccp_client_discover_cb_fake.arg0_history[0]);
	zassert_equal(0, mock_ccp_client_discover_cb_fake.arg1_history[0]);
	bearers = mock_ccp_client_discover_cb_fake.arg2_history[0];
	zassert_not_null(bearers);

#if defined(CONFIG_BT_TBS_CLIENT_GTBS)
	zassert_not_null(bearers->gtbs_bearer);
	fixture->bearers[i++] = bearers->gtbs_bearer;
#endif /* CONFIG_BT_TBS_CLIENT_GTBS */

#if defined(CONFIG_BT_TBS_CLIENT_TBS)
	zassert_equal(CONFIG_BT_TBS_CLIENT_MAX_TBS_INSTANCES, bearers->tbs_count);
	zassert_not_null(bearers->tbs_bearers);
	for (; i < bearers->tbs_count; i++) {
		zassert_not_null(bearers->tbs_bearers[i]);
		fixture->bearers[i] = bearers->gtbs_bearer;
	}
#endif /* CONFIG_BT_TBS_CLIENT_TBS */
}

static void ccp_client_procedures_test_suite_after(void *f)
{
	struct ccp_client_procedures_test_suite_fixture *fixture = f;

	(void)bt_ccp_client_unregister_cb(&mock_ccp_client_cb);
	mock_bt_conn_disconnected(&fixture->conn, BT_HCI_ERR_REMOTE_USER_TERM_CONN);
}

static void ccp_client_procedures_test_suite_teardown(void *f)
{
	free(f);
}

ZTEST_SUITE(ccp_client_procedures_test_suite, NULL, ccp_client_procedures_test_suite_setup,
	    ccp_client_procedures_test_suite_before, ccp_client_procedures_test_suite_after,
	    ccp_client_procedures_test_suite_teardown);

static ZTEST_F(ccp_client_procedures_test_suite, test_ccp_client_read_bearer_provider_name)
{
	int err;

	err = bt_ccp_client_read_bearer_provider_name(fixture->bearers[0]);
	zassert_equal(err, 0, "Unexpected return value %d", err);

	zexpect_call_count("bt_ccp_client_cb.bearer_provider_name", 1,
			   mock_ccp_client_bearer_provider_name_cb_fake.call_count);
	zassert_not_null(mock_ccp_client_bearer_provider_name_cb_fake.arg0_history[0]); /* bearer */
	zassert_equal(0, mock_ccp_client_bearer_provider_name_cb_fake.arg1_history[0]); /* err */
	zassert_not_null(mock_ccp_client_bearer_provider_name_cb_fake.arg2_history[0]); /* name */
}

static ZTEST_F(ccp_client_procedures_test_suite,
	       test_ccp_client_read_bearer_provider_name_inval_null_bearer)
{
	int err;

	err = bt_ccp_client_read_bearer_provider_name(NULL);
	zassert_equal(err, -EINVAL, "Unexpected return value %d", err);
}

static ZTEST_F(ccp_client_procedures_test_suite,
	       test_ccp_client_read_bearer_provider_name_inval_not_discovered)
{
	int err;

	/* Fake disconnection to clear the discovered value for the bearers*/
	mock_bt_conn_disconnected(&fixture->conn, BT_HCI_ERR_REMOTE_USER_TERM_CONN);
	/* Mark as connected again but without discovering */
	test_conn_init(&fixture->conn);

	err = bt_ccp_client_read_bearer_provider_name(fixture->bearers[0]);
	zassert_equal(err, -EFAULT, "Unexpected return value %d", err);
}

static ZTEST_F(ccp_client_procedures_test_suite,
	       test_ccp_client_read_bearer_provider_name_inval_bearer)
{
	struct bt_ccp_client_bearer *invalid_bearer = (struct bt_ccp_client_bearer *)0xdeadbeef;
	int err;

	err = bt_ccp_client_read_bearer_provider_name(invalid_bearer);
	zassert_equal(err, -EEXIST, "Unexpected return value %d", err);
}
```
