## CMakeLists.txt
```
# SPDX-License-Identifier: Apache-2.0

cmake_minimum_required(VERSION 3.28.0)

find_package(Zephyr REQUIRED HINTS $ENV{ZEPHYR_BASE})

project(bluetooth_bap_broadcast_source)

target_include_directories(app PRIVATE ${ZEPHYR_BASE}/tests/bluetooth/audio/mocks/include)

target_sources(app PRIVATE
  # Test source files
  src/main.c
  src/test_callback_register.c

  # Stack source file
  ${ZEPHYR_BASE}/subsys/bluetooth/audio/audio.c
  ${ZEPHYR_BASE}/subsys/bluetooth/audio/bap_iso.c
  ${ZEPHYR_BASE}/subsys/bluetooth/audio/bap_stream.c
  ${ZEPHYR_BASE}/subsys/bluetooth/audio/bap_broadcast_source.c
  ${ZEPHYR_BASE}/subsys/bluetooth/audio/codec.c

  # Mock files
  ${ZEPHYR_BASE}/tests/bluetooth/audio/mocks/src/bap_broadcast_source.c
  ${ZEPHYR_BASE}/tests/bluetooth/audio/mocks/src/bap_stream.c
  ${ZEPHYR_BASE}/tests/bluetooth/audio/mocks/src/conn.c
  ${ZEPHYR_BASE}/tests/bluetooth/audio/mocks/src/iso.c
)
```

## Kconfig
```
# Copyright (c) 2025 Nordic Semiconductor ASA
# SPDX-License-Identifier: Apache-2.0


config BT_AUDIO
	bool
	default y

config BT_BUF_EVT_RX_COUNT
	int
	default 10

config BT_BUF_ACL_TX_COUNT
	int
	default 5

config BT_ISO_BROADCASTER
	bool
	default y

config BT_ISO_MAX_BIG
	int
	default 10

config BT_ISO_MAX_CHAN
	int
	default 10

config BT_LOG
	bool
	default y

# Include Zephyr's Kconfig.
source "Kconfig"
source "subsys/bluetooth/audio/Kconfig"
source "subsys/bluetooth/Kconfig.logging"
```

## prj.conf
```kconfig
CONFIG_ZTEST=y

CONFIG_NET_BUF=y

CONFIG_BT_BAP_BROADCAST_SOURCE=y
CONFIG_BT_BAP_BROADCAST_SRC_SUBGROUP_COUNT=2
CONFIG_BT_BAP_BROADCAST_SRC_COUNT=1
CONFIG_BT_BAP_BROADCAST_SRC_STREAM_COUNT=2

CONFIG_BT_AUDIO_CODEC_CFG_MAX_DATA_SIZE=20
CONFIG_BT_AUDIO_CODEC_CFG_MAX_METADATA_SIZE=20
CONFIG_BT_AUDIO_CODEC_CAP_MAX_DATA_SIZE=20
CONFIG_BT_AUDIO_CODEC_CAP_MAX_METADATA_SIZE=20

CONFIG_LOG=y
CONFIG_BT_BAP_BROADCAST_SOURCE_LOG_LEVEL_DBG=y

CONFIG_ASSERT=y
```

## src/test_callback_register.c
```c
/* test_callback_register.c - Test bt_bap_broadcast_source_register and unregister */

/*
 * Copyright (c) 2024 Nordic Semiconductor ASA
 *
 * SPDX-License-Identifier: Apache-2.0
 */

#include <errno.h>
#include <stddef.h>

#include <zephyr/bluetooth/audio/bap.h>
#include <zephyr/fff.h>
#include <zephyr/toolchain.h>
#include <zephyr/ztest_assert.h>
#include <zephyr/ztest_test.h>

#include <bap_broadcast_source.h>

#define FFF_GLOBALS

static void mock_init_rule_before(const struct ztest_unit_test *test, void *fixture)
{
	ARG_UNUSED(test);
	ARG_UNUSED(fixture);

	mock_bap_broadcast_source_init();
}

ZTEST_RULE(mock_rule, mock_init_rule_before, NULL);

static void bap_broadcast_source_test_cb_register_suite_after(void *f)
{
	int err;

	ARG_UNUSED(f);

	err = bt_bap_broadcast_source_unregister_cb(&mock_bap_broadcast_source_cb);
	zassert_true(err == 0 || err == -ENOENT, "Unexpected error: %d", err);
}

ZTEST_SUITE(bap_broadcast_source_test_cb_register_suite, NULL, NULL, NULL,
	    bap_broadcast_source_test_cb_register_suite_after, NULL);

static ZTEST(bap_broadcast_source_test_cb_register_suite, test_broadcast_source_register_cb)
{
	int err;

	err = bt_bap_broadcast_source_register_cb(&mock_bap_broadcast_source_cb);
	zassert_equal(0, err, "Unexpected return value %d", err);
}

static ZTEST(bap_broadcast_source_test_cb_register_suite,
	     test_broadcast_source_register_cb_inval_param_null)
{
	int err;

	err = bt_bap_broadcast_source_register_cb(NULL);
	zassert_equal(err, -EINVAL, "Unexpected return value %d", err);
}

static ZTEST(bap_broadcast_source_test_cb_register_suite,
	     test_broadcast_source_register_cb_inval_double_register)
{
	int err;

	err = bt_bap_broadcast_source_register_cb(&mock_bap_broadcast_source_cb);
	zassert_equal(err, 0, "Unexpected return value %d", err);

	err = bt_bap_broadcast_source_register_cb(&mock_bap_broadcast_source_cb);
	zassert_equal(err, -EEXIST, "Unexpected return value %d", err);
}

static ZTEST(bap_broadcast_source_test_cb_register_suite, test_broadcast_source_unregister_cb)
{
	int err;

	err = bt_bap_broadcast_source_register_cb(&mock_bap_broadcast_source_cb);
	zassert_equal(err, 0, "Unexpected return value %d", err);

	err = bt_bap_broadcast_source_unregister_cb(&mock_bap_broadcast_source_cb);
	zassert_equal(err, 0, "Unexpected return value %d", err);
}

static ZTEST(bap_broadcast_source_test_cb_register_suite,
	     test_broadcast_source_unregister_cb_inval_param_null)
{
	int err;

	err = bt_bap_broadcast_source_unregister_cb(NULL);
	zassert_equal(err, -EINVAL, "Unexpected return value %d", err);
}

static ZTEST(bap_broadcast_source_test_cb_register_suite,
	     test_broadcast_source_unregister_cb_inval_double_unregister)
{
	int err;

	err = bt_bap_broadcast_source_register_cb(&mock_bap_broadcast_source_cb);
	zassert_equal(err, 0, "Unexpected return value %d", err);

	err = bt_bap_broadcast_source_unregister_cb(&mock_bap_broadcast_source_cb);
	zassert_equal(err, 0, "Unexpected return value %d", err);

	err = bt_bap_broadcast_source_unregister_cb(&mock_bap_broadcast_source_cb);
	zassert_equal(err, -ENOENT, "Unexpected return value %d", err);
}
```
