## CMakeLists.txt
```
# SPDX-License-Identifier: Apache-2.0

cmake_minimum_required(VERSION 3.28.0)

find_package(Zephyr REQUIRED HINTS $ENV{ZEPHYR_BASE})

project(bluetooth_cap_initiator)

target_include_directories(app PRIVATE
  ${ZEPHYR_BASE}/subsys/bluetooth/

  ${ZEPHYR_BASE}/tests/bluetooth/audio/cap_initiator/include
  ${ZEPHYR_BASE}/tests/bluetooth/audio/mocks/include
)

target_sources(app PRIVATE
  # Test source files
  src/main.c
  src/test_common.c
  src/test_unicast_group.c
  src/test_unicast_start.c
  src/test_unicast_stop.c

  # UUT files
  uut/cap_initiator.c
  uut/csip.c

  # Stack source file
  ${ZEPHYR_BASE}/subsys/bluetooth/audio/audio.c
  ${ZEPHYR_BASE}/subsys/bluetooth/audio/bap_iso.c
  ${ZEPHYR_BASE}/subsys/bluetooth/audio/bap_stream.c
  ${ZEPHYR_BASE}/subsys/bluetooth/audio/cap_initiator.c
  ${ZEPHYR_BASE}/subsys/bluetooth/audio/cap_common.c
  ${ZEPHYR_BASE}/subsys/bluetooth/audio/cap_stream.c
  ${ZEPHYR_BASE}/subsys/bluetooth/audio/ccid.c
  ${ZEPHYR_BASE}/subsys/bluetooth/common/bt_str.c
  ${ZEPHYR_BASE}/subsys/bluetooth/host/uuid.c
  ${ZEPHYR_BASE}/lib/uuid/uuid.c

  # Mock files
  ${ZEPHYR_BASE}/tests/bluetooth/audio/mocks/src/bap_unicast_client.c
  ${ZEPHYR_BASE}/tests/bluetooth/audio/mocks/src/conn.c
  ${ZEPHYR_BASE}/tests/bluetooth/audio/mocks/src/gatt.c
  ${ZEPHYR_BASE}/tests/bluetooth/audio/mocks/src/iso.c
)
```

## Kconfig
```
# Copyright (c) 2025 Nordic Semiconductor ASA
# SPDX-License-Identifier: Apache-2.0

config BT_ATT_PREPARE_COUNT
	int
	default 1

config BT_AUDIO
	bool
	default y

config BT_BAP_UNICAST_CLIENT
	bool
	default y

config BT_BAP_UNICAST_CLIENT_GROUP_COUNT
	int
	default 1

config BT_BAP_UNICAST_CLIENT_GROUP_CIS_COUNT
	int
	default 4

config BT_BONDABLE
	bool
	default y

config BT_BUF_ACL_RX_SIZE
	int
	default 69

config BT_BUF_ACL_TX_COUNT
	int
	default 5

config BT_BUF_EVT_RX_COUNT
	int
	default 10

config BT_CONN
	bool
	default y

config BT_CSIP_SET_COORDINATOR
	bool
	default y

config BT_ISO_MAX_CIG
	int
	default 1

config BT_ISO_MAX_CHAN
	int
	default 4

config BT_MAX_PAIRED
	int
	default 1

config BT_L2CAP_TX_MTU
	int
	default 65

config BT_LOG
	bool
	default y

config BT_MAX_CONN
	int
	default 2

config BT_SMP
	bool
	default y

# Include Zephyr's Kconfig.
source "Kconfig"
source "subsys/bluetooth/audio/Kconfig"
source "subsys/bluetooth/Kconfig.logging"
```

## prj.conf
```kconfig
CONFIG_ZTEST=y

CONFIG_BT_CAP_INITIATOR=y

CONFIG_ASSERT=y

CONFIG_LOG=y
CONFIG_BT_BAP_STREAM_LOG_LEVEL_DBG=y
CONFIG_BT_CAP_COMMON_LOG_LEVEL_DBG=y
CONFIG_BT_CAP_INITIATOR_LOG_LEVEL_DBG=y
```

## src/main.c
```c
/* main.c - Application main entry point */

/*
 * Copyright (c) 2023-2024 Nordic Semiconductor ASA
 *
 * SPDX-License-Identifier: Apache-2.0
 */

#include <errno.h>
#include <stddef.h>
#include <stdlib.h>
#include <string.h>

#include <zephyr/autoconf.h>
#include <zephyr/bluetooth/audio/cap.h>
#include <zephyr/bluetooth/hci_types.h>
#include <zephyr/fff.h>
#include <zephyr/sys/util.h>
#include <zephyr/toolchain.h>
#include <zephyr/ztest_assert.h>
#include <zephyr/ztest_test.h>

#include "cap_initiator.h"
#include "conn.h"
#include "expects_util.h"
#include "test_common.h"

static void mock_init_rule_before(const struct ztest_unit_test *test, void *fixture)
{
	ARG_UNUSED(test);
	ARG_UNUSED(fixture);

	test_mocks_init();
}

static void mock_destroy_rule_after(const struct ztest_unit_test *test, void *fixture)
{
	ARG_UNUSED(test);
	ARG_UNUSED(fixture);

	test_mocks_cleanup();
}

ZTEST_RULE(mock_rule, mock_init_rule_before, mock_destroy_rule_after);

struct cap_initiator_test_suite_fixture {
	struct bt_conn conns[CONFIG_BT_MAX_CONN];
};

static void cap_initiator_test_suite_fixture_init(struct cap_initiator_test_suite_fixture *fixture)
{
	for (size_t i = 0U; i < ARRAY_SIZE(fixture->conns); i++) {
		test_conn_init(&fixture->conns[i], i);
	}
}

static void *cap_initiator_test_suite_setup(void)
{
	struct cap_initiator_test_suite_fixture *fixture;

	fixture = malloc(sizeof(*fixture));
	zassert_not_null(fixture);

	return fixture;
}

static void cap_initiator_test_suite_before(void *f)
{
	memset(f, 0, sizeof(struct cap_initiator_test_suite_fixture));
	cap_initiator_test_suite_fixture_init(f);
}

static void cap_initiator_test_suite_after(void *f)
{
	struct cap_initiator_test_suite_fixture *fixture = f;
	int err;

	err = bt_cap_initiator_unregister_cb(&mock_cap_initiator_cb);
	zassert_true(err == 0 || err == -EINVAL, "Unexpected error: %d", err);

	for (size_t i = 0U; i < ARRAY_SIZE(fixture->conns); i++) {
		mock_bt_conn_disconnected(&fixture->conns[i], BT_HCI_ERR_REMOTE_USER_TERM_CONN);
	}
}

static void cap_initiator_test_suite_teardown(void *f)
{
	free(f);
}

ZTEST_SUITE(cap_initiator_test_suite, NULL, cap_initiator_test_suite_setup,
	    cap_initiator_test_suite_before, cap_initiator_test_suite_after,
	    cap_initiator_test_suite_teardown);

ZTEST_F(cap_initiator_test_suite, test_initiator_register_cb)
{
	int err;

	err = bt_cap_initiator_register_cb(&mock_cap_initiator_cb);
	zassert_equal(0, err, "Unexpected return value %d", err);
}

ZTEST_F(cap_initiator_test_suite, test_initiator_register_cb_inval_param_null)
{
	int err;

	err = bt_cap_initiator_register_cb(NULL);
	zassert_equal(-EINVAL, err, "Unexpected return value %d", err);
}

ZTEST_F(cap_initiator_test_suite, test_initiator_register_cb_inval_double_register)
{
	int err;

	err = bt_cap_initiator_register_cb(&mock_cap_initiator_cb);
	zassert_equal(0, err, "Unexpected return value %d", err);

	err = bt_cap_initiator_register_cb(&mock_cap_initiator_cb);
	zassert_equal(-EALREADY, err, "Unexpected return value %d", err);
}

ZTEST_F(cap_initiator_test_suite, test_initiator_unregister_cb)
{
	int err;

	err = bt_cap_initiator_register_cb(&mock_cap_initiator_cb);
	zassert_equal(0, err, "Unexpected return value %d", err);

	err = bt_cap_initiator_unregister_cb(&mock_cap_initiator_cb);
	zassert_equal(0, err, "Unexpected return value %d", err);
}

ZTEST_F(cap_initiator_test_suite, test_initiator_unregister_cb_inval_param_null)
{
	int err;

	err = bt_cap_initiator_unregister_cb(NULL);
	zassert_equal(-EINVAL, err, "Unexpected return value %d", err);
}

ZTEST_F(cap_initiator_test_suite, test_initiator_unregister_cb_inval_double_unregister)
{
	int err;

	err = bt_cap_initiator_register_cb(&mock_cap_initiator_cb);
	zassert_equal(0, err, "Unexpected return value %d", err);

	err = bt_cap_initiator_unregister_cb(&mock_cap_initiator_cb);
	zassert_equal(0, err, "Unexpected return value %d", err);

	err = bt_cap_initiator_unregister_cb(&mock_cap_initiator_cb);
	zassert_equal(-EINVAL, err, "Unexpected return value %d", err);
}

ZTEST_F(cap_initiator_test_suite, test_initiator_discover)
{
	int err;

	err = bt_cap_initiator_register_cb(&mock_cap_initiator_cb);
	zassert_equal(0, err, "Unexpected return value %d", err);

	for (size_t i = 0U; i < ARRAY_SIZE(fixture->conns); i++) {
		err = bt_cap_initiator_unicast_discover(&fixture->conns[i]);
		zassert_equal(0, err, "Unexpected return value %d", err);
	}

	zexpect_call_count("bt_cap_initiator_cb.discovery_complete", ARRAY_SIZE(fixture->conns),
			   mock_cap_initiator_unicast_discovery_complete_cb_fake.call_count);
}

ZTEST_F(cap_initiator_test_suite, test_initiator_discover_inval_param_null)
{
	int err;

	err = bt_cap_initiator_register_cb(&mock_cap_initiator_cb);
	zassert_equal(0, err, "Unexpected return value %d", err);

	err = bt_cap_initiator_unicast_discover(NULL);
	zassert_equal(-EINVAL, err, "Unexpected return value %d", err);
}
```

## include/cap_initiator.h
```c
/*
 * Copyright (c) 2023-2024 Nordic Semiconductor ASA
 *
 * SPDX-License-Identifier: Apache-2.0
 */

#ifndef MOCKS_CAP_INITIATOR_H_
#define MOCKS_CAP_INITIATOR_H_
#include <stdint.h>

#include <zephyr/bluetooth/audio/cap.h>
#include <zephyr/bluetooth/audio/csip.h>
#include <zephyr/bluetooth/bluetooth.h>
#include <zephyr/fff.h>

extern const struct bt_cap_initiator_cb mock_cap_initiator_cb;

void mock_cap_initiator_init(void);
void mock_cap_initiator_cleanup(void);

DECLARE_FAKE_VOID_FUNC(mock_cap_initiator_unicast_discovery_complete_cb, struct bt_conn *, int,
		       const struct bt_csip_set_coordinator_set_member *,
		       const struct bt_csip_set_coordinator_csis_inst *);
DECLARE_FAKE_VOID_FUNC(mock_cap_initiator_unicast_start_complete_cb, int, struct bt_conn *);
DECLARE_FAKE_VOID_FUNC(mock_cap_initiator_unicast_start_codec_configured_cb);
DECLARE_FAKE_VOID_FUNC(mock_cap_initiator_unicast_start_qos_configured_cb);
DECLARE_FAKE_VOID_FUNC(mock_cap_initiator_unicast_start_enabled_cb);
DECLARE_FAKE_VOID_FUNC(mock_cap_initiator_unicast_start_connected_cb);
DECLARE_FAKE_VOID_FUNC(mock_cap_initiator_unicast_start_started_cb);
DECLARE_FAKE_VOID_FUNC(mock_cap_initiator_unicast_update_complete_cb, int, struct bt_conn *);
DECLARE_FAKE_VOID_FUNC(mock_cap_initiator_unicast_stop_complete_cb, int, struct bt_conn *);
DECLARE_FAKE_VOID_FUNC(mock_cap_initiator_unicast_stop_disabled_cb);
DECLARE_FAKE_VOID_FUNC(mock_cap_initiator_unicast_stop_stopped_cb);
DECLARE_FAKE_VOID_FUNC(mock_cap_initiator_unicast_stop_released_cb);
DECLARE_FAKE_VOID_FUNC(mock_cap_initiator_broadcast_started_cb, struct bt_cap_broadcast_source *);
DECLARE_FAKE_VOID_FUNC(mock_cap_initiator_broadcast_stopped_cb, struct bt_cap_broadcast_source *,
		       uint8_t);

#endif /* MOCKS_CAP_INITIATOR_H_ */
```

## include/test_common.h
```c
/* test_common.h */

/*
 * Copyright (c) 2024-2025 Nordic Semiconductor ASA
 *
 * SPDX-License-Identifier: Apache-2.0
 */
#include <stdint.h>

#include <zephyr/autoconf.h>
#include <zephyr/bluetooth/audio/audio.h>
#include <zephyr/bluetooth/audio/bap.h>
#include <zephyr/bluetooth/audio/bap_lc3_preset.h>
#include <zephyr/bluetooth/audio/cap.h>
#include <zephyr/bluetooth/conn.h>

#include "conn.h"

void test_mocks_init(void);
void test_mocks_cleanup(void);

void test_conn_init(struct bt_conn *conn, uint8_t index);

void test_unicast_set_state(struct bt_cap_stream *cap_stream, struct bt_conn *conn,
			    struct bt_bap_ep *ep, const struct bt_audio_codec_cfg *codec_cfg,
			    enum bt_bap_ep_state state);
void mock_discover(
	struct bt_conn conns[CONFIG_BT_MAX_CONN],
	struct bt_bap_ep *snk_eps[CONFIG_BT_MAX_CONN][CONFIG_BT_BAP_UNICAST_CLIENT_ASE_SNK_COUNT],
	struct bt_bap_ep *src_eps[CONFIG_BT_MAX_CONN][CONFIG_BT_BAP_UNICAST_CLIENT_ASE_SRC_COUNT]);
```

## src/test_common.c
```c
/* test_common.c - common procedures for unit test of CAP initiator */

/*
 * Copyright (c) 2024-2025 Nordic Semiconductor ASA
 *
 * SPDX-License-Identifier: Apache-2.0
 */

#include <stddef.h>
#include <stdint.h>
#include <string.h>

#include <zephyr/bluetooth/audio/audio.h>
#include <zephyr/bluetooth/audio/bap.h>
#include <zephyr/bluetooth/audio/bap_lc3_preset.h>
#include <zephyr/bluetooth/audio/cap.h>
#include <zephyr/bluetooth/conn.h>
#include <zephyr/bluetooth/hci_types.h>
#include <zephyr/fff.h>
#include <zephyr/sys/printk.h>
#include <zephyr/sys/util.h>
#include <zephyr/ztest_assert.h>

#include "audio/bap_endpoint.h"
#include "bap_unicast_client.h"
#include "cap_initiator.h"
#include "conn.h"
#include "expects_util.h"
#include "test_common.h"

DEFINE_FFF_GLOBALS;

void test_mocks_init(void)
{
	mock_cap_initiator_init();
	mock_bap_unicast_client_set_disable_err(NULL, 0);
}

void test_mocks_cleanup(void)
{
	mock_cap_initiator_cleanup();
}

void test_conn_init(struct bt_conn *conn, uint8_t index)
{
	conn->index = index;
	conn->info.type = BT_CONN_TYPE_LE;
	conn->info.role = BT_CONN_ROLE_CENTRAL;
	conn->info.state = BT_CONN_STATE_CONNECTED;
	conn->info.security.level = BT_SECURITY_L2;
	conn->info.security.enc_key_size = BT_ENC_KEY_SIZE_MAX;
	conn->info.security.flags = BT_SECURITY_FLAG_OOB | BT_SECURITY_FLAG_SC;
}

void test_unicast_set_state(struct bt_cap_stream *cap_stream, struct bt_conn *conn,
			    struct bt_bap_ep *ep, const struct bt_audio_codec_cfg *codec_cfg,
			    enum bt_bap_ep_state state)
{
	struct bt_bap_stream *bap_stream = &cap_stream->bap_stream;
	int err;

	printk("Setting stream %p to state %d\n", bap_stream, state);

	if (state == BT_BAP_EP_STATE_IDLE) {
		return;
	}

	zassert_not_null(cap_stream);
	zassert_not_null(conn);
	zassert_not_null(ep);
	zassert_not_null(codec_cfg);

	err = bt_bap_stream_config(conn, &cap_stream->bap_stream, ep, codec_cfg);
	zassert_equal(err, 0, "Unexpected return value %d", err);

	/* Verify that the codec config data was updated */
	zassert_true(util_eq(codec_cfg->data, codec_cfg->data_len, bap_stream->codec_cfg->data,
			     bap_stream->codec_cfg->data_len));

	if (state > BT_BAP_EP_STATE_CODEC_CONFIGURED) {
		err = bt_bap_unicast_client_qos_from_group(bap_stream, &bap_stream->ep->qos);
		zassert_equal(err, 0, "Unexpected return value %d", err);
		bap_stream->qos = &bap_stream->ep->qos;
	}

	if (state > BT_BAP_EP_STATE_ENABLING) {
		zassert_true(codec_cfg->meta_len <= CONFIG_BT_AUDIO_CODEC_CFG_MAX_METADATA_SIZE,
			     "codec_cfg metadata too large: %u > %d", codec_cfg->meta_len,
			     CONFIG_BT_AUDIO_CODEC_CFG_MAX_METADATA_SIZE);

		(void)memcpy(bap_stream->ep->codec_cfg.meta, codec_cfg->meta, codec_cfg->meta_len);
		bap_stream->ep->codec_cfg.meta_len = codec_cfg->meta_len;
	}

	bap_stream->ep->state = state;
}

DECLARE_FAKE_VOID_FUNC(mock_bap_discover_endpoint, struct bt_conn *, enum bt_audio_dir,
		       struct bt_bap_ep *);
DEFINE_FAKE_VOID_FUNC(mock_bap_discover_endpoint, struct bt_conn *, enum bt_audio_dir,
		      struct bt_bap_ep *);

void mock_discover(
	struct bt_conn conns[CONFIG_BT_MAX_CONN],
	struct bt_bap_ep *snk_eps[CONFIG_BT_MAX_CONN][CONFIG_BT_BAP_UNICAST_CLIENT_ASE_SNK_COUNT],
	struct bt_bap_ep *src_eps[CONFIG_BT_MAX_CONN][CONFIG_BT_BAP_UNICAST_CLIENT_ASE_SRC_COUNT])
{
	struct bt_bap_unicast_client_cb unicast_client_cb = {
		.endpoint = mock_bap_discover_endpoint,
	};
	int err;

	err = bt_bap_unicast_client_register_cb(&unicast_client_cb);
	zassert_equal(0, err, "Unexpected return value %d", err);

	for (int i = 0U; i < CONFIG_BT_MAX_CONN; i++) {
		RESET_FAKE(mock_bap_discover_endpoint);
		err = bt_bap_unicast_client_discover(&conns[i], BT_AUDIO_DIR_SINK);
		zassert_equal(0, err, "Unexpected return value %d", err);

		/* TODO: use callback to populate eps */

		zexpect_call_count("unicast_client_cb.bap_discover_endpoint",
				   CONFIG_BT_BAP_UNICAST_CLIENT_ASE_SNK_COUNT,
				   mock_bap_discover_endpoint_fake.call_count);
		for (size_t j = 0U; j < mock_bap_discover_endpoint_fake.call_count; j++) {
			/* Verify conn */
			zassert_equal(mock_bap_discover_endpoint_fake.arg0_history[j], &conns[i],
				      "%p", mock_bap_discover_endpoint_fake.arg0_history[j]);

			/* Verify dir */
			zassert_equal(mock_bap_discover_endpoint_fake.arg1_history[j],
				      BT_AUDIO_DIR_SINK, "%d",
				      mock_bap_discover_endpoint_fake.arg1_history[j]);

			/* Verify and store ep */
			zassert_not_equal(mock_bap_discover_endpoint_fake.arg2_history[j], NULL,
					  "%p", mock_bap_discover_endpoint_fake.arg2_history[j]);

			snk_eps[conns[i].index][j] =
				mock_bap_discover_endpoint_fake.arg2_history[j];
		}

		RESET_FAKE(mock_bap_discover_endpoint);
		err = bt_bap_unicast_client_discover(&conns[i], BT_AUDIO_DIR_SOURCE);
		zassert_equal(0, err, "Unexpected return value %d", err);

		zexpect_call_count("unicast_client_cb.bap_discover_endpoint",
				   CONFIG_BT_BAP_UNICAST_CLIENT_ASE_SRC_COUNT,
				   mock_bap_discover_endpoint_fake.call_count);
		for (size_t j = 0U; j < mock_bap_discover_endpoint_fake.call_count; j++) {
			/* Verify conn */
			zassert_equal(mock_bap_discover_endpoint_fake.arg0_history[j], &conns[i],
				      "%p", mock_bap_discover_endpoint_fake.arg0_history[j]);

			/* Verify dir */
			zassert_equal(mock_bap_discover_endpoint_fake.arg1_history[j],
				      BT_AUDIO_DIR_SOURCE, "%d",
				      mock_bap_discover_endpoint_fake.arg1_history[j]);

			/* Verify and store ep */
			zassert_not_equal(mock_bap_discover_endpoint_fake.arg2_history[j], NULL,
					  "%p", mock_bap_discover_endpoint_fake.arg2_history[j]);

			src_eps[conns[i].index][j] =
				mock_bap_discover_endpoint_fake.arg2_history[j];
		}
	}

	/* We don't need the callbacks anymore */
	err = bt_bap_unicast_client_unregister_cb(&unicast_client_cb);
	zassert_equal(0, err, "Unexpected return value %d", err);
}
```

## src/test_unicast_group.c
```c
/* test_unicast_group.c - unit test for unicast group functions */

/*
 * Copyright (c) 2025 Nordic Semiconductor ASA
 *
 * SPDX-License-Identifier: Apache-2.0
 */

#include <errno.h>
#include <stdbool.h>
#include <stddef.h>
#include <stdlib.h>
#include <string.h>

#include <zephyr/autoconf.h>
#include <zephyr/bluetooth/audio/audio.h>
#include <zephyr/bluetooth/audio/bap.h>
#include <zephyr/bluetooth/audio/bap_lc3_preset.h>
#include <zephyr/bluetooth/audio/cap.h>
#include <zephyr/bluetooth/hci_types.h>
#include <zephyr/bluetooth/iso.h>
#include <zephyr/fff.h>
#include <zephyr/sys/slist.h>
#include <zephyr/sys/util.h>
#include <zephyr/sys/util_macro.h>
#include <zephyr/toolchain.h>
#include <zephyr/ztest_assert.h>
#include <zephyr/ztest_test.h>
#include <sys/errno.h>

#include "audio/bap_endpoint.h"
#include "test_common.h"

BUILD_ASSERT(CONFIG_BT_BAP_UNICAST_CLIENT_GROUP_CIS_COUNT % 2 == 0,
	     "Tests expect an even number of streams");

struct cap_initiator_test_unicast_group_fixture {
	struct bt_cap_unicast_group_param *group_param;
	struct bt_cap_unicast_group *unicast_group;
	struct bt_bap_qos_cfg *qos_cfg;
	void *cap_streams;
};

static void *cap_initiator_test_unicast_group_setup(void)
{
	struct cap_initiator_test_unicast_group_fixture *fixture;

	fixture = malloc(sizeof(*fixture));
	zassert_not_null(fixture);

	return fixture;
}

static void cap_initiator_test_unicast_group_before(void *f)
{
	const size_t max_pair_params =
		(size_t)(CONFIG_BT_BAP_UNICAST_CLIENT_GROUP_CIS_COUNT / 2);
	struct cap_initiator_test_unicast_group_fixture *fixture = f;
	struct bt_cap_unicast_group_stream_pair_param *pair_params;
	struct bt_cap_unicast_group_stream_param *stream_params;
	struct bt_cap_stream *cap_streams;
	size_t pair_cnt = 0U;
	size_t pair_idx = 0U;
	size_t str_cnt = 0U;

	memset(f, 0, sizeof(struct cap_initiator_test_unicast_group_fixture));

	fixture->group_param = calloc(sizeof(struct bt_cap_unicast_group_param), 1);
	zassert_not_null(fixture->group_param);
	pair_params =
		calloc(sizeof(struct bt_cap_unicast_group_stream_pair_param), max_pair_params);
	zassert_not_null(pair_params);
	stream_params = calloc(sizeof(struct bt_cap_unicast_group_stream_param),
			       CONFIG_BT_BAP_UNICAST_CLIENT_GROUP_CIS_COUNT);
	zassert_not_null(stream_params);
	cap_streams =
		calloc(sizeof(struct bt_cap_stream), CONFIG_BT_BAP_UNICAST_CLIENT_GROUP_CIS_COUNT);
	zassert_not_null(cap_streams);
	fixture->qos_cfg = calloc(sizeof(struct bt_bap_qos_cfg), 1);
	zassert_not_null(fixture->qos_cfg);

	*fixture->qos_cfg = BT_BAP_QOS_CFG_UNFRAMED(10000u, 40u, 2u, 10u, 40000u); /* 16_2_1 */

	while (str_cnt < CONFIG_BT_BAP_UNICAST_CLIENT_GROUP_CIS_COUNT &&
	       pair_cnt < max_pair_params) {
		stream_params[str_cnt].stream = &cap_streams[str_cnt];
		stream_params[str_cnt].qos_cfg = fixture->qos_cfg;

		if (IS_ENABLED(CONFIG_BT_BAP_UNICAST_CLIENT_ASE_SNK) &&
		    IS_ENABLED(CONFIG_BT_BAP_UNICAST_CLIENT_ASE_SRC)) {
			if (str_cnt & 1) {
				pair_params[pair_idx].tx_param = &stream_params[str_cnt];
			} else {
				pair_params[pair_idx].rx_param = &stream_params[str_cnt];
			}

			str_cnt++;
			pair_idx = str_cnt / 2U;
			pair_cnt = DIV_ROUND_UP(str_cnt, 2U);
		} else if (IS_ENABLED(CONFIG_BT_BAP_UNICAST_CLIENT_ASE_SNK)) {
			pair_params[pair_cnt].tx_param = &stream_params[str_cnt];
			str_cnt++;
			pair_idx++;
			pair_cnt++;
		} else { /* CONFIG_BT_BAP_UNICAST_CLIENT_ASE_SRC */
			pair_params[pair_cnt].rx_param = &stream_params[str_cnt];
			str_cnt++;
			pair_idx++;
			pair_cnt++;
		}
	}

	fixture->cap_streams = cap_streams;
	fixture->group_param->packing = BT_ISO_PACKING_SEQUENTIAL;
	fixture->group_param->params_count = pair_cnt;
	fixture->group_param->params = pair_params;
}

static void cap_initiator_test_unicast_group_after(void *f)
{
	struct cap_initiator_test_unicast_group_fixture *fixture = f;
	struct bt_cap_unicast_group_param *group_param;
	int err;

	/* In the case of a test failing, we delete the group so that subsequent tests won't fail */
	if (fixture->unicast_group != NULL) {
		err = bt_cap_unicast_group_delete(fixture->unicast_group);
		if (err != 0) {
			printk("Failed to delete unicast group (err %d)\n", err);
		}
	}

	group_param = fixture->group_param;

	free(fixture->cap_streams);
	/* rx_param and tx_param point to the same allocated array, so only free one of them */
	if (group_param->params[0].rx_param != NULL) {
		free(group_param->params[0].rx_param);
	} else if (group_param->params[0].tx_param != NULL) {
		free(group_param->params[0].tx_param);
	}
	free(group_param->params);
	free(group_param);
	free(fixture->qos_cfg);
}

static void cap_initiator_test_unicast_group_teardown(void *f)
{
	free(f);
}

ZTEST_SUITE(cap_initiator_test_unicast_group, NULL, cap_initiator_test_unicast_group_setup,
	    cap_initiator_test_unicast_group_before, cap_initiator_test_unicast_group_after,
	    cap_initiator_test_unicast_group_teardown);

static ZTEST_F(cap_initiator_test_unicast_group, test_initiator_unicast_group_create)
{
	int err = 0;

	err = bt_cap_unicast_group_create(fixture->group_param, &fixture->unicast_group);
	zassert_equal(err, 0, "Unexpected return value %d", err);

	err = bt_cap_unicast_group_delete(fixture->unicast_group);
	zassert_equal(err, 0, "Unexpected return value %d", err);
}

static ZTEST_F(cap_initiator_test_unicast_group,
	       test_initiator_unicast_group_create_inval_null_param)
{
	int err = 0;

	err = bt_cap_unicast_group_create(NULL, &fixture->unicast_group);
	zassert_equal(err, -EINVAL, "Unexpected return value %d", err);
}

static ZTEST_F(cap_initiator_test_unicast_group,
	       test_initiator_unicast_group_create_inval_null_rx_stream)
{
	int err = 0;

	if (!IS_ENABLED(CONFIG_BT_BAP_UNICAST_CLIENT_ASE_SRC)) {
		ztest_test_skip();
	}

	if (fixture->group_param->params[0].rx_param->stream == NULL) {
		ztest_test_skip();
	}
	fixture->group_param->params[0].rx_param->stream = NULL;

	err = bt_cap_unicast_group_create(fixture->group_param, &fixture->unicast_group);
	zassert_equal(err, -EINVAL, "Unexpected return value %d", err);
}

static ZTEST_F(cap_initiator_test_unicast_group,
	       test_initiator_unicast_group_create_inval_null_tx_stream)
{
	int err = 0;

	if (!IS_ENABLED(CONFIG_BT_BAP_UNICAST_CLIENT_ASE_SNK)) {
		ztest_test_skip();
	}

	if (fixture->group_param->params[0].tx_param->stream == NULL) {
		ztest_test_skip();
	}
	fixture->group_param->params[0].tx_param->stream = NULL;

	err = bt_cap_unicast_group_create(fixture->group_param, &fixture->unicast_group);
	zassert_equal(err, -EINVAL, "Unexpected return value %d", err);
}

static ZTEST_F(cap_initiator_test_unicast_group,
	       test_initiator_unicast_group_create_inval_too_many_streams)
{
	int err = 0;

	fixture->group_param->params_count = CONFIG_BT_BAP_UNICAST_CLIENT_GROUP_CIS_COUNT + 1;

	err = bt_cap_unicast_group_create(fixture->group_param, &fixture->unicast_group);
	zassert_equal(err, -EINVAL, "Unexpected return value %d", err);
}

static ZTEST_F(cap_initiator_test_unicast_group, test_initiator_unicast_group_reconfig)
{
	int err = 0;

	err = bt_cap_unicast_group_create(fixture->group_param, &fixture->unicast_group);
	zassert_equal(err, 0, "Unexpected return value %d", err);

	err = bt_cap_unicast_group_reconfig(fixture->unicast_group, fixture->group_param);
	zassert_equal(err, 0, "Unexpected return value %d", err);

	err = bt_cap_unicast_group_delete(fixture->unicast_group);
	zassert_equal(err, 0, "Unexpected return value %d", err);
}

static ZTEST_F(cap_initiator_test_unicast_group,
	       test_initiator_unicast_group_reconfig_inval_null_group)
{
	int err = 0;

	err = bt_cap_unicast_group_create(fixture->group_param, &fixture->unicast_group);
	zassert_equal(err, 0, "Unexpected return value %d", err);

	err = bt_cap_unicast_group_reconfig(NULL, fixture->group_param);
	zassert_equal(err, -EINVAL, "Unexpected return value %d", err);
}

static ZTEST_F(cap_initiator_test_unicast_group,
	       test_initiator_unicast_group_reconfig_inval_null_param)
{
	int err = 0;

	err = bt_cap_unicast_group_create(fixture->group_param, &fixture->unicast_group);
	zassert_equal(err, 0, "Unexpected return value %d", err);

	err = bt_cap_unicast_group_reconfig(fixture->unicast_group, NULL);
	zassert_equal(err, -EINVAL, "Unexpected return value %d", err);
}

static ZTEST_F(cap_initiator_test_unicast_group, test_initiator_unicast_group_add_streams)
{
	struct bt_cap_stream stream = {0};
	struct bt_cap_unicast_group_stream_param stream_param = {
		.stream = &stream,
		.qos_cfg = fixture->qos_cfg,
	};
	const struct bt_cap_unicast_group_stream_pair_param pair_param = {
		.rx_param = &stream_param,
	};
	int err = 0;

	if (!IS_ENABLED(CONFIG_BT_BAP_UNICAST_CLIENT_ASE_SRC)) {
		ztest_test_skip();
	}

	err = bt_cap_unicast_group_create(fixture->group_param, &fixture->unicast_group);
	zassert_equal(err, 0, "Unexpected return value %d", err);

	err = bt_cap_unicast_group_add_streams(fixture->unicast_group, &pair_param, 1);
	zassert_equal(err, 0, "Unexpected return value %d", err);

	err = bt_cap_unicast_group_delete(fixture->unicast_group);
	zassert_equal(err, 0, "Unexpected return value %d", err);
}

static ZTEST_F(cap_initiator_test_unicast_group,
	       test_initiator_unicast_group_add_streams_inval_null_group)
{
	struct bt_cap_stream stream = {0};
	struct bt_cap_unicast_group_stream_param stream_param = {
		.stream = &stream,
		.qos_cfg = fixture->qos_cfg,
	};
	const struct bt_cap_unicast_group_stream_pair_param pair_param = {
		.rx_param = &stream_param,
	};
	int err = 0;

	err = bt_cap_unicast_group_create(fixture->group_param, &fixture->unicast_group);
	zassert_equal(err, 0, "Unexpected return value %d", err);

	err = bt_cap_unicast_group_add_streams(NULL, &pair_param, 1);
	zassert_equal(err, -EINVAL, "Unexpected return value %d", err);
}

static ZTEST_F(cap_initiator_test_unicast_group,
	       test_initiator_unicast_group_add_streams_inval_null_param)
{
	int err = 0;

	err = bt_cap_unicast_group_create(fixture->group_param, &fixture->unicast_group);
	zassert_equal(err, 0, "Unexpected return value %d", err);

	err = bt_cap_unicast_group_add_streams(fixture->unicast_group, NULL, 1);
	zassert_equal(err, -EINVAL, "Unexpected return value %d", err);
}

static ZTEST_F(cap_initiator_test_unicast_group,
	       test_initiator_unicast_group_add_streams_inval_0_param)
{
	struct bt_cap_stream stream = {0};
	struct bt_cap_unicast_group_stream_param stream_param = {
		.stream = &stream,
		.qos_cfg = fixture->qos_cfg,
	};
	const struct bt_cap_unicast_group_stream_pair_param pair_param = {
		.rx_param = &stream_param,
	};
	int err = 0;

	err = bt_cap_unicast_group_create(fixture->group_param, &fixture->unicast_group);
	zassert_equal(err, 0, "Unexpected return value %d", err);

	err = bt_cap_unicast_group_add_streams(fixture->unicast_group, &pair_param, 0);
	zassert_equal(err, -EINVAL, "Unexpected return value %d", err);
}

static ZTEST_F(cap_initiator_test_unicast_group, test_initiator_unicast_group_delete)
{
	int err = 0;

	err = bt_cap_unicast_group_create(fixture->group_param, &fixture->unicast_group);
	zassert_equal(err, 0, "Unexpected return value %d", err);

	err = bt_cap_unicast_group_delete(fixture->unicast_group);
	zassert_equal(err, 0, "Unexpected return value %d", err);
	fixture->unicast_group = NULL;
}

static ZTEST_F(cap_initiator_test_unicast_group,
	       test_initiator_unicast_group_delete_inval_null_group)
{
	int err = 0;

	err = bt_cap_unicast_group_create(fixture->group_param, &fixture->unicast_group);
	zassert_equal(err, 0, "Unexpected return value %d", err);

	err = bt_cap_unicast_group_delete(NULL);
	zassert_equal(err, -EINVAL, "Unexpected return value %d", err);
}

static ZTEST_F(cap_initiator_test_unicast_group,
	       test_initiator_unicast_group_delete_inval_double_delete)
{
	int err = 0;

	err = bt_cap_unicast_group_create(fixture->group_param, &fixture->unicast_group);
	zassert_equal(err, 0, "Unexpected return value %d", err);

	err = bt_cap_unicast_group_delete(fixture->unicast_group);
	zassert_equal(err, 0, "Unexpected return value %d", err);

	err = bt_cap_unicast_group_delete(fixture->unicast_group);
	zassert_equal(err, -EINVAL, "Unexpected return value %d", err);
	fixture->unicast_group = NULL;
}

static bool unicast_group_foreach_stream_cb(struct bt_cap_stream *cap_stream, void *user_data)
{
	size_t *cnt = user_data;

	ARG_UNUSED(cap_stream);

	(*cnt)++;

	return true;
}

static ZTEST_F(cap_initiator_test_unicast_group, test_initiator_unicast_group_foreach_stream)
{
	size_t expect_cnt = 0U;
	size_t cnt = 0U;
	int err;

	err = bt_cap_unicast_group_create(fixture->group_param, &fixture->unicast_group);
	zassert_equal(err, 0, "Unexpected return value %d", err);

	err = bt_cap_unicast_group_foreach_stream(fixture->unicast_group,
						  unicast_group_foreach_stream_cb, &cnt);
	zassert_equal(err, 0, "Unexpected return value %d", err);

	for (size_t i = 0U; i < fixture->group_param->params_count; i++) {
		if (fixture->group_param->params[i].rx_param != NULL) {
			expect_cnt++;
		}

		if (fixture->group_param->params[i].tx_param != NULL) {
			expect_cnt++;
		}
	}

	zassert_equal(cnt, expect_cnt, "Unexpected cnt (%zu != %zu)", cnt, expect_cnt);
}

static bool unicast_group_foreach_stream_return_early_cb(struct bt_cap_stream *stream,
							 void *user_data)
{
	size_t *cnt = user_data;

	ARG_UNUSED(stream);

	(*cnt)++;

	return false;
}

static ZTEST_F(cap_initiator_test_unicast_group,
	       test_initiator_unicast_group_foreach_stream_return_early)
{
	size_t cnt = 0U;
	int err;

	err = bt_cap_unicast_group_create(fixture->group_param, &fixture->unicast_group);
	zassert_equal(err, 0, "Unexpected return value %d", err);

	err = bt_cap_unicast_group_foreach_stream(
		fixture->unicast_group, unicast_group_foreach_stream_return_early_cb, &cnt);
	zassert_equal(err, -ECANCELED, "Unexpected return value: %d", err);
	zassert_equal(cnt, 1U, "Got %zu, expected %u", cnt, 1U);
}

static ZTEST_F(cap_initiator_test_unicast_group,
	       test_initiator_unicast_group_foreach_stream_inval_null_group)
{
	size_t expect_cnt = 0U;
	size_t cnt = 0U;
	int err;

	err = bt_cap_unicast_group_create(fixture->group_param, &fixture->unicast_group);
	zassert_equal(err, 0, "Unexpected return value %d", err);

	err = bt_cap_unicast_group_foreach_stream(NULL, unicast_group_foreach_stream_cb, &cnt);
	zassert_equal(err, -EINVAL, "Unexpected return value %d", err);

	zassert_equal(cnt, expect_cnt, "Unexpected cnt (%zu != %zu)", cnt, expect_cnt);
}

static ZTEST_F(cap_initiator_test_unicast_group,
	       test_initiator_unicast_group_foreach_stream_inval_null_func)
{
	size_t expect_cnt = 0U;
	size_t cnt = 0U;
	int err;

	err = bt_cap_unicast_group_create(fixture->group_param, &fixture->unicast_group);
	zassert_equal(err, 0, "Unexpected return value %d", err);

	err = bt_cap_unicast_group_foreach_stream(fixture->unicast_group, NULL, &cnt);
	zassert_equal(err, -EINVAL, "Unexpected return value %d", err);

	zassert_equal(cnt, expect_cnt, "Unexpected cnt (%zu != %zu)", cnt, expect_cnt);
}

static ZTEST_F(cap_initiator_test_unicast_group, test_initiator_unicast_group_get_info)
{
	struct bt_cap_unicast_group_info cap_info;
	int err;

	err = bt_cap_unicast_group_create(fixture->group_param, &fixture->unicast_group);
	zassert_equal(err, 0, "Unexpected return value %d", err);

	err = bt_cap_unicast_group_get_info(fixture->unicast_group, &cap_info);
	zassert_equal(err, 0, "Unexpected return value %d", err);

	zassert_not_null(cap_info.unicast_group);
}

static ZTEST_F(cap_initiator_test_unicast_group,
	       test_initiator_unicast_group_get_info_inval_null_group)
{
	struct bt_cap_unicast_group_info cap_info;
	int err;

	err = bt_cap_unicast_group_get_info(NULL, &cap_info);
	zassert_equal(err, -EINVAL, "Unexpected return value %d", err);
}

static ZTEST_F(cap_initiator_test_unicast_group,
	       test_initiator_unicast_group_get_info_inval_null_info)
{
	int err;

	err = bt_cap_unicast_group_create(fixture->group_param, &fixture->unicast_group);
	zassert_equal(err, 0, "Unexpected return value %d", err);

	err = bt_cap_unicast_group_get_info(fixture->unicast_group, NULL);
	zassert_equal(err, -EINVAL, "Unexpected return value %d", err);
}
```
