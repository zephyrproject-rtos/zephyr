/*
 * Copyright (c) 2026 Silicon Laboratories Inc.
 *
 * SPDX-License-Identifier: Apache-2.0
 */

/ {
	chosen {
		zephyr,bt-hci = &bt_hci_test;
		zephyr,bt-mon-uart = &bt_mon_uart;
	};

	bt_hci_test: bt_hci_test {
		compatible = "zephyr,bt-hci-test";
		status = "okay";
	};

	/* Capture buffer deliberately smaller than the monitor ring buffer
	 * so that overflow tests exercise the buffer-full handling.
	 */
	bt_mon_uart: bt_mon_uart {
		compatible = "vnd,serial";
		status = "okay";
		buffer-size = <64>;
	};
};
