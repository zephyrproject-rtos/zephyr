/*
 * Copyright 2023 NXP
 *
 * SPDX-License-Identifier: Apache-2.0
 */

/ {
	chosen {
		zephyr,bt-hci = &bt_hci_uart;
	};
};

&lpuart3 {
	status = "okay";
	current-speed = <3000000>;
	hw-flow-control;

	bt_hci_uart: bt_hci_uart {
		compatible = "zephyr,bt-hci-uart";
		status = "okay";
	};
};
