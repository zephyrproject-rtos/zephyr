/*
 * Copyright (c) 2026 Nordic Semiconductor ASA
 * SPDX-License-Identifier: Apache-2.0
 */

/ {
	chosen {
		zephyr,bt-hci = &bt_hci_test;
	};

	bt_hci_test: bt_hci_test {
		compatible = "zephyr,bt-hci-test";
		status = "okay";
	};
};
