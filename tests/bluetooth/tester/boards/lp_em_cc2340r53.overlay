/*
 * BTP tester overlay for TI LP_EM_CC2340R53
 *
 * The CC2340R53 has only one UART (uart0). It must be used exclusively
 * for BTP (uart-pipe). Console output MUST be disabled in Kconfig to
 * prevent text from corrupting the BTP binary protocol stream.
 *
 * Do NOT assign zephyr,console or zephyr,shell-uart here — the console
 * subsystem is disabled via the board .conf file.
 */

/ {
       chosen {
               zephyr,uart-pipe = &uart0;
               /delete-property/ zephyr,console;
               /delete-property/ zephyr,shell-uart;
       };
};