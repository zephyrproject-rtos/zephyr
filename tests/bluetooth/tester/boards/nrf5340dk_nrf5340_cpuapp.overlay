/* SPDX-License-Identifier: Apache-2.0 */

/ {
	chosen {
		zephyr,uart-pipe = &uart0;
	};
};

&uart0 {
	compatible = "nordic,nrf-uarte";
	current-speed = <115200>;
	hw-flow-control;
	status = "okay";
};
