## tests/bluetooth/tester/boards/nucleo_wba55cg.conf
```kconfig
CONFIG_CONSOLE=n

CONFIG_BT_HCI_TX_STACK_SIZE_WITH_PROMPT=y
# TODO: Investigation to be done to optimize this value
CONFIG_BT_HCI_TX_STACK_SIZE=4096
```

## tests/bluetooth/tester/boards/panb511evb_nrf54l15_cpuapp.conf
```kconfig
# CONFIG_TEST enforces minimal logging, which we don't want
CONFIG_TEST=n

CONFIG_ASSERT=y
# Enable the option below to measure stack usage
#CONFIG_INIT_STACKS=y
CONFIG_THREAD_NAME=y
CONFIG_HW_STACK_PROTECTION=y

CONFIG_LOG=y
CONFIG_LOG_BUFFER_SIZE=4096
CONFIG_RTT_CONSOLE=y
CONFIG_LOG_BACKEND_RTT=y
CONFIG_LOG_BACKEND_RTT_MODE_DROP=y
CONFIG_LOG_BACKEND_RTT_MESSAGE_SIZE=256
CONFIG_USE_SEGGER_RTT=y
CONFIG_SEGGER_RTT_BUFFER_SIZE_UP=4096
CONFIG_LOG_BACKEND_SHOW_COLOR=n
CONFIG_LOG_PROCESS_THREAD_STACK_SIZE=1024

CONFIG_LOG_DEFAULT_LEVEL=3
CONFIG_BTTESTER_LOG_LEVEL_DBG=y

CONFIG_UART_INTERRUPT_DRIVEN=y
```

## tests/bluetooth/tester/boards/qemu_cortex_m3.conf
```kconfig
CONFIG_INIT_STACKS=y
CONFIG_PRINTK=y
CONFIG_LOG=y
CONFIG_BT_HCI_CORE_LOG_LEVEL_DBG=y
CONFIG_BT_CONN_LOG_LEVEL_DBG=y
CONFIG_BT_L2CAP_LOG_LEVEL_DBG=y
CONFIG_BT_SMP_LOG_LEVEL_DBG=y
CONFIG_BT_ATT_LOG_LEVEL_DBG=y
CONFIG_BT_GATT_LOG_LEVEL_DBG=y
```

## tests/bluetooth/tester/boards/rd_rw612_bga.conf
```kconfig
CONFIG_BT_MAX_CONN=16
CONFIG_BT_BUF_ACL_RX_COUNT=17
CONFIG_ENTROPY_GENERATOR=y

# debug options
# CONFIG_UART_CONSOLE=y
# CONFIG_LOG=y
# CONFIG_LOG_DEFAULT_LEVEL=4
```

## tests/bluetooth/tester/sysbuild/hci_ipc/boards/nrf54h20dk_nrf54h20_cpurad.conf
```kconfig
CONFIG_IPC_SERVICE=y
CONFIG_MBOX=y

CONFIG_ISR_STACK_SIZE=1024
CONFIG_IDLE_STACK_SIZE=256
CONFIG_MAIN_STACK_SIZE=1024
CONFIG_SYSTEM_WORKQUEUE_STACK_SIZE=512
CONFIG_IPC_SERVICE_BACKEND_RPMSG_WQ_STACK_SIZE=512
CONFIG_HEAP_MEM_POOL_SIZE=8192

CONFIG_BT=y
CONFIG_BT_HCI_RAW=y

CONFIG_BT_BUF_EVT_RX_COUNT=16
CONFIG_BT_BUF_EVT_RX_SIZE=255
CONFIG_BT_BUF_ACL_RX_SIZE=255
CONFIG_BT_BUF_ACL_TX_SIZE=251
CONFIG_BT_BUF_CMD_TX_SIZE=255

# Host
CONFIG_BT_BROADCASTER=y
CONFIG_BT_PERIPHERAL=y
CONFIG_BT_OBSERVER=y
CONFIG_BT_CENTRAL=y
CONFIG_BT_EXT_ADV=y
CONFIG_BT_PER_ADV=y
CONFIG_BT_PER_ADV_SYNC=y

# Controller
CONFIG_BT_LL_SW_SPLIT=n
CONFIG_BT_LL_SOFTDEVICE=y
CONFIG_BT_CTLR_DATA_LENGTH_MAX=251
CONFIG_BT_CTLR_SCAN_DATA_LEN_MAX=191

# Enable PSA RNG
CONFIG_PSA_CRYPTO_DRIVER_OBERON=n
CONFIG_PSA_SSF_CRYPTO_CLIENT=y
CONFIG_SSF_PSA_CRYPTO_SERVICE_ENABLED=y
CONFIG_MBEDTLS_PSA_CRYPTO_C=y
CONFIG_NRF_SECURITY=y
```

## tests/bluetooth/tester/testcase.yaml
```yaml
common:
  build_only: true
  tags: bluetooth

tests:
  bluetooth.general.tester:
    build_only: true
    platform_allow:
      - qemu_x86
      - native_sim
      - nrf52840dk/nrf52840
    tags: bluetooth
    harness: bluetooth
  bluetooth.general.tester_bsim:
    platform_allow:
      - nrf52_bsim/native
    harness: bsim
    harness_config:
      bsim_exe_name: tests_bluetooth_tester_prj_conf
    extra_args:
      - EXTRA_CONF_FILE="overlay-bt_ll_sw_split.conf"
  bluetooth.general.tester.nxp:
    # Disabling monolithic since CI environment doesn't use blobs
    build_only: true
    harness: bluetooth
    platform_allow:
      - rd_rw612_bga
      - frdm_rw612
    extra_configs:
      - CONFIG_NXP_MONOLITHIC_NBU=n
  bluetooth.general.tester_hci_ipc:
    build_only: true
    harness: bluetooth
    platform_allow:
      - qemu_x86
      - native_sim
      - nrf5340dk/nrf5340/cpuapp
    integration_platforms:
      - nrf5340dk/nrf5340/cpuapp
    tags: bluetooth
    sysbuild: true
  bluetooth.general.tester_hci_ipc_bsim:
    platform_allow:
      - nrf5340bsim/nrf5340/cpuapp
    harness: bsim
    harness_config:
      bsim_exe_name: tests_bluetooth_tester_prj_conf
    sysbuild: true
  bluetooth.general.tester_le_audio:
    build_only: true
    platform_allow:
      - qemu_x86
      - native_sim
      - nrf5340dk/nrf5340/cpuapp
      - nrf5340_audio_dk/nrf5340/cpuapp
    integration_platforms:
      - nrf5340dk/nrf5340/cpuapp
      - nrf5340_audio_dk/nrf5340/cpuapp
    extra_args:
      - EXTRA_CONF_FILE="overlay-le-audio.conf"
    tags: bluetooth
    harness: bluetooth
    sysbuild: true
  bluetooth.general.tester_le_audio_bsim:
    build_only: true
    platform_allow:
      - nrf52_bsim/native
      - nrf5340bsim/nrf5340/cpuapp
    extra_args:
      - EXTRA_CONF_FILE="overlay-le-audio.conf"
    harness: bsim
    harness_config:
      bsim_exe_name: tests_bluetooth_tester_le_audio_prj_conf
    sysbuild: true
  bluetooth.general.tester_mesh:
    build_only: true
    platform_allow:
      - qemu_x86
      - native_sim
      - nrf52840dk/nrf52840
    extra_args: EXTRA_CONF_FILE="overlay-mesh.conf"
    tags: bluetooth
    harness: bluetooth
  bluetooth.general.tester.legacy_adv:
    build_only: true
    platform_allow:
      - qemu_x86
      - native_sim
      - nrf52840dk/nrf52840
    extra_configs:
      - CONFIG_BT_EXT_ADV=n
    tags: bluetooth
    harness: bluetooth
  bluetooth.general.tester_br_edr:
    build_only: true
    platform_allow:
      - mimxrt1170_evk@B/mimxrt1176/cm7
    extra_args:
      - EXTRA_CONF_FILE="prj_br.conf"
      - CONFIG_BUILD_ONLY_NO_BLOBS=y
    tags: bluetooth
    harness: bluetooth
```

## tests/bluetooth/uuid/testcase.yaml
```yaml
tests:
  bluetooth.uuid:
    platform_allow:
      - native_posix/native
      - native_posix/native/64
      - native_sim/native
      - native_sim/native/64
      - qemu_x86/atom
      - qemu_cortex_m3/ti_lm3s6965
    integration_platforms:
      - native_sim/native
    tags:
      - bluetooth
      - uuid
```

## tests/boards/altera_max10/i2c_master/testcase.yaml
```yaml
tests:
  boards.altera_max10.i2c_master:
    platform_allow: altera_max10
    tags: i2c
```

## tests/boards/altera_max10/msgdma/testcase.yaml
```yaml
tests:
  boards.altera_max10.dma:
    platform_allow: altera_max10/zephyr_nios2f
    tags: dma
```

## tests/boards/altera_max10/qspi/testcase.yaml
```yaml
tests:
  boards.altera_max10.qspi:
    platform_allow: altera_max10
    tags:
      - qspi
      - flash
```

## tests/boards/altera_max10/sysid/testcase.yaml
```yaml
tests:
  boards.altera_max10.sysid:
    platform_allow: altera_max10
    tags: sysid
```

## tests/boards/board_shell/testcase.yaml
```yaml
tests:
  boards.shell.shell:
    tags: shell
    harness: keyboard
    platform_whitelist: nrf52840dk_nrf52840 frdm_k64f
```

## tests/boards/espressif/cache_coex/boards/esp32s3_devkitc_esp32s3_procpu.conf
```kconfig
# The esp32s3_devkitc used in CI is the 8MB octal PSRAM variant. Selecting
# octal PSRAM mode also enables octal flash by default, so its MSPI timing
# is tuned and stays reliable at high PSRAM speeds.
CONFIG_SPIRAM_MODE_OCT=y
```

## tests/boards/espressif/cache_coex/testcase.yaml
```yaml
common:
  tags:
    - spiram
    - spiflash
    - cache
  harness: ztest
tests:
  boards.esp32.cache_coex:
    platform_allow:
      - esp32_devkitc/esp32/procpu
      - esp32s2_devkitc
      - esp32s3_devkitc/esp32s3/procpu
      - esp32c5_devkitc/esp32c5/hpcore
      - esp32p4_function_ev_board/esp32p4/hpcore
    integration_platforms:
      - esp32s3_devkitc/esp32s3/procpu
  boards.esp32.cache_coex.octal_80m:
    platform_allow:
      - esp32s3_devkitc/esp32s3/procpu
    integration_platforms:
      - esp32s3_devkitc/esp32s3/procpu
    extra_configs:
      - CONFIG_SPIRAM_SPEED_80M=y
  boards.esp32.cache_coex.reloc:
    platform_allow:
      - esp32s2_devkitc
      - esp32s3_devkitc/esp32s3/procpu
    integration_platforms:
      - esp32s3_devkitc/esp32s3/procpu
    extra_args:
      - SNIPPET="espressif-psram-reloc"
  boards.esp32.cache_coex.mcuboot:
    platform_allow:
      - esp32s3_devkitc/esp32s3/procpu
    integration_platforms:
      - esp32s3_devkitc/esp32s3/procpu
    sysbuild: true
  boards.esp32.cache_coex.reloc_mcuboot:
    platform_allow:
      - esp32s3_devkitc/esp32s3/procpu
    integration_platforms:
      - esp32s3_devkitc/esp32s3/procpu
    sysbuild: true
    extra_args:
      - SNIPPET="espressif-psram-reloc"
```

## tests/boards/espressif/ethernet/Kconfig
```kconfig
# Copyright (c) 2024 Espressif Systems (Shanghai) Co., Ltd.
# SPDX-License-Identifier: Apache-2.0

mainmenu "Ethernet Test"

source "Kconfig.zephyr"

config DHCP_ASSIGN_TIMEOUT
	int "DHCP Assign Timeout (in seconds)"
	default 30
	help
	  Timeout duration for receiving IPv4 address from DHCP.
	  If no address is assigned within this time, test will fail.

config GATEWAY_PING_TIMEOUT
	int "Gateway Ping Timeout (in seconds)"
	default 10
	help
	  Timeout duration for pinging the network gateway.
	  If no reply is received within this time, test will fail.
```

## tests/boards/espressif/ethernet/testcase.yaml
```yaml
tests:
  boards.esp32.ethernet:
    platform_allow:
      - esp32_ethernet_kit/esp32/procpu
    tags:
      - ethernet

  boards.esp32.ethernet.esp_threadbr:
    platform_allow:
      - esp_threadbr/esp32s3/procpu
    extra_args:
      - SHIELD=esp_threadbr_ethernet
    tags:
      - ethernet
```

## tests/boards/espressif/i2s/Kconfig
```kconfig
#
# Copyright (c) 2025 Espressif Systems (Shanghai) CO LTD
#
# SPDX-License-Identifier: Apache-2.0
#

mainmenu "ESP32 I2S Loopback Test"

source "Kconfig.zephyr"

config I2S_TEST_SEPARATE_DEVICES
	bool "Use two separate I2S ports for loopback"
	help
	  Use separate I2S ports for transmit and receive.

config I2S_TEST_USE_GPIO_LOOPBACK
	bool "Use GPIO loopback"
	help
	  Use wiring between the data-out and data-in pins for looping back data.

config I2S_TEST_ALLOWED_DATA_DISCARD
	int "Allowed discard in received data"
	default 0
	help
	  Maximum allowed discard between sent and received samples
```

## tests/boards/espressif/i2s/boards/esp32s2_devkitc.conf
```kconfig
# Copyright (c) 2025 Espressif Systems (Shanghai) Co., Ltd.
# SPDX-License-Identifier: Apache-2.0

CONFIG_I2S_TEST_USE_GPIO_LOOPBACK=y
CONFIG_I2S_TEST_ALLOWED_DATA_DISCARD=1
CONFIG_I2S_ESP32_ALLOWED_EMPTY_TX_QUEUE_DEFERRAL_TIME_MS=1
```

## tests/boards/espressif/i2s/testcase.yaml
```yaml
tests:
  boards.esp32.i2s.gpio_loopback:
    depends_on:
      - i2s
      - gpio
    tags:
      - drivers
      - userspace
    filter: CONFIG_I2S_TEST_USE_GPIO_LOOPBACK
    harness: ztest
    platform_allow:
      - esp32_devkitc/esp32/procpu
      - esp32s2_saola
    harness_config:
      fixture: gpio_loopback
```

## tests/boards/espressif/interrupt/testcase.yaml
```yaml
common:
  integration_platforms:
    - esp32s3_devkitm/esp32s3/procpu
tests:
  boards.esp32.interrupts:
    tags:
      - drivers
    platform_allow:
      - esp32_devkitc/esp32/procpu
      - esp32s2_saola
      - esp32s3_devkitm/esp32s3/procpu
```

## tests/boards/espressif/memory_layout/testcase.yaml
```yaml
common:
  tags: memory
  filter: CONFIG_SOC_FAMILY_ESPRESSIF_ESP32
  harness: console
  harness_config:
    type: multi_line
    regex:
      - "total SRAM region: (.*) bytes"
      - "heap boundary: (.*) KB verified"
      - "PASS"
tests:
  boards.espressif.memory_layout.simple_boot: {}
  boards.espressif.memory_layout.mcuboot:
    sysbuild: true
```

## tests/boards/espressif/qdec/testcase.yaml
```yaml
common:
  depends_on:
    - sensor
    - gpio
    - pinctrl
  tags:
    - drivers
    - sensor
  harness: ztest
  platform_allow:
    - esp32_devkitc/esp32/procpu
    - esp32s2_saola
    - esp32s3_devkitc/esp32s3/procpu
    - esp32c5_devkitc/esp32c5/hpcore
    - esp32c6_devkitc/esp32c6/hpcore
    - esp32h2_devkitm/esp32h2

tests:
  boards.esp32.qdec.self_loopback: {}
```

## tests/boards/espressif/rtc_clk/Kconfig
```kconfig
# Copyright (c) 2024 Espressif Systems (Shanghai) Co., Ltd.
# SPDX-License-Identifier: Apache-2.0

mainmenu "RTC CLK Test Configuration"

source "Kconfig.zephyr"

config FIXTURE_XTAL
	bool "Selected when external crystal is present"
	default n
```

## tests/boards/espressif/rtc_clk/testcase.yaml
```yaml
common:
  integration_platforms:
    - esp32c6_devkitc/esp32c6/hpcore
tests:
  boards.esp32.rtc_clk:
    platform_allow:
      - esp32_devkitc/esp32/procpu
      - esp32c3_devkitm
      - esp32c6_devkitc/esp32c6/hpcore
      - esp32h2_devkitm
      - esp32s2_saola
      - esp32s3_devkitm/esp32s3/procpu
  boards.esp32.rtc_clk.xtal:
    platform_allow:
      - esp32_devkitc/esp32/procpu
      - esp32c3_devkitm
      - esp32c6_devkitc/esp32c6/hpcore
      - esp32s2_saola
      - esp32s3_devkitm/esp32s3/procpu
    harness_config:
      fixture: external_xtal
    extra_configs:
      - CONFIG_FIXTURE_XTAL=y
```

## tests/boards/espressif/wifi/Kconfig
```kconfig
# Copyright (c) 2024 Espressif Systems (Shanghai) Co., Ltd.
# SPDX-License-Identifier: Apache-2.0

mainmenu "Wi-Fi Test"

source "Kconfig.zephyr"

config WIFI_TEST_ENABLE
	bool "Enable Wi-Fi test"
	default y
	select WIFI
	select WIFI_USE_NATIVE_NETWORKING

config WIFI_TEST_SSID
	string "Wi-Fi Test SSID"
	default "TestSSID"
	help
	  This option sets the SSID of the Wi-Fi network for testing.
	  It allows you to specify the Wi-Fi SSID that the device will
	  use during test scenarios.

config WIFI_TEST_PSK
	string "Wi-Fi Test PSK"
	default "TestPSK"
	help
	  This option sets the Pre-Shared Key (PSK) for the Wi-Fi network
	  during test scenarios. The device will use this password to authenticate
	  with the specified test SSID.

config WIFI_TEST_AUTH_MODE_WPA2
	bool "WPA2 Security"
	help
	  Option to use WPA2 Security for Wi-Fi connections.

config WIFI_TEST_AUTH_MODE_WPA3
	bool "WPA3 Security"
	select ESP_WIFI_ENABLE_WPA3_SAE
	help
	  Option to use WPA3 Security for Wi-Fi connections.

config WIFI_CONNECT_ATTEMPTS
	int "Wi-Fi Connect Attempts"
	default 5
	help
	  Number of attempts when connecting to a Wi-Fi network.
	  If connection is not successful after all attempts, test will fail.

config WIFI_SCAN_TIMEOUT
	int "Wi-Fi Scan Timeout (in seconds)"
	default 30
	help
	  Timeout duration for Wi-Fi scanning.
	  If scan doesn't complete within this time, test will fail.

config WIFI_CONNECT_TIMEOUT
	int "Wi-Fi Connect Timeout (in seconds)"
	default 60
	help
	  Timeout duration for connecting to Wi-Fi network.
	  If connection is not established within this time, test will fail.

config WIFI_DISCONNECT_TIMEOUT
	int "Wi-Fi Disconnect Timeout (in seconds)"
	default 5
	help
	  Timeout duration for disconnecting from Wi-Fi network.
	  If disconnect doesn't complete within this time, test will fail.

config WIFI_PING_TIMEOUT
	int "Gateway Ping Timeout (in seconds)"
	default 10
	help
	  Timeout duration for pinging the network gateway.
	  If no reply is received within this time, test will fail.
```
