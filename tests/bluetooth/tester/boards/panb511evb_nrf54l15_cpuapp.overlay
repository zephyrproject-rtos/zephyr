/*
 * Copyright (c) 2025 Panasonic Industrial Devices Europe GmbH
 *
 * SPDX-License-Identifier: Apache-2.0
 */

/ {
	chosen {
		zephyr,uart-pipe = &uart30;
	};
};

&uart30 {
	compatible = "nordic,nrf-uarte";
	current-speed = <115200>;
	status = "okay";
	hw-flow-control;
};
