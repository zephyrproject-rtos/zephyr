## CMakeLists.txt
```
# SPDX-License-Identifier: Apache-2.0

cmake_minimum_required(VERSION 3.28.0)

LIST(APPEND QEMU_EXTRA_FLAGS -serial unix:/tmp/bt-stack-tester)

find_package(Zephyr REQUIRED HINTS $ENV{ZEPHYR_BASE})
project(tester)

zephyr_library_include_directories(${ZEPHYR_BASE}/samples/bluetooth)
zephyr_library_include_directories(${ZEPHYR_BASE}/subsys/bluetooth/mesh)
zephyr_library_include_directories(${ZEPHYR_BASE}/subsys/bluetooth/host)
target_sources(app PRIVATE
    src/main.c
    src/btp.c
    src/btp_core.c
    src/btp_gap.c
    src/btp_gatt.c
    )
if(CONFIG_BT_L2CAP_DYNAMIC_CHANNEL)
target_sources(app PRIVATE src/btp_l2cap.c)
endif()

if(CONFIG_BT_MESH)
target_sources(app PRIVATE src/btp_mesh.c)
endif()

if(CONFIG_BT_IAS OR CONFIG_BT_IAS_CLIENT)
target_sources(app PRIVATE src/btp_ias.c)
endif()

if(CONFIG_BT_OTS)
    target_sources(app PRIVATE src/btp_ots.c)
endif()

if(CONFIG_BT_RFCOMM)
    target_sources(app PRIVATE src/btp_rfcomm.c)
endif()

if(CONFIG_BT_HID_DEVICE)
  target_sources(app PRIVATE src/btp_hid_device.c)
endif()

if(CONFIG_BT_HID_HOST)
  target_sources(app PRIVATE src/btp_hid_host.c)
endif()

zephyr_library_include_directories(src src/btp src/audio/btp)
add_subdirectory_ifdef(CONFIG_BT_AUDIO src/audio)

if(CONFIG_BT_CLASSIC)
    target_sources(app PRIVATE src/btp_sdp.c)
endif()
```

## Kconfig
```
# Config options for tester app

# Copyright (c) 2023 Codecoup
# SPDX-License-Identifier: Apache-2.0

menu "Bttester configuration"

module = BTTESTER
module-str = bttester
source "subsys/logging/Kconfig.template.log_config"

config BTTESTER_BTP_CMD_THREAD_STACK_SIZE
	int "BTP CMD threads stack size."
	default 2048
	help
	  Stack size in byte used by the BTP CMD thread.

config BTTESTER_L2CAP_DATA_POOL_COUNT
	int "L2CAP Service data pool count"
	depends on BT_CLASSIC
	depends on BT_L2CAP_RET_FC
	default BT_L2CAP_MAX_WINDOW_SIZE
	range BT_L2CAP_MAX_WINDOW_SIZE 255
	help
	  Data pool count of L2CAP service.

endmenu

source "Kconfig.zephyr"
```

## Kconfig.sysbuild
```
# Copyright 2023-2024 Nordic Semiconductor ASA
# SPDX-License-Identifier: Apache-2.0

source "share/sysbuild/Kconfig"

config NET_CORE_BOARD
	string
	default "nrf54h20dk/nrf54h20/cpurad" if "$(BOARD)" = "nrf54h20dk"
	default "nrf5340dk/nrf5340/cpunet" if "$(BOARD)" = "nrf5340dk"
	default "nrf5340_audio_dk/nrf5340/cpunet" if "$(BOARD)" = "nrf5340_audio_dk"
	default "nrf5340bsim/nrf5340/cpunet" if $(BOARD_TARGET_STRING) = "NRF5340BSIM_NRF5340_CPUAPP"

config NET_CORE_IMAGE_HCI_IPC
	bool "HCI IPC image on network core"
	default y
	depends on NET_CORE_BOARD != ""
```

## prj.conf
```kconfig
CONFIG_TEST=y
CONFIG_UART_PIPE=y
CONFIG_UART_CONSOLE=n
CONFIG_SYSTEM_WORKQUEUE_STACK_SIZE=2048

CONFIG_BT=y
CONFIG_BT_CENTRAL=y
CONFIG_BT_PERIPHERAL=y
CONFIG_BT_PRIVACY=n
CONFIG_BT_SMP=y
CONFIG_BT_SMP_ENFORCE_MITM=n
CONFIG_BT_SMP_ALLOW_UNAUTH_OVERWRITE=y
CONFIG_BT_SMP_APP_PAIRING_ACCEPT=y
CONFIG_BT_SIGNING=y
CONFIG_BT_BONDABLE=y
CONFIG_BT_ATT_PREPARE_COUNT=12
# PTS drives long and reliable writes over a single connection, e.g.
# GATT/SR/GAW/BV-10-C and BV-14-C, so let one connection use the whole pool.
CONFIG_BT_ATT_PREPARE_COUNT_PER_CONN=12
CONFIG_BT_GATT_CLIENT=y
CONFIG_BT_L2CAP_DYNAMIC_CHANNEL=y
CONFIG_BT_DEVICE_NAME="Tester"
CONFIG_BT_DEVICE_NAME_MAX=32
CONFIG_BT_DEVICE_NAME_DYNAMIC=y
CONFIG_BT_DEVICE_NAME_GATT_WRITABLE=y
CONFIG_BT_EATT=y
CONFIG_BT_L2CAP_ECRED=y
CONFIG_BT_EATT_MAX=5
CONFIG_BT_FILTER_ACCEPT_LIST=y
CONFIG_BT_EATT_AUTO_CONNECT=n
CONFIG_BT_MAX_CONN=2
CONFIG_BT_MAX_PAIRED=2
CONFIG_BT_GATT_NOTIFY_MULTIPLE=y
CONFIG_BT_ATT_RETRY_ON_SEC_ERR=n
CONFIG_BT_GATT_DYNAMIC_DB=y
CONFIG_BT_EXT_ADV=y
CONFIG_BT_PER_ADV=y
CONFIG_BT_PER_ADV_SYNC=y
CONFIG_BT_BUF_ACL_RX_SIZE=100
CONFIG_BT_RX_STACK_SIZE=4096

CONFIG_BT_TESTING=y
CONFIG_UTF8=y

CONFIG_BT_OTS=y
CONFIG_BT_OTS_DIR_LIST_OBJ=y
CONFIG_BT_OTS_OBJ_NAME_WRITE_SUPPORT=y
CONFIG_BT_OTS_OACP_WRITE_SUPPORT=y
CONFIG_BT_OTS_OACP_PATCH_SUPPORT=y
CONFIG_BT_OTS_OACP_CREATE_SUPPORT=y
CONFIG_BT_OTS_OACP_DELETE_SUPPORT=y
CONFIG_BT_OTS_OACP_CHECKSUM_SUPPORT=y
```

## default.conf
```kconfig
CONFIG_TEST=y
CONFIG_UART_PIPE=y
CONFIG_CONSOLE_HANDLER=y
CONFIG_SYSTEM_WORKQUEUE_STACK_SIZE=2048

CONFIG_BT=y
CONFIG_BT_CENTRAL=y
CONFIG_BT_PERIPHERAL=y
CONFIG_BT_SMP=y
CONFIG_BT_SIGNING=y
CONFIG_BT_ATT_PREPARE_COUNT=4
CONFIG_BT_GATT_CLIENT=y
CONFIG_BT_L2CAP_DYNAMIC_CHANNEL=y
CONFIG_BT_PRIVACY=n
CONFIG_BT_RPA_TIMEOUT=60
CONFIG_BT_DEVICE_NAME="Tester"
CONFIG_BT_DEVICE_NAME_MAX=32
CONFIG_BT_DEVICE_NAME_DYNAMIC=y
CONFIG_BT_DEVICE_NAME_GATT_WRITABLE=y

CONFIG_BT_MESH=y
CONFIG_BT_MESH_RELAY=y
CONFIG_BT_MESH_PB_ADV=y
CONFIG_BT_MESH_PB_GATT=y
CONFIG_BT_MESH_LOW_POWER=y
CONFIG_BT_MESH_LPN_AUTO=n
CONFIG_BT_MESH_GATT_PROXY=y
CONFIG_BT_MESH_LABEL_COUNT=2
CONFIG_BT_MESH_SUBNET_COUNT=2
CONFIG_BT_MESH_MODEL_GROUP_COUNT=2
CONFIG_BT_MESH_APP_KEY_COUNT=4
CONFIG_BT_MESH_IV_UPDATE_TEST=y
CONFIG_BT_MESH_CFG_CLI=y
CONFIG_BT_MESH_HEALTH_CLI=y
CONFIG_BT_MESH_FRIEND=y
CONFIG_BT_MESH_FRIEND_QUEUE_SIZE=32

CONFIG_BT_TINYCRYPT_ECC=y
CONFIG_BT_TESTING=y

CONFIG_UART_CONSOLE=n
```

## extra-bt_ll_sw_split.conf
```kconfig
# This file is designed to be used with the BT Tester with the Zephyr Bluetooth LE Controller using
# BT_LL_SW_SPLIT.
# It is designed to be board-independent (assuming that it fits in memory).

CONFIG_LTO=y
CONFIG_ISR_TABLES_LOCAL_DECLARATION=y

# Host and Controller common dependencies
CONFIG_BT_BROADCASTER=y
CONFIG_BT_OBSERVER=y
CONFIG_BT_EXT_ADV=y
CONFIG_BT_PER_ADV=y
CONFIG_BT_PER_ADV_SYNC=y
CONFIG_BT_PER_ADV_SYNC_TRANSFER_SENDER=y
CONFIG_BT_PER_ADV_SYNC_TRANSFER_RECEIVER=y
CONFIG_BT_CENTRAL=y
CONFIG_BT_PERIPHERAL=y
CONFIG_BT_ISO_BROADCASTER=y
CONFIG_BT_ISO_SYNC_RECEIVER=y
CONFIG_BT_ISO_CENTRAL=y
CONFIG_BT_ISO_PERIPHERAL=y
CONFIG_MBEDTLS_PSA_CRYPTO_EXTERNAL_RNG=y
CONFIG_MBEDTLS_AES_ROM_TABLES=y

# Generic Controller configurations
CONFIG_BT_LL_SW_SPLIT=y

# BAP may require up to 2 channels of 155 octets per frame => 310 SDU size required
CONFIG_BT_ISO_TX_MTU=310
CONFIG_BT_ISO_RX_MTU=310
CONFIG_BT_CTLR_ISO_TX_SDU_LEN_MAX=310

# CSIP tests requires up to 3 devices
CONFIG_BT_MAX_CONN=3
CONFIG_MBEDTLS_PSA_KEY_SLOT_COUNT=3

# BAP/BSRC/SCC/BV-38-C requires 2 BIGs
CONFIG_BT_EXT_ADV_MAX_ADV_SET=2
CONFIG_BT_ISO_MAX_BIG=2

# Match supported periodic advertising ext adv instances
CONFIG_BT_CTLR_ADV_SYNC_SET=2
CONFIG_BT_CTLR_ADVANCED_FEATURES=y
CONFIG_BT_CTLR_ADV_DATA_BUF_MAX=4

# Multiple BAP tests requires 2 ISO channels for both unicast and broadcast
CONFIG_BT_ISO_MAX_CHAN=4
CONFIG_BT_CTLR_ISOAL_SOURCES=4
CONFIG_BT_CTLR_ISOAL_SINKS=4
CONFIG_BT_CTLR_ADV_ISO_STREAM_MAX=2
CONFIG_BT_CTLR_SYNC_ISO_STREAM_MAX=2
CONFIG_BT_CTLR_CONN_ISO_STREAMS_PER_GROUP=2

# Support both
CONFIG_BT_CTLR_ADV_ISO_SEQUENTIAL=y
CONFIG_BT_CTLR_ADV_ISO_INTERLEAVED=y

# Set TX buffers so that we have at least 3 buffers per channel
# in the Zephyr Bluetooth Controller implementation each SDU is buffered for up to 2 ISO interval:
# - One ISO interval until transmission on-air,
# - One ISO interval thereafter to generate Number of Completed packets,
# - One additional Tx buffer for upper layer to enqueue new SDU.
CONFIG_BT_CTLR_ISO_TX_BUFFERS=12
CONFIG_BT_CTLR_ISO_RX_BUFFERS=4

# Set ISO PDU size to max
CONFIG_BT_CTLR_ADV_ISO_PDU_LEN_MAX=251
CONFIG_BT_CTLR_SYNC_ISO_PDU_LEN_MAX=251
# Set buffer size to 8 above PDU size to make room for the SDU header
CONFIG_BT_CTLR_ISO_TX_BUFFER_SIZE=259

# Set advertising/scan data length to support large BAP BASEs
CONFIG_BT_CTLR_ADV_DATA_LEN_MAX=191
CONFIG_BT_CTLR_SCAN_DATA_LEN_MAX=191

# ACL data sizes
CONFIG_BT_BUF_ACL_TX_SIZE=251
CONFIG_BT_BUF_ACL_RX_SIZE=255
CONFIG_BT_CTLR_DATA_LENGTH_MAX=251
```

## gap_iso.conf
```kconfig
CONFIG_BT_ISO_BROADCASTER=y
CONFIG_BT_ISO_SYNC_RECEIVER=y
CONFIG_BT_ISO_CENTRAL=y
CONFIG_BT_ISO_PERIPHERAL=y
```

## hci_ipc.conf
```kconfig
# left empty until autopts has been updated to stop using it
```

## hci_ipc_cpunet.conf
```kconfig
# Apply this overlay at hci_ipc controller build

# PTS required counts
CONFIG_BT_MAX_CONN=3

# PTS tests specific tweaks
CONFIG_BT_CTLR_PERIPHERAL_ISO_EARLY_CIG_START=y
CONFIG_BT_CTLR_ISOAL_PSN_IGNORE=y

CONFIG_BT_ISO_MAX_BIG=2
CONFIG_BT_EXT_ADV_MAX_ADV_SET=2

CONFIG_BT_CTLR_ADV_ISO_SET=2
CONFIG_BT_CTLR_ADV_ISO_STREAM_COUNT=4
CONFIG_BT_CTLR_ADV_ISO_STREAM_MAX=4

CONFIG_BT_CTLR_ISOAL_SOURCES=4
CONFIG_BT_CTLR_ISO_TX_BUFFERS=8
```

## nble.conf
```kconfig
CONFIG_UART_PIPE=y
CONFIG_CONSOLE_HANDLER=y
CONFIG_BLUETOOTH=y
CONFIG_BLUETOOTH_CUSTOM=y
CONFIG_NBLE=y
CONFIG_UART_CONSOLE=n
CONFIG_BLUETOOTH_ATT_PREPARE_COUNT=4
```

## nrf52840_pca10056.overlay
```dts
/ {
	chosen {
		zephyr,uart-pipe = &uart0;
	};
};

&uart0 {
	current-speed = <115200>;
	status = "ok";
};
```

## nrf52840dk_nrf52840.overlay
```dts
/* SPDX-License-Identifier: Apache-2.0 */

/ {
	chosen {
		zephyr,uart-pipe = &uart0;
	};
};

&uart0 {
	compatible = "nordic,nrf-uart";
	current-speed = <115200>;
	status = "okay";
};
```

## nrf52_pca10040.overlay
```dts
/* SPDX-License-Identifier: Apache-2.0 */

/ {
	chosen {
		zephyr,uart-pipe = &uart0;
	};
};

&uart0 {
	compatible = "nordic,nrf-uart";
	current-speed = <115200>;
	status = "ok";
};
```

## rd_rw612_bga.overlay
```dts
/*
 * Copyright 2023 NXP
 *
 * SPDX-License-Identifier: Apache-2.0
 */

/ {
	chosen {
		zephyr,uart-pipe = &flexcomm0;
	};
};

&flexcomm0 {
	compatible = "nxp,lpc-usart";
	current-speed = <115200>;
	pinctrl-0 = <&pinmux_flexcomm0_usart>;
	pinctrl-names = "default";
	status = "okay";
};
```

## boards/bl54l15_dvk_nrf54l15_cpuapp.overlay
```dts
/*
 * Copyright (c) 2025 Nordic Semiconductor ASA
 * Copyright (c) 2025 Ezurio LLC
 *
 * SPDX-License-Identifier: Apache-2.0
 */

/ {
	chosen {
		zephyr,uart-pipe = &uart20;
	};
};

&uart20 {
	compatible = "nordic,nrf-uarte";
	current-speed = <115200>;
	hw-flow-control;
	status = "okay";
};
```

## boards/cyw920829m2evk_02.overlay
```dts
/* SPDX-License-Identifier: Apache-2.0 */

/ {
	chosen {
		zephyr,uart-pipe = &uart2;
	};
};
```

## src/main.c
```c
/* main.c - Application main entry point */

/*
 * Copyright (c) 2015-2016 Intel Corporation
 *
 * SPDX-License-Identifier: Apache-2.0
 */

#include <zephyr/autoconf.h>
#include <zephyr/logging/log.h>

#define LOG_MODULE_NAME bttester_main
LOG_MODULE_REGISTER(LOG_MODULE_NAME, CONFIG_BTTESTER_LOG_LEVEL);

#include "btp/btp.h"

int main(void)
{
	tester_init();
	return 0;
}
```

## src/btp.c
```c
/* bttester.c - Bluetooth Tester */

/*
 * Copyright (c) 2015-2016 Intel Corporation
 * Copyright (c) 2022 Codecoup
 *
 * SPDX-License-Identifier: Apache-2.0
 */
#include <errno.h>
#include <stdio.h>
#include <stdint.h>
#include <string.h>

#include <zephyr/autoconf.h>
#include <zephyr/bluetooth/bluetooth.h>
#include <zephyr/device.h>
#include <zephyr/drivers/uart.h>
#include <zephyr/drivers/uart_pipe.h>
#include <zephyr/kernel.h>
#include <zephyr/kernel/thread_stack.h>
#include <zephyr/logging/log.h>
#include <zephyr/net_buf.h>
#include <zephyr/sys/__assert.h>
#include <zephyr/sys/byteorder.h>
#include <zephyr/sys/util.h>
#include <zephyr/sys/clock.h>
#include <zephyr/toolchain.h>
#include <zephyr/types.h>

#define LOG_MODULE_NAME bttester
LOG_MODULE_REGISTER(LOG_MODULE_NAME, CONFIG_BTTESTER_LOG_LEVEL);

#include "btp/btp.h"

#define STACKSIZE CONFIG_BTTESTER_BTP_CMD_THREAD_STACK_SIZE
static K_THREAD_STACK_DEFINE(stack, STACKSIZE);
static struct k_thread cmd_thread;

#define CMD_QUEUED 2
struct btp_buf {
	intptr_t _reserved;
	uint8_t data[BTP_MTU]; /* includes btp header */
	uint8_t rsp[BTP_DATA_MAX_SIZE];
};

static struct btp_buf cmd_buf[CMD_QUEUED];

static K_FIFO_DEFINE(cmds_queue);
static K_FIFO_DEFINE(avail_queue);

static struct btp_buf *delayed_cmd;

static struct {
	const struct btp_handler *handlers;
	size_t num;
} service_handler[BTP_SERVICE_ID_COUNT];

static struct net_buf_simple *rsp_buf = NET_BUF_SIMPLE(BTP_MTU);
static K_MUTEX_DEFINE(rsp_buf_mutex);

static void tester_send_with_index(uint8_t service, uint8_t opcode, uint8_t index,
				   const uint8_t *data, size_t len);
static void tester_rsp_with_index(uint8_t service, uint8_t opcode, uint8_t index,
				  uint8_t status);

void tester_register_command_handlers(uint8_t service,
				      const struct btp_handler *handlers,
				      size_t num)
{
	__ASSERT_NO_MSG(service <= BTP_SERVICE_ID_MAX);
	__ASSERT_NO_MSG(service_handler[service].handlers == NULL);

	service_handler[service].handlers = handlers;
	service_handler[service].num = num;
}

static const struct btp_handler *find_btp_handler(uint8_t service, uint8_t opcode)
{
	if ((service > BTP_SERVICE_ID_MAX) ||
	    (service_handler[service].handlers == NULL)) {
		return NULL;
	}

	for (uint8_t i = 0; i < service_handler[service].num; i++) {
		if (service_handler[service].handlers[i].opcode == opcode) {
			return &service_handler[service].handlers[i];
		}
	}

	return NULL;
}

static void cmd_handler(void *p1, void *p2, void *p3)
{
	while (1) {
		const struct btp_handler *btp;
		struct btp_buf *cmd;
		struct btp_hdr *hdr;
		uint8_t status;
		uint16_t rsp_len = 0;

		cmd = k_fifo_get(&cmds_queue, K_FOREVER);
		hdr = (struct btp_hdr *)cmd->data;

		LOG_DBG("cmd service 0x%02x opcode 0x%02x index 0x%02x",
			hdr->service, hdr->opcode, hdr->index);

		btp = find_btp_handler(hdr->service, hdr->opcode);
		if (btp) {
			uint16_t len = sys_le16_to_cpu(hdr->len);

			if (len > BTP_DATA_MAX_SIZE) {
				status = BTP_STATUS_FAILED;
				LOG_ERR("Data len exceeds BTP MTU %u > %u", len, BTP_DATA_MAX_SIZE);
			} else if (btp->index != hdr->index) {
				status = BTP_STATUS_FAILED;
				LOG_ERR("Index mismatch %u != %u", btp->index, hdr->index);
			} else if ((btp->expect_len >= 0) && (btp->expect_len != len)) {
				status = BTP_STATUS_FAILED;
				LOG_ERR("len mismatch %u != %u", btp->expect_len, len);
			} else {
				status = btp->func(hdr->data, len,
						   cmd->rsp, &rsp_len);
				LOG_DBG("Command returns status %u", status);
			}

			/* This means that caller likely overwrote rsp buffer */
			__ASSERT_NO_MSG(rsp_len <= BTP_DATA_MAX_SIZE);
		} else {
			status = BTP_STATUS_UNKNOWN_CMD;
		}
		/* Allow to delay only 1 command. This is for convenience only
		 * of using cmd data without need of copying those in async
		 * functions. Should be not needed eventually.
		 */
		if (status == BTP_STATUS_DELAY_REPLY) {
			__ASSERT_NO_MSG(delayed_cmd == NULL);
			delayed_cmd = cmd;
			continue;
		}

		if ((status == BTP_STATUS_SUCCESS) && rsp_len > 0) {
			tester_send_with_index(hdr->service, hdr->opcode,
					       hdr->index, cmd->rsp, rsp_len);
		} else {
			tester_rsp_with_index(hdr->service, hdr->opcode,
					      hdr->index, status);
		}

		(void)memset(cmd, 0, sizeof(*cmd));
		k_fifo_put(&avail_queue, cmd);
	}
}

static uint8_t *recv_cb(uint8_t *buf, size_t *off)
{
	struct btp_hdr *cmd = (void *) buf;
	struct btp_buf *new_buf;
	uint16_t len;

	if (*off < sizeof(*cmd)) {
		return buf;
	}

	len = sys_le16_to_cpu(cmd->len);
	if (len > BTP_MTU - sizeof(*cmd)) {
		LOG_ERR("BT tester: invalid packet length");
		*off = 0;
		return buf;
	}

	if (*off < sizeof(*cmd) + len) {
		return buf;
	}

	new_buf =  k_fifo_get(&avail_queue, K_NO_WAIT);
	if (!new_buf) {
		LOG_ERR("BT tester: RX overflow");
		*off = 0;
		return buf;
	}

	k_fifo_put(&cmds_queue, CONTAINER_OF(buf, struct btp_buf, data[0]));

	*off = 0;
	return new_buf->data;
}

#if defined(CONFIG_UART_PIPE)
/* Uart Pipe */
static void uart_init(uint8_t *data)
{
	uart_pipe_register(data, BTP_MTU, recv_cb);
}

static void uart_send(const uint8_t *data, size_t len)
{
	uart_pipe_send(data, len);
}
#else /* !CONFIG_UART_PIPE */
static uint8_t *recv_buf;
static size_t recv_off;
static const struct device *const dev =
	DEVICE_DT_GET(DT_CHOSEN(zephyr_console));

static void timer_expiry_cb(struct k_timer *timer)
{
	uint8_t c;

	while (uart_poll_in(dev, &c) == 0) {
		recv_buf[recv_off++] = c;
		recv_buf = recv_cb(recv_buf, &recv_off);
	}
}

K_TIMER_DEFINE(timer, timer_expiry_cb, NULL);

/* Uart Poll */
static void uart_init(uint8_t *data)
{
	__ASSERT_NO_MSG(device_is_ready(dev));

	recv_buf = data;

	k_timer_start(&timer, K_MSEC(10), K_MSEC(10));
}

static void uart_send(const uint8_t *data, size_t len)
{
	int i;

	for (i = 0; i < len; i++) {
		uart_poll_out(dev, data[i]);
	}
}
#endif /* CONFIG_UART_PIPE */

void tester_init(void)
{
	int i;
	struct btp_buf *buf;

	LOG_DBG("Initializing tester");

	for (i = 0; i < CMD_QUEUED; i++) {
		k_fifo_put(&avail_queue, &cmd_buf[i]);
	}

	k_thread_create(&cmd_thread, stack, STACKSIZE, cmd_handler,
			NULL, NULL, NULL, K_PRIO_COOP(7), 0, K_NO_WAIT);

	buf = k_fifo_get(&avail_queue, K_NO_WAIT);

	uart_init(buf->data);

	/* core service is always available */
	tester_init_core();

	tester_send_with_index(BTP_SERVICE_ID_CORE, BTP_CORE_EV_IUT_READY,
			      BTP_INDEX_NONE, NULL, 0);
}

int tester_rsp_buffer_lock(void)
{
	if (k_mutex_lock(&rsp_buf_mutex, Z_FOREVER) != 0) {
		LOG_ERR("Cannot lock rsp_ring_buf");

		return -EACCES;
	}

	return 0;
}

void tester_rsp_buffer_unlock(void)
{
	k_mutex_unlock(&rsp_buf_mutex);
}

void tester_rsp_buffer_free(void)
{
	net_buf_simple_init(rsp_buf, 0);
}

void tester_rsp_buffer_allocate(size_t len, uint8_t **data)
{
	tester_rsp_buffer_free();

	*data = net_buf_simple_add(rsp_buf, len);
}

K_MUTEX_DEFINE(uart_mutex);
static void tester_send_with_index(uint8_t service, uint8_t opcode, uint8_t index,
				   const uint8_t *data, size_t len)
{
	struct btp_hdr msg;

	msg.service = service;
	msg.opcode = opcode;
	msg.index = index;
	msg.len = sys_cpu_to_le16(len);

	k_mutex_lock(&uart_mutex, K_FOREVER);
	uart_send((uint8_t *)&msg, sizeof(msg));
	if (data && len) {
		uart_send(data, len);
	}
	k_mutex_unlock(&uart_mutex);
}

static void tester_rsp_with_index(uint8_t service, uint8_t opcode, uint8_t index,
				  uint8_t status)
{
	struct btp_status s;

	LOG_DBG("service 0x%02x opcode 0x%02x index 0x%02x status 0x%02x", service, opcode, index,
		status);

	if (status == BTP_STATUS_SUCCESS) {
		tester_send_with_index(service, opcode, index, NULL, 0);
		return;
	}

	s.code = status;
	tester_send_with_index(service, BTP_STATUS, index, (uint8_t *) &s, sizeof(s));
}

void tester_event(uint8_t service, uint8_t opcode, const void *data, size_t len)
{
	__ASSERT_NO_MSG(opcode >= 0x80);

	LOG_DBG("service 0x%02x opcode 0x%02x", service, opcode);

	tester_send_with_index(service, opcode, BTP_INDEX, data, len);
}

void tester_rsp_full(uint8_t service, uint8_t opcode, const void *rsp, size_t len)
{
	struct btp_buf *cmd;

	__ASSERT_NO_MSG(opcode < 0x80);
	__ASSERT_NO_MSG(delayed_cmd != NULL);

	LOG_DBG("service 0x%02x opcode 0x%02x", service, opcode);

	tester_send_with_index(service, opcode, BTP_INDEX, rsp, len);

	cmd = delayed_cmd;
	delayed_cmd = NULL;

	(void)memset(cmd, 0, sizeof(*cmd));
	k_fifo_put(&avail_queue, cmd);
}

void tester_rsp(uint8_t service, uint8_t opcode, uint8_t status)
{
	struct btp_buf *cmd;

	__ASSERT_NO_MSG(opcode < 0x80);
	__ASSERT_NO_MSG(delayed_cmd != NULL);

	LOG_DBG("service 0x%02x opcode 0x%02x status 0x%02x", service, opcode, status);

	tester_rsp_with_index(service, opcode, BTP_INDEX, status);

	cmd = delayed_cmd;
	delayed_cmd = NULL;

	(void)memset(cmd, 0, sizeof(*cmd));
	k_fifo_put(&avail_queue, cmd);
}

uint16_t tester_supported_commands(uint8_t service, uint8_t *cmds)
{
	uint8_t opcode_max = 0;

	__ASSERT_NO_MSG(service <= BTP_SERVICE_ID_MAX);

	for (size_t i = 0; i < service_handler[service].num; i++) {
		const struct btp_handler *handler = &service_handler[service].handlers[i];

		tester_set_bit(cmds, handler->opcode);

		if (handler->opcode > opcode_max) {
			opcode_max = handler->opcode;
		}
	}

	/* bytes used to store supported commands bitmask */
	return (opcode_max / 8) + 1;
}
```

## src/btp_aics.c
```c
/* btp_aics.c - Bluetooth AICS Tester */

/*
 * Copyright (c) 2023 Codecoup
 *
 * SPDX-License-Identifier: Apache-2.0
 */

#include <stddef.h>
#include <errno.h>

#include <zephyr/types.h>
#include <zephyr/kernel.h>

#include <zephyr/bluetooth/bluetooth.h>
#include <zephyr/bluetooth/audio/audio.h>
#include <zephyr/bluetooth/audio/micp.h>
#include <zephyr/bluetooth/audio/aics.h>
#include <zephyr/logging/log.h>
#include <zephyr/sys/byteorder.h>

#include "bap_endpoint.h"
#include "btp/btp.h"

#define LOG_MODULE_NAME bttester_aics
LOG_MODULE_REGISTER(LOG_MODULE_NAME, CONFIG_BTTESTER_LOG_LEVEL);

#define BT_AICS_MAX_INPUT_DESCRIPTION_SIZE 16
#define BT_AICS_MAX_OUTPUT_DESCRIPTION_SIZE 16

struct btp_aics_instance aics_client_instance;
struct btp_aics_instance aics_server_instance;

static struct net_buf_simple *rx_ev_buf = NET_BUF_SIMPLE(BT_AICS_MAX_INPUT_DESCRIPTION_SIZE +
							 sizeof(struct btp_aics_description_ev));

static uint8_t aics_supported_commands(const void *cmd, uint16_t cmd_len, void *rsp,
				       uint16_t *rsp_len)
{
	struct btp_aics_read_supported_commands_rp *rp = rsp;

	/* octet 0 */
	tester_set_bit(rp->data, BTP_AICS_READ_SUPPORTED_COMMANDS);
	tester_set_bit(rp->data, BTP_AICS_SET_GAIN);
	tester_set_bit(rp->data, BTP_AICS_MUTE);
	tester_set_bit(rp->data, BTP_AICS_UNMUTE);
	tester_set_bit(rp->data, BTP_AICS_MAN_GAIN_SET);
	tester_set_bit(rp->data, BTP_AICS_AUTO_GAIN_SET);
	tester_set_bit(rp->data, BTP_AICS_SET_MAN_GAIN_ONLY);

	/* octet 1 */
	tester_set_bit(rp->data, BTP_AICS_SET_AUTO_GAIN_ONLY);
	tester_set_bit(rp->data, BTP_AICS_AUDIO_DESCRIPTION_SET);
	tester_set_bit(rp->data, BTP_AICS_MUTE_DISABLE);
	tester_set_bit(rp->data, BTP_AICS_GAIN_SETTING_PROP_GET);
	tester_set_bit(rp->data, BTP_AICS_TYPE_GET);
	tester_set_bit(rp->data, BTP_AICS_STATUS_GET);
	tester_set_bit(rp->data, BTP_AICS_STATE_GET);

	/* octet 2 */
	tester_set_bit(rp->data, BTP_AICS_DESCRIPTION_GET);

	*rsp_len = sizeof(*rp) + 2;

	return BTP_STATUS_SUCCESS;
}

void btp_send_aics_state_ev(struct bt_conn *conn, uint8_t att_status, int8_t gain, uint8_t mute,
			    uint8_t mode)
{
	struct btp_aics_state_ev ev;

	bt_addr_le_copy(&ev.address, bt_conn_get_dst(conn));

	ev.att_status = att_status;
	ev.gain = gain;
	ev.mute = mute;
	ev.mode = mode;

	tester_event(BTP_SERVICE_ID_AICS, BTP_AICS_STATE_EV, &ev, sizeof(ev));
}

void btp_send_gain_setting_properties_ev(struct bt_conn *conn,  uint8_t att_status, uint8_t units,
					 int8_t minimum, int8_t maximum)
{
	struct btp_gain_setting_properties_ev ev;

	bt_addr_le_copy(&ev.address, bt_conn_get_dst(conn));

	ev.att_status = att_status;
	ev.units = units;
	ev.minimum = minimum;
	ev.maximum = maximum;

	tester_event(BTP_SERVICE_ID_AICS, BTP_GAIN_SETTING_PROPERTIES_EV, &ev, sizeof(ev));
}

void btp_send_aics_input_type_event(struct bt_conn *conn, uint8_t att_status, uint8_t input_type)
{
	struct btp_aics_input_type_ev ev;

	bt_addr_le_copy(&ev.address, bt_conn_get_dst(conn));

	ev.att_status = att_status;
	ev.input_type = input_type;

	tester_event(BTP_SERVICE_ID_AICS, BTP_AICS_INPUT_TYPE_EV, &ev, sizeof(ev));
}

void btp_send_aics_status_ev(struct bt_conn *conn, uint8_t att_status, bool active)
{
	struct btp_aics_status_ev ev;

	bt_addr_le_copy(&ev.address, bt_conn_get_dst(conn));

	ev.att_status = att_status;
	ev.active = active;

	tester_event(BTP_SERVICE_ID_AICS, BTP_AICS_STATUS_EV, &ev, sizeof(ev));
}

void btp_send_aics_description_ev(struct bt_conn *conn, uint8_t att_status, uint8_t data_len,
				  char *description)
{
	struct btp_aics_description_ev *ev;

	net_buf_simple_init(rx_ev_buf, 0);

	ev = net_buf_simple_add(rx_ev_buf, sizeof(*ev));

	bt_addr_le_copy(&ev->address, bt_conn_get_dst(conn));

	ev->att_status = att_status;
	ev->data_len = data_len;
	memcpy(ev->data, description, data_len);

	tester_event(BTP_SERVICE_ID_AICS, BTP_AICS_DESCRIPTION_EV, ev, sizeof(*ev) + data_len);
}

void btp_send_aics_procedure_ev(struct bt_conn *conn, uint8_t att_status, uint8_t opcode)
{
	struct btp_aics_procedure_ev ev;

	bt_addr_le_copy(&ev.address, bt_conn_get_dst(conn));

	ev.att_status = att_status;
	ev.opcode = opcode;

	tester_event(BTP_SERVICE_ID_AICS, BTP_AICS_PROCEDURE_EV, &ev, sizeof(ev));
}

static uint8_t aics_set_gain(const void *cmd, uint16_t cmd_len, void *rsp, uint16_t *rsp_len)
{
	const struct btp_aics_set_gain_cmd *cp = cmd;

	LOG_DBG("AICS set gain %d", cp->gain);

	if (!bt_addr_le_eq(&cp->address, BT_ADDR_LE_ANY)) {
		if (bt_aics_gain_set(aics_client_instance.aics[0], cp->gain) != 0) {
			return BTP_STATUS_FAILED;
		}
	} else {
		for (uint8_t i = 0; i < aics_server_instance.aics_cnt; i++) {
			if (bt_aics_gain_set(aics_server_instance.aics[i], cp->gain) != 0) {
				return BTP_STATUS_FAILED;
			}
		}
	}

	return BTP_STATUS_SUCCESS;
}

static uint8_t aics_unmute(const void *cmd, uint16_t cmd_len, void *rsp, uint16_t *rsp_len)
{
	const struct btp_aics_unmute_cmd *cp = cmd;

	LOG_DBG("AICS Unmute");

	if (!bt_addr_le_eq(&cp->address, BT_ADDR_LE_ANY)) {
		if (bt_aics_unmute(aics_client_instance.aics[0]) != 0) {
			return BTP_STATUS_FAILED;
		}
	} else {
		for (uint8_t i = 0; i < aics_server_instance.aics_cnt; i++) {
			if (bt_aics_unmute(aics_server_instance.aics[i]) != 0) {
				return BTP_STATUS_FAILED;
			}
		}
	}

	return BTP_STATUS_SUCCESS;
}

static uint8_t aics_mute(const void *cmd, uint16_t cmd_len, void *rsp, uint16_t *rsp_len)
{
	const struct btp_aics_mute_cmd *cp = cmd;

	LOG_DBG("AICS Mute");

	if (!bt_addr_le_eq(&cp->address, BT_ADDR_LE_ANY)) {
		if (bt_aics_mute(aics_client_instance.aics[0]) != 0) {
			return BTP_STATUS_FAILED;
		}
	} else {
		for (uint8_t i = 0; i < aics_server_instance.aics_cnt; i++) {
			if (bt_aics_mute(aics_server_instance.aics[i]) != 0) {
				return BTP_STATUS_FAILED;
			}
		}
	}

	return BTP_STATUS_SUCCESS;
}

static uint8_t aics_state_get(const void *cmd, uint16_t cmd_len, void *rsp, uint16_t *rsp_len)
{
	const struct btp_aics_state_cmd *cp = cmd;

	LOG_DBG("AICS State");

	if (!bt_addr_le_eq(&cp->address, BT_ADDR_LE_ANY)) {
		if (bt_aics_state_get(aics_client_instance.aics[0]) != 0) {
			return BTP_STATUS_FAILED;
		}
	} else {
		for (uint8_t i = 0; i < aics_server_instance.aics_cnt; i++) {
			if (bt_aics_state_get(aics_server_instance.aics[i]) != 0) {
				return BTP_STATUS_FAILED;
			}
		}
	}

	return BTP_STATUS_SUCCESS;
}

static uint8_t aics_type_get(const void *cmd, uint16_t cmd_len, void *rsp, uint16_t *rsp_len)
{
	const struct btp_aics_type_cmd *cp = cmd;

	LOG_DBG("AICS Type");

	if (!bt_addr_le_eq(&cp->address, BT_ADDR_LE_ANY)) {
		if (bt_aics_type_get(aics_client_instance.aics[0]) != 0) {
			return BTP_STATUS_FAILED;
		}
	} else {
		for (uint8_t i = 0; i < aics_server_instance.aics_cnt; i++) {
			if (bt_aics_type_get(aics_server_instance.aics[i]) != 0) {
				return BTP_STATUS_FAILED;
			}
		}
	}

	return BTP_STATUS_SUCCESS;
}

static uint8_t aics_status_get(const void *cmd, uint16_t cmd_len, void *rsp, uint16_t *rsp_len)
{
	const struct btp_aics_status_cmd *cp = cmd;

	LOG_DBG("AICS Status");

	if (!bt_addr_le_eq(&cp->address, BT_ADDR_LE_ANY)) {
		if (bt_aics_status_get(aics_client_instance.aics[0]) != 0) {
			return BTP_STATUS_FAILED;
		}
	} else {
		for (uint8_t i = 0; i < aics_server_instance.aics_cnt; i++) {
			if (bt_aics_status_get(aics_server_instance.aics[i]) != 0) {
				return BTP_STATUS_FAILED;
			}
		}
	}

	return BTP_STATUS_SUCCESS;
}

static uint8_t aics_gain_setting_prop_get(const void *cmd, uint16_t cmd_len, void *rsp,
					  uint16_t *rsp_len)
{
	const struct btp_aics_gain_setting_prop_cmd *cp = cmd;

	LOG_DBG("AICS Gain settings properties");

	if (!bt_addr_le_eq(&cp->address, BT_ADDR_LE_ANY)) {
		if (bt_aics_gain_setting_get(aics_client_instance.aics[0]) != 0) {
			return BTP_STATUS_FAILED;
		}
	} else {
		for (uint8_t i = 0; i < aics_server_instance.aics_cnt; i++) {
			if (bt_aics_gain_setting_get(aics_server_instance.aics[i]) != 0) {
				return BTP_STATUS_FAILED;
			}
		}
	}

	return BTP_STATUS_SUCCESS;
}

static uint8_t aics_man_gain_set(const void *cmd, uint16_t cmd_len, void *rsp, uint16_t *rsp_len)
{
	const struct btp_aics_manual_gain_cmd *cp = cmd;

	LOG_DBG("AICS set manual gain mode");

	if (!bt_addr_le_eq(&cp->address, BT_ADDR_LE_ANY)) {
		if (bt_aics_manual_gain_set(aics_client_instance.aics[0]) != 0) {
			return BTP_STATUS_FAILED;
		}
	} else {
		for (uint8_t i = 0; i < aics_server_instance.aics_cnt; i++) {
			if (bt_aics_manual_gain_set(aics_server_instance.aics[i]) != 0) {
				return BTP_STATUS_FAILED;
			}
		}
	}

	return BTP_STATUS_SUCCESS;
}

static uint8_t aics_auto_gain_set(const void *cmd, uint16_t cmd_len, void *rsp, uint16_t *rsp_len)
{
	const struct btp_aics_auto_gain_cmd *cp = cmd;

	LOG_DBG("AICS set automatic gain mode");

	if (!bt_addr_le_eq(&cp->address, BT_ADDR_LE_ANY)) {
		if (bt_aics_automatic_gain_set(aics_client_instance.aics[0]) != 0) {
			return BTP_STATUS_FAILED;
		}
	} else {
		for (uint8_t i = 0; i < aics_server_instance.aics_cnt; i++) {
			if (bt_aics_automatic_gain_set(aics_server_instance.aics[i]) != 0) {
				return BTP_STATUS_FAILED;
			}
		}
	}

	return BTP_STATUS_SUCCESS;
}

static uint8_t aics_set_man_gain_only(const void *cmd, uint16_t cmd_len, void *rsp,
				      uint16_t *rsp_len)
{
	LOG_DBG("AICS manual gain only set");

	for (uint8_t i = 0; i < aics_server_instance.aics_cnt; i++) {
		if (bt_aics_gain_set_manual_only(aics_server_instance.aics[i]) != 0) {
			return BTP_STATUS_FAILED;
		}
	}

	return BTP_STATUS_SUCCESS;
}

static uint8_t aics_set_auto_gain_only(const void *cmd, uint16_t cmd_len, void *rsp,
				       uint16_t *rsp_len)
{
	LOG_DBG("AICS auto gain only set");

	for (uint8_t i = 0; i < aics_server_instance.aics_cnt; i++) {
		if (bt_aics_gain_set_auto_only(aics_server_instance.aics[i]) != 0) {
			return BTP_STATUS_FAILED;
		}
	}

	return BTP_STATUS_SUCCESS;
}

static uint8_t aics_mute_disable(const void *cmd, uint16_t cmd_len, void *rsp, uint16_t *rsp_len)
{
	LOG_DBG("AICS disable mute");

	for (uint8_t i = 0; i < aics_server_instance.aics_cnt; i++) {
		if (bt_aics_disable_mute(aics_server_instance.aics[i]) != 0) {
			return BTP_STATUS_FAILED;
		}
	}

	return BTP_STATUS_SUCCESS;
}

static uint8_t aics_desc_set(const void *cmd, uint16_t cmd_len, void *rsp, uint16_t *rsp_len)
{
	const struct btp_aics_audio_desc_cmd *cp = cmd;
	char description[BT_AICS_MAX_INPUT_DESCRIPTION_SIZE];

	LOG_DBG("AICS set description");

	if (cmd_len < sizeof(*cp) || cmd_len != sizeof(*cp) + cp->desc_len) {
		return BTP_STATUS_FAILED;
	}

	if (cp->desc_len >= sizeof(description)) {
		return BTP_STATUS_FAILED;
	}

	if (cp->desc_len > (BT_AICS_MAX_INPUT_DESCRIPTION_SIZE - 1)) {
		return BTP_STATUS_FAILED;
	}

	memcpy(description, cp->desc, cp->desc_len);
	description[cp->desc_len] = '\0';

	for (uint8_t i = 0; i < aics_server_instance.aics_cnt; i++) {
		if (bt_aics_description_set(aics_server_instance.aics[i], description) != 0) {
			return BTP_STATUS_FAILED;
		}
	}

	return BTP_STATUS_SUCCESS;
}

static uint8_t aics_desc_get(const void *cmd, uint16_t cmd_len, void *rsp, uint16_t *rsp_len)
{
	const struct btp_aics_desc_cmd *cp = cmd;

	LOG_DBG("AICS Description");

	if (!bt_addr_le_eq(&cp->address, BT_ADDR_LE_ANY)) {
		if (bt_aics_description_get(aics_client_instance.aics[0]) != 0) {
			return BTP_STATUS_FAILED;
		}
	} else {
		for (uint8_t i = 0; i < aics_server_instance.aics_cnt; i++) {
			if (bt_aics_description_get(aics_server_instance.aics[i]) != 0) {
				return BTP_STATUS_FAILED;
			}
		}
	}

	return BTP_STATUS_SUCCESS;
}

static const struct btp_handler aics_handlers[] = {
	{
		.opcode = BTP_AICS_READ_SUPPORTED_COMMANDS,
		.index = BTP_INDEX_NONE,
		.expect_len = 0,
		.func = aics_supported_commands,
	},
	{
		.opcode = BTP_AICS_SET_GAIN,
		.expect_len = sizeof(struct btp_aics_set_gain_cmd),
		.func = aics_set_gain,
	},
	{
		.opcode = BTP_AICS_MUTE,
		.expect_len = sizeof(struct btp_aics_mute_cmd),
		.func = aics_mute,
	},
	{
		.opcode = BTP_AICS_UNMUTE,
		.expect_len = sizeof(struct btp_aics_unmute_cmd),
		.func = aics_unmute,
	},
	{
		.opcode = BTP_AICS_GAIN_SETTING_PROP_GET,
		.expect_len = sizeof(struct btp_aics_gain_setting_prop_cmd),
		.func = aics_gain_setting_prop_get,
	},
	{
		.opcode = BTP_AICS_MUTE_DISABLE,
		.expect_len = 0,
		.func = aics_mute_disable,
	},
	{
		.opcode = BTP_AICS_MAN_GAIN_SET,
		.expect_len = sizeof(struct btp_aics_manual_gain_cmd),
		.func = aics_man_gain_set,
	},
	{
		.opcode = BTP_AICS_AUTO_GAIN_SET,
		.expect_len = sizeof(struct btp_aics_auto_gain_cmd),
		.func = aics_auto_gain_set,
	},
	{
		.opcode = BTP_AICS_SET_AUTO_GAIN_ONLY,
		.expect_len = 0,
		.func = aics_set_auto_gain_only,
	},
	{
		.opcode = BTP_AICS_SET_MAN_GAIN_ONLY,
		.expect_len = 0,
		.func = aics_set_man_gain_only,
	},
	{
		.opcode = BTP_AICS_AUDIO_DESCRIPTION_SET,
		.expect_len = BTP_HANDLER_LENGTH_VARIABLE,
		.func = aics_desc_set,
	},
	{
		.opcode = BTP_AICS_DESCRIPTION_GET,
		.expect_len = sizeof(struct btp_aics_desc_cmd),
		.func = aics_desc_get,
	},
	{
		.opcode = BTP_AICS_TYPE_GET,
		.expect_len = sizeof(struct btp_aics_type_cmd),
		.func = aics_type_get,
	},
	{
		.opcode = BTP_AICS_STATUS_GET,
		.expect_len = sizeof(struct btp_aics_status_cmd),
		.func = aics_status_get,
	},
	{
		.opcode = BTP_AICS_STATE_GET,
		.expect_len = sizeof(struct btp_aics_state_cmd),
		.func = aics_state_get,
	},
};

static void aics_state_cb(struct bt_aics *inst, int err, int8_t gain, uint8_t mute, uint8_t mode)
{
	struct bt_conn *conn;

	bt_aics_client_conn_get(inst, &conn);

	if (err) {
		if (err < 0) {
			err = BT_ATT_ERR_UNLIKELY;
		}
		btp_send_aics_state_ev(conn, err, 0, 0, 0);
	} else {
		btp_send_aics_state_ev(conn, 0, gain, mute, mode);
	}

	LOG_DBG("AICS state callback (%d)", err);
}

static void aics_gain_setting_cb(struct bt_aics *inst, int err, uint8_t units, int8_t minimum,
				 int8_t maximum)
{
	struct bt_conn *conn;

	bt_aics_client_conn_get(inst, &conn);
	btp_send_gain_setting_properties_ev(conn, err, units, minimum, maximum);

	LOG_DBG("AICS gain setting callback (%d)", err);
}

static void aics_input_type_cb(struct bt_aics *inst, int err, uint8_t input_type)
{
	struct bt_conn *conn;

	bt_aics_client_conn_get(inst, &conn);
	btp_send_aics_input_type_event(conn, err, input_type);

	LOG_DBG("AICS input type callback (%d)", err);
}

static void aics_status_cb(struct bt_aics *inst, int err, bool active)
{
	struct bt_conn *conn;

	bt_aics_client_conn_get(inst, &conn);
	btp_send_aics_status_ev(conn, err, active);

	LOG_DBG("AICS status callback (%d)", err);
}

static void aics_description_cb(struct bt_aics *inst, int err, char *description)
{
	struct bt_conn *conn;
	uint8_t data_len = strlen(description);

	bt_aics_client_conn_get(inst, &conn);
	btp_send_aics_description_ev(conn, err, data_len, description);

	LOG_DBG("AICS description callback (%d)", err);
}

static void aics_set_gain_cb(struct bt_aics *inst, int err)
{
	struct bt_conn *conn;

	bt_aics_client_conn_get(inst, &conn);

	btp_send_aics_procedure_ev(conn, err, BTP_AICS_SET_GAIN);

	LOG_DBG("AICS set gain cb (%d)", err);
}

static void aics_mute_cb(struct bt_aics *inst, int err)
{
	struct bt_conn *conn;

	bt_aics_client_conn_get(inst, &conn);

	btp_send_aics_procedure_ev(conn, err, BTP_AICS_MUTE);

	LOG_DBG("AICS mute cb (%d)", err);
}

static void aics_unmute_cb(struct bt_aics *inst, int err)
{
	struct bt_conn *conn;

	bt_aics_client_conn_get(inst, &conn);

	btp_send_aics_procedure_ev(conn, err, BTP_AICS_UNMUTE);

	LOG_DBG("AICS unmute cb (%d)", err);
}

static void aics_set_man_gain_cb(struct bt_aics *inst, int err)
{
	struct bt_conn *conn;

	bt_aics_client_conn_get(inst, &conn);

	btp_send_aics_procedure_ev(conn, err, BTP_AICS_MAN_GAIN_SET);

	LOG_DBG("AICS set manual gain cb (%d)", err);
}

static void aics_set_auto_gain_cb(struct bt_aics *inst, int err)
{
	struct bt_conn *conn;

	bt_aics_client_conn_get(inst, &conn);

	btp_send_aics_procedure_ev(conn, err, BTP_AICS_AUTO_GAIN_SET);

	LOG_DBG("AICS set automatic gain cb (%d)", err);
}

struct bt_aics_cb aics_client_cb = {
	.state = aics_state_cb,
	.gain_setting = aics_gain_setting_cb,
	.type = aics_input_type_cb,
	.status = aics_status_cb,
	.description = aics_description_cb,
#if defined(CONFIG_BT_AICS_CLIENT)
	.set_gain = aics_set_gain_cb,
	.unmute = aics_unmute_cb,
	.mute = aics_mute_cb,
	.set_manual_mode = aics_set_man_gain_cb,
	.set_auto_mode = aics_set_auto_gain_cb
#endif /* CONFIG_BT_AICS_CLIENT */
};

uint8_t tester_init_aics(void)
{
	tester_register_command_handlers(BTP_SERVICE_ID_AICS, aics_handlers,
					 ARRAY_SIZE(aics_handlers));

	return BTP_STATUS_SUCCESS;
}

uint8_t tester_unregister_aics(void)
{
	return BTP_STATUS_SUCCESS;
}
```

## src/btp_avctp.c
```c
/* btp_avctp.c - Bluetooth AVCTP Tester */

/*
 * Copyright 2025 NXP
 *
 * SPDX-License-Identifier: Apache-2.0
 */
#include <errno.h>
#include <stdbool.h>
#include <stdint.h>
#include <string.h>

#include <zephyr/autoconf.h>
#include <zephyr/bluetooth/addr.h>
#include <zephyr/bluetooth/bluetooth.h>
#include <zephyr/bluetooth/classic/sdp.h>
#include <zephyr/logging/log.h>
#include <zephyr/net_buf.h>
#include <zephyr/sys/byteorder.h>
#include <zephyr/sys/util.h>
#include <zephyr/sys/util_macro.h>

#include "btp/btp.h"

#define LOG_MODULE_NAME bttester_avctp
LOG_MODULE_REGISTER(LOG_MODULE_NAME, CONFIG_BTTESTER_LOG_LEVEL);

static uint8_t avctp_read_supported_commands(const void *cmd, uint16_t cmd_len, void *rsp,
					     uint16_t *rsp_len)
{
	struct btp_avctp_read_supported_commands_rp *rp = rsp;

	*rsp_len = tester_supported_commands(BTP_SERVICE_ID_AVCTP, rp->data);
	*rsp_len += sizeof(*rp);

	return BTP_STATUS_SUCCESS;
}

static const struct btp_handler avctp_handlers[] = {
	{.opcode = BTP_AVCTP_READ_SUPPORTED_COMMANDS,
	 .index = BTP_INDEX_NONE,
	 .expect_len = 0,
	 .func = avctp_read_supported_commands},
};

uint8_t tester_init_avctp(void)
{
	tester_register_command_handlers(BTP_SERVICE_ID_AVCTP, avctp_handlers,
					 ARRAY_SIZE(avctp_handlers));

	return BTP_STATUS_SUCCESS;
}

uint8_t tester_unregister_avctp(void)
{
	return BTP_STATUS_SUCCESS;
}
```

## src/btp_avdtp.c
```c
/* btp_avdtp.c - Bluetooth AVDTP Tester */

/*
 * Copyright (c) 2025 Intel Corporation
 *
 * SPDX-License-Identifier: Apache-2.0
 */

#include <errno.h>
#include <stddef.h>
#include <stdint.h>
#include <string.h>

#include "btp/btp.h"

static uint8_t supported_commands(const void *cmd, uint16_t cmd_len, void *rsp, uint16_t *rsp_len)
{
	struct btp_avdtp_read_supported_commands_rp *rp = rsp;

	*rsp_len = tester_supported_commands(BTP_SERVICE_ID_AVDTP, rp->data);
	*rsp_len += sizeof(*rp);

	return BTP_STATUS_SUCCESS;
}

static const struct btp_handler handlers[] = {
	{
		.opcode = BTP_AVDTP_READ_SUPPORTED_COMMANDS,
		.index = BTP_INDEX_NONE,
		.expect_len = 0,
		.func = supported_commands,
	},
};

uint8_t tester_init_avdtp(void)
{
	tester_register_command_handlers(BTP_SERVICE_ID_AVDTP, handlers, ARRAY_SIZE(handlers));
	return BTP_STATUS_SUCCESS;
}

uint8_t tester_unregister_avdtp(void)
{
	return BTP_STATUS_SUCCESS;
}
```

## src/btp_bap_audio_stream.c
```c
/* btp_bap_audio_stream.c - Bluetooth BAP Tester */

/*
 * Copyright (c) 2023 Codecoup
 *
 * SPDX-License-Identifier: Apache-2.0
 */


#include <stddef.h>
#include <errno.h>

#include <zephyr/types.h>
#include <zephyr/kernel.h>
#include <zephyr/sys/ring_buffer.h>

#include <zephyr/logging/log.h>
#include <zephyr/sys/byteorder.h>
#define LOG_MODULE_NAME bttester_bap_audio_stream
LOG_MODULE_REGISTER(LOG_MODULE_NAME, CONFIG_BTTESTER_LOG_LEVEL);
#include "btp/btp.h"
#include "btp_bap_audio_stream.h"

NET_BUF_POOL_FIXED_DEFINE(tx_pool, MAX(CONFIG_BT_ASCS_ASE_SRC_COUNT,
			  CONFIG_BT_BAP_UNICAST_CLIENT_ASE_SRC_COUNT),
			  BT_ISO_SDU_BUF_SIZE(CONFIG_BT_ISO_TX_MTU), 8, NULL);

RING_BUF_DECLARE(audio_ring_buf, CONFIG_BT_ISO_TX_MTU);

#define ISO_DATA_THREAD_STACK_SIZE 512
#define ISO_DATA_THREAD_PRIORITY -7
K_THREAD_STACK_DEFINE(iso_data_thread_stack_area, ISO_DATA_THREAD_STACK_SIZE);
static struct k_work_q iso_data_work_q;
static bool send_worker_inited;

static inline struct bt_bap_stream *audio_stream_to_bap_stream(struct btp_bap_audio_stream *stream)
{
	return &stream->cap_stream.bap_stream;
}

static void audio_clock_timeout(struct k_work *work)
{
	struct btp_bap_audio_stream *stream;
	struct k_work_delayable *dwork;

	dwork = k_work_delayable_from_work(work);
	stream = CONTAINER_OF(dwork, struct btp_bap_audio_stream, audio_clock_work);
	atomic_inc(&stream->seq_num);

	k_work_schedule(dwork, K_USEC(audio_stream_to_bap_stream(stream)->qos->interval));
}

static void audio_send_timeout(struct k_work *work)
{
	struct bt_iso_tx_info info;
	struct btp_bap_audio_stream *stream;
	struct bt_bap_stream *bap_stream;
	struct k_work_delayable *dwork;
	struct net_buf *buf;
	uint32_t size;
	uint8_t *data;
	int err;

	dwork = k_work_delayable_from_work(work);
	stream = CONTAINER_OF(dwork, struct btp_bap_audio_stream, audio_send_work);
	bap_stream = audio_stream_to_bap_stream(stream);

	if (stream->last_req_seq_num % 201 == 200) {
		err = bt_bap_stream_get_tx_sync(bap_stream, &info);
		if (err != 0) {
			LOG_DBG("Failed to get last seq num: err %d", err);
		} else if (stream->last_req_seq_num > info.seq_num) {
			LOG_DBG("Previous TX request rejected by the controller: requested seq %u,"
				" last accepted seq %u", stream->last_req_seq_num, info.seq_num);
			stream->last_sent_seq_num = info.seq_num;
		} else {
			LOG_DBG("Host and Controller sequence number is in sync.");
			stream->last_sent_seq_num = info.seq_num;
		}
		/* TODO: Synchronize the Host clock with the Controller clock */
	}

	/* Get buffer within a ring buffer memory */
	size = ring_buf_get_claim(&audio_ring_buf, &data, bap_stream->qos->sdu);
	if (size > 0) {
		buf = net_buf_alloc(&tx_pool, K_NO_WAIT);
		if (!buf) {
			LOG_ERR("Cannot allocate net_buf. Dropping data.");
		} else {
			net_buf_reserve(buf, BT_ISO_CHAN_SEND_RESERVE);
			net_buf_add_mem(buf, data, size);

			/* Because the seq_num field of the audio_stream struct is atomic_val_t
			 * (4 bytes), let's allow an overflow and just cast it to uint16_t.
			 */
			stream->last_req_seq_num = (uint16_t)atomic_get(&stream->seq_num);

			LOG_DBG("Sending data to stream %p len %d seq %d", bap_stream, size,
				stream->last_req_seq_num);

			err = bt_bap_stream_send(bap_stream, buf, 0, BT_ISO_TIMESTAMP_NONE);
			if (err != 0) {
				LOG_ERR("Failed to send audio data to stream %p, err %d",
					bap_stream, err);
				net_buf_unref(buf);
			}
		}

		/* Free ring buffer memory */
		err = ring_buf_get_finish(&audio_ring_buf, size);
		if (err != 0) {
			LOG_ERR("Error freeing ring buffer memory: %d", err);
		}
	}

	k_work_schedule_for_queue(&iso_data_work_q, dwork,
				  K_USEC(bap_stream->qos->interval));
}

void btp_bap_audio_stream_started(struct btp_bap_audio_stream *a_stream)
{
	struct bt_bap_ep_info info;
	struct bt_bap_stream *bap_stream = audio_stream_to_bap_stream(a_stream);

	/* Callback called on transition to Streaming state */

	LOG_DBG("Started stream %p", bap_stream);

	(void)bt_bap_ep_get_info(bap_stream->ep, &info);
	if (info.can_send == true) {
		/* Schedule first TX ISO data at seq_num 1 instead of 0 to ensure
		 * we are in sync with the controller at start of streaming.
		 */
		a_stream->seq_num = 1;

		/* Run audio clock work in system work queue */
		k_work_init_delayable(&a_stream->audio_clock_work, audio_clock_timeout);
		k_work_schedule(&a_stream->audio_clock_work, K_NO_WAIT);

		/* Run audio send work in user defined work queue */
		k_work_init_delayable(&a_stream->audio_send_work, audio_send_timeout);
		k_work_schedule_for_queue(&iso_data_work_q, &a_stream->audio_send_work,
					  K_USEC(bap_stream->qos->interval));
	}
}

void btp_bap_audio_stream_stopped(struct btp_bap_audio_stream *a_stream)
{
	/* Stop send timer */
	k_work_cancel_delayable(&a_stream->audio_clock_work);
	k_work_cancel_delayable(&a_stream->audio_send_work);
}

uint8_t btp_bap_audio_stream_send(const void *cmd, uint16_t cmd_len,
				  void *rsp, uint16_t *rsp_len)
{
	struct btp_bap_send_rp *rp = rsp;
	const struct btp_bap_send_cmd *cp = cmd;
	uint32_t ret;

	ret = ring_buf_put(&audio_ring_buf, cp->data, cp->data_len);

	rp->data_len = ret;
	*rsp_len = sizeof(*rp) + 1;

	return BTP_STATUS_SUCCESS;
}

int btp_bap_audio_stream_init_send_worker(void)
{
	if (send_worker_inited) {
		return 0;
	}

	k_work_queue_init(&iso_data_work_q);
	k_work_queue_start(&iso_data_work_q, iso_data_thread_stack_area,
			   K_THREAD_STACK_SIZEOF(iso_data_thread_stack_area),
			   ISO_DATA_THREAD_PRIORITY, NULL);

	send_worker_inited = true;

	return 0;
}
```

## src/btp_bap_audio_stream.h
```c
/* btp_bap_audio_stream.h - Bluetooth BAP Tester */

/*
 * Copyright (c) 2023 Codecoup
 *
 * SPDX-License-Identifier: Apache-2.0
 */

#include <zephyr/bluetooth/audio/cap.h>

struct btp_bap_audio_stream {
	struct bt_cap_stream cap_stream;
	atomic_t seq_num;
	uint16_t last_req_seq_num;
	uint16_t last_sent_seq_num;
	struct k_work_delayable audio_clock_work;
	struct k_work_delayable audio_send_work;
};

int btp_bap_audio_stream_init_send_worker(void);
void btp_bap_audio_stream_started(struct btp_bap_audio_stream *stream);
void btp_bap_audio_stream_stopped(struct btp_bap_audio_stream *a_stream);
uint8_t btp_bap_audio_stream_send(const void *cmd, uint16_t cmd_len, void *rsp, uint16_t *rsp_len);
```
