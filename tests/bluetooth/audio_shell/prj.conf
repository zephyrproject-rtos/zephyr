## CMakeLists.txt
```
# SPDX-License-Identifier: Apache-2.0

cmake_minimum_required(VERSION 3.13.1)
find_package(Zephyr HINTS $ENV{ZEPHYR_BASE})
project(bluetooth_audio_shell)

target_sources(app PRIVATE src/main.c)
```

## prj.conf
```kconfig
CONFIG_TEST=y
CONFIG_CONSOLE_HANDLER=y
CONFIG_USERSPACE=n

CONFIG_BT=y
CONFIG_BT_SHELL=y
CONFIG_BT_CENTRAL=y
CONFIG_BT_PERIPHERAL=y
CONFIG_BT_GATT_CLIENT=y
CONFIG_BT_DEVICE_NAME="Zephyr Audio"
# Needed to test BASS
CONFIG_BT_PER_ADV=y
CONFIG_BT_EXT_ADV_LEGACY_SUPPORT=y
CONFIG_BT_CTLR_ADV_EXT=y
# Needed to test CSIP
CONFIG_BT_MAX_CONN=4

CONFIG_BT_AUDIO=y
CONFIG_BT_AUDIO_UNICAST_SERVER=y
CONFIG_BT_AUDIO_UNICAST_CLIENT=y
CONFIG_BT_AUDIO_BROADCAST_SOURCE=y
CONFIG_BT_AUDIO_BROADCAST_SINK=y
CONFIG_BT_BAP=y

# Coordinated Set Identification
CONFIG_BT_CSIS=y
CONFIG_BT_CSIP=y
CONFIG_BT_CSIP_MAX_CSIS_INSTANCES=2

# Media control
CONFIG_BT_MCS=y
CONFIG_BT_MCS_MEDIA_PLAYER_NAME_MAX=30
CONFIG_BT_MCS_MEDIA_PLAYER_NAME="My media player"
CONFIG_BT_MCS_ICON_URL_MAX=27
CONFIG_BT_MCS_ICON_URL="http://www.somecompany.com"
CONFIG_BT_MCS_TRACK_TITLE_MAX=40
CONFIG_BT_MCS_GROUP_TITLE_MAX=40
CONFIG_BT_MCS_SEGMENT_NAME_MAX=35
CONFIG_BT_MCS_ICON_BITMAP_SIZE=321
CONFIG_BT_MCC=y
CONFIG_BT_MCC_OTS=y
CONFIG_BT_MCC_SHELL=y
CONFIG_BT_MCC_TOTAL_OBJ_CONTENT_MEM=4096
# TODO Check which value is sensible in the line below
# Must be larger than any of the object sizes - icon, track, group, segments, ...
CONFIG_BT_MCS_MAX_OBJ_SIZE=600
CONFIG_BT_MCS_TRACK_MAX_SIZE=50
CONFIG_BT_MCS_TRACK_SEG_MAX_SIZE=500
CONFIG_BT_MCS_GROUP_MAX_SIZE=552

# Object Transfer
CONFIG_BT_OTS=y
CONFIG_BT_OTS_SECONDARY_SVC=y
CONFIG_BT_OTS_MAX_OBJ_CNT=50
CONFIG_BT_OTC=y

# Broadcast Audio Scan Service and client
CONFIG_BT_BASS=y
CONFIG_BT_BASS_CLIENT=y

# Call control and telephone bearer
CONFIG_BT_TBS=y
CONFIG_BT_TBS_SUPPORTED_FEATURES=3
CONFIG_BT_TBS_TECHNOLOGY=1
CONFIG_BT_TBS_STATUS_FLAGS=3
CONFIG_BT_CCP=y
CONFIG_BT_CCP_MAX_CALLS=2

# Services that are now upstreamed, to avoid the "No SOURCES given [...]" error
CONFIG_BT_VCS=y

CONFIG_BT_VOCS_MAX_INSTANCE_COUNT=1
CONFIG_BT_VOCS_CLIENT_MAX_INSTANCE_COUNT=1

CONFIG_BT_AICS_MAX_INSTANCE_COUNT=2
CONFIG_BT_AICS_CLIENT_MAX_INSTANCE_COUNT=2

CONFIG_BT_VCS_VOCS_INSTANCE_COUNT=1
CONFIG_BT_VCS_AICS_INSTANCE_COUNT=1
CONFIG_BT_VCS_CLIENT=y
CONFIG_BT_VCS_CLIENT_MAX_VOCS_INST=1
CONFIG_BT_VCS_CLIENT_MAX_AICS_INST=1

CONFIG_BT_MICS=y
CONFIG_BT_MICS_AICS_INSTANCE_COUNT=1
CONFIG_BT_MICS_CLIENT=y
CONFIG_BT_MICS_CLIENT_MAX_AICS_INST=1


# DEBUGGING
CONFIG_BT_DEBUG_LOG=y
CONFIG_BT_AUDIO_DEBUG=y
CONFIG_BT_DEBUG_MCS=y
CONFIG_BT_DEBUG_MCC=y
CONFIG_BT_OTS_LOG_LEVEL_DBG=y
CONFIG_BT_DEBUG_OTC=y
CONFIG_BT_DEBUG_MEDIA_PROXY=y
CONFIG_BT_DEBUG_CSIS=y
CONFIG_BT_DEBUG_CSIS_CRYPTO=y
CONFIG_BT_DEBUG_CSIP=y
CONFIG_BT_DEBUG_TBS=y
CONFIG_BT_DEBUG_CCP=y
CONFIG_BT_DEBUG_PACS=y
CONFIG_BT_AUDIO_DEBUG_STREAM=y
CONFIG_BT_AUDIO_DEBUG_CAPABILITIES=y
CONFIG_BT_AUDIO_DEBUG_BROADCAST_SOURCE=y
CONFIG_BT_AUDIO_DEBUG_BROADCAST_SINK=y
CONFIG_BT_AUDIO_DEBUG_UNICAST_SERVER=y
CONFIG_BT_DEBUG_ASCS=y
CONFIG_BT_DEBUG_BAP=y
CONFIG_BT_DEBUG_BASS=y
CONFIG_BT_DEBUG_BASS_CLIENT=y

# LOGGING
CONFIG_TEST_LOGGING_DEFAULTS=n
CONFIG_LOG_PRINTK=n
CONFIG_LOG_MODE_IMMEDIATE=n
CONFIG_LOG_STRDUP_MAX_STRING=66
CONFIG_LOG_STRDUP_BUF_COUNT=50
CONFIG_LOG_BUFFER_SIZE=5000

# TESTING
CONFIG_BT_TESTING=y

# BUFFERS AND STACKS
# MCS requires additional buffers
# (Actual requirements not checked - these are "large enough")
CONFIG_BT_L2CAP_TX_BUF_COUNT=20
CONFIG_BT_CONN_TX_MAX=20

# VARIOUS
CONFIG_HW_STACK_PROTECTION=y
```

## boards/native_posix.conf
```kconfig
CONFIG_LOG_MODE_IMMEDIATE=y
CONFIG_NO_OPTIMIZATIONS=y
# Allows for copying larger amount of data into the shell
CONFIG_SHELL_BACKEND_SERIAL_RX_RING_BUFFER_SIZE=4096
#Enable TINYCRYPT for native_posix; needed for CSIS
CONFIG_BT_TINYCRYPT_ECC=y
```

## src/main.c
```c
/** @file
 *  @brief Interactive Bluetooth Audio shell application
 */

/*
 * Copyright (c) 2018 Intel Corporation
 *
 * SPDX-License-Identifier: Apache-2.0
 */

#include <sys/printk.h>
#include <zephyr.h>

#include <shell/shell.h>
#include <shell/shell_uart.h>

void main(void)
{
	printk("Type \"help\" for supported commands.\n");
	printk("Before any Bluetooth commands you must `bt init` to initialize "
	       "the bluetooth stack.\n");
}
```
