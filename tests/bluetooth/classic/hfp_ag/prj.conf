## prj.conf
```kconfig
CONFIG_BT=y
CONFIG_BT_CLASSIC=y
CONFIG_BT_SHELL=y
CONFIG_LOG=y
CONFIG_ZTEST=y
CONFIG_BT_HFP_HF=y
CONFIG_BT_HFP_AG=y
CONFIG_BT_HFP_AG_OUTGOING_TIMEOUT=10
CONFIG_BT_HFP_AG_INCOMING_TIMEOUT=10
CONFIG_BT_HFP_HF_CODEC_NEG=y
CONFIG_BT_HFP_AG_CODEC_NEG=y
CONFIG_BT_HFP_HF_ECNR=y
CONFIG_BT_HFP_AG_ECNR=y
CONFIG_BT_HFP_HF_3WAY_CALL=y
CONFIG_BT_HFP_AG_3WAY_CALL=y
CONFIG_BT_HFP_HF_VOICE_RECG_TEXT=y
CONFIG_BT_HFP_AG_VOICE_RECG_TEXT=y
CONFIG_BT_HFP_AG_VOICE_TAG=y
CONFIG_BT_HFP_HF_HF_INDICATOR_ENH_SAFETY=y
CONFIG_BT_HFP_HF_HF_INDICATOR_BATTERY=y
CONFIG_BT_HFP_AG_HF_INDICATOR_ENH_SAFETY=y
CONFIG_BT_HFP_AG_HF_INDICATOR_BATTERY=y
CONFIG_BT_HFP_AG_VOICE_TAG=y
CONFIG_BT_HFP_HF_VOLUME=y
CONFIG_BT_HFP_HF_ECS=y
CONFIG_BT_HFP_HF_CODEC_MSBC=y
CONFIG_BT_HFP_HF_CODEC_LC3_SWB=y
CONFIG_BT_HFP_AG_ECS=y
CONFIG_BT_HFP_AG_CODEC_MSBC=y
CONFIG_BT_HFP_AG_CODEC_LC3_SWB=y
CONFIG_BT_HFP_HF_CLI=y

CONFIG_BT_DEVICE_NAME="hfp_ag"
CONFIG_BT_HFP_AG_TX_BUF_COUNT=20

CONFIG_BT_CREATE_CONN_TIMEOUT=30
CONFIG_BT_PAGE_TIMEOUT=0xFFFF
```

## src/test_hfp_ag.c
```c
/*
 * Copyright 2025 NXP
 *
 * SPDX-License-Identifier: Apache-2.0
 */

#include <errno.h>
#include <zephyr/types.h>
#include <stddef.h>
#include <stdlib.h>
#include <string.h>
#include <zephyr/sys/byteorder.h>
#include <zephyr/kernel.h>
#include <zephyr/settings/settings.h>

#include <zephyr/bluetooth/hci.h>
#include <zephyr/bluetooth/bluetooth.h>
#include <zephyr/bluetooth/conn.h>
#include <zephyr/bluetooth/l2cap.h>
#include <zephyr/bluetooth/classic/hfp_hf.h>
#include <zephyr/bluetooth/classic/hfp_ag.h>

#include <zephyr/shell/shell.h>

#include "host/shell/bt.h"
#include "common/bt_shell_private.h"

#define HELP_NONE "[none]"

extern struct bt_hfp_hf_cb hf_cb;
extern struct bt_hfp_ag_cb ag_cb;
static struct bt_hfp_hf_cb hf_cb_test;
static struct bt_hfp_ag_cb ag_cb_test;

static int cmd_enable_codec_neg(const struct shell *sh, size_t argc, char **argv)
{
	bool is_neg = strtoul(argv[1], NULL, 10) == 0 ? false : true;

	if (is_neg) {
		hf_cb.codec_negotiate = hf_cb_test.codec_negotiate;
		bt_shell_print("enabled codec_neg cb");
	} else {
		hf_cb.codec_negotiate = NULL;
		bt_shell_print("disabled codec_neg cb");
	}

	return 0;
}

SHELL_STATIC_SUBCMD_SET_CREATE(ag_cmds,
	SHELL_CMD_ARG(enable_codec_neg, NULL, "Enable codec negotiate callback [0/1]",
		      cmd_enable_codec_neg, 2, 0),
	SHELL_SUBCMD_SET_END
);

static int cmd_ag(const struct shell *sh, size_t argc, char **argv)
{
	memcpy(&hf_cb_test, &hf_cb, sizeof(hf_cb));
	memcpy(&ag_cb_test, &ag_cb, sizeof(ag_cb));

	if (argc == 1) {
		shell_help(sh);
		/* sh returns 1 when help is printed */
		return 1;
	}

	shell_error(sh, "%s unknown parameter: %s", argv[0], argv[1]);

	return -ENOEXEC;
}

SHELL_CMD_ARG_REGISTER(hf_test, &ag_cmds, "Bluetooth test hfp ag test sh commands",
		       cmd_ag, 1, 1);
```
