## prj.conf
```kconfig
CONFIG_BT=y
CONFIG_BT_CLASSIC=y
CONFIG_BT_SHELL=y
CONFIG_LOG=y
CONFIG_ZTEST=y
CONFIG_BT_A2DP=y
CONFIG_BT_A2DP_SINK=y

CONFIG_BT_DEVICE_NAME="a2dp_sink"

CONFIG_BT_CREATE_CONN_TIMEOUT=30
CONFIG_BT_PAGE_TIMEOUT=0xFFFF
```

## src/test_a2dp_sink.c
```c
/*
 * Copyright 2025 NXP
 *
 * SPDX-License-Identifier: Apache-2.0
 */

#include <errno.h>
#include <zephyr/types.h>
#include <stddef.h>
#include <stdlib.h>
#include <string.h>
#include <zephyr/sys/byteorder.h>
#include <zephyr/kernel.h>

#include <zephyr/settings/settings.h>

#include <zephyr/bluetooth/hci.h>
#include <zephyr/bluetooth/bluetooth.h>
#include <zephyr/bluetooth/conn.h>
#include <zephyr/bluetooth/l2cap.h>
#include <zephyr/bluetooth/classic/a2dp_codec_sbc.h>
#include <zephyr/bluetooth/classic/a2dp.h>
#include <zephyr/bluetooth/classic/sdp.h>

#include <zephyr/shell/shell.h>

#include <host/shell/bt.h>
#include <common/bt_shell_private.h>

static struct bt_a2dp *default_a2dp;
static bool a2dp_initialized;
static struct bt_a2dp_codec_ie peer_sbc_capabilities;
static struct bt_a2dp_ep peer_sbc_endpoint = {
	.codec_cap = &peer_sbc_capabilities,
};
#define A2DP_SERVICE_LEN 512
NET_BUF_POOL_FIXED_DEFINE(find_avdtp_version_pool, 1, A2DP_SERVICE_LEN,
			  CONFIG_BT_CONN_TX_USER_DATA_SIZE, NULL);
static const struct bt_uuid *a2dp_src_uuid = BT_UUID_DECLARE_16(BT_SDP_AUDIO_SOURCE_SVCLASS);
static struct bt_sdp_discover_params discov_a2dp = {
	.type = BT_SDP_DISCOVER_SERVICE_SEARCH_ATTR,
	.pool = &find_avdtp_version_pool,
};
static struct bt_a2dp_ep *found_peer_sbc_endpoint;
static struct bt_a2dp_ep *registered_sbc_endpoint;
static struct bt_a2dp_stream sbc_stream;
static struct bt_a2dp_stream_ops stream_ops;
NET_BUF_POOL_DEFINE(a2dp_tx_pool, CONFIG_BT_MAX_CONN, BT_L2CAP_BUF_SIZE(CONFIG_BT_L2CAP_TX_MTU),
		    CONFIG_BT_CONN_TX_USER_DATA_SIZE, NULL);

static bool a2dp_sink_sdp_registered;
BT_A2DP_SBC_SINK_EP_DEFAULT(sink_sbc_endpoint);
static struct bt_sdp_attribute a2dp_sink_attrs[] = {
	BT_SDP_NEW_SERVICE,
	BT_SDP_LIST(
		BT_SDP_ATTR_SVCLASS_ID_LIST,
		BT_SDP_TYPE_SIZE_VAR(BT_SDP_SEQ8, 3),
		BT_SDP_DATA_ELEM_LIST(
		{
			BT_SDP_TYPE_SIZE(BT_SDP_UUID16),
			BT_SDP_ARRAY_16(BT_SDP_AUDIO_SINK_SVCLASS)
		},
		)
	),
	BT_SDP_LIST(
		BT_SDP_ATTR_PROTO_DESC_LIST,
		BT_SDP_TYPE_SIZE_VAR(BT_SDP_SEQ8, 16),
		BT_SDP_DATA_ELEM_LIST(
		{
			BT_SDP_TYPE_SIZE_VAR(BT_SDP_SEQ8, 6),
			BT_SDP_DATA_ELEM_LIST(
			{
				BT_SDP_TYPE_SIZE(BT_SDP_UUID16),
				BT_SDP_ARRAY_16(BT_SDP_PROTO_L2CAP)
			},
			{
				BT_SDP_TYPE_SIZE(BT_SDP_UINT16),
				BT_SDP_ARRAY_16(BT_UUID_AVDTP_VAL)
			},
			)
		},
		{
			BT_SDP_TYPE_SIZE_VAR(BT_SDP_SEQ8, 6),
			BT_SDP_DATA_ELEM_LIST(
			{
				BT_SDP_TYPE_SIZE(BT_SDP_UUID16),
				BT_SDP_ARRAY_16(BT_UUID_AVDTP_VAL)
			},
			{
				BT_SDP_TYPE_SIZE(BT_SDP_UINT16),
				BT_SDP_ARRAY_16(0x0100U)
			},
			)
		},
		)
	),
	BT_SDP_LIST(
		BT_SDP_ATTR_PROFILE_DESC_LIST,
		BT_SDP_TYPE_SIZE_VAR(BT_SDP_SEQ8, 8),
		BT_SDP_DATA_ELEM_LIST(
		{
			BT_SDP_TYPE_SIZE_VAR(BT_SDP_SEQ8, 6),
			BT_SDP_DATA_ELEM_LIST(
			{
				BT_SDP_TYPE_SIZE(BT_SDP_UUID16),
				BT_SDP_ARRAY_16(BT_SDP_ADVANCED_AUDIO_SVCLASS)
			},
			{
				BT_SDP_TYPE_SIZE(BT_SDP_UINT16),
				BT_SDP_ARRAY_16(0x0103U)
			},
			)
		},
		)
	),
	BT_SDP_SERVICE_NAME("A2DPSink"),
	BT_SDP_SUPPORTED_FEATURES(0x0001U),
};
static struct bt_sdp_record a2dp_sink_rec = BT_SDP_RECORD(a2dp_sink_attrs);

static void shell_a2dp_print_capabilities(struct bt_a2dp_ep_info *ep_info)
{
	uint8_t codec_type;
	uint8_t *codec_ie;
	uint16_t codec_ie_len;

	codec_type = ep_info->codec_type;
	codec_ie = ep_info->codec_cap.codec_ie;
	codec_ie_len = ep_info->codec_cap.len;
	bt_shell_print("endpoint id: %d, %s, %s:", ep_info->sep_info->id,
		       (ep_info->sep_info->tsep == BT_AVDTP_SINK) ? "(sink)" : "(source)",
		       (ep_info->sep_info->inuse) ? "(in use)" : "(idle)");
	if (BT_A2DP_SBC == codec_type) {
		bt_shell_print(" codec type: SBC");

		if (BT_A2DP_SBC_IE_LENGTH != codec_ie_len) {
			bt_shell_error(" wrong sbc codec ie");
			return;
		}

		bt_shell_print(" sample frequency:");
		if (0U != (codec_ie[0U] & A2DP_SBC_SAMP_FREQ_16000)) {
			bt_shell_print(" 16000 ");
		}
		if (0U != (codec_ie[0U] & A2DP_SBC_SAMP_FREQ_32000)) {
			bt_shell_print(" 32000 ");
		}
		if (0U != (codec_ie[0U] & A2DP_SBC_SAMP_FREQ_44100)) {
			bt_shell_print(" 44100 ");
		}
		if (0U != (codec_ie[0U] & A2DP_SBC_SAMP_FREQ_48000)) {
			bt_shell_print(" 48000");
		}

		bt_shell_print("  channel mode:");
		if (0U != (codec_ie[0U] & A2DP_SBC_CH_MODE_MONO)) {
			bt_shell_print(" Mono ");
		}
		if (0U != (codec_ie[0U] & A2DP_SBC_CH_MODE_DUAL)) {
			bt_shell_print(" Dual ");
		}
		if (0U != (codec_ie[0U] & A2DP_SBC_CH_MODE_STEREO)) {
			bt_shell_print(" Stereo ");
		}
		if (0U != (codec_ie[0U] & A2DP_SBC_CH_MODE_JOINT)) {
			bt_shell_print(" Joint-Stereo");
		}
		bt_shell_print(" Block Length:");
		if (0U != (codec_ie[1U] & A2DP_SBC_BLK_LEN_4)) {
			bt_shell_print(" 4 ");
		}
		if (0U != (codec_ie[1U] & A2DP_SBC_BLK_LEN_8)) {
			bt_shell_print(" 8 ");
		}
		if (0U != (codec_ie[1U] & A2DP_SBC_BLK_LEN_12)) {
			bt_shell_print(" 12 ");
		}
		if (0U != (codec_ie[1U] & A2DP_SBC_BLK_LEN_16)) {
			bt_shell_print(" 16");
		}

		bt_shell_print("  Subbands:");
		if (0U != (codec_ie[1U] & A2DP_SBC_SUBBAND_4)) {
			bt_shell_print(" 4 ");
		}
		if (0U != (codec_ie[1U] & A2DP_SBC_SUBBAND_8)) {
			bt_shell_print(" 8");
		}

		bt_shell_print("  Allocation Method:");
		if (0U != (codec_ie[1U] & A2DP_SBC_ALLOC_MTHD_SNR)) {
			bt_shell_print(" SNR ");
		}
		if (0U != (codec_ie[1U] & A2DP_SBC_ALLOC_MTHD_LOUDNESS)) {
			bt_shell_print(" Loudness");
		}

		bt_shell_print("  Bitpool Range: %d - %d", codec_ie[2U], codec_ie[3U]);
	} else {
		bt_shell_print("  not SBC codecs");
	}
}

static void app_connected(struct bt_a2dp *a2dp, int err)
{
	if (err == 0) {
		default_a2dp = a2dp;
		bt_shell_print("a2dp connected");
	} else {
		bt_shell_print("a2dp connecting fail");
	}
}

static void app_disconnected(struct bt_a2dp *a2dp)
{
	found_peer_sbc_endpoint = NULL;
	bt_shell_print("a2dp disconnected");
}

static int app_config_req(struct bt_a2dp *a2dp, struct bt_a2dp_ep *ep,
			  struct bt_a2dp_codec_cfg *codec_cfg, struct bt_a2dp_stream **stream,
			  uint8_t *rsp_err_code)
{
	uint32_t sample_rate;

	bt_a2dp_stream_cb_register(&sbc_stream, &stream_ops);
	*stream = &sbc_stream;
	*rsp_err_code = 0;

	bt_shell_print("receive requesting config and accept");
	sample_rate = bt_a2dp_sbc_get_sampling_frequency(
		(struct bt_a2dp_codec_sbc_params *)&codec_cfg->codec_config->codec_ie[0]);
	bt_shell_print("sample rate %dHz", sample_rate);

	return 0;
}

static int app_reconfig_req(struct bt_a2dp_stream *stream, struct bt_a2dp_codec_cfg *codec_cfg,
			    uint8_t *rsp_err_code)
{
	uint32_t sample_rate;

	*rsp_err_code = 0;
	bt_shell_print("receive requesting reconfig and accept");
	sample_rate = bt_a2dp_sbc_get_sampling_frequency(
		(struct bt_a2dp_codec_sbc_params *)&codec_cfg->codec_config->codec_ie[0]);
	bt_shell_print("sample rate %dHz", sample_rate);

	return 0;
}

static void app_config_rsp(struct bt_a2dp_stream *stream, uint8_t rsp_err_code)
{
	if (rsp_err_code == 0) {
		bt_shell_print("success to configure");
	} else {
		bt_shell_print("fail to configure");
	}
}

static int app_establish_req(struct bt_a2dp_stream *stream, uint8_t *rsp_err_code)
{
	*rsp_err_code = 0;
	bt_shell_print("receive requesting establishment and accept");
	return 0;
}

static void app_establish_rsp(struct bt_a2dp_stream *stream, uint8_t rsp_err_code)
{
	if (rsp_err_code == 0) {
		bt_shell_print("success to establish");
	} else {
		bt_shell_print("fail to establish");
	}
}

static int app_release_req(struct bt_a2dp_stream *stream, uint8_t *rsp_err_code)
{
	*rsp_err_code = 0;
	bt_shell_print("receive requesting release and accept");
	return 0;
}

static void app_release_rsp(struct bt_a2dp_stream *stream, uint8_t rsp_err_code)
{
	if (rsp_err_code == 0) {
		bt_shell_print("success to release");
	} else {
		bt_shell_print("fail to release");
	}
}

static int app_start_req(struct bt_a2dp_stream *stream, uint8_t *rsp_err_code)
{
	*rsp_err_code = 0;
	bt_shell_print("receive requesting start and accept");
	return 0;
}

static void app_start_rsp(struct bt_a2dp_stream *stream, uint8_t rsp_err_code)
{
	if (rsp_err_code == 0) {
		bt_shell_print("success to start");
	} else {
		bt_shell_print("fail to start");
	}
}

static int app_suspend_req(struct bt_a2dp_stream *stream, uint8_t *rsp_err_code)
{
	*rsp_err_code = 0;
	bt_shell_print("receive requesting suspend and accept");
	return 0;
}

static void app_suspend_rsp(struct bt_a2dp_stream *stream, uint8_t rsp_err_code)
{
	if (rsp_err_code == 0) {
		bt_shell_print("success to suspend");
	} else {
		bt_shell_print("fail to suspend");
	}
}

static void stream_configured(struct bt_a2dp_stream *stream)
{
	bt_shell_print("stream configured");
}

static void stream_established(struct bt_a2dp_stream *stream)
{
	bt_shell_print("stream established");
}

static void stream_released(struct bt_a2dp_stream *stream)
{
	bt_shell_print("stream released");
}

static void stream_started(struct bt_a2dp_stream *stream)
{
	bt_shell_print("stream started");
}

static void stream_suspended(struct bt_a2dp_stream *stream)
{
	bt_shell_print("stream suspended");
}

static void sink_sbc_streamer_data(struct bt_a2dp_stream *stream, struct net_buf *buf,
				   uint16_t seq_num, uint32_t ts)
{
	uint8_t sbc_hdr;

	if (buf->len < 1U) {
		return;
	}
	sbc_hdr = net_buf_pull_u8(buf);
	bt_shell_print("received, num of frames: %d, data length:%d",
		       (uint8_t)BT_A2DP_SBC_MEDIA_HDR_NUM_FRAMES_GET(sbc_hdr), buf->len);
	bt_shell_print("data: %d, %d, %d, %d, %d, %d ......", buf->data[0], buf->data[1],
		       buf->data[2], buf->data[3], buf->data[4], buf->data[5]);
}

static void stream_recv(struct bt_a2dp_stream *stream, struct net_buf *buf, uint16_t seq_num,
			uint32_t ts)
{
	sink_sbc_streamer_data(stream, buf, seq_num, ts);
}

static struct bt_a2dp_cb a2dp_cb = {
	.connected = app_connected,
	.disconnected = app_disconnected,
	.config_req = app_config_req,
	.config_rsp = app_config_rsp,
	.establish_req = app_establish_req,
	.establish_rsp = app_establish_rsp,
	.release_req = app_release_req,
	.release_rsp = app_release_rsp,
	.start_req = app_start_req,
	.start_rsp = app_start_rsp,
	.suspend_req = app_suspend_req,
	.suspend_rsp = app_suspend_rsp,
	.reconfig_req = app_reconfig_req,
};

static int cmd_register_cb(const struct shell *sh, int32_t argc, char *argv[])
{
	int err;

	if (a2dp_initialized) {
		shell_error(sh, "already registered");
		return -ENOEXEC;
	}

	err = bt_a2dp_register_cb(&a2dp_cb);
	if (err != 0) {
		shell_print(sh, "fail to register cb (%d)", err);
		return err;
	}

	a2dp_initialized = true;
	shell_print(sh, "success");

	return 0;
}

static int cmd_register_ep(const struct shell *sh, int32_t argc, char *argv[])
{
	int err;
	const char *type;
	const char *action;

	if (!a2dp_initialized) {
		shell_error(sh, "need to register a2dp connection callbacks");
		return -ENOEXEC;
	}

	type = argv[1];
	action = argv[2];

	if (strcmp(action, "sbc") != 0) {
		shell_help(sh);
		return SHELL_CMD_HELP_PRINTED;
	}

	if (!(IS_ENABLED(CONFIG_BT_A2DP_SINK) && strcmp(type, "sink") == 0)) {
		shell_help(sh);
		return SHELL_CMD_HELP_PRINTED;
	}

	if (a2dp_sink_sdp_registered == false) {
		a2dp_sink_sdp_registered = true;
		bt_sdp_register_service(&a2dp_sink_rec);
	}

	err = bt_a2dp_register_ep(&sink_sbc_endpoint, BT_AVDTP_AUDIO, BT_AVDTP_SINK);
	if (err != 0) {
		shell_error(sh, "fail to register endpoint (%d)", err);
		return err;
	}

	shell_print(sh, "SBC sink endpoint is registered");
	registered_sbc_endpoint = &sink_sbc_endpoint;
	return 0;
}

static int cmd_connect(const struct shell *sh, int32_t argc, char *argv[])
{
	if (!a2dp_initialized) {
		shell_error(sh, "need to register a2dp connection callbacks");
		return -ENOEXEC;
	}

	if (default_conn == NULL) {
		shell_error(sh, "Not connected");
		return -ENOEXEC;
	}

	default_a2dp = bt_a2dp_connect(default_conn);
	if (NULL == default_a2dp) {
		shell_error(sh, "fail to connect a2dp");
	}

	found_peer_sbc_endpoint = NULL;
	return 0;
}

static int cmd_disconnect(const struct shell *sh, int32_t argc, char *argv[])
{
	int err;

	if (!a2dp_initialized) {
		shell_error(sh, "need to register a2dp connection callbacks");
		return -ENOEXEC;
	}

	if (default_a2dp == NULL) {
		shell_error(sh, "a2dp is not connected");
		return -ENOEXEC;
	}
	err = bt_a2dp_disconnect(default_a2dp);
	if (err != 0) {
		shell_print(sh, "fail to send disconnect cmd");
		return err;
	}

	default_a2dp = NULL;
	return 0;
}

static struct bt_a2dp_stream_ops stream_ops = {
	.configured = stream_configured,
	.established = stream_established,
	.released = stream_released,
	.started = stream_started,
	.suspended = stream_suspended,
#if defined(CONFIG_BT_A2DP_SINK)
	.recv = stream_recv,
#endif
};

BT_A2DP_SBC_EP_CFG_DEFAULT(sbc_cfg, A2DP_SBC_SAMP_FREQ_44100);
static int cmd_configure(const struct shell *sh, int32_t argc, char *argv[])
{
	int err;

	if (!a2dp_initialized) {
		shell_error(sh, "need to register a2dp connection callbacks");
		return -ENOEXEC;
	}

	if (default_a2dp == NULL) {
		shell_error(sh, "a2dp is not connected");
		return -EINVAL;
	}

	if (registered_sbc_endpoint == NULL) {
		shell_error(sh, "no endpoint");
		return -EINVAL;
	}

	if (found_peer_sbc_endpoint == NULL) {
		shell_error(sh, "don't find the peer sbc endpoint");
		return -EINVAL;
	}

	bt_a2dp_stream_cb_register(&sbc_stream, &stream_ops);
	err = bt_a2dp_stream_config(default_a2dp, &sbc_stream, registered_sbc_endpoint,
				    found_peer_sbc_endpoint, &sbc_cfg);
	if (err != 0) {
		shell_error(sh, "fail to configure");
		return err;
	}

	return 0;
}

static int cmd_reconfigure(const struct shell *sh, int32_t argc, char *argv[])
{
	if (!a2dp_initialized) {
		shell_error(sh, "need to register a2dp connection callbacks");
		return -ENOEXEC;
	}

	if (bt_a2dp_stream_reconfig(&sbc_stream, &sbc_cfg) != 0) {
		shell_error(sh, "fail");
	}
	return 0;
}

static uint8_t bt_a2dp_discover_peer_endpoint_cb(struct bt_a2dp *a2dp, struct bt_a2dp_ep_info *info,
						 struct bt_a2dp_ep **ep)
{
	if (found_peer_sbc_endpoint != NULL) {
		return BT_A2DP_DISCOVER_EP_STOP;
	}

	if (info == NULL) {
		return BT_A2DP_DISCOVER_EP_CONTINUE;
	}

	bt_shell_print("find one endpoint");
	shell_a2dp_print_capabilities(info);

	if ((info->codec_type == BT_A2DP_SBC) && (ep != NULL) &&
	    info->sep_info->tsep == BT_AVDTP_SOURCE) {
		*ep = &peer_sbc_endpoint;
		found_peer_sbc_endpoint = &peer_sbc_endpoint;
		return BT_A2DP_DISCOVER_EP_STOP;
	}
	return BT_A2DP_DISCOVER_EP_CONTINUE;
}

static struct bt_avdtp_sep_info found_seps[5];

static struct bt_a2dp_discover_param discover_param = {
	.cb = bt_a2dp_discover_peer_endpoint_cb,
	.seps_info = &found_seps[0],
	.sep_count = ARRAY_SIZE(found_seps),
};

static uint8_t a2dp_sdp_discover_cb(struct bt_conn *conn, struct bt_sdp_client_result *result,
				    const struct bt_sdp_discover_params *params)
{
	int err;
	uint16_t peer_avdtp_version = AVDTP_VERSION_1_3;

	if ((result == NULL) || (result->resp_buf == NULL) || (result->resp_buf->len == 0)) {
		bt_shell_error("SDP discover nothing");
		return BT_SDP_DISCOVER_UUID_STOP;
	}

	err = bt_sdp_get_proto_param(result->resp_buf, BT_SDP_PROTO_AVDTP, &peer_avdtp_version);
	if (err != 0) {
		bt_shell_error("fail to get avdtp version (%d)", err);
		goto stop;
	}

	discover_param.avdtp_version = peer_avdtp_version;
	err = bt_a2dp_discover(default_a2dp, &discover_param);
	if (err != 0) {
		bt_shell_error("fail to discover peer endpoints (%d)", err);
	}

stop:
	return BT_SDP_DISCOVER_UUID_STOP;
}

static int cmd_get_peer_eps(const struct shell *sh, int32_t argc, char *argv[])
{
	int err;

	discov_a2dp.uuid = a2dp_src_uuid;
	discov_a2dp.func = a2dp_sdp_discover_cb;

	err = bt_sdp_discover(default_conn, &discov_a2dp);
	if (err != 0) {
		shell_error(sh, "SDP discover failed (err %d)", err);
		return err;
	}
	return 0;
}

static int cmd_establish(const struct shell *sh, int32_t argc, char *argv[])
{
	if (!a2dp_initialized) {
		shell_error(sh, "need to register a2dp connection callbacks");
		return -ENOEXEC;
	}

	if (bt_a2dp_stream_establish(&sbc_stream) != 0) {
		shell_error(sh, "fail");
	}
	return 0;
}

static int cmd_release(const struct shell *sh, int32_t argc, char *argv[])
{
	if (!a2dp_initialized) {
		shell_error(sh, "need to register a2dp connection callbacks");
		return -ENOEXEC;
	}

	if (bt_a2dp_stream_release(&sbc_stream) != 0) {
		shell_error(sh, "fail");
	}
	return 0;
}

static int cmd_start(const struct shell *sh, int32_t argc, char *argv[])
{
	if (!a2dp_initialized) {
		shell_error(sh, "need to register a2dp connection callbacks");
		return -ENOEXEC;
	}

	if (bt_a2dp_stream_start(&sbc_stream) != 0) {
		shell_error(sh, "fail");
	}
	return 0;
}

static int cmd_suspend(const struct shell *sh, int32_t argc, char *argv[])
{
	if (!a2dp_initialized) {
		shell_error(sh, "need to register a2dp connection callbacks");
		return -ENOEXEC;
	}

	if (bt_a2dp_stream_suspend(&sbc_stream) != 0) {
		shell_error(sh, "fail");
	}
	return 0;
}

static int cmd_abort(const struct shell *sh, int32_t argc, char *argv[])
{
	if (!a2dp_initialized) {
		shell_error(sh, "need to register a2dp connection callbacks");
		return -ENOEXEC;
	}

	if (bt_a2dp_stream_abort(&sbc_stream) != 0) {
		shell_error(sh, "fail");
	}
	return 0;
}

#define HELP_NONE "[none]"

SHELL_STATIC_SUBCMD_SET_CREATE(
	a2dp_sink_cmds,
	SHELL_CMD_ARG(register_cb, NULL, "register a2dp connection callbacks", cmd_register_cb, 1,
		      0),
	SHELL_CMD_ARG(register_ep, NULL, "<type: sink or source> <value: sbc>", cmd_register_ep, 3,
		      0),
	SHELL_CMD_ARG(connect, NULL, HELP_NONE, cmd_connect, 1, 0),
	SHELL_CMD_ARG(disconnect, NULL, HELP_NONE, cmd_disconnect, 1, 0),
	SHELL_CMD_ARG(discover_peer_eps, NULL, HELP_NONE, cmd_get_peer_eps, 1, 1),
	SHELL_CMD_ARG(configure, NULL, HELP_NONE, cmd_configure, 1, 0),
	SHELL_CMD_ARG(establish, NULL, HELP_NONE, cmd_establish, 1, 0),
	SHELL_CMD_ARG(reconfigure, NULL, HELP_NONE, cmd_reconfigure, 1, 0),
	SHELL_CMD_ARG(release, NULL, HELP_NONE, cmd_release, 1, 0),
	SHELL_CMD_ARG(start, NULL, HELP_NONE, cmd_start, 1, 0),
	SHELL_CMD_ARG(suspend, NULL, HELP_NONE, cmd_suspend, 1, 0),
	SHELL_CMD_ARG(abort, NULL, HELP_NONE, cmd_abort, 1, 0), SHELL_SUBCMD_SET_END);

static int cmd_a2dp_sink(const struct shell *sh, size_t argc, char **argv)
{
	if (argc == 1) {
		shell_help(sh);
		return SHELL_CMD_HELP_PRINTED;
	}

	shell_error(sh, "%s unknown parameter: %s", argv[0], argv[1]);

	return -ENOEXEC;
}

SHELL_CMD_ARG_REGISTER(a2dp_sink, &a2dp_sink_cmds, "Bluetooth test A2DP SINK sh commands",
		       cmd_a2dp_sink, 1, 0);
```
