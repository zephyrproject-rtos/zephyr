## CMakeLists.txt
```
# Copyright 2025 NXP
#
# SPDX-License-Identifier: Apache-2.0

cmake_minimum_required(VERSION 3.20.0)

set(NO_QEMU_SERIAL_BT_SERVER 1)

find_package(Zephyr REQUIRED HINTS $ENV{ZEPHYR_BASE})
project(hid_host_b2b)

file(GLOB app_sources src/*.c)
target_sources(app PRIVATE ${app_sources})
```

## prj.conf
```kconfig
CONFIG_BT=y
CONFIG_BT_CLASSIC=y
CONFIG_BT_SHELL=y
CONFIG_LOG=y

CONFIG_BT_HID_HOST=y
CONFIG_BT_HID_DEVICE=y

CONFIG_BT_DEVICE_NAME="hid_host_b2b"

CONFIG_BT_CREATE_CONN_TIMEOUT=30
CONFIG_BT_PAGE_TIMEOUT=0xFFFF
```

## src/main.c
```c
/*
 * Copyright (c) 2026 Xiaomi Corporation
 *
 * SPDX-License-Identifier: Apache-2.0
 */

/*
 * This test has no ZTEST cases of its own. With CONFIG_ZTEST=y the ztest
 * subsystem provides main() and keeps the image running so the pytest harness
 * can drive the classic shell. The HID Host shell commands (hid_host ...) are
 * registered by the classic shell subsystem enabled via CONFIG_BT_HID_HOST=y;
 * this translation unit only gives the build a source file to compile.
 */

#include <zephyr/kernel.h>
```

## src/test_hid_host.c
```c
/* test_hid_host.c - Bluetooth Classic HID Host board-to-board test application */

/*
 * Copyright 2025 NXP
 *
 * SPDX-License-Identifier: Apache-2.0
 */

#include <zephyr/kernel.h>

/*
 * The test suite drives the boards entirely through the in-tree Bluetooth
 * shell modules, so the application itself only has to bring up the shell.
 * The HID Host role is provided by
 * subsys/bluetooth/host/classic/shell/hid_host.c and the HID Device role of
 * the second board by subsys/bluetooth/host/classic/shell/hid_device.c, both
 * enabled through CONFIG_BT_HID_HOST and CONFIG_BT_HID_DEVICE.
 */
int main(void)
{
	return 0;
}
```
