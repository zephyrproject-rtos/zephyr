## CMakeLists.txt
```
# SPDX-FileCopyrightText: Copyright 2026 NXP
# SPDX-License-Identifier: Apache-2.0

cmake_minimum_required(VERSION 3.20.0)

find_package(Zephyr REQUIRED HINTS $ENV{ZEPHYR_BASE})
project(bluetooth_classic_obex)

target_sources(app PRIVATE
  src/test_link.c
  src/test_single.c
  src/test_multi.c
)
target_include_directories(app PRIVATE ${ZEPHYR_BASE}/subsys/bluetooth)
```

## prj.conf
```kconfig
# SPDX-FileCopyrightText: Copyright 2026 NXP
# SPDX-License-Identifier: Apache-2.0

CONFIG_ZTEST=y
CONFIG_ASSERT=y

CONFIG_BT=y
CONFIG_BT_CLASSIC=y
CONFIG_BT_LL_SW_SPLIT=n
CONFIG_BT_H4=n

# Builds the OBEX layer. The test drives it through a fake transport, so the
# GOEP transports and the controller are not used.
CONFIG_BT_GOEP=y

# Leak checks of the test buffer pools.
CONFIG_NET_BUF_POOL_USAGE=y
```

## src/test_link.c
```c
/*
 * SPDX-FileCopyrightText: Copyright 2026 NXP
 * SPDX-License-Identifier: Apache-2.0
 */

#include <errno.h>
#include <stdbool.h>
#include <stddef.h>
#include <stdint.h>
#include <string.h>

#include <zephyr/kernel.h>
#include <zephyr/net_buf.h>
#include <zephyr/sys/util.h>
#include <zephyr/ztest.h>

#include <zephyr/bluetooth/classic/obex.h>

#include "host/classic/obex_internal.h"

#include "test_link.h"

#define TEST_BUF_COUNT     8U
#define TEST_RAW_BUF_COUNT 2U
#define TEST_BUF_SIZE      255U

/* Value of the SRM header to enable SRM */
#define TEST_SRM_ENABLE 0x01

NET_BUF_POOL_FIXED_DEFINE(test_tx_pool, TEST_BUF_COUNT, TEST_BUF_SIZE, 0, NULL);
/* Buffers from this pool have no head room */
NET_BUF_POOL_FIXED_DEFINE(test_raw_pool, TEST_RAW_BUF_COUNT, TEST_BUF_SIZE, 0, NULL);

struct test_link cli_link;
struct test_link srv_link;

static size_t tx_pool_avail;
static size_t raw_pool_avail;

/* Name "a" and Dest Name "b", null-terminated UTF-16BE */
static const uint8_t test_name[] = {0x00, 'a', 0x00, 0x00};
static const uint8_t test_dest_name[] = {0x00, 'b', 0x00, 0x00};

static struct net_buf *alloc_reserved(void)
{
	struct net_buf *buf;

	buf = net_buf_alloc(&test_tx_pool, K_NO_WAIT);
	if (buf != NULL) {
		net_buf_reserve(buf, BT_OBEX_SEND_BUF_RESERVE);
	}

	return buf;
}

static struct net_buf *link_alloc_buf(struct bt_obex *obex, struct net_buf_pool *pool)
{
	struct test_link *link = CONTAINER_OF(obex, struct test_link, obex);

	ARG_UNUSED(pool);

	if (link->alloc_fail) {
		return NULL;
	}

	if (link->alloc_hook != NULL) {
		link->alloc_hook(link);
		link->alloc_hook = NULL;
	}

	return alloc_reserved();
}

static int link_send(struct bt_obex *obex, struct net_buf *buf)
{
	struct test_link *link = CONTAINER_OF(obex, struct test_link, obex);

	if (link->send_err != 0) {
		return link->send_err;
	}

	k_fifo_put(&link->txq, buf);
	link->pending++;
	return 0;
}

static int link_disconnect(struct bt_obex *obex)
{
	ARG_UNUSED(obex);

	zassert_unreachable("Unexpected transport disconnection");
	return 0;
}

static const struct bt_obex_transport_ops link_ops = {
	.alloc_buf = link_alloc_buf,
	.send = link_send,
	.disconnect = link_disconnect,
};

static void link_init(struct test_link *link)
{
	memset(link, 0, sizeof(*link));
	k_fifo_init(&link->txq);
	link->obex.rx.mtu = TEST_MTU;
	link->obex.tx.mtu = TEST_MTU;

	bt_obex_reg_transport(&link->obex, &link_ops);
	zassert_ok(bt_obex_transport_connected(&link->obex));
}

static void link_drain(struct test_link *link)
{
	struct net_buf *buf;

	while ((buf = k_fifo_get(&link->txq, K_NO_WAIT)) != NULL) {
		link->pending--;
		net_buf_unref(buf);
	}
}

void test_link_setup(void)
{
	tx_pool_avail = net_buf_get_available(&test_tx_pool);
	raw_pool_avail = net_buf_get_available(&test_raw_pool);

	link_init(&cli_link);
	link_init(&srv_link);
}

void test_link_cleanup(void)
{
	link_drain(&cli_link);
	link_drain(&srv_link);
}

void test_link_check_idle(void)
{
	zassert_equal(test_link_pending(&cli_link), 0, "Unexpected client packet");
	zassert_equal(test_link_pending(&srv_link), 0, "Unexpected server packet");
	zassert_equal(net_buf_get_available(&test_tx_pool), tx_pool_avail, "Leaked buffer");
	zassert_equal(net_buf_get_available(&test_raw_pool), raw_pool_avail, "Leaked buffer");
}

size_t test_link_pending(struct test_link *link)
{
	return link->pending;
}

void test_link_pump(struct test_link *from, struct test_link *to)
{
	struct net_buf *buf;
	int err;

	buf = k_fifo_get(&from->txq, K_NO_WAIT);
	zassert_not_null(buf, "No packet to deliver");
	from->pending--;

	/* The OBEX layer does not keep the received buffer */
	err = bt_obex_recv(&to->obex, buf);
	net_buf_unref(buf);
	zassert_ok(err, "Packet not accepted (err %d)", err);
}

struct net_buf *test_buf(void)
{
	struct net_buf *buf = alloc_reserved();

	zassert_not_null(buf, "No test buffer");
	return buf;
}

struct net_buf *test_buf_no_headroom(void)
{
	struct net_buf *buf = net_buf_alloc(&test_raw_pool, K_NO_WAIT);

	zassert_not_null(buf, "No test buffer");
	zassert_equal(net_buf_headroom(buf), 0);
	return buf;
}

void test_add_action_headers(struct net_buf *buf, const struct test_client *c)
{
	if (c->use_conn_id) {
		zassert_ok(bt_obex_add_header_conn_id(buf, c->conn_id));
	}

	zassert_ok(bt_obex_add_header_action_id(buf, BT_OBEX_ACTION_COPY));
	zassert_ok(bt_obex_add_header_name(buf, sizeof(test_name), test_name));
	zassert_ok(bt_obex_add_header_dest_name(buf, sizeof(test_dest_name), test_dest_name));
}

struct net_buf *test_action_req(const struct test_client *c)
{
	struct net_buf *buf = test_buf();

	test_add_action_headers(buf, c);
	return buf;
}

void test_buf_state_save(const struct net_buf *buf, struct test_buf_state *state)
{
	state->data = buf->data;
	state->len = buf->len;
}

void test_buf_state_check(const struct net_buf *buf, const struct test_buf_state *state)
{
	zassert_equal_ptr(buf->data, state->data, "Buffer data changed");
	zassert_equal(buf->len, state->len, "Buffer length changed");
}

static void client_connect(struct bt_obex_client *client, uint8_t rsp_code, uint8_t version,
			   uint16_t mopl, struct net_buf *buf)
{
	struct test_client *c = CONTAINER_OF(client, struct test_client, client);

	c->connect_count++;
	c->connect_rsp = rsp_code;
}

static void client_disconnect(struct bt_obex_client *client, uint8_t rsp_code,
			      struct net_buf *buf)
{
}

static void client_get(struct bt_obex_client *client, uint8_t rsp_code, struct net_buf *buf)
{
	struct test_client *c = CONTAINER_OF(client, struct test_client, client);

	c->get_count++;
	c->get_rsp = rsp_code;
}

static void client_action(struct bt_obex_client *client, uint8_t rsp_code, struct net_buf *buf)
{
	struct test_client *c = CONTAINER_OF(client, struct test_client, client);

	c->action_count++;
	c->action_rsp = rsp_code;
}

static const struct bt_obex_client_ops test_client_ops = {
	.connect = client_connect,
	.disconnect = client_disconnect,
	.get = client_get,
	.action = client_action,
};

static void server_connect(struct bt_obex_server *server, uint8_t version, uint16_t mopl,
			   struct net_buf *buf)
{
	struct test_server *s = CONTAINER_OF(server, struct test_server, server);

	s->connect_count++;
}

static void server_disconnect(struct bt_obex_server *server, struct net_buf *buf)
{
}

static void server_get(struct bt_obex_server *server, bool final, struct net_buf *buf)
{
	struct test_server *s = CONTAINER_OF(server, struct test_server, server);

	s->get_count++;
	s->get_final = final;
}

static void server_action(struct bt_obex_server *server, bool final, struct net_buf *buf)
{
	struct test_server *s = CONTAINER_OF(server, struct test_server, server);

	s->action_count++;
	s->action_final = final;
	if (bt_obex_get_header_action_id(buf, &s->action_id) != 0) {
		s->action_id = UINT8_MAX;
	}
}

static const struct bt_obex_server_ops test_server_ops = {
	.connect = server_connect,
	.disconnect = server_disconnect,
	.get = server_get,
	.action = server_action,
};

void test_client_init(struct test_client *c)
{
	memset(c, 0, sizeof(*c));
	c->client.obex = &cli_link.obex;
	c->client.ops = &test_client_ops;
}

void test_server_init(struct test_server *s)
{
	memset(s, 0, sizeof(*s));
	s->server.obex = &srv_link.obex;
	s->server.ops = &test_server_ops;
}

void test_connect(struct test_client *c, struct test_server *s, const uint8_t *target,
		  uint32_t conn_id)
{
	struct net_buf *buf = NULL;

	if (target != NULL) {
		buf = test_buf();
		zassert_ok(bt_obex_add_header_target(buf, BT_UUID_SIZE_128, target));
	}

	zassert_ok(bt_obex_connect(&c->client, TEST_MTU, buf));
	test_link_pump(&cli_link, &srv_link);
	zassert_equal(s->connect_count, 1, "Connect request not received by the server");

	buf = NULL;
	if (target != NULL) {
		buf = test_buf();
		zassert_ok(bt_obex_add_header_who(buf, BT_UUID_SIZE_128, target));
		zassert_ok(bt_obex_add_header_conn_id(buf, conn_id));
	}

	zassert_ok(bt_obex_connect_rsp(&s->server, BT_OBEX_RSP_CODE_SUCCESS, TEST_MTU, buf));
	test_link_pump(&srv_link, &cli_link);
	zassert_equal(c->connect_count, 1, "Connect response not received by the client");
	zassert_equal(c->connect_rsp, BT_OBEX_RSP_CODE_SUCCESS);

	c->conn_id = conn_id;
	c->use_conn_id = (target != NULL);
}

int test_send_action(struct test_client *c, bool final)
{
	struct net_buf *buf = test_action_req(c);
	int err;

	err = bt_obex_action(&c->client, final, buf);
	if (err != 0) {
		net_buf_unref(buf);
	}

	return err;
}

void test_continue_action(struct test_client *c, struct test_server *s)
{
	size_t c_count = c->action_count;
	size_t s_count = s->action_count;

	zassert_ok(test_send_action(c, false));
	test_link_pump(&cli_link, &srv_link);
	zassert_equal(s->action_count, s_count + 1, "Action request not received by the server");
	zassert_false(s->action_final);
	zassert_equal(s->action_id, BT_OBEX_ACTION_COPY);

	zassert_ok(bt_obex_action_rsp(&s->server, BT_OBEX_RSP_CODE_CONTINUE, NULL));
	test_link_pump(&srv_link, &cli_link);
	zassert_equal(c->action_count, c_count + 1, "Action response not received by the client");
	zassert_equal(c->action_rsp, BT_OBEX_RSP_CODE_CONTINUE);
}

void test_finish_action(struct test_client *c, struct test_server *s)
{
	size_t c_count = c->action_count;
	size_t s_count = s->action_count;

	zassert_ok(test_send_action(c, true));
	test_link_pump(&cli_link, &srv_link);
	zassert_equal(s->action_count, s_count + 1, "Action request not received by the server");
	zassert_true(s->action_final);
	zassert_equal(s->action_id, BT_OBEX_ACTION_COPY);

	zassert_ok(bt_obex_action_rsp(&s->server, BT_OBEX_RSP_CODE_SUCCESS, NULL));
	test_link_pump(&srv_link, &cli_link);
	zassert_equal(c->action_count, c_count + 1, "Action response not received by the client");
	zassert_equal(c->action_rsp, BT_OBEX_RSP_CODE_SUCCESS);
}

void test_srm_get(struct test_client *c, struct test_server *s)
{
	size_t c_count = c->get_count;
	size_t s_count = s->get_count;
	struct net_buf *buf;

	buf = test_buf();
	if (c->use_conn_id) {
		zassert_ok(bt_obex_add_header_conn_id(buf, c->conn_id));
	}
	zassert_ok(bt_obex_add_header_srm(buf, TEST_SRM_ENABLE));
	zassert_ok(bt_obex_get(&c->client, true, buf));
	test_link_pump(&cli_link, &srv_link);
	zassert_equal(s->get_count, s_count + 1, "Get request not received by the server");
	zassert_true(s->get_final);

	buf = test_buf();
	zassert_ok(bt_obex_add_header_srm(buf, TEST_SRM_ENABLE));
	zassert_ok(bt_obex_get_rsp(&s->server, BT_OBEX_RSP_CODE_SUCCESS, buf));
	test_link_pump(&srv_link, &cli_link);
	zassert_equal(c->get_count, c_count + 1, "Get response not received by the client");
	zassert_equal(c->get_rsp, BT_OBEX_RSP_CODE_SUCCESS);
}
```

## src/test_link.h
```c
/*
 * SPDX-FileCopyrightText: Copyright 2026 NXP
 * SPDX-License-Identifier: Apache-2.0
 */

#ifndef TESTS_BLUETOOTH_CLASSIC_OBEX_SRC_TEST_LINK_H_
#define TESTS_BLUETOOTH_CLASSIC_OBEX_SRC_TEST_LINK_H_

#include <stdbool.h>
#include <stddef.h>
#include <stdint.h>

#include <zephyr/bluetooth/classic/obex.h>
#include <zephyr/kernel.h>
#include <zephyr/net_buf.h>

/* MTU of both sides of the fake transport, also used as MOPL */
#define TEST_MTU 512U

/* One side of the fake OBEX transport */
struct test_link {
	struct bt_obex obex;
	/* Packets sent on this side and not delivered to the peer yet */
	struct k_fifo txq;
	size_t pending;
	/* Error returned by send() instead of queuing the packet, 0 to queue it */
	int send_err;
	/* Whether alloc_buf() fails */
	bool alloc_fail;
	/* buffer allocate hook */
	void (*alloc_hook)(struct test_link *link);
};

/* OBEX client with the records of its callbacks */
struct test_client {
	struct bt_obex_client client;
	/* Connection Id added to each request if use_conn_id is set */
	uint32_t conn_id;
	bool use_conn_id;
	size_t connect_count;
	uint8_t connect_rsp;
	size_t action_count;
	uint8_t action_rsp;
	size_t get_count;
	uint8_t get_rsp;
};

/* OBEX server with the records of its callbacks */
struct test_server {
	struct bt_obex_server server;
	size_t connect_count;
	size_t action_count;
	bool action_final;
	uint8_t action_id;
	size_t get_count;
	bool get_final;
};

/* Data pointer and length of a buffer, to check that a failed call left it unchanged */
struct test_buf_state {
	const uint8_t *data;
	uint16_t len;
};

/* Side of the clients */
extern struct test_link cli_link;
/* Side of the servers */
extern struct test_link srv_link;

/* Initialize both sides and save the free buffer counts of the test pools */
void test_link_setup(void);
/* Release the queued packets, for the after hook of a suite */
void test_link_cleanup(void);
/* Check that no packet is queued and that the test pools have no leaked buffer */
void test_link_check_idle(void);

/* Number of packets queued on one side */
size_t test_link_pending(struct test_link *link);
/* Deliver the next queued packet of `from` to `to` */
void test_link_pump(struct test_link *from, struct test_link *to);

/* Buffer with the head room reserved for OBEX, like the GOEP transport buffers */
struct net_buf *test_buf(void);
/* Buffer without any head room */
struct net_buf *test_buf_no_headroom(void);
/* Add the headers of a Copy action request (and the Connection Id of the client) */
void test_add_action_headers(struct net_buf *buf, const struct test_client *c);
/* Buffer holding the headers of a Copy action request */
struct net_buf *test_action_req(const struct test_client *c);

void test_buf_state_save(const struct net_buf *buf, struct test_buf_state *state);
void test_buf_state_check(const struct net_buf *buf, const struct test_buf_state *state);

/* Clear the records and attach the client to cli_link */
void test_client_init(struct test_client *c);
/* Clear the records and attach the server to srv_link */
void test_server_init(struct test_server *s);

/* OBEX connect, with the Target, Who and Connection Id headers if `target` is not NULL */
void test_connect(struct test_client *c, struct test_server *s, const uint8_t *target,
		  uint32_t conn_id);

/* Send an action request, the buffer is released if the call fails */
int test_send_action(struct test_client *c, bool final);
/* Non-final action request answered with Continue */
void test_continue_action(struct test_client *c, struct test_server *s);
/* Final action request answered with Success */
void test_finish_action(struct test_client *c, struct test_server *s);
/* Single packet GET operation with SRM enabled by both sides */
void test_srm_get(struct test_client *c, struct test_server *s);

#endif /* TESTS_BLUETOOTH_CLASSIC_OBEX_SRC_TEST_LINK_H_ */
```

## src/test_multi.c
```c
/*
 * SPDX-FileCopyrightText: Copyright 2026 NXP
 * SPDX-License-Identifier: Apache-2.0
 */

#include <errno.h>
#include <stdbool.h>
#include <stdint.h>

#include <zephyr/kernel.h>
#include <zephyr/net_buf.h>
#include <zephyr/sys/util.h>
#include <zephyr/ztest.h>

#include <zephyr/bluetooth/classic/obex.h>
#include <zephyr/bluetooth/uuid.h>

#include "test_link.h"

#define CONN_ID_A 0x00000001U
#define CONN_ID_B 0x00000002U

/* Target header values of the two sessions */
static const uint8_t target_a[BT_UUID_SIZE_128] = {
	0x0a, 0x00, 0x00, 0x00, 0x00, 0x00, 0x00, 0x00,
	0x00, 0x00, 0x00, 0x00, 0x00, 0x00, 0x00, 0x01,
};
static const uint8_t target_b[BT_UUID_SIZE_128] = {
	0x0b, 0x00, 0x00, 0x00, 0x00, 0x00, 0x00, 0x00,
	0x00, 0x00, 0x00, 0x00, 0x00, 0x00, 0x00, 0x02,
};

static union bt_obex_uuid uuid_a;
static union bt_obex_uuid uuid_b;

/* Two OBEX sessions on the same transport */
static struct test_client client_a;
static struct test_client client_b;
static struct test_server server_a;
static struct test_server server_b;

static void obex_action_multi_before(void *fixture)
{
	ARG_UNUSED(fixture);

	test_link_setup();
	test_client_init(&client_a);
	test_client_init(&client_b);
	test_server_init(&server_a);
	test_server_init(&server_b);

	zassert_ok(bt_obex_make_uuid(&uuid_a, target_a, sizeof(target_a)));
	zassert_ok(bt_obex_make_uuid(&uuid_b, target_b, sizeof(target_b)));
	zassert_ok(bt_obex_server_register(&server_a.server, &uuid_a.u128));
	zassert_ok(bt_obex_server_register(&server_b.server, &uuid_b.u128));

	test_connect(&client_a, &server_a, target_a, CONN_ID_A);
	test_connect(&client_b, &server_b, target_b, CONN_ID_B);
}

static void obex_action_multi_after(void *fixture)
{
	ARG_UNUSED(fixture);

	test_link_cleanup();
}

ZTEST_SUITE(obex_action_multi, NULL, NULL, obex_action_multi_before, obex_action_multi_after,
	    NULL);

/* Another client cannot send a request until the ongoing action operation completes */
ZTEST(obex_action_multi, test_multi_busy)
{
	struct test_buf_state state;
	struct net_buf *buf;

	zassert_ok(test_send_action(&client_a, false));

	buf = test_action_req(&client_b);
	test_buf_state_save(buf, &state);
	zassert_equal(bt_obex_action(&client_b.client, true, buf), -EBUSY);
	test_buf_state_check(buf, &state);
	zassert_equal(test_link_pending(&cli_link), 1);

	test_link_pump(&cli_link, &srv_link);
	zassert_equal(server_a.action_count, 1);
	zassert_equal(server_b.action_count, 0);
	zassert_ok(bt_obex_action_rsp(&server_a.server, BT_OBEX_RSP_CODE_CONTINUE, NULL));
	test_link_pump(&srv_link, &cli_link);
	zassert_equal(client_a.action_rsp, BT_OBEX_RSP_CODE_CONTINUE);
	zassert_equal(client_b.action_count, 0);

	/* Client A keeps the transport until its operation completes */
	zassert_equal(bt_obex_action(&client_b.client, true, buf), -EBUSY);
	test_buf_state_check(buf, &state);
	test_finish_action(&client_a, &server_a);

	zassert_ok(bt_obex_action(&client_b.client, true, buf));
	test_link_pump(&cli_link, &srv_link);
	zassert_equal(server_b.action_count, 1);
	zassert_true(server_b.action_final);
	zassert_equal(server_a.action_count, 2);
	zassert_ok(bt_obex_action_rsp(&server_b.server, BT_OBEX_RSP_CODE_SUCCESS, NULL));
	test_link_pump(&srv_link, &cli_link);
	zassert_equal(client_b.action_count, 1);
	zassert_equal(client_b.action_rsp, BT_OBEX_RSP_CODE_SUCCESS);
	zassert_equal(client_a.action_count, 2);
	test_link_check_idle();
}

/* A failed first request releases the transport for the other client */
ZTEST(obex_action_multi, test_multi_first_req_failure)
{
	struct net_buf *buf;

	cli_link.send_err = -EIO;
	zassert_equal(test_send_action(&client_a, true), -EIO);
	cli_link.send_err = 0;
	test_finish_action(&client_b, &server_b);

	buf = test_buf_no_headroom();
	test_add_action_headers(buf, &client_a);
	zassert_equal(bt_obex_action(&client_a.client, true, buf), -EINVAL);
	net_buf_unref(buf);
	test_finish_action(&client_b, &server_b);

	cli_link.alloc_fail = true;
	zassert_equal(bt_obex_action(&client_a.client, true, NULL), -ENOBUFS);
	cli_link.alloc_fail = false;
	test_finish_action(&client_b, &server_b);

	zassert_equal(server_a.action_count, 0);
	test_finish_action(&client_a, &server_a);
	test_link_check_idle();
}

/* A failed following request keeps the transport for the ongoing operation */
ZTEST(obex_action_multi, test_multi_following_req_failure)
{
	test_continue_action(&client_a, &server_a);

	cli_link.send_err = -EIO;
	zassert_equal(test_send_action(&client_a, true), -EIO);
	cli_link.send_err = 0;

	zassert_equal(test_send_action(&client_b, true), -EBUSY);
	zassert_equal(test_link_pending(&cli_link), 0);

	test_finish_action(&client_a, &server_a);
	test_finish_action(&client_b, &server_b);
	test_link_check_idle();
}

/* A server can only respond to its own action requests */
ZTEST(obex_action_multi, test_multi_server_isolation)
{
	zassert_ok(test_send_action(&client_a, false));
	test_link_pump(&cli_link, &srv_link);
	zassert_equal(server_a.action_count, 1);
	zassert_equal(server_b.action_count, 0);

	zassert_equal(bt_obex_action_rsp(&server_b.server, BT_OBEX_RSP_CODE_CONTINUE, NULL),
		      -EINVAL);
	zassert_ok(bt_obex_action_rsp(&server_a.server, BT_OBEX_RSP_CODE_CONTINUE, NULL));
	zassert_equal(bt_obex_action_rsp(&server_a.server, BT_OBEX_RSP_CODE_CONTINUE, NULL),
		      -EPROTO);
	zassert_equal(test_link_pending(&srv_link), 1);
	test_link_pump(&srv_link, &cli_link);
	zassert_equal(client_a.action_rsp, BT_OBEX_RSP_CODE_CONTINUE);
	test_finish_action(&client_a, &server_a);

	zassert_ok(test_send_action(&client_b, true));
	test_link_pump(&cli_link, &srv_link);
	zassert_equal(server_b.action_count, 1);
	zassert_equal(bt_obex_action_rsp(&server_a.server, BT_OBEX_RSP_CODE_SUCCESS, NULL),
		      -EINVAL);
	zassert_ok(bt_obex_action_rsp(&server_b.server, BT_OBEX_RSP_CODE_SUCCESS, NULL));
	test_link_pump(&srv_link, &cli_link);
	zassert_equal(client_b.action_rsp, BT_OBEX_RSP_CODE_SUCCESS);
	test_link_check_idle();
}

/* The SRM state of a previous GET operation of a server does not allow a second response */
ZTEST(obex_action_multi, test_multi_server_stale_srm_flags)
{
	test_srm_get(&client_b, &server_b);

	/* The other session is not affected */
	test_finish_action(&client_a, &server_a);

	zassert_ok(test_send_action(&client_b, true));
	test_link_pump(&cli_link, &srv_link);
	zassert_equal(server_b.action_count, 1);
	zassert_ok(bt_obex_action_rsp(&server_b.server, BT_OBEX_RSP_CODE_CONTINUE, NULL));
	zassert_equal(bt_obex_action_rsp(&server_b.server, BT_OBEX_RSP_CODE_CONTINUE, NULL),
		      -EPROTO);
	zassert_equal(test_link_pending(&srv_link), 1);
	test_link_pump(&srv_link, &cli_link);
	zassert_equal(client_b.action_rsp, BT_OBEX_RSP_CODE_CONTINUE);
	test_finish_action(&client_b, &server_b);
	test_link_check_idle();
}
```

## src/test_single.c
```c
/*
 * SPDX-FileCopyrightText: Copyright 2026 NXP
 * SPDX-License-Identifier: Apache-2.0
 */

#include <errno.h>
#include <stdbool.h>
#include <stddef.h>

#include <zephyr/kernel.h>
#include <zephyr/net_buf.h>
#include <zephyr/sys/util.h>
#include <zephyr/ztest.h>

#include <zephyr/bluetooth/classic/obex.h>

#include "test_link.h"

/* One OBEX session, connected without Target header */
static struct test_client client;
static struct test_server server;

static void obex_action_before(void *fixture)
{
	ARG_UNUSED(fixture);

	test_link_setup();
	test_client_init(&client);
	test_server_init(&server);

	zassert_ok(bt_obex_server_register(&server.server, NULL));
	test_connect(&client, &server, NULL, 0);
}

static void obex_action_after(void *fixture)
{
	ARG_UNUSED(fixture);

	test_link_cleanup();
}

ZTEST_SUITE(obex_action, NULL, NULL, obex_action_before, obex_action_after, NULL);

/* A final request answered with Success completes the action operation */
ZTEST(obex_action, test_client_action)
{
	test_finish_action(&client, &server);

	/* The next action operation can start */
	test_finish_action(&client, &server);
	test_link_check_idle();
}

/* The next request is rejected until the response of the previous one is received */
ZTEST(obex_action, test_client_next_req_before_rsp)
{
	struct test_buf_state state;
	struct net_buf *buf;

	zassert_ok(test_send_action(&client, false));

	buf = test_action_req(&client);
	test_buf_state_save(buf, &state);
	zassert_equal(bt_obex_action(&client.client, false, buf), -EPROTO);
	test_buf_state_check(buf, &state);
	zassert_equal(test_link_pending(&cli_link), 1);

	test_link_pump(&cli_link, &srv_link);
	zassert_equal(server.action_count, 1);
	zassert_ok(bt_obex_action_rsp(&server.server, BT_OBEX_RSP_CODE_CONTINUE, NULL));
	test_link_pump(&srv_link, &cli_link);
	zassert_equal(client.action_rsp, BT_OBEX_RSP_CODE_CONTINUE);

	/* The rejected buffer can be sent once the response has been received */
	zassert_ok(bt_obex_action(&client.client, true, buf));
	test_link_pump(&cli_link, &srv_link);
	zassert_equal(server.action_count, 2);
	zassert_true(server.action_final);
	zassert_ok(bt_obex_action_rsp(&server.server, BT_OBEX_RSP_CODE_SUCCESS, NULL));
	test_link_pump(&srv_link, &cli_link);
	zassert_equal(client.action_count, 2);
	zassert_equal(client.action_rsp, BT_OBEX_RSP_CODE_SUCCESS);
	test_link_check_idle();
}

/* A buffer without head room for the request header is rejected and left unchanged */
ZTEST(obex_action, test_client_no_headroom)
{
	struct test_buf_state state;
	struct net_buf *buf;

	buf = test_buf_no_headroom();
	test_add_action_headers(buf, &client);
	test_buf_state_save(buf, &state);
	zassert_equal(bt_obex_action(&client.client, true, buf), -EINVAL);
	test_buf_state_check(buf, &state);
	zassert_equal(test_link_pending(&cli_link), 0);
	net_buf_unref(buf);

	test_finish_action(&client, &server);
	test_link_check_idle();
}

/* A request that fails to be sent leaves the buffer and the request state unchanged */
ZTEST(obex_action, test_client_send_failure)
{
	struct test_buf_state state;
	struct net_buf *buf;

	test_continue_action(&client, &server);

	buf = test_action_req(&client);
	test_buf_state_save(buf, &state);
	cli_link.send_err = -EIO;
	zassert_equal(bt_obex_action(&client.client, true, buf), -EIO);
	cli_link.send_err = 0;
	test_buf_state_check(buf, &state);
	zassert_equal(test_link_pending(&cli_link), 0);

	/* The response of the previous request is still known as received */
	zassert_ok(bt_obex_action(&client.client, true, buf));
	test_link_pump(&cli_link, &srv_link);
	zassert_equal(server.action_count, 2);
	zassert_true(server.action_final);
	zassert_ok(bt_obex_action_rsp(&server.server, BT_OBEX_RSP_CODE_SUCCESS, NULL));
	test_link_pump(&srv_link, &cli_link);
	zassert_equal(client.action_rsp, BT_OBEX_RSP_CODE_SUCCESS);
	test_link_check_idle();
}

/* A failed buffer allocation does not change the request state */
ZTEST(obex_action, test_client_alloc_failure)
{
	/* First request of the operation */
	cli_link.alloc_fail = true;
	zassert_equal(bt_obex_action(&client.client, true, NULL), -ENOBUFS);
	cli_link.alloc_fail = false;
	zassert_equal(test_link_pending(&cli_link), 0);
	test_finish_action(&client, &server);

	/* Following request of the operation */
	test_continue_action(&client, &server);
	cli_link.alloc_fail = true;
	zassert_equal(bt_obex_action(&client.client, true, NULL), -ENOBUFS);
	cli_link.alloc_fail = false;
	zassert_equal(test_link_pending(&cli_link), 0);
	test_finish_action(&client, &server);
	test_link_check_idle();
}

static void client_alloc_hook(struct test_link *link)
{
	zassert_equal(link, &cli_link);

	zassert_equal(bt_obex_action(&client.client, false, NULL), -EBUSY);
}

/* Check the `BT_OBEX_IS_BUSY` flag set case */
ZTEST(obex_action, test_client_busy)
{
	cli_link.alloc_hook = client_alloc_hook;
	zassert_ok(bt_obex_action(&client.client, false, NULL));
	test_link_pump(&cli_link, &srv_link);

	zassert_ok(bt_obex_action_rsp(&server.server, BT_OBEX_RSP_CODE_CONTINUE, NULL));
	test_link_pump(&srv_link, &cli_link);
	zassert_equal(client.action_rsp, BT_OBEX_RSP_CODE_CONTINUE);
	test_finish_action(&client, &server);
	test_link_check_idle();
}

/* Only one response can be sent for each received request */
ZTEST(obex_action, test_server_second_rsp)
{
	struct test_buf_state state;
	struct net_buf *buf;

	zassert_ok(test_send_action(&client, false));
	test_link_pump(&cli_link, &srv_link);
	zassert_equal(server.action_count, 1);

	zassert_ok(bt_obex_action_rsp(&server.server, BT_OBEX_RSP_CODE_CONTINUE, NULL));
	zassert_equal(bt_obex_action_rsp(&server.server, BT_OBEX_RSP_CODE_CONTINUE, NULL), -EPROTO);

	buf = test_buf();
	test_buf_state_save(buf, &state);
	zassert_equal(bt_obex_action_rsp(&server.server, BT_OBEX_RSP_CODE_CONTINUE, buf), -EPROTO);
	test_buf_state_check(buf, &state);
	net_buf_unref(buf);
	zassert_equal(test_link_pending(&srv_link), 1);

	test_link_pump(&srv_link, &cli_link);
	zassert_equal(client.action_rsp, BT_OBEX_RSP_CODE_CONTINUE);
	test_finish_action(&client, &server);
	test_link_check_idle();
}

/* The SRM state of a previous GET operation does not allow a second response */
ZTEST(obex_action, test_server_stale_srm_flags)
{
	test_srm_get(&client, &server);

	zassert_ok(test_send_action(&client, true));
	test_link_pump(&cli_link, &srv_link);
	zassert_equal(server.action_count, 1);
	zassert_true(server.action_final);

	zassert_ok(bt_obex_action_rsp(&server.server, BT_OBEX_RSP_CODE_CONTINUE, NULL));
	zassert_equal(bt_obex_action_rsp(&server.server, BT_OBEX_RSP_CODE_CONTINUE, NULL), -EPROTO);
	zassert_equal(test_link_pending(&srv_link), 1);

	test_link_pump(&srv_link, &cli_link);
	zassert_equal(client.action_rsp, BT_OBEX_RSP_CODE_CONTINUE);
	test_finish_action(&client, &server);
	test_link_check_idle();
}

/* Success cannot be sent for a request without final bit */
ZTEST(obex_action, test_server_success_without_final)
{
	struct test_buf_state state;
	struct net_buf *buf;

	zassert_ok(test_send_action(&client, false));
	test_link_pump(&cli_link, &srv_link);
	zassert_false(server.action_final);

	zassert_equal(bt_obex_action_rsp(&server.server, BT_OBEX_RSP_CODE_SUCCESS, NULL), -EINVAL);

	buf = test_buf();
	test_buf_state_save(buf, &state);
	zassert_equal(bt_obex_action_rsp(&server.server, BT_OBEX_RSP_CODE_SUCCESS, buf), -EINVAL);
	test_buf_state_check(buf, &state);
	net_buf_unref(buf);
	zassert_equal(test_link_pending(&srv_link), 0);

	zassert_ok(bt_obex_action_rsp(&server.server, BT_OBEX_RSP_CODE_CONTINUE, NULL));
	test_link_pump(&srv_link, &cli_link);
	zassert_equal(client.action_rsp, BT_OBEX_RSP_CODE_CONTINUE);
	test_finish_action(&client, &server);
	test_link_check_idle();
}

/* No response can be sent without an action operation */
ZTEST(obex_action, test_server_no_action)
{
	zassert_equal(bt_obex_action_rsp(&server.server, BT_OBEX_RSP_CODE_SUCCESS, NULL), -EINVAL);
	zassert_equal(bt_obex_action_rsp(&server.server, BT_OBEX_RSP_CODE_CONTINUE, NULL), -EINVAL);
	zassert_equal(test_link_pending(&srv_link), 0);

	/* After the action operation has completed */
	test_finish_action(&client, &server);
	zassert_equal(bt_obex_action_rsp(&server.server, BT_OBEX_RSP_CODE_SUCCESS, NULL), -EINVAL);
	zassert_equal(test_link_pending(&srv_link), 0);
	test_link_check_idle();
}

/* A response that fails to be sent leaves the buffer and the response state unchanged */
ZTEST(obex_action, test_server_send_failure)
{
	struct test_buf_state state;
	struct net_buf *buf;

	/* Response of the first request */
	zassert_ok(test_send_action(&client, false));
	test_link_pump(&cli_link, &srv_link);

	buf = test_buf();
	test_buf_state_save(buf, &state);
	srv_link.send_err = -EIO;
	zassert_equal(bt_obex_action_rsp(&server.server, BT_OBEX_RSP_CODE_CONTINUE, buf), -EIO);
	srv_link.send_err = 0;
	test_buf_state_check(buf, &state);
	zassert_equal(test_link_pending(&srv_link), 0);

	zassert_ok(bt_obex_action_rsp(&server.server, BT_OBEX_RSP_CODE_CONTINUE, buf));
	test_link_pump(&srv_link, &cli_link);
	zassert_equal(client.action_rsp, BT_OBEX_RSP_CODE_CONTINUE);

	/* Response of a following request */
	zassert_ok(test_send_action(&client, false));
	test_link_pump(&cli_link, &srv_link);

	buf = test_buf();
	test_buf_state_save(buf, &state);
	srv_link.send_err = -EIO;
	zassert_equal(bt_obex_action_rsp(&server.server, BT_OBEX_RSP_CODE_CONTINUE, buf), -EIO);
	srv_link.send_err = 0;
	test_buf_state_check(buf, &state);
	zassert_equal(test_link_pending(&srv_link), 0);

	zassert_ok(bt_obex_action_rsp(&server.server, BT_OBEX_RSP_CODE_CONTINUE, buf));
	test_link_pump(&srv_link, &cli_link);
	zassert_equal(client.action_count, 2);
	zassert_equal(client.action_rsp, BT_OBEX_RSP_CODE_CONTINUE);

	test_finish_action(&client, &server);
	test_link_check_idle();
}

/* A buffer without head room for the response header is rejected and left unchanged */
ZTEST(obex_action, test_server_no_headroom)
{
	struct test_buf_state state;
	struct net_buf *buf;

	zassert_ok(test_send_action(&client, false));
	test_link_pump(&cli_link, &srv_link);

	buf = test_buf_no_headroom();
	test_buf_state_save(buf, &state);
	zassert_equal(bt_obex_action_rsp(&server.server, BT_OBEX_RSP_CODE_CONTINUE, buf), -EINVAL);
	test_buf_state_check(buf, &state);
	net_buf_unref(buf);
	zassert_equal(test_link_pending(&srv_link), 0);

	zassert_ok(bt_obex_action_rsp(&server.server, BT_OBEX_RSP_CODE_CONTINUE, NULL));
	test_link_pump(&srv_link, &cli_link);
	zassert_equal(client.action_rsp, BT_OBEX_RSP_CODE_CONTINUE);
	test_finish_action(&client, &server);
	test_link_check_idle();
}

static void server_alloc_hook(struct test_link *link)
{
	zassert_equal(link, &srv_link);

	zassert_equal(bt_obex_action_rsp(&server.server, BT_OBEX_RSP_CODE_CONTINUE, NULL), -EBUSY);
}

/* Check the `BT_OBEX_IS_BUSY` flag set case */
ZTEST(obex_action, test_server_busy)
{
	zassert_ok(test_send_action(&client, false));
	test_link_pump(&cli_link, &srv_link);

	srv_link.alloc_hook = server_alloc_hook;
	zassert_ok(bt_obex_action_rsp(&server.server, BT_OBEX_RSP_CODE_CONTINUE, NULL));
	test_link_pump(&srv_link, &cli_link);
	zassert_equal(client.action_rsp, BT_OBEX_RSP_CODE_CONTINUE);
	test_finish_action(&client, &server);
	test_link_check_idle();
}
```
