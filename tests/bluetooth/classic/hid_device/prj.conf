## CMakeLists.txt
```
# Copyright 2025 NXP
#
# SPDX-License-Identifier: Apache-2.0

cmake_minimum_required(VERSION 3.20.0)

set(NO_QEMU_SERIAL_BT_SERVER 1)

find_package(Zephyr REQUIRED HINTS $ENV{ZEPHYR_BASE})
project(hid_device_b2b)

file(GLOB app_sources src/*.c)
target_sources(app PRIVATE ${app_sources})
```

## prj.conf
```kconfig
CONFIG_BT=y
CONFIG_BT_CLASSIC=y
CONFIG_BT_SHELL=y
CONFIG_LOG=y

CONFIG_BT_HID_DEVICE=y
CONFIG_BT_HID_HOST=y

CONFIG_BT_DEVICE_NAME="hid_device_b2b"

CONFIG_BT_CREATE_CONN_TIMEOUT=30
CONFIG_BT_PAGE_TIMEOUT=0xFFFF
```

## src/test_hid_device.c
```c
/* test_hid_device.c - Bluetooth Classic HID Device board-to-board test application */

/*
 * Copyright 2025 NXP
 *
 * SPDX-License-Identifier: Apache-2.0
 */

#include <zephyr/kernel.h>

/*
 * The test suite drives the boards entirely through the in-tree Bluetooth
 * shell modules, so the application itself only has to bring up the shell.
 * The HID Device role is provided by
 * subsys/bluetooth/host/classic/shell/hid_device.c and the HID Host role of
 * the second board by subsys/bluetooth/host/classic/shell/hid_host.c, both
 * enabled through CONFIG_BT_HID_DEVICE and CONFIG_BT_HID_HOST.
 */
int main(void)
{
	return 0;
}
```
