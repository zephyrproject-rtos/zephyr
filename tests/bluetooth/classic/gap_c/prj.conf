## prj.conf
```kconfig
CONFIG_BT=y
CONFIG_BT_CLASSIC=y
CONFIG_SHELL=y
CONFIG_BT_SHELL=y
CONFIG_LOG=y
CONFIG_ZTEST=y

CONFIG_BT_RFCOMM=y

CONFIG_BT_DEVICE_NAME="gap_c"

CONFIG_BT_CREATE_CONN_TIMEOUT=30
CONFIG_BT_PAGE_TIMEOUT=0xFFFF
```

## src/gap_c.c
```c
/* gap_c.c - Bluetooth classic gap client smoke test */

/*
 * Copyright 2025 NXP
 *
 * SPDX-License-Identifier: Apache-2.0
 */
```
