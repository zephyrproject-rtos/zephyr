## prj.conf
```kconfig
CONFIG_BT=y
CONFIG_BT_CLASSIC=y
CONFIG_BT_SMP=y
CONFIG_BT_SHELL=y
CONFIG_LOG=y
CONFIG_ZTEST=y
CONFIG_REBOOT=y
CONFIG_BT_MAX_CONN=3
CONFIG_BT_MAX_PAIRED=3
CONFIG_BT_SMP_ENFORCE_MITM=n
CONFIG_BT_SETTINGS=y
CONFIG_FLASH=y
CONFIG_FLASH_MAP=y
CONFIG_NVS=y
CONFIG_SETTINGS=y
CONFIG_BT_PRIVACY=y
CONFIG_BT_BUF_ACL_RX_COUNT_EXTRA=10
CONFIG_BT_DATA_LEN_UPDATE=n
CONFIG_BT_PHY_UPDATE=n
CONFIG_BT_GAP_AUTO_UPDATE_CONN_PARAMS=n
CONFIG_BT_DEFAULT_ROLE_SWITCH_ENABLE=y

CONFIG_BT_DEVICE_NAME="smp_ctkd"

CONFIG_BT_CREATE_CONN_TIMEOUT=30
CONFIG_BT_PAGE_TIMEOUT=0xFFFF
```

## src/smp_br_ctkd.c
```c
/* smp_br_sc_only.c - Bluetooth classic SMP Cross-transport key derivation test */

/*
 * Copyright 2025 NXP
 *
 * SPDX-License-Identifier: Apache-2.0
 */

#include <errno.h>
#include <zephyr/types.h>
#include <stddef.h>
#include <stdlib.h>
#include <string.h>
#include <zephyr/sys/byteorder.h>
#include <zephyr/sys/reboot.h>
#include <zephyr/kernel.h>

#include <zephyr/settings/settings.h>

#include <zephyr/shell/shell.h>

#include "common/bt_shell_private.h"
#include "host/settings.h"

static int cmd_reboot(const struct shell *sh, size_t argc, char *argv[])
{
	sys_reboot(SYS_REBOOT_COLD);

	return 0;
}

static int cmd_delete_irk(const struct shell *sh, size_t argc, char *argv[])
{
	bt_settings_delete_irk();

	return 0;
}

static int cmd_default_handler(const struct shell *sh, size_t argc, char **argv)
{
	if (argc == 1) {
		shell_help(sh);
		return SHELL_CMD_HELP_PRINTED;
	}

	shell_error(sh, "%s unknown parameter: %s", argv[0], argv[1]);

	return -EINVAL;
}

#define HELP_NONE "[none]"

SHELL_STATIC_SUBCMD_SET_CREATE(test_smp_cmds,
			       SHELL_CMD_ARG(delete_irk, NULL, HELP_NONE, cmd_delete_irk, 1, 0),
			       SHELL_CMD_ARG(reboot, NULL, HELP_NONE, cmd_reboot, 1, 0),
			       SHELL_SUBCMD_SET_END);

SHELL_CMD_REGISTER(test_smp, &test_smp_cmds, "Bluetooth classic SMP shell commands",
		   cmd_default_handler);
```
