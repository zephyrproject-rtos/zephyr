## CMakeLists.txt
```
# SPDX-License-Identifier: Apache-2.0

cmake_minimum_required(VERSION 3.28.0)
set(NO_QEMU_SERIAL_BT_SERVER 1)

find_package(Zephyr REQUIRED HINTS $ENV{ZEPHYR_BASE})
project(bluetooth)

file(GLOB app_sources src/*.c)
target_sources(app PRIVATE ${app_sources})
```

## prj.conf
```kconfig
CONFIG_BT=y
CONFIG_BT_CLASSIC=y
CONFIG_BT_SHELL=y
CONFIG_LOG=y
CONFIG_ZTEST=y

CONFIG_BT_RFCOMM=y
CONFIG_BT_GOEP=y
CONFIG_BT_OPP_CLIENT=y
CONFIG_BT_OPP_SERVER=y

CONFIG_BT_DEVICE_NAME="opp"

CONFIG_BT_CREATE_CONN_TIMEOUT=30
CONFIG_BT_PAGE_TIMEOUT=0xFFFF
```

## src/opp_client.c
```c
/* opp_client.c - OPP Push Client role shell commands (board-to-board test) */

/*
 * Copyright 2026 NXP
 *
 * SPDX-License-Identifier: Apache-2.0
 */
#include <stdlib.h>

#include <errno.h>
#include <zephyr/types.h>
#include <zephyr/kernel.h>
#include <zephyr/sys/printk.h>
#include <zephyr/sys/byteorder.h>
#include <zephyr/shell/shell.h>

#include <zephyr/bluetooth/hci.h>
#include <zephyr/bluetooth/bluetooth.h>
#include <zephyr/bluetooth/conn.h>
#include <zephyr/bluetooth/l2cap.h>
#include <zephyr/bluetooth/classic/rfcomm.h>
#include <zephyr/bluetooth/classic/sdp.h>
#include <zephyr/bluetooth/classic/goep.h>
#include <zephyr/bluetooth/classic/obex.h>
#include <zephyr/bluetooth/classic/opp.h>
#include <host/shell/bt.h>
#include <common/bt_shell_private.h>

#include "opp_common.h"

#define SDP_CLIENT_USER_BUF_LEN 512U

NET_BUF_POOL_FIXED_DEFINE(opp_sdp_client_pool, 1, SDP_CLIENT_USER_BUF_LEN,
			  CONFIG_BT_CONN_TX_USER_DATA_SIZE, NULL);

static struct bt_opp_client opp_client;
static uint8_t opp_server_channel;

static struct bt_sdp_discover_params sdp_discover;
static struct bt_uuid_16 sdp_discover_uuid;

/* OPP client callbacks. */
static void opp_cli_rfcomm_connected(struct bt_conn *conn, struct bt_opp_client *client)
{
	bt_shell_print("OPP client RFCOMM connected client %p", client);
}

static void opp_cli_rfcomm_disconnected(struct bt_opp_client *client)
{
	bt_shell_print("OPP client RFCOMM disconnected client %p", client);
}

static void opp_cli_connect(struct bt_opp_client *client, uint8_t rsp_code, uint8_t version,
			    uint16_t mopl, struct net_buf *buf)
{
	bt_shell_print("OPP client OBEX connect rsp 0x%02x version 0x%02x mopl %u", rsp_code,
		       version, mopl);
	if (rsp_code == BT_OPP_RSP_CODE_SUCCESS) {
		bt_shell_print("OPP client OBEX connected");
	} else {
		bt_shell_print("OPP client OBEX connect error 0x%02x", rsp_code);
	}
}

static void opp_cli_disconnect(struct bt_opp_client *client, uint8_t rsp_code, struct net_buf *buf)
{
	bt_shell_print("OPP client OBEX disconnect rsp 0x%02x", rsp_code);
	if (rsp_code == BT_OPP_RSP_CODE_SUCCESS) {
		bt_shell_print("OPP client OBEX disconnected");
	} else {
		bt_shell_print("OPP client OBEX disconnect error 0x%02x", rsp_code);
	}
}

static void opp_cli_push(struct bt_opp_client *client, uint8_t rsp_code, struct net_buf *buf)
{
	bt_shell_print("OPP client push rsp 0x%02x", rsp_code);
	if (rsp_code == BT_OPP_RSP_CODE_SUCCESS) {
		bt_shell_print("OPP client push success");
	} else if (rsp_code == BT_OPP_RSP_CODE_CONTINUE) {
		bt_shell_print("OPP client push continue");
	} else if (rsp_code == BT_OPP_RSP_CODE_UNSUPP_MEDIA_TYPE) {
		bt_shell_print("OPP client push unsupported_media");
	} else if (rsp_code == BT_OPP_RSP_CODE_ENTITY_TOO_LARGE) {
		bt_shell_print("OPP client push entity_too_large");
	} else {
		bt_shell_print("OPP client push error 0x%02x", rsp_code);
	}
}

static void opp_cli_pull(struct bt_opp_client *client, uint8_t rsp_code, struct net_buf *buf)
{
	bt_shell_print("OPP client pull rsp 0x%02x", rsp_code);
	if (rsp_code == BT_OPP_RSP_CODE_SUCCESS) {
		bt_shell_print("OPP client pull success");
	} else if (rsp_code == BT_OPP_RSP_CODE_CONTINUE) {
		bt_shell_print("OPP client pull continue");
	} else if (rsp_code == BT_OPP_RSP_CODE_NOT_FOUND) {
		bt_shell_print("OPP client pull not_found");
	} else if (rsp_code == BT_OPP_RSP_CODE_FORBIDDEN) {
		bt_shell_print("OPP client pull forbidden");
	} else {
		bt_shell_print("OPP client pull error 0x%02x", rsp_code);
	}
}

static void opp_cli_abort(struct bt_opp_client *client, struct net_buf *buf)
{
	bt_shell_print("OPP client abort success");
}

static const struct bt_opp_client_cb opp_client_cb = {
	.transport_connected = opp_cli_rfcomm_connected,
	.transport_disconnected = opp_cli_rfcomm_disconnected,
	.connect = opp_cli_connect,
	.disconnect = opp_cli_disconnect,
	.push = opp_cli_push,
	.pull = opp_cli_pull,
	.abort = opp_cli_abort,
};

static uint8_t sdp_discover_func(struct bt_conn *conn, struct bt_sdp_client_result *result,
				 const struct bt_sdp_discover_params *params)
{
	int err;
	uint16_t channel;

	if ((result == NULL) || (result->resp_buf == NULL) || (result->resp_buf->len == 0)) {
		bt_shell_print("OPP SDP discovery done");
		return BT_SDP_DISCOVER_UUID_STOP;
	}

	err = bt_sdp_get_proto_param(result->resp_buf, BT_SDP_PROTO_RFCOMM, &channel);
	if (!err) {
		opp_server_channel = (uint8_t)channel;
		bt_shell_print("OPP server discovered on RFCOMM channel 0x%02x",
			       opp_server_channel);
		return BT_SDP_DISCOVER_UUID_STOP;
	}

	return BT_SDP_DISCOVER_UUID_CONTINUE;
}

static int cmd_discover(const struct shell *sh, size_t argc, char *argv[])
{
	int err;

	if (!default_conn) {
		shell_error(sh, "Not connected");
		return -ENOEXEC;
	}

	sdp_discover_uuid.uuid.type = BT_UUID_TYPE_16;
	sdp_discover_uuid.val = BT_SDP_OBEX_OBJPUSH_SVCLASS;
	sdp_discover.uuid = &sdp_discover_uuid.uuid;
	sdp_discover.func = sdp_discover_func;
	sdp_discover.pool = &opp_sdp_client_pool;
	sdp_discover.type = BT_SDP_DISCOVER_SERVICE_SEARCH_ATTR;

	opp_server_channel = 0U;

	err = bt_sdp_discover(default_conn, &sdp_discover);
	if (err) {
		shell_error(sh, "Unable to start SDP discovery (err %d)", err);
		return -ENOEXEC;
	}

	shell_print(sh, "OPP SDP discovery started");

	return 0;
}

static int cmd_connect_rfcomm(const struct shell *sh, size_t argc, char *argv[])
{
	uint8_t channel;
	int err;

	if (!default_conn) {
		shell_error(sh, "Not connected");
		return -ENOEXEC;
	}

	if (argc > 1) {
		channel = strtoul(argv[1], NULL, 16);
	} else {
		channel = opp_server_channel;
	}

	if (channel == 0U) {
		shell_error(sh, "No RFCOMM channel (run 'opp_c discover' first)");
		return -ENOEXEC;
	}

	err = bt_opp_client_transport_connect(default_conn, &opp_client, &opp_client_cb, channel);
	if (err) {
		shell_error(sh, "Unable to connect OPP RFCOMM (err %d)", err);
		return -ENOEXEC;
	}

	shell_print(sh, "OPP client RFCOMM connection pending");

	return 0;
}

static int cmd_obex_connect(const struct shell *sh, size_t argc, char *argv[])
{
	int err;

	err = bt_opp_client_connect(&opp_client, OPP_TEST_MOPL, NULL);
	if (err) {
		shell_error(sh, "Unable to send OBEX connect (err %d)", err);
		return -ENOEXEC;
	}

	shell_print(sh, "OPP client OBEX connect pending");

	return 0;
}

/*
 * Push a single-packet object. Optional args:
 *   argv[1]: Type header string (default BT_OPP_TYPE_VCARD). opp_s does not
 *            check the Type header; use 'opp_s set_push_rsp cf' to make it
 *            answer UNSUPP_MEDIA_TYPE.
 */
static int cmd_push(const struct shell *sh, size_t argc, char *argv[])
{
	static const uint8_t name[] = OPP_TEST_OBJECT_NAME_UTF16;
	static const uint8_t vcard[] = OPP_TEST_VCARD;
	const char *type = (argc > 1) ? argv[1] : BT_OPP_TYPE_VCARD;
	struct net_buf *buf;
	int err;

	buf = bt_opp_client_create_pdu(&opp_client, NULL);
	if (!buf) {
		shell_error(sh, "Unable to allocate OPP PDU");
		return -ENOEXEC;
	}

	err = bt_obex_add_header_name(buf, sizeof(name), name);
	if (err) {
		shell_error(sh, "Unable to add Name header (err %d)", err);
		net_buf_unref(buf);
		return -ENOEXEC;
	}

	err = bt_obex_add_header_type(buf, strlen(type) + 1, (const uint8_t *)type);
	if (err) {
		shell_error(sh, "Unable to add Type header (err %d)", err);
		net_buf_unref(buf);
		return -ENOEXEC;
	}

	err = bt_obex_add_header_len(buf, sizeof(vcard) - 1);
	if (err) {
		shell_error(sh, "Unable to add Length header (err %d)", err);
		net_buf_unref(buf);
		return -ENOEXEC;
	}

	err = bt_obex_add_header_end_body(buf, sizeof(vcard) - 1, vcard);
	if (err) {
		shell_error(sh, "Unable to add End-of-Body header (err %d)", err);
		net_buf_unref(buf);
		return -ENOEXEC;
	}

	err = bt_opp_client_push(&opp_client, true, buf);
	if (err) {
		shell_error(sh, "Unable to push object (err %d)", err);
		net_buf_unref(buf);
		return -ENOEXEC;
	}

	shell_print(sh, "OPP client push pending");

	return 0;
}

/*
 * Start a multi-packet push: first PUT carries Name/Type/Length and a Body
 * header (non-final). The last chunk is sent with 'push_final'.
 */
static int cmd_push_start(const struct shell *sh, size_t argc, char *argv[])
{
	static const uint8_t name[] = OPP_TEST_OBJECT_NAME_UTF16;
	static const uint8_t vcard[] = OPP_TEST_VCARD;
	struct net_buf *buf;
	int err;

	buf = bt_opp_client_create_pdu(&opp_client, NULL);
	if (!buf) {
		shell_error(sh, "Unable to allocate OPP PDU");
		return -ENOEXEC;
	}

	err = bt_obex_add_header_name(buf, sizeof(name), name);
	if (!err) {
		err = bt_obex_add_header_type(buf, sizeof(BT_OPP_TYPE_VCARD),
					      (const uint8_t *)BT_OPP_TYPE_VCARD);
	}
	if (!err) {
		err = bt_obex_add_header_len(buf, (sizeof(vcard) - 1) * 2);
	}
	if (!err) {
		err = bt_obex_add_header_body(buf, sizeof(vcard) - 1, vcard);
	}
	if (err) {
		shell_error(sh, "Unable to build first PUT packet (err %d)", err);
		net_buf_unref(buf);
		return -ENOEXEC;
	}

	err = bt_opp_client_push(&opp_client, false, buf);
	if (err) {
		shell_error(sh, "Unable to push (err %d)", err);
		net_buf_unref(buf);
		return -ENOEXEC;
	}

	shell_print(sh, "OPP client push_start pending");

	return 0;
}

/* Send the final PUT chunk (End-of-Body, final=true) of a multi-packet push. */
static int cmd_push_final(const struct shell *sh, size_t argc, char *argv[])
{
	static const uint8_t vcard[] = OPP_TEST_VCARD;
	struct net_buf *buf;
	int err;

	buf = bt_opp_client_create_pdu(&opp_client, NULL);
	if (!buf) {
		shell_error(sh, "Unable to allocate OPP PDU");
		return -ENOEXEC;
	}

	err = bt_obex_add_header_end_body(buf, sizeof(vcard) - 1, vcard);
	if (err) {
		shell_error(sh, "Unable to add End-of-Body header (err %d)", err);
		net_buf_unref(buf);
		return -ENOEXEC;
	}

	err = bt_opp_client_push(&opp_client, true, buf);
	if (err) {
		shell_error(sh, "Unable to push final (err %d)", err);
		net_buf_unref(buf);
		return -ENOEXEC;
	}

	shell_print(sh, "OPP client push_final pending");

	return 0;
}

/*
 * Pull the server's default business card (OBEX GET). Optional argv[1] adds a
 * non-empty Name header, which names an object. OPP spec section 5.6 only has
 * the Default Get Object, so bt_opp_client_pull() refuses such a request
 * locally and nothing is put on the air.
 */
static int cmd_pull(const struct shell *sh, size_t argc, char *argv[])
{
	static const uint8_t empty_name[] = {0x00, 0x00};
	static const uint8_t named[] = OPP_TEST_OBJECT_NAME_UTF16;
	struct net_buf *buf;
	int err;

	buf = bt_opp_client_create_pdu(&opp_client, NULL);
	if (!buf) {
		shell_error(sh, "Unable to allocate OPP PDU");
		return -ENOEXEC;
	}

	err = bt_obex_add_header_type(buf, sizeof(BT_OPP_TYPE_VCARD),
				      (const uint8_t *)BT_OPP_TYPE_VCARD);
	if (err) {
		shell_error(sh, "Unable to add Type header (err %d)", err);
		net_buf_unref(buf);
		return -ENOEXEC;
	}

	if (argc > 1) {
		/* Names an object, which bt_opp_client_pull() refuses. */
		err = bt_obex_add_header_name(buf, sizeof(named), named);
	} else {
		err = bt_obex_add_header_name(buf, sizeof(empty_name), empty_name);
	}
	if (err) {
		shell_error(sh, "Unable to add Name header (err %d)", err);
		net_buf_unref(buf);
		return -ENOEXEC;
	}

	err = bt_opp_client_pull(&opp_client, buf);
	if (err) {
		shell_error(sh, "Unable to pull business card (err %d)", err);
		net_buf_unref(buf);
		return -ENOEXEC;
	}

	shell_print(sh, "OPP client pull pending");

	return 0;
}

/*
 * Issue a continuation GET for a multi-packet business-card pull. The client
 * stack does not auto-continue a GET: after the pull callback reports
 * BT_OPP_RSP_CODE_CONTINUE the application must send another GET to fetch the
 * next chunk. Per IrOBEX 1.2 section 3.1 the continuation carries no
 * headers, so an empty PDU is sent.
 */
static int cmd_pull_continue(const struct shell *sh, size_t argc, char *argv[])
{
	struct net_buf *buf;
	int err;

	buf = bt_opp_client_create_pdu(&opp_client, NULL);
	if (!buf) {
		shell_error(sh, "Unable to allocate OPP PDU");
		return -ENOEXEC;
	}

	err = bt_opp_client_pull(&opp_client, buf);
	if (err) {
		shell_error(sh, "Unable to send continuation GET (err %d)", err);
		net_buf_unref(buf);
		return -ENOEXEC;
	}

	shell_print(sh, "OPP client pull_continue pending");

	return 0;
}

static int cmd_abort(const struct shell *sh, size_t argc, char *argv[])
{
	int err;

	err = bt_opp_client_abort(&opp_client, NULL);
	if (err) {
		shell_error(sh, "Unable to send abort (err %d)", err);
		return -ENOEXEC;
	}

	shell_print(sh, "OPP client abort pending");

	return 0;
}

static int cmd_obex_disconnect(const struct shell *sh, size_t argc, char *argv[])
{
	int err;

	err = bt_opp_client_disconnect(&opp_client, NULL);
	if (err) {
		shell_error(sh, "Unable to send OBEX disconnect (err %d)", err);
		return -ENOEXEC;
	}

	shell_print(sh, "OPP client OBEX disconnect pending");

	return 0;
}

static int cmd_disconnect_rfcomm(const struct shell *sh, size_t argc, char *argv[])
{
	int err;

	err = bt_opp_client_transport_disconnect(&opp_client);
	if (err) {
		shell_error(sh, "Unable to disconnect OPP RFCOMM (err %d)", err);
		return -ENOEXEC;
	}

	shell_print(sh, "OPP client RFCOMM disconnect pending");

	return 0;
}

static int cmd_create_pdu(const struct shell *sh, size_t argc, char *argv[])
{
	struct net_buf *buf;

	buf = bt_opp_client_create_pdu(&opp_client, NULL);
	if (!buf) {
		shell_error(sh, "OPP client create_pdu failed");
		return -ENOEXEC;
	}

	shell_print(sh, "OPP client create_pdu ok headroom %u", net_buf_headroom(buf));
	net_buf_unref(buf);

	return 0;
}

SHELL_STATIC_SUBCMD_SET_CREATE(
	opp_c_cmds,
	SHELL_CMD_ARG(discover, NULL, "discover OPP server RFCOMM channel via SDP", cmd_discover,
		      1, 0),
	SHELL_CMD_ARG(connect_rfcomm, NULL, "[channel(hex)] connect RFCOMM transport",
		      cmd_connect_rfcomm, 1, 1),
	SHELL_CMD_ARG(obex_connect, NULL, "establish OBEX session", cmd_obex_connect, 1, 0),
	SHELL_CMD_ARG(push, NULL, "[type] push a single-packet vCard object", cmd_push, 1, 1),
	SHELL_CMD_ARG(push_start, NULL, "start multi-packet push (non-final Body)",
		      cmd_push_start, 1, 0),
	SHELL_CMD_ARG(push_final, NULL, "send final PUT chunk (End-of-Body)", cmd_push_final,
		      1, 0),
	SHELL_CMD_ARG(pull, NULL,
		      "[named] pull server business card (GET); any argument adds the Name "
		      "\"test.vcf\", which bt_opp_client_pull() refuses",
		      cmd_pull, 1, 1),
	SHELL_CMD_ARG(pull_continue, NULL, "issue a continuation GET for a multi-packet pull",
		      cmd_pull_continue, 1, 0),
	SHELL_CMD_ARG(abort, NULL, "abort the ongoing operation", cmd_abort, 1, 0),
	SHELL_CMD_ARG(obex_disconnect, NULL, "terminate OBEX session", cmd_obex_disconnect, 1, 0),
	SHELL_CMD_ARG(disconnect_rfcomm, NULL, "disconnect RFCOMM transport",
		      cmd_disconnect_rfcomm, 1, 0),
	SHELL_CMD_ARG(create_pdu, NULL, "allocate a client PDU (headroom test)", cmd_create_pdu,
		      1, 0),
	SHELL_SUBCMD_SET_END);

static int cmd_default_handler(const struct shell *sh, size_t argc, char **argv)
{
	if (argc == 1) {
		shell_help(sh);
		return SHELL_CMD_HELP_PRINTED;
	}

	shell_error(sh, "%s unknown parameter: %s", argv[0], argv[1]);

	return -EINVAL;
}

SHELL_CMD_ARG_REGISTER(opp_c, &opp_c_cmds, "Bluetooth classic OPP client shell commands",
		       cmd_default_handler, 1, 1);
```

## src/opp_common.h
```c
/* opp_common.h - Shared declarations for the OPP board-to-board test firmware */

/*
 * Copyright 2026 NXP
 *
 * SPDX-License-Identifier: Apache-2.0
 */

#ifndef OPP_TEST_COMMON_H_
#define OPP_TEST_COMMON_H_

#include <zephyr/bluetooth/classic/opp.h>

/*
 * A minimal vCard 2.1 object used as the pushed object and as the server's
 * default Get Object. It fits within a single OBEX packet.
 */
#define OPP_TEST_VCARD                                                                             \
	"BEGIN:VCARD\r\n"                                                                          \
	"VERSION:2.1\r\n"                                                                          \
	"N:Zephyr;OPP\r\n"                                                                         \
	"FN:OPP Zephyr\r\n"                                                                        \
	"TEL;CELL:+10000000000\r\n"                                                                \
	"END:VCARD\r\n"

/* OBEX Name header value (UTF-16BE) for the pushed object: "test.vcf". */
#define OPP_TEST_OBJECT_NAME_UTF16                                                                 \
	{0x00, 't', 0x00, 'e', 0x00, 's', 0x00, 't', 0x00, '.', 0x00, 'v', 0x00, 'c', 0x00, 'f',   \
	 0x00, 0x00}

/* Default maximum OBEX packet length proposed by both roles in this test. */
#define OPP_TEST_MOPL 0xFFFFU

#endif /* OPP_TEST_COMMON_H_ */
```

## src/opp_server.c
```c
/* opp_server.c - OPP Push Server role shell commands (board-to-board test) */

/*
 * Copyright 2026 NXP
 *
 * SPDX-License-Identifier: Apache-2.0
 */
#include <stdlib.h>

#include <errno.h>
#include <zephyr/types.h>
#include <zephyr/kernel.h>
#include <zephyr/sys/printk.h>
#include <zephyr/sys/byteorder.h>
#include <zephyr/shell/shell.h>

#include <zephyr/bluetooth/hci.h>
#include <zephyr/bluetooth/bluetooth.h>
#include <zephyr/bluetooth/conn.h>
#include <zephyr/bluetooth/l2cap.h>
#include <zephyr/bluetooth/classic/rfcomm.h>
#include <zephyr/bluetooth/classic/sdp.h>
#include <zephyr/bluetooth/classic/goep.h>
#include <zephyr/bluetooth/classic/obex.h>
#include <zephyr/bluetooth/classic/opp.h>
#include <common/bt_shell_private.h>

#include "opp_common.h"

/* Default RFCOMM channel used to advertise the OPP server. */
#define OPP_SERVER_RFCOMM_CHANNEL 5U

/*
 * OPP SDP service record: service class OBEXObjectPush (0x1105), an RFCOMM/OBEX
 * protocol descriptor list carrying the server channel, the OPP profile
 * descriptor, and the mandatory Supported Formats List attribute (0x0303).
 */
static struct bt_sdp_attribute opp_attrs[] = {
	BT_SDP_NEW_SERVICE,
	BT_SDP_LIST(
		BT_SDP_ATTR_SVCLASS_ID_LIST,
		BT_SDP_TYPE_SIZE_VAR(BT_SDP_SEQ8, 3),
		BT_SDP_DATA_ELEM_LIST(
		{
			BT_SDP_TYPE_SIZE(BT_SDP_UUID16),
			BT_SDP_ARRAY_16(BT_SDP_OBEX_OBJPUSH_SVCLASS)
		},
		)
	),
	BT_SDP_LIST(
		BT_SDP_ATTR_PROTO_DESC_LIST,
		BT_SDP_TYPE_SIZE_VAR(BT_SDP_SEQ8, 17),
		BT_SDP_DATA_ELEM_LIST(
		{
			BT_SDP_TYPE_SIZE_VAR(BT_SDP_SEQ8, 3),
			BT_SDP_DATA_ELEM_LIST(
			{
				BT_SDP_TYPE_SIZE(BT_SDP_UUID16),
				BT_SDP_ARRAY_16(BT_SDP_PROTO_L2CAP)
			},
			)
		},
		{
			BT_SDP_TYPE_SIZE_VAR(BT_SDP_SEQ8, 5),
			BT_SDP_DATA_ELEM_LIST(
			{
				BT_SDP_TYPE_SIZE(BT_SDP_UUID16),
				BT_SDP_ARRAY_16(BT_SDP_PROTO_RFCOMM)
			},
			{
				BT_SDP_TYPE_SIZE(BT_SDP_UINT8),
				BT_SDP_ARRAY_8(OPP_SERVER_RFCOMM_CHANNEL)
			},
			)
		},
		{
			BT_SDP_TYPE_SIZE_VAR(BT_SDP_SEQ8, 3),
			BT_SDP_DATA_ELEM_LIST(
			{
				BT_SDP_TYPE_SIZE(BT_SDP_UUID16),
				BT_SDP_ARRAY_16(BT_SDP_PROTO_OBEX)
			},
			)
		},
		)
	),
	BT_SDP_LIST(
		BT_SDP_ATTR_PROFILE_DESC_LIST,
		BT_SDP_TYPE_SIZE_VAR(BT_SDP_SEQ8, 8),
		BT_SDP_DATA_ELEM_LIST(
		{
			BT_SDP_TYPE_SIZE_VAR(BT_SDP_SEQ8, 6),
			BT_SDP_DATA_ELEM_LIST(
			{
				BT_SDP_TYPE_SIZE(BT_SDP_UUID16),
				BT_SDP_ARRAY_16(BT_SDP_OBEX_OBJPUSH_SVCLASS)
			},
			{
				BT_SDP_TYPE_SIZE(BT_SDP_UINT16),
				/* OPP v1.1 Table 6.1 lists 0x0100 for v1.1, not 0x0101 */
				BT_SDP_ARRAY_16(0x0100)
			},
			)
		},
		)
	),
	/* Supported Formats List (attribute 0x0303): advertise vCard 2.1. */
	BT_SDP_LIST(
		BT_SDP_ATTR_SUPPORTED_FORMATS_LIST,
		BT_SDP_TYPE_SIZE_VAR(BT_SDP_SEQ8, 2),
		BT_SDP_DATA_ELEM_LIST(
		{
			BT_SDP_TYPE_SIZE(BT_SDP_UINT8),
			BT_SDP_ARRAY_8(BT_OPP_FORMAT_VCARD_2_1)
		},
		)
	),

	BT_SDP_SERVICE_NAME("OBEX Object Push"),
};

static struct bt_sdp_record opp_rec = BT_SDP_RECORD(opp_attrs);

static struct bt_opp_server opp_server;
static bool opp_server_registered;

/*
 * Runtime-configurable response codes so the pytest cases can drive the server
 * down the SUCCESS / CONTINUE / error paths without rebuilding the firmware.
 * Defaults reflect the normal happy-path behavior.
 */
static uint8_t rsp_connect = BT_OPP_RSP_CODE_SUCCESS;
static uint8_t rsp_push = BT_OPP_RSP_CODE_SUCCESS;
static uint8_t rsp_pull = BT_OPP_RSP_CODE_SUCCESS;

/*
 * Multi-packet business-card pull support. When 'pull_multi' is enabled the
 * server answers the first GET with a CONTINUE carrying a non-final Body
 * chunk, then answers the continuation GET with a SUCCESS carrying the final
 * End-of-Body chunk, so the GET CONTINUE_NON_FINAL path runs on the wire.
 */
static bool pull_multi;
static uint8_t pull_stage;

/* OPP server callbacks. */

static void opp_srv_rfcomm_connected(struct bt_conn *conn, struct bt_opp_server *server)
{
	bt_shell_print("OPP server RFCOMM connected server %p", server);
}

static void opp_srv_rfcomm_disconnected(struct bt_opp_server *server)
{
	int err;

	bt_shell_print("OPP server RFCOMM disconnected server %p", server);

	/* Release the instance so that it can serve a later connection. */
	err = bt_opp_server_unregister(server);
	if (err != 0) {
		bt_shell_error("OPP server unregister failed (err %d)", err);
	}
}

static void opp_srv_connect(struct bt_opp_server *server, uint8_t version, uint16_t mopl,
			    struct net_buf *buf)
{
	int err;

	bt_shell_print("OPP server OBEX connect req version 0x%02x mopl %u", version, mopl);

	/* Per OPP spec section 5.4 the client must not send a Target header. */
	if (buf != NULL) {
		uint16_t tgt_len;
		const uint8_t *tgt;

		if (bt_obex_get_header_target(buf, &tgt_len, &tgt) == 0) {
			bt_shell_print("OPP server OBEX connect target_header present");
		} else {
			bt_shell_print("OPP server OBEX connect no_target_header");
		}
	} else {
		bt_shell_print("OPP server OBEX connect no_target_header");
	}

	err = bt_opp_server_connect(server, OPP_TEST_MOPL, rsp_connect, NULL);
	if (err) {
		bt_shell_error("OPP server connect rsp failed (err %d)", err);
	} else if (rsp_connect == BT_OPP_RSP_CODE_SUCCESS) {
		bt_shell_print("OPP server OBEX connected");
	} else {
		bt_shell_print("OPP server OBEX connect rejected 0x%02x", rsp_connect);
	}
}

static void opp_srv_disconnect(struct bt_opp_server *server, struct net_buf *buf)
{
	int err;

	bt_shell_print("OPP server OBEX disconnect req");

	err = bt_opp_server_disconnect(server, NULL);
	if (err) {
		bt_shell_error("OPP server disconnect rsp failed (err %d)", err);
	} else {
		bt_shell_print("OPP server OBEX disconnected");
	}
}

static void opp_srv_push(struct bt_opp_server *server, bool final, struct net_buf *buf)
{
	uint8_t code;
	int err;

	bt_shell_print("OPP server push req final %d len %u", (int)final,
		       buf != NULL ? buf->len : 0U);

	if (rsp_push != BT_OPP_RSP_CODE_SUCCESS) {
		/* Forced error path for the negative test cases. */
		code = rsp_push;
	} else if (final) {
		code = BT_OPP_RSP_CODE_SUCCESS;
	} else {
		code = BT_OPP_RSP_CODE_CONTINUE;
	}

	err = bt_opp_server_push(server, code, NULL);
	if (err) {
		bt_shell_error("OPP server push rsp failed (err %d)", err);
		return;
	}

	if (code == BT_OPP_RSP_CODE_SUCCESS) {
		bt_shell_print("OPP server push complete");
	} else if (code == BT_OPP_RSP_CODE_CONTINUE) {
		bt_shell_print("OPP server push continue");
	} else {
		bt_shell_print("OPP server push error 0x%02x", code);
	}
}

static void opp_srv_pull(struct bt_opp_server *server, bool final, struct net_buf *buf)
{
	static const uint8_t vcard[] = OPP_TEST_VCARD;
	struct net_buf *rsp;
	int err;

	bt_shell_print("OPP server pull req final %d", (int)final);

	if (rsp_pull == BT_OPP_RSP_CODE_NOT_FOUND) {
		err = bt_opp_server_pull(server, BT_OPP_RSP_CODE_NOT_FOUND, NULL);
		if (err) {
			bt_shell_error("OPP server pull rsp failed (err %d)", err);
		} else {
			bt_shell_print("OPP server pull not_found");
		}
		return;
	}

	rsp = bt_opp_server_create_pdu(server, NULL);
	if (!rsp) {
		bt_shell_error("OPP server unable to allocate pull PDU");
		return;
	}

	if (pull_multi && pull_stage == 0U) {
		/*
		 * First half of a multi-packet GET: send a non-final Body chunk
		 * with CONTINUE so the client must issue a continuation GET.
		 */
		err = bt_obex_add_header_body(rsp, sizeof(vcard) - 1, vcard);
		if (err) {
			bt_shell_error("OPP server add Body failed (err %d)", err);
			net_buf_unref(rsp);
			return;
		}

		err = bt_opp_server_pull(server, BT_OPP_RSP_CODE_CONTINUE, rsp);
		if (err) {
			bt_shell_error("OPP server pull rsp failed (err %d)", err);
			net_buf_unref(rsp);
		} else {
			pull_stage = 1U;
			bt_shell_print("OPP server pull continue");
		}
		return;
	}

	err = bt_obex_add_header_end_body(rsp, sizeof(vcard) - 1, vcard);
	if (err) {
		bt_shell_error("OPP server add End-of-Body failed (err %d)", err);
		net_buf_unref(rsp);
		return;
	}

	err = bt_opp_server_pull(server, BT_OPP_RSP_CODE_SUCCESS, rsp);
	if (err) {
		bt_shell_error("OPP server pull rsp failed (err %d)", err);
		net_buf_unref(rsp);
	} else {
		pull_stage = 0U;
		bt_shell_print("OPP server pull success");
	}
}

static void opp_srv_abort(struct bt_opp_server *server, struct net_buf *buf)
{
	int err;

	bt_shell_print("OPP server abort req");

	err = bt_opp_server_abort(server, NULL);
	if (err) {
		bt_shell_error("OPP server abort rsp failed (err %d)", err);
	} else {
		bt_shell_print("OPP server abort handled");
	}
}

static const struct bt_opp_server_cb opp_server_cb = {
	.transport_connected = opp_srv_rfcomm_connected,
	.transport_disconnected = opp_srv_rfcomm_disconnected,
	.connect = opp_srv_connect,
	.disconnect = opp_srv_disconnect,
	.push = opp_srv_push,
	.pull = opp_srv_pull,
	.abort = opp_srv_abort,
};

static int opp_rfcomm_accept(struct bt_conn *conn, struct bt_opp_server_transport *rfcomm_server,
			     struct bt_opp_server **out)
{
	int err;

	bt_shell_print("OPP server accept conn %p", conn);

	err = bt_opp_server_register(&opp_server, &opp_server_cb);
	if (err) {
		bt_shell_error("OPP server register failed (err %d)", err);
		return err;
	}

	*out = &opp_server;

	return 0;
}

static struct bt_opp_server_transport opp_rfcomm = {
	.accept = opp_rfcomm_accept,
};

static int cmd_register(const struct shell *sh, size_t argc, char *argv[])
{
	int err;

	if (opp_server_registered) {
		shell_print(sh, "OPP server already registered");
		return 0;
	}

	opp_rfcomm.server.rfcomm.channel = OPP_SERVER_RFCOMM_CHANNEL;

	err = bt_opp_server_transport_register(&opp_rfcomm);
	if (err) {
		shell_error(sh, "Unable to register OPP server (err %d)", err);
		return -ENOEXEC;
	}

	err = bt_sdp_register_service(&opp_rec);
	if (err) {
		shell_error(sh, "Unable to register OPP SDP record (err %d)", err);
		return -ENOEXEC;
	}

	opp_server_registered = true;
	shell_print(sh, "OPP server registered on RFCOMM channel 0x%02x",
		    opp_rfcomm.server.rfcomm.channel);

	return 0;
}

static int cmd_set_connect_rsp(const struct shell *sh, size_t argc, char *argv[])
{
	rsp_connect = (uint8_t)strtoul(argv[1], NULL, 16);
	shell_print(sh, "OPP server connect rsp set 0x%02x", rsp_connect);
	return 0;
}

static int cmd_set_push_rsp(const struct shell *sh, size_t argc, char *argv[])
{
	rsp_push = (uint8_t)strtoul(argv[1], NULL, 16);
	shell_print(sh, "OPP server push rsp set 0x%02x", rsp_push);
	return 0;
}

static int cmd_set_pull_rsp(const struct shell *sh, size_t argc, char *argv[])
{
	rsp_pull = (uint8_t)strtoul(argv[1], NULL, 16);
	shell_print(sh, "OPP server pull rsp set 0x%02x", rsp_pull);
	return 0;
}

static int cmd_set_pull_multi(const struct shell *sh, size_t argc, char *argv[])
{
	pull_multi = (strtoul(argv[1], NULL, 10) != 0U);
	pull_stage = 0U;
	shell_print(sh, "OPP server pull multi %s", pull_multi ? "on" : "off");
	return 0;
}

static int cmd_reset_rsp(const struct shell *sh, size_t argc, char *argv[])
{
	rsp_connect = BT_OPP_RSP_CODE_SUCCESS;
	rsp_push = BT_OPP_RSP_CODE_SUCCESS;
	rsp_pull = BT_OPP_RSP_CODE_SUCCESS;
	pull_multi = false;
	pull_stage = 0U;
	shell_print(sh, "OPP server rsp codes reset");
	return 0;
}

static int cmd_create_pdu(const struct shell *sh, size_t argc, char *argv[])
{
	struct net_buf *buf;

	if (!opp_server_registered) {
		shell_error(sh, "OPP server not registered");
		return -ENOEXEC;
	}

	buf = bt_opp_server_create_pdu(&opp_server, NULL);
	if (!buf) {
		shell_error(sh, "OPP server create_pdu failed");
		return -ENOEXEC;
	}

	shell_print(sh, "OPP server create_pdu ok headroom %u", net_buf_headroom(buf));
	net_buf_unref(buf);

	return 0;
}

SHELL_STATIC_SUBCMD_SET_CREATE(
	opp_s_cmds,
	SHELL_CMD_ARG(register, NULL, "register OPP server + SDP record", cmd_register, 1, 0),
	SHELL_CMD_ARG(set_connect_rsp, NULL, "<hex> set OBEX connect response code",
		      cmd_set_connect_rsp, 2, 0),
	SHELL_CMD_ARG(set_push_rsp, NULL, "<hex> set PUT response code", cmd_set_push_rsp, 2, 0),
	SHELL_CMD_ARG(set_pull_rsp, NULL, "<hex> set GET (pull) response code",
		      cmd_set_pull_rsp, 2, 0),
	SHELL_CMD_ARG(set_pull_multi, NULL, "<0|1> enable multi-packet business-card pull",
		      cmd_set_pull_multi, 2, 0),
	SHELL_CMD_ARG(reset_rsp, NULL, "reset all response codes to SUCCESS", cmd_reset_rsp, 1, 0),
	SHELL_CMD_ARG(create_pdu, NULL, "allocate a server PDU (headroom test)", cmd_create_pdu,
		      1, 0),
	SHELL_SUBCMD_SET_END);

static int cmd_default_handler(const struct shell *sh, size_t argc, char **argv)
{
	if (argc == 1) {
		shell_help(sh);
		return SHELL_CMD_HELP_PRINTED;
	}

	shell_error(sh, "%s unknown parameter: %s", argv[0], argv[1]);

	return -EINVAL;
}

SHELL_CMD_ARG_REGISTER(opp_s, &opp_s_cmds, "Bluetooth classic OPP server shell commands",
		       cmd_default_handler, 1, 1);
```
