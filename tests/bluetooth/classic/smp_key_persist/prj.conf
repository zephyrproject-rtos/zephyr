## prj.conf
```kconfig
CONFIG_BT=y
CONFIG_BT_CLASSIC=y
CONFIG_BT_SMP=y
CONFIG_BT_SHELL=y
CONFIG_LOG=y
CONFIG_ZTEST=y
CONFIG_REBOOT=y
CONFIG_BT_SETTINGS=y
CONFIG_FLASH=y
CONFIG_FLASH_MAP=y
CONFIG_NVS=y
CONFIG_SETTINGS=y
# CONFIG_FLASH=y
# CONFIG_FLASH_MAP=y
# CONFIG_NVS=y
# CONFIG_SETTINGS_NVS=y
# CONFIG_SETTINGS=y
# CONFIG_BT_SETTINGS=y
# CONFIG_MPU_ALLOW_FLASH_WRITE=y

CONFIG_BT_DEVICE_NAME="smp_key_persist"

CONFIG_BT_CREATE_CONN_TIMEOUT=30
CONFIG_BT_PAGE_TIMEOUT=0xFFFF
```

## boards/mimxrt1170_evk_mimxrt1176_cm7_B.conf
```kconfig
#select NXP NW612 Chipset
CONFIG_BT_NXP_NW612=y

CONFIG_ENTROPY_GENERATOR=y
```

## src/smp_reboot.c
```c
/* smp_br_io_cap.c - Bluetooth classic SMP IO CAP smoke test */

/*
 * Copyright 2025 NXP
 *
 * SPDX-License-Identifier: Apache-2.0
 */
#include <errno.h>
#include <zephyr/types.h>
#include <stddef.h>
#include <stdlib.h>
#include <string.h>
#include <zephyr/sys/byteorder.h>
#include <zephyr/kernel.h>

#include <zephyr/sys/reboot.h>

#include <zephyr/shell/shell.h>

#include <host/shell/bt.h>
#include <common/bt_shell_private.h>

static int cmd_reboot(const struct shell *sh, size_t argc, char *argv[])
{
	sys_reboot(SYS_REBOOT_COLD);

	return 0;
}

#define HELP_NONE "[none]"

SHELL_STATIC_SUBCMD_SET_CREATE(
	test_smp_cmds,
	SHELL_CMD_ARG(reboot, NULL, HELP_NONE, cmd_reboot, 1, 0),
	SHELL_SUBCMD_SET_END);

static int cmd_default_handler(const struct shell *sh, size_t argc, char **argv)
{
	shell_error(sh, "%s unknown parameter: %s", argv[0], argv[1]);

	return -EINVAL;
}

SHELL_CMD_REGISTER(test_smp, &test_smp_cmds, "smp test cmds", cmd_default_handler);
```
