## CMakeLists.txt
```
# SPDX-License-Identifier: Apache-2.0

cmake_minimum_required(VERSION 3.28.0)
# Ahead of the vendor's include directories: the test's lll_meta.h and lll_conn_meta.h replace the
# vendor's, which #error when the options are enabled.
include_directories("./src")

find_package(Zephyr REQUIRED HINTS $ENV{ZEPHYR_BASE})
project(bluetooth_ctrl_pdu_meta)

zephyr_library_include_directories(${ZEPHYR_BASE}/subsys/bluetooth/controller/)

if(CONFIG_SOC_COMPATIBLE_NRF)
  zephyr_library_include_directories(
    ${ZEPHYR_BASE}/subsys/bluetooth/controller/ll_sw/nordic
    ${ZEPHYR_BASE}/subsys/bluetooth/hci/nordic
  )
endif()

target_include_directories(app PRIVATE
  ${ZEPHYR_BASE}/subsys/bluetooth/controller
  ${ZEPHYR_BASE}/subsys/bluetooth/controller/include
  ${ZEPHYR_BASE}/subsys/bluetooth/controller/ll_sw
  ${ZEPHYR_BASE}/subsys/bluetooth/controller/ll_sw/nordic
)

file(GLOB app_sources src/*.c)

target_sources(app PRIVATE ${app_sources})
```

## prj.conf
```kconfig
CONFIG_BT=y
CONFIG_BT_PERIPHERAL=y
CONFIG_BT_CENTRAL=y
CONFIG_ZTEST=y
CONFIG_BT_CTLR_ADVANCED_FEATURES=y
CONFIG_BT_CTLR_RX_PDU_META=y
CONFIG_BT_CTLR_TX_PDU_META=y
CONFIG_BT_CTLR_CONN_META=y
```

## src/main.c
```c
/*
 * Copyright (c) 2026 Kent Hauser
 *
 * SPDX-License-Identifier: Apache-2.0
 */

/* Builds the controller with RX, TX and connection meta data enabled, and checks that pdu[] lands
 * on the test descriptors' data.
 */

#include <stddef.h>

#include <zephyr/types.h>
#include <zephyr/ztest.h>
#include <zephyr/bluetooth/bluetooth.h>

#include "hal/cpu.h"
#include "hal/ccm.h"
#include "util/util.h"
#include "util/memq.h"
#include "pdu_df.h"
#include "lll/pdu_vendor.h"
#include "pdu.h"
#include "lll.h"
#include "lll_conn.h"

BUILD_ASSERT(offsetof(struct node_tx, pdu) ==
	     offsetof(struct node_tx, tx_pdu_meta) + offsetof(lll_tx_pdu_meta_t, data));
BUILD_ASSERT(offsetof(struct node_rx_pdu, pdu) ==
	     offsetof(struct node_rx_pdu, rx_pdu_meta) + offsetof(lll_rx_pdu_meta_t, data));
/* pdu[] is 2-byte aligned but not 4-byte aligned, as the test descriptors place it */
BUILD_ASSERT((offsetof(struct node_tx, pdu) % 4U) == 2U);
BUILD_ASSERT((offsetof(struct node_rx_pdu, pdu) % 4U) == 2U);

void lll_conn_meta_init(struct lll_conn *lll)
{
	lll->conn_meta.initialized = 1U;
}

ZTEST_SUITE(test_bluetooth, NULL, NULL, NULL, NULL, NULL);

ZTEST(test_bluetooth, test_ctrl_pdu_meta)
{
	zassert_false(bt_enable(NULL), "Bluetooth ctrl_pdu_meta failed");
}
```

## src/lll_conn_meta.h
```c
/*
 * Copyright (c) 2026 Kent Hauser
 *
 * SPDX-License-Identifier: Apache-2.0
 */

/* Test connection meta data. */
struct lll_conn_meta {
	uint8_t initialized;
};
```

## src/lll_meta.h
```c
/*
 * Copyright (c) 2026 Kent Hauser
 *
 * SPDX-License-Identifier: Apache-2.0
 */

/* Test PDU meta data: a 16-bit length followed by the PDU. pdu[] starts 2 bytes into the
 * descriptor, so it is 2-byte aligned but not 4-byte aligned.
 */

#ifndef TEST_LLL_META_H_
#define TEST_LLL_META_H_

#include <stddef.h>
#include <stdint.h>

typedef struct {
	uint16_t length;
	uint8_t data[];
} lll_tx_pdu_meta_t;

/* data[2] stands in for an unusual SDK header structure. ULL and LLL use the pdu[] declared in
 * the node's union, which starts at data[] and extends past the end of this type.
 */
typedef struct {
	uint16_t length;
	uint8_t data[2];
} lll_rx_pdu_meta_t;

#define LLL_TX_PDU_META_PDU_OFFSET offsetof(lll_tx_pdu_meta_t, data)
#define LLL_RX_PDU_META_PDU_OFFSET offsetof(lll_rx_pdu_meta_t, data)

#define BT_CTLR_USER_TX_BUFFER_OVERHEAD 4U /* e.g. MIC room for in-place encryption */
#define BT_CTLR_USER_RX_BUFFER_OVERHEAD 4U /* e.g. status the radio appends */

#endif /* TEST_LLL_META_H_ */
```
