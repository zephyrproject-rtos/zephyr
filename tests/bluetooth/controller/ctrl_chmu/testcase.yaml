## tests/bluetooth/controller/ctrl_chmu/testcase.yaml
```yaml
common:
  tags:
    - bluetooth
    - bt_chmu
    - bt_ull_llcp
tests:
  bluetooth.controller.ctrl_chmu.test:
    type: unit
```

## tests/bluetooth/controller/ctrl_cis_create/testcase.yaml
```yaml
common:
  tags:
    - bluetooth
    - bt_cis_create
    - bt_ull_llcp
tests:
  bluetooth.controller.ctrl_cis_create.test:
    type: unit
```

## tests/bluetooth/controller/ctrl_cis_terminate/testcase.yaml
```yaml
common:
  tags:
    - bluetooth
    - bt_cis_terminate
    - bt_ull_llcp
tests:
  bluetooth.controller.ctrl_cis_terminate.test:
    type: unit
```

## tests/bluetooth/controller/ctrl_collision/testcase.yaml
```yaml
common:
    tags: test_framework bluetooth bt_collision bt_ull_llcp
tests:
  bluetooth.controller.ctrl_collision.test:
     type: unit
```

## tests/bluetooth/controller/ctrl_conn_update/testcase.yaml
```yaml
common:
  tags: bluetooth bt_conn_update bt_conn_param_req bt_ull_llcp
tests:
  bluetooth.controller.ctrl_conn_update.test:
    type: unit

  bluetooth.controller.ctrl_conn_update.apm_test:
    type: unit
    extra_args: CONF_FILE=prj_apm.conf

  bluetooth.controller.ctrl_conn_update.no_param_req_test:
    type: unit
    extra_args: CONF_FILE=prj_no_param_req.conf
```

## tests/bluetooth/controller/ctrl_cte_req/testcase.yaml
```yaml
common:
  tags: bluetooth bt_le_cte_req bt_ull_llcp
tests:
  bluetooth.controller.ctrl_cte_req.test:
    type: unit
```

## tests/bluetooth/controller/ctrl_data_length_update/Kconfig
```kconfig
# SPDX-License-Identifier: Apache-2.0
#
# Copyright (c) 2022, Nordic Semiconductor ASA

config BT_CTLR_PHY
	prompt "Bluetooth 5.0 phy"
	help
	  This is generally a hidden symbol but for unit testing a prompt is
	  defined to allow controlling this setting in the build.

config BT_CTLR_PHY_CODED
	bool "Coded PHY Support"
	depends on BT_CTLR_PHY
	help
	  This is symbol generally has more dependencies but to allow for easy
	  unit testing of this source module the Kconfig setting allows to strip
	  extra dependencies.

source "Kconfig.zephyr"
```

## tests/bluetooth/controller/ctrl_data_length_update/testcase.yaml
```yaml
common:
  tags:
    - bluetooth
    - bt_data_length_update
    - bt_ull_llcp
tests:
  bluetooth.controller.ctrl_data_length_update.test:
    type: unit
    extra_args:
      - SNIPPET="bt-ll-sw-split"

  bluetooth.controller.ctrl_data_length_update.test_nocodedphy:
    type: unit
    extra_args:
      - CONF_FILE=prj_nocoded.conf
      - SNIPPET="bt-ll-sw-split"

  bluetooth.controller.ctrl_data_length_update.test_nophy:
    type: unit
    extra_args:
      - CONF_FILE=prj_nophy.conf
      - SNIPPET="bt-ll-sw-split"
```

## tests/bluetooth/controller/ctrl_encode/testcase.yaml
```yaml
common:
    tags: test_framework bluetooth encode ull_llcp
tests:
  bluetooth.controller.ctrl_encode.test:
     type: unit
     extra_args: CONFIG_BT_CTLR_PHY=y CONFIG_BT_CTLR_PHY_CODED=y CONFIG_BT_CTLR_PHY_2M=y CONFIG_BT_CTLR_DATA_LENGTH_MAX=251
```

## tests/bluetooth/controller/ctrl_encrypt/testcase.yaml
```yaml
common:
  tags:
    - bluetooth
    - bt_encrypt
    - bt_ull_llcp
tests:
  bluetooth.controller.ctrl_encrypt.test:
    type: unit
    extra_args:
      - SNIPPET="bt-ll-sw-split"
```

## tests/bluetooth/controller/ctrl_feature_exchange/testcase.yaml
```yaml
common:
    tags: test_framework bluetooth bt_feature_exchange bt_ull_llcp
tests:
  bluetooth.controller.ctrl_feature_exchange.test:
     type: unit
```

## tests/bluetooth/controller/ctrl_hci/testcase.yaml
```yaml
common:
  tags:
    - bluetooth
    - bt_ctlr_hci
    - bt_ull_llcp
tests:
  bluetooth.controller.ctrl_hci.test:
    type: unit
```

## tests/bluetooth/controller/ctrl_invalid/testcase.yaml
```yaml
common:
  tags: bluetooth bt_invalid bt_ull_llcp
tests:
  bluetooth.controller.ctrl_invalid.test:
    type: unit
```

## tests/bluetooth/controller/ctrl_le_ping/testcase.yaml
```yaml
common:
  tags: test_framework bluetooth bt_le_ping bt_ull_llcp
tests:
  bluetooth.controller.ctrl_le_ping.test:
    type: unit
```

## tests/bluetooth/controller/ctrl_min_used_chans/Kconfig
```kconfig
# Copyright (c) 2022 Nordic Semiconductor ASA
# SPDX-License-Identifier: Apache-2.0

# some of the control procedures in the BT LL depend on
# the following configs been set

config SOC_COMPATIBLE_NRF
	default y

config BT_CTLR_DATA_LEN_UPDATE_SUPPORT
	default y

config BT_CTLR_PHY_UPDATE_SUPPORT
	default y

config BT_CTLR_PHY_CODED_SUPPORT
	default y

config BT_CTLR_PHY_2M_SUPPORT
	default y

config ENTROPY_NRF_FORCE_ALT
	default n

config ENTROPY_NRF5_RNG
	default n

# Include Zephyr's Kconfig
source "Kconfig"
```

## tests/bluetooth/controller/ctrl_min_used_chans/testcase.yaml
```yaml
common:
    tags: test_framework bluetooth bt_min_used_chans bt_ull_llcp
tests:
  bluetooth.controller.ctrl_min_used_chans.test:
     type: unit
```

## tests/bluetooth/controller/ctrl_phy_update/testcase.yaml
```yaml
common:
  tags:
    - bluetooth
    - bt_phy_update
    - bt_ull_llcp
tests:
  bluetooth.controller.ctrl_phy_update.test:
    type: unit
    extra_args:
      - SNIPPET="bt-ll-sw-split"
  bluetooth.controller.ctrl_phy_update.test_reduced_buf:
    type: unit
    extra_args:
      - CONF_FILE=prj_rx_cnt.conf
      - SNIPPET="bt-ll-sw-split"
```

## tests/bluetooth/controller/ctrl_sw_privacy/testcase.yaml
```yaml
common:
  build_only: true
  tags: bluetooth
tests:
  bluetooth.ctrl_sw_privacy.test:
    platform_allow: nrf52_bsim
    extra_args:
      - SNIPPET="bt-ll-sw-split"
```

## tests/bluetooth/controller/ctrl_sw_privacy_unit/Kconfig
```kconfig
# Copyright (c) 2024 Nordic Semiconductor ASA
# SPDX-License-Identifier: Apache-2.0

source "tests/bluetooth/controller/common/Kconfig"

# Include Zephyr's Kconfig
source "Kconfig"
```

## tests/bluetooth/controller/ctrl_terminate/testcase.yaml
```yaml
common:
  tags:
    - bluetooth
    - bt_terminate
    - bt_ull_llcp
tests:
  bluetooth.controller.ctrl_terminate.test:
    type: unit
    extra_args:
      - SNIPPET="bt-ll-sw-split"
```

## tests/bluetooth/controller/ctrl_tx_buffer_alloc/testcase.yaml
```yaml
common:
  tags:
    - bluetooth
    - bt_tx_buffer_alloc
    - bt_ull_llcp
tests:
  bluetooth.controller.ctrl_tx_buffer_alloc.test_0_per_conn:
    type: unit

  bluetooth.controller.ctrl_tx_buffer_alloc.test_1_per_conn:
    type: unit
    extra_args: CONF_FILE=prj_1.conf

  bluetooth.controller.ctrl_tx_buffer_alloc.test_2_per_conn:
    type: unit
    extra_args: CONF_FILE=prj_2.conf

  bluetooth.controller.ctrl_tx_buffer_alloc.test_3_per_conn:
    type: unit
    extra_args: CONF_FILE=prj_3.conf

  bluetooth.controller.ctrl_tx_buffer_alloc.test_max_per_conn_alloc:
    type: unit
    extra_args: CONF_FILE=prj_max.conf

  bluetooth.controller.ctrl_tx_buffer_alloc.test_max_common_alloc:
    type: unit
    extra_args: CONF_FILE=prj_max_common.conf
```

## tests/bluetooth/controller/ctrl_ull_dletime/testcase.yaml
```yaml
common:
    tags: test_framework
    tags: bluetooth
    tags: dle_max_time
tests:
  bluetooth.controller.ctrl_ull_dletime.test_all:
     type: unit
     extra_args: CONFIG_BT_CTLR_PHY=y CONFIG_BT_CTLR_PHY_CODED=y CONFIG_BT_CTLR_PHY_2M=y CONFIG_BT_CTLR_DATA_LENGTH_MAX=251
  bluetooth.controller.ctrl_ull_dletime.test_coded:
     type: unit
     extra_args: CONFIG_BT_CTLR_PHY=y CONFIG_BT_CTLR_PHY_CODED=y CONFIG_BT_CTLR_PHY_2M=n CONFIG_BT_CTLR_DATA_LENGTH_MAX=251
  bluetooth.controller.ctrl_ull_dletime.test_2m:
     type: unit
     extra_args: CONFIG_BT_CTLR_PHY=y CONFIG_BT_CTLR_PHY_CODED=n CONFIG_BT_CTLR_PHY_2M=y CONFIG_BT_CTLR_DATA_LENGTH_MAX=251
  bluetooth.controller.ctrl_ull_dletime.test_none:
     type: unit
     extra_args: CONFIG_BT_CTLR_PHY=y CONFIG_BT_CTLR_PHY_CODED=n CONFIG_BT_CTLR_PHY_2M=n CONFIG_BT_CTLR_DATA_LENGTH_MAX=251
  bluetooth.controller.ctrl_ull_dletime.test_nophy:
     type: unit
     extra_args: CONFIG_BT_CTLR_PHY=n CONFIG_BT_CTLR_PHY_CODED=n CONFIG_BT_CTLR_PHY_2M=n CONFIG_BT_CTLR_DATA_LENGTH_MAX=251
```

## tests/bluetooth/controller/ctrl_unsupported/testcase.yaml
```yaml
common:
  tags:
    - bluetooth
    - bt_unsupported
    - bt_ull_llcp
tests:
  bluetooth.controller.ctrl_unsupported.default.test:
    type: unit
    extra_args:
      - SNIPPET="bt-ll-sw-split"

  bluetooth.controller.ctrl_unsupported.test:
    type: unit
    extra_args:
      - CONF_FILE=prj_unsupported.conf
      - SNIPPET="bt-ll-sw-split"
```

## tests/bluetooth/controller/ctrl_user_ext/testcase.yaml
```yaml
common:
  build_only: true
  tags: bluetooth
tests:
  bluetooth.ctrl_user_ext.test:
    platform_allow: nrf52_bsim
    extra_args:
      - SNIPPET="bt-ll-sw-split"
```

## tests/bluetooth/controller/ctrl_version/testcase.yaml
```yaml
common:
    tags: test_framework bluetooth version ull_llcp
tests:
  bluetooth.controller.ctrl_version.test:
     type: unit
```
