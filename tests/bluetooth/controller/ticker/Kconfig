## tests/bluetooth/controller/ticker/Kconfig
```kconfig
# Copyright (c) 2024 Nordic Semiconductor ASA
# SPDX-License-Identifier: Apache-2.0

# Ticker unit tests configuration

# Set compatible SoC for BT controller
config SOC_COMPATIBLE_NRF
	default y

# Disable entropy sources that may not be available in unit test environment
config ENTROPY_NRF_FORCE_ALT
	default n

config ENTROPY_NRF5_RNG
	default n

source "tests/bluetooth/controller/common/Kconfig"

# Include Zephyr's Kconfig
source "Kconfig"
```

## tests/bluetooth/controller/ticker/testcase.yaml
```yaml
common:
  tags:
    - bluetooth
    - bt_controller
    - ticker
tests:
  bluetooth.controller.ticker.test:
    type: unit
```

## tests/bluetooth/ctrl_isoal/Kconfig
```kconfig
# Bluetooth Controller configuration options for ISO-AL Unit Tests

# Copyright (c) 2022 Oticon A/S
# SPDX-License-Identifier: Apache-2.0

config BT_CTLR_CONN_ISO
	bool "LE Connected Isochronous Streams (for unit tests)"

config BT_CTLR_CONN_ISO_GROUPS
	int "LE Connected Isochronous Groups (for unit tests)"
	depends on BT_CTLR_CONN_ISO
	range 1 240
	default 1

parent-module = BT
module = BT_CTLR_ISOAL
module-str = "Bluetooth Controller ISO-AL"
source "subsys/logging/Kconfig.template.log_config_inherit"

config BT_CTLR_ISOAL_LOG_DBG_VERBOSE
	bool "ISO-AL verbose debug logging"
	depends on BT_CTLR_ISOAL_LOG_LEVEL = 4
	default n
	help
	  Use this option to enable ISO-AL verbose debug logging.

config BT_CTLR_ISOAL_SINKS
	int "Number of Isochronous Adaptation Layer sinks (for unit tests)"

config BT_CTLR_ISOAL_SOURCES
	int "Number of Isochronous Adaptation Layer sinks (for unit tests)"

config BT_CTLR_ISO_RX_SDU_BUFFERS
	int "Number of SDU fragments that the ISO-AL can buffer"
	depends on BT_CTLR_ISO_RX_BUFFER_SDUS
	default 0
	range 0 64
	help
	  Set the number of Isochronous Rx SDU fragments to be buffered in the
	  ISO-AL per channel. Buffering is required to compute the size of the
	  received SDU across all the fragments before each is released. The
	  number of buffers and maximum SDU fragment size will limit the maximum
	  size of an SDU that can be accurately declared in the HCI ISO Data
	  header.

config BT_CTLR_ISO_TX_SEG_PLAYLOAD_MIN
	int "Minimum number of playload data bytes in a new segment"
	depends on BT_CTLR_ADV_ISO || BT_CTLR_CONN_ISO
	default 1
	range 1 64
	help
	  Minimum number of payload bytes that would make inserting a new
	  segment into a PDU worthwhile.

config BT_CTLR_ISOAL_SN_STRICT
	bool "Enforce Strict Tx ISO Data Sequence Number use"
	depends on BT_CTLR_ADV_ISO || BT_CTLR_CONN_ISO
	default y

source "Kconfig.zephyr"
```

## tests/bluetooth/ctrl_isoal/testcase.yaml
```yaml
common:
  tags: bluetooth
tests:
  bluetooth.isoal.test:
    platform_allow:
      - native_posix
      - native_sim
    integration_platforms:
      - native_sim
```

## tests/bluetooth/ctrl_llcp/testcase.yaml
```yaml
common:
  tags: bluetooth
tests:
  bluetooth.ctrl_llcp.test:
    platform_whitelist: native_posix
```

## tests/bluetooth/ctrl_sw_privacy_unit/testcase.yaml
```yaml
common:
  tags: bluetooth
tests:
  bluetooth.privacy.test:
    platform_allow:
      - native_posix/native
      - native_sim/native
    integration_platforms:
      - native_sim/native
```

## tests/bluetooth/ctrl_tx_queue/testcase.yaml
```yaml
common:
  tags: bluetooth
tests:
  bluetooth.ctrl_tx_queue.test:
    platform_whitelist: native_posix
```

## tests/bluetooth/ctrl_user_ext/testcase.yaml
```yaml
common:
  build_only: true
  tags: bluetooth
tests:
  bluetooth.ctrl_user_ext.test:
    platform_whitelist: nrf52_bsim
```

## tests/bluetooth/df/connection_cte_req/testcase.yaml
```yaml
tests:
  bluetooth.df.conection_cte_req:
    platform_allow: nrf52_bsim
    tags: bluetooth
```

## tests/bluetooth/df/connection_cte_tx_params/testcase.yaml
```yaml
tests:
  bluetooth.df.conection_cte_tx_params:
    platform_allow: nrf52_bsim
    tags: bluetooth
    extra_args:
      - SNIPPET="bt-ll-sw-split"
```

## tests/bluetooth/df/connectionless_cte_chains/Kconfig
```kconfig
# Copyright (c) 2021 Nordic Semiconductor ASA
# SPDX-License-Identifier: Apache-2.0

config BT_CTLR_DF_SUPPORT
	bool
	default y

# Include Zephyr's Kconfig.
source "Kconfig"
```

## tests/bluetooth/df/connectionless_cte_chains/testcase.yaml
```yaml
tests:
  bluetooth.df.connectionless_cte_chains:
    platform_allow: nrf52_bsim
    tags: bluetooth
    extra_args:
      - SNIPPET="bt-ll-sw-split"
```

## tests/bluetooth/df/connectionless_cte_rx/testcase.yaml
```yaml
tests:
  bluetooth.df.connectionless_cte_rx:
    platform_allow: nrf52_bsim
    tags: bluetooth
    extra_args:
      - SNIPPET="bt-ll-sw-split"
```

## tests/bluetooth/df/connectionless_cte_tx/Kconfig
```kconfig
# Copyright (c) 2020 Nordic Semiconductor ASA
# SPDX-License-Identifier: Apache-2.0

config BT_CTLR_DF_SUPPORT
	bool
	default y

# Include Zephyr's Kconfig.
source "Kconfig"
```

## tests/bluetooth/df/connectionless_cte_tx/testcase.yaml
```yaml
tests:
  bluetooth.df.connectionless_cte_tx:
    platform_allow: nrf52_bsim
    tags: bluetooth
```

## tests/bluetooth/gap/testcase.yaml
```yaml
common:
  tags:
    - bluetooth
    - host
tests:
  bluetooth.gap.test:
    type: unit
```

## tests/bluetooth/gatt/testcase.yaml
```yaml
tests:
  bluetooth.gatt:
    extra_args:
      - EXTRA_DTC_OVERLAY_FILE="test.overlay"
    platform_allow:
      - native_sim
      - native_sim/native/64
      - qemu_x86
      - qemu_cortex_m3
    integration_platforms:
      - native_sim
    tags:
      - bluetooth
      - gatt
  bluetooth.gatt.psa:
    filter: CONFIG_PSA_CRYPTO_CLIENT
    extra_args:
      - EXTRA_DTC_OVERLAY_FILE="test.overlay"
    platform_allow:
      - native_sim
      - native_sim/native/64
      - qemu_x86
      - qemu_cortex_m3
      - nrf5340dk/nrf5340/cpuapp/ns
      - nrf52840dk/nrf52840
    integration_platforms:
      - native_sim
    tags:
      - bluetooth
      - gatt
  bluetooth.gatt.no_bt_conn_dynamic_callbacks:
    extra_args:
      - EXTRA_DTC_OVERLAY_FILE="test.overlay"
      - CONFIG_BT_CONN_DYNAMIC_CALLBACKS=n
    platform_allow:
      - native_sim
      - native_sim/native/64
      - qemu_x86
      - qemu_cortex_m3
    integration_platforms:
      - native_sim
    tags:
      - bluetooth
      - gatt
```

## tests/bluetooth/hci/testcase.yaml
```yaml
tests:
  bluetooth.hci:
    platform_allow:
      - native_sim
    integration_platforms:
      - native_sim
    tags:
      - bluetooth
```

## tests/bluetooth/hci_codecs_info/testcase.yaml
```yaml
tests:
  bluetooth.hci_codecs_info:
    platform_allow: nrf52_bsim/nrf52833
    tags: bluetooth
```

## tests/bluetooth/hci_prop_evt/dts/bindings/zephyr,bt-hci-test.yaml
```yaml
description: Bluetooth HCI for test purposes

compatible: "zephyr,bt-hci-test"

include: bt-hci.yaml

properties:
  bt-hci-name:
    default: "test"
  bt-hci-bus:
    default: "bus_virtual"
  bt-hci-quirks:
    default: ["no-reset"]
```

## tests/bluetooth/hci_prop_evt/testcase.yaml
```yaml
tests:
  bluetooth.hci_prop_evt:
    platform_allow:
      - qemu_x86
      - qemu_cortex_m3
      - native_posix
      - native_posix_64
    integration_platforms:
      - native_posix
    tags:
      - bluetooth
      - hci
      - prop
      - event
```

## tests/bluetooth/hci_uart_async/boards/native_posix.conf
```kconfig
# Print logs and test results on stdout. For some reason, this not the
# default when SERIAL=y.
CONFIG_LOG_BACKEND_NATIVE_POSIX=y
```

## tests/bluetooth/hci_uart_async/boards/native_sim.conf
```kconfig
# Print logs and test results on stdout as this not the
# default when SERIAL=y.
CONFIG_LOG_BACKEND_NATIVE_POSIX=y
```

## tests/bluetooth/hci_uart_async/dts/bindings/zephyr,bt-hci-test.yaml
```yaml
description: Bluetooth HCI for test purposes

compatible: "zephyr,bt-hci-test"

include: bt-hci.yaml

properties:
  bt-hci-name:
    default: "Mock Controller"
  bt-hci-bus:
    default: "virtual"
```
