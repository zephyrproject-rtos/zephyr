## CMakeLists.txt
```
# SPDX-License-Identifier: Apache-2.0

cmake_minimum_required(VERSION 3.20.0)

find_package(Zephyr COMPONENTS unittest REQUIRED HINTS $ENV{ZEPHYR_BASE})

project(bluetooth_ticker)

# Include ticker source file
target_sources(testbinary
  PRIVATE
    ${ZEPHYR_BASE}/subsys/bluetooth/controller/ticker/ticker.c
    src/main.c
)

# Include ticker header directories
# Note: Mock HAL headers in src/hal/ take precedence over real HAL headers
target_include_directories(testbinary
  PRIVATE
    ${CMAKE_CURRENT_SOURCE_DIR}/src  # For mock HAL headers
    ${ZEPHYR_BASE}/subsys/bluetooth/controller/ticker
    ${ZEPHYR_BASE}/subsys/bluetooth/controller/include
    ${ZEPHYR_BASE}/subsys/bluetooth/controller
)

# Add mocks for HAL dependencies
target_sources(testbinary
  PRIVATE
    src/hal_mock.c
)
```

## Kconfig
```
# Copyright (c) 2024 Nordic Semiconductor ASA
# SPDX-License-Identifier: Apache-2.0

# Ticker unit tests configuration

# Set compatible SoC for BT controller
config SOC_COMPATIBLE_NRF
	default y

# Disable entropy sources that may not be available in unit test environment
config ENTROPY_NRF_FORCE_ALT
	default n

config ENTROPY_NRF5_RNG
	default n

source "tests/bluetooth/controller/common/Kconfig"

# Include Zephyr's Kconfig
source "Kconfig"
```

## prj.conf
```kconfig
# SPDX-License-Identifier: Apache-2.0

# Enable Zephyr test framework
CONFIG_ZTEST=y

# Enable assertions for debugging
CONFIG_ASSERT=y
CONFIG_ASSERT_LEVEL=2
CONFIG_ASSERT_VERBOSE=y

# Bluetooth Controller Configuration
CONFIG_BT=y
CONFIG_BT_HCI=y
CONFIG_BT_LLL_VENDOR_NORDIC=y

# Ticker Configuration - Enable all features for comprehensive testing
CONFIG_BT_TICKER_EXT=y
# CONFIG_BT_TICKER_EXT_EXPIRE_INFO=y
# CONFIG_BT_TICKER_PRIORITY_SET=y

# Enable advertising and connection features for ticker usage
CONFIG_BT_BROADCASTER=y
CONFIG_BT_OBSERVER=y
CONFIG_BT_CENTRAL=y
CONFIG_BT_PERIPHERAL=y

# Disable features that might interfere with unit testing
CONFIG_BT_CTLR_ASSERT_HANDLER=n
```

## src/hal_mock.c
```c
/*
 * Copyright (c) 2024 Nordic Semiconductor ASA
 *
 * SPDX-License-Identifier: Apache-2.0
 */

/**
 * @file hal_mock.c
 * @brief Mock implementations of HAL interfaces for ticker unit tests
 *
 * This file provides mock implementations of hardware abstraction layer
 * (HAL) interfaces required by the ticker module for unit testing.
 */

#include <zephyr/types.h>
#include <zephyr/ztest.h>

/* Global variables for mock control */
static uint32_t mock_cntr_ticks = 0;
static uint32_t mock_cntr_increment = 1;

/**
 * Mock implementation of cntr_cnt_get
 * Returns a simulated counter value for testing
 */
uint32_t cntr_cnt_get(void)
{
	uint32_t current = mock_cntr_ticks;
	mock_cntr_ticks += mock_cntr_increment;
	return current;
}

/**
 * Mock implementation of cntr_cmp_set
 * Sets the compare value for the counter (no-op in mock)
 */
void cntr_cmp_set(uint8_t cmp, uint32_t value)
{
	/* Mock implementation - no actual hardware operation */
	(void)cmp;
	(void)value;
}

/**
 * Mock implementation of cpu_dmb
 * Data memory barrier (no-op in mock)
 */
void cpu_dmb(void)
{
	/* Mock implementation - no actual memory barrier needed in tests */
}

/**
 * Reset mock counter to initial state
 */
void hal_mock_reset(void)
{
	mock_cntr_ticks = 0;
	mock_cntr_increment = 1;
}

/**
 * Set mock counter increment value
 */
void hal_mock_set_increment(uint32_t increment)
{
	mock_cntr_increment = increment;
}

/**
 * Set mock counter ticks value
 */
void hal_mock_set_ticks(uint32_t ticks)
{
	mock_cntr_ticks = ticks;
}

/**
 * Get current mock counter ticks value
 */
uint32_t hal_mock_get_ticks(void)
{
	return mock_cntr_ticks;
}
```

## src/soc.h
```c
/*
 * Copyright (c) 2024 Nordic Semiconductor ASA
 *
 * SPDX-License-Identifier: Apache-2.0
 */

/*
 * Mock soc.h header file for ticker unit tests
 * Intentionally minimal to avoid hardware dependencies
 */
```
