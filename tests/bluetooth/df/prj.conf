## CMakeLists.txt
```
#
# Copyright (c) 2020 Nordic Semiconductor ASA
#
# SPDX-License-Identifier: Apache-2.0

cmake_minimum_required(VERSION 3.13.1)
find_package(Zephyr REQUIRED HINTS $ENV{ZEPHYR_BASE})
project(bluetooth_df)

FILE(GLOB app_sources src/*.c)
target_sources(app PRIVATE ${app_sources})
```

## prj.conf
```kconfig
#
# Copyright (c) 2020 Nordic Semiconductor ASA
#
# SPDX-License-Identifier: Apache-2.0


CONFIG_TEST=y
CONFIG_ZTEST=y

CONFIG_BT=y
CONFIG_BT_CTLR=n
CONFIG_BT_NO_DRIVER=y
CONFIG_BT_RECV_IS_RX_THREAD=y

CONFIG_BT_HCI_VS_EVT_USER=y

CONFIG_HEAP_MEM_POOL_SIZE=2048

CONFIG_BT_DIRECTION_FINDING=y
```

## src/main.c
```c
/*
 * Copyright (c) 2020 Nordic Semiconductor ASA
 *
 * SPDX-License-Identifier: Apache-2.0
 */

#include <stdint.h>

#include "common.h"
#include "test_set_cl_cte_tx_params.h"
#include "test_set_cl_cte_tx_enable.h"


/*test case main entry*/
void test_main(void)
{
	common_setup();
	common_create_adv_set();
	run_set_cl_cte_tx_params_tests();
	common_delete_adv_set();
	run_set_cl_cte_tx_enable_tests();
}
```

## src/common.c
```c
/*
 * Copyright (c) 2021 Nordic Semiconductor ASA
 *
 * SPDX-License-Identifier: Apache-2.0
 */

#include <zephyr.h>
#include <stddef.h>
#include <ztest.h>

#include <bluetooth/bluetooth.h>
#include <bluetooth/hci.h>
#include <bluetooth/direction.h>
#include <host/hci_core.h>

#include "common.h"

struct bt_le_ext_adv *g_adv;
struct bt_le_adv_param g_param =
		BT_LE_ADV_PARAM_INIT(BT_LE_ADV_OPT_EXT_ADV |
				     BT_LE_ADV_OPT_NOTIFY_SCAN_REQ,
				     BT_GAP_ADV_FAST_INT_MIN_2,
				     BT_GAP_ADV_FAST_INT_MAX_2,
				     NULL);

static struct bt_le_per_adv_param per_param = {
	.interval_min = BT_GAP_ADV_SLOW_INT_MIN,
	.interval_max = BT_GAP_ADV_SLOW_INT_MAX,
	.options = BT_LE_ADV_OPT_USE_TX_POWER,
};

void common_setup(void)
{
	int err;

	/* Initialize bluetooth subsystem */
	err = bt_enable(NULL);
	zassert_equal(err, 0, "Bluetooth subsystem initialization failed");
}

void common_create_adv_set(void)
{
	int err;

	err = bt_le_ext_adv_create(&g_param, NULL, &g_adv);
	zassert_equal(err, 0, "Failed to create advertiser set");
}

void common_delete_adv_set(void)
{
	int err;

	err = bt_le_ext_adv_delete(g_adv);
	zassert_equal(err, 0, "Failed to delete advertiser set");
}
```

## src/common.h
```c
/*
 * Copyright (c) 2021 Nordic Semiconductor ASA
 *
 * SPDX-License-Identifier: Apache-2.0
 */

extern struct bt_le_ext_adv *g_adv;
extern struct bt_le_adv_param g_param;

void common_setup(void);
void common_create_adv_set(void);
void common_delete_adv_set(void);
```

## src/hci_driver_mock.c
```c
/*
 * Copyright (c) 2020 Nordic Semiconductor ASA
 *
 * SPDX-License-Identifier: Apache-2.0
 */

#include <zephyr.h>
#include <ztest_assert.h>
#include <bluetooth/buf.h>
#include <bluetooth/bluetooth.h>
#include <drivers/bluetooth/hci_driver.h>
#include "hci_mock.h"


/* @brief Function handles HCI commands received from
 * HOST and provides response events.
 *
 * Function uses mock of HCI command handler to process
 * HCI messages received from HOST. If handler provides
 * reposnse event, that event is send back to HOST.
 *
 * @param[in] buf	Pointer to command buffer
 */
static int cmd_handle(struct net_buf *buf)
{
	int err = 0;
	struct net_buf *evt;

	evt = hci_cmd_handle(buf);
	if (evt) {
		err = bt_recv_prio(evt);
		if (err) {
			printk("HCI Test driver - failed bt_recv_prio,"
			       " error %d", err);
		}
		return err;
	}
	return 0;
}

/* @brief HCI Test driver open function */
static int hci_driver_open(void)
{
	return 0;
}

/* @brief HCI Test driver mock of send function.
 *
 * @param[in] buf	Pointer to command to be handled
 *
 * @return 0 on success, negative error number on failure
 */
static int hci_driver_send(struct net_buf *buf)
{
	int err;

	err = cmd_handle(buf);
	net_buf_unref(buf);

	return err;
}

/* @brief Instance of a HCI test virtual driver. */
static const struct bt_hci_driver hci_test_drv = {
	.name = "hci_test_drv",
	.bus = BT_HCI_DRIVER_BUS_VIRTUAL,
	.open = hci_driver_open,
	.send = hci_driver_send,
	.quirks = BT_QUIRK_NO_RESET
};

int hci_init_test_driver(void)
{
	/* Register the test HCI driver */
	return bt_hci_driver_register(&hci_test_drv);
}
```

## src/hci_driver_mock.h
```c
/*
 * Copyright (c) 2020 Nordic Semiconductor ASA
 *
 * SPDX-License-Identifier: Apache-2.0
 */

#ifndef ZEPHYR_TESTS_BLUETOOTH_DF_HCI_DRIVER_MOCK_H_
#define ZEPHYR_TESTS_BLUETOOTH_DF_HCI_DRIVER_MOCK_H_

/* @brief Function initislizes virtual test HCI driver.
 *
 * @return Function returns zero in case of success,
 * negative error value in case of failure.
 */
int hci_init_test_driver(void);

#endif /* ZEPHYR_TESTS_BLUETOOTH_DF_HCI_DRIVER_MOCK_H_ */
```

## src/hci_mock.c
```c
/*
 * Copyright (c) 2020 Nordic Semiconductor ASA
 *
 * SPDX-License-Identifier: Apache-2.0
 */

#include <zephyr.h>
#include <ztest_assert.h>
#include <bluetooth/buf.h>
#include <bluetooth/hci.h>
#include <drivers/bluetooth/hci_driver.h>
#include <sys/byteorder.h>
#include "hci_mock.h"

/* @brief Storage for reference to user defined HCI command handlers. */
static struct {
	const struct hci_cmd_handler *handlers;	/* Pointer to handlers array */
	uint32_t num;				/* Handlers array size */
} user_cmd_handlers;

/* @brief The function is a mock handler for
 *  BT_HCI_OP_READ_LOCAL_FEATURES HCI command.
 *
 * @param[in] opcode	Opcode of request command
 * @param[in] cmd	Pointer to requect command
 * @param[out] evt	Pointer to memory where to store response event
 * @param[in] rp_len	Length of response event
 */
static void read_local_features(uint16_t opcode, struct net_buf *buf,
				struct net_buf **evt, uint8_t rp_len)
{
	struct bt_hci_rp_read_local_features *rp;

	rp = hci_cmd_complete(opcode, evt, sizeof(*rp));
	rp->status = 0x00;
	(void)memset(&rp->features[0], 0xFF, sizeof(rp->features));
}

/* @brief The function is a mock handler for
 *  BT_HCI_OP_READ_SUPPORTED_COMMANDS HCI command.
 *
 * @param[in] opcode	Opcode of request command
 * @param[in] cmd	Pointer to requect command
 * @param[out] evt	Pointer to memory where to store response event
 * @param[in] rp_len	Length of response event
 */
static void read_supported_commands(uint16_t opcode, struct net_buf *buf,
				    struct net_buf **evt, uint8_t rp_len)
{
	struct bt_hci_rp_read_supported_commands *rp;

	rp = hci_cmd_complete(opcode, evt, sizeof(*rp));
	(void)memset(&rp->commands[0], 0xFF, sizeof(rp->commands));
	rp->status = 0x00;
}

/* @brief The function is a mock handler for
 *  BT_HCI_OP_LE_READ_LOCAL_FEATURES HCI command.
 *
 * @param[in] opcode	Opcode of request command
 * @param[in] cmd	Pointer to requect command
 * @param[out] evt	Pointer to memory where to store response event
 * @param[in] rp_len	Length of response event
 */
static void le_read_local_features(uint16_t opcode, struct net_buf *buf,
				   struct net_buf **evt, uint8_t rp_len)
{
	struct bt_hci_rp_le_read_local_features *rp;

	rp = hci_cmd_complete(opcode, evt, sizeof(*rp));
	rp->status = 0x00;
	(void)memset(&rp->features[0], 0xFF, sizeof(rp->features));
}

/* @brief The function is a mock handler for
 *  BT_HCI_OP_LE_READ_SUPP_STATES HCI command.
 *
 * @param[in] opcode	Opcode of request command
 * @param[in] cmd	Pointer to requect command
 * @param[out] evt	Pointer to memory where to store response event
 * @param[in] rp_len	Length of response event
 */
static void le_read_supp_states(uint16_t opcode, struct net_buf *buf,
				struct net_buf **evt, uint8_t rp_len)
{
	struct bt_hci_rp_le_read_supp_states *rp;

	rp = hci_cmd_complete(opcode, evt, sizeof(*rp));
	rp->status = 0x00;
	(void)memset(&rp->le_states, 0xFF, sizeof(rp->le_states));
}

/* @brief Common HCI command handlers required by bt_enable function.
 *
 * Each handler may be overridden by user. Just provide a handler
 * with appropriate opcode of command.
 */
static const struct hci_cmd_handler common_handlers[] = {
	{ BT_HCI_OP_READ_LOCAL_VERSION_INFO,
	  sizeof(struct bt_hci_rp_read_local_version_info),
	  hci_cmd_complete_success },
	{ BT_HCI_OP_READ_SUPPORTED_COMMANDS,
	  sizeof(struct bt_hci_rp_read_supported_commands),
	  read_supported_commands },
	{ BT_HCI_OP_READ_LOCAL_FEATURES,
	  sizeof(struct bt_hci_rp_read_local_features),
	  read_local_features },
	{ BT_HCI_OP_READ_BD_ADDR,
	  sizeof(struct bt_hci_rp_read_bd_addr),
	  hci_cmd_complete_success },
	{ BT_HCI_OP_SET_EVENT_MASK,
	  sizeof(struct bt_hci_evt_cc_status),
	  hci_cmd_complete_success },
	{ BT_HCI_OP_LE_SET_EVENT_MASK,
	  sizeof(struct bt_hci_evt_cc_status),
	  hci_cmd_complete_success },
	{ BT_HCI_OP_LE_READ_LOCAL_FEATURES,
	  sizeof(struct bt_hci_rp_le_read_local_features),
	  le_read_local_features },
	{ BT_HCI_OP_LE_READ_SUPP_STATES,
	  sizeof(struct bt_hci_rp_le_read_supp_states),
	  le_read_supp_states },
	{ BT_HCI_OP_LE_RAND,
	  sizeof(struct bt_hci_rp_le_rand),
	  hci_cmd_complete_success },
	{ BT_HCI_OP_LE_SET_RANDOM_ADDRESS,
	  sizeof(struct bt_hci_cp_le_set_random_address),
	  hci_cmd_complete_success },
};

void hci_set_handlers(const struct hci_cmd_handler *handlers,
		     uint32_t num_handlers)
{
	zassert_true(handlers != NULL, "HCI command handlers pointer is null");
	zassert_true(num_handlers != 0, "HCI command handlers number is zero");

	user_cmd_handlers.handlers = handlers;
	user_cmd_handlers.num = num_handlers;
}

void *hci_cmd_complete(uint16_t opcode, struct net_buf **buf, uint8_t rp_len)
{
	*buf = bt_hci_cmd_complete_create(opcode, rp_len);

	return net_buf_add(*buf, rp_len);
}

void hci_cmd_complete_success(uint16_t opcode, struct net_buf *cmd,
			      struct net_buf **evt, uint8_t rp_len)
{
	struct bt_hci_evt_cc_status *ccst;

	ccst = hci_cmd_complete(opcode, evt, rp_len);

	(void)memset(ccst, 0, rp_len);

	ccst->status = BT_HCI_ERR_SUCCESS;
}

struct net_buf *hci_cmd_handle(struct net_buf *cmd)
{
	struct bt_hci_cmd_hdr *chdr;
	struct net_buf *evt = NULL;
	uint16_t opcode;
	bool cmd_handled;

	if (cmd->len < sizeof(*chdr)) {
		return NULL;
	}

	chdr = net_buf_pull_mem(cmd, sizeof(*chdr));
	if (cmd->len < chdr->param_len) {
		return NULL;
	}

	opcode = sys_le16_to_cpu(chdr->opcode);
	cmd_handled = false;

	const struct hci_cmd_handler *handler;

	if (user_cmd_handlers.handlers != NULL && user_cmd_handlers.num > 0) {
		uint32_t num = user_cmd_handlers.num;

		for (uint32_t handl_idx = 0; handl_idx < num; ++handl_idx) {
			handler = &user_cmd_handlers.handlers[handl_idx];
			if (handler->opcode == opcode) {
				handler->handl_cb(opcode, cmd, &evt,
						  handler->rp_len);
				cmd_handled = true;
				break;
			}
		}
	}

	if (cmd_handled == false) {
		uint32_t num = ARRAY_SIZE(common_handlers);

		for (uint32_t handl_idx = 0; handl_idx < num; ++handl_idx) {
			handler = &common_handlers[handl_idx];
			if (handler->opcode == opcode) {
				handler->handl_cb(opcode, cmd, &evt,
						  handler->rp_len);
				cmd_handled = true;
				break;
			}
		}
	}

	if (cmd_handled == false) {
		evt = bt_hci_cmd_status_create(opcode, BT_HCI_ERR_UNKNOWN_CMD);
	}

	return evt;
}
```

## src/hci_mock.h
```c
/*
 * Copyright (c) 2020 Nordic Semiconductor ASA
 *
 * SPDX-License-Identifier: Apache-2.0
 */

#ifndef ZEPHYR_TESTS_BLUETOOTH_DF_HCI_MOCK_H_
#define ZEPHYR_TESTS_BLUETOOTH_DF_HCI_MOCK_H_

#include <stdint.h>

/* Command handler structure for cmd_handle(). */
struct hci_cmd_handler {
	uint16_t opcode;
	uint8_t rp_len;
	void (*handl_cb)(uint16_t opcode, struct net_buf *buf,
			 struct net_buf **evt, uint8_t rp_len);
};

/* @brief Function sets HCI command handlers that will be used
 * during unit tests to simulate BLE Controller.
 *
 * @param[in] handlers		Pointer to handlers array.
 * @param[in] num_handlers	Length of handlers array.
 */
void hci_set_handlers(const struct hci_cmd_handler *handlers,
		     uint32_t num_handlers);

/* @brief Function prepares comman complete event.
 *
 * Prepared event is associated with given opcode and has size
 * requested by response length.
 *
 * @param[in] opcode	Opcode of a command to prepare completion even.
 * @param[out] buf	Pointer for an event memory.
 * @param[in] rp_len	Length of response event.
 *
 * @return Pointer to beginning of the response memory.
 */
void *hci_cmd_complete(uint16_t opcode, struct net_buf **buf, uint8_t rp_len);

/* @brief The function is a generic handler for command complete
 *  with success status.
 *
 *  All event parameters are set to zeros.
 *
 * @param[in] opcode	Opcode of request command
 * @param[in] cmd	Pointer to requect command
 * @param[out] evt	Pointer to memory where to store response event
 * @param[in] rp_len	Length of response event
 */
void hci_cmd_complete_success(uint16_t opcode, struct net_buf *cmd,
			      struct net_buf **evt, uint8_t rp_len);

/* @brief Function is a generic test handler for HCI commands.
 *
 * Function handles HCI commands by common definded commands or
 * user defined command handlers.
 * User defined command handler has priority over common handlers.
 *
 * @param[in] cmd	Pointer to command memory.
 *
 * @retval NULL		Null poitner if the message does not provide
 *			reposnse.
 */
struct net_buf *hci_cmd_handle(struct net_buf *cmd);

#endif /* ZEPHYR_TESTS_BLUETOOTH_DF_HCI_MOCK_H_ */
```

## src/radio_df_stub.c
```c
/*
 * Copyright (c) 2021 Nordic Semiconductor ASA
 *
 * SPDX-License-Identifier: Apache-2.0
 */
#include <stdint.h>

/* Stub functitons that does nothing. Just to avoid liker complains. */
void radio_df_ant_configure(void)
{

}

uint8_t radio_df_ant_num_get(void)
{
	return 0;
}

void radio_df_cte_inline_set(uint8_t enable)
{

}

void radio_df_cte_length_set(uint8_t value)
{

}

void radio_df_ant_switch_pattern_clear(void)
{

}

void radio_df_ant_switch_pattern_set(uint8_t pattern)
{

}

void radio_df_reset(void)
{

}

void radio_switch_complete_and_phy_end_disable(void)
{

}

void radio_df_ant_switch_spacing_set_2us(void)
{

}

void radio_df_ant_switch_spacing_set_4us(void)
{

}

void radio_df_mode_set_aoa(void)
{

}

void radio_df_mode_set_aod(void)
{

}

void radio_df_ant_switching_gpios_cfg(void)
{

}

void radio_df_ant_switching_pin_sel_cfg(void)
{

}
```

## src/test_set_cl_cte_tx_enable.c
```c
/*
 * Copyright (c) 2021 Nordic Semiconductor ASA
 *
 * SPDX-License-Identifier: Apache-2.0
 */

#include <zephyr.h>
#include <stddef.h>
#include <ztest.h>

#include <bluetooth/bluetooth.h>
#include <bluetooth/hci.h>
#include <sys/byteorder.h>
#include <host/hci_core.h>

#include "common.h"
#include "test_set_cl_cte_tx_enable.h"

/* Macros delivering common values for unit tests */
#define ADV_HANDLE_INVALID              (CONFIG_BT_CTLR_ADV_AUX_SET + 1)

/* @brief Function sends HCI_LE_Set_Connectionless_CTE_Transmit_Enable
 *        to controller.
 *
 * @param[in]adv_handle                 Handle of advertising set.
 * @param[in]adv_flags                  Flags related with advertising set.
 * @param[in] enable                    Enable or disable CTE TX
 *
 * @return Zero if success, non-zero value in case of failure.
 */
int send_set_cl_cte_tx_enable(uint8_t adv_handle, atomic_t *adv_flags,
			      bool enable)
{
	struct bt_hci_cp_le_set_cl_cte_tx_enable *cp;
	struct bt_hci_cmd_state_set state;
	struct net_buf *buf;

	buf = bt_hci_cmd_create(BT_HCI_OP_LE_SET_CL_CTE_TX_ENABLE, sizeof(*cp));
	if (!buf) {
		return -ENOBUFS;
	}

	cp = net_buf_add(buf, sizeof(*cp));
	(void)memset(cp, 0, sizeof(*cp));

	cp->handle = adv_handle;
	cp->cte_enable = enable ? 1 : 0;

	bt_hci_cmd_state_set_init(buf, &state, adv_flags, BT_PER_ADV_CTE_ENABLED,
				  enable);

	return bt_hci_cmd_send_sync(BT_HCI_OP_LE_SET_CL_CTE_TX_ENABLE,
				    buf, NULL);
}

void test_set_cl_cte_tx_enable_invalid_adv_set_handle(void)
{
	int err;

	err = send_set_cl_cte_tx_enable(ADV_HANDLE_INVALID, g_adv->flags, true);
	zassert_equal(err, -EIO, "Unexpected error value for enable CTE with "
		      "wrong advertising set handle");
}

void test_set_cl_cte_tx_enable_cte_params_not_set(void)
{
	int err;

	/* setup */
	common_create_adv_set();

	/* test logic */
	err = send_set_cl_cte_tx_enable(g_adv->handle, g_adv->flags, true);
	zassert_equal(err, -EIO, "Unexpected error value for enable CTE before "
		      "CTE params set");

	/* clean up */
	common_delete_adv_set();
}

void test_set_cl_cte_tx_enable_per_adv_coded_phy(void)
{
	int err;

	/* setup */
	g_param.options =  g_param.options | BT_LE_ADV_OPT_CODED;

	common_create_adv_set();
	common_set_cl_cte_tx_params();

	/* test logic */
	err = send_set_cl_cte_tx_enable(g_adv->handle, g_adv->flags, true);
	zassert_equal(err, -EIO, "Unexpected error value for enable CTE for "
		      "coded PHY");

	/* clean up */
	common_delete_adv_set();

	g_param.options =  g_param.options & (~BT_LE_ADV_OPT_CODED);
}

void test_set_cl_cte_tx_enable(void)
{
	int err;

	/* setup */
	common_create_adv_set();
	common_set_cl_cte_tx_params();
	common_set_adv_params();

	/* test logic */
	err = send_set_cl_cte_tx_enable(g_adv->handle, g_adv->flags, true);
	zassert_equal(err, 0, "Unexpected error value for enable CTE");

	/* clean up */
	err = send_set_cl_cte_tx_enable(g_adv->handle, g_adv->flags, false);
	zassert_equal(err,  0, "Unexpected error value for disable CTE ");

	common_delete_adv_set();
}

void test_set_cl_cte_tx_enable_after_per_adv_enabled(void)
{
	int err;

	/* setup */
	common_create_adv_set();
	common_set_cl_cte_tx_params();
	common_set_adv_params();
	common_per_adv_enable();

	/* test logic */
	err = send_set_cl_cte_tx_enable(g_adv->handle, g_adv->flags, true);
	zassert_equal(err,  0, "Unexpected error value for enable CTE after"
		      " per. adv. is enabled");

	/* clean up */
	err = send_set_cl_cte_tx_enable(g_adv->handle, g_adv->flags, false);
	zassert_equal(err,  0, "Unexpected error value for disable CTE ");

	common_per_adv_disable();
	common_delete_adv_set();
}

void test_set_cl_cte_tx_disable_when_no_CTE_enabled(void)
{
	int err;

	/* setup */
	common_create_adv_set();

	/* test logic */
	err = send_set_cl_cte_tx_enable(g_adv->handle, g_adv->flags, false);
	zassert_equal(err,  -EIO, "Unexpected error value for disable CTE "
		      "before CTE enable");

	/* clean up */
	common_delete_adv_set();
}

void test_set_cl_cte_tx_disable_before_per_adv_enable(void)
{
	int err;

	/* setup */
	common_create_adv_set();
	common_set_cl_cte_tx_params();
	common_set_adv_params();

	err = send_set_cl_cte_tx_enable(g_adv->handle, g_adv->flags, true);
	zassert_equal(err,  0, "Unexpected error value for enable");

	/* test logic */
	err = send_set_cl_cte_tx_enable(g_adv->handle, g_adv->flags, false);
	zassert_equal(err,  0, "Unexpected error value for disable CTE ");

	/* clean up */
	common_delete_adv_set();
}

void test_set_cl_cte_tx_disable_during_per_adv_enable(void)
{
	int err;

	/* setup */
	common_create_adv_set();
	common_set_cl_cte_tx_params();
	common_set_adv_params();

	err = send_set_cl_cte_tx_enable(g_adv->handle, g_adv->flags, true);
	zassert_equal(err,  0, "Unexpected error value for enable");

	common_per_adv_enable();

	/* test logic */
	err = send_set_cl_cte_tx_enable(g_adv->handle, g_adv->flags, false);
	zassert_equal(err,  0, "Unexpected error value for disable CTE ");

	/* clean up */
	common_per_adv_disable();
	common_delete_adv_set();
}

void test_set_cl_cte_tx_enable_and_update_cte_params(void)
{
	uint8_t cte_len_prev;
	int err;

	/* setup */
	common_create_adv_set();
	common_set_cl_cte_tx_params();
	common_set_adv_params();

	printk("en cte\n");
	/* test logic */
	err = send_set_cl_cte_tx_enable(g_adv->handle, g_adv->flags, true);
	zassert_equal(err,  0, "Unexpected error value for enable CTE after"
		      " per. adv. is enabled");

	printk("en adv\n");
	common_per_adv_enable();

	printk("disable cte\n");
	err = send_set_cl_cte_tx_enable(g_adv->handle, g_adv->flags, false);
	zassert_equal(err,  0, "Unexpected error value for disable CTE ");

	printk("params to update\n");
	cte_len_prev = g_cte_len;
	g_cte_len = 0x5U;
	common_set_cl_cte_tx_params();

	printk("params updated\n");
	err = send_set_cl_cte_tx_enable(g_adv->handle, g_adv->flags, true);
	zassert_equal(err,  0, "Unexpected error value for enable CTE after"
		      " per. adv. is enabled");

	printk("cleanup\n");
	/* clean up */
	err = send_set_cl_cte_tx_enable(g_adv->handle, g_adv->flags, false);
	zassert_equal(err,  0, "Unexpected error value for disable CTE ");

	g_cte_len = cte_len_prev;
	common_per_adv_disable();
	common_delete_adv_set();
}

void run_set_cl_cte_tx_enable_tests(void)
{
	ztest_test_suite(test_hci_df_info,
			 ztest_unit_test(test_set_cl_cte_tx_enable_invalid_adv_set_handle),
			 ztest_unit_test(test_set_cl_cte_tx_enable_cte_params_not_set),
			 ztest_unit_test(test_set_cl_cte_tx_enable_per_adv_coded_phy),
			 ztest_unit_test(test_set_cl_cte_tx_enable),
			 ztest_unit_test(test_set_cl_cte_tx_enable_after_per_adv_enabled),
			 ztest_unit_test(test_set_cl_cte_tx_disable_before_per_adv_enable),
			 ztest_unit_test(test_set_cl_cte_tx_enable_and_update_cte_params),
			 ztest_unit_test(test_set_cl_cte_tx_disable_during_per_adv_enable));
	ztest_run_test_suite(test_hci_df_info);
}
```

## src/test_set_cl_cte_tx_enable.h
```c
/*
 * Copyright (c) 2021 Nordic Semiconductor ASA
 *
 * SPDX-License-Identifier: Apache-2.0
 */

/* Runs tests for HCI_LE_Set_Connectionless_CTE_Transmit_Enable command */
void run_set_cl_cte_tx_enable_tests(void);
```

## src/test_set_cl_cte_tx_param.c
```c
/*
 * Copyright (c) 2020 Nordic Semiconductor ASA
 *
 * SPDX-License-Identifier: Apache-2.0
 */

#include <zephyr.h>
#include <stddef.h>
#include <ztest.h>

#include <bluetooth/bluetooth.h>
#include <bluetooth/hci.h>
#include <sys/byteorder.h>
#include <host/hci_core.h>

#include "common.h"

/* Macros delivering common values for unit tests */
#define CTE_LEN_VALID                   (BT_HCI_LE_CTE_LEN_MIN + 5)
#define CTE_LEN_INVALID                 (BT_HCI_LE_CTE_LEN_MAX + 1)
#define CTE_COUNT_VALID                 (BT_HCI_LE_CTE_COUNT_MIN + 5)
#define CTE_COUNT_INVALID               (BT_HCI_LE_CTE_COUNT_MAX + 1)
#define ADV_HANDLE_INVALID              (CONFIG_BT_CTLR_ADV_AUX_SET + 1)
#define CTE_TYPE_INVALID                0xFF
#define ANT_SW_PATTERN_LEN_INVALID      \
	(CONFIG_BT_CTLR_DF_MAX_ANT_SW_PATTERN_LEN + 1)

/* Antenna identifiers */
static uint8_t g_ant_ids[] = { 0x1, 0x2, 0x3, 0x4, 0x5 };

/* @brief Function sends HCI_LE_Set_Connectionless_CTE_Transmit_Parameters
 *        to controller.
 *
 * @param[in]adv_handle                 Handle of advertising set.
 * @param[in]cte_len                    Length of CTE in 8us units.
 * @param[in]cte_type                   Type of CTE to be used for transmission.
 * @param[in]cte_count                  Number of CTE that should be transmitted
 *                                      during each periodic advertising
 *                                      interval.
 * @param[in]num_ant_ids                Number of antenna IDs in switching
 *                                      pattern. May be zero if CTE type is
 *                                      AoA.
 * @param[in]ant_ids                    Array of antenna IDs in a switching
 *                                      pattern. May be NULL if CTE type is AoA.
 *
 * @return Zero if success, non-zero value in case of failure.
 */
int send_set_cl_cte_tx_params(uint8_t adv_handle, uint8_t cte_len,
					  uint8_t cte_type, uint8_t cte_count,
					  uint8_t switch_pattern_len,
					  uint8_t *ant_ids)
{
	struct bt_hci_cp_le_set_cl_cte_tx_params *cp;
	struct net_buf *buf;

	buf = bt_hci_cmd_create(BT_HCI_OP_LE_SET_CL_CTE_TX_PARAMS,
				sizeof(*cp) + switch_pattern_len);
	zassert_not_null(buf, "Failed to create HCI cmd object");

	cp = net_buf_add(buf, sizeof(*cp));
	cp->handle = adv_handle;
	cp->cte_len = cte_len;
	cp->cte_type = cte_type;
	cp->cte_count = cte_count;

	uint8_t *dest_ant_ids = net_buf_add(buf, switch_pattern_len);

	if (switch_pattern_len > 0) {
		memcpy(dest_ant_ids, ant_ids, switch_pattern_len);
	}
	cp->switch_pattern_len = switch_pattern_len;

	return bt_hci_cmd_send_sync(BT_HCI_OP_LE_SET_CL_CTE_TX_PARAMS,
				    buf, NULL);
}

void test_set_cl_cte_tx_params_with_correct_aod_2us(void)
{
	int err;

	err = send_set_cl_cte_tx_params(g_adv->handle,
					CTE_LEN_VALID,
					BT_HCI_LE_AOD_CTE_2US,
					CTE_COUNT_VALID,
					ARRAY_SIZE(g_ant_ids),
					g_ant_ids);
	zassert_equal(err, 0, "Set AoD 2us CTE parameters failed");
}

void test_set_cl_cte_tx_params_with_correct_aod_1us(void)
{
	int err;

	err = send_set_cl_cte_tx_params(g_adv->handle,
					CTE_LEN_VALID,
					BT_HCI_LE_AOD_CTE_1US,
					CTE_COUNT_VALID,
					ARRAY_SIZE(g_ant_ids),
					g_ant_ids);
	zassert_equal(err, 0, "Set AoD 1us CTE parameters failed");
}

void test_set_ct_cte_tx_params_correct_aoa(void)
{
	int err;

	err = send_set_cl_cte_tx_params(ADV_HANDLE_INVALID,
					CTE_LEN_VALID,
					BT_HCI_LE_AOA_CTE,
					CTE_COUNT_VALID,
					ARRAY_SIZE(g_ant_ids),
					g_ant_ids);
	zassert_equal(err, -EIO, "Set AoA CTE parameters failed");
}

void test_set_ct_cte_tx_params_correct_aoa_without_ant_pattern(void)
{
	int err;

	err = send_set_cl_cte_tx_params(ADV_HANDLE_INVALID,
					CTE_LEN_VALID,
					BT_HCI_LE_AOA_CTE,
					CTE_COUNT_VALID,
					0,
					NULL);
	zassert_equal(err, -EIO, "Set AoA CTE parameters failed");
}

void test_set_ct_cte_tx_params_wrong_adv_handle(void)
{
	int err;

	err = send_set_cl_cte_tx_params(ADV_HANDLE_INVALID,
					CTE_LEN_VALID,
					BT_HCI_LE_AOD_CTE_2US,
					CTE_COUNT_VALID,
					ARRAY_SIZE(g_ant_ids),
					g_ant_ids);
	zassert_equal(err, -EIO,
		      "Unexpected error value for invalid adv handle");
}

void test_set_ct_cte_tx_params_invalid_cte_len(void)
{
	int err;

	err = send_set_cl_cte_tx_params(g_adv->handle,
					CTE_LEN_INVALID,
					BT_HCI_LE_AOD_CTE_2US,
					CTE_COUNT_VALID,
					ARRAY_SIZE(g_ant_ids),
					g_ant_ids);
	zassert_equal(err, -EIO,
		      "Unexpected error value for invalid CTE length");
}

void test_set_ct_cte_tx_params_invalid_cte_type(void)
{
	int err;

	err = send_set_cl_cte_tx_params(g_adv->handle,
					CTE_LEN_VALID,
					CTE_TYPE_INVALID,
					CTE_COUNT_VALID,
					ARRAY_SIZE(g_ant_ids),
					g_ant_ids);
	zassert_equal(err, -EIO,
		      "Unexpected error value for invalid CTE type");
}

void test_set_ct_cte_tx_params_invalid_cte_count(void)
{
	int err;

	err = send_set_cl_cte_tx_params(g_adv->handle,
					CTE_LEN_VALID,
					BT_HCI_LE_AOD_CTE_2US,
					CTE_COUNT_INVALID,
					ARRAY_SIZE(g_ant_ids),
					g_ant_ids);
	zassert_equal(err, -EIO,
		      "Unexpected error value for invalid CTE count");
}

void test_set_ct_cte_tx_params_aod_2us_invalid_pattern_len(void)
{
	int err;

	err = send_set_cl_cte_tx_params(g_adv->handle,
					CTE_LEN_VALID,
					BT_HCI_LE_AOD_CTE_2US,
					CTE_COUNT_VALID,
					ANT_SW_PATTERN_LEN_INVALID,
					g_ant_ids);
	zassert_equal(err, -EIO,
		      "Unexpected error value for invalid switch pattern len");
}

void test_set_ct_cte_tx_params_aod_1us_invalid_pattern_len(void)
{
	int err;

	err = send_set_cl_cte_tx_params(g_adv->handle,
					CTE_LEN_VALID,
					BT_HCI_LE_AOD_CTE_1US,
					CTE_COUNT_VALID,
					ANT_SW_PATTERN_LEN_INVALID,
					g_ant_ids);
	zassert_equal(err, -EIO,
		      "Unexpected error value for invalid switch pattern len");
}

void test_set_ct_cte_tx_params_aoa_invalid_pattern_len(void)
{
	int err;

	err = send_set_cl_cte_tx_params(g_adv->handle,
					CTE_LEN_VALID,
					BT_HCI_LE_AOA_CTE,
					CTE_COUNT_VALID,
					ANT_SW_PATTERN_LEN_INVALID,
					g_ant_ids);
	zassert_equal(err, 0, "Unexpected error value for AoA");
}

void run_set_cl_cte_tx_params_tests(void)
{
	ztest_test_suite(test_hci_df_info,
			 ztest_unit_test(test_set_cl_cte_tx_params_with_correct_aod_2us),
			 ztest_unit_test(test_set_cl_cte_tx_params_with_correct_aod_1us),
			 ztest_unit_test(test_set_ct_cte_tx_params_correct_aoa),
			 ztest_unit_test(test_set_ct_cte_tx_params_correct_aoa_without_ant_pattern),
			 ztest_unit_test(test_set_ct_cte_tx_params_wrong_adv_handle),
			 ztest_unit_test(test_set_ct_cte_tx_params_invalid_cte_len),
			 ztest_unit_test(test_set_ct_cte_tx_params_invalid_cte_type),
			 ztest_unit_test(test_set_ct_cte_tx_params_invalid_cte_count),
			 ztest_unit_test(test_set_ct_cte_tx_params_aod_2us_invalid_pattern_len),
			 ztest_unit_test(test_set_ct_cte_tx_params_aod_1us_invalid_pattern_len),
			 ztest_unit_test(test_set_ct_cte_tx_params_aoa_invalid_pattern_len));
	ztest_run_test_suite(test_hci_df_info);
}
```

## src/test_set_cl_cte_tx_params.h
```c
/*
 * Copyright (c) 2020 Nordic Semiconductor ASA
 *
 * SPDX-License-Identifier: Apache-2.0
 */

/* Runs tests for HCI_LE_Set_Connectionless_CTE_Transmit_Parameters command */
void run_set_cl_cte_tx_params_tests(void);
```
