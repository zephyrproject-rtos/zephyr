## CMakeLists.txt
```
# SPDX-License-Identifier: Apache-2.0

cmake_minimum_required(VERSION 3.28.0)
find_package(Zephyr REQUIRED HINTS $ENV{ZEPHYR_BASE})
project(app)

# Include Bluetooth subsystem headers for testing
target_include_directories(app PRIVATE
  ${ZEPHYR_BASE}/subsys/bluetooth
)

target_sources(app PRIVATE
  src/test_bt_addr_le_eq.c
  src/test_bt_addr_from_str.c
  src/test_bt_addr_le_is_resolved.c
  src/test_bt_addr_le_from_str.c
  src/test_bt_addr_le_to_str.c
  src/test_bt_addr_matches_irk.c
)

# Resolving an RPA through the Host key store needs SMP and privacy
if(CONFIG_BT_PRIVACY AND CONFIG_BT_SMP)
  target_sources(app PRIVATE src/test_bt_addr_le_resolve.c)
endif()
```

## prj.conf
```kconfig
CONFIG_TEST=y
CONFIG_ZTEST=y

CONFIG_BT=y
CONFIG_BT_ID_MAX=2
CONFIG_BT_LL_SW_SPLIT=n
CONFIG_BT_H4=n
CONFIG_BT_CENTRAL=y
CONFIG_BT_PRIVACY=y
CONFIG_BT_SMP=y
CONFIG_MAIN_STACK_SIZE=2048
```

## src/test_bt_addr_from_str.c
```c
/* Copyright (c) 2023 Nordic Semiconductor ASA
 * SPDX-License-Identifier: Apache-2.0
 */

#include <zephyr/bluetooth/addr.h>
#include <zephyr/ztest.h>

ZTEST_SUITE(bt_addr_from_str, NULL, NULL, NULL, NULL, NULL);

ZTEST(bt_addr_from_str, test_reject_empty_string)
{
	char *addr_str = "";
	bt_addr_t a;

	zassert_equal(bt_addr_from_str(addr_str, &a), -EINVAL);
}

ZTEST(bt_addr_from_str, test_reject_missing_octet)
{
	char *addr_str = "ab:ab:ab:ab:ab";
	bt_addr_t a;

	zassert_equal(bt_addr_from_str(addr_str, &a), -EINVAL);
}

ZTEST(bt_addr_from_str, test_reject_empty_octet)
{
	char *addr_str = "ab:ab:ab:ab::ab";
	bt_addr_t a;

	zassert_equal(bt_addr_from_str(addr_str, &a), -EINVAL);
}

ZTEST(bt_addr_from_str, test_reject_short_octet)
{
	char *addr_str = "ab:ab:ab:ab:b:ab";
	bt_addr_t a;

	zassert_equal(bt_addr_from_str(addr_str, &a), -EINVAL);
}

ZTEST(bt_addr_from_str, test_reject_trailing_colon)
{
	char *addr_str = "ab:ab:ab:ab:ab:ab:";
	bt_addr_t a;

	zassert_equal(bt_addr_from_str(addr_str, &a), -EINVAL);
}

ZTEST(bt_addr_from_str, test_reject_octet_colon_a)
{
	char *addr_str = "ab:ab:ab:ab:a::ab";
	bt_addr_t a;

	zassert_equal(bt_addr_from_str(addr_str, &a), -EINVAL);
}

ZTEST(bt_addr_from_str, test_reject_octet_colon_b)
{
	char *addr_str = "ab:ab:ab:ab::b:ab";
	bt_addr_t a;

	zassert_equal(bt_addr_from_str(addr_str, &a), -EINVAL);
}

ZTEST(bt_addr_from_str, test_reject_octet_space_a)
{
	char *addr_str = "ab:ab:ab:ab: b:ab";
	bt_addr_t a;

	zassert_equal(bt_addr_from_str(addr_str, &a), -EINVAL);
}

ZTEST(bt_addr_from_str, test_reject_octet_space_b)
{
	char *addr_str = "ab:ab:ab:ab:a :ab";
	bt_addr_t a;

	zassert_equal(bt_addr_from_str(addr_str, &a), -EINVAL);
}

ZTEST(bt_addr_from_str, test_reject_extra_space_before)
{
	char *addr_str = " 00:00:00:00:00:00";
	bt_addr_t a;

	zassert_equal(bt_addr_from_str(addr_str, &a), -EINVAL);
}

ZTEST(bt_addr_from_str, test_reject_extra_space_after)
{
	char *addr_str = "00:00:00:00:00:00 ";
	bt_addr_t a;

	zassert_equal(bt_addr_from_str(addr_str, &a), -EINVAL);
}

ZTEST(bt_addr_from_str, test_reject_replace_space_first)
{
	char *addr_str = " 0:00:00:00:00:00";
	bt_addr_t a;

	zassert_equal(bt_addr_from_str(addr_str, &a), -EINVAL);
}

ZTEST(bt_addr_from_str, test_reject_replace_colon_first)
{
	char *addr_str = ":0:00:00:00:00:00";
	bt_addr_t a;

	zassert_equal(bt_addr_from_str(addr_str, &a), -EINVAL);
}

ZTEST(bt_addr_from_str, test_reject_non_hex)
{
	char *addr_str = "00:00:00:00:g0:00";
	bt_addr_t a;

	zassert_equal(bt_addr_from_str(addr_str, &a), -EINVAL);
}

ZTEST(bt_addr_from_str, test_reject_bad_colon)
{
	char *addr_str = "00.00:00:00:00:00";
	bt_addr_t a;

	zassert_equal(bt_addr_from_str(addr_str, &a), -EINVAL);
}

ZTEST(bt_addr_from_str, test_order)
{
	char *addr_str = "01:02:03:04:05:06";
	bt_addr_t a;
	bt_addr_t b = {{6, 5, 4, 3, 2, 1}};

	zassert_equal(bt_addr_from_str(addr_str, &a), 0);
	zassert_true(bt_addr_eq(&a, &b));
}

ZTEST(bt_addr_from_str, test_hex_case_equal)
{
	char *addr_str_a = "ab:cd:ef:00:00:00";
	char *addr_str_b = "AB:CD:EF:00:00:00";
	bt_addr_t a;
	bt_addr_t b;

	zassert_equal(bt_addr_from_str(addr_str_a, &a), 0);
	zassert_equal(bt_addr_from_str(addr_str_b, &b), 0);
	zassert_true(bt_addr_eq(&a, &b));
}

ZTEST(bt_addr_from_str, test_hex_case_not_equal)
{
	char *addr_str_a = "aa:aa:aa:00:00:00";
	char *addr_str_b = "bb:bb:bb:00:00:00";
	bt_addr_t a;
	bt_addr_t b;

	zassert_equal(bt_addr_from_str(addr_str_a, &a), 0);
	zassert_equal(bt_addr_from_str(addr_str_b, &b), 0);
	zassert_false(bt_addr_eq(&a, &b));
}
```

## src/test_bt_addr_le_eq.c
```c
/* Copyright (c) 2022 Nordic Semiconductor ASA
 * SPDX-License-Identifier: Apache-2.0
 */

#include <zephyr/bluetooth/addr.h>
#include <zephyr/ztest.h>

ZTEST_SUITE(bt_addr_le_eq, NULL, NULL, NULL, NULL, NULL);

ZTEST(bt_addr_le_eq, test_all_zero)
{
	bt_addr_le_t a = {.type = 0, .a = {{0, 0, 0, 0, 0, 0}}};
	bt_addr_le_t b = a;

	zassert_true(bt_addr_le_eq(&a, &b));
}

ZTEST(bt_addr_le_eq, test_type_not_zero)
{
	bt_addr_le_t a = {.type = 1, .a = {{1, 2, 3, 4, 5, 6}}};
	bt_addr_le_t b = a;

	zassert_true(bt_addr_le_eq(&a, &b));
}

ZTEST(bt_addr_le_eq, test_type_matters)
{
	bt_addr_le_t a = {.type = 0, .a = {{1, 2, 3, 4, 5, 6}}};
	bt_addr_le_t b = a;

	zassume_true(bt_addr_le_eq(&a, &b));
	a.type = 1;
	zassert_false(bt_addr_le_eq(&a, &b));
}

ZTEST(bt_addr_le_eq, test_address_matters_start)
{
	bt_addr_le_t a = {.type = 0, .a = {{1, 2, 3, 4, 5, 6}}};
	bt_addr_le_t b = a;

	zassume_true(bt_addr_le_eq(&a, &b));
	a.a.val[0] = 0;
	zassert_false(bt_addr_le_eq(&a, &b));
}

ZTEST(bt_addr_le_eq, test_address_matters_end)
{
	bt_addr_le_t a = {.type = 0, .a = {{1, 2, 3, 4, 5, 6}}};
	bt_addr_le_t b = a;

	zassume_true(bt_addr_le_eq(&a, &b));
	a.a.val[5] = 0;
	zassert_false(bt_addr_le_eq(&a, &b));
}

ZTEST(bt_addr_le_eq, test_only_type_and_address_matters)
{
	bt_addr_le_t a;
	bt_addr_le_t b;

	/* Make anything that is not the type and address unequal bytes. */
	memset(&a, 0xaa, sizeof(a));
	memset(&b, 0xbb, sizeof(b));
	a.type = 1;
	b.type = 1;
	memset(a.a.val, 1, sizeof(a.a.val));
	memset(b.a.val, 1, sizeof(b.a.val));

	zassert_true(bt_addr_le_eq(&a, &b));
}

ZTEST(bt_addr_le_eq, test_same_object)
{
	bt_addr_le_t a = {.type = 0, .a = {{1, 2, 3, 4, 5, 6}}};

	zassert_true(bt_addr_le_eq(&a, &a));
}
```

## src/test_bt_addr_le_from_str.c
```c
/* Copyright (c) 2026 Silicon Laboratories Inc.
 * SPDX-License-Identifier: Apache-2.0
 */

#include <errno.h>
#include <string.h>

#include <zephyr/bluetooth/addr.h>
#include <zephyr/ztest.h>

ZTEST_SUITE(bt_addr_le_from_str, NULL, NULL, NULL, NULL, NULL);

/* The example addresses used throughout these tests, in on-air (little-endian) order. */
static const bt_addr_t example = { { 0x66, 0x55, 0x44, 0x33, 0x22, 0x11 } };
static const bt_addr_t example_alpha = { { 0xff, 0xee, 0xdd, 0xcc, 0xbb, 0xaa } };

static ZTEST(bt_addr_le_from_str, test_public)
{
	bt_addr_le_t a;

	zassert_equal(bt_addr_le_from_str("P:11:22:33:44:55:66", &a), 0);
	zassert_equal(a.type, BT_ADDR_LE_PUBLIC);
	zassert_true(bt_addr_eq(&a.a, &example));
}

static ZTEST(bt_addr_le_from_str, test_random)
{
	bt_addr_le_t a;

	zassert_equal(bt_addr_le_from_str("R:11:22:33:44:55:66", &a), 0);
	zassert_equal(a.type, BT_ADDR_LE_RANDOM);
	zassert_true(bt_addr_eq(&a.a, &example));
}

static ZTEST(bt_addr_le_from_str, test_prefix_and_digits_are_case_insensitive)
{
	bt_addr_le_t a;

	zassert_equal(bt_addr_le_from_str("p:11:22:33:44:55:66", &a), 0);
	zassert_equal(a.type, BT_ADDR_LE_PUBLIC);
	zassert_true(bt_addr_eq(&a.a, &example));

	zassert_equal(bt_addr_le_from_str("r:aa:bb:cc:dd:ee:ff", &a), 0);
	zassert_equal(a.type, BT_ADDR_LE_RANDOM);
	zassert_true(bt_addr_eq(&a.a, &example_alpha));

	zassert_equal(bt_addr_le_from_str("R:AA:BB:CC:DD:EE:FF", &a), 0);
	zassert_equal(a.type, BT_ADDR_LE_RANDOM);
	zassert_true(bt_addr_eq(&a.a, &example_alpha));
}

static ZTEST(bt_addr_le_from_str, test_rejects_unknown_prefix)
{
	bt_addr_le_t a;

	zassert_equal(bt_addr_le_from_str("X:11:22:33:44:55:66", &a), -EINVAL);
	zassert_equal(bt_addr_le_from_str("1:11:22:33:44:55:66", &a), -EINVAL);
}

static ZTEST(bt_addr_le_from_str, test_rejects_missing_prefix)
{
	bt_addr_le_t a;

	/* The bare address without a type prefix is not accepted. */
	zassert_equal(bt_addr_le_from_str("11:22:33:44:55:66", &a), -EINVAL);
}

static ZTEST(bt_addr_le_from_str, test_rejects_missing_separator)
{
	bt_addr_le_t a;

	zassert_equal(bt_addr_le_from_str("P11:22:33:44:55:66", &a), -EINVAL);
	zassert_equal(bt_addr_le_from_str("R-11:22:33:44:55:66", &a), -EINVAL);
	zassert_equal(bt_addr_le_from_str("R 11:22:33:44:55:66", &a), -EINVAL);
}

static ZTEST(bt_addr_le_from_str, test_rejects_malformed_address)
{
	bt_addr_le_t a;

	zassert_equal(bt_addr_le_from_str("R:11:22:33:44:55", &a), -EINVAL);
	zassert_equal(bt_addr_le_from_str("R:11:22:33:44:55:66:77", &a), -EINVAL);
	zassert_equal(bt_addr_le_from_str("P:gg:22:33:44:55:66", &a), -EINVAL);
	zassert_equal(bt_addr_le_from_str("P:11-22-33-44-55-66", &a), -EINVAL);
}

static ZTEST(bt_addr_le_from_str, test_rejects_truncated_string)
{
	bt_addr_le_t a;

	zassert_equal(bt_addr_le_from_str("", &a), -EINVAL);
	zassert_equal(bt_addr_le_from_str("P", &a), -EINVAL);
	zassert_equal(bt_addr_le_from_str("P:", &a), -EINVAL);
}

static ZTEST(bt_addr_le_from_str, test_roundtrip_through_to_str)
{
	bt_addr_le_t src = {
		.type = BT_ADDR_LE_RANDOM,
		.a = { { 0xaa, 0xbb, 0xcc, 0xdd, 0xee, 0xff } },
	};
	bt_addr_le_t dst;
	char str[BT_ADDR_LE_STR_LEN];
	int written;

	written = bt_addr_le_to_str(&src, str, sizeof(str));
	zassert_equal(written, (int)strlen(str));
	zassert_equal(bt_addr_le_from_str(str, &dst), 0);
	zassert_true(bt_addr_le_eq(&src, &dst));
}
```

## src/test_bt_addr_le_is_resolved.c
```c
/* Copyright (c) 2026 Silicon Laboratories Inc.
 * SPDX-License-Identifier: Apache-2.0
 */

#include <zephyr/bluetooth/addr.h>
#include <zephyr/ztest.h>

#include <host/addr_internal.h>

ZTEST_SUITE(bt_addr_le_is_resolved, NULL, NULL, NULL, NULL, NULL);

static const bt_addr_t example = { { 0x66, 0x55, 0x44, 0x33, 0x22, 0x11 } };

static ZTEST(bt_addr_le_is_resolved, test_identity_types_are_resolved)
{
	bt_addr_le_t a = { .a = example };

	a.type = BT_ADDR_LE_PUBLIC_ID;
	zassert_true(bt_addr_le_is_resolved(&a));

	a.type = BT_ADDR_LE_RANDOM_ID;
	zassert_true(bt_addr_le_is_resolved(&a));
}

static ZTEST(bt_addr_le_is_resolved, test_plain_types_are_not_resolved)
{
	bt_addr_le_t a = { .a = example };

	a.type = BT_ADDR_LE_PUBLIC;
	zassert_false(bt_addr_le_is_resolved(&a));

	a.type = BT_ADDR_LE_RANDOM;
	zassert_false(bt_addr_le_is_resolved(&a));
}

static ZTEST(bt_addr_le_is_resolved, test_sentinels_are_not_resolved)
{
	/* The LE Extended Advertising Report sentinels have bit 1 set as well,
	 * but neither is a Controller-resolved identity address.
	 */
	bt_addr_le_t a = { .a = example };

	a.type = BT_ADDR_LE_UNRESOLVED;
	zassert_false(bt_addr_le_is_resolved(&a));

	a.type = BT_ADDR_LE_ANONYMOUS;
	zassert_false(bt_addr_le_is_resolved(&a));
}

static ZTEST(bt_addr_le_is_resolved, test_copy_resolved_yields_base_type)
{
	bt_addr_le_t src = { .a = example };
	bt_addr_le_t dst;

	src.type = BT_ADDR_LE_PUBLIC_ID;
	bt_addr_le_copy_resolved(&dst, &src);
	zassert_equal(dst.type, BT_ADDR_LE_PUBLIC);
	zassert_true(bt_addr_eq(&dst.a, &example));

	src.type = BT_ADDR_LE_RANDOM_ID;
	bt_addr_le_copy_resolved(&dst, &src);
	zassert_equal(dst.type, BT_ADDR_LE_RANDOM);
	zassert_true(bt_addr_eq(&dst.a, &example));
}
```

## src/test_bt_addr_le_resolve.c
```c
/* Copyright (c) 2026 Demant A/S
 * SPDX-License-Identifier: Apache-2.0
 */

#include <string.h>

#include <zephyr/bluetooth/addr.h>
#include <zephyr/bluetooth/bluetooth.h>
#include <zephyr/ztest.h>

#include <common/rpa.h>
#include <host/keys.h>

static void bt_addr_le_rpa_resolve_before(void *f)
{
	ARG_UNUSED(f);

	bt_keys_reset();
}

ZTEST_SUITE(bt_addr_le_rpa_resolve, NULL, NULL, bt_addr_le_rpa_resolve_before, NULL, NULL);

static ZTEST(bt_addr_le_rpa_resolve, test_null_args)
{
	const bt_addr_le_t addr = {
		.type = BT_ADDR_LE_PUBLIC,
		.a = {{0x06, 0x05, 0x04, 0x03, 0x02, 0x01}},
	};
	bt_addr_le_t resolved;

	zassert_equal(bt_addr_le_rpa_resolve(BT_ID_DEFAULT, NULL, &resolved), -EINVAL);
	zassert_equal(bt_addr_le_rpa_resolve(BT_ID_DEFAULT, &addr, NULL), -EINVAL);
}

static ZTEST(bt_addr_le_rpa_resolve, test_invalid_id_is_rejected)
{
	const bt_addr_le_t input = {
		.type = BT_ADDR_LE_RANDOM,
		.a = {{0x01, 0x02, 0x03, 0x04, 0x05, 0x46}},
	};
	bt_addr_le_t resolved;

	zassert_true(bt_addr_le_is_rpa(&input));
	zassert_equal(bt_addr_le_rpa_resolve(CONFIG_BT_ID_MAX, &input, &resolved), -EINVAL);
}

static ZTEST(bt_addr_le_rpa_resolve, test_rpa_resolution_no_matching_irk)
{
	const bt_addr_le_t input = {
		.type = BT_ADDR_LE_RANDOM,
		.a = {{0x01, 0x02, 0x03, 0x04, 0x05, 0x46}},
	};
	bt_addr_le_t resolved;

	zassert_true(bt_addr_le_is_rpa(&input));
	zassert_equal(bt_addr_le_rpa_resolve(BT_ID_DEFAULT, &input, &resolved), -ENOENT);
}

static ZTEST(bt_addr_le_rpa_resolve, test_non_rpa_random_is_rejected)
{
	const bt_addr_le_t input = {
		.type = BT_ADDR_LE_RANDOM,
		.a = {{0x01, 0x02, 0x03, 0x04, 0x05, 0x06}},
	};
	bt_addr_le_t resolved;

	zassert_false(bt_addr_le_is_rpa(&input));
	zassert_equal(bt_addr_le_rpa_resolve(BT_ID_DEFAULT, &input, &resolved), -EINVAL);
}

static ZTEST(bt_addr_le_rpa_resolve, test_identity_is_rejected)
{
	const bt_addr_le_t input = {
		.type = BT_ADDR_LE_PUBLIC,
		.a = {{0xA1, 0xA2, 0xA3, 0xA4, 0xA5, 0xA6}},
	};
	bt_addr_le_t resolved;

	zassert_equal(bt_addr_le_rpa_resolve(BT_ID_DEFAULT, &input, &resolved), -EINVAL);
}

static ZTEST(bt_addr_le_rpa_resolve, test_valid_irk_resolves_rpa_to_identity)
{
	const uint8_t irk[16] = {
		0x10, 0x32, 0x54, 0x76, 0x98, 0xba, 0xdc, 0xfe,
		0x01, 0x23, 0x45, 0x67, 0x89, 0xab, 0xcd, 0xef,
	};
	const bt_addr_le_t identity = {
		.type = BT_ADDR_LE_PUBLIC,
		.a = {{0xc6, 0xc5, 0xc4, 0xc3, 0xc2, 0xc1}},
	};
	bt_addr_t rpa;
	bt_addr_le_t input = {
		.type = BT_ADDR_LE_RANDOM,
	};
	bt_addr_le_t resolved;
	struct bt_keys *keys;

	keys = bt_keys_get_addr(BT_ID_DEFAULT, &identity);
	zassert_not_null(keys, "Failed to allocate key entry");

	bt_keys_add_type(keys, BT_KEYS_IRK);
	(void)memcpy(keys->irk.val, irk, sizeof(irk));

	zassert_equal(bt_rpa_create(irk, &rpa), 0, "Failed to generate RPA");
	bt_addr_copy(&input.a, &rpa);
	zassert_true(bt_addr_le_is_rpa(&input), "Generated address is not an RPA");

	zassert_equal(bt_addr_le_rpa_resolve(BT_ID_DEFAULT, &input, &resolved), 0);
	zassert_true(bt_addr_le_eq(&resolved, &identity));
}

static ZTEST(bt_addr_le_rpa_resolve, test_rpa_for_different_identity_is_not_resolved)
{
	const uint8_t irk[16] = {
		0x11, 0x22, 0x33, 0x44, 0x55, 0x66, 0x77, 0x88,
		0x99, 0xaa, 0xbb, 0xcc, 0xdd, 0xee, 0xf0, 0x01,
	};
	const bt_addr_le_t identity = {
		.type = BT_ADDR_LE_PUBLIC,
		.a = {{0xd6, 0xd5, 0xd4, 0xd3, 0xd2, 0xd1}},
	};
	bt_addr_t rpa;
	bt_addr_le_t input = {
		.type = BT_ADDR_LE_RANDOM,
	};
	bt_addr_le_t resolved;
	struct bt_keys *keys;

	keys = bt_keys_get_addr(1, &identity);
	zassert_not_null(keys, "Failed to allocate key entry");

	bt_keys_add_type(keys, BT_KEYS_IRK);
	(void)memcpy(keys->irk.val, irk, sizeof(irk));

	zassert_equal(bt_rpa_create(irk, &rpa), 0, "Failed to generate RPA");
	bt_addr_copy(&input.a, &rpa);
	zassert_true(bt_addr_le_is_rpa(&input), "Generated address is not an RPA");

	zassert_equal(bt_addr_le_rpa_resolve(BT_ID_DEFAULT, &input, &resolved), -ENOENT);
}
```

## src/test_bt_addr_le_to_str.c
```c
/* Copyright (c) 2026 Silicon Laboratories Inc.
 * SPDX-License-Identifier: Apache-2.0
 */

#include <string.h>

#include <zephyr/bluetooth/addr.h>
#include <zephyr/ztest.h>

ZTEST_SUITE(bt_addr_le_to_str, NULL, NULL, NULL, NULL, NULL);

static const bt_addr_le_t example_addr = {
	.type = 0,
	.a = { { 0x66, 0x55, 0x44, 0x33, 0x22, 0x11 } },
};

static ZTEST(bt_addr_le_to_str, test_public_uses_p_prefix)
{
	bt_addr_le_t a = example_addr;
	char str[BT_ADDR_LE_STR_LEN];

	a.type = BT_ADDR_LE_PUBLIC;

	zassert_equal(bt_addr_le_to_str(&a, str, sizeof(str)), strlen("P:11:22:33:44:55:66"));
	zassert_str_equal(str, "P:11:22:33:44:55:66");
}

static ZTEST(bt_addr_le_to_str, test_random_uses_r_prefix)
{
	bt_addr_le_t a = example_addr;
	char str[BT_ADDR_LE_STR_LEN];

	a.type = BT_ADDR_LE_RANDOM;

	zassert_equal(bt_addr_le_to_str(&a, str, sizeof(str)), strlen("R:11:22:33:44:55:66"));
	zassert_str_equal(str, "R:11:22:33:44:55:66");
}

static ZTEST(bt_addr_le_to_str, test_public_id_masks_to_public_prefix)
{
	/* BT_ADDR_LE_PUBLIC_ID (0x02) is the identity-address marker derived from a
	 * public on-air address; the base type is still public, so it must print as P:.
	 */
	bt_addr_le_t a = example_addr;
	char str[BT_ADDR_LE_STR_LEN];

	a.type = BT_ADDR_LE_PUBLIC_ID;

	zassert_equal(bt_addr_le_to_str(&a, str, sizeof(str)), strlen("P:11:22:33:44:55:66"));
	zassert_str_equal(str, "P:11:22:33:44:55:66");
}

static ZTEST(bt_addr_le_to_str, test_random_id_masks_to_random_prefix)
{
	bt_addr_le_t a = example_addr;
	char str[BT_ADDR_LE_STR_LEN];

	a.type = BT_ADDR_LE_RANDOM_ID;

	zassert_equal(bt_addr_le_to_str(&a, str, sizeof(str)), strlen("R:11:22:33:44:55:66"));
	zassert_str_equal(str, "R:11:22:33:44:55:66");
}

static ZTEST(bt_addr_le_to_str, test_hci_resolved_random_masks_to_random_prefix)
{
	/* HCI events use bit 1 of Address_Type to indicate the Controller resolved an
	 * RPA. bt_addr_le_to_str() must mask that bit away so the public API string
	 * format only reflects the base address type. The extra bit is logged
	 * separately at the call sites that handle raw HCI event addresses.
	 */
	bt_addr_le_t a = example_addr;
	char str[BT_ADDR_LE_STR_LEN];

	a.type = BT_ADDR_LE_RANDOM | 0x02U;

	zassert_equal(bt_addr_le_to_str(&a, str, sizeof(str)), strlen("R:11:22:33:44:55:66"));
	zassert_str_equal(str, "R:11:22:33:44:55:66");
}

static ZTEST(bt_addr_le_to_str, test_hci_resolved_public_masks_to_public_prefix)
{
	bt_addr_le_t a = example_addr;
	char str[BT_ADDR_LE_STR_LEN];

	a.type = BT_ADDR_LE_PUBLIC | 0x02U;

	zassert_equal(bt_addr_le_to_str(&a, str, sizeof(str)), strlen("P:11:22:33:44:55:66"));
	zassert_str_equal(str, "P:11:22:33:44:55:66");
}

static ZTEST(bt_addr_le_to_str, test_byte_order_is_big_endian_display)
{
	/* a.val is stored little-endian (on-air order) but the string is rendered
	 * with the most significant byte first.
	 */
	bt_addr_le_t a = {
		.type = BT_ADDR_LE_PUBLIC,
		.a = { { 0x06, 0x05, 0x04, 0x03, 0x02, 0x01 } },
	};
	char str[BT_ADDR_LE_STR_LEN];

	zassert_equal(bt_addr_le_to_str(&a, str, sizeof(str)), strlen("P:01:02:03:04:05:06"));
	zassert_str_equal(str, "P:01:02:03:04:05:06");
}

static ZTEST(bt_addr_le_to_str, test_recommended_buffer_is_large_enough)
{
	bt_addr_le_t a = {
		.type = BT_ADDR_LE_RANDOM,
		.a = { { 0xff, 0xff, 0xff, 0xff, 0xff, 0xff } },
	};
	char str[BT_ADDR_LE_STR_LEN] = { 0 };
	int written = bt_addr_le_to_str(&a, str, sizeof(str));

	/* snprintk returns the number of bytes it would have written, excluding the
	 * trailing NUL. The recommended buffer must fit the full string + NUL.
	 */
	zassert_true(written > 0);
	zassert_true((size_t)written < sizeof(str),
		     "BT_ADDR_LE_STR_LEN (%d) too small to hold output (%d bytes)",
		     BT_ADDR_LE_STR_LEN, written);
}

static ZTEST(bt_addr_le_to_str, test_unresolved_formats_as_random)
{
	/* BT_ADDR_LE_UNRESOLVED marks an RPA the Controller could not resolve. It
	 * is still a random address and must not be printed as a public one.
	 */
	bt_addr_le_t a = example_addr;
	char str[BT_ADDR_LE_STR_LEN];

	a.type = BT_ADDR_LE_UNRESOLVED;

	zassert_equal(bt_addr_le_to_str(&a, str, sizeof(str)), strlen("R:11:22:33:44:55:66"));
	zassert_str_equal(str, "R:11:22:33:44:55:66");
}

static ZTEST(bt_addr_le_to_str, test_anonymous_formats_as_random)
{
	/* BT_ADDR_LE_ANONYMOUS carries no address at all. The string format has no
	 * representation for that, so it is formatted as a random address; callers
	 * that need to convey the sentinel do so separately.
	 */
	bt_addr_le_t a = example_addr;
	char str[BT_ADDR_LE_STR_LEN];

	a.type = BT_ADDR_LE_ANONYMOUS;

	zassert_equal(bt_addr_le_to_str(&a, str, sizeof(str)), strlen("R:11:22:33:44:55:66"));
	zassert_str_equal(str, "R:11:22:33:44:55:66");
}
```

## src/test_bt_addr_le_to_str_legacy.c
```c
/* Copyright (c) 2026 Silicon Laboratories Inc.
 * SPDX-License-Identifier: Apache-2.0
 */

#include <string.h>

#include <zephyr/bluetooth/addr.h>
#include <zephyr/ztest.h>

ZTEST_SUITE(bt_addr_le_to_str_legacy, NULL, NULL, NULL, NULL, NULL);

static const bt_addr_le_t example_addr = {
	.type = 0,
	.a = { { 0x66, 0x55, 0x44, 0x33, 0x22, 0x11 } },
};

static ZTEST(bt_addr_le_to_str_legacy, test_recommended_buffer_grows_for_legacy)
{
	zassert_true(BT_ADDR_LE_STR_LEN >= sizeof("11:22:33:44:55:66 (random-id)"));
}

static ZTEST(bt_addr_le_to_str_legacy, test_public_uses_parenthesised_type)
{
	bt_addr_le_t a = example_addr;
	char str[BT_ADDR_LE_STR_LEN];

	a.type = BT_ADDR_LE_PUBLIC;

	zassert_equal(bt_addr_le_to_str(&a, str, sizeof(str)),
		      strlen("11:22:33:44:55:66 (public)"));
	zassert_str_equal(str, "11:22:33:44:55:66 (public)");
}

static ZTEST(bt_addr_le_to_str_legacy, test_random_uses_parenthesised_type)
{
	bt_addr_le_t a = example_addr;
	char str[BT_ADDR_LE_STR_LEN];

	a.type = BT_ADDR_LE_RANDOM;

	zassert_equal(bt_addr_le_to_str(&a, str, sizeof(str)),
		      strlen("11:22:33:44:55:66 (random)"));
	zassert_str_equal(str, "11:22:33:44:55:66 (random)");
}

static ZTEST(bt_addr_le_to_str_legacy, test_public_id_keeps_distinct_label)
{
	bt_addr_le_t a = example_addr;
	char str[BT_ADDR_LE_STR_LEN];

	a.type = BT_ADDR_LE_PUBLIC_ID;

	zassert_equal(bt_addr_le_to_str(&a, str, sizeof(str)),
		      strlen("11:22:33:44:55:66 (public-id)"));
	zassert_str_equal(str, "11:22:33:44:55:66 (public-id)");
}

static ZTEST(bt_addr_le_to_str_legacy, test_random_id_keeps_distinct_label)
{
	bt_addr_le_t a = example_addr;
	char str[BT_ADDR_LE_STR_LEN];

	a.type = BT_ADDR_LE_RANDOM_ID;

	zassert_equal(bt_addr_le_to_str(&a, str, sizeof(str)),
		      strlen("11:22:33:44:55:66 (random-id)"));
	zassert_str_equal(str, "11:22:33:44:55:66 (random-id)");
}

static ZTEST(bt_addr_le_to_str_legacy, test_unknown_type_prints_hex)
{
	bt_addr_le_t a = example_addr;
	char str[BT_ADDR_LE_STR_LEN];

	a.type = 0x42;

	zassert_equal(bt_addr_le_to_str(&a, str, sizeof(str)), strlen("11:22:33:44:55:66 (0x42)"));
	zassert_str_equal(str, "11:22:33:44:55:66 (0x42)");
}
```

## src/test_bt_addr_matches_irk.c
```c
/*
 * Copyright The Zephyr Project Contributors
 *
 * SPDX-License-Identifier: Apache-2.0
 */

#include <stdint.h>
#include <string.h>

#include <zephyr/bluetooth/addr.h>
#include <zephyr/bluetooth/crypto.h>
#include <zephyr/sys/util.h>
#include <zephyr/ztest.h>

/* Sample data for the random address hash function ah, from the Bluetooth Core
 * Specification, Vol 3, Part H, Appendix D.7:
 *
 *   IRK   = ec0234a3 57c8ad05 341010a6 0a397d9b
 *   prand = 708194
 *   ah    = 0dfbaa
 *
 * The IRK and the address are stored least significant octet first, so the RPA
 * is 70:81:94:0D:FB:AA, with prand in the upper three octets and the hash in the
 * lower three.
 */
static const uint8_t spec_irk[BT_IRK_SIZE] = {
	0x9b, 0x7d, 0x39, 0x0a, 0xa6, 0x10, 0x10, 0x34,
	0x05, 0xad, 0xc8, 0x57, 0xa3, 0x34, 0x02, 0xec,
};

static const bt_addr_t spec_rpa = {{0xaa, 0xfb, 0x0d, 0x94, 0x81, 0x70}};

ZTEST_SUITE(bt_addr_matches_irk, NULL, NULL, NULL, NULL, NULL);

static ZTEST(bt_addr_matches_irk, test_spec_sample_data)
{
	zassert_true(BT_ADDR_IS_RPA(&spec_rpa), "Sample address is not an RPA");
	zassert_true(bt_addr_matches_irk(&spec_rpa, spec_irk),
		     "Sample RPA does not match the sample IRK");
}

static ZTEST(bt_addr_matches_irk, test_irk_mismatch)
{
	uint8_t irk[BT_IRK_SIZE];

	(void)memcpy(irk, spec_irk, sizeof(irk));
	irk[BT_IRK_SIZE - 1U] ^= 0x01;

	zassert_false(bt_addr_matches_irk(&spec_rpa, irk), "RPA matches a different IRK");
}

static ZTEST(bt_addr_matches_irk, test_irk_byte_order)
{
	uint8_t irk[BT_IRK_SIZE];

	for (size_t i = 0U; i < BT_IRK_SIZE; i++) {
		irk[i] = spec_irk[BT_IRK_SIZE - 1U - i];
	}

	zassert_false(bt_addr_matches_irk(&spec_rpa, irk),
		      "RPA matches the IRK in most significant octet first order");
}

static ZTEST(bt_addr_matches_irk, test_hash_mismatch)
{
	bt_addr_t rpa = spec_rpa;

	rpa.val[0] ^= 0x01;

	zassert_false(bt_addr_matches_irk(&rpa, spec_irk), "RPA with a modified hash matches");
}

static ZTEST(bt_addr_matches_irk, test_prand_mismatch)
{
	bt_addr_t rpa = spec_rpa;

	rpa.val[3] ^= 0x01;

	zassert_false(bt_addr_matches_irk(&rpa, spec_irk), "RPA with a modified prand matches");
}

static ZTEST(bt_addr_matches_irk, test_non_rpa_does_not_match)
{
	/* The sample prand with each value of the two most significant bits: 0b01 (RPA),
	 * 0b00 (non-resolvable), 0b10 (reserved) and 0b11 (static)
	 */
	const uint8_t prands[][3] = {
		{0x94, 0x81, 0x70},
		{0x94, 0x81, 0x30},
		{0x94, 0x81, 0xb0},
		{0x94, 0x81, 0xf0},
	};
	bt_addr_t addr[ARRAY_SIZE(prands)];

	for (size_t i = 0U; i < ARRAY_SIZE(prands); i++) {
		uint8_t r[16] = {0};
		uint8_t enc[16];

		/* ah(k, r) = e(k, r') mod 2^24, with r' = padding || r */
		(void)memcpy(r, prands[i], sizeof(prands[i]));
		zassert_ok(bt_encrypt_le(spec_irk, r, enc), "AES encryption failed");
		(void)memcpy(&addr[i].val[0], enc, 3U);
		(void)memcpy(&addr[i].val[3], prands[i], sizeof(prands[i]));
	}

	zassert_true(bt_addr_matches_irk(&addr[0], spec_irk),
		     "RPA with a valid hash does not match");

	for (size_t i = 1U; i < ARRAY_SIZE(prands); i++) {
		zassert_false(BT_ADDR_IS_RPA(&addr[i]), "Address %zu is an RPA", i);
		zassert_false(bt_addr_matches_irk(&addr[i], spec_irk),
			      "Address %zu, which is not an RPA, matches", i);
	}
}
```
