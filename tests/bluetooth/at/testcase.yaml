## tests/bluetooth/at/testcase.yaml
```yaml
tests:
  bluetooth.at:
    build_only: true
    min_ram: 16
    platform_allow:
      - qemu_x86/atom
      - qemu_cortex_m3/ti_lm3s6965
    tags: bluetooth
    integration_platforms:
      - qemu_x86/atom
```

## tests/bluetooth/audio/ascs/testcase.yaml
```yaml
common:
  tags:
    - bluetooth
    - bluetooth_audio
  platform_allow:
    - native_sim
  integration_platforms:
    - native_sim

tests:
  bluetooth.audio.ascs.test_default: {}
  bluetooth.audio.ascs.test_snk_only:
    extra_configs:
      - CONFIG_BT_ASCS_MAX_ASE_SRC_COUNT=0
  bluetooth.audio.ascs.test_src_only:
    extra_configs:
      - CONFIG_BT_ASCS_MAX_ASE_SNK_COUNT=0
  bluetooth.audio.ascs.test_unicast_client_enabled:
    extra_configs:
      - CONFIG_BT_CENTRAL=y
      - CONFIG_BT_ISO_CENTRAL=y
      - CONFIG_BT_BAP_UNICAST_CLIENT=y
      - CONFIG_BT_GATT_CLIENT=y
      - CONFIG_BT_GATT_AUTO_DISCOVER_CCC=y
      - CONFIG_BT_GATT_AUTO_UPDATE_MTU=y
  bluetooth.audio.ascs.test_stream_pair:
    extra_configs:
      - CONFIG_BT_ASCS_MAX_ACTIVE_ASES=2
```

## tests/bluetooth/audio/bap_base/Kconfig
```kconfig
# Temporary override
#
# Copyright (c) 2024 Nordic Semiconductor ASA

# SPDX-License-Identifier: Apache-2.0
#

config BT_BAP_BASE
	# Override until someone fixes the UT build system
	bool
	default y

# Include Zephyr's Kconfig.
source "Kconfig.zephyr"
```

## tests/bluetooth/audio/bap_base/testcase.yaml
```yaml
common:
  tags:
    - bluetooth
    - bluetooth_audio
tests:
  bluetooth.audio.bap_base.test_default:
    type: unit
```

## tests/bluetooth/audio/bap_broadcast_source/Kconfig
```kconfig
# Copyright (c) 2025 Nordic Semiconductor ASA
# SPDX-License-Identifier: Apache-2.0


config BT_AUDIO
	bool
	default y

config BT_BUF_EVT_RX_COUNT
	int
	default 10

config BT_BUF_ACL_TX_COUNT
	int
	default 5

config BT_ISO_BROADCASTER
	bool
	default y

config BT_ISO_MAX_BIG
	int
	default 10

config BT_ISO_MAX_CHAN
	int
	default 10

config BT_LOG
	bool
	default y

# Include Zephyr's Kconfig.
source "Kconfig"
source "subsys/bluetooth/audio/Kconfig"
source "subsys/bluetooth/Kconfig.logging"
```

## tests/bluetooth/audio/bap_broadcast_source/testcase.yaml
```yaml
common:
  tags:
    - bluetooth
    - bluetooth_audio
tests:
  bluetooth.audio.bap_broadcast_source.test_default:
    platform_allow:
      - native_sim
    integration_platforms:
      - native_sim
```

## tests/bluetooth/audio/cap_commander/Kconfig
```kconfig
# Copyright (c) 2025 Nordic Semiconductor ASA
# SPDX-License-Identifier: Apache-2.0

config BT_AICS_CLIENT
	bool
	default y

config BT_AICS_CLIENT_MAX_INSTANCE_COUNT
	int
	default 1

config BT_ATT_PREPARE_COUNT
	int
	default 1

config BT_AUDIO
	bool
	default y

config BT_BAP_BASS_MAX_SUBGROUPS
	int
	default 2

config BT_BAP_BROADCAST_ASSISTANT
	bool
	default y

config BT_BAP_SCAN_DELEGATOR
	bool
	default y

config BT_BONDABLE
	bool
	default y

config BT_BUF_ACL_RX_SIZE
	int
	default 69

config BT_BUF_ACL_TX_COUNT
	int
	default 5

config BT_BUF_EVT_RX_COUNT
	int
	default 10

config BT_CSIP_SET_COORDINATOR
	bool
	default y

config BT_CSIP_SET_COORDINATOR_MAX_CSIS_INSTANCES
	int
	default 1

config BT_CONN
	bool
	default y

config BT_MAX_PAIRED
	int
	default 1

config BT_MICP_MIC_CTLR
	bool
	default y

config BT_MICP_MIC_CTLR_AICS
	bool
	default y

config BT_MICP_MIC_CTLR_MAX_AICS_INST
	int
	default 1

config BT_GATT_DYNAMIC_DB
	bool
	default y

config BT_ISO_PERIPHERAL
	bool
	default y

config BT_ISO_MAX_CHAN
	int
	default 10

config BT_L2CAP_TX_MTU
	int
	default 65

config BT_LOG
	bool
	default y

config BT_MAX_CONN
	int
	default 2

config BT_PERIPHERAL
	bool
	default y

config BT_VCP_VOL_CTLR
	bool
	default y

config BT_VCP_VOL_CTLR_MAX_VOCS_INST
	int
	default 1

config BT_VCP_VOL_CTLR_MAX_AICS_INST
	int
	default 1

config BT_VOCS_CLIENT
	bool
	default y

config BT_VOCS_CLIENT_MAX_INSTANCE_COUNT
	int
	default 1

config BT_SMP
	bool
	default y

# Include Zephyr's Kconfig.
source "Kconfig"
source "subsys/bluetooth/audio/Kconfig"
source "subsys/bluetooth/Kconfig.logging"
```

## tests/bluetooth/audio/cap_commander/testcase.yaml
```yaml
common:
  tags:
    - bluetooth
    - bluetooth_audio
tests:
  bluetooth.audio.cap_commander.test_default:
    type: unit
```

## tests/bluetooth/audio/cap_handover/testcase.yaml
```yaml
common:
  tags:
    - bluetooth
    - bluetooth_audio
tests:
  bluetooth.audio.cap_handover.test_default:
    type: unit
```

## tests/bluetooth/audio/cap_initiator/testcase.yaml
```yaml
common:
  tags:
    - bluetooth
    - bluetooth_audio
tests:
  bluetooth.audio.cap_initiator.test_default:
    type: unit
```

## tests/bluetooth/audio/ccid/testcase.yaml
```yaml
common:
  tags:
    - bluetooth
    - bluetooth_audio
tests:
  bluetooth.audio.ccid.test:
    platform_allow:
      - native_sim
    integration_platforms:
      - native_sim
```

## tests/bluetooth/audio/ccp_call_control_client/Kconfig
```kconfig
# Copyright (c) 2025 Nordic Semiconductor ASA
# SPDX-License-Identifier: Apache-2.0

config BT_AUDIO
	bool
	default y

config BT_BONDABLE
	bool
	default y

config BT_BUF_ACL_RX_SIZE
	int
	default 69

config BT_BUF_ACL_TX_COUNT
	int
	default 5

config BT_BUF_EVT_RX_COUNT
	int
	default 10

config BT_CONN
	bool
	default y

config BT_EXT_ADV
	bool
	default y

config BT_L2CAP_TX_MTU
	int
	default 65

config BT_LOG
	bool
	default y

config BT_MAX_CONN
	int
	default 1

config BT_MAX_PAIRED
	int
	default 1

config BT_SMP
	bool
	default y

config BT_TBS_CLIENT
	bool
	default y

config BT_TBS_CLIENT_GTBS
	bool
	default y

config BT_TBS_CLIENT_TBS
	bool
	default y

# Include Zephyr's Kconfig.
source "Kconfig"
source "subsys/bluetooth/audio/Kconfig"
source "subsys/bluetooth/Kconfig.logging"
```

## tests/bluetooth/audio/ccp_call_control_client/testcase.yaml
```yaml
common:
  tags:
    - bluetooth
    - bluetooth_audio
tests:
  bluetooth.audio.ccp_call_control_client.test:
    platform_allow:
      - native_sim
    integration_platforms:
      - native_sim
```

## tests/bluetooth/audio/ccp_call_control_server/testcase.yaml
```yaml
common:
  tags:
    - bluetooth
    - bluetooth_audio
tests:
  bluetooth.audio.ccp_call_control_server.test:
    type: unit
```

## tests/bluetooth/audio/ccp_client/testcase.yaml
```yaml
common:
  tags:
    - bluetooth
    - bluetooth_audio
tests:
  bluetooth.audio.ccp_client.test:
    type: unit
```

## tests/bluetooth/audio/ccp_server/testcase.yaml
```yaml
common:
  tags:
    - bluetooth
    - bluetooth_audio
tests:
  bluetooth.audio.ccp_server.test:
    type: unit
```

## tests/bluetooth/audio/codec/testcase.yaml
```yaml
common:
  tags:
    - bluetooth
    - bluetooth_audio
tests:
  bluetooth.audio.codec.test:
    type: unit
```

## tests/bluetooth/audio/hap_harc/testcase.yaml
```yaml
common:
  tags:
    - bluetooth
    - bluetooth_audio
tests:
  bluetooth.audio.hap_harc.test:
    type: unit
```

## tests/bluetooth/audio/pacs/testcase.yaml
```yaml
common:
  tags:
    - bluetooth
    - bluetooth_audio
tests:
  bluetooth.audio.pacs.test_default:
    platform_allow:
      - native_sim
    integration_platforms:
      - native_sim
    extra_configs:
      - CONFIG_BT_PAC_SNK=y
      - CONFIG_BT_PAC_SNK_LOC=y
      - CONFIG_BT_PAC_SRC=y
      - CONFIG_BT_PAC_SRC_LOC=y
  bluetooth.audio.pacs.test_snk_pac_snk_loc_src_pac:
    platform_allow:
      - native_sim
    integration_platforms:
      - native_sim
    extra_configs:
      - CONFIG_BT_PAC_SNK=y
      - CONFIG_BT_PAC_SNK_LOC=y
      - CONFIG_BT_PAC_SRC=y
      - CONFIG_BT_PAC_SRC_LOC=n
  bluetooth.audio.pacs.test_snk_pac_snk_loc:
    platform_allow:
      - native_sim
    integration_platforms:
      - native_sim
    extra_configs:
      - CONFIG_BT_PAC_SNK=y
      - CONFIG_BT_PAC_SNK_LOC=y
      - CONFIG_BT_PAC_SRC=n
      - CONFIG_BT_PAC_SRC_LOC=n
  bluetooth.audio.pacs.test_snk_pac:
    platform_allow:
      - native_sim
    integration_platforms:
      - native_sim
    extra_configs:
      - CONFIG_BT_PAC_SNK=y
      - CONFIG_BT_PAC_SNK_LOC=n
      - CONFIG_BT_PAC_SRC=n
      - CONFIG_BT_PAC_SRC_LOC=n
  bluetooth.audio.pacs.test_snk_pac_src_pac_src_loc:
    platform_allow:
      - native_sim
    integration_platforms:
      - native_sim
    extra_configs:
      - CONFIG_BT_PAC_SNK=y
      - CONFIG_BT_PAC_SNK_LOC=n
      - CONFIG_BT_PAC_SRC=y
      - CONFIG_BT_PAC_SRC_LOC=y
  bluetooth.audio.pacs.test_snk_pac_src_pac:
    platform_allow:
      - native_sim
    integration_platforms:
      - native_sim
    extra_configs:
      - CONFIG_BT_PAC_SNK=y
      - CONFIG_BT_PAC_SNK_LOC=n
      - CONFIG_BT_PAC_SRC=y
      - CONFIG_BT_PAC_SRC_LOC=n
  bluetooth.audio.pacs.test_src_pac_src_loc:
    platform_allow:
      - native_sim
    integration_platforms:
      - native_sim
    extra_configs:
      - CONFIG_BT_PAC_SNK=n
      - CONFIG_BT_PAC_SNK_LOC=n
      - CONFIG_BT_PAC_SRC=y
      - CONFIG_BT_PAC_SRC_LOC=y
  bluetooth.audio.pacs.test_src_pac:
    platform_allow:
      - native_sim
    integration_platforms:
      - native_sim
    extra_configs:
      - CONFIG_BT_PAC_SNK=n
      - CONFIG_BT_PAC_SNK_LOC=n
      - CONFIG_BT_PAC_SRC=y
      - CONFIG_BT_PAC_SRC_LOC=n
```

## tests/bluetooth/audio_shell/boards/native_posix.conf
```kconfig
CONFIG_LOG_MODE_IMMEDIATE=y
CONFIG_NO_OPTIMIZATIONS=y
# Allows for copying larger amount of data into the shell
CONFIG_SHELL_BACKEND_SERIAL_RX_RING_BUFFER_SIZE=4096
#Enable TINYCRYPT for native_posix; needed for CSIS
CONFIG_BT_TINYCRYPT_ECC=y
```

## tests/bluetooth/audio_shell/testcase.yaml
```yaml
common:
  platform_exclude: nrf52dk_nrf52810
  tags: bluetooth
  harness: keyboard
  min_flash: 145
tests:
  bluetooth.audio_shell:
    platform_allow: qemu_cortex_m3 qemu_x86 native_posix native_posix_64 nrf52840dk_nrf52840
  bluetooth.audio_shell.no_mcs:
    build_only: true
    integration_platforms:
      - native_posix
    extra_configs:
      - CONFIG_BT_MCS=n
  bluetooth.audio_shell.no_mcc:
    build_only: true
    integration_platforms:
      - native_posix
    extra_configs:
      - CONFIG_BT_MCC=n
  bluetooth.audio_shell.no_ots:
    build_only: true
    integration_platforms:
      - native_posix
    extra_configs:
      - CONFIG_BT_OTS=n
  bluetooth.audio_shell.no_otc:
    build_only: true
    integration_platforms:
      - native_posix
    extra_configs:
      - CONFIG_BT_OTC=n
  bluetooth.audio_shell.no_otsc:
    build_only: true
    integration_platforms:
      - native_posix
    extra_configs:
      - CONFIG_BT_OTS=n
      - CONFIG_BT_OTC=n
  bluetooth.audio_shell.no_bass:
    build_only: true
    integration_platforms:
      - native_posix
    extra_configs:
      - CONFIG_BT_BASS=n
  bluetooth.audio_shell.no_bass_client:
    build_only: true
    integration_platforms:
      - native_posix
    extra_configs:
      - CONFIG_BT_BASS_CLIENT=n
  bluetooth.audio_shell.no_bass_bass_client:
    build_only: true
    integration_platforms:
      - native_posix
    extra_configs:
      - CONFIG_BT_BASS=n
      - CONFIG_BT_BASS_CLIENT=n
  bluetooth.audio_shell.no_csis:
    build_only: true
    integration_platforms:
      - native_posix
    extra_configs:
      - CONFIG_BT_CSIS=n
  bluetooth.audio_shell.no_csip:
    build_only: true
    integration_platforms:
      - native_posix
    extra_configs:
      - CONFIG_BT_CSIP=n
  bluetooth.audio_shell.no_csis_csip:
    build_only: true
    integration_platforms:
      - native_posix
    extra_configs:
      - CONFIG_BT_CSIS=n
      - CONFIG_BT_CSIP=n
  bluetooth.audio_shell.no_vcs:
    build_only: true
    integration_platforms:
      - native_posix
    extra_configs:
      - CONFIG_BT_VCS=n
  bluetooth.audio_shell.no_vcs_client:
    build_only: true
    integration_platforms:
      - native_posix
    extra_configs:
      - CONFIG_BT_VCS_CLIENT=n
  bluetooth.audio_shell.no_vcs_vcs_client:
    build_only: true
    integration_platforms:
      - native_posix
    extra_configs:
      - CONFIG_BT_VCS=n
      - CONFIG_BT_VCS_CLIENT=n
  bluetooth.audio_shell.no_mics:
    build_only: true
    integration_platforms:
      - native_posix
    extra_configs:
      - CONFIG_BT_MICS=n
  bluetooth.audio_shell.no_mics_client:
    build_only: true
    integration_platforms:
      - native_posix
    extra_configs:
      - CONFIG_BT_MICS_CLIENT=n
  bluetooth.audio_shell.no_mics_mics_client:
    build_only: true
    integration_platforms:
      - native_posix
    extra_configs:
      - CONFIG_BT_MICS=n
      - CONFIG_BT_MICS_CLIENT=n
  bluetooth.audio_shell.no_tbs:
    build_only: true
    integration_platforms:
      - native_posix
    extra_configs:
      - CONFIG_BT_TBS=n
  bluetooth.audio_shell.no_ccp:
    build_only: true
    integration_platforms:
      - native_posix
    extra_configs:
      - CONFIG_BT_CCP=n
  bluetooth.audio_shell.no_tbs_ccp:
    build_only: true
    integration_platforms:
      - native_posix
    extra_configs:
      - CONFIG_BT_TBS=n
      - CONFIG_BT_CCP=n
  bluetooth.audio_shell.no_pacs:
    build_only: true
    integration_platforms:
      - native_posix
    extra_configs:
      - CONFIG_BT_PACS=n
  bluetooth.audio_shell.no_pac_snk:
    build_only: true
    integration_platforms:
      - native_posix
    extra_configs:
      - CONFIG_BT_PAC_SNK=n
  bluetooth.audio_shell.no_pac_src:
    build_only: true
    integration_platforms:
      - native_posix
    extra_configs:
      - CONFIG_BT_PAC_SRC=n
  bluetooth.audio_shell.no_bap:
    build_only: true
    integration_platforms:
      - native_posix
    extra_configs:
      - CONFIG_BT_BAP=n
  bluetooth.audio_shell.no_ascs:
    build_only: true
    integration_platforms:
      - native_posix
    extra_configs:
      - CONFIG_BT_ASCS=n
  bluetooth.audio_shell.no_baps:
    build_only: true
    integration_platforms:
      - native_posix
    extra_configs:
      - CONFIG_BT_PACS=n
      - CONFIG_BT_ASCS=n
      - CONFIG_BT_BAP=n
```

## tests/bluetooth/bluetooth/dts/bindings/zephyr,bt-hci-test.yaml
```yaml
description: Bluetooth HCI for test purposes

compatible: "zephyr,bt-hci-test"

include: bt-hci.yaml

properties:
  bt-hci-name:
    default: "test"
  bt-hci-bus:
    default: "virtual"
```

## tests/bluetooth/bluetooth/testcase.yaml
```yaml
tests:
  bluetooth.general:
    extra_args:
      - EXTRA_DTC_OVERLAY_FILE="test.overlay"
    platform_allow:
      - qemu_x86
      - qemu_cortex_m3
      - native_sim
      - native_sim/native/64
    integration_platforms:
      - qemu_x86
    tags: bluetooth
```

## tests/bluetooth/bsim_bt/bsim_test_advx/testcase.yaml
```yaml
tests:
  bluetooth.bsim.advx:
    harness: bsim
    tags: bluetooth
    platform_allow: nrf52_bsim
    harness_config:
      bsim_phy:
        sim_length: 60
      bsim_tests:
        - id: advx
        - id: scanx
```

## tests/bluetooth/bsim_bt/bsim_test_app/testcase.yaml
```yaml
common:
  harness: bsim
  tags: bluetooth
  platform_allow: nrf52_bsim
tests:
  bluetooth.bsim.basic_conn.split:
    extra_args: CONF_FILE=prj_split_privacy.conf
    harness_config:
      bsim_phy:
        sim_length: 20
      bsim_tests:
        - id: peripheral
          rs: 23
        - id: central
          rs: 6
  bluetooth.bsim.basic_conn.split.enc:
    extra_args: CONF_FILE=prj_split.conf
    harness_config:
      bsim_phy:
        sim_length: 20
      bsim_tests:
        - id: peripheral
          real_encryption: true
          rs: 23
        - id: central_encrypted
          real_encryption: true
          rs: 6
  bluetooth.bsim.basic_conn.split.enc_privacy:
    extra_args: CONF_FILE=prj_split_privacy.conf
    harness_config:
      bsim_phy:
        sim_length: 20
      bsim_tests:
        - id: peripheral
          real_encryption: true
          rs: 23
        - id: central_encrypted
          real_encryption: true
          rs: 6
```
