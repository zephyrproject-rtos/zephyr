## tests/bluetooth/bsim_bt/bsim_test_conn_win/Kconfig
```kconfig
# Copyright (c) 2021 Nordic Semiconductor ASA
# SPDX-License-Identifier: Apache-2.0

config BT_CTRL_CONN_TEST_WIN
	bool "Enable transmit window configuration"
	depends on BT_CTLR_TICKER_TEST
	help
	  This option enable the configuration of the connection transmit
	  window size and to skip connection packet. To use it you must
	  declare the struct conn_win_test

config BT_CTLR_TICKER_TEST
	bool "Enable ticker configuration to skip event"

# Include Zephyr's Kconfig.
source "Kconfig"
```

## tests/bluetooth/bsim_bt/bsim_test_dual_role_connection/central_hr/sample.yaml
```yaml
sample:
  name: Bluetooth Central HR
tests:
  sample.bluetooth.central_hr:
    arch_allow: x86
    harness: bluetooth
    tags: bluetooth
```

## tests/bluetooth/bsim_bt/bsim_test_iso/testcase.yaml
```yaml
tests:
  bluetooth.bsim.iso.broadcast:
    harness: bsim
    tags: bluetooth
    platform_allow: nrf52_bsim
    harness_config:
      bsim_phy:
        sim_length: 20
      bsim_tests:
        - id: receive
          real_encryption: true
        - id: broadcast
          real_encryption: true
```

## tests/bluetooth/bsim_bt/bsim_test_mesh/testcase.yaml
```yaml
common:
  harness: bsim
  tags: bluetooth
  platform_allow: nrf52_bsim
tests:
  # Transport tests:
  bluetooth.bsim.mesh.transport.group:
    harness_config:
      bsim_tests:
        - id: transport_tx_group
          real_encryption: true
        - id: transport_rx_group
          real_encryption: true
  bluetooth.bsim.mesh.transport.loopback_group:
    harness_config:
      bsim_tests:
        - id: transport_tx_loopback_group
          real_encryption: true
        - id: transport_rx_group
          real_encryption: true
  bluetooth.bsim.mesh.transport.loopback:
    harness_config:
      bsim_tests:
        - id: transport_tx_loopback
          real_encryption: true
        - id: transport_rx_none
          real_encryption: true
  bluetooth.bsim.mesh.transport.seg_block:
    harness_config:
      bsim_tests:
        - id: transport_tx_seg_block
          real_encryption: true
        - id: transport_rx_seg_block
          real_encryption: true
  bluetooth.bsim.mesh.transport.seg_concurrent:
    harness_config:
      bsim_tests:
        - id: transport_tx_seg_concurrent
          real_encryption: true
        - id: transport_rx_seg_concurrent
          real_encryption: true
  bluetooth.bsim.mesh.transport.seg_fail:
    harness_config:
      bsim_tests:
        - id: transport_tx_seg_fail
          real_encryption: true
  bluetooth.bsim.mesh.transport.seg_ivu:
    harness_config:
      bsim_tests:
        - id: transport_tx_seg_ivu
          real_encryption: true
        - id: transport_rx_seg_ivu
          real_encryption: true
  bluetooth.bsim.mesh.transport.unicast:
    harness_config:
      bsim_tests:
        - id: transport_tx_unicast
          real_encryption: true
        - id: transport_rx_unicast
          real_encryption: true
  bluetooth.bsim.mesh.transport.unknown_app:
    harness_config:
      bsim_tests:
        - id: transport_tx_unknown_app
          real_encryption: true
        - id: transport_rx_none
          real_encryption: true
  bluetooth.bsim.mesh.transport.va:
    harness_config:
      bsim_tests:
        - id: transport_tx_va
          real_encryption: true
        - id: transport_rx_va
          real_encryption: true
```

## tests/bluetooth/bt_crypto/Kconfig
```kconfig
# Copyright (c) 2022 Nordic Semiconductor ASA
# SPDX-License-Identifier: Apache-2.0

config BT_CRYPTO
	default y

# Include Zephyr's Kconfig.
source "Kconfig"
```

## tests/bluetooth/bt_crypto_ccm/testcase.yaml
```yaml
tests:
  bluetooth.bt_crypto_ccm:
    extra_args:
      - EXTRA_DTC_OVERLAY_FILE="test.overlay"
    platform_allow:
      - native_sim
      - native_sim/native/64
    integration_platforms:
      - native_sim
    tags: bluetooth
```

## tests/bluetooth/classic/a2dp_source/boards/mimxrt1170_evk_mimxrt1176_cm7_B.conf
```kconfig
CONFIG_BT_SETTINGS=n
CONFIG_FLASH=n
CONFIG_FLASH_MAP=n
CONFIG_NVS=n
CONFIG_SETTINGS=n
```

## tests/bluetooth/classic/gap_c/testcase.yaml
```yaml
tests:
  bluetooth.classic.gap.client:
    platform_allow:
    - native_sim
    integration_platforms:
    - native_sim
    tags:
    - bluetooth
    - gap
    harness: pytest
    harness_config:
      pytest_dut_scope: session
      fixture: usb_hci
    timeout: 600
  bluetooth.classic.gap.client.no_blobs:
    platform_allow:
    - mimxrt1170_evk@B/mimxrt1176/cm7
    tags:
    - bluetooth
    - gap
    extra_args:
    - CONFIG_BUILD_ONLY_NO_BLOBS=y
    timeout: 600
    build_only: true
```

## tests/bluetooth/classic/gap_s/testcase.yaml
```yaml
tests:
  bluetooth.classic.gap.server:
    platform_allow:
    - native_sim
    integration_platforms:
    - native_sim
    tags:
    - bluetooth
    - gap
    harness: pytest
    harness_config:
      pytest_dut_scope: session
      fixture: usb_hci
    timeout: 600
  bluetooth.classic.gap.server.no_blobs:
    platform_allow:
    - mimxrt1170_evk@B/mimxrt1176/cm7
    tags:
    - bluetooth
    - gap
    extra_args:
    - CONFIG_BUILD_ONLY_NO_BLOBS=y
    timeout: 600
    build_only: true
```

## tests/bluetooth/classic/hid_device/testcase.yaml
```yaml
tests:
  bluetooth.classic.hid_device:
    platform_allow:
      - native_sim
    integration_platforms:
      - native_sim
    tags:
      - bluetooth
    harness: pytest
    harness_config:
      pytest_dut_scope: session
      fixture: usb_hci
    timeout: 180
```

## tests/bluetooth/classic/l2cap/testcase.yaml
```yaml
tests:
  bluetooth.classic.l2cap:
    platform_allow:
      - native_sim
      - mimxrt1170_evk@B/mimxrt1176/cm7
    integration_platforms:
      - native_sim
    tags:
      - bluetooth
      - l2cap
    harness: pytest
    harness_config:
      pytest_dut_scope: session
      fixture: usb_hci
    timeout: 480
```

## tests/bluetooth/classic/l2cap_c/boards/mimxrt1170_evk_mimxrt1176_cm7_B.conf
```kconfig
#select NXP NW612 Chipset
CONFIG_BT_NXP_NW612=y

CONFIG_BT_SETTINGS=n
CONFIG_FLASH=n
CONFIG_FLASH_MAP=n
CONFIG_NVS=n
CONFIG_SETTINGS=n

CONFIG_ENTROPY_GENERATOR=y
```

## tests/bluetooth/classic/l2cap_s/testcase.yaml
```yaml
tests:
  bluetooth.classic.l2cap_s:
    platform_allow:
      - native_sim
    integration_platforms:
      - native_sim
    tags:
      - bluetooth
      - l2cap
    harness: pytest
    harness_config:
      pytest_dut_scope: session
      fixture: usb_hci
    timeout: 3600
  bluetooth.classic.l2cap_s.no_blobs:
    platform_allow:
      - mimxrt1170_evk@B/mimxrt1176/cm7
    tags:
      - bluetooth
      - l2cap
    extra_args:
      - CONFIG_BUILD_ONLY_NO_BLOBS=y
    timeout: 3600
    build_only: true
```

## tests/bluetooth/classic/rfcomm_s/testcase.yaml
```yaml
tests:
  bluetooth.classic.rfcomm.server:
    platform_allow:
    - native_sim
    integration_platforms:
    - native_sim
    tags:
    - bluetooth
    - rfcomm
    harness: pytest
    harness_config:
      pytest_dut_scope: session
      fixture: usb_hci
    timeout: 700
  bluetooth.classic.rfcomm.server.no_blobs:
    platform_allow:
    - mimxrt1170_evk@B/mimxrt1176/cm7
    tags:
    - bluetooth
    - rfcomm
    extra_args:
    - CONFIG_BUILD_ONLY_NO_BLOBS=y
    timeout: 700
    build_only: true
```

## tests/bluetooth/classic/sdp_c/testcase.yaml
```yaml
tests:
  bluetooth.classic.sdp.client:
    platform_allow:
      - native_sim
    integration_platforms:
      - native_sim
    tags:
      - bluetooth
      - sdp
    harness: pytest
    harness_config:
      pytest_dut_scope: session
      fixture: usb_hci
    timeout: 180
  bluetooth.classic.sdp.client.no_blobs:
    platform_allow:
      - mimxrt1170_evk@B/mimxrt1176/cm7
    tags:
      - bluetooth
      - sdp
    extra_args:
      - CONFIG_BUILD_ONLY_NO_BLOBS=y
    timeout: 180
    build_only: true
```

## tests/bluetooth/classic/sdp_s/testcase.yaml
```yaml
tests:
  bluetooth.classic.sdp.server:
    platform_allow:
      - native_sim
    integration_platforms:
      - native_sim
    tags:
      - bluetooth
      - sdp
    harness: pytest
    harness_config:
      pytest_dut_scope: session
      fixture: usb_hci
    timeout: 60
  bluetooth.classic.sdp.server.no_blobs:
    platform_allow:
      - mimxrt1170_evk@B/mimxrt1176/cm7
    tags:
      - bluetooth
      - sdp
    extra_args:
      - CONFIG_BUILD_ONLY_NO_BLOBS=y
    timeout: 60
    build_only: true
```

## tests/bluetooth/classic/sim/gap_discovery/Kconfig
```kconfig
# Copyright 2026 NXP
#
# SPDX-License-Identifier: Apache-2.0

# Only for use with the Bluetooth Classic GAP Discovery simulation test
# Used to shorten test time by limiting discovery duration
config BT_LIMITED_DISCOVERABLE_DURATION
	default 3
	range 1 60

source "Kconfig.zephyr"

module = TEST_GAP_DISCOVERY
module-str = test_gap_discovery
source "subsys/logging/Kconfig.template.log_config"
```

## tests/bluetooth/classic/sim/gap_discovery/testcase.yaml
```yaml
tests:
  bluetooth.classic.gap.discovery:
    platform_allow:
    - native_sim
    integration_platforms:
    - native_sim
    tags:
    - bluetooth
    - gap
    timeout: 120
    harness: bluetooth
```

## tests/bluetooth/classic/sim/l2cap_connectless/Kconfig
```kconfig
# Copyright 2026 NXP
#
# SPDX-License-Identifier: Apache-2.0

source "Kconfig.zephyr"

module = TEST_CLASSIC_L2CAP_CONNLESS_SIM
module-str = test_classic_l2cap_connless_sim
source "subsys/logging/Kconfig.template.log_config"
```

## tests/bluetooth/classic/sim/l2cap_echo/Kconfig
```kconfig
# Copyright 2026 NXP
#
# SPDX-License-Identifier: Apache-2.0

source "Kconfig.zephyr"

module = TEST_CLASSIC_L2CAP_ECHO_SIM
module-str = test_classic_l2cap_echo_sim
source "subsys/logging/Kconfig.template.log_config"
```

## tests/bluetooth/classic/sim/sdp_discovery/Kconfig
```kconfig
# Copyright 2026 NXP
#
# SPDX-License-Identifier: Apache-2.0

source "Kconfig.zephyr"

config TEST_SDP_DISCOVER_ATTR_TRACK_TABLE_SIZE
	int "Number of attribute IDs to track"
	default 32
	range 1 255
	help
	  Sets the size of the internal table used by the test to store discovered
	  attribute IDs and their hit counts.

config TEST_ADDITIONAL_SDP_RECORD_COUNT
	int "Number of additional SDP records to be registered"
	default 10
	range 1 252
	help
	  Sets the number of additional SDP service records that can be registered by specific
	  test cases.
	  Each record represents a service that can be discovered through the SDP discovery process.

module = TEST_SDP_DISCOVERY
module-str = test_sdp_discovery
source "subsys/logging/Kconfig.template.log_config"
```

## tests/bluetooth/controller/common/Kconfig
```kconfig
# Copyright (c) 2024 Nordic Semiconductor ASA
# SPDX-License-Identifier: Apache-2.0

# The link layer requires a corresponding device tree node to be enabled
# The corresponding Kconfig entry is not generated for unit tests,
# so we add it here.
config DT_HAS_ZEPHYR_BT_HCI_LL_SW_SPLIT_ENABLED
	bool
	default y
```

## tests/bluetooth/controller/ctrl_api/testcase.yaml
```yaml
common:
  tags:
    - bluetooth
    - bt_api
    - bt_ull_llcp
tests:
  bluetooth.controller.ctrl_api.test:
    type: unit
    extra_args:
      - SNIPPET="bt-ll-sw-split"
```
