## CMakeLists.txt
```
# SPDX-License-Identifier: Apache-2.0

cmake_minimum_required(VERSION 3.20.0)

if (NOT DEFINED ENV{BSIM_COMPONENTS_PATH})
  message(FATAL_ERROR "This test requires the BabbleSim simulator. Please set  \
          the  environment variable BSIM_COMPONENTS_PATH to point to its       \
          components folder. More information can be found in                  \
          https://babblesim.github.io/folder_structure_and_env.html")
endif()

find_package(Zephyr HINTS $ENV{ZEPHYR_BASE})
project(bsim_test_conn_win)

target_sources(app PRIVATE
  src/main.c
  ${ZEPHYR_BASE}/tests/bluetooth/bsim_bt/bsim_test_conn_win/src/test_central.c
  ${ZEPHYR_BASE}/tests/bluetooth/bsim_bt/bsim_test_conn_win/src/test_peripheral.c
)

zephyr_include_directories(
  $ENV{BSIM_COMPONENTS_PATH}/libUtilv1/src/
  $ENV{BSIM_COMPONENTS_PATH}/libPhyComv1/src/
  ${ZEPHYR_BASE}/include/bluetooth/
  ${ZEPHYR_BASE}/subsys/bluetooth/controller/include/
  ${ZEPHYR_BASE}/subsys/bluetooth/controller/ll_sw/
)
```

## Kconfig
```
# Copyright (c) 2021 Nordic Semiconductor ASA
# SPDX-License-Identifier: Apache-2.0

config BT_CTRL_CONN_TEST_WIN
	bool "Enable transmit window configuration"
	depends on BT_CTLR_TICKER_TEST
	help
	  This option enable the configuration of the connection transmit
	  window size and to skip connection packet. To use it you must
	  declare the struct conn_win_test

config BT_CTLR_TICKER_TEST
	bool "Enable ticker configuration to skip event"

# Include Zephyr's Kconfig.
source "Kconfig"
```

## prj.conf
```kconfig
CONFIG_BT_PERIPHERAL=y
CONFIG_BT_PRIVACY=y
CONFIG_BT_DEVICE_NAME="Conn window"

CONFIG_BT=y
CONFIG_BT_CENTRAL=y
CONFIG_BT_DEBUG_LOG=y
CONFIG_BT_AUTO_PHY_UPDATE=n
CONFIG_BT_GAP_AUTO_UPDATE_CONN_PARAMS=n
CONFIG_BT_AUTO_DATA_LEN_UPDATE=n
CONFIG_BT_CTLR_PER_INIT_FEAT_XCHG=n
CONFIG_CLOCK_CONTROL_NRF_K32SRC_250PPM=y
CONFIG_BT_CTRL_CONN_TEST_WIN=y
CONFIG_BT_CTLR_TICKER_TEST=y
```

## src/main.c
```c
/* main.c - Application main entry point */

/*
 * Copyright (c) 2015-2016 Intel Corporation
 *
 * SPDX-License-Identifier: Apache-2.0
 */

#include <stddef.h>

#include <zephyr.h>

#include <sys/printk.h>
#include <sys/util.h>

#include "bs_types.h"
#include "bs_tracing.h"
#include "time_machine.h"
#include "bstests.h"

int init_central(void);
int init_peripheral(void);

#define FAIL(...)					\
	do {						\
		bst_result = Failed;			\
		bs_trace_error_time_line(__VA_ARGS__);	\
	} while (0)

#define PASS(...)					\
	do {						\
		bst_result = Passed;			\
		bs_trace_info_time(1, __VA_ARGS__);	\
	} while (0)

extern enum bst_result_t bst_result;

static void test_central_main(void)
{
	int err;

	err = init_central();
	if (err) {
		goto exit;
	}

	/* Wait a little so that peripheral side completes the last
	 * connection establishment.
	 */
	k_sleep(K_SECONDS(1));

	PASS("Central tests passed\n");
	bs_trace_silent_exit(0);

	return;

exit:
	FAIL("Central tests failed (%d)\n", err);
	bs_trace_silent_exit(0);
}

static void test_peripheral_main(void)
{
	int err;

	err = init_peripheral();
	if (err) {
		goto exit;
	}

	PASS("Peripheral tests passed\n");

	return;

exit:
	FAIL("Peripheral tests failed (%d)\n", err);
	bs_trace_silent_exit(0);
}

static void test_conn_win_init(void)
{
	bst_ticker_set_next_tick_absolute(30e6);
	bst_result = In_progress;
}

static void test_conn_win_tick(bs_time_t HW_device_time)
{
	bst_result = Failed;
	bs_trace_error_line("Test connection window finished.\n");
}

static const struct bst_test_instance test_def[] = {
	{
		.test_id = "central",
		.test_descr = "Central conn win init",
		.test_tick_f = test_conn_win_tick,
		.test_main_f = test_central_main
	},
	{
		.test_id = "peripheral",
		.test_descr = "Peripheral multiple identity",
		.test_post_init_f = test_conn_win_init,
		.test_tick_f = test_conn_win_tick,
		.test_main_f = test_peripheral_main
	},
	BSTEST_END_MARKER
};

struct bst_test_list *test_conn_win_install(struct bst_test_list *tests)
{
	return bst_add_tests(tests, test_def);
}

bst_test_install_t test_installers[] = {
	test_conn_win_install,
	NULL
};

void main(void)
{
	bst_main();
}
```

## src/test_central.c
```c
#ifdef __INTELLISENSE__
    #pragma diag_suppress 3365
#endif

#include <zephyr/types.h>
#include <stddef.h>
#include <errno.h>
#include <zephyr.h>
#include <sys/printk.h>

#include <bluetooth/conn.h>

#include "lll_test.h"

#define LATE_SENDING_INSIDE_WIN_US	9375
#define CONNECTION_INTERVAL_US		11250
#define US_UNITS_TO_625US_UNITS(us_units) ((uint16_t)(((uint32_t)(us_units))/625))
#define US_UNITS_TO_1250US_UNITS(us_units) ((US_UNITS_TO_625US_UNITS(us_units))/2)

enum invalid_conn_timing_test{
	EARLY_SENDING_1,
	LATE_SENDING_1,
	HCTO_TRUNCATE_1,
	EARLY_SENDING_2,
	LATE_SENDING_2,
	HCTO_TRUNCATE_2,
	NORMAL
};

struct bt_conn_win_test conn_win_test;

static struct bt_conn_le_create_param *create_param = BT_CONN_LE_CREATE_CONN;
static struct bt_le_conn_param *conn_param = BT_LE_CONN_PARAM_DEFAULT;
static struct bt_conn *default_conn;

static uint8_t expect_disconn = 0;
static uint8_t test_err = 0;


static void start_scan(void);

static void test_conn(const bt_addr_le_t *addr, struct bt_conn **conn)
{
	int err;
	static uint8_t i = 0;

	switch (i)
	{
	case EARLY_SENDING_1:
		/* CONNECTION TERMINATED BY LOCAL HOST (0x16) */
		expect_disconn = 0x16;
		conn_win_test.tr_win_offset = 0;
		conn_win_test.win_size = 1;
		conn_win_test.pkt_conn_delay_us = 0;
		printk("EARLY_SENDING_1 \n");
		break;

	case LATE_SENDING_1:
		expect_disconn = 0x16;
		conn_win_test.tr_win_offset = 0;
		conn_win_test.win_size = 8;
		conn_win_test.pkt_conn_delay_us = LATE_SENDING_INSIDE_WIN_US;
		printk("LATE_SENDING_1 \n");
		break;


	case HCTO_TRUNCATE_1:
		/* CONN FAILED TO BE ESTABLISHED /SYNCHRONIZATION TIMEOUT (0x3E) */
		expect_disconn = 0x3E;
		conn_win_test.pkt_conn_delay_us = CONNECTION_INTERVAL_US;
		printk("HCTO_TRUNCATE_1 \n");
		break;


	case EARLY_SENDING_2:
		expect_disconn = 0x16;
		conn_win_test.tr_win_offset = 8;
		conn_win_test.win_size = 1;
		conn_win_test.pkt_conn_delay_us = 0;
		printk("EARLY_SENDING_2 \n");
		break;

	case LATE_SENDING_2:
		expect_disconn = 0x16;
		conn_win_test.tr_win_offset = 8;
		conn_win_test.win_size = 8;
		conn_win_test.pkt_conn_delay_us = LATE_SENDING_INSIDE_WIN_US;
		printk("LATE_SENDING_2 \n");
		break;

	case HCTO_TRUNCATE_2:
		expect_disconn = 0x3E;
		conn_win_test.pkt_conn_delay_us = CONNECTION_INTERVAL_US;
		printk("HCTO_TRUNCATE_2 \n");
		break;

	case NORMAL:
		expect_disconn = 0x16;
		conn_win_test.tr_win_offset = 0;
		conn_win_test.win_size = 1;
		conn_win_test.pkt_conn_delay_us = 0;
		printk("NORMAL \n");
		break;

	default:
		return;
		break;
	}

	err = bt_conn_le_create(addr, create_param,	conn_param, &default_conn);
	if (err) {
		printk("Create conn to failed (%u)\n", err);
		start_scan();
	}

	i++;
}

static void device_found(const bt_addr_le_t *addr, int8_t rssi, uint8_t type,
			 struct net_buf_simple *ad)
{
	char addr_str[BT_ADDR_LE_STR_LEN];
	if (default_conn) {
		return;
	}

	/* We're only interested in connectable events */
	if (type != BT_GAP_ADV_TYPE_ADV_IND &&
	    type != BT_GAP_ADV_TYPE_ADV_DIRECT_IND) {
		return;
	}

	bt_addr_le_to_str(addr, addr_str, sizeof(addr_str));
	printk("Device found: %s (RSSI %d)\n", addr_str, rssi);

	/* connect only to devices in close proximity */
	if (rssi < -50) {
		return;
	}

	if (bt_le_scan_stop()) {
		return;
	}

	test_conn(addr, &default_conn);
}

static void start_scan(void)
{
	int err;

	/* This demo doesn't require active scan */
	err = bt_le_scan_start(BT_LE_SCAN_PASSIVE, device_found);
	if (err) {
		printk("Scanning failed to start (err %d)\n", err);
		return;
	}

	printk("Scanning successfully started\n");
}

static void connected(struct bt_conn *conn, uint8_t err)
{
	char addr[BT_ADDR_LE_STR_LEN];

	bt_addr_le_to_str(bt_conn_get_dst(conn), addr, sizeof(addr));

	if (err) {
		printk("Failed to connect to %s (%u)\n", addr, err);

		bt_conn_unref(default_conn);
		default_conn = NULL;

		start_scan();
		return;
	}

	if (conn != default_conn) {
		return;
	}

	printk("Connected: %s\n Wait 100ms\n", addr);

	k_sleep(K_MSEC(100));

	printk("Wake up\n");

	bt_conn_disconnect(conn, BT_HCI_ERR_REMOTE_USER_TERM_CONN);
}

static void disconnected(struct bt_conn *conn, uint8_t reason)
{
	char addr[BT_ADDR_LE_STR_LEN];

	if (conn != default_conn) {
		return;
	}

	bt_addr_le_to_str(bt_conn_get_dst(conn), addr, sizeof(addr));

	printk("Central Disconnected: %s (reason 0x%02x)\n", addr, reason);

	bt_conn_unref(default_conn);
	default_conn = NULL;

	if(reason != expect_disconn){
		test_err = reason;

		printk("Test fail at disconnection:  (expected disconnection 0x%02x) \
					insteed of(reason 0x%02x)\n", expect_disconn, reason);
		return;
	}

	start_scan();
}

BT_CONN_CB_DEFINE(conn_callbacks) = {
	.connected = connected,
	.disconnected = disconnected,
};

int init_central(void)
{
	conn_param->interval_min = US_UNITS_TO_1250US_UNITS(8000);
	conn_param->interval_max = US_UNITS_TO_1250US_UNITS(CONNECTION_INTERVAL_US);
	conn_win_test.pkt_conn_delay_us = 0;
	conn_win_test.skip_pkt = 5;
	conn_win_test.conn_interval_us = CONNECTION_INTERVAL_US;

	test_err = bt_enable(NULL);
	if (test_err) {
		printk("Bluetooth init failed (err %d)\n", test_err);
		return test_err;
	}

	printk("Bluetooth initialized\n");

	start_scan();

	k_sleep(K_MSEC(2500));

	return test_err;
}
```

## src/test_peripheral.c
```c
#include <zephyr/types.h>
#include <stddef.h>
#include <string.h>
#include <errno.h>
#include <sys/printk.h>
#include <sys/byteorder.h>
#include <zephyr.h>

#include <bluetooth/conn.h>


static uint8_t mfg_data[] = { 0xff, 0xff, 0x00 };

static const struct bt_data ad[] = {
	BT_DATA(BT_DATA_MANUFACTURER_DATA, mfg_data, 3),
};

static void connected(struct bt_conn *conn, uint8_t err)
{
	if (err) {
		printk("Connection failed (err 0x%02x)\n", err);
	} else {
		printk("Connected\n");
	}
}

static void disconnected(struct bt_conn *conn, uint8_t reason)
{
	printk("Disconnected (reason 0x%02x)\n", reason);
}

BT_CONN_CB_DEFINE(conn_callbacks) = {
	.connected = connected,
	.disconnected = disconnected,
};

int init_peripheral(void)
{
	int err;

	err = bt_enable(NULL);
	if (err) {
		printk("Bluetooth init failed (err %d)\n", err);
		return err;
	}

    err = bt_le_adv_start(BT_LE_ADV_CONN_NAME, ad, ARRAY_SIZE(ad), NULL, 0);
	if (err) {
		printk("Advertising failed to start (err %d)\n", err);
		return err;
	}

	printk("Advertising successfully started\n");

    return err;
}
```
