## CMakeLists.txt
```
# SPDX-License-Identifier: Apache-2.0

cmake_minimum_required(VERSION 3.20.0)
include_directories("./src")

find_package(Zephyr REQUIRED HINTS $ENV{ZEPHYR_BASE})
project(bluetooth_ctrl_user_ext)

zephyr_library_include_directories(${ZEPHYR_BASE}/subsys/bluetooth/controller/)

if(CONFIG_SOC_COMPATIBLE_NRF)
  zephyr_library_include_directories(
    ${ZEPHYR_BASE}/subsys/bluetooth/controller/ll_sw/nordic
    ${ZEPHYR_BASE}/subsys/bluetooth/hci/nordic
  )
elseif(CONFIG_SOC_OPENISA_RV32M1_RISCV32)
  zephyr_library_include_directories(
    ${ZEPHYR_BASE}/bluetooth/controller/ll_sw/openisa
    ${ZEPHYR_BASE}/bluetooth/hci/openisa
  )
endif()


FILE(GLOB app_sources src/*.c)

target_sources(app PRIVATE ${app_sources})
```

## prj.conf
```kconfig
CONFIG_BT=y
CONFIG_BT_CTLR=y
CONFIG_BT_LL_SW_SPLIT=y
CONFIG_BT_PERIPHERAL=y
CONFIG_BT_CENTRAL=y
CONFIG_ZTEST=y
CONFIG_BT_CTLR_ADVANCED_FEATURES=y
CONFIG_BT_CTLR_USER_EXT=y
CONFIG_BT_CTLR_USER_EVT_RANGE=10
CONFIG_BT_RX_USER_PDU_LEN=7
CONFIG_BT_CTLR_USER_CPR_INTERVAL_MIN=y
```

## src/main.c
```c
/* main.c - Application main entry point */

/*
 * Copyright (c) 2015-2016 Intel Corporation
 *
 * SPDX-License-Identifier: Apache-2.0
 */

#include <zephyr/types.h>
#include <stddef.h>
#include <zephyr/sys/printk.h>
#include <ztest.h>

#include <zephyr/bluetooth/bluetooth.h>

ZTEST_SUITE(test_bluetooth, NULL, NULL, NULL, NULL, NULL);

ZTEST(test_bluetooth, test_ctrl_user_ext)
{
	zassert_false(bt_enable(NULL), "Bluetooth ctrl_user_ext failed");
}
```

## src/hci_user_ext.c
```c
/*
 * Copyright (c) 2019 Oticon A/S
 *
 * SPDX-License-Identifier: Apache-2.0
 */

#if defined(CONFIG_BT_CTLR_USER_EXT)

#include <zephyr/toolchain.h>
#include <zephyr/types.h>
#include <zephyr/net/buf.h>

#include "util/memq.h"

#include "ll_sw/pdu_df.h"
#include "lll/pdu_vendor.h"
#include "ll_sw/pdu.h"
#include "ll_sw/lll.h"
#include "hci/hci_user_ext.h"

/* The test is made to show that hci.c and other code can compile when
 * certain Kconfig options are set. This includes functions that are
 * used for proprietary user extension. The function implementations
 * in this file are simple stubs without functional behavior.
 */

int8_t hci_user_ext_get_class(struct node_rx_pdu *node_rx)
{
	return 0;
}

void hci_user_ext_encode_control(struct node_rx_pdu *node_rx, struct pdu_data *pdu_data, struct net_buf *buf)
{
	return;
}

#endif
```

## src/ull_vendor.h
```c
/*
 * Copyright (c) 2019 Oticon A/S
 *
 * SPDX-License-Identifier: Apache-2.0
 */

#if defined(CONFIG_BT_CTLR_USER_EXT)

/* The test is made to show that ull.c and other code can compile when
 * certain Kconfig options are set. This includes functions that are
 * used for vendor specific behavior, as such the function implementations
 * in this file are simple stubs without functional behavior.
 */

static inline int ull_user_init(void)
{
	return 0;
}

static inline int rx_demux_rx_proprietary(memq_link_t *link,
					  struct node_rx_hdr *rx,
					  memq_link_t *tail,
					  memq_link_t **head)
{
	return 0;
}

static inline void ull_proprietary_done(struct node_rx_event_done *evdone)
{
	/* Nothing to do */
}

#endif /* CONFIG_BT_CTLR_USER_EXT */
```
