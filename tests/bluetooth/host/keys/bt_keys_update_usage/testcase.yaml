## tests/bluetooth/host/keys/bt_keys_update_usage/testcase.yaml
```yaml
common:
  tags: bluetooth host
tests:
  bluetooth.host.bt_keys_update_usage.default:
    type: unit
    extra_configs:
      - CONFIG_BT_SMP=y
      - CONFIG_BT_KEYS_OVERWRITE_OLDEST=y
  bluetooth.host.bt_keys_update_usage.save_aging_counter:
    type: unit
    extra_configs:
      - CONFIG_SETTINGS=y
      - CONFIG_BT_SETTINGS=y
      - CONFIG_BT_SMP=y
      - CONFIG_BT_KEYS_OVERWRITE_OLDEST=y
      - CONFIG_BT_KEYS_SAVE_AGING_COUNTER_ON_PAIRING=y
```

## tests/bluetooth/host_long_adv_recv/dts/bindings/zephyr,bt-hci-test.yaml
```yaml
description: Bluetooth HCI for test purposes

compatible: "zephyr,bt-hci-test"

include: bt-hci.yaml

properties:
  bt-hci-name:
    default: "test"
  bt-hci-bus:
    default: "BT_HCI_BUS_VIRTUAL"
  bt-hci-quirks:
    default: ["BT_HCI_QUIRK_NO_RESET"]
```

## tests/bluetooth/host_long_adv_recv/testcase.yaml
```yaml
tests:
  bluetooth.host_long_adv_recv:
    platform_allow:
      - native_posix/native
      - native_posix/native/64
      - native_sim/native
      - native_sim/native/64
    integration_platforms:
      - native_sim/native
    tags:
      - bluetooth
      - host
```

## tests/bluetooth/init/testcase.yaml
```yaml
common:
  build_only: true
  tags: bluetooth
tests:
  bluetooth.init.test:
    platform_allow: qemu_cortex_m3
  bluetooth.init.test_0:
    extra_args: CONF_FILE=prj_0.conf
    platform_allow: qemu_cortex_m3
  bluetooth.init.test_1:
    extra_args: CONF_FILE=prj_1.conf
    platform_allow: qemu_cortex_m3
  bluetooth.init.test_10:
    extra_args: CONF_FILE=prj_10.conf
    platform_allow: qemu_cortex_m3
  bluetooth.init.test_11:
    extra_args: CONF_FILE=prj_11.conf
    platform_allow: qemu_cortex_m3
  bluetooth.init.test_12:
    extra_args: CONF_FILE=prj_12.conf
    platform_allow: qemu_cortex_m3
  bluetooth.init.test_13:
    extra_args: CONF_FILE=prj_13.conf
    platform_allow: qemu_cortex_m3
  bluetooth.init.test_14:
    extra_args: CONF_FILE=prj_14.conf
    platform_allow: qemu_cortex_m3
  bluetooth.init.test_15:
    extra_args: CONF_FILE=prj_15.conf
    platform_allow: qemu_cortex_m3
  bluetooth.init.test_16:
    extra_args: CONF_FILE=prj_16.conf
    platform_allow: qemu_cortex_m3
  bluetooth.init.test_17:
    extra_args: CONF_FILE=prj_17.conf
    platform_allow: qemu_cortex_m3
  bluetooth.init.test_18:
    extra_args: CONF_FILE=prj_18.conf
    platform_allow: qemu_cortex_m3
  bluetooth.init.test_19:
    extra_args: CONF_FILE=prj_19.conf
    platform_allow: qemu_cortex_m3
  bluetooth.init.test_2:
    extra_args: CONF_FILE=prj_2.conf
    platform_allow: qemu_cortex_m3
  bluetooth.init.test_20:
    extra_args: CONF_FILE=prj_20.conf
    platform_allow: qemu_cortex_m3
  bluetooth.init.test_21:
    extra_args: CONF_FILE=prj_21.conf
    platform_allow: qemu_cortex_m3
  bluetooth.init.test_22:
    extra_args: CONF_FILE=prj_22.conf
    platform_allow: qemu_cortex_m3
  bluetooth.init.test_3:
    extra_args: CONF_FILE=prj_3.conf
    platform_allow: qemu_cortex_m3
  bluetooth.init.test_4:
    extra_args: CONF_FILE=prj_4.conf
    platform_allow: qemu_cortex_m3
  bluetooth.init.test_5:
    extra_args: CONF_FILE=prj_5.conf
    platform_allow: qemu_cortex_m3
  bluetooth.init.test_6:
    extra_args: CONF_FILE=prj_6.conf
    platform_allow: qemu_cortex_m3
  bluetooth.init.test_7:
    extra_args: CONF_FILE=prj_7.conf
    platform_allow: qemu_cortex_m3
  bluetooth.init.test_8:
    extra_args: CONF_FILE=prj_8.conf
    platform_allow: qemu_cortex_m3
  bluetooth.init.test_9:
    extra_args: CONF_FILE=prj_9.conf
    platform_allow: qemu_cortex_m3
  bluetooth.init.test_ctlr:
    extra_args: CONF_FILE=prj_ctlr.conf
    platform_allow:
      - nrf52840dk/nrf52840
      - nrf52dk/nrf52832
      - nrf51dk/nrf51822
      - rv32m1_vega/openisa_rv32m1/ri5cy
    integration_platforms:
      - nrf52840dk/nrf52840
      - nrf52dk/nrf52832
      - nrf51dk/nrf51822
      - rv32m1_vega/openisa_rv32m1/ri5cy
  bluetooth.init.test_ctlr_4_0:
    extra_args: CONF_FILE=prj_ctlr_4_0.conf
    platform_allow:
      - nrf52840dk/nrf52840
      - nrf52dk/nrf52832
      - nrf51dk/nrf51822
    integration_platforms:
      - nrf52dk/nrf52832
      - nrf51dk/nrf51822
  bluetooth.init.test_ctlr_4_0_dbg:
    extra_args: CONF_FILE=prj_ctlr_4_0_dbg.conf
    platform_allow:
      - nrf52840dk/nrf52840
      - nrf52dk/nrf52832
      - nrf51dk/nrf51822
    integration_platforms:
      - nrf52dk/nrf52832
      - nrf51dk/nrf51822
  bluetooth.init.test_ctlr_tiny:
    extra_args: CONF_FILE=prj_ctlr_tiny.conf
    platform_allow:
      - nrf52840dk/nrf52840
      - nrf52dk/nrf52832
      - nrf51dk/nrf51822
    integration_platforms:
      - nrf52dk/nrf52832
      - nrf51dk/nrf51822
  bluetooth.init.test_ctlr_dbg:
    extra_args:
      - CONF_FILE=prj_ctlr_dbg.conf
      - DTC_OVERLAY_FILE=pa_lna.overlay
    platform_allow:
      - nrf52840dk/nrf52840
      - nrf52dk/nrf52832
    integration_platforms:
      - nrf52840dk/nrf52840
      - nrf52dk/nrf52832
  bluetooth.init.test_ctlr_5_x_dbg:
    extra_args:
      - CONF_FILE=prj_ctlr_5_x_dbg.conf
      - DTC_OVERLAY_FILE=pa_lna.overlay
    platform_allow:
      - nrf52840dk/nrf52840
      - nrf52dk/nrf52832
    integration_platforms:
      - nrf52840dk/nrf52840
      - nrf52dk/nrf52832
  bluetooth.init.test_ctlr_sw_switch_single_timer:
    extra_args:
      - CONF_FILE=prj_ctlr.conf
      - CONFIG_BT_CTLR_ADVANCED_FEATURES=y
      - CONFIG_BT_CTLR_SW_SWITCH_SINGLE_TIMER=y
    platform_allow:
      - nrf5340dk/nrf5340/cpunet
      - nrf52840dk/nrf52840
      - nrf52dk/nrf52832
    integration_platforms:
      - nrf5340dk/nrf5340/cpunet
  bluetooth.init.test_ctlr_ticker:
    extra_args:
      - CONF_FILE=prj_ctlr_ticker.conf
    platform_allow:
      - nrf52840dk/nrf52840
      - nrf52dk/nrf52832
    integration_platforms:
      - nrf52dk/nrf52832
  bluetooth.init.test_ctlr_broadcaster:
    extra_args: CONF_FILE=prj_ctlr_broadcaster.conf
    platform_allow:
      - nrf52840dk/nrf52840
      - nrf52dk/nrf52832
      - nrf51dk/nrf51822
      - rv32m1_vega/openisa_rv32m1/ri5cy
    integration_platforms:
      - nrf52dk/nrf52832
  bluetooth.init.test_ctlr_peripheral:
    extra_args: CONF_FILE=prj_ctlr_peripheral.conf
    platform_allow:
      - nrf52840dk/nrf52840
      - nrf52dk/nrf52832
      - nrf51dk/nrf51822
      - rv32m1_vega/openisa_rv32m1/ri5cy
    integration_platforms:
      - nrf52dk/nrf52832
  bluetooth.init.test_ctlr_peripheral_priv:
    extra_args: CONF_FILE=prj_ctlr_peripheral_priv.conf
    platform_allow:
      - nrf52840dk/nrf52840
      - nrf52dk/nrf52832
      - nrf51dk/nrf51822
      - rv32m1_vega/openisa_rv32m1/ri5cy
    integration_platforms:
      - nrf52840dk/nrf52840
  bluetooth.init.test_ctlr_observer:
    extra_args: CONF_FILE=prj_ctlr_observer.conf
    platform_allow:
      - nrf52840dk/nrf52840
      - nrf52dk/nrf52832
      - nrf51dk/nrf51822
      - rv32m1_vega/openisa_rv32m1/ri5cy
    integration_platforms:
      - nrf52dk/nrf52832
  bluetooth.init.test_ctlr_central:
    extra_args: CONF_FILE=prj_ctlr_central.conf
    platform_allow:
      - nrf52840dk/nrf52840
      - nrf52dk/nrf52832
      - nrf51dk/nrf51822
      - rv32m1_vega/openisa_rv32m1/ri5cy
    integration_platforms:
      - nrf52dk/nrf52832
      - rv32m1_vega/openisa_rv32m1/ri5cy
  bluetooth.init.test_ctlr_central_priv:
    extra_args: CONF_FILE=prj_ctlr_central_priv.conf
    platform_allow:
      - nrf52840dk/nrf52840
      - nrf52dk/nrf52832
      - nrf51dk/nrf51822
      - rv32m1_vega/openisa_rv32m1/ri5cy
    integration_platforms:
      - nrf52dk/nrf52832
      - rv32m1_vega/openisa_rv32m1/ri5cy
  bluetooth.init.test_ctlr_broadcaster_ext:
    extra_args: CONF_FILE=prj_ctlr_broadcaster_ext.conf
    platform_allow:
      - nrf52840dk/nrf52840
      - nrf52dk/nrf52832
      - nrf51dk/nrf51822
    integration_platforms:
      - nrf52840dk/nrf52840
      - nrf51dk/nrf51822
  bluetooth.init.test_ctlr_peripheral_ext:
    extra_args: CONF_FILE=prj_ctlr_peripheral_ext.conf
    platform_allow:
      - nrf52840dk/nrf52840
      - nrf52dk/nrf52832
      - nrf51dk/nrf51822
    integration_platforms:
      - nrf52840dk/nrf52840
      - nrf51dk/nrf51822
  bluetooth.init.test_ctlr_peripheral_ext_priv:
    extra_args: CONF_FILE=prj_ctlr_peripheral_ext_priv.conf
    platform_allow:
      - nrf52840dk/nrf52840
      - nrf52dk/nrf52832
      - nrf51dk/nrf51822
    integration_platforms:
      - nrf52840dk/nrf52840
      - nrf51dk/nrf51822
  bluetooth.init.test_ctlr_oberver_ext:
    extra_args: CONF_FILE=prj_ctlr_observer_ext.conf
    platform_allow:
      - nrf52840dk/nrf52840
      - nrf52dk/nrf52832
      - nrf51dk/nrf51822
    integration_platforms:
      - nrf52840dk/nrf52840
      - nrf51dk/nrf51822
  bluetooth.init.test_ctlr_central_ext:
    extra_args: CONF_FILE=prj_ctlr_central_ext.conf
    platform_allow:
      - nrf52840dk/nrf52840
      - nrf52dk/nrf52832
      - nrf51dk/nrf51822
    integration_platforms:
      - nrf52840dk/nrf52840
      - nrf51dk/nrf51822
  bluetooth.init.test_ctlr_central_ext_priv:
    extra_args: CONF_FILE=prj_ctlr_central_ext_priv.conf
    platform_allow:
      - nrf52840dk/nrf52840
      - nrf52dk/nrf52832
      - nrf51dk/nrf51822
    integration_platforms:
      - nrf52840dk/nrf52840
      - nrf51dk/nrf51822
  bluetooth.init.test_ctlr_per_adv:
    extra_args: CONF_FILE=prj_ctlr_per_adv.conf
    platform_allow:
      - nrf52840dk/nrf52840
      - nrf52dk/nrf52832
      - nrf51dk/nrf51822
    integration_platforms:
      - nrf52840dk/nrf52840
      - nrf51dk/nrf51822
  bluetooth.init.test_ctlr_per_adv_no_adi:
    extra_args: CONF_FILE=prj_ctlr_per_adv_no_adi.conf
    platform_allow:
      - nrf52840dk/nrf52840
      - nrf52dk/nrf52832
      - nrf51dk/nrf51822
    integration_platforms:
      - nrf52840dk/nrf52840
      - nrf51dk/nrf51822
  bluetooth.init.test_ctlr_per_sync:
    extra_args: CONF_FILE=prj_ctlr_per_sync.conf
    platform_allow:
      - nrf52840dk/nrf52840
      - nrf52dk/nrf52832
      - nrf51dk/nrf51822
    integration_platforms:
      - nrf52840dk/nrf52840
      - nrf51dk/nrf51822
  bluetooth.init.test_ctlr_per_sync_no_adi:
    extra_args: CONF_FILE=prj_ctlr_per_sync_no_adi.conf
    platform_allow:
      - nrf52840dk/nrf52840
      - nrf52dk/nrf52832
      - nrf51dk/nrf51822
    integration_platforms:
      - nrf52840dk/nrf52840
      - nrf51dk/nrf51822
  bluetooth.init.test_ctlr_per_sync_no_filter:
    extra_args: CONF_FILE=prj_ctlr_per_sync_no_filter.conf
    platform_allow:
      - nrf52840dk/nrf52840
      - nrf52dk/nrf52832
      - nrf51dk/nrf51822
    integration_platforms:
      - nrf52840dk/nrf52840
      - nrf51dk/nrf51822
  bluetooth.init.test_ctlr_peripheral_iso:
    extra_args: CONF_FILE=prj_ctlr_peripheral_iso.conf
    platform_allow:
      - nrf52840dk/nrf52840
      - nrf52dk/nrf52832
      - nrf51dk/nrf51822
    integration_platforms:
      - nrf52840dk/nrf52840
      - nrf51dk/nrf51822
  bluetooth.init.test_ctlr_central_iso:
    extra_args: CONF_FILE=prj_ctlr_central_iso.conf
    platform_allow:
      - nrf52840dk/nrf52840
      - nrf52dk/nrf52832
      - nrf51dk/nrf51822
    integration_platforms:
      - nrf52840dk/nrf52840
      - nrf51dk/nrf51822
  bluetooth.init.test_h5:
    extra_args:
      - CONF_FILE=prj_h5.conf
      - DTC_OVERLAY_FILE=h5.overlay
    platform_allow: qemu_cortex_m3
  bluetooth.init.test_h5_dbg:
    extra_args:
      - CONF_FILE=prj_h5_dbg.conf
      - DTC_OVERLAY_FILE=h5.overlay
    platform_allow: qemu_cortex_m3
  bluetooth.init.test_llcp:
    extra_args: CONF_FILE=prj_llcp.conf
    platform_allow:
      - nrf52840dk/nrf52840
      - nrf52dk/nrf52832
      - rv32m1_vega/openisa_rv32m1/ri5cy
    integration_platforms:
      - nrf52840dk/nrf52840
      - rv32m1_vega/openisa_rv32m1/ri5cy
  bluetooth.init.test_config_bt_recv_workq_bt:
    extra_args:
      - CONF_FILE=prj_ctlr.conf
      - CONFIG_BT_RECV_WORKQ_BT=y
    platform_allow:
      - nrf52840dk/nrf52840
  bluetooth.init.test_host_6_x:
    extra_args: CONF_FILE=prj_host_6_x.conf
    platform_allow:
      - qemu_cortex_m3
      - nrf52840dk/nrf52840
    integration_platforms:
      - nrf52840dk/nrf52840
```

## tests/bluetooth/ll_settings/testcase.yaml
```yaml
tests:
  bluetooth.ll_settings:
    platform_allow: nrf52_bsim/nrf52833
    tags: bluetooth
```

## tests/bluetooth/mesh/basic/testcase.yaml
```yaml
tests:
  bluetooth.mesh.main:
    build_only: true
    platform_allow:
      - qemu_x86
      - nrf52840dk/nrf52840
    integration_platforms:
      - qemu_x86
    tags:
      - bluetooth
      - mesh
  bluetooth.mesh.dbg:
    build_only: true
    extra_args: CONF_FILE=dbg.conf
    platform_allow:
      - qemu_x86
      - nrf52840dk/nrf52840
    integration_platforms:
      - qemu_x86
    tags:
      - bluetooth
      - mesh
  bluetooth.mesh.friend:
    build_only: true
    extra_args: CONF_FILE=friend.conf
    platform_allow:
      - qemu_x86
      - nrf52840dk/nrf52840
    integration_platforms:
      - qemu_x86
    tags:
      - bluetooth
      - mesh
  bluetooth.mesh.gatt:
    build_only: true
    extra_args: CONF_FILE=gatt.conf
    platform_allow:
      - qemu_x86
      - nrf52840dk/nrf52840
      - nrf5340dk/nrf5340/cpuapp/ns
    integration_platforms:
      - qemu_x86
    tags:
      - bluetooth
      - mesh
  bluetooth.mesh.gatt.psa:
    build_only: true
    extra_args: CONF_FILE=gatt.conf
    extra_configs:
      - CONFIG_BT_USE_PSA_API=y
    platform_allow:
      - qemu_x86
      - nrf5340dk/nrf5340/cpuapp/ns
    integration_platforms:
      - qemu_x86
    tags:
      - bluetooth
      - mesh
  bluetooth.mesh.lpn:
    build_only: true
    extra_args: CONF_FILE=lpn.conf
    platform_allow:
      - qemu_x86
      - nrf52840dk/nrf52840
    integration_platforms:
      - qemu_x86
    tags:
      - bluetooth
      - mesh
  bluetooth.mesh.pb_gatt:
    build_only: true
    extra_args: CONF_FILE=pb_gatt.conf
    platform_allow:
      - qemu_x86
      - nrf52840dk/nrf52840
    integration_platforms:
      - qemu_x86
    tags:
      - bluetooth
      - mesh
  bluetooth.mesh.proxy:
    build_only: true
    extra_args: CONF_FILE=proxy.conf
    platform_allow:
      - qemu_x86
      - nrf52840dk/nrf52840
    integration_platforms:
      - qemu_x86
    tags:
      - bluetooth
      - mesh
  bluetooth.mesh.multi_ext_adv:
    build_only: true
    extra_args: CONF_FILE=multi_ext_adv.conf
    platform_allow:
      - qemu_x86
      - nrf52840dk/nrf52840
    integration_platforms:
      - qemu_x86
    tags:
      - bluetooth
      - mesh
```

## tests/bluetooth/mesh/blob_io_flash/testcase.yaml
```yaml
tests:
  bluetooth.mesh.blob_io_flash:
    extra_args:
      - EXTRA_DTC_OVERLAY_FILE="test.overlay"
    platform_allow:
      - native_sim
    tags:
      - bluetooth
      - mesh
    integration_platforms:
      - native_sim
```

## tests/bluetooth/mesh/brg/testcase.yaml
```yaml
tests:
  bluetooth.mesh.brg:
    platform_allow:
      - native_sim
    tags:
      - bluetooth
      - mesh
    integration_platforms:
      - native_sim
```

## tests/bluetooth/mesh/delayable_msg/testcase.yaml
```yaml
tests:
  bluetooth.mesh.delayable_msg:
    platform_allow:
      - native_sim
    tags:
      - bluetooth
      - mesh
    integration_platforms:
      - native_sim
```

## tests/bluetooth/mesh/net/testcase.yaml
```yaml
tests:
  bluetooth.mesh.net:
    platform_allow:
      - native_sim
    tags:
      - bluetooth
      - mesh
    integration_platforms:
      - native_sim
```

## tests/bluetooth/mesh/rpl/testcase.yaml
```yaml
tests:
  bluetooth.mesh.rpl:
    platform_allow:
      - native_posix
      - native_sim
    tags:
      - bluetooth
      - mesh
    integration_platforms:
      - native_sim
```
