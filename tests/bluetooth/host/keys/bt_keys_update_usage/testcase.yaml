## tests/bluetooth/mesh/testcase.yaml
```yaml
tests:
  bluetooth.mesh.main:
    build_only: true
    platform_allow: qemu_x86 nrf51dk_nrf51422 nrf52840dk_nrf52840
    tags: bluetooth mesh
  bluetooth.mesh.dbg:
    build_only: true
    extra_args: CONF_FILE=dbg.conf
    platform_allow: qemu_x86 nrf51dk_nrf51422 nrf52840dk_nrf52840
    tags: bluetooth mesh
  bluetooth.mesh.friend:
    build_only: true
    extra_args: CONF_FILE=friend.conf
    platform_allow: qemu_x86 nrf51dk_nrf51422 nrf52840dk_nrf52840
    tags: bluetooth mesh
  bluetooth.mesh.gatt:
    build_only: true
    extra_args: CONF_FILE=gatt.conf
    platform_allow: qemu_x86 nrf51dk_nrf51422 nrf52840dk_nrf52840
    tags: bluetooth mesh
  bluetooth.mesh.lpn:
    build_only: true
    extra_args: CONF_FILE=lpn.conf
    platform_allow: qemu_x86 nrf51dk_nrf51422 nrf52840dk_nrf52840
    tags: bluetooth mesh
  bluetooth.mesh.main.microbit:
    build_only: true
    extra_args: CONF_FILE=microbit.conf
    platform_allow: bbc_microbit
    tags: bluetooth mesh
  bluetooth.mesh.pb_gatt:
    build_only: true
    extra_args: CONF_FILE=pb_gatt.conf
    platform_allow: qemu_x86 nrf51dk_nrf51422 nrf52840dk_nrf52840
    tags: bluetooth mesh
  bluetooth.mesh.proxy:
    build_only: true
    extra_args: CONF_FILE=proxy.conf
    platform_allow: qemu_x86 nrf51dk_nrf51422 nrf52840dk_nrf52840
    tags: bluetooth mesh
  bluetooth.mesh.ext_adv:
    build_only: true
    extra_args: CONF_FILE=ext_adv.conf
    platform_allow: qemu_x86 nrf51dk_nrf51422 nrf52840dk_nrf52840
    tags: bluetooth mesh
```

## tests/bluetooth/mesh_shell/boards/qemu_x86.conf
```kconfig
# nrf_security only supports Cortex-M via PSA crypto libraries.
# Enforcing usage of built-in Mbed TLS for native simulator.
CONFIG_NRF_SECURITY=n
CONFIG_MBEDTLS_ENABLE_HEAP=n
CONFIG_TRUSTED_STORAGE=n
CONFIG_SECURE_STORAGE=y
```

## tests/bluetooth/shell/boards/mimxrt1170_evk_mimxrt1176_cm7_B.conf
```kconfig
#select NXP NW612 Chipset
CONFIG_BT_NXP_NW612=y
#Enable entropy generator
CONFIG_ENTROPY_GENERATOR=y

CONFIG_BT_HFP_HF_CODEC_NEG=y
CONFIG_BT_HFP_AG_CODEC_NEG=y

CONFIG_BT_HFP_HF_ECNR=y
CONFIG_BT_HFP_AG_ECNR=y

CONFIG_BT_HFP_HF_3WAY_CALL=y
CONFIG_BT_HFP_AG_3WAY_CALL=y

CONFIG_BT_HFP_HF_VOICE_RECG_TEXT=y
CONFIG_BT_HFP_AG_VOICE_RECG_TEXT=y

CONFIG_BT_HFP_AG_VOICE_TAG=y

CONFIG_BT_HFP_HF_HF_INDICATOR_ENH_SAFETY=y
CONFIG_BT_HFP_HF_HF_INDICATOR_BATTERY=y

CONFIG_BT_HFP_AG_HF_INDICATOR_ENH_SAFETY=y
CONFIG_BT_HFP_AG_HF_INDICATOR_BATTERY=y

CONFIG_BT_SETTINGS=n
CONFIG_FLASH=n
CONFIG_FLASH_MAP=n
CONFIG_NVS=n
CONFIG_SETTINGS=n
```

## tests/bluetooth/shell/boards/native_posix.conf
```kconfig
CONFIG_NO_OPTIMIZATIONS=y
# Allows for copying larger amount of data into the shell
CONFIG_SHELL_BACKEND_SERIAL_RX_RING_BUFFER_SIZE=4096

# For native posix k_sleep is used in the data path as well as for shell input
# detection, hence data processing is at least two ticks per packet. To support
# 5ms ISO interval bidirectional data the system shall never stall for more
# than 1.5 ms in average.
CONFIG_SYS_CLOCK_TICKS_PER_SEC=500

# For LC3 the following configs are needed
CONFIG_FPU=y
CONFIG_LIBLC3=y
# The LC3 codec uses a large amount of stack. This app runs the codec in the work-queue, hence
# inctease stack size for that thread.
CONFIG_SYSTEM_WORKQUEUE_STACK_SIZE=4096
```

## tests/bluetooth/shell/boards/nrf5340_audio_dk_nrf5340_cpuapp.conf
```kconfig
# For LC3 the following configs are needed
CONFIG_FPU=y
CONFIG_LIBLC3=y

# For USB audio the following configs are needed
CONFIG_RING_BUFFER=y
CONFIG_USB_DEVICE_STACK_NEXT=y
CONFIG_USBD_AUDIO2_CLASS=y
```
