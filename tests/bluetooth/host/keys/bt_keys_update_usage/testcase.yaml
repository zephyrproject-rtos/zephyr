## tests/bluetooth/test_bluetooth/testcase.yaml
```yaml
tests:
-   test:
        arch_whitelist: x86 arm
        platform_whitelist: minnowboard arduino_101
            frdm_k64f
        tags: bluetooth
```

## tests/bluetooth/tester/Kconfig
```kconfig
# Config options for tester app

# Copyright (c) 2023 Codecoup
# SPDX-License-Identifier: Apache-2.0

menu "Bttester configuration"

module = BTTESTER
module-str = bttester
source "subsys/logging/Kconfig.template.log_config"

config BTTESTER_BTP_CMD_THREAD_STACK_SIZE
	int "BTP CMD threads stack size."
	default 2048
	help
	  Stack size in byte used by the BTP CMD thread.

config BTTESTER_L2CAP_DATA_POOL_COUNT
	int "L2CAP Service data pool count"
	depends on BT_CLASSIC
	depends on BT_L2CAP_RET_FC
	default BT_L2CAP_MAX_WINDOW_SIZE
	range BT_L2CAP_MAX_WINDOW_SIZE 255
	help
	  Data pool count of L2CAP service.

endmenu

source "Kconfig.zephyr"
```

## tests/bluetooth/tester/Kconfig.sysbuild
```kconfig
# Copyright 2023-2024 Nordic Semiconductor ASA
# SPDX-License-Identifier: Apache-2.0

source "share/sysbuild/Kconfig"

config NET_CORE_BOARD
	string
	default "nrf54h20dk/nrf54h20/cpurad" if "$(BOARD)" = "nrf54h20dk"
	default "nrf5340dk/nrf5340/cpunet" if "$(BOARD)" = "nrf5340dk"
	default "nrf5340_audio_dk/nrf5340/cpunet" if "$(BOARD)" = "nrf5340_audio_dk"
	default "nrf5340bsim/nrf5340/cpunet" if $(BOARD_TARGET_STRING) = "NRF5340BSIM_NRF5340_CPUAPP"

config NET_CORE_IMAGE_HCI_IPC
	bool "HCI IPC image on network core"
	default y
	depends on NET_CORE_BOARD != ""
```

## tests/bluetooth/tester/boards/cyw920829m2evk_02.conf
```kconfig
CONFIG_INIT_STACKS=y
CONFIG_PRINTK=n
CONFIG_LOG=n
CONFIG_BT_HCI_CORE_LOG_LEVEL_DBG=y
CONFIG_BT_CONN_LOG_LEVEL_DBG=y
CONFIG_BT_L2CAP_LOG_LEVEL_DBG=y
CONFIG_BT_SMP_LOG_LEVEL_DBG=y
CONFIG_BT_ATT_LOG_LEVEL_DBG=y
CONFIG_BT_GATT_LOG_LEVEL_DBG=y

CONFIG_LOG_PROCESS_THREAD_STACK_SIZE=1024
CONFIG_UART_INTERRUPT_DRIVEN=y
```

## tests/bluetooth/tester/boards/frdm_rw612.conf
```kconfig
CONFIG_BT_MAX_CONN=16

# debug options
# CONFIG_UART_CONSOLE=y
# CONFIG_LOG=y
# CONFIG_LOG_DEFAULT_LEVEL=4
```

## tests/bluetooth/tester/boards/mimxrt1170_evk_mimxrt1176_cm7_B.conf
```kconfig
#select NXP NW612 Chipset
CONFIG_BT_NXP_NW612=y
#Enable BT Classic
CONFIG_BT_CLASSIC=y

#Enable BT L2CAP Connectionless data channel
# L2CAP/CLS/CLR/BV-01-C
#
# L2CAP/CLS/UCD/BV-01-C
# L2CAP/CLS/CID/BV-01-C
# L2CAP/CLS/UCD/BV-02-C
# L2CAP/CLS/UCD/BV-03-C
CONFIG_BT_L2CAP_CLS=y

# L2CAP/COS/CED/BV-10-C
# CONFIG_BT_L2CAP_MAX_WINDOW_SIZE=6
# L2CAP/COS/FLC/BV-01-C
CONFIG_BT_L2CAP_MAX_WINDOW_SIZE=4
# others
# CONFIG_BT_L2CAP_MAX_WINDOW_SIZE=3

# Retransmission
# L2CAP/COS/CFD/BV-10-C
# L2CAP/COS/RTX/BV-01-C
# L2CAP/COS/RTX/BV-02-C
# L2CAP/COS/RTX/BV-03-C

CONFIG_BT_L2CAP_RET=n

# Flow Control
# L2CAP/COS/CED/BV-10-C
# L2CAP/COS/FLC/BV-01-C
# L2CAP/COS/FLC/BV-02-C
# L2CAP/COS/FLC/BV-03-C
# L2CAP/COS/FLC/BV-04-C
# L2CAP/COS/CFD/BV-13-C
CONFIG_BT_L2CAP_FC=n

# Enhanced Retransmission Mode
# L2CAP/EXF/BV-01-C
# L2CAP/CMC/BV-01-C
# L2CAP/CMC/BV-02-C
# L2CAP/ERM/BV-01-C
# L2CAP/ERM/BV-02-C
# L2CAP/ERM/BV-03-C
# L2CAP/ERM/BV-08-C
# L2CAP/ERM/BV-09-C
# L2CAP/ERM/BV-10-C
# L2CAP/ERM/BV-11-C
# L2CAP/ERM/BV-12-C
# L2CAP/ERM/BV-18-C
# L2CAP/ERM/BV-19-C
# L2CAP/ERM/BV-20-C
#
# L2CAP/EXF/BV-03-C
# L2CAP/FOC/BV-01-C
# L2CAP/FOC/BV-02-C
# L2CAP/FOC/BV-03-C
#
# L2CAP/OFS/BV-01-C
# L2CAP/OFS/BV-02-C
# L2CAP/OFS/BV-05-C
# L2CAP/OFS/BV-06-C
#
# L2CAP/ERM/BV-07-C
# L2CAP/ERM/BV-22-C
#
# L2CAP/ERM/BV-16-C
# L2CAP/ERM/BI-01-C
#
# L2CAP/CMC/BI-01-C
# L2CAP/CMC/BI-02-C
# L2CAP/CMC/BV-12-C
#
# L2CAP/CMC/BV-03-C
# L2CAP/CMC/BV-07-C
# L2CAP/CMC/BV-10-C
#
# L2CAP/ERM/BV-23-C
#
# L2CAP/CMC/BV-09-C
# L2CAP/CMC/BI-05-C
# L2CAP/CMC/BI-06-C
#
# L2CAP/CMC/BV-14-C
# L2CAP/CMC/BV-15-C
#
# L2CAP/ERM/BV-05-C
# L2CAP/ERM/BV-06-C
# L2CAP/ERM/BV-13-C
# L2CAP/ERM/BI-03-C
# L2CAP/ERM/BI-04-C
# L2CAP/ERM/BI-05-C
#
# L2CAP/ERM/BV-14-C
# L2CAP/ERM/BV-15-C
#
# L2CAP/LSC/BV-01-C
# L2CAP/LSC/BV-03-C
# L2CAP/LSC/BI-04-C
#
# L2CAP/ECF/BV-01-C
# L2CAP/ECF/BV-02-C
# L2CAP/ECF/BV-03-C
# L2CAP/ECF/BV-04-C
# L2CAP/ECF/BV-05-C
# L2CAP/ECF/BV-06-C
# L2CAP/ECF/BV-07-C
# L2CAP/ECF/BV-08-C
CONFIG_BT_L2CAP_ENH_RET=y
# L2CAP/EXF/BV-02-C
# L2CAP/CMC/BV-04-C
# L2CAP/CMC/BV-05-C
# L2CAP/STM/BV-01-C
# L2CAP/STM/BV-02-C
#
# L2CAP/OFS/BV-03-C
# L2CAP/OFS/BV-04-C
# L2CAP/OFS/BV-07-C
# L2CAP/OFS/BV-08-C
#
# L2CAP/CMC/BI-03-C
# L2CAP/CMC/BI-04-C
# L2CAP/CMC/BV-13-C
#
# L2CAP/CMC/BV-06-C
# L2CAP/CMC/BV-08-C
# L2CAP/CMC/BV-11-C
#
# L2CAP/STM/BV-03-C
#
# L2CAP/CMC/BV-09-C
# L2CAP/CMC/BI-05-C
# L2CAP/CMC/BI-06-C
#
# L2CAP/CMC/BV-14-C
# L2CAP/CMC/BV-15-C
#
CONFIG_BT_L2CAP_STREAM=y

# L2CAP/EXF/BV-03-C
# L2CAP/FOC/BV-01-C
# L2CAP/FOC/BV-02-C
# L2CAP/FOC/BV-03-C
#
# L2CAP/OFS/BV-01-C
# L2CAP/OFS/BV-02-C
# L2CAP/OFS/BV-05-C
# L2CAP/OFS/BV-06-C
#
# L2CAP/OFS/BV-03-C
# L2CAP/OFS/BV-04-C
# L2CAP/OFS/BV-07-C
# L2CAP/OFS/BV-08-C
CONFIG_BT_L2CAP_FCS=y

# L2CAP/EWC/BV-01-C
# L2CAP/EWC/BV-02-C
# L2CAP/EXF/BV-06-C
# L2CAP/EWC/BV-03-C
CONFIG_BT_L2CAP_EXT_WIN_SIZE=y

# SC Only
# GAP/SEC/SEM/BV-16-C
# GAP/SEC/SEM/BV-17-C
# GAP/SEC/SEM/BV-18-C
# GAP/SEC/SEM/BI-31-C
# GAP/SEC/SEM/BV-54-C
#
# CONFIG_BT_SMP_SC_ONLY=y

#
# GAP/SEC/SEM/BI-14-C
# GAP/SEC/SEM/BI-17-C
# GAP/SEC/SEM/BI-15-C
# GAP/SEC/SEM/BI-18-C
# GAP/SEC/SEM/BI-16-C
# GAP/SEC/SEM/BI-19-C
# GAP/SEC/SEM/BI-04-C
# GAP/SEC/SEM/BI-08-C
# GAP/SEC/SEM/BI-31-C
# CONFIG_BT_SMP_MIN_ENC_KEY_SIZE=16
```

## tests/bluetooth/tester/boards/native_sim.conf
```kconfig
CONFIG_UART_PIPE=n
CONFIG_SERIAL=y
CONFIG_UART_NATIVE_PTY=y
CONFIG_ASAN=y
# Remove optimization otherwise the build will fail when building on 64-bit
# platforms. Reason: TF-PSA-Crypto includes some assembly optimizations in bignum
# module. When building for "native_sim/native" the compiler tries to build
# with 32 bit compatible mode, but assembly function doesn't match and the build
# just fails.
CONFIG_NO_OPTIMIZATIONS=y
```

## tests/bluetooth/tester/boards/nrf5340bsim_nrf5340_cpuapp.conf
```kconfig
# CONFIG_TEST enforces minimal logging, which we don't want
CONFIG_TEST=n

CONFIG_ASSERT=y
CONFIG_THREAD_NAME=y

CONFIG_LOG=y
CONFIG_LOG_BACKEND_SHOW_COLOR=y
CONFIG_LOG_FUNC_NAME_PREFIX_ERR=y
CONFIG_LOG_FUNC_NAME_PREFIX_WRN=y

CONFIG_LOG_DEFAULT_LEVEL=3
CONFIG_BTTESTER_LOG_LEVEL_DBG=y

CONFIG_UART_PIPE=n
CONFIG_UART_INTERRUPT_DRIVEN=y

CONFIG_SERIAL=y

# Increase the number of RX buffers to a high amount to avoid issues with running out of buffers
# Presumably this is due to the speed of BSIM and the "slowness" of the BSIM UART, since all
# events (include ISO data received event) is sent in a blocking manner
CONFIG_BT_ISO_RX_BUF_COUNT=30
```
