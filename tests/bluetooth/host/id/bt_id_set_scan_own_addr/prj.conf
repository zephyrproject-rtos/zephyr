## CMakeLists.txt
```
# SPDX-License-Identifier: Apache-2.0

cmake_minimum_required(VERSION 3.28.0)

project(bt_id_set_scan_own_addr)

# Suppress the format-zero-length error if GNUC is used
if(CMAKE_C_COMPILER_ID MATCHES "GNU")
add_compile_options(-Wno-error=format-zero-length -Wno-format-zero-length)
endif()

find_package(Zephyr COMPONENTS unittest REQUIRED HINTS $ENV{ZEPHYR_BASE})

include_directories(BEFORE
    ${ZEPHYR_BASE}/tests/bluetooth/host/id/mocks
)

add_subdirectory(${ZEPHYR_BASE}/tests/bluetooth/host host_mocks)
add_subdirectory(${ZEPHYR_BASE}/tests/bluetooth/host/id/mocks mocks)

target_link_libraries(testbinary PRIVATE mocks host_mocks)

target_sources(testbinary
    PRIVATE
    src/main.c
    src/test_suite_invalid_inputs.c

    ${ZEPHYR_BASE}/subsys/bluetooth/host/id.c
    ${ZEPHYR_BASE}/subsys/bluetooth/common/addr.c
    ${ZEPHYR_BASE}/subsys/logging/log_minimal.c
    ${ZEPHYR_BASE}/subsys/bluetooth/common/bt_str.c
    ${ZEPHYR_BASE}/subsys/bluetooth/host/uuid.c
    ${ZEPHYR_BASE}/lib/utils/hex.c
    ${ZEPHYR_BASE}/lib/uuid/uuid.c
)
```

## prj.conf
```kconfig
CONFIG_ZTEST=y
CONFIG_BT=y
CONFIG_BT_CENTRAL=y
CONFIG_BT_SMP=y
CONFIG_BT_ID_MAX=4
CONFIG_ASSERT=y
CONFIG_ASSERT_ON_ERRORS=y
```

## src/main.c
```c
/*
 * Copyright (c) 2022 Nordic Semiconductor ASA
 *
 * SPDX-License-Identifier: Apache-2.0
 */

#include "mocks/crypto.h"
#include "mocks/hci_core.h"
#include "mocks/rpa.h"
#include "mocks/adv.h"
#include "mocks/adv_expects.h"
#include "testing_common_defs.h"

#include <zephyr/bluetooth/hci.h>
#include <zephyr/bluetooth/hci_types.h>
#include <zephyr/fff.h>
#include <zephyr/kernel.h>

#include <host/hci_core.h>
#include <host/id.h>

DEFINE_FFF_GLOBALS;

static void fff_reset_rule_before(const struct ztest_unit_test *test, void *fixture)
{
	memset(&bt_dev, 0x00, sizeof(struct bt_dev));

	RPA_FFF_FAKES_LIST(RESET_FAKE);
	CRYPTO_FFF_FAKES_LIST(RESET_FAKE);
	HCI_CORE_FFF_FAKES_LIST(RESET_FAKE);
}

ZTEST_RULE(fff_reset_rule, fff_reset_rule_before, NULL);

ZTEST_SUITE(bt_id_set_scan_own_addr, NULL, NULL, NULL, NULL, NULL);

static int bt_rand_custom_fake(void *buf, size_t len)
{
	__ASSERT_NO_MSG(buf != NULL);
	__ASSERT_NO_MSG(len == sizeof(BT_ADDR->val));

	/* This will make set_random_address() succeeds and returns 0 */
	memcpy(buf, &BT_ADDR->val, len);
	bt_addr_copy(&bt_dev.random_addr, BT_ADDR);

	return 0;
}

/*
 *  Test setting scan own address while 'CONFIG_BT_PRIVACY' isn't enabled.
 *  bt_id_set_private_addr() is called to generate a NRPA and passed to set_random_address().
 *  Address type reference is updated upon success.
 *
 *  Constraints:
 *   - bt_id_set_private_addr() succeeds and returns 0
 *   - 'CONFIG_BT_SCAN_WITH_IDENTITY' isn't enabled
 *   - 'CONFIG_BT_PRIVACY' isn't enabled
 *
 *  Expected behaviour:
 *   - bt_id_set_scan_own_addr() returns 0
 *   - Address type reference is updated
 */
ZTEST(bt_id_set_scan_own_addr, test_set_nrpa_scan_address_no_privacy)
{
	int err;
	uint8_t own_addr_type = BT_ADDR_LE_ANONYMOUS;

	Z_TEST_SKIP_IFDEF(CONFIG_BT_PRIVACY);
	Z_TEST_SKIP_IFDEF(CONFIG_BT_SCAN_WITH_IDENTITY);

	bt_rand_fake.custom_fake = bt_rand_custom_fake;

	err = bt_id_set_scan_own_addr(false, &own_addr_type);

	zassert_ok(err, "Unexpected error code '%d' was returned", err);
	zassert_true(own_addr_type == BT_HCI_OWN_ADDR_RANDOM,
		     "Address type reference was incorrectly set");
}

/*
 *  Test setting scan own address while 'CONFIG_BT_PRIVACY' isn't enabled.
 *  Advertising is ongoing and uses a random device address.
 *
 *  Constraints:
 *   - bt_id_set_private_addr() succeeds and returns 0
 *   - 'CONFIG_BT_SCAN_WITH_IDENTITY' isn't enabled
 *   - 'CONFIG_BT_PRIVACY' isn't enabled
 *
 *  Expected behaviour:
 *   - bt_id_set_scan_own_addr() returns 0
 *   - Address type reference is updated
 */
ZTEST(bt_id_set_scan_own_addr, test_set_nrpa_scan_address_no_privacy_adv_ongoing_random_identity)
{
	int err;
	struct bt_le_ext_adv *adv = &bt_dev.adv;
	uint8_t own_addr_type = BT_ADDR_LE_ANONYMOUS;

	Z_TEST_SKIP_IFDEF(CONFIG_BT_PRIVACY);
	Z_TEST_SKIP_IFDEF(CONFIG_BT_SCAN_WITH_IDENTITY);
	Z_TEST_SKIP_IFNDEF(CONFIG_BT_BROADCASTER);

	bt_rand_fake.custom_fake = bt_rand_custom_fake;
	bt_le_adv_lookup_legacy_fake.return_val = adv;

	bt_addr_le_copy(&bt_dev.id_addr[BT_ID_DEFAULT], BT_STATIC_RANDOM_LE_ADDR_1);

	atomic_set_bit(adv->flags, BT_ADV_ENABLED);

	err = bt_id_set_scan_own_addr(false, &own_addr_type);

	zassert_ok(err, "Unexpected error code '%d' was returned", err);
	zassert_true(own_addr_type == BT_HCI_OWN_ADDR_RANDOM,
		     "Address type reference was incorrectly set");
}

/*
 *  Test setting scan own address while 'CONFIG_BT_PRIVACY' isn't enabled.
 *  Advertising is ongoing and uses a public device address.
 *
 *  Constraints:
 *   - bt_id_set_private_addr() succeeds and returns 0
 *   - 'CONFIG_BT_SCAN_WITH_IDENTITY' isn't enabled
 *   - 'CONFIG_BT_PRIVACY' isn't enabled
 *
 *  Expected behaviour:
 *   - bt_id_set_scan_own_addr() returns 0
 *   - Address type reference is updated
 */
ZTEST(bt_id_set_scan_own_addr, test_set_nrpa_scan_address_no_privacy_adv_ongoing_public_identity)
{
	int err;
	struct bt_le_ext_adv *adv = &bt_dev.adv;
	uint8_t own_addr_type = BT_ADDR_LE_ANONYMOUS;

	Z_TEST_SKIP_IFDEF(CONFIG_BT_PRIVACY);
	Z_TEST_SKIP_IFDEF(CONFIG_BT_SCAN_WITH_IDENTITY);
	Z_TEST_SKIP_IFNDEF(CONFIG_BT_BROADCASTER);

	bt_rand_fake.custom_fake = bt_rand_custom_fake;
	bt_le_adv_lookup_legacy_fake.return_val = adv;

	bt_addr_le_copy(&bt_dev.id_addr[BT_ID_DEFAULT], BT_LE_ADDR);

	atomic_set_bit(adv->flags, BT_ADV_ENABLED);
	atomic_set_bit(adv->flags, BT_ADV_USE_IDENTITY);

	err = bt_id_set_scan_own_addr(false, &own_addr_type);

	zassert_ok(err, "Unexpected error code '%d' was returned", err);
	zassert_true(own_addr_type == BT_HCI_OWN_ADDR_PUBLIC,
		     "Address type reference was incorrectly set");
}

/*
 *  Test setting scan own address while 'CONFIG_BT_PRIVACY' isn't enabled.
 *  If 'CONFIG_BT_SCAN_WITH_IDENTITY' is enabled and the default identity has an RPA address of type
 * 'BT_HCI_OWN_ADDR_RANDOM', set_random_address() is called and address type reference is updated
 * upon success.
 *
 *  Constraints:
 *   - Default identity has an address with the type 'BT_HCI_OWN_ADDR_RANDOM'
 *   - 'CONFIG_BT_PRIVACY' isn't enabled
 *   - 'CONFIG_BT_SCAN_WITH_IDENTITY' is enabled
 *   - set_random_address() succeeds and returns 0
 *
 *  Expected behaviour:
 *   - bt_id_set_scan_own_addr() returns 0
 *   - Address type reference is updated
 */
ZTEST(bt_id_set_scan_own_addr, test_setting_scan_own_rpa_address_no_privacy)
{
	int err;
	uint8_t own_addr_type = BT_ADDR_LE_ANONYMOUS;

	Z_TEST_SKIP_IFDEF(CONFIG_BT_PRIVACY);
	Z_TEST_SKIP_IFNDEF(CONFIG_BT_SCAN_WITH_IDENTITY);

	bt_addr_le_copy_addr(&bt_dev.id_addr[BT_ID_DEFAULT], BT_RPA_ADDR, BT_ADDR_LE_RANDOM);

	/* This will make set_random_address() succeeds and returns 0 */
	bt_addr_copy(&bt_dev.random_addr, BT_RPA_ADDR);

	err = bt_id_set_scan_own_addr(false, &own_addr_type);

	zassert_ok(err, "Unexpected error code '%d' was returned", err);
	zassert_true(own_addr_type == BT_HCI_OWN_ADDR_RANDOM,
		     "Address type reference was incorrectly set");
}

/*
 *  Test setting scan own address while 'CONFIG_BT_PRIVACY' is enabled and privacy features
 *  'BT_LE_FEAT_BIT_PRIVACY' bit isn't set.
 *  bt_id_set_private_addr() is called with 'BT_ID_DEFAULT' as the ID and address type reference is
 *  updated upon success.
 *
 *  Constraints:
 *   - 'CONFIG_BT_PRIVACY' is enabled
 *   - 'BT_LE_FEAT_BIT_PRIVACY' bit isn't set.
 *   - bt_id_set_private_addr() succeeds and returns 0
 *
 *  Expected behaviour:
 *   - bt_id_set_scan_own_addr() returns 0
 *   - Address type reference is updated with the value 'BT_HCI_OWN_ADDR_RANDOM'
 */
ZTEST(bt_id_set_scan_own_addr, test_setting_scan_own_address_privacy_enabled)
{
	int err;
	uint8_t own_addr_type = BT_ADDR_LE_ANONYMOUS;

	Z_TEST_SKIP_IFNDEF(CONFIG_BT_PRIVACY);

	/* This will cause bt_id_set_private_addr() to return 0 (success) */
	atomic_set_bit(bt_dev.flags, BT_DEV_RPA_VALID);

	err = bt_id_set_scan_own_addr(true, &own_addr_type);

	zassert_ok(err, "Unexpected error code '%d' was returned", err);
	zassert_true(own_addr_type == BT_HCI_OWN_ADDR_RANDOM,
		     "Address type reference was incorrectly set");
}

/*
 *  Test setting scan own address while 'CONFIG_BT_PRIVACY' is enabled and privacy features
 *  'BT_LE_FEAT_BIT_PRIVACY' bit is set.
 *  bt_id_set_private_addr() is called with 'BT_ID_DEFAULT' as the ID and address type reference
 *  is updated upon success.
 *
 *  Constraints:
 *   - 'CONFIG_BT_PRIVACY' is enabled
 *   - 'BT_LE_FEAT_BIT_PRIVACY' bit is set.
 *   - bt_id_set_private_addr() succeeds and returns 0
 *
 *  Expected behaviour:
 *   - bt_id_set_scan_own_addr() returns 0
 *   - Address type reference is updated with the value 'BT_HCI_OWN_ADDR_RPA_OR_RANDOM'
 */
ZTEST(bt_id_set_scan_own_addr, test_setting_scan_own_address_privacy_features_set)
{
	int err;
	uint8_t own_addr_type = BT_ADDR_LE_ANONYMOUS;

	Z_TEST_SKIP_IFNDEF(CONFIG_BT_PRIVACY);

	/* This will cause bt_id_set_private_addr() to return 0 (success) */
	atomic_set_bit(bt_dev.flags, BT_DEV_RPA_VALID);

	bt_dev.le.features[(BT_LE_FEAT_BIT_PRIVACY) >> 3] |= BIT((BT_LE_FEAT_BIT_PRIVACY)&7);

	err = bt_id_set_scan_own_addr(true, &own_addr_type);

	zassert_ok(err, "Unexpected error code '%d' was returned", err);
	zassert_true(own_addr_type == BT_HCI_OWN_ADDR_RPA_OR_RANDOM,
		     "Address type reference was incorrectly set");
}
```

## src/test_suite_invalid_inputs.c
```c
/*
 * Copyright (c) 2022 Nordic Semiconductor ASA
 *
 * SPDX-License-Identifier: Apache-2.0
 */

#include "host_mocks/assert.h"
#include "mocks/crypto.h"
#include "mocks/hci_core.h"
#include "mocks/rpa.h"
#include "mocks/rpa_expects.h"
#include "testing_common_defs.h"

#include <zephyr/bluetooth/hci.h>
#include <zephyr/kernel.h>
#include <zephyr/ztest.h>

#include <host/hci_core.h>
#include <host/id.h>

ZTEST_SUITE(bt_id_set_scan_own_addr_invalid_inputs, NULL, NULL, NULL, NULL, NULL);

/*
 *  Test passing NULL value for address type reference
 *
 *  Constraints:
 *   - Address type reference is passed as NULL
 *
 *  Expected behaviour:
 *   - An assertion is raised and execution stops
 */
ZTEST(bt_id_set_scan_own_addr_invalid_inputs, test_null_address_type_reference)
{
	expect_assert();
	bt_id_set_scan_own_addr(false, NULL);
}

/*
 *  Test setting scan own address while 'CONFIG_BT_PRIVACY' isn't enabled.
 *  bt_id_set_private_addr() is called to generate a NRPA, but execution fails
 *  and it returns an error.
 *
 *  Constraints:
 *   - 'CONFIG_BT_PRIVACY' isn't enabled
 *   - 'CONFIG_BT_SCAN_WITH_IDENTITY' isn't enabled
 *   - bt_id_set_private_addr() fails and returns a negative error
 *
 *  Expected behaviour:
 *   - bt_id_set_scan_own_addr() fails and returns the same error code returned by
 *     bt_id_set_private_addr()
 */
ZTEST(bt_id_set_scan_own_addr_invalid_inputs, test_bt_id_set_private_addr_fails_no_privacy)
{
	int err;
	uint8_t own_addr_type = BT_ADDR_LE_ANONYMOUS;

	Z_TEST_SKIP_IFDEF(CONFIG_BT_PRIVACY);
	Z_TEST_SKIP_IFDEF(CONFIG_BT_SCAN_WITH_IDENTITY);

	bt_rand_fake.return_val = -1;

	err = bt_id_set_scan_own_addr(false, &own_addr_type);

	zassert_true(err < 0, "Unexpected error code '%d' was returned", err);
}

/*
 *  Test setting scan own address while 'CONFIG_BT_PRIVACY' isn't enabled.
 *  If 'CONFIG_BT_SCAN_WITH_IDENTITY' is enabled and the default identity has an RPA address of type
 * 'BT_ADDR_LE_RANDOM', set_random_address() is called, but execution fails and a negative error
 *  code is returned.
 *
 *  Constraints:
 *   - Default identity has an address with the type 'BT_ADDR_LE_RANDOM'
 *   - 'CONFIG_BT_PRIVACY' isn't enabled
 *   - 'CONFIG_BT_SCAN_WITH_IDENTITY' is enabled
 *   - set_random_address() fails and returns a negative error
 *
 *  Expected behaviour:
 *   - bt_id_set_scan_own_addr() fails and returns the same error code returned by
 *     set_random_address()
 */
ZTEST(bt_id_set_scan_own_addr_invalid_inputs, test_set_random_address_fails)
{
	int err;
	uint8_t own_addr_type = BT_ADDR_LE_ANONYMOUS;

	Z_TEST_SKIP_IFDEF(CONFIG_BT_PRIVACY);
	Z_TEST_SKIP_IFNDEF(CONFIG_BT_SCAN_WITH_IDENTITY);

	bt_addr_le_copy(&bt_dev.id_addr[BT_ID_DEFAULT], BT_RPA_LE_ADDR);

	/* This will cause set_random_address() to return (-ENOBUFS) */
	bt_hci_cmd_alloc_fake.return_val = NULL;

	err = bt_id_set_scan_own_addr(false, &own_addr_type);

	zassert_true(err == -ENOBUFS, "Unexpected error code '%d' was returned", err);
}

/*
 *  Test setting scan own address while 'CONFIG_BT_PRIVACY' is enabled.
 *  bt_id_set_private_addr() is called with 'BT_ID_DEFAULT' as the ID, but it fails and returns
 *  a negative error code.
 *
 *  Constraints:
 *   - 'CONFIG_BT_PRIVACY' is enabled
 *   - bt_id_set_private_addr() fails and returns a negative error
 *
 *  Expected behaviour:
 *   - bt_id_set_scan_own_addr() fails and returns the same error code returned by
 *     bt_id_set_private_addr()
 */
ZTEST(bt_id_set_scan_own_addr_invalid_inputs, test_bt_id_set_private_addr_fails_privacy_enabled)
{
	int err;
	uint8_t own_addr_type = BT_ADDR_LE_ANONYMOUS;

	Z_TEST_SKIP_IFNDEF(CONFIG_BT_PRIVACY);

	atomic_clear_bit(bt_dev.flags, BT_DEV_RPA_VALID);

	/* This will cause bt_id_set_private_addr() to fail */
	bt_rpa_create_fake.return_val = -1;

	err = bt_id_set_scan_own_addr(true, &own_addr_type);

#if defined(CONFIG_BT_PRIVACY)
	expect_single_call_bt_rpa_create(bt_dev.irk[BT_ID_DEFAULT]);
#endif

	zassert_true(err < 0, "Unexpected error code '%d' was returned", err);
}
```
