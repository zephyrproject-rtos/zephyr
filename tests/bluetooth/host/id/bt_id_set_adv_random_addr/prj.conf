## CMakeLists.txt
```
# SPDX-License-Identifier: Apache-2.0

cmake_minimum_required(VERSION 3.28.0)

project(bt_id_set_adv_random_addr)

# Suppress the format-zero-length error if GNUC is used
if(CMAKE_C_COMPILER_ID MATCHES "GNU")
add_compile_options(-Wno-error=format-zero-length -Wno-format-zero-length)
endif()

find_package(Zephyr COMPONENTS unittest REQUIRED HINTS $ENV{ZEPHYR_BASE})

include_directories(BEFORE
    ${ZEPHYR_BASE}/tests/bluetooth/host/id/mocks
)

add_subdirectory(${ZEPHYR_BASE}/tests/bluetooth/host host_mocks)
add_subdirectory(${ZEPHYR_BASE}/tests/bluetooth/host/id/mocks mocks)

target_link_libraries(testbinary PRIVATE mocks host_mocks)

target_sources(testbinary
    PRIVATE
    src/main.c
    src/test_suite_invalid_cases.c

    ${ZEPHYR_BASE}/subsys/bluetooth/host/id.c
    ${ZEPHYR_BASE}/subsys/bluetooth/common/addr.c
    ${ZEPHYR_BASE}/subsys/logging/log_minimal.c
    ${ZEPHYR_BASE}/subsys/bluetooth/common/bt_str.c
    ${ZEPHYR_BASE}/subsys/bluetooth/host/uuid.c
    ${ZEPHYR_BASE}/lib/utils/hex.c
    ${ZEPHYR_BASE}/lib/uuid/uuid.c
)
```

## prj.conf
```kconfig
CONFIG_ZTEST=y
CONFIG_BT=y
CONFIG_BT_CENTRAL=y
CONFIG_BT_ID_MAX=2
CONFIG_ASSERT=y
CONFIG_ASSERT_LEVEL=2
CONFIG_ASSERT_VERBOSE=y
CONFIG_ASSERT_ON_ERRORS=y
```

## src/main.c
```c
/*
 * Copyright (c) 2022 Nordic Semiconductor ASA
 *
 * SPDX-License-Identifier: Apache-2.0
 */

#include "mocks/hci_core.h"
#include "mocks/hci_core_expects.h"
#include "mocks/net_buf.h"
#include "mocks/net_buf_expects.h"
#include "testing_common_defs.h"

#include <zephyr/bluetooth/hci.h>
#include <zephyr/fff.h>
#include <zephyr/kernel.h>

#include <host/hci_core.h>
#include <host/id.h>

DEFINE_FFF_GLOBALS;

static void fff_reset_rule_before(const struct ztest_unit_test *test, void *fixture)
{
	memset(&bt_dev, 0x00, sizeof(struct bt_dev));

	HCI_CORE_FFF_FAKES_LIST(RESET_FAKE);
}

ZTEST_RULE(fff_reset_rule, fff_reset_rule_before, NULL);

ZTEST_SUITE(bt_id_set_adv_random_addr, NULL, NULL, NULL, NULL, NULL);

/*
 *  Test setting advertising random address while 'CONFIG_BT_EXT_ADV' isn't enabled
 *
 *  Constraints:
 *   - set_random_address() returns 0 (success)
 *   - 'CONFIG_BT_EXT_ADV' isn't enabled
 *
 *  Expected behaviour:
 *   - bt_id_set_adv_random_addr() returns 0 (success)
 */
ZTEST(bt_id_set_adv_random_addr, test_no_ext_adv)
{
	int err;
	struct bt_le_ext_adv adv_param = {0};

	Z_TEST_SKIP_IFDEF(CONFIG_BT_EXT_ADV);

	/* This will make set_random_address() succeeds and returns 0 */
	bt_addr_copy(&bt_dev.random_addr, BT_RPA_ADDR);

	err = bt_id_set_adv_random_addr(&adv_param, BT_RPA_ADDR);

	expect_not_called_bt_hci_cmd_alloc();
	expect_not_called_bt_hci_cmd_send_sync();
	expect_not_called_net_buf_simple_add();

	zassert_ok(err, "Unexpected error code '%d' was returned", err);

	zassert_equal(adv_param.adv_addr.type, BT_ADDR_LE_RANDOM,
		      "Incorrect address type was set");
	zassert_mem_equal(&adv_param.adv_addr.a, BT_RPA_ADDR, sizeof(bt_addr_t),
			  "Incorrect address was set");
}

/*
 *  Test setting advertising random address while 'CONFIG_BT_EXT_ADV' is enabled
 *
 *  Constraints:
 *   - 'CONFIG_BT_EXT_ADV' is enabled
 *   - 'BT_ADV_PARAMS_SET' flag in advertising parameters reference isn't set
 *
 *  Expected behaviour:
 *   - bt_id_set_adv_random_addr() returns 0 (success)
 *   - Random address field in advertising parameters reference is loaded with the address
 *   - 'BT_ADV_RANDOM_ADDR_PENDING' flag is set
 */
ZTEST(bt_id_set_adv_random_addr, test_ext_adv_enabled)
{
	int err;
	struct bt_le_ext_adv adv_param = {0};

	Z_TEST_SKIP_IFNDEF(CONFIG_BT_EXT_ADV);

	atomic_clear_bit(adv_param.flags, BT_ADV_PARAMS_SET);

	err = bt_id_set_adv_random_addr(&adv_param, &BT_RPA_LE_ADDR->a);

	expect_not_called_bt_hci_cmd_alloc();
	expect_not_called_bt_hci_cmd_send_sync();
	expect_not_called_net_buf_simple_add();

	zassert_ok(err, "Unexpected error code '%d' was returned", err);

	zassert_true(atomic_test_bit(adv_param.flags, BT_ADV_RANDOM_ADDR_PENDING),
		     "Flags were not correctly set");

	zassert_mem_equal(&adv_param.adv_addr, BT_RPA_LE_ADDR, sizeof(bt_addr_le_t),
			  "Incorrect address was set");
}

/*
 *  Test setting advertising random address while 'CONFIG_BT_EXT_ADV' is enabled
 *  and 'BT_ADV_PARAMS_SET' flag in advertising parameters reference is set.
 *
 *  Constraints:
 *   - 'CONFIG_BT_EXT_ADV' is enabled
 *   - 'BT_ADV_PARAMS_SET' flag in advertising parameters reference is set
 *   - bt_hci_cmd_alloc() returns a valid buffer pointer
 *   - bt_hci_cmd_send_sync() returns 0 (success)
 *
 *  Expected behaviour:
 *   - bt_id_set_adv_random_addr() returns 0 (success)
 */
ZTEST(bt_id_set_adv_random_addr, test_ext_adv_enabled_hci_set_adv_set_random_addr)
{
	int err;
	struct net_buf net_buff;
	struct bt_hci_cp_le_set_adv_set_random_addr cp;
	struct bt_le_ext_adv adv_param = {0};

	Z_TEST_SKIP_IFNDEF(CONFIG_BT_EXT_ADV);

	atomic_set_bit(adv_param.flags, BT_ADV_PARAMS_SET);

	net_buf_simple_add_fake.return_val = &cp;
	bt_hci_cmd_alloc_fake.return_val = &net_buff;
	bt_hci_cmd_send_sync_fake.return_val = 0;

	err = bt_id_set_adv_random_addr(&adv_param, BT_RPA_ADDR);

	expect_single_call_net_buf_simple_add(&net_buff.b, sizeof(cp));
	expect_single_call_bt_hci_cmd_alloc();
	expect_single_call_bt_hci_cmd_send_sync(BT_HCI_OP_LE_SET_ADV_SET_RANDOM_ADDR);

	zassert_ok(err, "Unexpected error code '%d' was returned", err);
	zassert_equal(cp.handle, adv_param.handle, "Incorrect handle value was set");
	zassert_mem_equal(&cp.bdaddr, BT_RPA_ADDR, sizeof(bt_addr_t),
			  "Incorrect address was set");
	zassert_mem_equal(&adv_param.adv_addr, BT_RPA_LE_ADDR, sizeof(bt_addr_le_t),
			  "Incorrect address was set");
}
```

## src/test_suite_invalid_cases.c
```c
/*
 * Copyright (c) 2022 Nordic Semiconductor ASA
 *
 * SPDX-License-Identifier: Apache-2.0
 */

#include "host_mocks/assert.h"
#include "mocks/hci_core.h"
#include "mocks/net_buf.h"
#include "testing_common_defs.h"

#include <zephyr/bluetooth/hci.h>
#include <zephyr/kernel.h>
#include <zephyr/ztest.h>

#include <host/hci_core.h>
#include <host/id.h>

ZTEST_SUITE(bt_id_set_adv_random_addr_invalid_cases, NULL, NULL, NULL, NULL, NULL);

/*
 *  Test setting advertise random address while passing a NULL value as a reference to
 *  the advertise parameters.
 *
 *  Constraints:
 *   - A NULL value is passed to the function as a reference
 *   - A valid address pointer is used
 *
 *  Expected behaviour:
 *   - An assertion is raised and execution stops
 */
ZTEST(bt_id_set_adv_random_addr_invalid_cases, test_null_adv_params_reference)
{
	expect_assert();
	bt_id_set_adv_random_addr(NULL, BT_RPA_ADDR);
}

/*
 *  Test setting advertise random address while passing a NULL value as an address reference
 *
 *  Constraints:
 *   - A valid value is passed to the function as a reference for advertise parameters
 *   - A NULL address pointer is used
 *
 *  Expected behaviour:
 *   - An assertion is raised and execution stops
 */
ZTEST(bt_id_set_adv_random_addr_invalid_cases, test_null_address_reference)
{
	struct bt_le_ext_adv adv_param = {0};

	expect_assert();
	bt_id_set_adv_random_addr(&adv_param, NULL);
}

/*
 *  Test setting advertise random address while passing a NULL value for the advertise parameters
 *  and the address
 *
 *  Constraints:
 *   - A NULL value is passed to the function as a reference
 *   - A NULL address pointer is used
 *
 *  Expected behaviour:
 *   - An assertion is raised and execution stops
 */
ZTEST(bt_id_set_adv_random_addr_invalid_cases, test_null_arguments)
{
	expect_assert();
	bt_id_set_adv_random_addr(NULL, NULL);
}

/*
 *  Test setting advertising random address while 'CONFIG_BT_EXT_ADV' is enabled
 *  and 'BT_ADV_PARAMS_SET' flag in advertising parameters reference is set.
 *  bt_hci_cmd_alloc() fails to allocate buffers and returns NULL.
 *
 *  Constraints:
 *   - 'CONFIG_BT_EXT_ADV' is enabled
 *   - 'BT_ADV_PARAMS_SET' flag in advertising parameters reference is set
 *   - bt_hci_cmd_alloc() returns null
 *
 *  Expected behaviour:
 *   - bt_id_set_adv_random_addr() returns a negative error code (failure)
 */
ZTEST(bt_id_set_adv_random_addr_invalid_cases, test_bt_hci_cmd_alloc_returns_null)
{
	int err;
	struct bt_le_ext_adv adv_param = {0};

	Z_TEST_SKIP_IFNDEF(CONFIG_BT_EXT_ADV);

	atomic_set_bit(adv_param.flags, BT_ADV_PARAMS_SET);

	bt_hci_cmd_alloc_fake.return_val = NULL;

	err = bt_id_set_adv_random_addr(&adv_param, BT_RPA_ADDR);

	zassert_true(err < 0, "Unexpected error code '%d' was returned", err);
}

/*
 *  Test setting advertising random address while 'CONFIG_BT_EXT_ADV' is enabled
 *  and 'BT_ADV_PARAMS_SET' flag in advertising parameters reference is set.
 *  bt_hci_cmd_send_sync() fails and returns a negative error code.
 *
 *  Constraints:
 *   - 'CONFIG_BT_EXT_ADV' is enabled
 *   - 'BT_ADV_PARAMS_SET' flag in advertising parameters reference is set
 *   - bt_hci_cmd_alloc() returns a valid buffer pointer
 *   - bt_hci_cmd_send_sync() fails and returns a negative error code.
 *
 *  Expected behaviour:
 *   - bt_id_set_adv_random_addr() returns a negative error code (failure)
 */
ZTEST(bt_id_set_adv_random_addr_invalid_cases, test_bt_hci_cmd_send_sync_fails)
{
	int err;
	struct net_buf net_buff;
	struct bt_hci_cp_le_set_adv_set_random_addr cp;
	struct bt_le_ext_adv adv_param = {0};

	Z_TEST_SKIP_IFNDEF(CONFIG_BT_EXT_ADV);

	atomic_set_bit(adv_param.flags, BT_ADV_PARAMS_SET);

	net_buf_simple_add_fake.return_val = &cp;
	bt_hci_cmd_alloc_fake.return_val = &net_buff;
	bt_hci_cmd_send_sync_fake.return_val = -1;

	err = bt_id_set_adv_random_addr(&adv_param, BT_RPA_ADDR);

	zassert_true(err < 0, "Unexpected error code '%d' was returned", err);
}
```
