## CMakeLists.txt
```
# SPDX-License-Identifier: Apache-2.0

cmake_minimum_required(VERSION 3.28.0)

project(bt_id_delete)

find_package(Zephyr COMPONENTS unittest REQUIRED HINTS $ENV{ZEPHYR_BASE})

include_directories(BEFORE
    ${ZEPHYR_BASE}/tests/bluetooth/host/id/mocks
)

add_subdirectory(${ZEPHYR_BASE}/tests/bluetooth/host host_mocks)
add_subdirectory(${ZEPHYR_BASE}/tests/bluetooth/host/id/mocks mocks)

target_link_libraries(testbinary PRIVATE mocks host_mocks)

target_sources(testbinary
    PRIVATE
    src/main.c
    src/test_suite_bt_settings.c
    src/test_suite_invalid_inputs.c

    ${ZEPHYR_BASE}/subsys/bluetooth/host/id.c
    ${ZEPHYR_BASE}/subsys/bluetooth/common/addr.c
    ${ZEPHYR_BASE}/subsys/logging/log_minimal.c
    ${ZEPHYR_BASE}/subsys/bluetooth/common/bt_str.c
    ${ZEPHYR_BASE}/subsys/bluetooth/host/uuid.c
    ${ZEPHYR_BASE}/lib/utils/hex.c
    ${ZEPHYR_BASE}/lib/uuid/uuid.c
)
```

## prj.conf
```kconfig
CONFIG_ZTEST=y
CONFIG_BT=y
CONFIG_BT_PERIPHERAL=y
CONFIG_BT_SMP=y
CONFIG_BT_ID_MAX=4
CONFIG_ASSERT=y
CONFIG_ASSERT_ON_ERRORS=y
```

## src/main.c
```c
/*
 * Copyright (c) 2022-2026 Nordic Semiconductor ASA
 *
 * SPDX-License-Identifier: Apache-2.0
 */

#include "mocks/adv.h"
#include "mocks/hci_core.h"
#include "mocks/settings.h"
#include "mocks/settings_expects.h"
#include "testing_common_defs.h"
#include <stdint.h>

#include <zephyr/bluetooth/addr.h>
#include <zephyr/bluetooth/bluetooth.h>
#include <zephyr/bluetooth/hci.h>
#include <zephyr/fff.h>
#include <zephyr/kernel.h>
#include <zephyr/sys/atomic.h>
#include <zephyr/sys/util_macro.h>

#include <host/hci_core.h>
#include <host/id.h>

DEFINE_FFF_GLOBALS;

static void fff_reset_rule_before(const struct ztest_unit_test *test, void *fixture)
{
	memset(&bt_dev, 0x00, sizeof(struct bt_dev));

	ADV_FFF_FAKES_LIST(RESET_FAKE);
	SETTINGS_FFF_FAKES_LIST(RESET_FAKE);
	HCI_CORE_FFF_FAKES_LIST(RESET_FAKE);
}

ZTEST_RULE(fff_reset_rule, fff_reset_rule_before, NULL);

ZTEST_SUITE(bt_id_delete, NULL, NULL, NULL, NULL, NULL);

/*
 *  Test deleting an ID, but not the last one
 *
 *  Constraints:
 *   - ID value used is neither corresponds to default index nor the last index
 *
 *  Expected behaviour:
 *   - bt_dev.id_addr[] at index equals to the ID value used is cleared
 *   - bt_dev.irk[] at index equals to the ID value used is cleared (if privacy is enabled)
 *   - bt_id_delete() returns 0
 */
ZTEST(bt_id_delete, test_delete_non_default_no_last_item)
{
	int err;
	uint8_t id;
	int id_count;
#if defined(CONFIG_BT_PRIVACY)
	uint8_t zero_irk[16] = {0};
#endif

	bt_dev.id_count = 3;
	id = 1;
	id_count = bt_dev.id_count;

	bt_addr_le_copy(&bt_dev.id_addr[0], BT_RPA_LE_ADDR);
	bt_addr_le_copy(&bt_dev.id_addr[1], BT_STATIC_RANDOM_LE_ADDR_1);
	bt_addr_le_copy(&bt_dev.id_addr[2], BT_STATIC_RANDOM_LE_ADDR_2);

	atomic_clear_bit(bt_dev.flags, BT_DEV_READY);

	err = bt_id_delete(id);

	expect_not_called_bt_settings_store_id();
	expect_not_called_bt_settings_store_irk();

	zassert_ok(err, "Unexpected error code '%d' was returned", err);
	zassert_true(bt_dev.id_count == id_count, "Incorrect ID count %d was set", bt_dev.id_count);

	zassert_mem_equal(&bt_dev.id_addr[id], BT_ADDR_LE_ANY, sizeof(bt_addr_le_t),
			  "Incorrect address was set");
#if defined(CONFIG_BT_PRIVACY)
	zassert_mem_equal(bt_dev.irk[id], zero_irk, sizeof(zero_irk),
			  "Incorrect IRK value was set");
#endif
}

/*
 *  Test deleting last ID
 *
 *  Constraints:
 *   - ID value used corresponds to the last item in the list bt_dev.id_addr[]
 *
 *  Expected behaviour:
 *   - bt_dev.id_addr[] at index equals to the ID value used is cleared
 *   - bt_dev.irk[] at index equals to the ID value used is cleared (if privacy is enabled)
 *   - bt_dev.id_count is decremented
 *   - bt_id_delete() returns 0
 */
ZTEST(bt_id_delete, test_delete_last_id)
{
	int err;
	uint8_t id;
	int id_count;
#if defined(CONFIG_BT_PRIVACY)
	uint8_t zero_irk[16] = {0};
#endif

	bt_dev.id_count = 2;
	id = bt_dev.id_count - 1;
	id_count = bt_dev.id_count;

	bt_addr_le_copy(&bt_dev.id_addr[0], BT_STATIC_RANDOM_LE_ADDR_1);
	bt_addr_le_copy(&bt_dev.id_addr[1], BT_STATIC_RANDOM_LE_ADDR_2);

	atomic_clear_bit(bt_dev.flags, BT_DEV_READY);

	err = bt_id_delete(id);

	expect_not_called_bt_settings_store_id();
	expect_not_called_bt_settings_store_irk();

	zassert_ok(err, "Unexpected error code '%d' was returned", err);

	zassert_true(bt_dev.id_count == (id_count - 1), "Incorrect ID count %d was set",
		     bt_dev.id_count);

	zassert_mem_equal(&bt_dev.id_addr[id], BT_ADDR_LE_ANY, sizeof(bt_addr_le_t),
			  "Incorrect address was set");
#if defined(CONFIG_BT_PRIVACY)
	zassert_mem_equal(bt_dev.irk[id], zero_irk, sizeof(zero_irk),
			  "Incorrect IRK value was set");
#endif
}

/*
 * Test deleting an ID after creation
 *
 * After creating the initial default (that cannot be deleted), the test will attempt to create and
 * delete more IDs than CONFIG_BT_ID_MAX to ensure that we clean properly up after a delete
 */
static ZTEST(bt_id_delete, test_id_create_after_delete)
{
	int default_id;

	atomic_set_bit(bt_dev.flags, BT_DEV_READY);

	if (CONFIG_BT_ID_MAX < 2) {
		ztest_test_skip();
	}

	default_id = bt_id_create(BT_STATIC_RANDOM_LE_ADDR_1, NULL);
	zassert_true(default_id >= 0, "Unexpected error code '%d' was returned", default_id);

	/* Add and delete several IDs to ensure that we do not run out of spaces for IDs */
	for (int i = 0; i < CONFIG_BT_ID_MAX * 2; i++) {
		bt_addr_le_t addr = *BT_STATIC_RANDOM_LE_ADDR_2;
		int id;
		int err;

		/* Make addresses unique */
		addr.a.val[3] = i;

		id = bt_id_create(&addr, NULL);

		zassert_true(id >= 0, "[%d]: Unexpected error code '%d' was returned", i, id);
		zassert_true(bt_dev.id_count == 2U,
			     "[%d]: Incorrect ID count %d was set (expected (%u))", i,
			     bt_dev.id_count, 2U);
		zassert_mem_equal(&bt_dev.id_addr[id], &addr, sizeof(bt_addr_le_t),
				  "[%d]: Incorrect address was set", i);

		err = bt_id_delete(id);
		zassert_ok(err, "Unexpected error code '%d' was returned", err);
	}
}
```

## src/test_suite_bt_settings.c
```c
/*
 * Copyright (c) 2022 Nordic Semiconductor ASA
 *
 * SPDX-License-Identifier: Apache-2.0
 */

#include <mocks/adv.h>
#include <mocks/hci_core.h>
#include <mocks/settings.h>
#include <mocks/settings_expects.h>
#include <testing_common_defs.h>

#include <zephyr/bluetooth/hci.h>
#include <zephyr/kernel.h>
#include <zephyr/ztest.h>

#include <host/hci_core.h>
#include <host/id.h>

ZTEST_SUITE(bt_id_delete_bt_settings, NULL, NULL, NULL, NULL, NULL);

/*
 *  Test deleting an ID, but not the last one
 *  As 'CONFIG_BT_SETTINGS' is enabled, settings should be saved by calling bt_settings_store_id()
 *  and bt_settings_store_irk() if 'BT_DEV_READY' flag in bt_dev.flags is set
 *
 *  Constraints:
 *   - ID value used is neither corresponds to default index nor the last index
 *   - 'CONFIG_BT_SETTINGS' is enabled
 *   - 'BT_DEV_READY' flag in bt_dev.flags is set
 *
 *  Expected behaviour:
 *   - bt_dev.id_addr[] at index equals to the ID value used is cleared
 *   - bt_dev.irk[] at index equals to the ID value used is cleared (if privacy is enabled)
 *   - bt_settings_store_id() and bt_settings_store_irk() are called to save settings
 *   - bt_dev.id_count is kept unchanged
 *   - bt_id_delete() returns 0
 */
ZTEST(bt_id_delete_bt_settings, test_delete_non_default_no_last_item_settings_enabled)
{
	int err;
	uint8_t id;
	int id_count;
#if defined(CONFIG_BT_PRIVACY)
	uint8_t zero_irk[16] = {0};
#endif

	Z_TEST_SKIP_IFNDEF(CONFIG_BT_SETTINGS);

	bt_dev.id_count = 3;
	id = 1;
	id_count = bt_dev.id_count;

	bt_addr_le_copy(&bt_dev.id_addr[0], BT_RPA_LE_ADDR);
	bt_addr_le_copy(&bt_dev.id_addr[1], BT_STATIC_RANDOM_LE_ADDR_1);
	bt_addr_le_copy(&bt_dev.id_addr[2], BT_STATIC_RANDOM_LE_ADDR_2);

	atomic_set_bit(bt_dev.flags, BT_DEV_READY);

	err = bt_id_delete(id);

	expect_single_call_bt_settings_store_id();
	expect_single_call_bt_settings_store_irk();

	zassert_ok(err, "Unexpected error code '%d' was returned", err);
	zassert_true(bt_dev.id_count == id_count, "Incorrect ID count %d was set", bt_dev.id_count);

	zassert_mem_equal(&bt_dev.id_addr[id], BT_ADDR_LE_ANY, sizeof(bt_addr_le_t),
			  "Incorrect address was set");
#if defined(CONFIG_BT_PRIVACY)
	zassert_mem_equal(bt_dev.irk[id], zero_irk, sizeof(zero_irk),
			  "Incorrect IRK value was set");
#endif
}

/*
 *  Test deleting last ID. As 'CONFIG_BT_SETTINGS' is enabled, settings should
 *  be saved by calling bt_settings_store_id() and bt_settings_store_irk() if
 *  'BT_DEV_READY' flag in bt_dev.flags is set
 *
 *  Constraints:
 *   - ID value used corresponds to the last item in the list bt_dev.id_addr[]
 *   - 'CONFIG_BT_SETTINGS' is enabled
 *   - 'BT_DEV_READY' flag in bt_dev.flags is set
 *
 *  Expected behaviour:
 *   - bt_dev.id_addr[] at index equals to the ID value used is cleared
 *   - bt_dev.irk[] at index equals to the ID value used is cleared (if privacy
 *     is enabled)
 *   - bt_settings_store_id() and bt_settings_store_irk() are called to save settings
 *   - bt_dev.id_count is decremented
 *   - bt_id_delete() returns 0
 */
ZTEST(bt_id_delete_bt_settings, test_delete_last_id_settings_enabled)
{
	int err;
	uint8_t id;
	int id_count;
#if defined(CONFIG_BT_PRIVACY)
	uint8_t zero_irk[16] = {0};
#endif

	Z_TEST_SKIP_IFNDEF(CONFIG_BT_SETTINGS);

	bt_dev.id_count = 2;
	id = bt_dev.id_count - 1;
	id_count = bt_dev.id_count;

	bt_addr_le_copy(&bt_dev.id_addr[0], BT_STATIC_RANDOM_LE_ADDR_1);
	bt_addr_le_copy(&bt_dev.id_addr[1], BT_STATIC_RANDOM_LE_ADDR_2);

	atomic_set_bit(bt_dev.flags, BT_DEV_READY);

	err = bt_id_delete(id);

	expect_single_call_bt_settings_store_id();
	expect_single_call_bt_settings_store_irk();

	zassert_ok(err, "Unexpected error code '%d' was returned", err);
	zassert_true(bt_dev.id_count == (id_count - 1), "Incorrect ID count %d was set",
		     bt_dev.id_count);

	zassert_mem_equal(&bt_dev.id_addr[id], BT_ADDR_LE_ANY, sizeof(bt_addr_le_t),
			  "Incorrect address was set");
#if defined(CONFIG_BT_PRIVACY)
	zassert_mem_equal(bt_dev.irk[id], zero_irk, sizeof(zero_irk),
			  "Incorrect IRK value was set");
#endif
}
```

## src/test_suite_invalid_inputs.c
```c
/*
 * Copyright (c) 2022 Nordic Semiconductor ASA
 *
 * SPDX-License-Identifier: Apache-2.0
 */

#include "mocks/adv.h"
#include "mocks/adv_expects.h"
#include "mocks/hci_core.h"
#include "mocks/hci_core_expects.h"
#include "testing_common_defs.h"

#include <zephyr/bluetooth/hci.h>
#include <zephyr/kernel.h>
#include <zephyr/ztest.h>

#include <host/hci_core.h>
#include <host/id.h>

ZTEST_SUITE(bt_id_delete_invalid_inputs, NULL, NULL, NULL, NULL, NULL);

/*
 *  Test deleting default ID which shouldn't be allowed
 *
 *  Constraints:
 *   - BT_ID_DEFAULT value is used for the ID
 *
 *  Expected behaviour:
 *   - '-EINVAL' error code is returned representing invalid values were used.
 */
ZTEST(bt_id_delete_invalid_inputs, test_deleting_default_id)
{
	int err;

	err = bt_id_delete(BT_ID_DEFAULT);

	zassert_true(err == -EINVAL, "Unexpected error code '%d' was returned", err);
}

/*
 *  Test deleting ID value that is equal to bt_dev.id_count
 *
 *  Constraints:
 *   - bt_dev.id_count is greater than 0
 *   - ID value used is equal to bt_dev.id_count
 *
 *  Expected behaviour:
 *   - '-EINVAL' error code is returned representing invalid values were used.
 */
ZTEST(bt_id_delete_invalid_inputs, test_deleting_id_value_equal_to_dev_id_count)
{
	int err;

	bt_dev.id_count = 1;

	err = bt_id_delete(bt_dev.id_count);

	zassert_true(err == -EINVAL, "Unexpected error code '%d' was returned", err);
}

/*
 *  Test deleting ID that corresponds to a zero-filled item
 *
 *  Constraints:
 *   - bt_dev.id_count is greater than 1
 *   - ID value used corresponds to a zero-filled item
 *
 *  Expected behaviour:
 *   - '-EALREADY' error code is returned representing invalid values were used.
 */
ZTEST(bt_id_delete_invalid_inputs, test_deleting_id_with_zero_filled_item)
{
	int err;

	bt_dev.id_count = 2;
	bt_addr_le_copy(&bt_dev.id_addr[0], BT_STATIC_RANDOM_LE_ADDR_1);
	bt_addr_le_copy(&bt_dev.id_addr[1], BT_ADDR_LE_ANY);

	err = bt_id_delete(1);

	zassert_true(err == -EALREADY, "Unexpected error code '%d' was returned", err);
}

static void bt_le_ext_adv_foreach_custom_fake(void (*func)(struct bt_le_ext_adv *adv, void *data),
					      void *data)
{
	struct bt_le_ext_adv adv_params = {0};

	__ASSERT_NO_MSG(func != NULL);
	__ASSERT_NO_MSG(data != NULL);

	if (IS_ENABLED(CONFIG_BT_EXT_ADV)) {
		/* Only check if the ID is in use, as the advertiser can be
		 * started and stopped without reconfiguring parameters.
		 */
		adv_params.id = bt_dev.id_count - 1;
	} else {
		atomic_set_bit(adv_params.flags, BT_ADV_ENABLED);
		adv_params.id = bt_dev.id_count - 1;
	}

	func(&adv_params, data);
}

/*
 *  Test deleting an ID if the 'CONFIG_BT_BROADCASTER' is enabled and the same ID is already
 *  in use with the advertising data.
 *
 *  Constraints:
 *   - ID value used corresponds to a currently used ID in advertising
 *   - 'CONFIG_BT_BROADCASTER' is enabled
 *
 *  Expected behaviour:
 *   - '-EBUSY' error code is returned representing invalid values were used.
 */
ZTEST(bt_id_delete_invalid_inputs, test_deleting_id_used_in_advertising)
{
	int err;

	Z_TEST_SKIP_IFNDEF(CONFIG_BT_BROADCASTER);

	bt_dev.id_count = 2;
	bt_addr_le_copy(&bt_dev.id_addr[0], BT_STATIC_RANDOM_LE_ADDR_1);
	bt_addr_le_copy(&bt_dev.id_addr[1], BT_STATIC_RANDOM_LE_ADDR_2);

	/* When bt_le_ext_adv_foreach() is called, this callback will be triggered and causes
	 * adv_id_check_func() to set the advertising enable flag to true.
	 */
	bt_le_ext_adv_foreach_fake.custom_fake = bt_le_ext_adv_foreach_custom_fake;

	err = bt_id_delete(bt_dev.id_count - 1);

	expect_single_call_bt_le_ext_adv_foreach();

	zassert_true(err == -EBUSY, "Unexpected error code '%d' was returned", err);
}

/*
 *  Test returning error when bt_unpair() fails
 *
 *  Constraints:
 *   - 'CONFIG_BT_CONN' is enabled
 *   - bt_unpair() fails and returns a negative error code
 *
 *  Expected behaviour:
 *   - '-EALREADY' error code is returned representing invalid values were used.
 */
ZTEST(bt_id_delete_invalid_inputs, test_bt_unpair_fails)
{
	int err;
	uint8_t id;

	Z_TEST_SKIP_IFNDEF(CONFIG_BT_CONN);

	bt_dev.id_count = 2;
	id = bt_dev.id_count - 1;

	bt_addr_le_copy(&bt_dev.id_addr[0], BT_STATIC_RANDOM_LE_ADDR_1);
	bt_addr_le_copy(&bt_dev.id_addr[1], BT_STATIC_RANDOM_LE_ADDR_2);

	bt_unpair_fake.return_val = -1;

	err = bt_id_delete(id);

	expect_single_call_bt_unpair(id, NULL);

	zassert_true(err < 0, "Unexpected error code '%d' was returned", err);
}
```
