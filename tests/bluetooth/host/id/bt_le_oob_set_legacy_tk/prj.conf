## CMakeLists.txt
```
# SPDX-License-Identifier: Apache-2.0

cmake_minimum_required(VERSION 3.20.0)

project(bt_le_oob_set_legacy_tk)

# Suppress the format-zero-length error if GNUC is used
if(CMAKE_C_COMPILER_ID MATCHES "GNU")
add_compile_options(-Wno-error=format-zero-length -Wno-format-zero-length)
endif()

find_package(Zephyr COMPONENTS unittest REQUIRED HINTS $ENV{ZEPHYR_BASE})

include_directories(BEFORE
    ${ZEPHYR_BASE}/tests/bluetooth/host/id/mocks
)

add_subdirectory(${ZEPHYR_BASE}/tests/bluetooth/host host_mocks)
add_subdirectory(${ZEPHYR_BASE}/tests/bluetooth/host/id/mocks mocks)

target_link_libraries(testbinary PRIVATE mocks host_mocks)

target_sources(testbinary
    PRIVATE
    src/main.c
    src/test_suite_invalid_inputs.c

    ${ZEPHYR_BASE}/subsys/bluetooth/host/id.c
    ${ZEPHYR_BASE}/subsys/bluetooth/common/addr.c
    ${ZEPHYR_BASE}/subsys/logging/log_minimal.c
    ${ZEPHYR_BASE}/subsys/bluetooth/common/bt_str.c
    ${ZEPHYR_BASE}/subsys/bluetooth/host/uuid.c
    ${ZEPHYR_BASE}/lib/utils/hex.c
    ${ZEPHYR_BASE}/lib/uuid/uuid.c
)
```

## prj.conf
```kconfig
CONFIG_ZTEST=y
CONFIG_BT=y
CONFIG_BT_CENTRAL=y
CONFIG_BT_EXT_ADV=y
CONFIG_BT_SMP=y
CONFIG_BT_SMP_SC_PAIR_ONLY=n
CONFIG_BT_ID_MAX=4
CONFIG_ASSERT=y
CONFIG_ASSERT_ON_ERRORS=y
```

## src/main.c
```c
/*
 * Copyright (c) 2022 Nordic Semiconductor ASA
 *
 * SPDX-License-Identifier: Apache-2.0
 */

#include <zephyr/bluetooth/hci.h>
#include <zephyr/fff.h>
#include <zephyr/kernel.h>

#include <host/hci_core.h>
#include <host/id.h>
#include <mocks/conn.h>
#include <mocks/smp.h>
#include <mocks/smp_expects.h>

DEFINE_FFF_GLOBALS;

static void fff_reset_rule_before(const struct ztest_unit_test *test, void *fixture)
{
	memset(&bt_devs[0], 0x00, sizeof(struct bt_dev));

	SMP_FFF_FAKES_LIST(RESET_FAKE);
}

ZTEST_RULE(fff_reset_rule, fff_reset_rule_before, NULL);

ZTEST_SUITE(bt_le_oob_set_legacy_tk, NULL, NULL, NULL, NULL, NULL);

/*
 *  Test setting OOB Temporary Key to be used for pairing and verify that input arguments are
 *  passed correctly to bt_smp_le_oob_set_tk().
 *
 *  Constraints:
 *   - Valid references are used for the connection and TK references
 *   - bt_smp_le_oob_set_tk() returns 0 (success)
 *
 *  Expected behaviour:
 *   - bt_le_oob_set_legacy_tk() returns 0 (success)
 */
ZTEST(bt_le_oob_set_legacy_tk, test_passing_arguments_correctly)
{
	int err;
	struct bt_conn conn = {0};
	const uint8_t tk[16] = {0x00, 0x00, 0x00, 0x00, 0x00, 0x00, 0x00, 0x00,
				0x00, 0x00, 0x00, 0x00, 0x00, 0x00, 0x00, 0x00};

	bt_smp_le_oob_set_tk_fake.return_val = 0;

	err = bt_le_oob_set_legacy_tk(&conn, tk);

	expect_single_call_bt_smp_le_oob_set_tk(&conn, tk);

	zassert_ok(err, "Unexpected error code '%d' was returned", err);
}

/*
 *  Test setting OOB Temporary Key to be used for pairing and verify it fails when
 *  bt_smp_le_oob_set_tk() fails.
 *
 *  Constraints:
 *   - Valid references are used for the connection and TK references
 *   - bt_smp_le_oob_set_tk() returns '-EINVAL' (failure)
 *
 *  Expected behaviour:
 *   - bt_le_oob_set_legacy_tk() returns '-EINVAL' (failure)
 */
ZTEST(bt_le_oob_set_legacy_tk, test_bt_smp_le_oob_set_tk_fails)
{
	int err;
	struct bt_conn conn = {0};
	const uint8_t tk[16] = {0x00, 0x00, 0x00, 0x00, 0x00, 0x00, 0x00, 0x00,
				0x00, 0x00, 0x00, 0x00, 0x00, 0x00, 0x00, 0x00};

	bt_smp_le_oob_set_tk_fake.return_val = -EINVAL;

	err = bt_le_oob_set_legacy_tk(&conn, tk);

	expect_single_call_bt_smp_le_oob_set_tk(&conn, tk);

	zassert_true(err == -EINVAL, "Unexpected error code '%d' was returned", err);
}
```

## src/test_suite_invalid_inputs.c
```c
/*
 * Copyright (c) 2022 Nordic Semiconductor ASA
 *
 * SPDX-License-Identifier: Apache-2.0
 */

#include <host_mocks/assert.h>

#include <zephyr/bluetooth/hci.h>
#include <zephyr/kernel.h>
#include <zephyr/ztest.h>

#include <host/hci_core.h>
#include <host/id.h>
#include <mocks/conn.h>

ZTEST_SUITE(bt_le_oob_set_legacy_tk_invalid_inputs, NULL, NULL, NULL, NULL, NULL);

/*
 *  Test passing NULL reference for the connection reference argument
 *
 *  Constraints:
 *   - NULL reference is used for the connection reference
 *   - Valid reference is used for the 'TK' reference
 *
 *  Expected behaviour:
 *   - An assertion is raised and execution stops
 */
ZTEST(bt_le_oob_set_legacy_tk_invalid_inputs, test_null_conn_reference)
{
	const uint8_t tk[16] = {0x00, 0x00, 0x00, 0x00, 0x00, 0x00, 0x00, 0x00,
				0x00, 0x00, 0x00, 0x00, 0x00, 0x00, 0x00, 0x00};

	expect_assert();
	bt_le_oob_set_legacy_tk(NULL, tk);
}

/*
 *  Test passing NULL reference for the 'TK' reference argument
 *
 *  Constraints:
 *   - Valid reference is used for the connection reference
 *   - NULL reference is used as an argument for the 'TK' reference
 *
 *  Expected behaviour:
 *   - An assertion is raised and execution stops
 */
ZTEST(bt_le_oob_set_legacy_tk_invalid_inputs, test_null_tk_reference)
{
	struct bt_conn conn = {0};

	expect_assert();
	bt_le_oob_set_legacy_tk(&conn, NULL);
}
```
