## tests/bluetooth/host/id/bt_id_init/testcase.yaml
```yaml
common:
  tags:
    - bluetooth
    - host
tests:
  bluetooth.host.bt_id_init.default:
    type: unit
  bluetooth.host.bt_id_init.default_bt_settings_enabled:
    type: unit
    extra_configs:
      - CONFIG_SETTINGS=y
      - CONFIG_BT_SETTINGS=y
  bluetooth.host.bt_id_init.bt_privacy_enabled:
    type: unit
    extra_configs:
      - CONFIG_BT_SMP=y
      - CONFIG_BT_PRIVACY=y
```

## tests/bluetooth/host/id/bt_id_read_public_addr/testcase.yaml
```yaml
common:
  tags: bluetooth host
tests:
  bluetooth.host.bt_id_read_public_addr.default:
    type: unit
```

## tests/bluetooth/host/id/bt_id_reset/testcase.yaml
```yaml
common:
  tags: bluetooth host
tests:
  bluetooth.host.bt_id_reset.default:
    type: unit
```

## tests/bluetooth/host/id/bt_id_scan_random_addr_check/testcase.yaml
```yaml
common:
  tags: bluetooth host
tests:
  bluetooth.host.bt_id_scan_random_addr_check.default:
    type: unit
  bluetooth.host.bt_id_scan_random_addr_check.broadcaster_enabled:
    type: unit
    extra_configs:
      - CONFIG_BT_BROADCASTER=y
  bluetooth.host.bt_id_scan_random_addr_check.broadcaster_privacy_enabled:
    type: unit
    extra_configs:
      - CONFIG_BT_SMP=y
      - CONFIG_BT_PRIVACY=y
      - CONFIG_BT_BROADCASTER=y
  bluetooth.host.bt_id_scan_random_addr_check.bt_ext_adv_enabled:
    type: unit
    extra_configs:
      - CONFIG_BT_EXT_ADV=y
```

## tests/bluetooth/host/id/bt_id_set_adv_own_addr/testcase.yaml
```yaml
common:
  tags:
    - bluetooth
    - host
tests:
  bluetooth.host.bt_id_set_adv_own_addr.default:
    type: unit
  bluetooth.host.bt_id_set_adv_own_addr.default_ext_adv_enabled:
    type: unit
    extra_configs:
      - CONFIG_BT_EXT_ADV=y
  bluetooth.host.bt_id_set_adv_own_addr.privacy_enabled:
    type: unit
    extra_configs:
      - CONFIG_BT_SMP=y
      - CONFIG_BT_PRIVACY=y
```

## tests/bluetooth/host/id/bt_id_set_adv_private_addr/testcase.yaml
```yaml
common:
  tags: bluetooth host
tests:
  bluetooth.host.bt_id_set_adv_private_addr.default:
    type: unit
  bluetooth.host.bt_id_set_adv_private_addr.bt_privacy_enabled:
    type: unit
    extra_configs:
      - CONFIG_BT_SMP=y
      - CONFIG_BT_PRIVACY=y
  bluetooth.host.bt_id_set_adv_private_addr.bt_privacy_ext_adv_enabled:
    type: unit
    extra_configs:
      - CONFIG_BT_SMP=y
      - CONFIG_BT_PRIVACY=y
      - CONFIG_BT_EXT_ADV=y
```

## tests/bluetooth/host/id/bt_id_set_adv_random_addr/testcase.yaml
```yaml
common:
  tags:
    - bluetooth
    - host
tests:
  bluetooth.host.bt_id_set_adv_random_addr.default:
    type: unit
  bluetooth.host.bt_id_set_adv_random_addr.bt_ext_adv_enabled:
    type: unit
    extra_configs:
      - CONFIG_BT_EXT_ADV=y
```

## tests/bluetooth/host/id/bt_id_set_create_conn_own_addr/testcase.yaml
```yaml
common:
    tags: test_framework bluetooth host
tests:
  bluetooth.host.bt_id_set_create_conn_own_addr.default:
     type: unit
  bluetooth.host.bt_id_set_create_conn_own_addr.privacy_enabled:
     type: unit
     extra_configs:
      - CONFIG_BT_SMP=y
      - CONFIG_BT_PRIVACY=y
```

## tests/bluetooth/host/id/bt_id_set_private_addr/testcase.yaml
```yaml
common:
  tags:
    - bluetooth
    - host
tests:
  bluetooth.host.bt_id_set_private_addr.default:
    type: unit
  bluetooth.host.bt_id_set_private_addr.bt_privacy_enabled:
    type: unit
    extra_configs:
      - CONFIG_BT_SMP=y
      - CONFIG_BT_PRIVACY=y
```

## tests/bluetooth/host/id/bt_le_ext_adv_oob_get_local/testcase.yaml
```yaml
common:
  tags: bluetooth host
tests:
  bluetooth.host.bt_le_ext_adv_oob_get_local.default:
    type: unit
  bluetooth.host.bt_le_oob_get_local.bt_privacy_enabled:
    type: unit
    extra_configs:
      - CONFIG_BT_SMP=y
      - CONFIG_BT_PRIVACY=y
```

## tests/bluetooth/host/id/bt_le_oob_get_local/testcase.yaml
```yaml
common:
  tags:
    - bluetooth
    - host
tests:
  bluetooth.host.bt_le_oob_get_local.default:
    type: unit
  bluetooth.host.bt_le_oob_get_local.bt_privacy_enabled:
    type: unit
    extra_configs:
      - CONFIG_BT_SMP=y
      - CONFIG_BT_PRIVACY=y
  bluetooth.host.bt_le_oob_get_local.bt_broadcaster_privacy_enabled:
    type: unit
    extra_configs:
      - CONFIG_BT_SMP=y
      - CONFIG_BT_PRIVACY=y
      - CONFIG_BT_BROADCASTER=y
```

## tests/bluetooth/host/id/bt_le_oob_get_sc_data/testcase.yaml
```yaml
common:
  tags:
    - bluetooth
    - host
tests:
  bluetooth.host.bt_le_oob_get_sc_data.default:
    type: unit
    extra_configs:
      - CONFIG_BT_SMP=y
```

## tests/bluetooth/host/id/bt_le_oob_set_legacy_tk/testcase.yaml
```yaml
common:
  tags: bluetooth host
tests:
  bluetooth.host.bt_le_oob_set_legacy_tk.default:
    type: unit
    extra_configs:
      - CONFIG_BT_SMP=y
```

## tests/bluetooth/host/id/bt_le_oob_set_sc_data/testcase.yaml
```yaml
common:
    tags: test_framework bluetooth host
tests:
  bluetooth.host.bt_le_oob_set_sc_data.default:
     type: unit
     extra_configs:
      - CONFIG_BT_SMP=y
```

## tests/bluetooth/host/id/bt_lookup_id_addr/testcase.yaml
```yaml
common:
  tags: bluetooth host
tests:
  bluetooth.host.bt_lookup_id_addr.default:
    type: unit
  bluetooth.host.bt_lookup_id_addr.bt_smp_enabled:
    type: unit
    extra_configs:
      - CONFIG_BT_SMP=y
```

## tests/bluetooth/host/id/bt_setup_public_id_addr/testcase.yaml
```yaml
common:
  tags: bluetooth host
tests:
  bluetooth.host.bt_setup_public_id_addr.default:
    type: unit
  bluetooth.host.bt_setup_public_id_addr.default_bt_settings_enabled:
    type: unit
    extra_configs:
      - CONFIG_SETTINGS=y
      - CONFIG_BT_SETTINGS=y
  bluetooth.host.bt_setup_public_id_addr.bt_privacy_enabled:
    type: unit
    extra_configs:
      - CONFIG_BT_SMP=y
      - CONFIG_BT_PRIVACY=y
  bluetooth.host.bt_setup_public_id_addr.bt_privacy_settings_enabled:
    type: unit
    extra_configs:
      - CONFIG_BT_SMP=y
      - CONFIG_BT_PRIVACY=y
      - CONFIG_SETTINGS=y
      - CONFIG_BT_SETTINGS=y
```

## tests/bluetooth/host/keys/bt_keys_add_type/testcase.yaml
```yaml
common:
  tags: bluetooth host
tests:
  bluetooth.host.bt_keys_add_type.default:
    type: unit
```

## tests/bluetooth/host/keys/bt_keys_find/testcase.yaml
```yaml
common:
  tags: bluetooth host
tests:
  bluetooth.host.bt_keys_find.default:
    type: unit
```

## tests/bluetooth/host/keys/bt_keys_find_addr/testcase.yaml
```yaml
common:
  tags: test_framework bluetooth host
tests:
  bluetooth.host.bt_keys_find_addr.default:
    type: unit
```

## tests/bluetooth/host/keys/bt_keys_find_irk/testcase.yaml
```yaml
common:
  tags: test_framework bluetooth host
tests:
  bluetooth.host.bt_keys_find_irk.default:
    type: unit
```

## tests/bluetooth/host/keys/bt_keys_foreach_bond/testcase.yaml
```yaml
common:
  tags: bluetooth host
tests:
  bluetooth.host.bt_keys_foreach_bond.default:
    type: unit
```

## tests/bluetooth/host/keys/bt_keys_foreach_type/testcase.yaml
```yaml
common:
  tags: bluetooth host
tests:
  bluetooth.host.bt_keys_foreach_type.default:
    type: unit
```

## tests/bluetooth/host/keys/bt_keys_get_addr/testcase.yaml
```yaml
common:
  tags: test_framework bluetooth host
tests:
  bluetooth.host.bt_keys_get_addr.default:
    type: unit
  bluetooth.host.bt_keys_get_addr.keys_overwrite_oldest:
    type: unit
    extra_configs:
      - CONFIG_BT_SMP=y
      - CONFIG_BT_KEYS_OVERWRITE_OLDEST=y
```

## tests/bluetooth/host/keys/bt_keys_get_type/testcase.yaml
```yaml
common:
  tags: bluetooth host
tests:
  bluetooth.host.bt_keys_get_type.default:
    type: unit
```

## tests/bluetooth/host/keys/bt_keys_store/testcase.yaml
```yaml
common:
  tags: bluetooth host
tests:
  bluetooth.host.bt_keys_store.default:
    type: unit
    extra_configs:
      - CONFIG_SETTINGS=y
      - CONFIG_BT_SETTINGS=y
```
