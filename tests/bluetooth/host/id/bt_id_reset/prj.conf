## CMakeLists.txt
```
# SPDX-License-Identifier: Apache-2.0

cmake_minimum_required(VERSION 3.28.0)

project(bt_id_reset)

find_package(Zephyr COMPONENTS unittest REQUIRED HINTS $ENV{ZEPHYR_BASE})

include_directories(BEFORE
    ${ZEPHYR_BASE}/tests/bluetooth/host/id/mocks
)

add_subdirectory(${ZEPHYR_BASE}/tests/bluetooth/host host_mocks)
add_subdirectory(${ZEPHYR_BASE}/tests/bluetooth/host/id/mocks mocks)

target_link_libraries(testbinary PRIVATE mocks host_mocks)

target_sources(testbinary
    PRIVATE
    src/main.c
    src/test_suite_invalid_inputs.c

    ${ZEPHYR_BASE}/subsys/bluetooth/host/id.c
    ${ZEPHYR_BASE}/subsys/bluetooth/common/addr.c
    ${ZEPHYR_BASE}/subsys/logging/log_minimal.c
    ${ZEPHYR_BASE}/subsys/bluetooth/common/bt_str.c
    ${ZEPHYR_BASE}/subsys/bluetooth/host/uuid.c
    ${ZEPHYR_BASE}/lib/utils/hex.c
    ${ZEPHYR_BASE}/lib/uuid/uuid.c
)
```

## prj.conf
```kconfig
CONFIG_ZTEST=y
CONFIG_ZTEST_NEW_API=y
CONFIG_BT=y
CONFIG_BT_PERIPHERAL=y
CONFIG_BT_SMP=y
CONFIG_BT_ID_MAX=4
CONFIG_ASSERT=y
CONFIG_ASSERT_LEVEL=2
CONFIG_ASSERT_VERBOSE=y
CONFIG_ASSERT_ON_ERRORS=y
```

## src/main.c
```c
/*
 * Copyright (c) 2022 Nordic Semiconductor ASA
 *
 * SPDX-License-Identifier: Apache-2.0
 */

#include "mocks/addr.h"
#include "mocks/addr_expects.h"
#include "mocks/adv.h"
#include "mocks/hci_core.h"
#include "testing_common_defs.h"

#include <zephyr/bluetooth/hci.h>
#include <zephyr/fff.h>
#include <zephyr/kernel.h>

#include <host/hci_core.h>
#include <host/id.h>

DEFINE_FFF_GLOBALS;

static void fff_reset_rule_before(const struct ztest_unit_test *test, void *fixture)
{
	memset(&bt_dev, 0x00, sizeof(struct bt_dev));

	ADV_FFF_FAKES_LIST(RESET_FAKE);
	ADDR_FFF_FAKES_LIST(RESET_FAKE);
	HCI_CORE_FFF_FAKES_LIST(RESET_FAKE);
}

ZTEST_RULE(fff_reset_rule, fff_reset_rule_before, NULL);

ZTEST_SUITE(bt_id_reset, NULL, NULL, NULL, NULL, NULL);

static int bt_addr_le_create_static_custom_fake(bt_addr_le_t *addr)
{
	const char *func_name = "bt_addr_le_create_static";

	zassert_not_null(addr, "'%s()' was called with incorrect '%s' value", func_name, "addr");

	/* This is required to test when the generated address already exists in the ID list */
	if (bt_addr_le_create_static_fake.call_count == 1) {
		bt_addr_le_copy(addr, BT_STATIC_RANDOM_LE_ADDR_1);
	} else {
		bt_addr_le_copy(addr, BT_STATIC_RANDOM_LE_ADDR_2);
	}

	return 0;
}

/*
 *  Test resetting an ID while using a NULL value for the address.
 *  As a NULL is passed to bt_id_reset() for the address and 'BT_DEV_READY' is set,
 *  a new random address is generated.
 *
 *  Constraints:
 *   - Input address is NULL
 *   - Input IRK is NULL
 *   - 'BT_DEV_OPEN' and 'BT_DEV_READY' flags are set in bt_dev.flags
 *   - bt_addr_le_create_static() returns a zero error code (success)
 *
 *  Expected behaviour:
 *   - A new identity is created and the address is loaded to bt_dev.id_addr[]
 *   - bt_dev.id_count isn't changed
 */
ZTEST(bt_id_reset, test_reset_id_null_address)
{
	uint8_t input_id;
	int id_count, returned_id;

	bt_dev.id_count = 2;
	input_id = bt_dev.id_count - 1; /* ID must not equal BT_ID_DEFAULT */
	id_count = bt_dev.id_count;
	atomic_set_bit(bt_dev.flags, BT_DEV_OPEN);
	atomic_set_bit(bt_dev.flags, BT_DEV_READY);
	bt_addr_le_create_static_fake.custom_fake = bt_addr_le_create_static_custom_fake;

	returned_id = bt_id_reset(input_id, NULL, NULL);

	expect_call_count_bt_addr_le_create_static(1);

	zassert_true(returned_id >= 0, "Unexpected error code '%d' was returned", returned_id);
	zassert_equal(returned_id, input_id, "Incorrect ID %d was returned", returned_id);
	zassert_true(bt_dev.id_count == id_count, "Incorrect ID count %d was set", bt_dev.id_count);
	zassert_mem_equal(&bt_dev.id_addr[returned_id], BT_STATIC_RANDOM_LE_ADDR_1,
			  sizeof(bt_addr_le_t), "Incorrect address was set");
}

/*
 *  Test resetting an identity and generating a new one while ensuring that the generated address
 *  isn't in the ID list. As a NULL is passed to bt_id_reset() for the address and 'BT_DEV_READY'
 *  is set, a new random address is generated.
 *
 *  Constraints:
 *   - Input address is NULL
 *   - Input IRK is NULL
 *   - 'BT_DEV_OPEN' and 'BT_DEV_READY' flags are set in bt_dev.flags
 *   - bt_addr_le_create_static() returns a zero error code (success)
 *
 *  Expected behaviour:
 *   - A new identity is created and the address is loaded to bt_dev.id_addr[]
 *   - bt_dev.id_count isn't changed
 */
ZTEST(bt_id_reset, test_reset_id_null_address_with_no_duplication)
{
	uint8_t input_id;
	int id_count, returned_id;

	bt_dev.id_count = 2;
	bt_addr_le_copy(&bt_dev.id_addr[0], BT_STATIC_RANDOM_LE_ADDR_1);

	input_id = bt_dev.id_count - 1; /* ID must not equal BT_ID_DEFAULT */
	id_count = bt_dev.id_count;
	atomic_set_bit(bt_dev.flags, BT_DEV_OPEN);
	atomic_set_bit(bt_dev.flags, BT_DEV_READY);
	bt_addr_le_create_static_fake.custom_fake = bt_addr_le_create_static_custom_fake;

	returned_id = bt_id_reset(input_id, NULL, NULL);

	expect_call_count_bt_addr_le_create_static(2);

	zassert_true(returned_id >= 0, "Unexpected error code '%d' was returned", returned_id);
	zassert_equal(returned_id, input_id, "Incorrect ID %d was returned", returned_id);
	zassert_true(bt_dev.id_count == id_count, "Incorrect ID count %d was set", bt_dev.id_count);
	zassert_mem_equal(&bt_dev.id_addr[returned_id], BT_STATIC_RANDOM_LE_ADDR_2,
			  sizeof(bt_addr_le_t), "Incorrect address was set");
}

/*
 *  Test resetting an identity and using BT_ADDR_LE_ANY as an input.
 *  As an initialized address to BT_ADDR_LE_ANY is passed to bt_id_reset() for the address and
 * 'BT_DEV_READY' is set, a new random address is generated.
 *  The generated address should be copied to the address reference passed
 *
 *  Constraints:
 *   - Input address is NULL
 *   - Input IRK is NULL
 *   - 'BT_DEV_OPEN' and 'BT_DEV_READY' flags are set in bt_dev.flags
 *   - bt_addr_le_create_static() returns a zero error code (success)
 *
 *  Expected behaviour:
 *   - A new identity is created and the address is loaded to bt_dev.id_addr[]
 *   - bt_dev.id_count isn't changed
 *   - Generated address is copied to the address reference passed
 */
ZTEST(bt_id_reset, test_reset_id_bt_addr_le_any_address)
{
	uint8_t input_id;
	int id_count, returned_id;
	bt_addr_le_t addr = bt_addr_le_any;

	bt_dev.id_count = 2;
	input_id = bt_dev.id_count - 1; /* ID must not equal BT_ID_DEFAULT */
	id_count = bt_dev.id_count;
	atomic_set_bit(bt_dev.flags, BT_DEV_OPEN);
	atomic_set_bit(bt_dev.flags, BT_DEV_READY);
	bt_addr_le_create_static_fake.custom_fake = bt_addr_le_create_static_custom_fake;

	returned_id = bt_id_reset(input_id, &addr, NULL);

	expect_call_count_bt_addr_le_create_static(1);

	zassert_true(returned_id >= 0, "Unexpected error code '%d' was returned", returned_id);
	zassert_equal(returned_id, input_id, "Incorrect ID %d was returned", returned_id);
	zassert_true(bt_dev.id_count == id_count, "Incorrect ID count %d was set", bt_dev.id_count);
	zassert_mem_equal(&bt_dev.id_addr[returned_id], BT_STATIC_RANDOM_LE_ADDR_1,
			  sizeof(bt_addr_le_t), "Incorrect address was set");
	zassert_mem_equal(&addr, BT_STATIC_RANDOM_LE_ADDR_1, sizeof(bt_addr_le_t),
			  "Incorrect address was set");
}

/*
 *  Test resetting an identity, but bt_addr_le_create_static() returns an error.
 *
 *  Constraints:
 *   - Input address is NULL
 *   - Input IRK is NULL
 *   - 'BT_DEV_OPEN' and 'BT_DEV_READY' flags are set in bt_dev.flags
 *   - bt_addr_le_create_static() returns a non-zero error code (failure)
 *
 *  Expected behaviour:
 *   - No new identity is created
 *   - bt_dev.id_count is kept unchanged
 */
ZTEST(bt_id_reset, test_reset_id_null_address_fails)
{
	uint8_t input_id;
	int id_count, err;

	bt_dev.id_count = 2;
	input_id = bt_dev.id_count - 1; /* ID must not equal BT_ID_DEFAULT */
	id_count = bt_dev.id_count;
	atomic_set_bit(bt_dev.flags, BT_DEV_OPEN);
	atomic_set_bit(bt_dev.flags, BT_DEV_READY);
	bt_addr_le_create_static_fake.return_val = -1;

	err = bt_id_reset(input_id, NULL, NULL);

	expect_call_count_bt_addr_le_create_static(1);

	zassert_true(err == -1, "Unexpected error code '%d' was returned", err);
	zassert_true(bt_dev.id_count == id_count, "Incorrect ID count %d was set", bt_dev.id_count);
}

/*
 *  Test resetting an identity while a valid random static address is passed to bt_id_reset() for
 *  the address and 'BT_DEV_READY' is set.
 *  The same address is used and copied to bt_dev.id_addr[].
 *
 *  Constraints:
 *   - Valid private random address is used
 *   - Input IRK is NULL
 *   - 'BT_DEV_OPEN' and 'BT_DEV_READY' flags are set in bt_dev.flags
 *
 *  Expected behaviour:
 *   - The same address is used and loaded to bt_dev.id_addr[]
 *   - bt_dev.id_count is kept unchanged
 */
ZTEST(bt_id_reset, test_reset_id_valid_input_address)
{
	uint8_t input_id;
	int id_count, returned_id;
	bt_addr_le_t addr = *BT_STATIC_RANDOM_LE_ADDR_1;

	bt_dev.id_count = 2;
	input_id = bt_dev.id_count - 1; /* ID must not equal BT_ID_DEFAULT */
	id_count = bt_dev.id_count;
	atomic_set_bit(bt_dev.flags, BT_DEV_OPEN);
	atomic_set_bit(bt_dev.flags, BT_DEV_READY);
	/* Calling bt_addr_le_create_static() isn't expected */
	bt_addr_le_create_static_fake.return_val = -1;

	returned_id = bt_id_reset(input_id, &addr, NULL);

	expect_not_called_bt_addr_le_create_static();

	zassert_true(returned_id >= 0, "Unexpected error code '%d' was returned", returned_id);
	zassert_equal(returned_id, input_id, "Incorrect ID %d was returned", returned_id);
	zassert_true(bt_dev.id_count == id_count, "Incorrect ID count %d was set", bt_dev.id_count);
	zassert_mem_equal(&bt_dev.id_addr[returned_id], BT_STATIC_RANDOM_LE_ADDR_1,
			  sizeof(bt_addr_le_t), "Incorrect address was set");
}
```

## src/test_suite_invalid_inputs.c
```c
/*
 * Copyright (c) 2022 Nordic Semiconductor ASA
 *
 * SPDX-License-Identifier: Apache-2.0
 */

#include <mocks/adv.h>
#include <mocks/adv_expects.h>
#include <mocks/hci_core.h>
#include <mocks/hci_core_expects.h>
#include <testing_common_defs.h>

#include <zephyr/bluetooth/hci.h>
#include <zephyr/kernel.h>
#include <zephyr/ztest.h>

#include <host/hci_core.h>
#include <host/id.h>

ZTEST_SUITE(bt_id_reset_invalid_inputs, NULL, NULL, NULL, NULL, NULL);

/*
 *  Test resetting default ID which shouldn't be allowed
 *
 *  Constraints:
 *   - BT_ID_DEFAULT value is used for the ID
 *   - Input address is NULL
 *   - Input IRK is NULL
 *
 *  Expected behaviour:
 *   - '-EINVAL' error code is returned representing invalid values were used.
 */
ZTEST(bt_id_reset_invalid_inputs, test_resetting_default_id)
{
	int err;

	err = bt_id_reset(BT_ID_DEFAULT, NULL, NULL);

	zassert_true(err == -EINVAL, "Unexpected error code '%d' was returned", err);
}

/*
 *  Test resetting ID value that is equal to bt_dev.id_count
 *
 *  Constraints:
 *   - bt_dev.id_count is greater than 0
 *   - ID value used is equal to bt_dev.id_count
 *   - Input address is NULL
 *   - Input IRK is NULL
 *
 *  Expected behaviour:
 *   - '-EINVAL' error code is returned representing invalid values were used.
 */
ZTEST(bt_id_reset_invalid_inputs, test_resetting_id_value_equal_to_dev_id_count)
{
	int err;

	bt_dev.id_count = 1;

	err = bt_id_reset(bt_dev.id_count, NULL, NULL);

	zassert_true(err == -EINVAL, "Unexpected error code '%d' was returned", err);
}

/*
 *  Test using a valid IRK pointer value while privacy isn't enabled
 *
 *  Constraints:
 *   - BT_ID_DEFAULT is used for the ID
 *   - Input address is NULL
 *   - Input IRK isn't NULL
 *   - 'CONFIG_BT_PRIVACY' isn't enabled
 *
 *  Expected behaviour:
 *   - '-EINVAL' error code is returned representing invalid values were used.
 */
ZTEST(bt_id_reset_invalid_inputs, test_null_addr_valid_irk_no_privacy_enabled)
{
	int err;
	uint8_t valid_irk_ptr[16];

	err = bt_id_reset(BT_ID_DEFAULT, NULL, valid_irk_ptr);

	zassert_true(err == -EINVAL, "Unexpected error code '%d' was returned", err);
}

/*
 *  Test invalid input arguments to bt_id_reset() by using a valid address of type public and using
 *  NULL value for the IRK.
 *
 *  Constraints:
 *   - BT_ID_DEFAULT is used for the ID
 *   - A valid address of type public is used
 *   - Input IRK is NULL
 *
 *  Expected behaviour:
 *   - '-EINVAL' error code is returned representing invalid values were used.
 */
ZTEST(bt_id_reset_invalid_inputs, test_public_address)
{
	int err;

	err = bt_id_reset(BT_ID_DEFAULT, BT_LE_ADDR, NULL);

	zassert_true(err == -EINVAL, "Unexpected error code '%d' was returned", err);
}

/*
 *  Test invalid input arguments to bt_id_reset() by using a valid address of type RPA and using
 *  NULL value for the IRK.
 *
 *  Constraints:
 *   - BT_ID_DEFAULT is used for the ID
 *   - An RPA address of type random is used
 *   - Input IRK is NULL
 *
 *  Expected behaviour:
 *   - '-EINVAL' error code is returned representing invalid values were used.
 */
ZTEST(bt_id_reset_invalid_inputs, test_rpa_address)
{
	int err;

	err = bt_id_reset(BT_ID_DEFAULT, BT_RPA_LE_ADDR, NULL);

	zassert_true(err == -EINVAL, "Unexpected error code '%d' was returned", err);
}

/*
 *  Test invalid input arguments to bt_id_reset() by using an address that already exists
 *  in the identity list.
 *
 *  Constraints:
 *   - BT_ID_DEFAULT is used for the ID
 *   - A valid random static address is used
 *   - Input address already exists in the identity list
 *   - Input IRK is NULL
 *
 *  Expected behaviour:
 *   - '-EALREADY' error code is returned representing invalid values were used.
 */
ZTEST(bt_id_reset_invalid_inputs, test_pa_address_exists_in_id_list)
{
	int err;

	bt_dev.id_count = 1;
	bt_addr_le_copy(&bt_dev.id_addr[0], BT_STATIC_RANDOM_LE_ADDR_1);

	err = bt_id_reset(BT_ID_DEFAULT, BT_STATIC_RANDOM_LE_ADDR_1, NULL);

	zassert_true(err == -EALREADY, "Unexpected error code '%d' was returned", err);
}

static void bt_le_ext_adv_foreach_custom_fake(void (*func)(struct bt_le_ext_adv *adv, void *data),
					      void *data)
{
	struct bt_le_ext_adv adv_params = {0};

	__ASSERT_NO_MSG(func != NULL);
	__ASSERT_NO_MSG(data != NULL);

	if (IS_ENABLED(CONFIG_BT_EXT_ADV)) {
		/* Only check if the ID is in use, as the advertiser can be
		 * started and stopped without reconfiguring parameters.
		 */
		adv_params.id = bt_dev.id_count - 1;
	} else {
		atomic_set_bit(adv_params.flags, BT_ADV_ENABLED);
		adv_params.id = bt_dev.id_count - 1;
	}

	func(&adv_params, data);
}

/*
 *  Test resetting an ID if the 'CONFIG_BT_BROADCASTER' is enabled and the same ID is already
 *  in use with the advertising data.
 *
 *  Constraints:
 *   - A valid random static address is used
 *   - Input address doesn't exist in the identity list
 *   - Input IRK is NULL
 *   - 'CONFIG_BT_BROADCASTER' is enabled
 *
 *  Expected behaviour:
 *   - '-EBUSY' error code is returned representing invalid values were used.
 */
ZTEST(bt_id_reset_invalid_inputs, test_resetting_id_used_in_advertising)
{
	int err;

	Z_TEST_SKIP_IFNDEF(CONFIG_BT_BROADCASTER);

	bt_dev.id_count = 2;

	/* When bt_le_ext_adv_foreach() is called, this callback will be triggered and causes
	 * adv_id_check_func() to set the advertising enable flag to true.
	 */
	bt_le_ext_adv_foreach_fake.custom_fake = bt_le_ext_adv_foreach_custom_fake;

	err = bt_id_reset(bt_dev.id_count - 1, BT_STATIC_RANDOM_LE_ADDR_1, NULL);

	expect_single_call_bt_le_ext_adv_foreach();

	zassert_true(err == -EBUSY, "Unexpected error code '%d' was returned", err);
}

/*
 *  Test returning error when the ID used corresponds to an empty address and bt_unpair() fails
 *
 *  Constraints:
 *   - A valid random static address is used
 *   - Input address doesn't exist in the identity list
 *   - Input IRK is NULL
 *   - 'CONFIG_BT_CONN' is enabled
 *   - bt_unpair() fails and returns a negative error code
 *
 *  Expected behaviour:
 *   - '-EALREADY' error code is returned representing invalid values were used.
 */
ZTEST(bt_id_reset_invalid_inputs, test_bt_unpair_fails)
{
	int err;
	uint8_t id;

	Z_TEST_SKIP_IFNDEF(CONFIG_BT_CONN);

	bt_dev.id_count = 2;
	id = bt_dev.id_count - 1;

	bt_addr_le_copy(&bt_dev.id_addr[0], BT_STATIC_RANDOM_LE_ADDR_1);
	bt_addr_le_copy(&bt_dev.id_addr[1], BT_STATIC_RANDOM_LE_ADDR_1);

	bt_unpair_fake.return_val = -1;

	err = bt_id_reset(id, BT_STATIC_RANDOM_LE_ADDR_2, NULL);

	expect_single_call_bt_unpair(id, NULL);

	zassert_true(err < 0, "Unexpected error code '%d' was returned", err);
}
```
