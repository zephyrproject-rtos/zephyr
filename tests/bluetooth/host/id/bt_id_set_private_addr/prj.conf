## CMakeLists.txt
```
# SPDX-License-Identifier: Apache-2.0

cmake_minimum_required(VERSION 3.28.0)

project(bt_id_set_private_addr)

find_package(Zephyr COMPONENTS unittest REQUIRED HINTS $ENV{ZEPHYR_BASE})

include_directories(BEFORE
    ${ZEPHYR_BASE}/tests/bluetooth/host/id/mocks
)

add_subdirectory(${ZEPHYR_BASE}/tests/bluetooth/host host_mocks)
add_subdirectory(${ZEPHYR_BASE}/tests/bluetooth/host/id/mocks mocks)

target_link_libraries(testbinary PRIVATE mocks host_mocks)

target_sources(testbinary
    PRIVATE
    src/main.c
    src/test_suite_invalid_cases.c

    ${ZEPHYR_BASE}/subsys/bluetooth/host/id.c
    ${ZEPHYR_BASE}/subsys/bluetooth/common/addr.c
    ${ZEPHYR_BASE}/subsys/logging/log_minimal.c
    ${ZEPHYR_BASE}/subsys/bluetooth/common/bt_str.c
    ${ZEPHYR_BASE}/subsys/bluetooth/host/uuid.c
    ${ZEPHYR_BASE}/lib/utils/hex.c
    ${ZEPHYR_BASE}/lib/uuid/uuid.c
)
```

## prj.conf
```kconfig
CONFIG_ZTEST=y
CONFIG_BT=y
CONFIG_BT_CENTRAL=y
CONFIG_BT_ID_MAX=2
CONFIG_ASSERT=y
CONFIG_ASSERT_ON_ERRORS=y
```

## src/main.c
```c
/*
 * Copyright (c) 2022 Nordic Semiconductor ASA
 *
 * SPDX-License-Identifier: Apache-2.0
 */

#include "mocks/crypto.h"
#include "mocks/crypto_expects.h"
#include "mocks/hci_core.h"
#include "mocks/rpa.h"
#include "mocks/rpa_expects.h"
#include "testing_common_defs.h"

#include <zephyr/bluetooth/hci.h>
#include <zephyr/fff.h>
#include <zephyr/kernel.h>

#include <host/hci_core.h>
#include <host/id.h>

DEFINE_FFF_GLOBALS;

static void fff_reset_rule_before(const struct ztest_unit_test *test, void *fixture)
{
	memset(&bt_dev, 0x00, sizeof(struct bt_dev));
	bt_addr_copy(&bt_dev.random_addr, &bt_addr_none);

	RPA_FFF_FAKES_LIST(RESET_FAKE);
	CRYPTO_FFF_FAKES_LIST(RESET_FAKE);
	HCI_CORE_FFF_FAKES_LIST(RESET_FAKE);
}

ZTEST_RULE(fff_reset_rule, fff_reset_rule_before, NULL);

ZTEST_SUITE(bt_id_set_private_addr, NULL, NULL, NULL, NULL, NULL);

static int bt_rand_custom_fake(void *buf, size_t len)
{
	__ASSERT_NO_MSG(buf != NULL);
	__ASSERT_NO_MSG(len == sizeof(BT_ADDR->val));

	/* This will make set_random_address() succeeds and returns 0 */
	memcpy(buf, &BT_ADDR->val, len);
	bt_addr_copy(&bt_dev.random_addr, BT_ADDR);

	return 0;
}

static int bt_rpa_create_custom_fake(const uint8_t irk[16], bt_addr_t *rpa)
{
	__ASSERT_NO_MSG(irk != NULL);
	__ASSERT_NO_MSG(rpa != NULL);

	/* This will make set_random_address() succeeds and returns 0 */
	bt_addr_copy(rpa, &BT_RPA_LE_ADDR->a);
	bt_addr_copy(&bt_dev.random_addr, BT_RPA_ADDR);

	return 0;
}

/*
 *  Test setting private address with a valid 'id'
 *
 *  Constraints:
 *   - A valid ID value should be used (<= CONFIG_BT_ID_MAX)
 *
 *  Expected behaviour:
 *   - bt_id_set_private_addr() returns 0 (success)
 */
ZTEST(bt_id_set_private_addr, test_setting_address_with_valid_id_succeeds)
{
	int err;
	uint8_t id = BT_ID_DEFAULT;

	if (!IS_ENABLED(CONFIG_BT_PRIVACY)) {
		bt_rand_fake.custom_fake = bt_rand_custom_fake;
	} else {
		bt_rpa_create_fake.custom_fake = bt_rpa_create_custom_fake;
	}

	err = bt_id_set_private_addr(id);

	if (!IS_ENABLED(CONFIG_BT_PRIVACY)) {
		expect_not_called_bt_rpa_create();
	} else {
#if defined(CONFIG_BT_PRIVACY)
		expect_single_call_bt_rpa_create(bt_dev.irk[id]);
#endif
		zassert_true(atomic_test_bit(bt_dev.flags, BT_DEV_RPA_VALID),
			     "Flags were not correctly set");
	}

	zassert_ok(err, "Unexpected error code '%d' was returned", err);
}

/*
 *  Test setting private address with a valid 'id' after it has been set before.
 *
 *  Constraints:
 *   - A valid ID value should be used (<= CONFIG_BT_ID_MAX)
 *   - 'BT_DEV_RPA_VALID' flag in bt_dev.flags is set
 *
 *  Expected behaviour:
 *   - bt_id_set_private_addr() returns 0 (success) without completing the procedure
 */
ZTEST(bt_id_set_private_addr, test_setting_address_do_nothing_when_it_was_previously_set)
{
	int err;
	uint8_t id = BT_ID_DEFAULT;

	Z_TEST_SKIP_IFNDEF(CONFIG_BT_PRIVACY);

	atomic_set_bit(bt_dev.flags, BT_DEV_RPA_VALID);

	err = bt_id_set_private_addr(id);

	expect_not_called_bt_rpa_create();

	zassert_ok(err, "Unexpected error code '%d' was returned", err);
}
```

## src/test_suite_invalid_cases.c
```c
/*
 * Copyright (c) 2022 Nordic Semiconductor ASA
 *
 * SPDX-License-Identifier: Apache-2.0
 */

#include <host_mocks/assert.h>
#include <mocks/crypto.h>
#include <mocks/hci_core.h>
#include <mocks/rpa.h>
#include <testing_common_defs.h>

#include <zephyr/bluetooth/hci.h>
#include <zephyr/kernel.h>
#include <zephyr/ztest.h>

#include <host/hci_core.h>
#include <host/id.h>

ZTEST_SUITE(bt_id_set_private_addr_invalid_cases, NULL, NULL, NULL, NULL, NULL);

/*
 *  Test setting private address with invalid id
 *
 *  Constraints:
 *   - Non-valid 'id' should be used (>= CONFIG_BT_ID_MAX)
 *
 *  Expected behaviour:
 *   - An assertion is raised and execution stops
 */
ZTEST(bt_id_set_private_addr_invalid_cases, test_setting_address_with_invalid_id)
{
	expect_assert();
	bt_id_set_private_addr(0xff);
}

/*
 *  Test setting private address, while CONFIG_BT_PRIVACY isn't enabled, but bt_rand() fails
 *
 *  Constraints:
 *   - Any ID value can be used
 *   - bt_rand() fails and returns a negative error code (failure)
 *   - 'CONFIG_BT_PRIVACY' isn't enabled
 *
 *  Expected behaviour:
 *   - bt_id_set_private_addr() returns a negative error code (failure)
 */
ZTEST(bt_id_set_private_addr_invalid_cases, test_setting_address_bt_rand_fails)
{
	int err;

	Z_TEST_SKIP_IFDEF(CONFIG_BT_PRIVACY);

	bt_rand_fake.return_val = -1;

	err = bt_id_set_private_addr(BT_ID_DEFAULT);

	zassert_true(err < 0, "Unexpected error code '%d' was returned", err);
}

/*
 *  Test setting private address, while CONFIG_BT_PRIVACY is enabled, but bt_rpa_create() fails
 *
 *  Constraints:
 *   - Any ID value can be used
 *   - bt_rpa_create() fails and returns a negative error code (failure)
 *   - 'CONFIG_BT_PRIVACY' is enabled
 *
 *  Expected behaviour:
 *   - bt_id_set_private_addr() returns a negative error code (failure)
 */
ZTEST(bt_id_set_private_addr_invalid_cases, test_setting_address_bt_rpa_create_fails)
{
	int err;

	Z_TEST_SKIP_IFNDEF(CONFIG_BT_PRIVACY);

	bt_rpa_create_fake.return_val = -1;

	err = bt_id_set_private_addr(BT_ID_DEFAULT);

	zassert_true(err < 0, "Unexpected error code '%d' was returned", err);
}

static int bt_rand_custom_fake(void *buf, size_t len)
{
	__ASSERT_NO_MSG(buf != NULL);
	__ASSERT_NO_MSG(len == sizeof(BT_ADDR->val));

	return 0;
}

/*
 *  Test setting private address, but set_random_address() fails
 *
 *  Constraints:
 *   - Any ID value can be used
 *   - bt_rand() returns 0 (success)
 *   - set_random_address() fails and returns a negative error code (failure)
 *
 *  Expected behaviour:
 *   - bt_id_set_private_addr() returns a negative error code (failure)
 */
ZTEST(bt_id_set_private_addr_invalid_cases, test_setting_address_set_random_address_fails)
{
	int err;

	if (!IS_ENABLED(CONFIG_BT_PRIVACY)) {
		bt_rand_fake.custom_fake = bt_rand_custom_fake;
	}

	/* This will make set_random_address() returns a negative number error code */
	bt_hci_cmd_alloc_fake.return_val = NULL;

	err = bt_id_set_private_addr(BT_ID_DEFAULT);

	zassert_true(err < 0, "Unexpected error code '%d' was returned", err);
}
```
