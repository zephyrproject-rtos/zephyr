## CMakeLists.txt
```
# SPDX-License-Identifier: Apache-2.0

cmake_minimum_required(VERSION 3.28.0)
set(NO_QEMU_SERIAL_BT_SERVER 1)

list(APPEND DTS_ROOT ${CMAKE_CURRENT_SOURCE_DIR}/../common/fake_hci)
find_package(Zephyr REQUIRED HINTS $ENV{ZEPHYR_BASE})
project(bluetooth)

target_sources(app PRIVATE src/bluetooth.c)
```

## prj.conf
```kconfig
CONFIG_BT=y
CONFIG_BT_LL_SW_SPLIT=n
CONFIG_BT_H4=n
CONFIG_LOG=y
CONFIG_UART_INTERRUPT_DRIVEN=n
CONFIG_ZTEST=y
CONFIG_MAIN_STACK_SIZE=2048
```

## test.overlay
```dts
/ {
	chosen {
		zephyr,bt-hci = &bt_hci_test;
	};

	bt_hci_test: bt_hci_test {
		compatible = "zephyr,bt-hci-test";
		status = "okay";
	};
};
```

## dts/bindings/zephyr,bt-hci-test.yaml
```yaml
description: Bluetooth HCI for test purposes

compatible: "zephyr,bt-hci-test"

include: bt-hci.yaml

properties:
  bt-hci-name:
    default: "test"
  bt-hci-bus:
    default: "virtual"
```

## src/bluetooth.c
```c
/* bluetooth.c - Bluetooth smoke test */

/*
 * Copyright (c) 2015-2016 Intel Corporation.
 *
 * SPDX-License-Identifier: Apache-2.0
 */

#include <zephyr/kernel.h>

#include <errno.h>
#include <zephyr/tc_util.h>
#include <zephyr/ztest.h>

#include <zephyr/bluetooth/bluetooth.h>
#include <zephyr/drivers/bluetooth.h>

#define DT_DRV_COMPAT zephyr_bt_hci_test

#define EXPECTED_ERROR -ENOSYS

static int driver_open(const struct device *dev)
{
	TC_PRINT("driver: %s\n", __func__);

	/* Indicate that there is no real Bluetooth device */
	return EXPECTED_ERROR;
}

static int driver_send(const struct device *dev, struct net_buf *buf)
{
	return 0;
}

static DEVICE_API(bt_hci, driver_api) = {
	.open = driver_open,
	.send = driver_send,
};

#define TEST_DEVICE_INIT(inst) \
	static struct bt_hci_driver_data driver_data_##inst = { \
	}; \
	static const struct bt_hci_driver_config driver_config_##inst = \
						BT_DT_HCI_DRIVER_CONFIG_INST_GET(inst); \
	DEVICE_DT_INST_DEFINE(inst, NULL, NULL, &driver_data_##inst, &driver_config_##inst, \
			      POST_KERNEL, CONFIG_KERNEL_INIT_PRIORITY_DEVICE, &driver_api)

DT_INST_FOREACH_STATUS_OKAY(TEST_DEVICE_INIT)

ZTEST_SUITE(test_bluetooth, NULL, NULL, NULL, NULL, NULL);

ZTEST(test_bluetooth, test_bluetooth_entry)
{
	zassert_true((bt_enable(NULL) == EXPECTED_ERROR),
			"bt_enable failed");
}
```

## src/preinit.c
```c
/*
 * Copyright (c) 2019 ZhongYao Luo
 *
 * SPDX-License-Identifier: Apache-2.0
 */

#include <zephyr.h>

#include <errno.h>
#include <tc_util.h>
#include <ztest.h>

#include <bluetooth/bluetooth.h>
#include <drivers/bluetooth/hci_driver.h>

#define EXPECTED_ERROR -ENOSYS

static int driver_open(void)
{
	TC_PRINT("driver: %s\n", __func__);

	/* Indicate that there is no real Bluetooth device */
	return 0;
}

static int driver_send(struct net_buf *buf)
{
	return 0;
}

static const struct bt_hci_driver drv = {
	.name         = "test",
	.bus          = BT_HCI_DRIVER_BUS_VIRTUAL,
	.open         = driver_open,
	.send         = driver_send,
};

static void driver_init(void)
{
	bt_hci_driver_register(&drv);
}

static int bluetooth_preinit(void *data)
{
	TC_PRINT("preinit: %s\n", __func__);
	return EXPECTED_ERROR;
}

void test_bluetooth_preinit_entry(void)
{
	driver_init();

	zassert_true((bt_enable(NULL, bluetooth_preinit, NULL) == EXPECTED_ERROR),
			"bt_enable failed");
}

/*test case main entry*/
void test_main(void)
{
	ztest_test_suite(test_bluetooth_preinit,
			ztest_unit_test(test_bluetooth_preinit_entry));
	ztest_run_test_suite(test_bluetooth_preinit);
}
```
