## CMakeLists.txt
```
# SPDX-License-Identifier: Apache-2.0

cmake_minimum_required(VERSION 3.28.0)
find_package(Zephyr REQUIRED HINTS $ENV{ZEPHYR_BASE})
project(bluetooth_gatt)

FILE(GLOB app_sources src/*.c)
target_sources(app PRIVATE ${app_sources})
```

## prj.conf
```kconfig
CONFIG_TEST=y
CONFIG_ZTEST=y

CONFIG_BT=y
CONFIG_BT_LL_SW_SPLIT=n
CONFIG_BT_H4=n

CONFIG_LOG=y
CONFIG_BT_PERIPHERAL=y
CONFIG_BT_SMP=y
CONFIG_BT_L2CAP_DYNAMIC_CHANNEL=y
CONFIG_MAIN_STACK_SIZE=2048
```

## src/main.c
```c
/* main.c - Application main entry point */

/*
 * Copyright (c) 2019 Intel Corporation
 *
 * SPDX-License-Identifier: Apache-2.0
 */

#include <zephyr/kernel.h>
#include <stddef.h>
#include <zephyr/ztest.h>

#include <zephyr/bluetooth/buf.h>
#include <zephyr/bluetooth/bluetooth.h>
#include <zephyr/bluetooth/l2cap.h>

static int l2cap_accept(struct bt_conn *conn, struct bt_l2cap_server *server,
			struct bt_l2cap_chan **chan)
{
	return -ENOSYS;
}

static struct bt_l2cap_server test_server = {
	.accept		= l2cap_accept,
};

static struct bt_l2cap_server test_fixed_server = {
	.accept		= l2cap_accept,
	.psm		= 0x007f,
};

static struct bt_l2cap_server test_dyn_server = {
	.accept		= l2cap_accept,
	.psm		= 0x00ff,
};

static struct bt_l2cap_server test_inv_server = {
	.accept		= l2cap_accept,
	.psm		= 0xffff,
};

static struct bt_l2cap_server test_unreg_server = {
	.accept		= l2cap_accept,
	.psm		= 0x0071,
};

ZTEST_SUITE(test_l2cap, NULL, NULL, NULL, NULL, NULL);

ZTEST(test_l2cap, test_l2cap_register)
{
	/* Attempt to register server with PSM auto allocation */
	zassert_false(bt_l2cap_server_register(&test_server),
		     "Test server registration failed");

	/* Attempt to register server with fixed PSM */
	zassert_false(bt_l2cap_server_register(&test_fixed_server),
		     "Test fixed PSM server registration failed");

	/* Attempt to register server with dynamic PSM */
	zassert_false(bt_l2cap_server_register(&test_dyn_server),
		     "Test dynamic PSM server registration failed");

	/* Attempt to register server with invalid PSM */
	zassert_true(bt_l2cap_server_register(&test_inv_server),
		     "Test invalid PSM server registration succeeded");

	/* Attempt to re-register server with PSM auto allocation */
	zassert_equal(bt_l2cap_server_register(&test_server), -EALREADY,
		      "Test server duplicate succeeded");

	/* Attempt to re-register server with fixed PSM */
	zassert_equal(bt_l2cap_server_register(&test_fixed_server), -EALREADY,
		      "Test fixed PSM server duplicate succeeded");

	/* Attempt to re-register server with dynamic PSM */
	zassert_equal(bt_l2cap_server_register(&test_dyn_server), -EALREADY,
		      "Test dynamic PSM server duplicate succeeded");
}

ZTEST(test_l2cap, test_l2cap_unregister)
{
	/* Attempt to unregister a NULL server */
	zassert_equal(bt_l2cap_server_unregister(NULL), -EINVAL,
		      "Unregistering NULL did not fail with -EINVAL");

	/* Attempt to unregister a server that was never registered */
	zassert_equal(bt_l2cap_server_unregister(&test_unreg_server), -ENOENT,
		      "Unregistering an unknown server did not fail with -ENOENT");

	zassert_ok(bt_l2cap_server_register(&test_unreg_server),
		   "Test unregister server registration failed");

	/* The server cannot be registered twice */
	zassert_equal(bt_l2cap_server_register(&test_unreg_server), -EALREADY,
		      "Test unregister server duplicate succeeded");

	zassert_ok(bt_l2cap_server_unregister(&test_unreg_server),
		   "Test unregister server unregistration failed");

	/* Attempt to unregister the same server twice */
	zassert_equal(bt_l2cap_server_unregister(&test_unreg_server), -ENOENT,
		      "Double unregistration did not fail with -ENOENT");

	/* The PSM is available again */
	zassert_ok(bt_l2cap_server_register(&test_unreg_server),
		   "Test unregister server re-registration failed");
	zassert_ok(bt_l2cap_server_unregister(&test_unreg_server),
		   "Test unregister server unregistration failed");
}
```
