## tests/bluetooth/hci_uart_async/testcase.yaml
```yaml
tests:
  bluetooth.hci_uart_async:
    tags:
      - bluetooth
      - uart
    harness: ztest
    platform_allow:
      - native_posix/native
      - native_sim/native
    integration_platforms:
      - native_sim/native
```

## tests/bluetooth/host/bt_buf_get_rx/testcase.yaml
```yaml
common:
    tags: test_framework bluetooth host
tests:
  bluetooth.host.bt_buf_get_rx.api:
     type: unit
  bluetooth.host.bt_buf_get_rx.hci_acl_flow_control:
     type: unit
     extra_args: COMPILE_PARAM_1=CONFIG_BT_HCI_ACL_FLOW_CONTROL
  bluetooth.host.bt_buf_get_rx.iso_unicast:
     type: unit
     extra_args:
      COMPILE_PARAM_1=CONFIG_BT_ISO_UNICAST=1
      COMPILE_PARAM_2=CONFIG_BT_ISO_RX_BUF_COUNT=1
      COMPILE_PARAM_3=CONFIG_BT_ISO_RX_MTU=251
  bluetooth.host.bt_buf_get_rx.iso_sync_receiver:
     type: unit
     extra_args:
      COMPILE_PARAM_1=CONFIG_BT_ISO_SYNC_RECEIVER=1
      COMPILE_PARAM_2=CONFIG_BT_ISO_RX_BUF_COUNT=1
      COMPILE_PARAM_3=CONFIG_BT_ISO_RX_MTU=251
```

## tests/bluetooth/host/buf/bt_buf_get_evt/testcase.yaml
```yaml
common:
    tags: test_framework bluetooth host
tests:
  bluetooth.host.bt_buf_get_evt.default:
     type: unit
  bluetooth.host.bt_buf_get_evt.hci_acl_flow_control:
     type: unit
     extra_args: COMPILE_SWITCH_PARAM=CONFIG_BT_HCI_ACL_FLOW_CONTROL
  bluetooth.host.bt_buf_get_evt.bt_connect_enabled:
     type: unit
     extra_args: COMPILE_SWITCH_PARAM=BT_CONN_CONFIG_SET
  bluetooth.host.bt_buf_get_evt.bt_iso_enabled:
     type: unit
     extra_args: COMPILE_SWITCH_PARAM=BT_ISO_CONFIG_SET
  bluetooth.host.bt_buf_get_evt.buf_evt_discardable_count:
     type: unit
     extra_args: COMPILE_SWITCH_PARAM=BT_BUF_EVT_DISCARDABLE_COUNT_CONFIG_SET
  bluetooth.host.bt_buf_get_evt.iso_unicast:
     type: unit
     extra_args: COMPILE_SWITCH_PARAM=BT_ISO_UNICAST_CONFIG_SET
  bluetooth.host.bt_buf_get_evt.iso_sync_receiver:
     type: unit
     extra_args: COMPILE_SWITCH_PARAM=BT_ISO_SYNC_RECEIVER_CONFIG_SET
```

## tests/bluetooth/host/buf/bt_buf_get_rx/testcase.yaml
```yaml
common:
    tags: test_framework bluetooth host
tests:
  bluetooth.host.bt_buf_get_rx.default:
     type: unit
  bluetooth.host.bt_buf_get_rx.hci_acl_flow_control:
     type: unit
     extra_configs:
      - CONFIG_BT_CENTRAL=y
      - CONFIG_BT_HCI_ACL_FLOW_CONTROL=y
  bluetooth.host.bt_buf_get_rx.iso_unicast:
     type: unit
     # enable CONFIG_BT_ISO_UNICAST
     extra_configs:
      - CONFIG_BT_ISO_CENTRAL=y
  bluetooth.host.bt_buf_get_rx.iso_sync_receiver:
     type: unit
     extra_configs:
      - CONFIG_BT_ISO_SYNC_RECEIVER=y
```

## tests/bluetooth/host/buf/bt_buf_get_type/testcase.yaml
```yaml
common:
  tags: bluetooth host
tests:
  bluetooth.host.bt_buf_get_type.default:
    type: unit
```

## tests/bluetooth/host/buf_bt_buf_get_cmd_complete/testcase.yaml
```yaml
common:
    tags: test_framework bluetooth host
tests:
  bluetooth.host.bt_buf_get_cmd_complete.api:
     type: unit
```

## tests/bluetooth/host/buf_bt_buf_get_evt/testcase.yaml
```yaml
common:
    tags: test_framework bluetooth host
tests:
  bluetooth.host.bt_buf_get_evt.api:
     type: unit
  bluetooth.host.bt_buf_get_evt.hci_acl_flow_control:
     type: unit
     extra_args: COMPILE_PARAM_1=CONFIG_BT_HCI_ACL_FLOW_CONTROL
```

## tests/bluetooth/host/conn/testcase.yaml
```yaml
common:
  tags:
    - bluetooth
    - host
tests:
  bluetooth.host.conn.test_default:
    type: unit
  bluetooth.host.conn.check_null_before_create:
    type: unit
    extra_configs:
      - CONFIG_BT_CONN_CHECK_NULL_BEFORE_CREATE=y
```

## tests/bluetooth/host/crypto/bt_encrypt_be/testcase.yaml
```yaml
common:
  tags: test_framework bluetooth host
tests:
  bluetooth.host.bt_encrypt_be.default:
    type: unit
```

## tests/bluetooth/host/crypto/bt_encrypt_le/testcase.yaml
```yaml
common:
  tags:
    - bluetooth
    - host
tests:
  bluetooth.host.bt_encrypt_le.default:
    type: unit
```

## tests/bluetooth/host/crypto/bt_rand/testcase.yaml
```yaml
common:
  tags:
    - bluetooth
    - host
tests:
  bluetooth.host.bt_rand.default:
    type: unit
  bluetooth.host.bt_rand.host_crypto_prng_disabled:
    type: unit
    extra_configs:
      - CONFIG_BT_HOST_CRYPTO_PRNG=n
```

## tests/bluetooth/host/crypto/prng_init/testcase.yaml
```yaml
common:
  tags:
    - bluetooth
    - host
tests:
  bluetooth.host.prng_init.default:
    type: unit
```

## tests/bluetooth/host/cs/bt_le_cs_step_data_parse/testcase.yaml
```yaml
common:
  tags:
    - bluetooth
    - host
tests:
  bluetooth.host.cs.bt_le_cs_step_data_parse:
    type: unit
```

## tests/bluetooth/host/data/bt_data_parse/testcase.yaml
```yaml
common:
  tags: bluetooth host
tests:
  bluetooth.host.bt_data_parse:
    type: unit
```

## tests/bluetooth/host/ecc/bt_dh_key_gen/testcase.yaml
```yaml
common:
  tags: test_framework bluetooth host
tests:
  bluetooth.host.bt_dh_key_gen.default:
    type: unit
  bluetooth.host.bt_dh_key_gen.bt_use_debug_keys_enabled:
    type: unit
    extra_configs:
      - CONFIG_BT_SMP=y
      - CONFIG_BT_USE_DEBUG_KEYS=y
```

## tests/bluetooth/host/ecc/bt_pub_key_gen/testcase.yaml
```yaml
common:
  tags: test_framework bluetooth host
tests:
  bluetooth.host.bt_pub_key_gen.default:
    type: unit
  bluetooth.host.bt_pub_key_gen.bt_use_debug_keys_enabled:
    type: unit
    extra_configs:
      - CONFIG_BT_SMP=y
      - CONFIG_BT_USE_DEBUG_KEYS=y
```

## tests/bluetooth/host/ecc/bt_pub_key_is_debug/testcase.yaml
```yaml
common:
  tags: test_framework bluetooth host
tests:
  bluetooth.host.bt_pub_key_is_debug.default:
    type: unit
```

## tests/bluetooth/host/hci_cmd_cb/testcase.yaml
```yaml
common:
  tags:
    - bluetooth
    - host
tests:
  bluetooth.host.hci_cmd_cb.test_default:
    type: unit
```

## tests/bluetooth/host/id/bt_br_oob_get_local/testcase.yaml
```yaml
common:
    tags: test_framework bluetooth host
tests:
  bluetooth.host.bt_br_oob_get_local.default:
     type: unit
```

## tests/bluetooth/host/id/bt_id_adv_random_addr_check/testcase.yaml
```yaml
common:
  tags:
    - bluetooth
    - host
tests:
  bluetooth.host.bt_id_adv_random_addr_check.default:
    type: unit
  bluetooth.host.bt_id_adv_random_addr_check.observer_enabled:
    type: unit
    extra_configs:
      - CONFIG_BT_CENTRAL=y
      - CONFIG_BT_OBSERVER=y
  bluetooth.host.bt_id_adv_random_addr_check.observer_privacy_enabled:
    type: unit
    extra_configs:
      - CONFIG_BT_SMP=y
      - CONFIG_BT_PRIVACY=y
      - CONFIG_BT_CENTRAL=y
      - CONFIG_BT_OBSERVER=y
  bluetooth.host.bt_id_adv_random_addr_check.observer_scan_with_identity_enabled:
    type: unit
    extra_configs:
      - CONFIG_BT_SCAN_WITH_IDENTITY=y
      - CONFIG_BT_CENTRAL=y
      - CONFIG_BT_OBSERVER=y
  bluetooth.host.bt_id_adv_random_addr_check.bt_ext_adv_enabled:
    type: unit
    extra_configs:
      - CONFIG_BT_EXT_ADV=y
```

## tests/bluetooth/host/id/bt_id_create/Kconfig
```kconfig
# Copyright (c) 2023 Nordic Semiconductor ASA
#
# SPDX-License-Identifier: Apache-2.0

config SELECT_BT_HCI_SET_PUBLIC_ADDR
	bool "dummy kconfig"
	select BT_HCI_SET_PUBLIC_ADDR
	help
	  dummy kconfig

source "Kconfig.zephyr"
```

## tests/bluetooth/host/id/bt_id_create/testcase.yaml
```yaml
common:
  tags: bluetooth host
tests:
  bluetooth.host.bt_id_create.default:
    type: unit
  bluetooth.host.bt_id_create.bt_privacy_enabled:
    type: unit
    extra_configs:
      - CONFIG_BT_SMP=y
      - CONFIG_BT_PRIVACY=y
```

## tests/bluetooth/host/id/bt_id_del/testcase.yaml
```yaml
common:
  tags:
    - bluetooth
    - host
tests:
  bluetooth.host.bt_id_del.default:
    type: unit
  bluetooth.host.bt_id_del.broadcaster_ext_adv_enabled:
    type: unit
    extra_configs:
      - CONFIG_BT_EXT_ADV=y
      - CONFIG_BT_BROADCASTER=y
  bluetooth.host.bt_id_del.broadcaster_no_ext_adv:
    type: unit
    extra_configs:
      - CONFIG_BT_BROADCASTER=y
  bluetooth.host.bt_id_del.broadcaster_no_ext_adv_privacy_enabled:
    type: unit
    extra_configs:
      - CONFIG_BT_CENTRAL=y
      - CONFIG_BT_PRIVACY=y
      - CONFIG_BT_BROADCASTER=y
  bluetooth.host.bt_id_del.observer_ext_adv:
    type: unit
    extra_configs:
      - CONFIG_BT_EXT_ADV=y
      - CONFIG_BT_OBSERVER=y
      - CONFIG_BT_BROADCASTER=y
```

## tests/bluetooth/host/id/bt_id_delete/testcase.yaml
```yaml
common:
    tags: test_framework bluetooth host
tests:
  bluetooth.host.bt_id_delete.default:
     type: unit
  bluetooth.host.bt_id_delete.default_bt_settings_enabled:
     type: unit
     extra_configs:
      - CONFIG_SETTINGS=y
      - CONFIG_BT_SETTINGS=y
  bluetooth.host.bt_id_delete.privacy_enabled:
     type: unit
     extra_configs:
      - CONFIG_BT_SMP=y
      - CONFIG_BT_PRIVACY=y
  bluetooth.host.bt_id_delete.privacy_bt_settings_enabled:
     type: unit
     extra_configs:
      - CONFIG_SETTINGS=y
      - CONFIG_BT_SETTINGS=y
      - CONFIG_BT_SMP=y
      - CONFIG_BT_PRIVACY=y
```

## tests/bluetooth/host/id/bt_id_get/testcase.yaml
```yaml
common:
    tags: test_framework bluetooth host
tests:
  bluetooth.host.bt_id_get.default:
     type: unit
```
