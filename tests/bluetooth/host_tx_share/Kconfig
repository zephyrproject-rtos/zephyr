## tests/bluetooth/host_tx_share/Kconfig
```kconfig
# SPDX-FileCopyrightText: Copyright (c) 2026 Xiaomi Corporation
# SPDX-License-Identifier: Apache-2.0

config TEST_SIX_BUFFERS
	bool "Run only the test with six controller buffers"
	help
	  Give the Host six controller buffers instead of one, and let the
	  test decide when the controller reports packets as completed, so
	  that one connection can hold every buffer.

source "Kconfig.zephyr"
```

## tests/bluetooth/mesh_shell/testcase.yaml
```yaml
common:
  tags: bluetooth
  harness: keyboard
tests:
  bluetooth.mesh.mesh_shell:
    platform_allow:
      - qemu_x86
      - nrf52840dk/nrf52840
    integration_platforms:
      - qemu_x86
    platform_exclude: nrf52dk/nrf52810
  bluetooth.mesh_shell.ti_lpf3:
    platform_allow:
      - lp_em_cc2340r5moda
      - lp_em_cc2340r53
      - lp_em_cc2340r53_wcsp
      - lp_em_cc2745r10_q1/cc2745r10_q1
      - lp_em_cc2745r10_q1/cc2755r10
      - lp_em_cc2755p10
      - lp_em_cc2755p20
    build_only: true
```

## tests/bluetooth/shell/Kconfig
```kconfig
# Copyright (c) 2026 Nordic Semiconductor ASA
# SPDX-License-Identifier: Apache-2.0

mainmenu "Bluetooth Shell Test Application"

# LE Audio Controller settings for non-network core devices
if BT_AUDIO && BT_LL_SW_SPLIT

configdefault BT_CTLR_DATA_LENGTH_MAX
	default 251

# Set to high value to support large BASEs + extra data
configdefault BT_CTLR_SCAN_DATA_LEN_MAX
	default 1650

configdefault BT_CTLR_ADV_SYNC_SET
	default BT_CTLR_ADV_AUX_SET

configdefault BT_CTLR_ADV_DATA_LEN_MAX
	default 191

configdefault BT_CTLR_ADV_DATA_BUF_MAX
	default 6

# Match BT_BAP_BROADCAST_SRC_STREAM_COUNT in audio.conf
configdefault BT_CTLR_SYNC_ISO_STREAM_MAX
	default 2

# Match BT_BAP_BROADCAST_SNK_STREAM_COUNT in audio.conf
configdefault BT_CTLR_ADV_ISO_STREAM_MAX
	default 2

# Match BT_BAP_UNICAST_CLIENT_ASE_SRC_COUNT/BT_ASCS_MAX_ASE_SNK_COUNT audio.conf
configdefault BT_CTLR_ISOAL_SOURCES
	default 2

# BT_BAP_UNICAST_CLIENT_ASE_SNK_COUNT/BT_ASCS_MAX_ASE_SRC_COUNT in audio.conf
configdefault BT_CTLR_ISOAL_SINKS
	default 2

endif # BT_AUDIO && BT_LL_SW_SPLIT

source "Kconfig.zephyr"
```

## tests/boards/microchip/nandflash/testcase.yaml
```yaml
tests:
  boards.microchip.nandflash:
    tags:
      - drivers
      - flash
    depends_on:
      - flash
    filter: CONFIG_FLASH_MCHP_SAM_NAND
    harness: ztest
    platform_allow:
      - sama7d65_curiosity
```

## tests/boards/nrf/rram/boards/nrf54lv10dk_nrf54lv10a_cpuapp.conf
```kconfig
#
# Copyright (c) 2026 Nordic Semiconductor ASA
#
# SPDX-License-Identifier: Apache-2.0
#

CONFIG_NRF_RRAM_WRITE_BUFFER_SIZE=16
```

## tests/boards/nrf/uarte/Kconfig
```kconfig
# Copyright (c) 2026 Nordic Semiconductor ASA
#
# SPDX-License-Identifier: Apache-2.0

mainmenu "Nordic UARTE tests"

source "Kconfig.zephyr"

config NRF_UARTE_TEST_CBWT
	bool "Run the Count Bytes With Timer regression test"
```

## tests/boards/nxp/mimxrt2660evk/hwinfo/reset_cause/Kconfig
```kconfig
# SPDX-FileCopyrightText: Copyright 2026 NXP
# SPDX-License-Identifier: Apache-2.0

source "Kconfig.zephyr"

config TEST_RESET_CAUSE_COLD
	bool "Cold reboot reset cause test"
	help
	  Request a cold reboot and verify software reset escalation and clearing
	  of the POWERCON cold-reset GPR. Otherwise, test a warm reboot.
```

## tests/boards/raspberrypi/rp2350_heterogeneous/Kconfig.sysbuild
```kconfig
# SPDX-License-Identifier: Apache-2.0

source "share/sysbuild/Kconfig"

config REMOTE_BOARD
	string
	default "rpi_pico2/rp2350a/hazard3/cpu1"
```

## tests/boot/mcuboot_data_sharing/Kconfig
```kconfig
# Copyright 2026 Nordic Semiconductor ASA
# SPDX-License-Identifier: Apache-2.0

choice
	prompt "Expected signature type passed from MCUboot via retention"
	default TEST_EXPECTED_MCUBOOT_SIGNATURE_TYPE_NONE

config TEST_EXPECTED_MCUBOOT_SIGNATURE_TYPE_ECDSA_P256
	bool "Expected ECDSA P256"

config TEST_EXPECTED_MCUBOOT_SIGNATURE_TYPE_ED25519
	bool "Expected ED25519"

config TEST_EXPECTED_MCUBOOT_SIGNATURE_TYPE_RSA
	bool "Expected RSA"

config TEST_EXPECTED_MCUBOOT_SIGNATURE_TYPE_NONE
	bool "Expected None"

endchoice

source "Kconfig.zephyr"
```

## tests/boot/mcuboot_ram_load_split/Kconfig
```kconfig
# Copyright (c) 2026 The Zephyr Project Contributors
# SPDX-License-Identifier: Apache-2.0

mainmenu "MCUboot split RAM-load test"

source "Kconfig.zephyr"
```

## tests/boot/test_mcuboot/swapped_app/Kconfig
```kconfig
# Copyright 2022 NXP
# Copyright 2025 Nordic Semiconductor ASA
# SPDX-License-Identifier: Apache-2.0
source "Kconfig.zephyr"

config BUILD_OUTPUT_ADJUST_LMA
	default "$(dt_node_reg_addr_hex,$(dt_nodelabel_path,slot1_partition))-\
		$(dt_chosen_reg_addr_hex,$(DT_CHOSEN_Z_CODE_PARTITION))+\
		$(dt_node_int_prop_hex,$(dt_node_parent,$(dt_node_parent,$(dt_nodelabel_path,slot1_partition))),erase-block-size)" if MCUBOOT_BOOTLOADER_MODE_SWAP_USING_OFFSET
	default "$(dt_node_reg_addr_hex,$(dt_nodelabel_path,slot1_partition))-\
		$(dt_chosen_reg_addr_hex,$(DT_CHOSEN_Z_CODE_PARTITION))"
```

## tests/bsim/bluetooth/audio_samples/cap/handover/Kconfig
```kconfig
# Copyright (c) 2025 Nordic Semiconductor ASA
# SPDX-License-Identifier: Apache-2.0

source "$(ZEPHYR_BASE)/samples/bluetooth/audio/cap_handover/Kconfig"
```

## tests/bsim/bluetooth/host/gatt/notify_oversized/testcase.yaml
```yaml
tests:
  bluetooth.host.gatt.notify_oversized:
    build_only: true
    tags:
      - bluetooth
    platform_allow:
      - nrf52_bsim/native
    harness: bsim
    harness_config:
      bsim_exe_name: tests_bsim_bluetooth_host_gatt_notify_oversized_prj_conf
```

## tests/bsim/bluetooth/host/gatt/prepare_write_quota/testcase.yaml
```yaml
tests:
  bluetooth.host.gatt.prepare_write_quota:
    build_only: true
    tags:
      - bluetooth
    platform_allow:
      - nrf52_bsim/native
    harness: bsim
    harness_config:
      bsim_exe_name: tests_bsim_bluetooth_host_gatt_prepare_write_quota_prj_conf
  bluetooth.host.gatt.prepare_write_quota_oversubscribed:
    build_only: true
    tags:
      - bluetooth
    platform_allow:
      - nrf52_bsim/native
    harness: bsim
    harness_config:
      bsim_exe_name: tests_bsim_bluetooth_host_gatt_prepare_write_quota_overlay-oversubscribed_conf
    extra_args:
      EXTRA_CONF_FILE=overlay-oversubscribed.conf
```

## tests/bsim/bluetooth/services/hids/Kconfig
```kconfig
# Kconfig options of the HID Service test
#
# Copyright (c) 2026 Xiaomi Corporation
# SPDX-License-Identifier: Apache-2.0

menu "Test configuration"

config TEST_HIDS_SECURITY_REQUEST
	bool "The HID Device requests security when a Host connects"
	default y
	help
	  Use the Peripheral Security Request procedure to inform the HID Host
	  of the security requirements of the HID Device, as recommended by
	  the HID over GATT Profile. The client side of the test never initiates
	  pairing, so building the test with this disabled has to make it fail.

endmenu

source "Kconfig.zephyr"
```

## tests/cmake/hwm/board_extend/oot_root/boards/arm/mps2_default/Kconfig.mps2_default
```kconfig
# SPDX-FileCopyrightText: Copyright The Zephyr Project Contributors
# SPDX-License-Identifier: Apache-2.0

config BOARD_MPS2_DEFAULT
	select SOC_AN521_CPU0 if BOARD_MPS2_DEFAULT_AN521_CPU0 || BOARD_MPS2_DEFAULT_AN521_CPU0_TWO
	select SOC_AN521_CPU1 if BOARD_MPS2_DEFAULT_AN521_CPU1
```

## tests/cmake/hwm/board_extend/oot_root/boards/arm/mps2_default/board.yml
```yaml
board:
  name: mps2_default
  full_name: V2M MPS2 default qualifier test
  vendor: arm
  default_qualifier: an521/cpu0
  socs:
    - name: an521
      variants:
        - name: two
          cpucluster: cpu0
```
