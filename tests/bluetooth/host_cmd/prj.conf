## CMakeLists.txt
```
# SPDX-FileCopyrightText: Copyright (c) 2026 Silicon Laboratories Inc.
# SPDX-License-Identifier: Apache-2.0

cmake_minimum_required(VERSION 3.28.0)

find_package(Zephyr REQUIRED HINTS $ENV{ZEPHYR_BASE})
project(host_cmd)

target_sources(app PRIVATE
  src/driver.c
  src/deadline.c
  src/disconnect.c
  src/op.c
  src/op_no_reset.c
)

# The suites use internal headers of the Host
target_include_directories(app PRIVATE ${ZEPHYR_BASE}/subsys/bluetooth/host)
```

## prj.conf
```kconfig
CONFIG_ZTEST=y

CONFIG_BT=y
CONFIG_BT_LL_SW_SPLIT=n
CONFIG_BT_H4=n
CONFIG_BT_PERIPHERAL=y

# The suites look at what the Host does once the controller stops responding,
# which with asserts is to stop.
CONFIG_ASSERT=n
CONFIG_BT_ASSERT=n

CONFIG_LOG=y

# Lets the suites check that the command pool counts its buffers right
CONFIG_NET_BUF_POOL_USAGE=y

# The suites are picked by what the test controller is like, see
# TEST_DRIVER_RESETS: no scenario runs all of them.
CONFIG_ZTEST_VERIFY_RUN_ALL=n
```

## no_reset.overlay
```dts
/*
 * SPDX-FileCopyrightText: Copyright (c) 2026 Silicon Laboratories Inc.
 * SPDX-License-Identifier: Apache-2.0
 */

/* A controller that the Host does not reset. bt_disable() then needs no
 * command of its own, so it can be called while a command is outstanding.
 */
&bt_hci_test {
	bt-hci-quirks = "no-reset";
};
```

## src/deadline.c
```c
/*
 * SPDX-FileCopyrightText: Copyright (c) 2026 Silicon Laboratories Inc.
 * SPDX-License-Identifier: Apache-2.0
 */

/* The HCI command deadline: what the Host does with a command that gets no
 * response, with a controller that stops granting command credits, and with
 * a driver that fails to send a command.
 */

#include <errno.h>
#include <stdint.h>

#include <zephyr/bluetooth/bluetooth.h>
#include <zephyr/bluetooth/conn.h>
#include <zephyr/bluetooth/hci.h>
#include <zephyr/kernel.h>
#include <zephyr/net_buf.h>
#include <zephyr/sys/util.h>
#include <zephyr/ztest.h>

#include "hci_core.h"

#include "driver.h"

/* A command sent from a work item, on whichever queue the test picks */
struct work_sender {
	struct k_work_delayable work;
	struct k_sem done;
	int err;
	int64_t done_time;
};

static void sender_handler(struct k_work *work)
{
	struct k_work_delayable *dwork = k_work_delayable_from_work(work);
	struct work_sender *sender = CONTAINER_OF(dwork, struct work_sender, work);

	sender->err = bt_hci_cmd_send_sync(TEST_OPCODE, NULL, NULL);
	sender->done_time = k_uptime_get();
	k_sem_give(&sender->done);
}

static struct work_sender sender;

static K_SEM_DEFINE(connected_sem, 0, 1);
static struct bt_conn *test_conn;
static int connected_cmd_err;
static bool is_cmd_from_connected;

static void connected(struct bt_conn *conn, uint8_t err)
{
	ARG_UNUSED(err);

	/* A connection of another suite */
	if (!is_cmd_from_connected) {
		return;
	}

	test_conn = bt_conn_ref(conn);

	/* This is the Bluetooth workqueue */
	connected_cmd_err = bt_hci_cmd_send_sync(TEST_OPCODE, NULL, NULL);

	k_sem_give(&connected_sem);
}

BT_CONN_CB_DEFINE(deadline_conn_callbacks) = {
	.connected = connected,
};

/* A command queued just as the deadline expires, see
 * test_not_extended_at_expiry
 */
static struct net_buf *expiry_buf;
static int expiry_err;

static void expiry_handler(struct k_timer *timer)
{
	ARG_UNUSED(timer);

	expiry_err = bt_hci_cmd_send(TEST_OPCODE, net_buf_take(&expiry_buf));
}

static K_TIMER_DEFINE(expiry_timer, expiry_handler, NULL);

/* A command of a work item that waits for a command buffer, see
 * test_tx_held_up_by_alloc
 */
static K_SEM_DEFINE(alloc_started, 0, 1);
static K_SEM_DEFINE(alloc_done, 0, 1);
static int alloc_err;

static void alloc_handler(struct k_work *work)
{
	struct net_buf *buf;

	ARG_UNUSED(work);

	k_sem_give(&alloc_started);

	buf = bt_hci_cmd_alloc(K_FOREVER);
	alloc_err = bt_hci_cmd_send_sync(TEST_OPCODE, buf, NULL);

	k_sem_give(&alloc_done);
}

static K_WORK_DEFINE(alloc_work, alloc_handler);

static void *setup(void)
{
	k_work_init_delayable(&sender.work, sender_handler);
	(void)k_sem_init(&sender.done, 0U, 1U);

	return NULL;
}

static void before(void *fixture)
{
	ARG_UNUSED(fixture);

	test_driver_reset();
	zassert_ok(bt_enable(NULL), "Bluetooth init failed");

	test_reset_count = 0U;
	test_close_count = 0U;
}

static void after(void *fixture)
{
	struct k_work_sync sync;

	ARG_UNUSED(fixture);

	k_timer_stop(&expiry_timer);
	net_buf_drop(&expiry_buf);
	test_cmd_bufs_release();

	/* The disable completes whatever the work items still wait for. A
	 * test that failed in the middle of a recovery left Bluetooth disabled.
	 */
	if (bt_is_ready()) {
		test_driver_release();
		zassert_ok(bt_disable(), "Bluetooth disable failed");
	}
	(void)k_work_cancel_delayable_sync(&sender.work, &sync);
	(void)k_work_cancel_sync(&alloc_work, &sync);

	is_cmd_from_connected = false;
	bt_conn_drop(&test_conn);

	k_sem_reset(&sender.done);
	k_sem_reset(&connected_sem);
	k_sem_reset(&alloc_started);
	k_sem_reset(&alloc_done);
}

ZTEST_SUITE(cmd_deadline, test_with_reset, setup, before, after, NULL);

/* Out of the state in which no command is accepted: bt_disable(), which must
 * not try to reset a controller that does not respond, and bt_enable().
 */
static void recover(void)
{
	zassert_ok(bt_disable(), "Bluetooth disable failed");
	zassert_equal(test_reset_count, 0U, "bt_disable() sent a reset");
	zassert_equal(test_close_count, 1U, "close() was called %u times", test_close_count);

	bt_conn_drop(&test_conn);

	test_driver_reset();
	zassert_ok(bt_enable(NULL), "Bluetooth init failed");
	zassert_equal(test_reset_count, 1U, "bt_enable() sent %u resets", test_reset_count);
}

/* A command queued just as the deadline expires is no step forward: the one
 * that gets no response still ends with the deadline.
 */
static ZTEST(cmd_deadline, test_not_extended_at_expiry)
{
	int64_t start = k_uptime_get();
	int64_t waited;
	int err;

	expiry_buf = bt_hci_cmd_alloc(K_NO_WAIT);
	zassert_not_null(expiry_buf, "No command buffer");
	expiry_err = -EINPROGRESS;

	test_cmd.delay = K_FOREVER;

	/* Started first, so it comes first in the tick of the deadline */
	k_timer_start(&expiry_timer, HCI_CMD_TIMEOUT, K_NO_WAIT);

	err = bt_hci_cmd_send_sync(TEST_OPCODE, NULL, NULL);
	waited = k_uptime_get() - start;
	zassert_equal(err, -ETIMEDOUT, "The command gave %d (!= %d)", err, -ETIMEDOUT);
	zassert_within(waited, TEST_DEADLINE_MS, TEST_DEADLINE_SLACK_MS,
		       "The command took %lld ms", waited);
	zassert_ok(expiry_err, "The command at the expiry was refused (err %d)", expiry_err);

	recover();
}

/* A driver that fails to send a command has not sent it: the sender gets an
 * error at once and the next command goes through.
 */
static ZTEST(cmd_deadline, test_send_failure)
{
	int64_t start = k_uptime_get();
	int err;

	test_cmd.send_err = -ENOMEM;
	err = bt_hci_cmd_send_sync(TEST_OPCODE, NULL, NULL);
	zassert_equal(err, -EIO, "The command gave %d (!= %d)", err, -EIO);
	zassert_equal(test_cmd.count, 0U, "The controller got the command");
	zassert_true(k_uptime_get() - start < MSEC_PER_SEC, "The sender had to wait");

	test_cmd.send_err = 0;
	zassert_ok(bt_hci_cmd_send_sync(TEST_OPCODE, NULL, NULL), "The next command failed");
	zassert_equal(test_cmd.count, 1U, "The controller got %u commands", test_cmd.count);
}

/* A command that gets no response ends with the deadline, and so does the one
 * queued behind it, whose sender is the system workqueue: the queue that
 * transmits commands when there is no TX processor thread. After that nothing
 * is accepted, a response that still arrives completes nothing, and a disable
 * and enable cycle brings Bluetooth back.
 */
static ZTEST(cmd_deadline, test_no_response)
{
	int64_t start = k_uptime_get();
	int64_t waited;
	int err;

	test_cmd.delay = K_FOREVER;

	/* The second command is queued while the first one waits for its
	 * response: a second into that wait, the first one has long reached
	 * the controller.
	 */
	zassert_equal(k_work_schedule(&sender.work, K_SECONDS(1)), 1,
		      "Scheduling the sender failed");

	err = bt_hci_cmd_send_sync(TEST_OPCODE, NULL, NULL);
	waited = k_uptime_get() - start;
	zassert_equal(err, -ETIMEDOUT, "The command gave %d (!= %d)", err, -ETIMEDOUT);
	zassert_within(waited, TEST_DEADLINE_MS, TEST_DEADLINE_SLACK_MS,
		       "The command took %lld ms", waited);

	zassert_ok(k_sem_take(&sender.done, TEST_TIMEOUT), "The queued command never returned");
	zassert_equal(sender.err, -EHOSTDOWN, "The queued command gave %d (!= %d)", sender.err,
		      -EHOSTDOWN);
	zassert_within(sender.done_time - start, TEST_DEADLINE_MS, TEST_DEADLINE_SLACK_MS,
		       "The queued command returned after %lld ms", sender.done_time - start);
	zassert_equal(test_cmd.count, 1U, "The controller got %u commands", test_cmd.count);

	/* Nothing is accepted any more */
	err = bt_hci_cmd_send_sync(TEST_OPCODE, NULL, NULL);
	zassert_equal(err, -EHOSTDOWN, "A further command gave %d (!= %d)", err, -EHOSTDOWN);
	err = bt_hci_cmd_send(TEST_OPCODE, NULL);
	zassert_equal(err, -EHOSTDOWN, "A further command gave %d (!= %d)", err, -EHOSTDOWN);
	zassert_equal(test_cmd.count, 1U, "The controller got %u commands", test_cmd.count);

	/* The late response has nothing to complete, and its credit nothing to
	 * send
	 */
	test_cmd_respond(&test_cmd);
	test_settle();
	zassert_equal(test_cmd.count, 1U, "The controller got %u commands", test_cmd.count);

	recover();

	zassert_ok(bt_hci_cmd_send_sync(TEST_OPCODE, NULL, NULL),
		   "The command failed after the recovery");
	zassert_equal(test_cmd.count, 1U, "The controller got %u commands", test_cmd.count);
}

/* A controller that responds with no command credit, and grants none later,
 * lets the queue behind that command stand still. The deadline covers that
 * too.
 */
static ZTEST(cmd_deadline, test_no_credit)
{
	int64_t start;
	int64_t waited;
	int err;

	test_cmd.ncmd = 0U;
	zassert_ok(bt_hci_cmd_send_sync(TEST_OPCODE, NULL, NULL), "The first command failed");

	start = k_uptime_get();
	err = bt_hci_cmd_send_sync(TEST_OPCODE, NULL, NULL);
	waited = k_uptime_get() - start;
	zassert_equal(err, -EHOSTDOWN, "The command gave %d (!= %d)", err, -EHOSTDOWN);
	zassert_within(waited, TEST_DEADLINE_MS, TEST_DEADLINE_SLACK_MS,
		       "The command took %lld ms", waited);
	zassert_equal(test_cmd.count, 1U, "The controller got %u commands", test_cmd.count);

	recover();
}

/* A work item on the system workqueue waits for a command buffer while the
 * pool is held by a thread whose command is still to be sent. Without a TX
 * processor thread it is the system workqueue that sends the commands, so
 * that command is not sent and its buffer not freed. The deadline gives the
 * command up, not the controller.
 */
static ZTEST(cmd_deadline, test_tx_held_up_by_alloc)
{
	unsigned int count;
	int64_t start;
	int64_t waited;
	int err;

	count = test_cmd_bufs_hold();
	zassert_true(count > 0U, "The Host has no command buffer");

	zassert_true(k_work_submit(&alloc_work) >= 0, "Starting the work item failed");
	zassert_ok(k_sem_take(&alloc_started, TEST_TIMEOUT), "The work item did not start");

	start = k_uptime_get();
	err = bt_hci_cmd_send_sync(TEST_OPCODE, net_buf_take(&test_cmd_bufs[0]), NULL);
	waited = k_uptime_get() - start;

	test_cmd_bufs_release();

	zassert_ok(k_sem_take(&alloc_done, TEST_TIMEOUT), "The work item got no buffer");
	zassert_ok(alloc_err, "The command of the work item gave %d", alloc_err);

	if (IS_ENABLED(CONFIG_BT_TX_PROCESSOR_THREAD)) {
		zassert_ok(err, "The command gave %d", err);
		zassert_equal(test_cmd.count, 2U, "The controller got %u commands", test_cmd.count);
		return;
	}

	zassert_equal(err, -ENOBUFS, "The command gave %d (!= %d)", err, -ENOBUFS);
	zassert_within(waited, TEST_DEADLINE_MS, TEST_DEADLINE_SLACK_MS,
		       "The command took %lld ms", waited);
	zassert_equal(test_cmd.count, 1U, "The controller got %u commands", test_cmd.count);

	/* The controller has not been given up on */
	zassert_ok(bt_hci_cmd_send_sync(TEST_OPCODE, NULL, NULL), "The next command failed");
	zassert_equal(test_cmd.count, 2U, "The controller got %u commands", test_cmd.count);
}

/* The Bluetooth workqueue runs synchronous senders, in callbacks and in the
 * Host's own event handlers. The deadline has to release those as well.
 */
static ZTEST(cmd_deadline, test_sender_on_bt_workq)
{
	int64_t start;
	int64_t waited;

	zassert_ok(bt_le_adv_start(BT_LE_ADV_CONN_FAST_1, NULL, 0U, NULL, 0U),
		   "Advertising failed to start");

	test_cmd.delay = K_FOREVER;
	is_cmd_from_connected = true;

	start = k_uptime_get();
	test_connect();

	zassert_ok(k_sem_take(&connected_sem, TEST_PAST_DEADLINE), "The sender was not released");
	waited = k_uptime_get() - start;
	zassert_equal(connected_cmd_err, -ETIMEDOUT, "The command gave %d (!= %d)",
		      connected_cmd_err, -ETIMEDOUT);
	zassert_within(waited, TEST_DEADLINE_MS, TEST_DEADLINE_SLACK_MS,
		       "The command took %lld ms", waited);

	recover();
}

/* A response that the driver delivers from within send() completes the
 * command before send() returns. The deadline must not be left running for it.
 */
static ZTEST(cmd_deadline, test_response_within_send)
{
	zassert_ok(bt_hci_cmd_send_sync(TEST_OPCODE, NULL, NULL), "The command failed");

	/* A deadline that is left running expires only once its time has
	 * passed, and nothing signals the expiry.
	 */
	(void)k_sleep(TEST_PAST_DEADLINE);

	zassert_ok(bt_hci_cmd_send_sync(TEST_OPCODE, NULL, NULL),
		   "The command failed after an idle deadline period");
	zassert_equal(test_cmd.count, 2U, "The controller got %u commands", test_cmd.count);
}

/* The deadline of a command whose response comes just in time must not end
 * the command that follows it.
 */
static ZTEST(cmd_deadline, test_response_just_in_time)
{
	test_cmd.delay = K_MSEC(TEST_DEADLINE_MS - TEST_DEADLINE_SLACK_MS);
	zassert_ok(bt_hci_cmd_send_sync(TEST_OPCODE, NULL, NULL), "The slow command failed");

	/* Longer than what was left of the deadline of the first command */
	test_cmd.delay = K_MSEC(2U * TEST_DEADLINE_SLACK_MS);
	zassert_ok(bt_hci_cmd_send_sync(TEST_OPCODE, NULL, NULL),
		   "The command after the slow one failed");
	zassert_equal(test_cmd.count, 2U, "The controller got %u commands", test_cmd.count);
}

/* A response that arrives at the moment of the deadline: the command either
 * completes or times out, never both and never neither, and the Host is left
 * in the state that goes with the outcome.
 */
static ZTEST(cmd_deadline, test_response_at_deadline)
{
	int err;

	test_cmd.delay = HCI_CMD_TIMEOUT;
	err = bt_hci_cmd_send_sync(TEST_OPCODE, NULL, NULL);
	TC_PRINT("The command %s\n", (err == 0) ? "completed" : "timed out");

	/* Whichever came second, in the same tick, has been dealt with */
	test_settle();

	if (err == 0) {
		test_cmd.delay = K_NO_WAIT;
		zassert_ok(bt_hci_cmd_send_sync(TEST_OPCODE, NULL, NULL),
			   "The command after the completed one failed");
		zassert_equal(test_cmd.count, 2U, "The controller got %u commands", test_cmd.count);
		return;
	}

	zassert_equal(err, -ETIMEDOUT, "The command gave %d (!= %d)", err, -ETIMEDOUT);
	err = bt_hci_cmd_send_sync(TEST_OPCODE, NULL, NULL);
	zassert_equal(err, -EHOSTDOWN, "A further command gave %d (!= %d)", err, -EHOSTDOWN);
	zassert_equal(test_cmd.count, 1U, "The controller got %u commands", test_cmd.count);

	recover();

	zassert_ok(bt_hci_cmd_send_sync(TEST_OPCODE, NULL, NULL),
		   "The command failed after the recovery");
}

/* The latest response says whether the controller accepts another command. A
 * credit that it grants while a command is outstanding is taken back by the
 * response to that command if that response allows no further command, and
 * the next command waits until a response allows it.
 */
static ZTEST(cmd_deadline, test_credit_taken_back)
{
	test_cmd.delay = K_FOREVER;
	zassert_ok(bt_hci_cmd_send(TEST_OPCODE, NULL), "Sending a command failed");
	zassert_ok(test_cmd_wait(&test_cmd, 1U), "The controller got no command");

	/* A credit while the command is outstanding, and a command behind it */
	test_credit_grant();
	zassert_ok(bt_hci_cmd_send(TEST_OPCODE, NULL), "Sending a command failed");
	test_settle();
	zassert_equal(test_cmd.count, 1U, "A command was sent while another was outstanding");

	test_cmd.ncmd = 0U;
	test_cmd_respond(&test_cmd);
	test_settle();
	zassert_equal(test_cmd.count, 1U, "A command was sent that the controller did not accept");

	test_cmd.delay = K_NO_WAIT;
	test_cmd.ncmd = 1U;
	test_credit_grant();
	zassert_ok(test_cmd_wait(&test_cmd, 2U), "The queued command was not sent");

	zassert_ok(bt_hci_cmd_send_sync(TEST_OPCODE, NULL, NULL), "The next command failed");
}

/* A response that allows no further command holds the next one back until a
 * later response allows it: here the Command Complete event for no command
 * that a controller sends for this alone.
 */
static ZTEST(cmd_deadline, test_credit_granted_later)
{
	test_cmd.delay = K_FOREVER;
	zassert_ok(bt_hci_cmd_send(TEST_OPCODE, NULL), "Sending a command failed");
	zassert_ok(bt_hci_cmd_send(TEST_OPCODE, NULL), "Sending a command failed");
	zassert_ok(test_cmd_wait(&test_cmd, 1U), "The controller got no command");

	test_cmd.ncmd = 0U;
	test_cmd_respond(&test_cmd);
	test_settle();
	zassert_equal(test_cmd.count, 1U, "A command was sent that the controller did not accept");

	test_cmd.delay = K_NO_WAIT;
	test_cmd.ncmd = 1U;
	test_credit_grant();
	zassert_ok(test_cmd_wait(&test_cmd, 2U), "The queued command was not sent");

	zassert_ok(bt_hci_cmd_send_sync(TEST_OPCODE, NULL, NULL), "The next command failed");
}
```

## src/disconnect.c
```c
/*
 * SPDX-FileCopyrightText: Copyright (c) 2026 Silicon Laboratories Inc.
 * SPDX-License-Identifier: Apache-2.0
 */

/* bt_conn_disconnect() does not wait for the controller. These cases cover
 * what becomes of the request: rejected, not sent, overtaken by the peer, and
 * responded to only after the connection is gone.
 */

#include <errno.h>
#include <stdint.h>

#include <zephyr/bluetooth/bluetooth.h>
#include <zephyr/bluetooth/conn.h>
#include <zephyr/bluetooth/hci.h>
#include <zephyr/bluetooth/hci_types.h>
#include <zephyr/kernel.h>
#include <zephyr/net_buf.h>
#include <zephyr/sys/util.h>
#include <zephyr/ztest.h>

#include "hci_core.h"

#include "driver.h"

static K_SEM_DEFINE(connected_sem, 0, 1);
static K_SEM_DEFINE(disconnected_sem, 0, 1);
static struct bt_conn *conn;
static unsigned int connected_count;
static uint8_t disconnect_reason;
static bool is_running;

static void connected(struct bt_conn *new_conn, uint8_t err)
{
	ARG_UNUSED(err);

	/* A connection of another suite */
	if (!is_running) {
		return;
	}

	connected_count++;
	conn = bt_conn_ref(new_conn);
	k_sem_give(&connected_sem);
}

static void disconnected(struct bt_conn *old_conn, uint8_t reason)
{
	if (!is_running || old_conn != conn) {
		return;
	}

	disconnect_reason = reason;
	bt_conn_drop(&conn);
	k_sem_give(&disconnected_sem);
}

BT_CONN_CB_DEFINE(disconnect_conn_callbacks) = {
	.connected = connected,
	.disconnected = disconnected,
};

/* Holds up the Bluetooth workqueue, see
 * test_peer_first_no_credit_workq_busy
 */
static K_SEM_DEFINE(rx_gate, 0, 1);

static void rx_gate_handler(struct k_work *work)
{
	ARG_UNUSED(work);

	/* Ended by the test, or by the reset of the gate in after() */
	(void)k_sem_take(&rx_gate, K_FOREVER);
}

static K_WORK_DEFINE(rx_gate_work, rx_gate_handler);

static void connect(void)
{
	zassert_ok(bt_le_adv_start(BT_LE_ADV_CONN_FAST_1, NULL, 0U, NULL, 0U),
		   "Advertising failed to start");
	test_connect();
	zassert_ok(k_sem_take(&connected_sem, TEST_TIMEOUT), "No connection");
}

static enum bt_conn_state conn_state(void)
{
	struct bt_conn_info info;

	zassert_ok(bt_conn_get_info(conn, &info), "No connection info");

	return info.state;
}

static void before(void *fixture)
{
	ARG_UNUSED(fixture);

	test_driver_reset();
	is_running = true;
	zassert_ok(bt_enable(NULL), "Bluetooth init failed");

	connect();
	connected_count = 0U;
}

static void after(void *fixture)
{
	ARG_UNUSED(fixture);

	/* Lets go of the Bluetooth workqueue if a failed test left it held up */
	k_sem_reset(&rx_gate);
	test_cmd_bufs_release();

	/* Whatever is left of the connection goes with the disable. A test
	 * that failed between its own disable and enable left Bluetooth
	 * disabled.
	 */
	if (bt_is_ready()) {
		test_driver_release();
		zassert_ok(bt_disable(), "Bluetooth disable failed");
	}

	is_running = false;
	bt_conn_drop(&conn);

	k_sem_reset(&connected_sem);
	k_sem_reset(&disconnected_sem);
}

ZTEST_SUITE(cmd_disconnect, test_with_reset, NULL, before, after, NULL);

/* A request that the controller rejects leaves the connection as it was: no
 * callback, and it can be disconnected again.
 */
static ZTEST(cmd_disconnect, test_rejected)
{
	test_disconnect.status = BT_HCI_ERR_CMD_DISALLOWED;

	/* Pending for the second request, as no time passes until the wait */
	test_disconnect.delay = K_MSEC(20);

	zassert_equal(bt_conn_disconnect(conn, BT_HCI_ERR_LOCALHOST_TERM_CONN), -EINVAL,
		      "A reason that the controller would refuse was accepted");
	zassert_equal(test_disconnect.count, 0U, "The controller got the command");

	zassert_ok(bt_conn_disconnect(conn, BT_HCI_ERR_REMOTE_USER_TERM_CONN),
		   "The request was refused");
	zassert_equal(conn_state(), BT_CONN_STATE_DISCONNECTING, "Wrong state while requested");
	zassert_ok(bt_conn_disconnect(conn, BT_HCI_ERR_REMOTE_USER_TERM_CONN),
		   "A second request was refused");

	/* The rejection is dealt with on the Bluetooth workqueue */
	zassert_ok(test_rsp_wait(&test_disconnect, 1U), "The controller did not respond");
	test_bt_workq_flush();
	zassert_equal(test_disconnect.count, 1U, "The controller got %u commands",
		      test_disconnect.count);
	zassert_equal(conn_state(), BT_CONN_STATE_CONNECTED, "Wrong state after the rejection");
	zassert_equal(k_sem_count_get(&disconnected_sem), 0U, "The connection was reported gone");
	zassert_equal(connected_count, 0U, "The connection was reported a second time");

	test_disconnect.status = BT_HCI_ERR_SUCCESS;
	zassert_ok(bt_conn_disconnect(conn, BT_HCI_ERR_REMOTE_USER_TERM_CONN),
		   "The request was refused after a rejection");
	zassert_ok(k_sem_take(&disconnected_sem, TEST_TIMEOUT), "No disconnection");
	zassert_equal(disconnect_reason, BT_HCI_ERR_LOCALHOST_TERM_CONN, "Reason 0x%02x",
		      disconnect_reason);
}

/* A controller that does not know the connection any more has lost it without
 * saying so. The Host takes the connection down and says what it found.
 */
static ZTEST(cmd_disconnect, test_unknown_to_controller)
{
	test_disconnect.status = BT_HCI_ERR_UNKNOWN_CONN_ID;

	zassert_ok(bt_conn_disconnect(conn, BT_HCI_ERR_REMOTE_USER_TERM_CONN),
		   "The request was refused");
	zassert_ok(k_sem_take(&disconnected_sem, TEST_TIMEOUT), "No disconnection");
	zassert_equal(disconnect_reason, BT_HCI_ERR_UNKNOWN_CONN_ID, "Reason 0x%02x",
		      disconnect_reason);

	/* Done with the connection before the next one */
	test_bt_workq_flush();
	connect();
}

/* A command that the driver fails to send has not been sent: the connection
 * stays, and the next request goes through.
 */
static ZTEST(cmd_disconnect, test_send_failure)
{
	test_disconnect.send_err = -ENOMEM;

	zassert_ok(bt_conn_disconnect(conn, BT_HCI_ERR_REMOTE_USER_TERM_CONN),
		   "The request was refused");
	test_settle();
	zassert_equal(test_disconnect.count, 0U, "The controller got the command");
	zassert_equal(conn_state(), BT_CONN_STATE_CONNECTED, "Wrong state after the failure");
	zassert_equal(k_sem_count_get(&disconnected_sem), 0U, "The connection was reported gone");

	test_disconnect.send_err = 0;
	zassert_ok(bt_conn_disconnect(conn, BT_HCI_ERR_REMOTE_USER_TERM_CONN),
		   "The request was refused after a failure");
	zassert_ok(k_sem_take(&disconnected_sem, TEST_TIMEOUT), "No disconnection");
	zassert_equal(test_disconnect.count, 1U, "The controller got %u commands",
		      test_disconnect.count);
}

/* A request that gets no command buffer before the deadline, as synchronous
 * senders keep the whole command pool for their responses, has not been sent:
 * the connection stays, and the next request goes through.
 */
static ZTEST(cmd_disconnect, test_no_buffer_until_deadline)
{
	ARRAY_FOR_EACH(test_cmd_bufs, i) {
		struct net_buf *buf = bt_hci_cmd_alloc(K_NO_WAIT);

		if (buf == NULL) {
			break;
		}

		zassert_ok(bt_hci_cmd_send_sync(TEST_OPCODE, buf, &test_cmd_bufs[i]),
			   "Command %zu failed", i);
	}

	zassert_is_null(test_cmd_bufs[ARRAY_SIZE(test_cmd_bufs) - 1U],
			"The Host has more command buffers than expected");

	zassert_ok(bt_conn_disconnect(conn, BT_HCI_ERR_REMOTE_USER_TERM_CONN),
		   "The request was refused");
	zassert_equal(conn_state(), BT_CONN_STATE_DISCONNECTING, "Wrong state while requested");

	/* The deadline gives the request up once its time has passed, which
	 * nothing signals
	 */
	(void)k_sleep(TEST_PAST_DEADLINE);
	zassert_equal(test_disconnect.count, 0U, "The controller got the command");
	zassert_equal(conn_state(), BT_CONN_STATE_CONNECTED, "Wrong state after the deadline");
	zassert_equal(k_sem_count_get(&disconnected_sem), 0U, "The connection was reported gone");
	zassert_equal(connected_count, 0U, "The connection was reported a second time");

	test_cmd_bufs_release();
	zassert_ok(bt_conn_disconnect(conn, BT_HCI_ERR_REMOTE_USER_TERM_CONN),
		   "The request was refused after the deadline");
	zassert_ok(k_sem_take(&disconnected_sem, TEST_TIMEOUT), "No disconnection");
	zassert_equal(test_disconnect.count, 1U, "The controller got %u commands",
		      test_disconnect.count);
}

/* The peer disconnects while the request has no command buffer yet. The
 * connection object is used again at once, and the command of the old
 * connection must not come out of it.
 */
static ZTEST(cmd_disconnect, test_peer_first_no_buffer)
{
	(void)test_cmd_bufs_hold();

	zassert_ok(bt_conn_disconnect(conn, BT_HCI_ERR_REMOTE_USER_TERM_CONN),
		   "The request was refused");
	test_settle();

	test_disconnect_complete(BT_HCI_ERR_REMOTE_USER_TERM_CONN);
	zassert_ok(k_sem_take(&disconnected_sem, TEST_TIMEOUT), "No disconnection");
	zassert_equal(disconnect_reason, BT_HCI_ERR_REMOTE_USER_TERM_CONN, "Reason 0x%02x",
		      disconnect_reason);

	test_cmd_bufs_release();
	test_settle();
	connect();
	test_settle();

	zassert_equal(test_disconnect.count, 0U, "A command of the old connection was sent");
	zassert_equal(conn_state(), BT_CONN_STATE_CONNECTED, "The new connection is not up");
}

/* The same with the command encoded, waiting for the controller to accept
 * the next command.
 */
static ZTEST(cmd_disconnect, test_peer_first_no_credit)
{
	test_cmd.delay = K_FOREVER;
	zassert_ok(bt_hci_cmd_send(TEST_OPCODE, NULL), "Sending a command failed");
	zassert_ok(test_cmd_wait(&test_cmd, 1U), "The command was not sent");

	/* Encoded, behind the command that the controller holds */
	zassert_ok(bt_conn_disconnect(conn, BT_HCI_ERR_REMOTE_USER_TERM_CONN),
		   "The request was refused");
	test_settle();

	test_disconnect_complete(BT_HCI_ERR_REMOTE_USER_TERM_CONN);
	zassert_ok(k_sem_take(&disconnected_sem, TEST_TIMEOUT), "No disconnection");

	/* The controller accepts commands again */
	test_cmd_respond(&test_cmd);
	test_settle();
	connect();
	test_settle();

	zassert_equal(test_disconnect.count, 0U, "A command of the old connection was sent");
	zassert_equal(conn_state(), BT_CONN_STATE_CONNECTED, "The new connection is not up");
}

/* The same with the Bluetooth workqueue still busy with something else when the
 * credit comes: the connection is gone for the controller, which may have given
 * the handle to a new connection already, and the Host has only seen the
 * priority part of the event so far.
 */
static ZTEST(cmd_disconnect, test_peer_first_no_credit_workq_busy)
{
	test_cmd.delay = K_FOREVER;
	zassert_ok(bt_hci_cmd_send(TEST_OPCODE, NULL), "Sending a command failed");
	zassert_ok(test_cmd_wait(&test_cmd, 1U), "The command was not sent");

	/* Encoded, behind the command that the controller holds */
	zassert_ok(bt_conn_disconnect(conn, BT_HCI_ERR_REMOTE_USER_TERM_CONN),
		   "The request was refused");
	test_settle();

	/* The workqueue is to be held up at the gate */
	zassert_true(bt_work_submit(&rx_gate_work) >= 0, "Blocking the workqueue failed");
	test_settle();

	test_disconnect_complete(BT_HCI_ERR_REMOTE_USER_TERM_CONN);
	test_cmd_respond(&test_cmd);
	test_settle();

	zassert_equal(test_disconnect.count, 0U, "The command was sent after the disconnection");

	k_sem_give(&rx_gate);
	zassert_ok(k_sem_take(&disconnected_sem, TEST_TIMEOUT), "No disconnection");
	zassert_equal(disconnect_reason, BT_HCI_ERR_REMOTE_USER_TERM_CONN, "Reason 0x%02x",
		      disconnect_reason);
}

/* The connection goes away while the command is with the controller, and the
 * response comes afterwards. Until then the request keeps the connection
 * object; the completion drops the last reference to it, and the object is
 * free for the next connection.
 */
static void count_conn(struct bt_conn *any_conn, void *data)
{
	unsigned int *count = data;

	ARG_UNUSED(any_conn);

	(*count)++;
}

static ZTEST(cmd_disconnect, test_response_after_disconnection)
{
	const struct bt_conn *const first = conn;
	unsigned int objects = 0U;

	test_disconnect.status = BT_HCI_ERR_UNKNOWN_CONN_ID;

	/* The response comes after the disconnection that the test delivers */
	test_disconnect.delay = K_MSEC(500);

	zassert_ok(bt_conn_disconnect(conn, BT_HCI_ERR_REMOTE_USER_TERM_CONN),
		   "The request was refused");
	zassert_ok(test_cmd_wait(&test_disconnect, 1U), "The command was not sent");

	test_disconnect_complete(BT_HCI_ERR_REMOTE_USER_TERM_CONN);
	zassert_ok(k_sem_take(&disconnected_sem, TEST_TIMEOUT), "No disconnection");
	zassert_equal(disconnect_reason, BT_HCI_ERR_REMOTE_USER_TERM_CONN, "Reason 0x%02x",
		      disconnect_reason);
	test_bt_workq_flush();

	/* The connection object is still taken */
	bt_conn_foreach(BT_CONN_TYPE_LE, count_conn, &objects);
	zassert_equal(objects, 1U, "The request did not keep the connection object");

	/* The completion of the request, on the Bluetooth workqueue, releases
	 * the object
	 */
	zassert_ok(test_rsp_wait(&test_disconnect, 1U), "The controller did not respond");
	test_bt_workq_flush();
	objects = 0U;
	bt_conn_foreach(BT_CONN_TYPE_LE, count_conn, &objects);
	zassert_equal(objects, 0U, "The connection object was not released");

	connect();
	zassert_equal_ptr(conn, first, "The new connection is in another object");
	zassert_equal(k_sem_count_get(&disconnected_sem), 0U,
		      "A late response disconnected the new connection");
}

/* The controller rejects the request, and the connection goes away by itself
 * before the Host has dealt with the rejection: the disconnection stands, and
 * the connection is not put back to connected.
 */
static ZTEST(cmd_disconnect, test_rejected_and_gone)
{
	unsigned int objects = 0U;

	test_disconnect.status = BT_HCI_ERR_CMD_DISALLOWED;
	test_disconnect.delay = K_FOREVER;

	zassert_ok(bt_conn_disconnect(conn, BT_HCI_ERR_REMOTE_USER_TERM_CONN),
		   "The request was refused");
	zassert_ok(test_cmd_wait(&test_disconnect, 1U), "The command was not sent");

	/* Both events arrive before the Bluetooth workqueue gets to either */
	k_sched_lock();
	test_cmd_respond(&test_disconnect);
	test_disconnect_complete(BT_HCI_ERR_CONN_TIMEOUT);
	k_sched_unlock();

	zassert_ok(k_sem_take(&disconnected_sem, TEST_TIMEOUT), "No disconnection");
	zassert_equal(disconnect_reason, BT_HCI_ERR_CONN_TIMEOUT, "Reason 0x%02x",
		      disconnect_reason);
	zassert_equal(connected_count, 0U, "The connection was reported a second time");

	/* The completion of the request, on the Bluetooth workqueue, releases
	 * the object
	 */
	test_bt_workq_flush();
	bt_conn_foreach(BT_CONN_TYPE_LE, count_conn, &objects);
	zassert_equal(objects, 0U, "The connection object was not released");
}

/* bt_disable() while the command of a request is with the controller: the
 * controller responds to the request before it gets the reset, and the
 * disable goes through.
 */
static ZTEST(cmd_disconnect, test_disable_after_request)
{
	/* The response comes once bt_disable() has been called */
	test_disconnect.delay = K_MSEC(100);

	zassert_ok(bt_conn_disconnect(conn, BT_HCI_ERR_REMOTE_USER_TERM_CONN),
		   "The request was refused");
	zassert_ok(test_cmd_wait(&test_disconnect, 1U), "The command was not sent");

	zassert_ok(bt_disable(), "Bluetooth disable failed");
	zassert_ok(k_sem_take(&disconnected_sem, TEST_TIMEOUT), "No disconnection");

	test_driver_reset();
	zassert_ok(bt_enable(NULL), "Bluetooth init failed");
	connect();
}

/* bt_disable() before the command of a request has been sent: the disable
 * takes the connection down, and the command is not needed any more.
 */
static ZTEST(cmd_disconnect, test_disable_overtakes_request)
{
	zassert_ok(bt_conn_disconnect(conn, BT_HCI_ERR_REMOTE_USER_TERM_CONN),
		   "The request was refused");
	zassert_ok(bt_disable(), "Bluetooth disable failed");
	zassert_ok(k_sem_take(&disconnected_sem, TEST_TIMEOUT), "No disconnection");
	zassert_equal(test_disconnect.count, 0U, "The controller got %u commands",
		      test_disconnect.count);

	test_driver_reset();
	zassert_ok(bt_enable(NULL), "Bluetooth init failed");
	connect();
}
```

## src/driver.c
```c
/*
 * SPDX-FileCopyrightText: Copyright (c) 2026 Silicon Laboratories Inc.
 * SPDX-License-Identifier: Apache-2.0
 */

/* A scriptable controller behind an HCI driver, for tests of the Host's HCI
 * command handling. It responds to the initialization commands as far as the
 * Host needs, and lets a test decide when and how it responds to two commands.
 */

#include <errno.h>
#include <stddef.h>
#include <stdint.h>
#include <string.h>

#include <zephyr/bluetooth/addr.h>
#include <zephyr/bluetooth/buf.h>
#include <zephyr/bluetooth/gap.h>
#include <zephyr/bluetooth/hci.h>
#include <zephyr/bluetooth/hci_types.h>
#include <zephyr/device.h>
#include <zephyr/devicetree.h>
#include <zephyr/drivers/bluetooth.h>
#include <zephyr/kernel.h>
#include <zephyr/net_buf.h>
#include <zephyr/sys/byteorder.h>
#include <zephyr/sys/util.h>
#include <zephyr/ztest.h>

#include "driver.h"

#define DT_DRV_COMPAT zephyr_bt_hci_test

/* Large enough for the return parameters of initialization commands that are
 * irrelevant to these tests, of which Read Local Supported Commands is the
 * largest.
 */
#define GENERIC_RP_SIZE sizeof(struct bt_hci_rp_read_supported_commands)

/* The LE ACL buffers of the controller: the smallest size there is, and a
 * few of them
 */
#define LE_ACL_MAX_LEN 27U
#define LE_ACL_MAX_NUM 3U

struct test_cmd_script test_cmd;
struct test_cmd_script test_disconnect;
uint8_t test_cmd_plen[TEST_CMD_PLEN_MAX];
unsigned int test_reset_count;
unsigned int test_close_count;
struct net_buf *test_cmd_bufs[TEST_CMD_BUF_MAX];

/* Given whenever a scripted command arrives or is responded to */
static K_SEM_DEFINE(script_sem, 0, K_SEM_MAX_LIMIT);

static const struct device *const hci_dev = DEVICE_DT_GET(DT_DRV_INST(0));

static void *evt_create(struct net_buf **buf, uint8_t evt, uint8_t len)
{
	struct bt_hci_evt_hdr *hdr;

	*buf = bt_buf_get_evt(evt, false, K_FOREVER);
	hdr = net_buf_add(*buf, sizeof(*hdr));
	hdr->evt = evt;
	hdr->len = len;

	return net_buf_add(*buf, len);
}

static void *cmd_complete(struct net_buf **buf, uint16_t opcode, uint8_t ncmd, uint8_t plen)
{
	struct bt_hci_evt_cmd_complete *cc;

	cc = evt_create(buf, BT_HCI_EVT_CMD_COMPLETE, sizeof(*cc) + plen);
	cc->ncmd = ncmd;
	cc->opcode = sys_cpu_to_le16(opcode);
	(void)memset(&cc[1], 0, plen);

	return &cc[1];
}

void test_cmd_respond(struct test_cmd_script *script)
{
	struct net_buf *evt;

	if (script == &test_disconnect) {
		struct bt_hci_evt_cmd_status *status;

		status = evt_create(&evt, BT_HCI_EVT_CMD_STATUS, sizeof(*status));
		status->status = script->status;
		status->ncmd = script->ncmd;
		status->opcode = sys_cpu_to_le16(BT_HCI_OP_DISCONNECT);
		bt_hci_recv(hci_dev, evt);

		if (script->status == BT_HCI_ERR_SUCCESS) {
			test_disconnect_complete(BT_HCI_ERR_LOCALHOST_TERM_CONN);
		}
	} else {
		uint8_t *rp;

		rp = cmd_complete(&evt, TEST_OPCODE, script->ncmd, 1U + script->rp_len);
		rp[0] = script->status;
		for (uint8_t i = 0U; i < script->rp_len; i++) {
			rp[1U + i] = i;
		}

		bt_hci_recv(hci_dev, evt);
	}

	script->rsp_count++;
	k_sem_give(&script_sem);
}

static int script_wait(const unsigned int *counter, unsigned int count)
{
	while (*counter < count) {
		if (k_sem_take(&script_sem, TEST_TIMEOUT) != 0) {
			return -EAGAIN;
		}
	}

	return 0;
}

int test_cmd_wait(const struct test_cmd_script *script, unsigned int count)
{
	return script_wait(&script->count, count);
}

void test_settle(void)
{
	/* No time passes on native_sim while a thread runs, so a sleep of one
	 * tick returns only once every thread that was ready has run until it
	 * waits.
	 */
	(void)k_sleep(K_TICKS(1));
}

unsigned int test_cmd_bufs_hold(void)
{
	unsigned int count = 0U;

	ARRAY_FOR_EACH(test_cmd_bufs, i) {
		test_cmd_bufs[i] = bt_hci_cmd_alloc(K_NO_WAIT);
		if (test_cmd_bufs[i] == NULL) {
			break;
		}

		count++;
	}

	zassert_true(count < ARRAY_SIZE(test_cmd_bufs),
		     "The Host has more command buffers than expected");

	return count;
}

void test_cmd_bufs_release(void)
{
	ARRAY_FOR_EACH(test_cmd_bufs, i) {
		net_buf_drop(&test_cmd_bufs[i]);
	}
}

void test_credit_grant(void)
{
	struct net_buf *evt;

	(void)cmd_complete(&evt, 0U, 1U, 0U);
	bt_hci_recv(hci_dev, evt);
}

bool test_with_reset(const void *state)
{
	ARG_UNUSED(state);

	return TEST_DRIVER_RESETS;
}

bool test_without_reset(const void *state)
{
	ARG_UNUSED(state);

	return !TEST_DRIVER_RESETS;
}

static void cmd_rsp_handler(struct k_work *work)
{
	ARG_UNUSED(work);

	test_cmd_respond(&test_cmd);
}

static void disconnect_rsp_handler(struct k_work *work)
{
	ARG_UNUSED(work);

	test_cmd_respond(&test_disconnect);
}

static K_WORK_DELAYABLE_DEFINE(cmd_rsp_work, cmd_rsp_handler);
static K_WORK_DELAYABLE_DEFINE(disconnect_rsp_work, disconnect_rsp_handler);

static void scripted(struct test_cmd_script *script, struct k_work_delayable *work)
{
	script->count++;
	k_sem_give(&script_sem);

	if (K_TIMEOUT_EQ(script->delay, K_NO_WAIT)) {
		test_cmd_respond(script);
	} else if (!K_TIMEOUT_EQ(script->delay, K_FOREVER)) {
		(void)k_work_schedule(work, script->delay);
	} else {
		/* The test responds with test_cmd_respond() */
	}
}

void test_connect(void)
{
	/* A static random address, as its two most significant bits say */
	const bt_addr_le_t peer = {
		.type = BT_ADDR_LE_RANDOM,
		.a.val = { 0x01U, 0x02U, 0x03U, 0x04U, 0x05U, 0xc6U },
	};
	struct bt_hci_evt_le_conn_complete *cc;
	struct bt_hci_evt_le_meta_event *meta;
	struct net_buf *evt;

	meta = evt_create(&evt, BT_HCI_EVT_LE_META_EVENT, sizeof(*meta) + sizeof(*cc));
	meta->subevent = BT_HCI_EVT_LE_CONN_COMPLETE;
	cc = (void *)&meta[1];
	(void)memset(cc, 0, sizeof(*cc));
	cc->status = BT_HCI_ERR_SUCCESS;
	cc->handle = sys_cpu_to_le16(TEST_CONN_HANDLE);
	cc->role = BT_HCI_ROLE_PERIPHERAL;
	bt_addr_le_copy(&cc->peer_addr, &peer);
	cc->interval = sys_cpu_to_le16(BT_GAP_INIT_CONN_INT_MIN);
	/* Any valid value: the test controller does not supervise the connection */
	cc->supv_timeout = sys_cpu_to_le16(BT_GAP_MS_TO_CONN_TIMEOUT(4000U));

	bt_hci_recv(hci_dev, evt);
}

void test_disconnect_complete(uint8_t reason)
{
	struct bt_hci_evt_disconn_complete *complete;
	struct net_buf *evt;

	complete = evt_create(&evt, BT_HCI_EVT_DISCONN_COMPLETE, sizeof(*complete));
	complete->status = BT_HCI_ERR_SUCCESS;
	complete->handle = sys_cpu_to_le16(TEST_CONN_HANDLE);
	complete->reason = reason;

	bt_hci_recv(hci_dev, evt);
}

static void cmd_handle(struct net_buf *cmd)
{
	struct bt_hci_cmd_hdr *chdr;
	struct net_buf *evt;
	uint16_t opcode;
	uint8_t *rp;

	chdr = net_buf_pull_mem(cmd, sizeof(*chdr));
	opcode = sys_le16_to_cpu(chdr->opcode);

	switch (opcode) {
	case TEST_OPCODE:
		if (test_cmd.count < ARRAY_SIZE(test_cmd_plen)) {
			test_cmd_plen[test_cmd.count] = (uint8_t)cmd->len;
		}

		scripted(&test_cmd, &cmd_rsp_work);
		return;
	case BT_HCI_OP_DISCONNECT:
		scripted(&test_disconnect, &disconnect_rsp_work);
		return;
	case BT_HCI_OP_RESET:
		test_reset_count++;
		break;
	default:
		break;
	}

	rp = cmd_complete(&evt, opcode, 1U, GENERIC_RP_SIZE);

	switch (opcode) {
	case BT_HCI_OP_READ_LOCAL_FEATURES: {
		struct bt_hci_rp_read_local_features *features = (void *)rp;

		/* LE supported and BR/EDR not supported */
		features->features[4] = BIT(5) | BIT(6);
		break;
	}
	case BT_HCI_OP_READ_SUPPORTED_COMMANDS: {
		struct bt_hci_rp_read_supported_commands *commands = (void *)rp;

		(void)memset(commands->commands, 0xFF, sizeof(commands->commands));
		break;
	}
	case BT_HCI_OP_READ_BD_ADDR: {
		struct bt_hci_rp_read_bd_addr *addr = (void *)rp;

		(void)memset(&addr->bdaddr, 0x11, sizeof(addr->bdaddr));
		break;
	}
	case BT_HCI_OP_LE_READ_BUFFER_SIZE: {
		struct bt_hci_rp_le_read_buffer_size *size = (void *)rp;

		size->le_max_len = sys_cpu_to_le16(LE_ACL_MAX_LEN);
		size->le_max_num = LE_ACL_MAX_NUM;
		break;
	}
	case BT_HCI_OP_LE_READ_SUPP_STATES: {
		struct bt_hci_rp_le_read_supp_states *states = (void *)rp;

		(void)memset(states->le_states, 0xFF, sizeof(states->le_states));
		break;
	}
	default:
		break;
	}

	bt_hci_recv(hci_dev, evt);
}

static int send_err(const struct net_buf *buf)
{
	uint16_t opcode = sys_get_le16(buf->data);

	if (opcode == TEST_OPCODE) {
		return test_cmd.send_err;
	}

	if (opcode == BT_HCI_OP_DISCONNECT) {
		return test_disconnect.send_err;
	}

	return 0;
}

static int driver_open(const struct device *dev)
{
	ARG_UNUSED(dev);

	return 0;
}

static int driver_close(const struct device *dev)
{
	ARG_UNUSED(dev);

	test_close_count++;

	return 0;
}

static int driver_send(const struct device *dev, struct net_buf *buf)
{
	ARG_UNUSED(dev);

	if (buf->data[0] == BT_HCI_H4_CMD) {
		int err;

		(void)net_buf_pull_u8(buf);

		err = send_err(buf);
		if (err != 0) {
			/* The buffer stays with the caller */
			return err;
		}

		cmd_handle(buf);
	}

	net_buf_unref(buf);

	return 0;
}

static DEVICE_API(bt_hci, driver_api) = {
	.open = driver_open,
	.close = driver_close,
	.send = driver_send,
};

void test_driver_reset(void)
{
	static const struct test_cmd_script respond_at_once = {
		.delay = K_NO_WAIT,
		.status = BT_HCI_ERR_SUCCESS,
		.ncmd = 1U,
	};

	(void)k_work_cancel_delayable(&cmd_rsp_work);
	(void)k_work_cancel_delayable(&disconnect_rsp_work);

	test_cmd = respond_at_once;
	test_disconnect = respond_at_once;
	test_reset_count = 0U;
	test_close_count = 0U;
	k_sem_reset(&script_sem);
}

void test_driver_release(void)
{
	bool is_cmd_held = (test_cmd.rsp_count < test_cmd.count);
	bool is_disconnect_held = (test_disconnect.rsp_count < test_disconnect.count);

	test_driver_reset();

	if (is_cmd_held) {
		test_cmd_respond(&test_cmd);
	}

	if (is_disconnect_held) {
		test_cmd_respond(&test_disconnect);
	}

	test_credit_grant();
}

#define TEST_DEVICE_INIT(inst)                                                                     \
	static struct bt_hci_driver_data driver_data_##inst = { 0 };                               \
	static const struct bt_hci_driver_config driver_config_##inst =                            \
		BT_DT_HCI_DRIVER_CONFIG_INST_GET(inst);                                            \
	DEVICE_DT_INST_DEFINE(inst, NULL, NULL, &driver_data_##inst, &driver_config_##inst,        \
			      POST_KERNEL, CONFIG_KERNEL_INIT_PRIORITY_DEVICE, &driver_api)

DT_INST_FOREACH_STATUS_OKAY(TEST_DEVICE_INIT)
```

## src/driver.h
```c
/*
 * SPDX-FileCopyrightText: Copyright (c) 2026 Silicon Laboratories Inc.
 * SPDX-License-Identifier: Apache-2.0
 */

#ifndef TESTS_BLUETOOTH_HOST_CMD_SRC_DRIVER_H_
#define TESTS_BLUETOOTH_HOST_CMD_SRC_DRIVER_H_

#include <stdbool.h>
#include <stdint.h>

#include <zephyr/bluetooth/hci_types.h>
#include <zephyr/devicetree.h>
#include <zephyr/kernel.h>
#include <zephyr/net_buf.h>

/* A vendor command that only the tests send */
#define TEST_OPCODE BT_OP(BT_OGF_VS, 0x03f0U)

/* How long a test waits for something that happens without time passing, as
 * a response from within send() or a work item that is due: the bound only
 * turns a hang into a failure.
 */
#define TEST_TIMEOUT K_SECONDS(1)

/* The command deadline of the Host in milliseconds. HCI_CMD_TIMEOUT comes from
 * hci_core.h, which the sources include themselves: it has no include guard.
 */
#define TEST_DEADLINE_MS ((int64_t)k_ticks_to_ms_floor64(HCI_CMD_TIMEOUT.ticks))

/* How far a measured wait for the deadline may be off: more than the few
 * ticks that the Host takes to act on the expiry and the waiter to return.
 */
#define TEST_DEADLINE_SLACK_MS 100U

/* A wait that is to end with the deadline gives up this much later */
#define TEST_PAST_DEADLINE K_MSEC(TEST_DEADLINE_MS + MSEC_PER_SEC)

/* More than the Host has command buffers in any configuration of the suites */
#define TEST_CMD_BUF_MAX 32U

/* How many TEST_OPCODE commands the controller keeps the parameter length of */
#define TEST_CMD_PLEN_MAX 4U

/* The handle of the connection that test_connect() brings up */
#define TEST_CONN_HANDLE 0x0001U

/** What the test controller does with one command. It responds to every
 *  other command with success and one command credit from within send().
 */
struct test_cmd_script {
	/** When the response comes: K_NO_WAIT from within send(), K_FOREVER never */
	k_timeout_t delay;
	/** Status of the response */
	uint8_t status;
	/** Num_HCI_Command_Packets of the response */
	uint8_t ncmd;
	/** Length of the return parameters after the status (TEST_OPCODE only) */
	uint8_t rp_len;
	/** The return parameters repeat the first parameter byte of the command
	 *  instead of counting up (TEST_OPCODE only)
	 */
	bool echo;
	/** What send() returns instead of taking the command, if not 0 */
	int send_err;
	/** How often the controller has been given the command */
	unsigned int count;
	/** How often the controller has responded to the command */
	unsigned int rsp_count;
};

/** TEST_OPCODE, whose response is a Command Complete event */
extern struct test_cmd_script test_cmd;

/** Parameter length of the first few TEST_OPCODE commands the controller got */
extern uint8_t test_cmd_plen[TEST_CMD_PLEN_MAX];

/** HCI Disconnect, whose response is a Command Status event, followed by a
 *  Disconnection Complete event when the status is success.
 */
extern struct test_cmd_script test_disconnect;

/** How often the controller has been reset and the transport closed */
extern unsigned int test_reset_count;
extern unsigned int test_close_count;

/** Back to a controller that responds at once, counters at zero */
void test_driver_reset(void);

/** As test_driver_reset(), and respond to a command that the controller holds
 *  and grant a command credit: what a failed test leaves for bt_disable(),
 *  whose HCI Reset is to get through.
 */
void test_driver_release(void);

/** Deliver the response of a scripted command now */
void test_cmd_respond(struct test_cmd_script *script);

/** Wait until the controller has been given @p count commands of @p script.
 *
 *  @retval 0 It has.
 *  @retval -EAGAIN It has not within TEST_TIMEOUT of the last one.
 */
int test_cmd_wait(const struct test_cmd_script *script, unsigned int count);

/** Wait until the controller has responded @p count times to the commands of
 *  @p script.
 *
 *  @retval 0 It has.
 *  @retval -EAGAIN It has not within TEST_TIMEOUT of the last response.
 */
int test_rsp_wait(const struct test_cmd_script *script, unsigned int count);

/** Wait until @p queue has run what has been submitted to it */
void test_workq_flush(struct k_work_q *queue);

/** Wait until the Bluetooth workqueue has run what has been submitted to it */
void test_bt_workq_flush(void);

/** Let every thread run until it waits, for a check of something that nothing
 *  signals: a command that must not have been sent, or a thread that is to
 *  have blocked.
 */
void test_settle(void);

/** Command buffers that a test holds, NULL where none is held */
extern struct net_buf *test_cmd_bufs[TEST_CMD_BUF_MAX];

/** Take every free command buffer into test_cmd_bufs.
 *
 *  @return How many there were.
 */
unsigned int test_cmd_bufs_hold(void);

/** Free the command buffers in test_cmd_bufs */
void test_cmd_bufs_release(void);

/** Check that the command pool has all of its buffers, and counts them right */
void test_cmd_pool_check(void);

/** Deliver a Command Complete event for no command that grants a command credit */
void test_credit_grant(void);

/** Deliver a Command Complete event for no command that takes the credit back */
void test_credit_revoke(void);

/** Whether the Host resets the test controller, which it does unless the
 *  devicetree gives the controller the "no-reset" quirk.
 */
#define TEST_DRIVER_RESETS (!DT_NODE_HAS_PROP(DT_NODELABEL(bt_hci_test), bt_hci_quirks))

/** Suite predicates: most suites need the reset, one cannot do with it */
bool test_with_reset(const void *state);
bool test_without_reset(const void *state);

/** Deliver an LE Connection Complete event for TEST_CONN_HANDLE, peripheral role */
void test_connect(void);

/** Deliver a Disconnection Complete event for TEST_CONN_HANDLE */
void test_disconnect_complete(uint8_t reason);

#endif /* TESTS_BLUETOOTH_HOST_CMD_SRC_DRIVER_H_ */
```
