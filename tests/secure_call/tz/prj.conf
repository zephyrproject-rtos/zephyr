## CMakeLists.txt
```
# SPDX-FileCopyrightText: Copyright (c) 2026 Infineon Technologies AG,
# SPDX-FileCopyrightText: or an affiliate of Infineon Technologies AG. All rights reserved.
#
# SPDX-License-Identifier: Apache-2.0

cmake_minimum_required(VERSION 3.20.0)

# In a sysbuild run the S image builds in a sibling directory named "secure_s".
# Point tz/CMakeLists.txt at that directory so it can find libentryveneers.a.
cmake_path(GET CMAKE_CURRENT_BINARY_DIR PARENT_PATH _sb_root)
set(ARM_VENEERS_LIB_DIR "${_sb_root}/secure_s" CACHE PATH
    "Directory containing libentryveneers.a from the Secure image build" FORCE)

find_package(Zephyr REQUIRED HINTS $ENV{ZEPHYR_BASE})
project(secure_call_tz_ns)

target_sources(app PRIVATE src/main.c)
```

## Kconfig
```
# SPDX-FileCopyrightText: Copyright (c) 2026 Infineon Technologies AG,
# SPDX-FileCopyrightText: or an affiliate of Infineon Technologies AG. All rights reserved.
#
# SPDX-License-Identifier: Apache-2.0

mainmenu "Secure Call TrustZone Integration Tests"

source "Kconfig.zephyr"
```

## prj.conf
```kconfig
# SPDX-FileCopyrightText: Copyright (c) 2026 Infineon Technologies AG,
# SPDX-FileCopyrightText: or an affiliate of Infineon Technologies AG. All rights reserved.
#
# SPDX-License-Identifier: Apache-2.0

# Non-Secure image: plain Zephyr, no TF-M, uses __secure_call veneers.
CONFIG_BUILD_WITH_TFM=n
CONFIG_APPLICATION_DEFINED_SYSCALL=y
CONFIG_ARM_FIRMWARE_USES_SECURE_CALLS=y
```

## boards/kit_pse84_eval_pse846gps2dbzc4a_m33_ns.conf
```kconfig
# SPDX-FileCopyrightText: Copyright (c) 2026 Infineon Technologies AG,
# SPDX-FileCopyrightText: or an affiliate of Infineon Technologies AG. All rights reserved.
#
# SPDX-License-Identifier: Apache-2.0

CONFIG_BUILD_WITH_TFM=n
CONFIG_APPLICATION_DEFINED_SYSCALL=y
CONFIG_ARM_FIRMWARE_USES_SECURE_CALLS=y
```

## src/main.c
```c
/*
 * SPDX-FileCopyrightText: Copyright (c) 2026 Infineon Technologies AG,
 * SPDX-FileCopyrightText: or an affiliate of Infineon Technologies AG. All rights reserved.
 *
 * SPDX-License-Identifier: Apache-2.0
 *
 * Non-Secure integration test: exercises the three __secure_call shapes by
 * crossing the TrustZone boundary into the Secure world via CMSE veneers.
 * Output lines are read by pytest/test_tz_calls.py to verify correctness.
 */

#include <zephyr/kernel.h>
#include <zephyr/secure_call.h>
#include "test_calls.h"

int main(void)
{
	printk("NS: starting secure call integration test\n");

	/* sc_add: two scalar args, non-void return */
	int sum = sc_add(3, 4);

	printk("SC_ADD: %d\n", sum);

	/* sc_nop: zero args, non-void return */
	int nop_ret = sc_nop();

	printk("SC_NOP: %d\n", nop_ret);

	/* sc_fill: void return, pointer + size args */
	uint8_t buf[4] = {0xFF, 0xFF, 0xFF, 0xFF};
	int fill_ok;

	sc_fill(buf, sizeof(buf));
	fill_ok = (buf[0] == 0 && buf[1] == 1 && buf[2] == 2 && buf[3] == 3);
	printk("SC_FILL: %s\n", fill_ok ? "OK" : "FAIL");

	printk("NS: test complete\n");
	return 0;
}
```

## src/test_calls.h
```c
/*
 * SPDX-FileCopyrightText: Copyright (c) 2026 Infineon Technologies AG,
 * SPDX-FileCopyrightText: or an affiliate of Infineon Technologies AG. All rights reserved.
 *
 * SPDX-License-Identifier: Apache-2.0
 */

#ifndef TESTS_SECURE_CALL_TZ_TEST_CALLS_H_
#define TESTS_SECURE_CALL_TZ_TEST_CALLS_H_

#include <stdint.h>
#include <zephyr/toolchain.h>

__secure_call int sc_add(int a, int b);
__secure_call void sc_fill(uint8_t *buf, size_t len);
__secure_call int sc_nop(void);

/* Generated NS-side inline wrappers */
#include <zephyr/secure_calls/test_calls.h>

#endif /* TESTS_SECURE_CALL_TZ_TEST_CALLS_H_ */
```
