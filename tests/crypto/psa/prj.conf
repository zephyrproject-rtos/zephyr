## CMakeLists.txt
```
# Copyright (c) 2024 Nordic Semiconductor ASA
# SPDX-License-Identifier: Apache-2.0


cmake_minimum_required(VERSION 3.28.0)
find_package(Zephyr REQUIRED HINTS $ENV{ZEPHYR_BASE})
project(mbedtls)

target_sources(app PRIVATE src/main.c)

target_sources_ifdef(CONFIG_MBEDTLS_THREADING_ALT
  app PRIVATE src/thread_test.c
)
```

## prj.conf
```kconfig
CONFIG_ZTEST=y
CONFIG_PSA_CRYPTO=y
CONFIG_MBEDTLS_PSA_STATIC_KEY_SLOTS=y

CONFIG_PSA_WANT_ALG_SHA_1=y
CONFIG_PSA_WANT_ALG_SHA_224=y
CONFIG_PSA_WANT_ALG_SHA_256=y
CONFIG_PSA_WANT_ALG_SHA_384=y
CONFIG_PSA_WANT_ALG_SHA_512=y

CONFIG_PSA_WANT_ALG_HMAC=y
CONFIG_PSA_WANT_KEY_TYPE_HMAC=y

CONFIG_PSA_WANT_KEY_TYPE_AES=y
CONFIG_PSA_WANT_ALG_ECB_NO_PADDING=y
```

## boards/frdm_mcxa266.conf
```kconfig
# The SGI PKC PSA crypto driver builds its CPU/PKC workareas on the stack of the
# thread running the PSA operation, so both the main thread (psa_crypto_init())
# and the ztest thread need more room than the common values in prj.conf.
CONFIG_MAIN_STACK_SIZE=4096
CONFIG_ZTEST_STACK_SIZE=4096
```

## boards/rd_rw612_bga.conf
```kconfig
# The ELS PKC PSA crypto driver builds its CPU/PKC workareas on the stack of the
# thread running the PSA operation, so both the main thread (psa_crypto_init())
# and the ztest thread need more room than the common values in prj.conf.
CONFIG_MAIN_STACK_SIZE=4096
CONFIG_ZTEST_STACK_SIZE=4096
```

## src/main.c
```c
/*
 * Copyright (c) 2024 Nordic Semiconductor ASA
 *
 * SPDX-License-Identifier: Apache-2.0
 */

/*
 * Test psa_crypto_init() and psa_generate_random() on the PSA implementation
 * provided by Mbed TLS (platforms using TFM are filtered out in the yaml file).
 */

#include <zephyr/ztest.h>

#include <psa/crypto.h>

ZTEST_USER(psa_crypto_test_suite, test_generate_random)
{
	uint8_t tmp[64];
	psa_status_t status;

	status = psa_generate_random(tmp, sizeof(tmp));
	zassert_equal(status, PSA_SUCCESS);
}

ZTEST_USER(psa_crypto_test_suite, test_sha1)
{
	uint8_t in_buf[] = { 'a' };
	uint8_t out_buf[PSA_HASH_LENGTH(PSA_ALG_SHA_1)] = { 0 };
	uint8_t out_buf_ref[PSA_HASH_LENGTH(PSA_ALG_SHA_1)] = {
		0x86, 0xf7, 0xe4, 0x37, 0xfa, 0xa5, 0xa7, 0xfc, 0xe1, 0x5d,
		0x1d, 0xdc, 0xb9, 0xea, 0xea, 0xea, 0x37, 0x76, 0x67, 0xb8
	};
	size_t out_len;
	psa_status_t status;

	status = psa_hash_compute(PSA_ALG_SHA_1, in_buf, sizeof(in_buf),
				  out_buf, sizeof(out_buf), &out_len);
	zassert_equal(status, PSA_SUCCESS);
	zassert_mem_equal(out_buf, out_buf_ref, sizeof(out_buf_ref));
}

ZTEST_USER(psa_crypto_test_suite, test_sha224)
{
	uint8_t in_buf[] = { 'a' };
	uint8_t out_buf[PSA_HASH_LENGTH(PSA_ALG_SHA_224)] = { 0 };
	uint8_t out_buf_ref[PSA_HASH_LENGTH(PSA_ALG_SHA_224)] = {
		0xab, 0xd3, 0x75, 0x34, 0xc7, 0xd9, 0xa2, 0xef, 0xb9, 0x46,
		0x5d, 0xe9, 0x31, 0xcd, 0x70, 0x55, 0xff, 0xdb, 0x88, 0x79,
		0x56, 0x3a, 0xe9, 0x80, 0x78, 0xd6, 0xd6, 0xd5
	};
	size_t out_len;
	psa_status_t status;

	status = psa_hash_compute(PSA_ALG_SHA_224, in_buf, sizeof(in_buf),
				  out_buf, sizeof(out_buf), &out_len);
	zassert_equal(status, PSA_SUCCESS);
	zassert_mem_equal(out_buf, out_buf_ref, sizeof(out_buf_ref));
}

ZTEST_USER(psa_crypto_test_suite, test_sha256)
{
	uint8_t in_buf[] = { 'a' };
	uint8_t out_buf[PSA_HASH_LENGTH(PSA_ALG_SHA_256)] = { 0 };
	uint8_t out_buf_ref[PSA_HASH_LENGTH(PSA_ALG_SHA_256)] = {
		0xca, 0x97, 0x81, 0x12, 0xca, 0x1b, 0xbd, 0xca, 0xfa, 0xc2,
		0x31, 0xb3, 0x9a, 0x23, 0xdc, 0x4d, 0xa7, 0x86, 0xef, 0xf8,
		0x14, 0x7c, 0x4e, 0x72, 0xb9, 0x80, 0x77, 0x85, 0xaf, 0xee,
		0x48, 0xbb
	};
	size_t out_len;
	psa_status_t status;

	status = psa_hash_compute(PSA_ALG_SHA_256, in_buf, sizeof(in_buf),
				  out_buf, sizeof(out_buf), &out_len);
	zassert_equal(status, PSA_SUCCESS);
	zassert_mem_equal(out_buf, out_buf_ref, sizeof(out_buf_ref));
}

ZTEST_USER(psa_crypto_test_suite, test_sha384)
{
	uint8_t in_buf[] = { 'a' };
	uint8_t out_buf[PSA_HASH_LENGTH(PSA_ALG_SHA_384)] = { 0 };
	uint8_t out_buf_ref[PSA_HASH_LENGTH(PSA_ALG_SHA_384)] = {
		0x54, 0xa5, 0x9b, 0x9f, 0x22, 0xb0, 0xb8, 0x08, 0x80, 0xd8,
		0x42, 0x7e, 0x54, 0x8b, 0x7c, 0x23, 0xab, 0xd8, 0x73, 0x48,
		0x6e, 0x1f, 0x03, 0x5d, 0xce, 0x9c, 0xd6, 0x97, 0xe8, 0x51,
		0x75, 0x03, 0x3c, 0xaa, 0x88, 0xe6, 0xd5, 0x7b, 0xc3, 0x5e,
		0xfa, 0xe0, 0xb5, 0xaf, 0xd3, 0x14, 0x5f, 0x31
	};
	size_t out_len;
	psa_status_t status;

	status = psa_hash_compute(PSA_ALG_SHA_384, in_buf, sizeof(in_buf),
				  out_buf, sizeof(out_buf), &out_len);
	zassert_equal(status, PSA_SUCCESS);
	zassert_mem_equal(out_buf, out_buf_ref, sizeof(out_buf_ref));
}

ZTEST_USER(psa_crypto_test_suite, test_sha512)
{
	uint8_t in_buf[] = { 'a' };
	uint8_t out_buf[PSA_HASH_LENGTH(PSA_ALG_SHA_512)] = { 0 };
	uint8_t out_buf_ref[PSA_HASH_LENGTH(PSA_ALG_SHA_512)] = {
		0x1f, 0x40, 0xfc, 0x92, 0xda, 0x24, 0x16, 0x94, 0x75, 0x09,
		0x79, 0xee, 0x6c, 0xf5, 0x82, 0xf2, 0xd5, 0xd7, 0xd2, 0x8e,
		0x18, 0x33, 0x5d, 0xe0, 0x5a, 0xbc, 0x54, 0xd0, 0x56, 0x0e,
		0x0f, 0x53, 0x02, 0x86, 0x0c, 0x65, 0x2b, 0xf0, 0x8d, 0x56,
		0x02, 0x52, 0xaa, 0x5e, 0x74, 0x21, 0x05, 0x46, 0xf3, 0x69,
		0xfb, 0xbb, 0xce, 0x8c, 0x12, 0xcf, 0xc7, 0x95, 0x7b, 0x26,
		0x52, 0xfe, 0x9a, 0x75
	};
	size_t out_len;
	psa_status_t status;

	status = psa_hash_compute(PSA_ALG_SHA_512, in_buf, sizeof(in_buf),
				  out_buf, sizeof(out_buf), &out_len);
	zassert_equal(status, PSA_SUCCESS);
	zassert_mem_equal(out_buf, out_buf_ref, sizeof(out_buf_ref));
}

ZTEST_USER(psa_crypto_test_suite, test_hmac_sha256)
{
	uint8_t key[] = { 'a' };
	psa_key_attributes_t key_attr = PSA_KEY_ATTRIBUTES_INIT;
	psa_key_id_t key_id = PSA_KEY_ID_NULL;
	uint8_t in_buf[] = { 'a' };
	uint8_t out_buf[PSA_HASH_LENGTH(PSA_ALG_SHA_256)] = { 0 };
	uint8_t out_buf_ref[PSA_HASH_LENGTH(PSA_ALG_SHA_256)] = {
		0x3e, 0xcf, 0x53, 0x88, 0xe2, 0x20, 0xda, 0x9e,
		0x0f, 0x91, 0x94, 0x85, 0xde, 0xb6, 0x76, 0xd8,
		0xbe, 0xe3, 0xae, 0xc0, 0x46, 0xa7, 0x79, 0x35,
		0x3b, 0x46, 0x34, 0x18, 0x51, 0x1e, 0xe6, 0x22
	};
	size_t out_len;
	psa_status_t status;

	psa_set_key_type(&key_attr, PSA_KEY_TYPE_HMAC);
	psa_set_key_algorithm(&key_attr, PSA_ALG_HMAC(PSA_ALG_SHA_256));
	psa_set_key_usage_flags(&key_attr, PSA_KEY_USAGE_SIGN_MESSAGE);

	status = psa_import_key(&key_attr, key, sizeof(key), &key_id);
	zassert_equal(status, PSA_SUCCESS);

	status = psa_mac_compute(key_id, PSA_ALG_HMAC(PSA_ALG_SHA_256),
				 in_buf, sizeof(in_buf),
				 out_buf, sizeof(out_buf), &out_len);
	zassert_equal(status, PSA_SUCCESS);
	zassert_mem_equal(out_buf, out_buf_ref, sizeof(out_buf_ref));

	status = psa_destroy_key(key_id);
	zassert_equal(status, PSA_SUCCESS);
}

ZTEST_USER(psa_crypto_test_suite, test_aes_ecb)
{
	uint8_t key[] = {0x0, 0x1, 0x2, 0x3, 0x4, 0x5, 0x6, 0x7,
			 0x8, 0x9, 0xa, 0xb, 0xc, 0xd, 0xe, 0xf};
	psa_key_attributes_t key_attr = PSA_KEY_ATTRIBUTES_INIT;
	psa_key_id_t key_id = PSA_KEY_ID_NULL;
	uint8_t in_buf[PSA_BLOCK_CIPHER_BLOCK_LENGTH(PSA_KEY_TYPE_AES)];
#define AES_ENCRYPTED_OUTPUT_SIZE \
	PSA_CIPHER_ENCRYPT_OUTPUT_SIZE(PSA_KEY_TYPE_AES, PSA_ALG_ECB_NO_PADDING, sizeof(in_buf))
	uint8_t out_buf[AES_ENCRYPTED_OUTPUT_SIZE] = { 0 };
	uint8_t out_buf_ref[AES_ENCRYPTED_OUTPUT_SIZE] = {
		0xea, 0x5e, 0x61, 0xae, 0x81, 0x67, 0xca, 0xa0,
		0x58, 0x63, 0x88, 0xeb, 0x9a, 0x7c, 0xb7, 0x55
	};
#define AES_DECRYPTED_OUTPUT_SIZE \
	PSA_CIPHER_DECRYPT_OUTPUT_SIZE(PSA_KEY_TYPE_AES, PSA_ALG_ECB_NO_PADDING, \
				       AES_ENCRYPTED_OUTPUT_SIZE)
	uint8_t dec_buf[AES_DECRYPTED_OUTPUT_SIZE] = { 0 };
	size_t out_len;
	psa_status_t status;

	memset(in_buf, 0x5, sizeof(in_buf));

	psa_set_key_type(&key_attr, PSA_KEY_TYPE_AES);
	psa_set_key_algorithm(&key_attr, PSA_ALG_ECB_NO_PADDING);
	psa_set_key_usage_flags(&key_attr, PSA_KEY_USAGE_ENCRYPT | PSA_KEY_USAGE_DECRYPT);
	status = psa_import_key(&key_attr, key, sizeof(key), &key_id);
	zassert_equal(status, PSA_SUCCESS);

	status = psa_cipher_encrypt(key_id, PSA_ALG_ECB_NO_PADDING, in_buf, sizeof(in_buf),
				    out_buf, sizeof(out_buf), &out_len);
	zassert_equal(status, PSA_SUCCESS);

	zassert_mem_equal(out_buf, out_buf_ref, sizeof(out_buf_ref));

	status = psa_cipher_decrypt(key_id, PSA_ALG_ECB_NO_PADDING, out_buf_ref,
				    sizeof(out_buf_ref), dec_buf, sizeof(dec_buf), &out_len);
	zassert_equal(status, PSA_SUCCESS);
	zassert_equal(out_len, sizeof(in_buf));
	zassert_mem_equal(dec_buf, in_buf, sizeof(in_buf));

	status = psa_destroy_key(key_id);
	zassert_equal(status, PSA_SUCCESS);
}

ZTEST_SUITE(psa_crypto_test_suite, NULL, NULL, NULL, NULL, NULL);
```

## src/thread_test.c
```c
/*
 * SPDX-FileCopyrightText: Copyright (c) 2026 STMicroelectronics
 * SPDX-License-Identifier: Apache-2.0
 */

#include <zephyr/ztest.h>
#include <mbedtls/threading.h>

/*
 * Mutex test sequence dumped from TF PSA Crypt test environment
 */

ZTEST_USER(psa_crypto_test_suite, test_mbedtls_mutex_nominal)
{
	mbedtls_threading_mutex_t mutex;

	mbedtls_mutex_init(&mutex);

	for (int i = 0; i < 5; i++) {
		zassert_ok(mbedtls_mutex_lock(&mutex));
		zassert_ok(mbedtls_mutex_unlock(&mutex), 0);
	}

	mbedtls_mutex_free(&mutex);
}

ZTEST_USER(psa_crypto_test_suite, test_mbedtls_mutex_no_init)
{
	mbedtls_threading_mutex_t mutex;

	memset(&mutex, 0, sizeof(mutex));
	zassert_equal(mbedtls_mutex_lock(&mutex), MBEDTLS_ERR_THREADING_USAGE_ERROR);
	zassert_equal(mbedtls_mutex_unlock(&mutex), MBEDTLS_ERR_THREADING_USAGE_ERROR);
	mbedtls_mutex_free(&mutex);
}

ZTEST_USER(psa_crypto_test_suite, test_mbedtls_mutex_unbalanced_unlock)
{
	mbedtls_threading_mutex_t mutex;

	mbedtls_mutex_init(&mutex);
	mbedtls_mutex_free(&mutex);
	zassert_equal(mbedtls_mutex_lock(&mutex), MBEDTLS_ERR_THREADING_USAGE_ERROR);
	zassert_equal(mbedtls_mutex_unlock(&mutex), MBEDTLS_ERR_THREADING_USAGE_ERROR);
	mbedtls_mutex_free(&mutex);
}

ZTEST_USER(psa_crypto_test_suite, test_mbedtls_condvar_nominal)
{
	mbedtls_threading_condition_variable_t cond;

	mbedtls_condition_variable_init(&cond);
	zassert_ok(mbedtls_condition_variable_signal(&cond));
	zassert_ok(mbedtls_condition_variable_broadcast(&cond));
	mbedtls_condition_variable_free(&cond);
}

/*
 * Test mutex and condvar using the ztest thread and a conpanion test thread,
 * synchornised using mbedtls mutex and condvar resources.
 */

static mbedtls_threading_condition_variable_t test_thread_condvar;
static mbedtls_threading_mutex_t test_thread_mutex;
K_THREAD_STACK_DEFINE(test_thread_stack_area, 512);
static struct k_thread test_thread;
static int test_thread_step;

void test_thread_func(void *p1, void *p2, void *p3)
{
	ARG_UNUSED(p1);
	ARG_UNUSED(p2);
	ARG_UNUSED(p3);

	/* Active waiting for main thread to reach step 1 */
	while (test_thread_step == 0) {
		k_yield();
	}

	/* Lock mutex to move from step 1 to step 2 */
	mbedtls_mutex_lock(&test_thread_mutex);
	zassert_equal(test_thread_step, 1);
	test_thread_step = 2;

	/* Yielded waiting for main loop to reach step 3 */
	zassert_ok(mbedtls_condition_variable_wait(&test_thread_condvar, &test_thread_mutex));
	zassert_equal(test_thread_step, 3);
	test_thread_step = 4;

	/* Yielded waiting for main loop to reach step 5 */
	zassert_ok(mbedtls_condition_variable_wait(&test_thread_condvar, &test_thread_mutex));
	zassert_equal(test_thread_step, 5);
	test_thread_step = 6;

	mbedtls_mutex_unlock(&test_thread_mutex);
}

ZTEST_USER(psa_crypto_test_suite, test_mbedtls_sync_on_mutex_condvar)
{
	mbedtls_mutex_init(&test_thread_mutex);
	mbedtls_condition_variable_init(&test_thread_condvar);

	k_thread_create(&test_thread, test_thread_stack_area,
			K_THREAD_STACK_SIZEOF(test_thread_stack_area),
			test_thread_func, NULL, NULL, NULL, 10, 0,
			K_FOREVER);
	k_thread_start(&test_thread);

	/*
	 * Main thread(test_main) priority was 10 but ztest thread runs at
	 * priority -1. To run the test smoothly make both main and ztest
	 * threads run at same priority level.
	 */
	k_thread_priority_set(k_current_get(), 10);

	/* Enter test step 1, check test thread reaches step 2 using mutex */
	mbedtls_mutex_lock(&test_thread_mutex);
	zassert_equal(test_thread_step, 0);
	test_thread_step = 1;
	/* Let other thread to opportinuty to execute: test thread shall still wait on mutex */
	k_yield();
	zassert_equal(test_thread_step, 1);
	mbedtls_mutex_unlock(&test_thread_mutex);
	/* Let test thread the opportunity to get the mutex and reach step 2 */
	k_yield();
	zassert_equal(test_thread_step, 2);

	/* Enter test step 3, check test thread reaches step 4 using condvar signal */
	mbedtls_mutex_lock(&test_thread_mutex);
	zassert_equal(test_thread_step, 2);
	test_thread_step = 3;
	mbedtls_mutex_unlock(&test_thread_mutex);
	/* Let other thread to opportinuty to execute: test thread shall still wait on condvar */
	k_yield();
	zassert_equal(test_thread_step, 3);
	zassert_ok(mbedtls_condition_variable_signal(&test_thread_condvar));
	/* Let test thread the opportunity to get the mutex and reach step 4 */
	k_yield();
	zassert_equal(test_thread_step, 4);

	/* Enter test step 5, check test thread reaches step 6 using condvar broadcast */
	mbedtls_mutex_lock(&test_thread_mutex);
	zassert_equal(test_thread_step, 4);
	test_thread_step = 5;
	mbedtls_mutex_unlock(&test_thread_mutex);
	/* Let other thread to opportinuty to execute: test thread shall still wait on condvar */
	k_yield();
	zassert_equal(test_thread_step, 5);
	zassert_ok(mbedtls_condition_variable_broadcast(&test_thread_condvar));
	/* Let test thread the opportunity to get the mutex and reach step 6 */
	k_yield();
	zassert_equal(test_thread_step, 6);

	k_thread_abort(&test_thread);
}
```
