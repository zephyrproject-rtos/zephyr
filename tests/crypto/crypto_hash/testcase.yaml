## tests/crypto/crypto_hash/testcase.yaml
```yaml
tests:
  crypto.hash.mbedtls_shim:
    platform_allow:
      - native_sim
      - nucleo_u575zi_q
    integration_platforms:
      - native_sim
      - nucleo_u575zi_q
    extra_args: EXTRA_CONF_FILE=prj_mtls_shim.conf
    tags: crypto
  crypto.hash:
    platform_allow:
      - esp32_devkitc/esp32/procpu
      - esp32s2_devkitc
      - esp32s3_devkitc/esp32s3/procpu
      - esp32c3_devkitc
      - esp32c6_devkitc/esp32c6/hpcore
      - esp32h2_devkitm
      - sama7g54_ek
    tags: crypto
```

## tests/crypto/ecc_dh/testcase.yaml
```yaml
tests:
  crypto.ecc_dh:
    min_flash: 35
    min_ram: 16
    slow: true
    tags: crypto ecc dh
    timeout: 500
```

## tests/crypto/ecc_dsa/testcase.yaml
```yaml
tests:
  crypto.ecc_dsa:
    min_ram: 16
    tags: crypto ecc dsa
    timeout: 180
```

## tests/crypto/mbedtls/testcase.yaml
```yaml
common:
  min_flash: 65
  min_ram: 36
  tags:
    - crypto
    - mbedtls
    - userspace
  timeout: 400
tests:
  crypto.mbedtls:
    platform_exclude: m2gl025_miv
    extra_configs:
      - CONFIG_COMMON_LIBC_MALLOC_ARENA_SIZE=0
      - arch:riscv64:CONFIG_ZTEST_STACK_SIZE=8192
    integration_platforms:
      - qemu_x86
      - native_sim
```

## tests/crypto/mbedtls_psa/boards/nrf54l15dk_nrf54l15_cpuapp.conf
```kconfig
#
# Copyright (c) 2024 Nordic Semiconductor ASA
#
# SPDX-License-Identifier: LicenseRef-Nordic-5-Clause
#
CONFIG_ENTROPY_GENERATOR=y
```

## tests/crypto/mbedtls_psa/boards/nrf54lm20dk_nrf54lm20b_cpuapp.conf
```kconfig
#
# Copyright (c) 2026 Nordic Semiconductor ASA
#
# SPDX-License-Identifier: LicenseRef-Nordic-5-Clause
#
CONFIG_ENTROPY_GENERATOR=y
```

## tests/crypto/mbedtls_psa/testcase.yaml
```yaml
# The goal here is to showcase that Mbed TLS's PSA crypto implementation can be
# supported on any platform. A very minimal configuration is tested here: simply
# enable support for PSA crypto APIs in Mbed TLS and then test them with:
# - psa_crypto_init() which is required before any PSA crypto operation
# - psa_generate_random() which is always available as long as PSA crypto is
#   initialized.
#
# Since it might take too long to execute this test on all platforms
# supported by Zephyr, we reduce to a very small selected group whose
# characteristics are:
# - no TF-M enabled devices because we assume that the TF-M implementation
#   of PSA crypto is working fine on the platforms that support TF-M.
# - platform should be testable by the CI.
# - pick 1 platform which supports entropy driver and 1 which does not. The
#   latter case will allow to test
#   CONFIG_MBEDTLS_PSA_CRYPTO_EXTERNAL_RNG_ALLOW_NON_CSPRNG.
common:
  filter: not CONFIG_BUILD_WITH_TFM
  tags:
    - mbedtls
    - psa
tests:
  crypto.mbedtls_psa.with_entropy_driver:
    filter: CONFIG_CSPRNG_ENABLED
    # Pick a platform which has an entropy driver and enable it.
    integration_platforms:
      - native_sim/native/64
    extra_configs:
      - CONFIG_ENTROPY_GENERATOR=y
  crypto.mbedtls_psa.without_entropy_driver:
    filter: not CONFIG_CSPRNG_ENABLED
    # Pick a platform which does not have an entropy driver. In this case we
    # enable the timer random generator because it's always available on all
    # platforms.
    # Explicitly select CONFIG_MBEDTLS_PSA_CRYPTO_EXTERNAL_RNG because this is
    # not "automatically selected" when there is CSPRNG available.
    integration_platforms:
      - qemu_x86
    extra_configs:
      - CONFIG_MBEDTLS_PSA_CRYPTO_EXTERNAL_RNG=y
      - CONFIG_MBEDTLS_PSA_CRYPTO_EXTERNAL_RNG_ALLOW_NON_CSPRNG=y
      - CONFIG_TEST_RANDOM_GENERATOR=y
```

## tests/crypto/psa_acceleration/testcase.yaml
```yaml
common:
  filter: not CONFIG_BUILD_WITH_TFM
  tags:
    - mbedtls
    - psa

tests:
  crypto.psa_acceleration:
    integration_platforms:
      - native_sim/native/64
```

## tests/crypto/rand32/testcase.yaml
```yaml
common:
  tags:
    - crypto
    - random
    - security
tests:
  crypto.rand32:
    min_ram: 16
    integration_platforms:
      - qemu_x86
  crypto.rand32.random_sw_systimer:
    extra_args: CONF_FILE=prj_sw_random_systimer.conf
    integration_platforms:
      - qemu_x86
  crypto.rand32.random_hw_xoshiro:
    extra_args: CONF_FILE=prj_hw_random_xoshiro.conf
    filter: CONFIG_ENTROPY_HAS_DRIVER
    min_ram: 16
    integration_platforms:
      - native_posix
  crypto.rand32.random_ctr_drbg:
    extra_args: CONF_FILE=prj_ctr_drbg.conf
    filter: CONFIG_ENTROPY_HAS_DRIVER
    min_ram: 16
    integration_platforms:
      - native_posix
  drivers.rand32.random_psa_crypto:
    filter: CONFIG_BUILD_WITH_TFM
    extra_args:
      - DTC_OVERLAY_FILE=./entropy_psa_crypto.overlay
      - CONF_FILE=prj_hw_random_psa_crypto.conf
    tags:
      - psa-crypto
    integration_platforms:
      - nrf5340dk_nrf5340_cpuapp_ns
```

## tests/crypto/secp256r1/testcase.yaml
```yaml
common:
  filter: dt_chosen_enabled("zephyr,entropy") and
          CONFIG_CSPRNG_ENABLED and
          CONFIG_HARDWARE_DEVICE_CS_GENERATOR and
          not CONFIG_BUILD_WITH_TFM and
          CONFIG_MBEDTLS
  tags:
    - mbedtls
    - p256-m
tests:
  crypto.secp256r1.mbedtls:
    extra_args: EXTRA_CONF_FILE=mbedtls.conf
  crypto.secp256r1.p256-m_raw:
    extra_args: EXTRA_CONF_FILE=p256-m_raw.conf
```

## tests/crypto/sha256/testcase.yaml
```yaml
tests:
  crypto.sha256:
    min_ram: 48
    tags: crypto sha256
    timeout: 600
```

## tests/crypto/test_ecc_dh/testcase.yaml
```yaml
tests:
-   test:
        platform_exclude: qemu_riscv32
        slow: 'True'
        tags: crypto ecc dh
        timeout: '500'
```

## tests/crypto/test_mbedtls/testcase.yaml
```yaml
tests:
-   test:
        filter: '( CONFIG_SRAM_SIZE >= 32 or CONFIG_DCCM_SIZE
            >= 32 or

            CONFIG_RAM_SIZE >= 32 )'
        tags: crypto mbedtls
        timeout: '200'
-   test_nios:
        arch_whitelist: nios2
        slow: true
        tags: crypto mbedtls
        timeout: '200'
```

## tests/crypto/test_sha256/testcase.yaml
```yaml
tests:
-   test:
        arch_whitelist: arm arc x86
        build_only: false
        filter: ( CONFIG_SRAM_SIZE > 32 or CONFIG_DCCM_SIZE
            > 32 or CONFIG_RAM_SIZE > 32 )
        tags: crypto sha256
        timeout: '10800'
-   test_nios2:
        arch_whitelist: nios2
        build_only: false
        tags: crypto sha256
        timeout: '10800'
```

## tests/crypto/tinycrypt/testcase.yaml
```yaml
tests:
  crypto.tinycrypt:
    tags:
      - tinycrypt
      - crypto
      - aes
      - ccm
    platform_exclude:
      - qemu_arc_em
      - qemu_arc_hs
      - m2gl025_miv
    timeout: 500
    integration_platforms:
      - native_posix
    toolchain_exclude: xcc
```

## tests/crypto/tinycrypt_hmac_prng/testcase.yaml
```yaml
tests:
  crypto.tinycrypt.hmac_prng:
    tags:
      - tinycrypt
      - crypto
      - sha256
      - hmac
      - prng
    platform_exclude:
      - mec15xxevb_assy6853/mec1501_hsz
      - mec1501modular_assy6885/mec1501_hsz
      - m2gl025_miv/miv
    integration_platforms:
      - native_sim/native
    toolchain_exclude: xcc
```

## tests/ctest/base/testcase.yaml
```yaml
common:
  tags:
    - test_framework
  integration_platforms:
    - native_sim
  harness: ctest
tests:
  testing.ctest.base: {}
```

## tests/drivers/actuator/shell/testcase.yaml
```yaml
# Copyright (c) 2025 Nordic Semiconductor
# SPDX-License-Identifier: Apache-2.0

tests:
  drivers.actuator.shell:
    platform_allow:
      - native_sim
      - native_sim/native/64
    tags:
      - drivers
      - actuator
      - shell
```
