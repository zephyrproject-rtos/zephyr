/*
 * Copyright 2026 NXP
 *
 * SPDX-License-Identifier: Apache-2.0
 */

#include <zephyr/dt-bindings/gpio/gpio.h>

/ {
	gpio_mux_test: gpio-mux-test {
		compatible = "gpio-mux";
		status = "okay";
		mux-gpios = <&gpio0 4 GPIO_ACTIVE_HIGH>,
			    <&gpio0 5 GPIO_ACTIVE_HIGH>,
			    <&gpio0 6 GPIO_ACTIVE_HIGH>;
		#mux-control-cells = <0>;
		#mux-state-cells = <1>;
	};
};
