## CMakeLists.txt
```
# SPDX-FileCopyrightText: 2026 NXP
# SPDX-FileCopyrightText: 2026 Analog Devices Inc.
# SPDX-License-Identifier: Apache-2.0

cmake_minimum_required(VERSION 3.28.0)

find_package(Zephyr REQUIRED HINTS $ENV{ZEPHYR_BASE})
project(adgm3121)

file(GLOB app_sources src/*.c)
target_sources(app PRIVATE ${app_sources})
```

## Kconfig
```
# SPDX-FileCopyrightText: 2026 NXP
# SPDX-FileCopyrightText: 2026 Analog Devices Inc.
# SPDX-License-Identifier: Apache-2.0

source "Kconfig.zephyr"

config TEST_ADGM3121_OBSERVE_GPIO
	bool "Observe the GPIO-mode switch lines via gpio_emul"
	help
	  Set for the GPIO-control fixture on native_sim: the test reads the four
	  emulated switch lines with gpio_emul_output_get_dt() to confirm set /
	  disconnect physically drive them. Leave off for SPI (build-only) runs.
```

## prj.conf
```kconfig
# SPDX-FileCopyrightText: 2026 NXP
# SPDX-FileCopyrightText: 2026 Analog Devices Inc.
# SPDX-License-Identifier: Apache-2.0

CONFIG_ZTEST=y
CONFIG_MUX=y
```

## boards/native_sim.conf
```kconfig
# SPDX-FileCopyrightText: 2026 NXP
# SPDX-FileCopyrightText: 2026 Analog Devices Inc.
# SPDX-License-Identifier: Apache-2.0

# Both fixtures need GPIO (switch lines in GPIO mode, chip-select in SPI mode).
CONFIG_GPIO=y
```

## boards/native_sim.overlay
```dts
/*
 * SPDX-FileCopyrightText: 2026 NXP
 * SPDX-FileCopyrightText: 2026 Analog Devices Inc.
 *
 * SPDX-License-Identifier: Apache-2.0
 *
 * ADGM3121 GPIO-control fixture on native_sim. Four emulated GPIO lines
 * drive the four switches; the test observes them with
 * gpio_emul_output_get_dt().
 */

#include <zephyr/dt-bindings/gpio/gpio.h>

/ {
	adgm3121: adgm3121 {
		compatible = "adi,adgm3121-gpio";
		in1-gpios = <&gpio0 0 GPIO_ACTIVE_HIGH>;
		in2-gpios = <&gpio0 1 GPIO_ACTIVE_HIGH>;
		in3-gpios = <&gpio0 2 GPIO_ACTIVE_HIGH>;
		in4-gpios = <&gpio0 3 GPIO_ACTIVE_HIGH>;
		#mux-control-cells = <0>;
		#mux-state-cells = <1>;
		status = "okay";
	};

	mux_consumer: mux-consumer {
		compatible = "vnd,mux-consumer-test";
		mux-controls = <&adgm3121>;
		mux-states = <&adgm3121 0x5>;
		status = "okay";
	};
};
```

## dts/bindings/vnd,mux-consumer-test.yaml
```yaml
# SPDX-FileCopyrightText: 2026 NXP
# SPDX-FileCopyrightText: 2026 Analog Devices Inc.
# SPDX-License-Identifier: Apache-2.0

description: |
  Consumer fixture for the ADGM3121 mux backend test. Carries mux-controls
  and mux-states pointing at the ADGM3121 controller under test (SPI or GPIO
  mode, chosen per overlay).

compatible: "vnd,mux-consumer-test"

include: [base.yaml, mux-consumer.yaml]
```

## src/main.c
```c
/*
 * SPDX-FileCopyrightText: 2026 NXP
 * SPDX-FileCopyrightText: 2026 Analog Devices Inc.
 *
 * SPDX-License-Identifier: Apache-2.0
 *
 * ADGM3121 mux backend test. The device is modeled as a single control line
 * (#mux-control-cells = 0) whose state is a 4-bit switch bitmask. The suite
 * drives the mask with mux_control_set(), opens all switches with
 * mux_control_disconnect(), and reads the mask back with mux_state_get().
 *
 * On the GPIO-control fixture (native_sim) it additionally confirms the four
 * switch lines physically follow the mask via gpio_emul_output_get_dt().
 */

#include <zephyr/device.h>
#include <zephyr/devicetree.h>
#include <zephyr/drivers/mux.h>
#include <zephyr/ztest.h>

#if IS_ENABLED(CONFIG_TEST_ADGM3121_OBSERVE_GPIO)
#include <zephyr/drivers/gpio.h>
#include <zephyr/drivers/gpio/gpio_emul.h>

static const struct gpio_dt_spec in_gpios[4] = {
	GPIO_DT_SPEC_GET(DT_NODELABEL(adgm3121), in1_gpios),
	GPIO_DT_SPEC_GET(DT_NODELABEL(adgm3121), in2_gpios),
	GPIO_DT_SPEC_GET(DT_NODELABEL(adgm3121), in3_gpios),
	GPIO_DT_SPEC_GET(DT_NODELABEL(adgm3121), in4_gpios),
};

static void assert_switch_lines(uint8_t mask)
{
	for (int i = 0; i < 4; i++) {
		zassert_equal(gpio_emul_output_get_dt(&in_gpios[i]), (mask >> i) & 0x1U,
			      "switch line %d does not match mask bit", i);
	}
}
#else
static void assert_switch_lines(uint8_t mask)
{
	ARG_UNUSED(mask);
}
#endif

#define CONSUMER DT_NODELABEL(mux_consumer)

BUILD_ASSERT(DT_NODE_EXISTS(CONSUMER),
	     "board overlay must define a 'mux_consumer' node for this test");

MUX_CONTROL_DT_SPEC_DEFINE(CONSUMER);

static const struct device *const mux_dev = MUX_CONTROL_DT_DEV_GET(CONSUMER);

ZTEST(adgm3121, test_dev_ready)
{
	zassert_true(device_is_ready(mux_dev), "adgm3121 controller not ready");
}

ZTEST(adgm3121, test_set_disconnect_reconnect)
{
	const struct mux_control *ctrl = MUX_CONTROL_DT_GET(CONSUMER);
	uint32_t state;

	/* Set a mix of switches: SW2 + SW4 closed. */
	zassert_ok(mux_control_set(mux_dev, ctrl, 0x0A), "set 0x0A failed");
	zassert_ok(mux_state_get(mux_dev, ctrl, &state), "get failed");
	zassert_equal(state, 0x0A, "read-back should match the set mask");
	assert_switch_lines(0x0A);

	/* disconnect() opens every switch (the all-open state of the array). */
	zassert_ok(mux_control_disconnect(mux_dev, ctrl), "disconnect failed");
	zassert_ok(mux_state_get(mux_dev, ctrl, &state), "get after disconnect failed");
	zassert_equal(state, 0x00, "disconnect should turn all switches off");
	assert_switch_lines(0x00);

	/* A subsequent set() reconnects with the new mask: SW1 + SW3 closed. */
	zassert_ok(mux_control_set(mux_dev, ctrl, 0x05), "reconnect set 0x05 failed");
	zassert_ok(mux_state_get(mux_dev, ctrl, &state), "get after reconnect failed");
	zassert_equal(state, 0x05, "read-back should track the reconnect mask");
	assert_switch_lines(0x05);
}

ZTEST(adgm3121, test_state_out_of_range)
{
	const struct mux_control *ctrl = MUX_CONTROL_DT_GET(CONSUMER);

	/* Only the low 4 bits are valid switch selectors. */
	zassert_equal(mux_control_set(mux_dev, ctrl, 0x10), -EINVAL,
		      "state beyond the 4-bit mask should be rejected");
}

ZTEST_SUITE(adgm3121, NULL, NULL, NULL, NULL, NULL);
```
