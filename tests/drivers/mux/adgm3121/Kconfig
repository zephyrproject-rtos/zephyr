## tests/drivers/mux/adgm3121/Kconfig
```kconfig
# SPDX-FileCopyrightText: 2026 NXP
# SPDX-FileCopyrightText: 2026 Analog Devices Inc.
# SPDX-License-Identifier: Apache-2.0

source "Kconfig.zephyr"

config TEST_ADGM3121_OBSERVE_GPIO
	bool "Observe the GPIO-mode switch lines via gpio_emul"
	help
	  Set for the GPIO-control fixture on native_sim: the test reads the four
	  emulated switch lines with gpio_emul_output_get_dt() to confirm set /
	  disconnect physically drive them. Leave off for SPI (build-only) runs.
```

## tests/drivers/mux/adgm3121/boards/native_sim.conf
```kconfig
# SPDX-FileCopyrightText: 2026 NXP
# SPDX-FileCopyrightText: 2026 Analog Devices Inc.
# SPDX-License-Identifier: Apache-2.0

# Both fixtures need GPIO (switch lines in GPIO mode, chip-select in SPI mode).
CONFIG_GPIO=y
```

## tests/drivers/mux/adgm3121/dts/bindings/vnd,mux-consumer-test.yaml
```yaml
# SPDX-FileCopyrightText: 2026 NXP
# SPDX-FileCopyrightText: 2026 Analog Devices Inc.
# SPDX-License-Identifier: Apache-2.0

description: |
  Consumer fixture for the ADGM3121 mux backend test. Carries mux-controls
  and mux-states pointing at the ADGM3121 controller under test (SPI or GPIO
  mode, chosen per overlay).

compatible: "vnd,mux-consumer-test"

include: [base.yaml, mux-consumer.yaml]
```

## tests/drivers/mux/gpio_mux_api/testcase.yaml
```yaml
# Copyright 2026 NXP
# SPDX-License-Identifier: Apache-2.0

tests:
  drivers.mux.gpio_mux:
    tags:
      - drivers
      - mux
      - gpio
    depends_on:
      - gpio
    platform_allow:
      - native_sim
      - frdm_mcxa153
    integration_platforms:
      - native_sim
```

## tests/drivers/mux/mux_api/Kconfig
```kconfig
# SPDX-FileCopyrightText: 2026 NXP
# SPDX-License-Identifier: Apache-2.0

source "Kconfig.zephyr"

config TEST_MUX_SET_VALUE_A
	int "First runtime state value to set and read back"
	default 3
	help
	  A state value driven through mux_control_set() and verified with
	  mux_state_get(). Must be valid for the target controller's field
	  width (the default fits the XBAR SEL field).

config TEST_MUX_SET_VALUE_B
	int "Second runtime state value to set and read back"
	default 7
	help
	  A second state value, used to confirm read-back tracks the latest
	  write. Must be valid for the target controller and differ from
	  TEST_MUX_SET_VALUE_A.

config TEST_MUX_HAS_DISCONNECT
	bool "Fixture supports mux_control_disconnect()"
	help
	  Set when the board fixture wires an enable line so the controller
	  implements mux_control_disconnect(). When enabled, the test observes
	  the enable line via gpio_emul_output_get_dt(); when disabled, the test
	  asserts mux_control_disconnect() returns -ENOSYS.
```

## tests/drivers/mux/mux_api/dts/bindings/vnd,mux-consumer-test.yaml
```yaml
# SPDX-FileCopyrightText: 2026 NXP
# SPDX-License-Identifier: Apache-2.0

description: |
  Consumer fixture for the mux_api test suite. Carries mux-controls and
  mux-states properties pointing at the MUX controller under test. The
  controller (and addressing-cell layout) is chosen per board overlay, so
  the same binding serves XBAR, TRGMUX, etc.

compatible: "vnd,mux-consumer-test"

include: [base.yaml, mux-consumer.yaml]
```

## tests/drivers/mux/nxp_mux_api/dts/bindings/test-nxp-mux-consumer.yaml
```yaml
# Copyright 2026 NXP
# SPDX-License-Identifier: Apache-2.0

description: |
  Test consumer node for NXP MUX driver API tests (nxp_inputmux, nxp_xbar).

  Used in board overlays to create test nodes that reference the real MUX
  controller (inputmux or xbar) with either mux-controls (2-cell) or
  mux-states (3-cell) properties, exercising both the mux-controls and
  mux-states code paths of the MUX API.

compatible: "test-nxp-mux-consumer"

include:
  - base.yaml
  - mux-consumer.yaml
```

## tests/drivers/mux/nxp_mux_api/testcase.yaml
```yaml
common:
  tags:
    - drivers
    - mux
  harness: ztest

tests:
  drivers.mux.nxp_inputmux:
    platform_allow:
      - mimxrt595_evk/mimxrt595s/cm33
    integration_platforms:
      - mimxrt595_evk/mimxrt595s/cm33

  drivers.mux.nxp_xbar:
    platform_allow:
      - mimxrt1050_evk/mimxrt1052/hyperflash
    integration_platforms:
      - mimxrt1050_evk/mimxrt1052/hyperflash
```

## tests/drivers/mux/reg_mux_api/dts/bindings/test-reg-mux-consumer.yaml
```yaml
# Copyright 2026 NXP
# SPDX-License-Identifier: Apache-2.0

description: Test consumer node for the reg-mux driver test suite.

compatible: "test-reg-mux-consumer"

include:
  - base.yaml
  - mux-consumer.yaml
```

## tests/drivers/mux/reg_mux_api/testcase.yaml
```yaml
common:
  tags:
    - drivers
    - mux
  harness: ztest

tests:
  drivers.mux.reg_mux:
    platform_allow:
      - frdm_mcxa153
    integration_platforms:
      - frdm_mcxa153

  drivers.mux.reg_mux.native_sim:
    platform_allow:
      - native_sim
    integration_platforms:
      - native_sim
```

## tests/drivers/nsim_uart/testcase.yaml
```yaml
tests:
  test_pinmux_dev:
    build_only: true
    platform_whitelist: arduino_101_sss
    tags: drivers
```

## tests/drivers/opamp/opamp_api/testcase.yaml
```yaml
# Copyright 2025 NXP
# SPDX-License-Identifier: Apache-2.0

common:
  tags:
    - drivers
    - opamp
tests:
  drivers.opamp.api.nxp:
    depends_on: opamp
    filter: dt_compat_enabled("nxp,opamp") or dt_compat_enabled("nxp,opamp-fast")
```

## tests/drivers/opamp/opamp_stm32/testcase.yaml
```yaml
# Copyright (c) 2025 Alexander Kozhinov <ak.alexander.kozhinov@gmail.com>
# SPDX-License-Identifier: Apache-2.0

common:
  tags:
    - drivers
    - opamp
  platform_allow:
    - nucleo_g474re
  vendor_allow:
    - st

tests:
  drivers.opamp.api.stm32.opamp_stm32.opamp_functional_mode_standalone:
    extra_args:
      - EXTRA_DTC_OVERLAY_FILE="dts/opamp2_functional_mode_standalone.overlay;
                                dts/opamp2_inp_single.overlay;
                                dts/opamp2_inm_single.overlay"
    filter: dt_compat_enabled("st,stm32-opamp")

  drivers.opamp.api.stm32.opamp_stm32.opamp2_functional_mode_standalone_single_inm_single_inp:
    extra_args:
      - EXTRA_DTC_OVERLAY_FILE="dts/opamp2_functional_mode_standalone.overlay;
                                dts/opamp2_inp_single.overlay;
                                dts/opamp2_inm_single.overlay"
    filter: dt_compat_enabled("st,stm32-opamp")

  drivers.opamp.api.stm32.opamp_stm32.opamp2_functional_mode_standalone_double_inm_double_inp:
    extra_args:
      - EXTRA_DTC_OVERLAY_FILE="dts/opamp2_functional_mode_standalone.overlay;
                                dts/opamp2_inm_double.overlay;
                                dts/opamp2_inp_double.overlay;
                                dts/opamp2_lock_enable.overlay;
                                dts/opamp2_timer_mux.overlay"
    filter: dt_compat_enabled("st,stm32-opamp")

  drivers.opamp.api.stm32.opamp_stm32.opamp2_user_trimming:
    extra_args:
      - EXTRA_DTC_OVERLAY_FILE="dts/opamp2_functional_mode_standalone.overlay;
                                dts/opamp2_inp_single.overlay;
                                dts/opamp2_user_trimming.overlay"
    filter: dt_compat_enabled("st,stm32-opamp")

  drivers.opamp.api.stm32.opamp_stm32.opamp_functional_mode_differential:
    extra_args:
      - EXTRA_DTC_OVERLAY_FILE="dts/opamp2_functional_mode_differential.overlay;
                                dts/opamp2_inp_single.overlay;
                                dts/opamp2_inm_single.overlay"
    filter: dt_compat_enabled("st,stm32-opamp")

  drivers.opamp.api.stm32.opamp_stm32.power_mode_highspeed:
    extra_args:
      - EXTRA_DTC_OVERLAY_FILE="dts/opamp2_functional_mode_standalone.overlay;
                                dts/opamp2_inp_single.overlay;
                                dts/opamp2_power_mode_highspeed.overlay"
    filter: dt_compat_enabled("st,stm32-opamp")

  drivers.opamp.api.stm32.opamp_stm32.lock_enable:
    extra_args:
      - EXTRA_DTC_OVERLAY_FILE="dts/opamp2_functional_mode_standalone.overlay;
                                dts/opamp2_inp_single.overlay;
                                dts/opamp2_lock_enable.overlay"
    filter: dt_compat_enabled("st,stm32-opamp")

  drivers.opamp.api.stm32.opamp_stm32.lock_enable_with_timer_mux:
    extra_args:
      - EXTRA_DTC_OVERLAY_FILE="dts/opamp2_functional_mode_standalone.overlay;
                                dts/opamp2_inp_single.overlay;
                                dts/opamp2_lock_enable.overlay;
                                dts/opamp2_timer_mux.overlay"
    filter: dt_compat_enabled("st,stm32-opamp")

  drivers.opamp.api.stm32.opamp_stm32.opamp_self_calibration_without_adc:
    extra_args:
      - EXTRA_DTC_OVERLAY_FILE="dts/opamp2_functional_mode_standalone.overlay;
                                dts/opamp2_inp_single.overlay;
                                dts/opamp2_self_calibration.overlay"
    filter: dt_compat_enabled("st,stm32-opamp")

  drivers.opamp.api.stm32.opamp_stm32.opamp_self_calibration_with_adc:
    extra_args:
      - EXTRA_CONF_FILE="config/adc.conf"
      - EXTRA_DTC_OVERLAY_FILE="dts/opamp2_functional_mode_standalone.overlay;
                                dts/opamp2_inp_single.overlay;
                                dts/opamp2_self_calibration.overlay;
                                dts/opamp2_adc_output.overlay"
    filter: dt_compat_enabled("st,stm32-opamp")

  drivers.opamp.api.stm32.opamp_stm32.opamp_functional_mode_follower:
    extra_args:
      - EXTRA_DTC_OVERLAY_FILE="dts/opamp2_functional_mode_follower.overlay;
                                dts/opamp2_inp_single.overlay"
    filter: dt_compat_enabled("st,stm32-opamp")

  drivers.opamp.api.stm32.opamp_stm32.opamp2_functional_mode_follower_double_inp_double_inm:
    extra_args:
      - EXTRA_DTC_OVERLAY_FILE="dts/opamp2_functional_mode_follower.overlay;
                                dts/opamp2_inm_double.overlay;
                                dts/opamp2_inp_double.overlay;
                                dts/opamp2_timer_mux.overlay"
    filter: dt_compat_enabled("st,stm32-opamp")

  drivers.opamp.api.stm32.opamp_stm32.opamp_functional_mode_inverting:
    extra_args:
      - EXTRA_DTC_OVERLAY_FILE="dts/opamp2_functional_mode_inverting.overlay;
                                dts/opamp2_inp_single_vinp0.overlay;
                                dts/opamp2_inm_single_vinm0.overlay"
    filter: dt_compat_enabled("st,stm32-opamp")

  drivers.opamp.api.stm32.opamp_stm32.opamp2_functional_mode_inverting_double_inm:
    extra_args:
      - EXTRA_DTC_OVERLAY_FILE="dts/opamp2_functional_mode_inverting.overlay;
                                dts/opamp2_inp_single.overlay;
                                dts/opamp2_inm_double.overlay;
                                dts/opamp2_timer_mux.overlay"
    filter: dt_compat_enabled("st,stm32-opamp")

  drivers.opamp.api.stm32.opamp_stm32.opamp_functional_mode_non_inverting:
    extra_args:
      - EXTRA_DTC_OVERLAY_FILE="dts/opamp2_functional_mode_non_inverting.overlay;
                                dts/opamp2_inp_single_vinp0.overlay;
                                dts/opamp2_inm_single_vinm0.overlay"
    filter: dt_compat_enabled("st,stm32-opamp")

  drivers.opamp.api.stm32.opamp_stm32.opamp_functional_mode_non_inverting_double_inm_double_inp:
    extra_args:
      - EXTRA_DTC_OVERLAY_FILE="dts/opamp2_functional_mode_non_inverting.overlay;
                                dts/opamp2_inp_double.overlay;
                                dts/opamp2_inm_double.overlay;
                                dts/opamp2_timer_mux.overlay"
    filter: dt_compat_enabled("st,stm32-opamp")

  drivers.opamp.api.stm32.opamp_stm32.opamp_functional_mode_non_inverting_filtering_vinm0:
    extra_args:
      - EXTRA_DTC_OVERLAY_FILE="dts/opamp2_functional_mode_non_inverting.overlay;
                                dts/opamp2_inp_single_vinp0.overlay;
                                dts/opamp2_inm_single_vinm0.overlay;
                                dts/opamp2_filtering_vinm0.overlay"
    filter: dt_compat_enabled("st,stm32-opamp")

  drivers.opamp.api.stm32.opamp_stm32.opamp_functional_mode_inverting_filtering_vinm1:
    extra_args:
      - EXTRA_DTC_OVERLAY_FILE="dts/opamp2_functional_mode_inverting.overlay;
                                dts/opamp2_inp_single_vinp0.overlay;
                                dts/opamp2_inm_single_vinm0.overlay;
                                dts/opamp2_filtering_vinm1.overlay"
    filter: dt_compat_enabled("st,stm32-opamp")
```

## tests/drivers/pcie/edu/boards/qemu_cortex_a53.conf
```kconfig
CONFIG_KERNEL_VM_SIZE=0x20000000
CONFIG_ARM64_VA_BITS_40=y
CONFIG_ARM64_PA_BITS_40=y

# Enable PCIe stuff
CONFIG_PCIE=y
CONFIG_PCIE_CONTROLLER=y
CONFIG_PCIE_MSI=y
CONFIG_PCIE_MSI_X=y
CONFIG_PCIE_MSI_MULTI_VECTOR=y

# Qemu PCIe drivers
CONFIG_PCIE_ECAM=y
CONFIG_GIC_V3_ITS=y
```

## tests/drivers/pcie/edu/testcase.yaml
```yaml
# Copyright 2022 BayLibre SAS
# SPDX-License-Identifier: Apache-2.0

tests:
  pcie.edu:
    platform_allow: qemu_cortex_a53
```

## tests/drivers/pinctrl/api/Kconfig
```kconfig
# Copyright (c) 2021 Nordic Semiconductor ASA
# SPDX-License-Identifier: Apache-2.0

mainmenu "pinctrl API Test"

source "Kconfig.zephyr"

config PINCTRL_TEST_STORE_REG
	bool "Store register address"
	select PINCTRL_STORE_REG
	help
	  This option should be selected by unit tests that want to store the
	  register address of devices.
```

## tests/drivers/pinctrl/api/testcase.yaml
```yaml
# Copyright (c) 2021 Nordic Semiconductor ASA
# SPDX-License-Identifier: Apache-2.0

common:
  platform_allow:
    - native_sim
    - native_sim/native/64
  integration_platforms:
    - native_sim
tests:
  drivers.pinctrl.api:
    tags:
      - drivers
      - pinctrl
  drivers.pinctrl.api_reg:
    tags:
      - drivers
      - pinctrl
    extra_args: CONF_FILE="prj.conf;reg.conf"
```

## tests/drivers/pinctrl/gd32/Kconfig
```kconfig
# Copyright (c) 2021 Teslabs Engineering S.L.
# SPDX-License-Identifier: Apache-2.0

mainmenu "pinctrl GD32 DT Test"

source "Kconfig.zephyr"

config PINCTRL_TEST_NON_STATIC
	bool "Access to pin control configuration"
	select PINCTRL_NON_STATIC
	help
	  This option should be selected by unit tests that need to access the pin
	  control configuration defined in a device driver.
```

## tests/drivers/pinctrl/gd32/testcase.yaml
```yaml
# Copyright (c) 2021 Teslabs Engineering S.L.
# SPDX-License-Identifier: Apache-2.0

tests:
  drivers.pinctrl.gd32_af:
    tags:
      - drivers
      - pinctrl
    platform_allow: gd32f450i_eval/gd32f450
  drivers.pinctrl.gd32_afio:
    tags:
      - drivers
      - pinctrl
    platform_allow: gd32f403z_eval/gd32f403
```

## tests/drivers/pinctrl/mchp/testcase.yaml
```yaml
tests:
  drivers.pinctrl.mchp:
    tags:
      - drivers
      - pinctrl
    platform_allow:
      - sam_e54_xpro
```

## tests/drivers/pinctrl/microchip/Kconfig
```kconfig
# Copyright (c) 2025 Microchip Technology Inc.
# SPDX-License-Identifier: Apache-2.0

mainmenu "pinctrl microchip DT Test"

source "Kconfig.zephyr"

config PINCTRL_TEST_NON_STATIC
	bool "Access to pin control configuration"
	select PINCTRL_NON_STATIC
	help
	  This option should be selected by unit tests that need to access the pin
	  control configuration defined in a device driver.

config TEST_PINCTRL_MCHP_SAM
	bool "Enable test for MCHP SAM drive strength"
	default y if SOC_FAMILY_MICROCHIP_SAM_D5X_E5X
```

## tests/drivers/pinctrl/microchip/boards/sam_e54_xpro.conf
```kconfig
# Copyright (c) 2025 Microchip Technology Inc.
# SPDX-License-Identifier: Apache-2.0

CONFIG_TEST_PINCTRL_MCHP_SAM=y
```

## tests/drivers/pinctrl/microchip/testcase.yaml
```yaml
tests:
  drivers.pinctrl.microchip:
    tags:
      - drivers
      - pinctrl
    platform_allow:
      - sam_e54_xpro
```
