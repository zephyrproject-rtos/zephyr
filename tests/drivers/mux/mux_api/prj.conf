## CMakeLists.txt
```
# SPDX-FileCopyrightText: 2026 NXP
# SPDX-License-Identifier: Apache-2.0

cmake_minimum_required(VERSION 3.20.0)

find_package(Zephyr REQUIRED HINTS $ENV{ZEPHYR_BASE})
project(mux_api)

file(GLOB app_sources src/*.c)
target_sources(app PRIVATE ${app_sources})
```

## Kconfig
```
# SPDX-FileCopyrightText: 2026 NXP
# SPDX-License-Identifier: Apache-2.0

source "Kconfig.zephyr"

config TEST_MUX_SET_VALUE_A
	int "First runtime state value to set and read back"
	default 3
	help
	  A state value driven through mux_control_set() and verified with
	  mux_state_get(). Must be valid for the target controller's field
	  width (the default fits the XBAR SEL field).

config TEST_MUX_SET_VALUE_B
	int "Second runtime state value to set and read back"
	default 7
	help
	  A second state value, used to confirm read-back tracks the latest
	  write. Must be valid for the target controller and differ from
	  TEST_MUX_SET_VALUE_A.

config TEST_MUX_HAS_DISCONNECT
	bool "Fixture supports mux_control_disconnect()"
	help
	  Set when the board fixture wires an enable line so the controller
	  implements mux_control_disconnect(). When enabled, the test observes
	  the enable line via gpio_emul_output_get_dt(); when disabled, the test
	  asserts mux_control_disconnect() returns -ENOSYS.
```

## prj.conf
```kconfig
# SPDX-FileCopyrightText: 2026 NXP
# SPDX-License-Identifier: Apache-2.0

CONFIG_ZTEST=y
CONFIG_MUX=y
```

## boards/lp_am13e230.conf
```kconfig
# SPDX-FileCopyrightText: 2026 Texas Instruments Incorporated
# SPDX-License-Identifier: Apache-2.0

# AM13e MPU map is still incomplete for userspace ztests; run in supervisor
# mode (same approach as pwm_loopback on this board).
CONFIG_TEST_USERSPACE=n
```

## boards/native_sim.conf
```kconfig
# SPDX-FileCopyrightText: 2026 NXP
# SPDX-License-Identifier: Apache-2.0

# The gpio-mux fixture in native_sim.overlay drives the emulated GPIO
# controller, so the GPIO subsystem must be enabled for the mux backend
# to build and define the mux0 controller device (link error otherwise).
CONFIG_GPIO=y
```

## boards/frdm_ke15z.overlay
```dts
/*
 * SPDX-FileCopyrightText: 2026 NXP
 *
 * SPDX-License-Identifier: Apache-2.0
 *
 */

&trgmux0 {
	status = "okay";
};

/ {
	mux_consumer: mux-consumer {
		compatible = "vnd,mux-consumer-test";
		/* control idx0: ExtOut0, input 0 - driven at runtime and read back.
		 * state:        ExtOut0, input 0, source LpitCh0 (7), baked in DT.
		 */
		mux-controls = <&trgmux0 1 0>;
		mux-states = <&trgmux0 1 0 7>;
		status = "okay";
	};
};
```

## boards/frdm_ke17z.overlay
```dts
/*
 * SPDX-FileCopyrightText: Copyright 2026 NXP
 *
 * SPDX-License-Identifier: Apache-2.0
 */

&trgmux0 {
	status = "okay";
};

/ {
	mux_consumer: mux-consumer {
		compatible = "vnd,mux-consumer-test";
		/* control idx0: EXTOUT0, input 0 - driven at runtime and read back.
		 * state:        EXTOUT0, input 0, source LPIT0 channel 0 (7), baked in DT.
		 */
		mux-controls = <&trgmux0 1 0>;
		mux-states = <&trgmux0 1 0 7>;
		status = "okay";
	};
};
```

## boards/frdm_mcxe247.overlay
```dts
/*
 * SPDX-FileCopyrightText: 2026 NXP
 *
 * SPDX-License-Identifier: Apache-2.0
 *
 */

&trgmux {
	status = "okay";
};

/ {
	mux_consumer: mux-consumer {
		compatible = "vnd,mux-consumer-test";
		/* control idx0: ExtOut0, input 0 - driven at runtime and read back.
		 * state:        ExtOut0, input 0, source LpitCh0 (17), baked in DT.
		 */
		mux-controls = <&trgmux 1 0>;
		mux-states = <&trgmux 1 0 17>;
		status = "okay";
	};
};
```

## boards/frdm_mcxe31b.overlay
```dts
/*
 * SPDX-FileCopyrightText: 2026 NXP
 *
 * SPDX-License-Identifier: Apache-2.0
 *
 */

&trgmux {
	status = "okay";
};

/ {
	mux_consumer: mux-consumer {
		compatible = "vnd,mux-consumer-test";
		/* control idx0: ExtOut0 (17), input 0 - driven at runtime and read back.
		 * state:        ExtOut0 (17), input 0, source Pit0Ch0 (117), baked in DT.
		 */
		mux-controls = <&trgmux 17 0>;
		mux-states = <&trgmux 17 0 117>;
		status = "okay";
	};
};
```

## boards/lp_am13e230.overlay
```dts
/*
 * SPDX-FileCopyrightText: 2026 Texas Instruments Incorporated
 * SPDX-License-Identifier: Apache-2.0
 *
 * Wires mux_api to the AM13E2 Input XBAR. Only SELECT / RAW_INPUTSELECT
 * registers are programmed, so no external signal wiring is needed.
 */

#include <zephyr/dt-bindings/mux/ti_am13e2_xbar_in.h>

&xbar1 {
	status = "okay";
};

/ {
	mux_consumer: mux-consumer {
		compatible = "vnd,mux-consumer-test";
		/* control: INPUTXBAR channel 0 — driven at runtime and read back.
		 * state:   channel 1 → GPIO36 raw, baked in DT for apply/get.
		 */
		mux-controls = <&xbar1 0>;
		mux-states = <&xbar1 1 AM13E2_XBAR_IN_STATE(36, 1)>;
		status = "okay";
	};
};
```

## boards/mimxrt1050_evk_mimxrt1052_hyperflash.overlay
```dts
/*
 * SPDX-FileCopyrightText: 2026 NXP
 *
 * SPDX-License-Identifier: Apache-2.0
 *
 * Wires the mux_api test to the real XBAR controller. xbar1 is disabled by
 * default in the SoC dtsi, so enable it and attach the consumer fixture.
 * Only SEL registers are programmed, so no external signal wiring is needed.
 */

&xbar1 {
	status = "okay";
};

/ {
	mux_consumer: mux-consumer {
		compatible = "vnd,mux-consumer-test";
		/* control idx0: routing driven at runtime on XBAR output 0.
		 * state:        XBAR output 1 receives input 7, baked into DT.
		 */
		mux-controls = <&xbar1 0>;
		mux-states = <&xbar1 1 7>;
		status = "okay";
	};
};
```

## dts/bindings/vnd,mux-consumer-test.yaml
```yaml
# SPDX-FileCopyrightText: 2026 NXP
# SPDX-License-Identifier: Apache-2.0

description: |
  Consumer fixture for the mux_api test suite. Carries mux-controls and
  mux-states properties pointing at the MUX controller under test. The
  controller (and addressing-cell layout) is chosen per board overlay, so
  the same binding serves XBAR, TRGMUX, etc.

compatible: "vnd,mux-consumer-test"

include: [base.yaml, mux-consumer.yaml]
```

## src/main.c
```c
/*
 * SPDX-FileCopyrightText: 2026 NXP
 *
 * SPDX-License-Identifier: Apache-2.0
 *
 * MUX subsystem API test suite.
 *
 * Configures a route with the generic mux API (mux_control_set /
 * mux_state_apply) and verifies it by reading it back with mux_state_get(),
 * exercising a real MUX controller end-to-end (set and get_state paths).
 *
 * The suite is controller-agnostic: it operates on the consumer fixture node
 * "mux_consumer" via the generic devicetree macros, so the addressing-cell
 * width and the concrete controller (XBAR, TRGMUX, ...) are opaque. Per-target
 * wiring lives in the board overlay; per-target values come from Kconfig:
 *
 *   CONFIG_TEST_MUX_SET_VALUE_A / _B  - runtime states to set and read back
 *
 * The fixed-state route (mux-states) is verified against its own DT value, so
 * no per-target constant is hardcoded here.
 *
 * The consumer fixture provides one control entry:
 *   idx 0 - the line driven by set / apply and read back by get.
 */

#include <zephyr/device.h>
#include <zephyr/devicetree.h>
#include <zephyr/drivers/mux.h>
#include <zephyr/ztest.h>

#define CONSUMER DT_NODELABEL(mux_consumer)

BUILD_ASSERT(DT_NODE_EXISTS(CONSUMER),
	     "board overlay must define a 'mux_consumer' node for this test");

MUX_CONTROL_DT_SPEC_DEFINE_BY_IDX(CONSUMER, 0);
MUX_STATE_DT_SPEC_DEFINE(CONSUMER);

static const struct device *const mux_dev = MUX_CONTROL_DT_DEV_GET(CONSUMER);

ZTEST(mux_api, test_dev_ready)
{
	zassert_true(device_is_ready(mux_dev), "mux controller not ready");
	zassert_equal_ptr(MUX_STATE_DT_DEV_GET(CONSUMER), mux_dev,
			  "control and state should resolve to the same controller");
}

ZTEST(mux_api, test_set_then_get)
{
	const struct mux_control *ctrl = MUX_CONTROL_DT_GET_BY_IDX(CONSUMER, 0);
	uint32_t state;

	zassert_ok(mux_control_set(mux_dev, ctrl, CONFIG_TEST_MUX_SET_VALUE_A),
		   "set A failed");
	zassert_ok(mux_state_get(mux_dev, ctrl, &state), "get A failed");
	zassert_equal(state, CONFIG_TEST_MUX_SET_VALUE_A,
		      "read-back should match the value just set");

	zassert_ok(mux_control_set(mux_dev, ctrl, CONFIG_TEST_MUX_SET_VALUE_B),
		   "set B failed");
	zassert_ok(mux_state_get(mux_dev, ctrl, &state), "get B failed");
	zassert_equal(state, CONFIG_TEST_MUX_SET_VALUE_B,
		      "read-back should track the latest set");
}

ZTEST(mux_api, test_state_apply_then_get)
{
	const struct mux_state *mstate = MUX_STATE_DT_GET(CONSUMER);
	uint32_t state;

	/* mux_state_apply() programs the DT-defined routing; read it back
	 * through the state's own addressing and compare to the DT value.
	 */
	zassert_ok(mux_state_apply(mux_dev, mstate), "apply failed");
	zassert_ok(mux_state_get(mux_dev, mstate->control, &state), "get failed");
	zassert_equal(state, mstate->state,
		      "read-back should equal the applied DT state");
}

ZTEST_SUITE(mux_api, NULL, NULL, NULL, NULL, NULL);
```
