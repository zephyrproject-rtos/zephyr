/*
 * SPDX-FileCopyrightText: Copyright 2026 NXP
 *
 * SPDX-License-Identifier: Apache-2.0
 */

&trgmux0 {
	status = "okay";
};

/ {
	mux_consumer: mux-consumer {
		compatible = "vnd,mux-consumer-test";
		/* control idx0: EXTOUT0, input 0 - driven at runtime and read back.
		 * state:        EXTOUT0, input 0, source LPIT0 channel 0 (7), baked in DT.
		 */
		mux-controls = <&trgmux0 1 0>;
		mux-states = <&trgmux0 1 0 7>;
		status = "okay";
	};
};
