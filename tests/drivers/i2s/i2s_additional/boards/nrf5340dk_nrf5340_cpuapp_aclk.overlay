/*
 * Copyright (c) 2025 Nordic Semiconductor ASA
 *
 * SPDX-License-Identifier: Apache-2.0
 */

/* Drive i2s peripheral from ACLK. */

&clock {
	hfclkaudio-frequency = <11289600>;
};

&hfclkaudio {
	hfclkaudio-frequency = <11289600>;
};

&i2s0 {
	clock-source = "ACLK";
};
