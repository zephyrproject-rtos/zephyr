/*
 * SPDX-FileCopyrightText: Copyright The Zephyr Project Contributors
 * SPDX-License-Identifier: Apache-2.0
 */

/* i2s-node0 is the transmitter/receiver */

/ {
	aliases {
		i2s-node0 = &i2s1;
	};
};
