/*
 * Copyright (c) 2026 Ambiq Micro Inc.
 *
 * SPDX-License-Identifier: Apache-2.0
 */

/*
 * GPIO loopback: wire I2S0_SDOUT (P6) to I2S0_SDIN (P4).
 * CLK is P5, WS is P7.
 */

/ {
	aliases {
		i2s-node0 = &i2s0;
	};
};

&i2s0 {
	status = "okay";
};
