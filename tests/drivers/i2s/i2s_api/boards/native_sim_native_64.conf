## tests/drivers/i2s/i2s_api/boards/native_sim_native_64.conf
```kconfig
# Copyright 2026 NXP
# SPDX-License-Identifier: Apache-2.0

CONFIG_I2S_NATIVE_SIM_RX_FILE_PATH="/tmp/native_sim_i2s_api_in.pcm"
CONFIG_I2S_NATIVE_SIM_TX_FILE_PATH="/tmp/native_sim_i2s_api_out.pcm"
```

## tests/drivers/i2s/i2s_api/boards/nucleo_n657x0_q.conf
```kconfig
#
# Copyright (c) 2026 Mario Paja
#
# SPDX-License-Identifier: Apache-2.0
#

CONFIG_I2S_TEST_USE_GPIO_LOOPBACK=y
```

## tests/drivers/i2s/i2s_api/testcase.yaml
```yaml
tests:
  drivers.i2s:
    depends_on: i2s
    tags:
      - drivers
      - userspace
    filter: not CONFIG_I2S_TEST_USE_GPIO_LOOPBACK
    platform_exclude:
      - frdm_mcxn947/mcxn947/cpu0
      - mcx_n9xx_evk/mcxn947/cpu0
      - mimxrt595_evk/mimxrt595s/cm33
      - mimxrt685_evk/mimxrt685s/cm33
      - nrf54h20dk/nrf54h20/cpuapp
      - mimxrt1060_evk/mimxrt1062/qspi
      - frdm_mcxn236/mcxn236
      - mimxrt1180_evk/mimxrt1189/cm33
      - mimxrt1180_evk/mimxrt1189/cm7
  drivers.i2s.gpio_loopback:
    depends_on:
      - i2s
      - gpio
    tags:
      - drivers
      - userspace
    filter: CONFIG_I2S_TEST_USE_GPIO_LOOPBACK
    harness: ztest
    platform_exclude:
      - frdm_mcxn947/mcxn947/cpu0
      - mcx_n9xx_evk/mcxn947/cpu0
      - mimxrt595_evk/mimxrt595s/cm33
      - mimxrt685_evk/mimxrt685s/cm33
      - nrf54h20dk/nrf54h20/cpuapp
      - frdm_mcxn236/mcxn236
    harness_config:
      fixture: gpio_loopback
  drivers.i2s.gpio_loopback.nrf54h:
    depends_on: i2s
    tags:
      - drivers
      - userspace
    harness_config:
      fixture: i2s_loopback
    platform_allow:
      - nrf54h20dk/nrf54h20/cpuapp
    integration_platforms:
      - nrf54h20dk/nrf54h20/cpuapp
```

## tests/drivers/i2s/i2s_multichannel/Kconfig
```kconfig
#
# Copyright (c) 2021, NXP
#
# SPDX-License-Identifier: Apache-2.0
#

mainmenu "I2S multi-channel Test"

source "Kconfig.zephyr"

config I2S_TEST_MULTI_CHANNEL
	bool "multi channel testing"
	help
	  Use separate I2S test for multichannel.

config I2S_TEST_ALLOWED_MULTI_CHANNEL_RX
	bool "Allowed i2s multichannel read"
	default n
	help
	  allow multichannel read test

config I2S_TEST_ALLOWED_MULTI_CHANNEL_TX
	bool "Allowed i2s multichannel read"
	default n
	help
	  allow multichannel read test

config I2S_TEST_SKIP_RX_VERIFY
	bool "skip rx verification if the rx is connect to codec already"
	default n
	help
	  skip rx verification
```

## tests/drivers/i2s/i2s_multichannel/boards/mimxrt1060_evk_mimxrt1062_qspi_C.conf
```kconfig
#
# Copyright 2025, NXP
#
# SPDX-License-Identifier: Apache-2.0
#

# CONFIG_DMA_TCD_QUEUE_SIZE sets size of queue used to chain DMA blocks (TCDs)
# together, and should be sized as needed by the application.  If not large
# enough, the DMA may starve.  Symptoms of this issue include transmit blocks
# repeated, or RX blocks skipped. For I2S driver, queue size must be at least 3.
CONFIG_DMA_TCD_QUEUE_SIZE=4

# I2S and DMA logging can occur in interrupt context, and interfere with I2S
# stream timing.  If using either logging, set logging to deferred
# CONFIG_LOG_MODE_DEFERRED=y

CONFIG_DMA_LOG_LEVEL_OFF=y
CONFIG_I2S_LOG_LEVEL_OFF=y

CONFIG_I2S_TEST_MULTI_CHANNEL=y
CONFIG_I2S_TEST_ALLOWED_MULTI_CHANNEL_TX=y
CONFIG_I2S_TEST_SKIP_RX_VERIFY=y
```

## tests/drivers/i2s/i2s_multichannel/testcase.yaml
```yaml
tests:
  drivers.i2s.multichannel:
    depends_on: i2s
    tags:
      - drivers
    filter: CONFIG_I2S_TEST_MULTI_CHANNEL
    integration_platforms:
      - mimxrt1060_evk/mimxrt1062/qspi
```

## tests/drivers/i2s/i2s_speed/Kconfig
```kconfig
#
# Copyright (c) 2021, NXP
#
# SPDX-License-Identifier: Apache-2.0
#

mainmenu "I2S Speed Test"

source "Kconfig.zephyr"

config I2S_TEST_SEPARATE_DEVICES
	bool "Use two separate I2S ports for loopback"
	help
	  Use separate I2S ports for transmit and receive.

config I2S_TEST_USE_I2S_DIR_BOTH
	bool "Use I2S_DIR_BOTH value to perform RX/TX transfers"
	default y if DT_HAS_NORDIC_NRF_I2S_ENABLED || DT_HAS_NORDIC_NRF_TDM_ENABLED
	help
	  Use the I2S_DIR_BOTH enumeration value to trigger commands in test
	  cases involving both reception and transmission. Use of this option
	  is essential for devices that cannot independently start and stop
	  the RX and TX streams.

config I2S_TEST_USE_GPIO_LOOPBACK
	bool "Use GPIO loopback"
	default y if DT_HAS_NORDIC_NRF_I2S_ENABLED || DT_HAS_NORDIC_NRF_TDM_ENABLED
	help
	  Use wiring between the data-out and data-in pins for looping back
	  data. This option is intended to be used for devices that do not
	  provide the internal loopback functionality.

config I2S_TEST_ALLOWED_DATA_OFFSET
	int "Allowed offset in received data"
	default 2 if DT_HAS_NORDIC_NRF_I2S_ENABLED || DT_HAS_NORDIC_NRF_TDM_ENABLED
	default 0
	help
	  Maximum allowed offset between sent and received samples. Non-zero
	  value of this option may be needed when GPIO loopback is used.

config I2S_TEST_ALLOW_VARIABLE_OFFSET
	bool "Recalculate the data offset on every block read"
	default n
	help
	  If the data offset is not consistent between reads because of
	  timing variations in the hardware, enable this option to
	  always recalculate the offset.

config I2S_TEST_USE_32_SAMPLES_PER_BLOCK
	bool "Use 32 samples per block"
	default n
	help
	  When set to 'y', the test will use 32 samples per block
	  instead of the default 64 samples per block. This option
	  may be needed for devices with smaller hardware FIFOs.

config I2S_TEST_SKIP_SAMPLERATE_8000
	bool "Skip short transfer tests at 8000 samples per second"
	help
	  When set to 'y', short transfer tests at 8000 samples per second
	  will be skipped.

config I2S_TEST_SKIP_SAMPLERATE_16000
	bool "Skip short transfer tests at 16000 samples per second"
	help
	  When set to 'y', short transfer tests at 16000 samples per second
	  will be skipped.

config I2S_TEST_SKIP_SAMPLERATE_32000
	bool "Skip short transfer tests at 32000 samples per second"
	help
	  When set to 'y', short transfer tests at 32000 samples per second
	  will be skipped.

config I2S_TEST_SKIP_SAMPLERATE_44100
	bool "Skip short transfer tests at 44100 samples per second"
	help
	  When set to 'y', short transfer tests at 44100 samples per second
	  will be skipped.

config I2S_TEST_SKIP_SAMPLERATE_48000
	bool "Skip short transfer tests at 48000 samples per second"
	help
	  When set to 'y', short transfer tests at 48000 samples per second
	  will be skipped.

config I2S_TEST_SKIP_SAMPLERATE_88200
	bool "Skip short transfer tests at 88200 samples per second"
	help
	  When set to 'y', short transfer tests at 88200 samples per second
	  will be skipped.

config I2S_TEST_SKIP_SAMPLERATE_96000
	bool "Skip short transfer tests at 96000 samples per second"
	help
	  When set to 'y', short transfer tests at 96000 samples per second
	  will be skipped.
```

## tests/drivers/i2s/i2s_speed/boards/ek_ra8m2_r7ka8m2jflcac_cm85.conf
```kconfig
# Copyright (c) 2025 Renesas Electronics Corporation
# SPDX-License-Identifier: Apache-2.0

CONFIG_I2S_INIT_PRIORITY=52
CONFIG_I2S_TEST_USE_GPIO_LOOPBACK=y
CONFIG_I2S_TEST_SEPARATE_DEVICES=y
CONFIG_I2S_TEST_SKIP_SAMPLERATE_8000=y
CONFIG_I2S_TEST_SKIP_SAMPLERATE_16000=y
CONFIG_I2S_TEST_SKIP_SAMPLERATE_32000=y
CONFIG_I2S_TEST_SKIP_SAMPLERATE_48000=y
CONFIG_I2S_TEST_SKIP_SAMPLERATE_96000=y
```

## tests/drivers/i2s/i2s_speed/boards/frdm_mcxn236.conf
```kconfig
#
# Copyright (c) 2024, NXP
#
# SPDX-License-Identifier: Apache-2.0
#

# SAI peripheral does not have loopback mode.  Use 2 SAI peripherals connected
# together externally.
CONFIG_I2S_TEST_SEPARATE_DEVICES=y

# Repeat test continually to help find intermittent issues
CONFIG_ZTEST_RETEST_IF_PASSED=y

# I2S and DMA logging can occur in interrupt context, and interfere with I2S
# stream timing.  If using either logging, set logging to deferred
# CONFIG_LOG_MODE_DEFERRED=y

CONFIG_DMA_LOG_LEVEL_OFF=y
CONFIG_I2S_LOG_LEVEL_OFF=y
CONFIG_I2S_TEST_USE_GPIO_LOOPBACK=y
```

## tests/drivers/i2s/i2s_speed/boards/kit_pse84_ai_pse846gps2dbzc4a_m33.conf
```kconfig
# Copyright (c) 2026 Infineon Technologies AG,
# or an affiliate of Infineon Technologies AG.
#
# SPDX-License-Identifier: Apache-2.0

CONFIG_I2S_TEST_USE_32_SAMPLES_PER_BLOCK=y
CONFIG_I2S_INFINEON_RX_QUEUE_SIZE=20
CONFIG_I2S_INFINEON_TX_QUEUE_SIZE=20
CONFIG_I2S_TEST_ALLOWED_DATA_OFFSET=14
CONFIG_I2S_TEST_ALLOW_VARIABLE_OFFSET=y
CONFIG_I2S_TEST_SKIP_SAMPLERATE_48000=y
CONFIG_I2S_TEST_SKIP_SAMPLERATE_88200=y
CONFIG_I2S_TEST_SKIP_SAMPLERATE_96000=y
```

## tests/drivers/i2s/i2s_speed/boards/kit_pse84_eval_pse846gps2dbzc4a_m55.conf
```kconfig
# Copyright (c) 2025 Infineon Technologies AG,
# or an affiliate of Infineon Technologies AG.
#
# SPDX-License-Identifier: Apache-2.0

CONFIG_DMA=y
CONFIG_I2S_TEST_USE_32_SAMPLES_PER_BLOCK=y
CONFIG_I2S_INFINEON_RX_QUEUE_SIZE=20
CONFIG_I2S_INFINEON_TX_QUEUE_SIZE=20
CONFIG_I2S_TEST_ALLOWED_DATA_OFFSET=8
CONFIG_I2S_TEST_ALLOW_VARIABLE_OFFSET=y
```

## tests/drivers/i2s/i2s_speed/boards/mimxrt1060_evk_mimxrt1062_qspi_B.conf
```kconfig
#
# Copyright (c) 2024, NXP
#
# SPDX-License-Identifier: Apache-2.0
#

# Repeat test continually to help find intermittent issues
CONFIG_ZTEST_RETEST_IF_PASSED=y

# I2S and DMA logging can occur in interrupt context, and interfere with I2S
# stream timing.  If using either logging, set logging to deferred
# CONFIG_LOG_MODE_DEFERRED=y

CONFIG_DMA_LOG_LEVEL_OFF=y
CONFIG_I2S_LOG_LEVEL_OFF=y
```

## tests/drivers/i2s/i2s_speed/boards/mimxrt1170_evk_mimxrt1176_cm7.conf
```kconfig
#
# Copyright (c) 2021, NXP
#
# SPDX-License-Identifier: Apache-2.0
#

# SAI peripheral does not have loopback mode but we can connect CLK, SYNC,
# RXD and TXD of one SAI for test purpose.
CONFIG_I2S_TEST_SEPARATE_DEVICES=n

# Repeat test continually to help find intermittent issues
CONFIG_ZTEST_RETEST_IF_PASSED=y

# I2S and DMA logging can occur in interrupt context, and interfere with I2S
# stream timing.  If using either logging, set logging to deferred
# CONFIG_LOG_MODE_DEFERRED=y

CONFIG_DMA_LOG_LEVEL_OFF=y
CONFIG_I2S_LOG_LEVEL_OFF=y
```

## tests/drivers/i2s/i2s_speed/boards/mimxrt1170_evk_rt1176_cm7.conf
```kconfig
#
# Copyright (c) 2021, NXP
#
# SPDX-License-Identifier: Apache-2.0
#

# SAI peripheral does not have loopback mode.  Use 2 SAI peripherals connected
# together externally.
CONFIG_I2S_TEST_SEPARATE_DEVICES=y

# CONFIG_DMA_TCD_QUEUE_SIZE sets size of queue used to chain DMA blocks (TCDs)
# together, and should be sized as needed by the application.  If not large
# enough, the DMA may starve.  Symptoms of this issue include transmit blocks
# repeated, or RX blocks skipped. For I2S driver, queue size must be at least 3.
CONFIG_DMA_TCD_QUEUE_SIZE=4

# Repeat test continually to help find intermittent issues
CONFIG_ZTEST_RETEST_IF_PASSED=y

# I2S and DMA logging can occur in interrupt context, and interfere with I2S
# stream timing.  If using either logging, set logging to deferred
# CONFIG_LOG_MODE_DEFERRED=y

CONFIG_DMA_LOG_LEVEL_OFF=y
CONFIG_I2S_LOG_LEVEL_OFF=y
```

## tests/drivers/i2s/i2s_speed/boards/mimxrt595_evk_mimxrt595s_cm33.conf
```kconfig
#
# Copyright 2023 NXP
#
# SPDX-License-Identifier: Apache-2.0
#

CONFIG_I2S_TEST_SEPARATE_DEVICES=y
```

## tests/drivers/i2s/i2s_speed/boards/mimxrt685_evk_cm33.conf
```kconfig
#
# Copyright (c) 2021, NXP
#
# SPDX-License-Identifier: Apache-2.0
#

CONFIG_I2S_TEST_SEPARATE_DEVICES=y
```

## tests/drivers/i2s/i2s_speed/boards/nrf52840dk_nrf52840.conf
```kconfig
CONFIG_I2S_TEST_USE_I2S_DIR_BOTH=y
CONFIG_I2S_TEST_USE_GPIO_LOOPBACK=y
CONFIG_I2S_TEST_ALLOWED_DATA_OFFSET=2
CONFIG_I2S_LOG_LEVEL_INF=y
```

## tests/drivers/i2s/i2s_speed/boards/nucleo_u575zi_q.conf
```kconfig
#
# Copyright (c) 2026 Mario Paja
#
# SPDX-License-Identifier: Apache-2.0
#

CONFIG_HEAP_MEM_POOL_SIZE=128
CONFIG_I2S_TEST_SEPARATE_DEVICES=y
CONFIG_I2S_TEST_USE_GPIO_LOOPBACK=y
CONFIG_I2S_TEST_USE_I2S_DIR_BOTH=n

# 88200Hz is not supported by Hardware
CONFIG_I2S_TEST_SKIP_SAMPLERATE_88200=y

# Clock is optimized for 44100Hz, 96000Hz is not supported
CONFIG_I2S_TEST_SKIP_SAMPLERATE_96000=y
```

## tests/drivers/i2s/i2s_speed/boards/stm32h573i_dk.conf
```kconfig
#
# Copyright (c) 2024 STMicroelectronics
#
# SPDX-License-Identifier: Apache-2.0
#
CONFIG_I2S_TEST_SEPARATE_DEVICES=y
```

## tests/drivers/i2s/i2s_speed/testcase.yaml
```yaml
tests:
  drivers.i2s.speed:
    depends_on: i2s
    tags:
      - drivers
      - i2s
    filter: not CONFIG_I2S_TEST_USE_GPIO_LOOPBACK
    extra_configs:
      - CONFIG_CLOCK_CONTROL_NRF=n
    platform_exclude:
      - nrf54h20dk/nrf54h20/cpuapp
      - mimxrt1060_evk/mimxrt1062/qspi
      - mimxrt1180_evk/mimxrt1189/cm33
      - mimxrt1180_evk/mimxrt1189/cm7

  drivers.i2s.speed.gpio_loopback:
    depends_on:
      - i2s
      - gpio
    tags:
      - drivers
      - i2s
    filter: CONFIG_I2S_TEST_USE_GPIO_LOOPBACK
    extra_configs:
      - CONFIG_CLOCK_CONTROL_NRF=n
    platform_exclude:
      - nrf54h20dk/nrf54h20/cpuapp
    harness: ztest
    harness_config:
      fixture: gpio_loopback

  drivers.i2s.speed.gpio_loopback.aclk:
    depends_on:
      - i2s
      - gpio
    tags:
      - drivers
      - i2s
    filter: CONFIG_I2S_TEST_USE_GPIO_LOOPBACK
    extra_configs:
      - CONFIG_CLOCK_CONTROL_NRF=n
    harness: ztest
    harness_config:
      fixture: gpio_loopback
    extra_args: EXTRA_DTC_OVERLAY_FILE="boards/nrf5340dk_nrf5340_cpuapp_aclk.overlay"
    platform_allow: nrf5340dk/nrf5340/cpuapp

  drivers.i2s.speed.gpio_loopback.nrf54h:
    depends_on: i2s
    tags:
      - drivers
      - i2s
    harness_config:
      fixture: i2s_loopback
    extra_configs:
      - CONFIG_CLOCK_CONTROL_NRF=n
    platform_allow:
      - nrf54h20dk/nrf54h20/cpuapp
    integration_platforms:
      - nrf54h20dk/nrf54h20/cpuapp

  drivers.i2s.speed.legacy:
    depends_on: i2s
    tags:
      - drivers
      - i2s
    filter: not CONFIG_I2S_TEST_USE_GPIO_LOOPBACK
    extra_configs:
      - CONFIG_CLOCK_CONTROL_NRF=y
      - CONFIG_DEPRECATION_TEST=y
    platform_exclude:
      - nrf54h20dk/nrf54h20/cpuapp
      - mimxrt1060_evk/mimxrt1062/qspi
      - mimxrt1180_evk/mimxrt1189/cm33
      - mimxrt1180_evk/mimxrt1189/cm7

  drivers.i2s.speed.gpio_loopback.legacy:
    depends_on:
      - i2s
      - gpio
    tags:
      - drivers
      - i2s
    filter: CONFIG_I2S_TEST_USE_GPIO_LOOPBACK
    extra_configs:
      - CONFIG_CLOCK_CONTROL_NRF=y
      - CONFIG_DEPRECATION_TEST=y
    platform_exclude:
      - nrf54h20dk/nrf54h20/cpuapp
    harness: ztest
    harness_config:
      fixture: gpio_loopback

  drivers.i2s.speed.gpio_loopback.aclk.legacy:
    depends_on:
      - i2s
      - gpio
    tags:
      - drivers
      - i2s
    filter: CONFIG_I2S_TEST_USE_GPIO_LOOPBACK
    extra_configs:
      - CONFIG_CLOCK_CONTROL_NRF=y
      - CONFIG_DEPRECATION_TEST=y
    harness: ztest
    harness_config:
      fixture: gpio_loopback
    extra_args: EXTRA_DTC_OVERLAY_FILE="boards/nrf5340dk_nrf5340_cpuapp_aclk.overlay"
    platform_allow: nrf5340dk/nrf5340/cpuapp

  drivers.i2s.speed.gpio_loopback.nrf54h.legacy:
    depends_on: i2s
    tags:
      - drivers
      - i2s
    harness_config:
      fixture: i2s_loopback
    extra_configs:
      - CONFIG_CLOCK_CONTROL_NRF=y
      - CONFIG_DEPRECATION_TEST=y
    platform_allow:
      - nrf54h20dk/nrf54h20/cpuapp
    integration_platforms:
      - nrf54h20dk/nrf54h20/cpuapp
```
