/* i2s_speed with CONFIG_I2S_TEST_SEPARATE_DEVICES=n uses only one I2S peripheral:
 * i2s-node0 is both the transitter and receiver.
 * uses SAI1 peripheral on RT1170
 */
/ {
	aliases {
		i2s-node0 = &sai1;
	};
};

/* Default DMA channel 0 and 1 maybe used by other peripherals like UART. */
&sai1 {
	nxp,tx-dma-channel = <8>;
	nxp,rx-dma-channel = <9>;
};
