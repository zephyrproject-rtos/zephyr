/*
 * Copyright (c) 2024 Arif Balik <arifbalik@outlook.com>
 * SPDX-License-Identifier: Apache-2.0
 */

/ {
	zephyr,user {
		/* This will be used to trigger the SYNC (PB8) pin high and low programmatically.
		 * They have to be connected.
		 */
		signal-gpios = <&gpioa 10 GPIO_ACTIVE_HIGH>;
	};
};

&tsc {
	status = "okay";

	pinctrl-0 = <&tsc_g1_io3_pa2 &tsc_g1_io4_pa3 &tsc_g2_io3_pa6 &tsc_g2_io4_pa7 &tsc_g3_io2_pb0
		     &tsc_sync_pb8>;
	pinctrl-names = "default";

	st,pulse-generator-prescaler = <128>;

	st,spread-spectrum;
	st,spread-spectrum-prescaler = <2>;
	st,spread-spectrum-deviation = <10>;

	st,max-count-value = <16383>;

	st,synced-acquisition;
	st,syncpol-rising;
};
