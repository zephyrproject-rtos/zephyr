/*
 * Copyright (c) 2026 Andrew Yong <me@ndoo.sg>
 *
 * SPDX-License-Identifier: Apache-2.0
 *
 * Data bus interleaved over four GPIO controllers, with an active-low pin in the first group.
 */

#include "mipi_dbi_bitbang_native_sim_2port_split.overlay"

/ {
	gpio3: gpio3 {
		compatible = "zephyr,gpio-emul";
		#gpio-cells = <2>;
		gpio-controller;
		status = "okay";
	};

	gpio4: gpio4 {
		compatible = "zephyr,gpio-emul";
		#gpio-cells = <2>;
		gpio-controller;
		status = "okay";
	};
};

&mipi_dbi {
	data-gpios = <&gpio1 0 GPIO_ACTIVE_LOW>, <&gpio2 0 GPIO_ACTIVE_HIGH>,
		     <&gpio3 0 GPIO_ACTIVE_HIGH>, <&gpio4 0 GPIO_ACTIVE_HIGH>,
		     <&gpio1 1 GPIO_ACTIVE_HIGH>, <&gpio2 1 GPIO_ACTIVE_HIGH>,
		     <&gpio3 1 GPIO_ACTIVE_HIGH>, <&gpio4 1 GPIO_ACTIVE_HIGH>;
};
