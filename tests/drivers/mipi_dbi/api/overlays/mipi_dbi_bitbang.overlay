/*
 * Copyright 2026 Hsiu-Chi Tsai
 *
 * SPDX-License-Identifier: Apache-2.0
 */

/*
 * The eight data lines share one emulated port, so this also covers the driver's
 * single-port lookup-table path rather than only its per-pin fallback.
 */
/ {
	mipi_dbi: mipi_dbi {
		status = "okay";
		compatible = "zephyr,mipi-dbi-bitbang";
		reset-gpios = <&gpio0 12 GPIO_ACTIVE_LOW>;
		cs-gpios = <&gpio0 10 GPIO_ACTIVE_LOW>;
		dc-gpios = <&gpio0 11 GPIO_ACTIVE_HIGH>;
		wr-gpios = <&gpio0 9 GPIO_ACTIVE_HIGH>;
		rd-gpios = <&gpio0 8 GPIO_ACTIVE_HIGH>;
		data-gpios = <&gpio0 0 GPIO_ACTIVE_HIGH>,
			     <&gpio0 1 GPIO_ACTIVE_HIGH>,
			     <&gpio0 2 GPIO_ACTIVE_HIGH>,
			     <&gpio0 3 GPIO_ACTIVE_HIGH>,
			     <&gpio0 4 GPIO_ACTIVE_HIGH>,
			     <&gpio0 5 GPIO_ACTIVE_HIGH>,
			     <&gpio0 6 GPIO_ACTIVE_HIGH>,
			     <&gpio0 7 GPIO_ACTIVE_HIGH>;
		#address-cells = <1>;
		#size-cells = <0>;
	};
};
