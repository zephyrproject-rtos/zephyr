/*
 * Copyright (c) 2026 Andrew Yong <me@ndoo.sg>
 *
 * SPDX-License-Identifier: Apache-2.0
 *
 * Data bus split 4+4 across two distinct GPIO controllers.
 */

#include <zephyr/dt-bindings/gpio/gpio.h>

/ {
	gpio1: gpio1 {
		compatible = "zephyr,gpio-emul";
		#gpio-cells = <2>;
		gpio-controller;
		status = "okay";
	};

	gpio2: gpio2 {
		compatible = "zephyr,gpio-emul";
		#gpio-cells = <2>;
		gpio-controller;
		status = "okay";
	};

	mipi_dbi: mipi_dbi {
		compatible = "zephyr,mipi-dbi-bitbang";
		dc-gpios = <&gpio0 0 GPIO_ACTIVE_HIGH>;
		wr-gpios = <&gpio0 1 GPIO_ACTIVE_HIGH>;
		rd-gpios = <&gpio0 2 GPIO_ACTIVE_HIGH>;
		cs-gpios = <&gpio0 3 GPIO_ACTIVE_LOW>;
		reset-gpios = <&gpio0 4 GPIO_ACTIVE_LOW>;
		data-gpios = <&gpio1 0 GPIO_ACTIVE_HIGH>, <&gpio1 1 GPIO_ACTIVE_HIGH>,
			     <&gpio1 2 GPIO_ACTIVE_HIGH>, <&gpio1 3 GPIO_ACTIVE_HIGH>,
			     <&gpio2 0 GPIO_ACTIVE_HIGH>, <&gpio2 1 GPIO_ACTIVE_HIGH>,
			     <&gpio2 2 GPIO_ACTIVE_HIGH>, <&gpio2 3 GPIO_ACTIVE_HIGH>;
		#address-cells = <1>;
		#size-cells = <0>;
		status = "okay";
	};
};
