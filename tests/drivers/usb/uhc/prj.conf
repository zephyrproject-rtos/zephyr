## CMakeLists.txt
```
# SPDX-FileCopyrightText: Copyright Nordic Semiconductor ASA
# SPDX-License-Identifier: Apache-2.0

cmake_minimum_required(VERSION 3.20.0)

find_package(Zephyr REQUIRED HINTS $ENV{ZEPHYR_BASE})
project(test_uhc)

target_include_directories(app PRIVATE ${ZEPHYR_BASE}/subsys/usb/host)
target_include_directories(app PRIVATE include)

target_sources(app PRIVATE src/main.c)
```

## prj.conf
```kconfig
# SPDX-FileCopyrightText: Copyright Nordic Semiconductor ASA
# SPDX-License-Identifier: Apache-2.0

CONFIG_LOG=y
CONFIG_ZTEST=y

CONFIG_UHC_DRIVER=y
CONFIG_USB_HOST_STACK=y
```

## boards/qemu_riscv32_qemu_virt_riscv32_smp.conf
```kconfig
CONFIG_QEMU_EXTRA_FLAGS="-device usb-ccid"
```

## src/main.c
```c
/*
 * SPDX-FileCopyrightText: Copyright Nordic Semiconductor ASA
 * SPDX-License-Identifier: Apache-2.0
 */

#include <zephyr/ztest.h>
#include <zephyr/usb/usbh.h>
#include <zephyr/logging/log.h>
#include <zephyr/devicetree.h>

#include "usbh_device.h"

LOG_MODULE_REGISTER(udc_test, LOG_LEVEL_INF);

USBH_CONTROLLER_DEFINE(uhs_ctx, DEVICE_DT_GET(DT_NODELABEL(zephyr_uhc0)));

ZTEST(usbh_test, test_device)
{
	struct usb_device *udev;
	int ret;

	ret = usbh_init(&uhs_ctx);
	zassert_ok(ret, "Failed to initialize USB host");

	ret = usbh_enable(&uhs_ctx);
	zassert_ok(ret, "Failed to enable USB host");

	LOG_INF("Host controller enabled");

	/* Give time for any USB Host stack operation to complete */
	k_sleep(K_MSEC(500));

	udev = usbh_device_get_any(&uhs_ctx);
	zassert_not_null(udev, "Expecting a device to be connected and detected");
	zassert_not_equal(udev->addr, 0, "Could not complete enumeration up to SET_ADDRESS");
	zassert_not_null(udev->cfg_desc, "Could not read configuration descriptor header");
	zassert_equal(udev->state, USB_STATE_CONFIGURED, "Could not complete configuration");

	ret = usbh_disable(&uhs_ctx);
	zassert_ok(ret, "Failed to disable USB host");

	ret = usbh_shutdown(&uhs_ctx);
	zassert_ok(ret, "Failed to shutdown host support");

	LOG_INF("Host controller disabled");
}

ZTEST_SUITE(usbh_test, NULL, NULL, NULL, NULL, NULL);
```
