## CMakeLists.txt
```
# SPDX-License-Identifier: Apache-2.0

cmake_minimum_required(VERSION 3.20.0)
find_package(Zephyr REQUIRED HINTS $ENV{ZEPHYR_BASE})
project(uhc_dwc3_build)

target_sources(app PRIVATE src/main.c)
```

## prj.conf
```kconfig
CONFIG_ZTEST=y

CONFIG_USB_HOST_STACK=y
CONFIG_UHC_DWC3=y
```

## versal_apu.overlay
```dts
/*
 * Devicetree overlay: DWC3 xHCI USB host on versal_apu (&soc).
 *
 * SPDX-FileCopyrightText: Copyright (c) 2026 Advanced Micro Devices, Inc.
 * SPDX-License-Identifier: Apache-2.0
 */

#include <zephyr/dt-bindings/interrupt-controller/arm-gic.h>

&soc {
	zephyr_uhc0: usb_host@fe200000 {
		compatible = "snps,dwc3";
		reg = <0x00 0xfe200000 0x00 0x10000>,
		      <0x00 0xff9d0000 0x00 0x100>;
		reg-names = "core", "usb2_wrapper";
		interrupts = <GIC_SPI 22 IRQ_TYPE_LEVEL IRQ_DEFAULT_PRIORITY>;
		status = "okay";
	};
};
```

## src/main.c
```c
/*
 * Copyright (c) 2026 Advanced Micro Devices, Inc.
 *
 * SPDX-License-Identifier: Apache-2.0
 */

#include <zephyr/ztest.h>

ZTEST(uhc_dwc3_build, test_build)
{
	zassert_true(IS_ENABLED(CONFIG_UHC_DWC3));
}

ZTEST_SUITE(uhc_dwc3_build, NULL, NULL, NULL, NULL, NULL);
```
