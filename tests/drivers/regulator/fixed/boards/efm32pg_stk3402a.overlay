/*
 * Copyright (c) 2022 T-Mobile USA, Inc.
 *
 * SPDX-License-Identifier: Apache-2.0
 */

#include "test_common.dtsi"

/ {
	regulator {
		enable-gpios = <&gpioa 3 GPIO_ACTIVE_HIGH>;
	};
	resources {
		check-gpios = <&gpioa 4 (GPIO_ACTIVE_HIGH | GPIO_PULL_DOWN)>;
	};
};
