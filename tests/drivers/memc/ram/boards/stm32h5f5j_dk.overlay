/*
 * Copyright (c) 2026 STMicroelectronics
 *
 * SPDX-License-Identifier: Apache-2.0
 */

&sram1 {
	status = "disabled";
};

/ {
	aliases {
		psram0 = &memc;
	};
};

&xspi1 {
	status = "disabled";
};
