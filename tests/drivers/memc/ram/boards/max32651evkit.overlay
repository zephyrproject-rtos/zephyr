/*
 * Copyright (c) 2026 Analog Devices, Inc.
 *
 * SPDX-License-Identifier: Apache-2.0
 */

&sram1 {
	status = "disabled";
};

&sram2 {
	status = "disabled";
};

&hpb {
	status = "okay";
};

&sdram1 {
	status = "okay";
};
