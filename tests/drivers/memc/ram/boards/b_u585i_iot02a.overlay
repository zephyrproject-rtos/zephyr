/*
 * Copyright (c) 2025 ZAL Zentrum für Angewandte Luftfahrtforschung GmbH
 * Copyright (c) 2026 STMicroelectronics
 *
 * SPDX-License-Identifier: Apache-2.0
 */

&sram1 {
	status = "disabled";
};

/ {
	aliases {
		psram0 = &memc;
	};
};
