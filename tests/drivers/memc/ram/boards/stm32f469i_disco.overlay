/*
 * Copyright (c) 2025 STMicroelectronics
 *
 * SPDX-License-Identifier: Apache-2.0
 */

/* Test the full SDRAM accesses. Discable LTDC to prevent conflicts */

ram0: &sdram1 {};

&ltdc {
	status = "disabled";
};
