## tests/drivers/memc/ram/testcase.yaml
```yaml
tests:
  drivers.memc:
    simulation_exclude:
      - renode
    tags:
      - drivers
      - memc
    depends_on: memc
    integration_platforms:
      - sam4s_xplained
    extra_args:
      - platform:da1469x_dk_pro/da14699:EXTRA_DTC_OVERLAY_FILE="da1469x_dk_pro_psram.overlay"
      - platform:da14695_dk_usb/da14695:EXTRA_DTC_OVERLAY_FILE="da14695_dk_usb_psram.overlay"
  drivers.memc.stm32_mspi:
    tags: mspi
    filter: dt_alias_exists("psram0")
    platform_allow:
      - b_u585i_iot02a
      - stm32h7s78_dk
    integration_platforms:
      - b_u585i_iot02a
      - stm32h7s78_dk
    extra_args:
      - platform:b_u585i_iot02a:DTC_OVERLAY_FILE=boards/b_u585i_iot02a_mspi_aps6408l.overlay
      - platform:b_u585i_iot02a:EXTRA_CONF_FILE=boards/b_u585i_iot02a_mspi_aps6408l.conf
      - platform:stm32h7s78_dk:CONF_FILE=boards/stm32h7s78_dk_mspi_psram.conf
      - platform:stm32h7s78_dk:DTC_OVERLAY_FILE=boards/stm32h7s78_dk_mspi_psram.overlay
```

## tests/drivers/memc/stm32_sdram/testcase.yaml
```yaml
tests:
  drivers.memc.stm32_sdram:
    tags: drivers memc
    depends_on: memc
    filter: dt_compat_enabled("st,stm32-fmc-sdram")
```

## tests/drivers/mipi_dbi/api/testcase.yaml
```yaml
common:
  tags:
    - drivers
    - mipi-dbi

tests:
  drivers.mipi_dbi.api:
    filter: dt_nodelabel_enabled("mipi-dbi")
  drivers.mipi_dbi.rpi_pico.pio0.single_split:
    platform_allow:
      - rpi_pico/rp2040
      - rpi_pico2/rp2350a/m33
      - rpi_pico2/rp2350a/hazard3
    extra_args:
      - EXTRA_DTC_OVERLAY_FILE=overlays/mipi_dbi_rpi_pico_pio0_1_split.overlay
  drivers.mipi_dbi.rpi_pico.pio0.four_splits:
    platform_allow:
      - rpi_pico/rp2040
      - rpi_pico2/rp2350a/m33
      - rpi_pico2/rp2350a/hazard3
    extra_args:
      - EXTRA_DTC_OVERLAY_FILE=overlays/mipi_dbi_rpi_pico_pio0_4_splits.overlay
  drivers.mipi_dbi.rpi_pico.pio1.single_split:
    platform_allow:
      - rpi_pico/rp2040
      - rpi_pico2/rp2350a/m33
      - rpi_pico2/rp2350a/hazard3
    extra_args:
      - EXTRA_DTC_OVERLAY_FILE=overlays/mipi_dbi_rpi_pico_pio1_1_split.overlay
  drivers.mipi_dbi.rpi_pico.pio1.four_splits:
    platform_allow:
      - rpi_pico/rp2040
      - rpi_pico2/rp2350a/m33
      - rpi_pico2/rp2350a/hazard3
    extra_args:
      - EXTRA_DTC_OVERLAY_FILE=overlays/mipi_dbi_rpi_pico_pio1_4_splits.overlay
  drivers.mipi_dbi.rpi_pico.multiple_instances.four_splits:
    platform_allow:
      - rpi_pico/rp2040
      - rpi_pico2/rp2350a/m33
      - rpi_pico2/rp2350a/hazard3
    extra_args:
      - EXTRA_DTC_OVERLAY_FILE=overlays/mipi_dbi_rpi_pico_multiple_instances_4_splits.overlay
      - MULTIPLE_INSTANCES=1
  drivers.mipi_dbi.rpi_pico.pio2.single_split:
    platform_allow:
      - rpi_pico2/rp2350a/m33
      - rpi_pico2/rp2350a/hazard3
    extra_args:
      - EXTRA_DTC_OVERLAY_FILE=overlays/mipi_dbi_rpi_pico_pio2_1_split.overlay
  drivers.mipi_dbi.rpi_pico.pio2.four_splits:
    platform_allow:
      - rpi_pico2/rp2350a/m33
      - rpi_pico2/rp2350a/hazard3
    extra_args:
      - EXTRA_DTC_OVERLAY_FILE=overlays/mipi_dbi_rpi_pico_pio2_4_splits.overlay
```

## tests/drivers/mipi_dbi/mipi_dbi_rpi_pico/testcase.yaml
```yaml
common:
  tags:
    - drivers
    - mipi_dbi

tests:
  drivers.mipi_dbi.rpi_pico.pio0.single_split:
    filter: CONFIG_SOC_FAMILY_RPI_PICO
    extra_args:
      - EXTRA_DTC_OVERLAY_FILE=overlays/mipi_dbi_rpi_pico_pio0_1_split.overlay
  drivers.mipi_dbi.rpi_pico.pio0.four_splits:
    filter: CONFIG_SOC_FAMILY_RPI_PICO
    extra_args:
      - EXTRA_DTC_OVERLAY_FILE=overlays/mipi_dbi_rpi_pico_pio0_4_splits.overlay
  drivers.mipi_dbi.rpi_pico.pio1.single_split:
    filter: CONFIG_SOC_FAMILY_RPI_PICO
    extra_args:
      - EXTRA_DTC_OVERLAY_FILE=overlays/mipi_dbi_rpi_pico_pio1_1_split.overlay
  drivers.mipi_dbi.rpi_pico.pio1.four_splits:
    filter: CONFIG_SOC_FAMILY_RPI_PICO
    extra_args:
      - EXTRA_DTC_OVERLAY_FILE=overlays/mipi_dbi_rpi_pico_pio1_4_splits.overlay
  drivers.mipi_dbi.rpi_pico.multiple_instances.four_splits:
    filter: CONFIG_SOC_FAMILY_RPI_PICO
    extra_args:
      - EXTRA_DTC_OVERLAY_FILE=overlays/mipi_dbi_rpi_pico_multiple_instances_4_splits.overlay
      - MULTIPLE_INSTANCES=1
  drivers.mipi_dbi.rpi_pico.pio2.single_split:
    filter: CONFIG_SOC_SERIES_RP2350
    extra_args:
      - EXTRA_DTC_OVERLAY_FILE=overlays/mipi_dbi_rpi_pico_pio2_1_split.overlay
  drivers.mipi_dbi.rpi_pico.pio2.four_splits:
    filter: CONFIG_SOC_SERIES_RP2350
    extra_args:
      - EXTRA_DTC_OVERLAY_FILE=overlays/mipi_dbi_rpi_pico_pio2_4_splits.overlay
```

## tests/drivers/mipi_dsi/api/Kconfig
```kconfig
#
# Copyright 2022, NXP
#
# SPDX-License-Identifier: Apache-2.0
#

mainmenu "mipi-dsi API Test"

source "Kconfig.zephyr"

config MIPI_DSI_TEST_CHANNEL
	int "MIPI-DSI device channel number"
	default 0
	help
	  MIPI device channel number used for testing.
```

## tests/drivers/mipi_dsi/api/testcase.yaml
```yaml
tests:
  drivers.mipi_dsi.api:
    tags: drivers mipi_dsi
    depends_on: mipi_dsi
    filter: dt_alias_exists("mipi-dsi")
```

## tests/drivers/misc/espressif_rmt/loopback/testcase.yaml
```yaml
tests:
  drivers.misc.espressif_rmt.loopback:
    platform_allow:
      - esp32_devkitc/esp32/procpu
      - esp32c3_devkitc/esp32c3
      - esp32c5_devkitc/esp32c5/hpcore
      - esp32c6_devkitc/esp32c6/hpcore
      - esp32h2_devkitm/esp32h2
      - esp32s2_devkitc/esp32s2
      - esp32s3_devkitc/esp32s3/procpu
    harness: console
    harness_config:
      type: multi_line
      regex:
        - "Enable RMT RX channel"
        - "Enable RMT TX channel"
        - "RMT TX value 0x00"
        - "RMT RX value 0x00"
        - "RMT TX value 0x01"
        - "RMT RX value 0x01"
        - "RMT TX value 0x02"
        - "RMT RX value 0x02"
        - "RMT TX value 0x03"
        - "RMT RX value 0x03"
        - "RMT TX value 0x04"
        - "RMT RX value 0x04"
    tags:
      - drivers
```

## tests/drivers/misc/stm32_tsc/testcase.yaml
```yaml
tests:
  drivers.misc.stm32_tsc:
    tags: drivers misc stm32 tsc
    filter: dt_compat_enabled("st,stm32-tsc")
    depends_on: tsc
    integration_platforms: [stm32u083c_dk]
```

## tests/drivers/mm/sys_mm_drv_api/testcase.yaml
```yaml
tests:
  drivers.mm.sys_mm_drv_api:
    tags:
      - drivers
      - mm
    filter: dt_compat_enabled("intel,adsp-mtl-tlb") or dt_compat_enabled("intel,adsp-tlb")
    integration_platforms:
      - intel_adsp_ace15_mtpm
```

## tests/drivers/mm/sys_mm_drv_bank/testcase.yaml
```yaml
tests:
  drivers.mm.sys_mm_drv_bank:
    tags: drivers mm
    filter: dt_compat_enabled("intel,adsp-mtl-tlb") or
            dt_compat_enabled("intel,adsp-tlb")
```

## tests/drivers/modem/modem_cmd_handler/testcase.yaml
```yaml
tests:
  drivers.modem.modem_cmd_handler:
    tags:
      - drivers
      - modem
    platform_allow:
      - native_sim
    integration_platforms:
      - native_sim
```

## tests/drivers/modem/modem_socket/testcase.yaml
```yaml
tests:
  drivers.modem.modem_sockets:
    tags:
      - drivers
      - modem
    platform_allow:
      - native_sim
    integration_platforms:
      - native_sim
```

## tests/drivers/mspi/api/testcase.yaml
```yaml
# Copyright (c) 2024 Ambiq Micro Inc. <www.ambiq.com>
# SPDX-License-Identifier: Apache-2.0

tests:
  drivers.mspi.api:
    tags:
      - drivers
      - mspi
      - api
    filter: dt_compat_enabled("zephyr,mspi-emul-controller")
    harness: ztest
    platform_allow:
      - native_sim
    integration_platforms:
      - native_sim
  drivers.mspi.api.ambiq:
    tags:
      - drivers
      - mspi
      - api
    filter: dt_compat_enabled("ambiq,mspi-controller")
    harness: ztest
    platform_allow:
      - apollo3p_evb
      - apollo510_evb
    extra_configs:
      - CONFIG_MSPI_AMBIQ_CONTROLLER=y
  drivers.mspi.api.stm32:
    tags:
      - drivers
      - mspi
      - api
    filter: dt_compat_enabled("st,stm32-ospi-controller")
            or dt_compat_enabled("st,stm32-xspi-controller")
    harness: ztest
    platform_allow:
      - b_u585i_iot02a
```

## tests/drivers/mspi/flash/boards/apollo3p_evb.conf
```kconfig
# Copyright (c) 2024 Ambiq Micro Inc. <www.ambiq.com>
# SPDX-License-Identifier: Apache-2.0

CONFIG_FLASH_MSPI_ATXP032=y
CONFIG_MSPI_INIT_PRIORITY=40
CONFIG_FLASH_INIT_PRIORITY=50
CONFIG_PM_DEVICE=y
```

## tests/drivers/mspi/flash/boards/apollo4p_evb.conf
```kconfig
# Copyright (c) 2025 Ambiq Micro Inc. <www.ambiq.com>
# SPDX-License-Identifier: Apache-2.0

CONFIG_MSPI_INIT_PRIORITY=40
CONFIG_FLASH_INIT_PRIORITY=50
CONFIG_PM_DEVICE=y
CONFIG_PM_DEVICE_RUNTIME=y
```

## tests/drivers/mspi/flash/boards/apollo510_evb.conf
```kconfig
# Copyright (c) 2025 Ambiq Micro Inc. <www.ambiq.com>
# SPDX-License-Identifier: Apache-2.0

CONFIG_LOG=y
CONFIG_LOG_DEFAULT_LEVEL=0
CONFIG_FLASH_INIT_PRIORITY=50
```

## tests/drivers/mspi/flash/boards/b_u585i_iot02a.conf
```kconfig
# Copyright (c) 2026 Ambiq Micro Inc. <www.ambiq.com>
# SPDX-License-Identifier: Apache-2.0

CONFIG_MSPI_MEMMAP=y
CONFIG_FLASH_MSPI_MEMMAP_READ=y

# Exercise the memory-mapped read path with the data cache enabled;
# the DCACHE peripheral covers the OCTOSPI memory-mapped region.
CONFIG_CACHE_MANAGEMENT=y
CONFIG_DCACHE=y
CONFIG_CACHE_STM32=y
CONFIG_DCACHE_LINE_SIZE=16
```

## tests/drivers/mspi/flash/boards/mec_assy6941_mec1753_qlj.conf
```kconfig
CONFIG_FLASH=y
CONFIG_FLASH_JESD216_API=y
CONFIG_FLASH_PAGE_LAYOUT=y
CONFIG_MSPI=y
CONFIG_MSPI_DMA=y
CONFIG_PM_DEVICE=y
```

## tests/drivers/mspi/flash/boards/native_sim.conf
```kconfig
# Copyright (c) 2024 Ambiq Micro Inc. <www.ambiq.com>
# SPDX-License-Identifier: Apache-2.0

CONFIG_EMUL=y
CONFIG_FLASH_MSPI_EMUL_DEVICE=y
```

## tests/drivers/mspi/flash/boards/stm32h573i_dk.conf
```kconfig
# Copyright (c) 2024 STMicroelectronics
# SPDX-License-Identifier: Apache-2.0

CONFIG_FLASH_MSPI_NOR_MX=y
```

## tests/drivers/mspi/flash/testcase.yaml
```yaml
# Copyright (c) 2024 Ambiq Micro Inc. <www.ambiq.com>
# SPDX-License-Identifier: Apache-2.0

common:
  tags:
    - drivers
    - mspi
    - flash
  harness: ztest

tests:
  drivers.mspi.flash:
    filter: dt_compat_enabled("zephyr,mspi-emul-flash")
      or dt_compat_enabled("jedec,spi-nor") or dt_compat_enabled("jedec,mspi-nor")
      or dt_compat_enabled("mspi-atxp032") or dt_compat_enabled("mspi-is25xX0xx")
    platform_allow:
      - native_sim
      - apollo3p_evb
      - apollo510_evb
    integration_platforms:
      - native_sim
      - apollo3p_evb
      - apollo510_evb
  drivers.mspi.flash.xip_read:
    filter: dt_compat_enabled("mspi-is25xX0xx")
    platform_allow:
      - apollo510_evb
    integration_platforms:
      - apollo510_evb
    extra_configs:
      - CONFIG_FLASH_MSPI_XIP_READ=y
  drivers.mspi.flash.mspi_dw_system_workqueue:
    filter: dt_alias_exists("mspi0") and dt_compat_enabled("jedec,mspi-nor")
      and CONFIG_MSPI_DW
    integration_platforms:
      - nrf54h20dk/nrf54h20/cpuapp
    extra_configs:
      - CONFIG_MSPI_DW_HANDLE_FIFOS_IN_SYSTEM_WORKQUEUE=y
  drivers.mspi.flash.mspi_nor_no_multithreading:
    filter: dt_alias_exists("mspi0") and CONFIG_FLASH_MSPI_NOR
    platform_allow:
      - nrf54h20dk/nrf54h20/cpuapp
    extra_configs:
      - CONFIG_MULTITHREADING=n
  drivers.mspi.flash.dma:
    filter: dt_alias_exists("mspi0") and dt_compat_enabled("nordic,nrf-mspi")
    platform_allow:
      - nrf7120dk/nrf7120/cpuapp
    extra_configs:
      - CONFIG_MSPI_DMA=y
```

## tests/drivers/mspi/mspi_tx_rx_loopback/testcase.yaml
```yaml
common:
  tags:
    - drivers
    - mspi
  harness: ztest
  harness_config:
    fixture: mspi_tx_rx_loopback

tests:
  drivers.mspi.mspi_tx_rx_loopback:
    platform_allow:
      - nrf7120dk/nrf7120/cpuapp
    extra_configs:
      - CONFIG_MSPI_DMA=y
```

## tests/drivers/mtd/testcase.yaml
```yaml
tests:
  drivers.flash.mtd_part:
    platform_allow: native_posix nrf52840dk_nrf52840
    tags: mtd_part
```
