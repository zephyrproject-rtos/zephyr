/*
 * Copyright (c) 2026 Nordic Semiconductor ASA
 * SPDX-License-Identifier: Apache-2.0
 */

/ {
	aliases {
		memc0 = &is66wvs8m8f;
	};
};

&mspi01 {
	status = "okay";
};

&is66wvs8m8f {
	status = "okay";
};
