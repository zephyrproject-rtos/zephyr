/*
 * SPDX-FileCopyrightText: Copyright The Zephyr Project Contributors
 * SPDX-License-Identifier: Apache-2.0
 */

&i2c0 {
	bq41z50: bq41z50@b {
		compatible = "ti,bq41z50";
		reg = <0x0b>;
		status = "okay";
	};
};
