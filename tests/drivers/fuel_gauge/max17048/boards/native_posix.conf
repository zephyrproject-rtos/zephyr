## tests/drivers/fuel_gauge/max17048/boards/native_posix.conf
```kconfig
# SPDX-License-Identifier: Apache-2.0

CONFIG_EMUL=y
CONFIG_EMUL_MAX17048=y
CONFIG_I2C=y
CONFIG_I2C_EMUL=y
```

## tests/drivers/fuel_gauge/max17048/testcase.yaml
```yaml
tests:
  drivers.fuel_gauge.max17048:
    tags:
      - fuel_gauge
    filter: dt_compat_enabled("maxim,max17048")
    platform_allow: native_posix
```

## tests/drivers/fuel_gauge/sbs_gauge/Kconfig
```kconfig
# Copyright 2023 Google LLC
#
# SPDX-License-Identifier: Apache-2.0

source "Kconfig.zephyr"

config TEST_SBS_CUTOFF_EXTENSION
	bool "Test Battery Cutoff"
	help
	  Enabling this option adds test sources that verify if the battery cutoff extension to the
	  SBS driver are functional.
```

## tests/drivers/fuel_gauge/sbs_gauge/testcase.yaml
```yaml
tests:
  drivers.fuel_gauge.sbs_gauge_new_api.emulated:
    tags:
      - drivers
      - fuel_gauge
    platform_key:
      - arch
      - simulation
    filter: dt_compat_enabled("sbs,sbs-gauge-new-api")
    extra_args:
      - CONF_FILE="prj.conf;boards/emulated_board.conf"
      - DTC_OVERLAY_FILE="boards/emulated_board.overlay"
    platform_exclude:
      - hifive_unmatched
      - qemu_cortex_a53
      - qemu_cortex_a53/qemu_cortex_a53/smp
      - qemu_kvm_arm64
      - xenvm
      - xenvm/xenvm/gicv3
      - rcar_h3ulcb/r8a77951/a57
      - rcar_salvator_xs
    integration_platforms:
      - qemu_x86
  drivers.fuel_gauge.sbs_gauge_new_api.emulated_64_bit_i2c_addr:
    tags:
      - drivers
      - fuel_gauge
    platform_key:
      - arch
      - simulation
    filter: dt_compat_enabled("sbs,sbs-gauge-new-api")
    platform_allow:
      - hifive_unmatched
      - qemu_cortex_a53
      - qemu_cortex_a53/qemu_cortex_a53/smp
      - qemu_kvm_arm64
      - xenvm
      - xenvm/xenvm/gicv3
    integration_platforms:
      - qemu_cortex_a53
    extra_args:
      - CONF_FILE="prj.conf;boards/qemu_cortex_a53.conf"
      - DTC_OVERLAY_FILE="boards/qemu_cortex_a53.overlay"
  drivers.fuel_gauge.sbs_gauge_new_api.emulated.cutoff:
    tags:
      - drivers
      - fuel_gauge
    filter: dt_compat_enabled("sbs,sbs-gauge-new-api")
    extra_args:
      - DTC_OVERLAY_FILE="boards/emulated_board_cutoff.overlay"
    extra_configs:
      - CONFIG_EMUL=y
      - CONFIG_TEST_SBS_CUTOFF_EXTENSION=y
      - CONFIG_USERSPACE=y
    platform_allow:
      - native_posix
      - native_sim
      - qemu_x86
```

## tests/drivers/fuel_gauge/sy24561/testcase.yaml
```yaml
tests:
  drivers.fuel_gauge.sy24561:
    tags:
      - fuel_gauge
    filter: dt_compat_enabled("silergy,sy24561")
    platform_allow:
      - native_sim
      - native_sim/native/64
    harness: console
    harness_config:
      type: multi_line
      ordered: true
      regex:
        - "Property 65535 not supported"
        - "SY24561: SOC alarm threshold 0 should be >= 1"
        - "emul_sy24561_reg_write: 0x0c 0x3c1f"
        - "SY24561: SOC alarm threshold 255 should be <= 32"
        - "emul_sy24561_reg_write: 0x0c 0x3c00"
        - "SY24561: Temperature 0.0K should be >= 253.1K"
        - "emul_sy24561_reg_write: 0x0c 0x141c"
        - "SY24561: Temperature 6553.5K should be <= 333.1K"
        - "emul_sy24561_reg_write: 0x0c 0x641c"
```

## tests/drivers/gnss/gnss_api/Kconfig
```kconfig
# Copyright (c) 2024 Trackunit Corporation
# SPDX-License-Identifier: Apache-2.0

source "Kconfig.zephyr"

config TEST_ENABLED_SYSTEMS_0
	int "Enabled systems configuration 0"
	range 0 255
	default 0

config TEST_ENABLED_SYSTEMS_1
	int "Enabled systems configuration 1"
	range 0 255
	default 0

config TEST_ENABLED_SYSTEMS_2
	int "Enabled systems configuration 2"
	range 0 255
	default 0

config TEST_ENABLED_SYSTEMS_3
	int "Enabled systems configuration 3"
	range 0 255
	default 0

config TEST_SEARCH_PERIOD
	int "Search period for satellites in seconds"
	default 60

config TEST_FIX_TIMEOUT
	int "Timeout waiting for a fix in seconds"
	default 60
```

## tests/drivers/gnss/gnss_api/boards/qemu_x86_64.conf
```kconfig
# Copyright (c) 2024 Trackunit Corporation
# SPDX-License-Identifier: Apache-2.0

CONFIG_GNSS_SATELLITES=y

# GPS
CONFIG_TEST_ENABLED_SYSTEMS_0=1
# GPS + GLONASS
CONFIG_TEST_ENABLED_SYSTEMS_1=3
# GPS + GLONASS + QZSS
CONFIG_TEST_ENABLED_SYSTEMS_2=19
# GPS + GLONASS + GALILEO + BEIDOU + QZSS + SBAS
CONFIG_TEST_ENABLED_SYSTEMS_3=95

# This emulated board runs real-time
# Lower timeouts to prevent unnecessary waiting
CONFIG_TEST_SEARCH_PERIOD=5
CONFIG_TEST_FIX_TIMEOUT=1
```

## tests/drivers/gnss/gnss_api/testcase.yaml
```yaml
# Copyright (c) 2024 Trackunit Corporation
# SPDX-License-Identifier: Apache-2.0

tests:
  drivers.gnss.gnss_api:
    filter: dt_alias_exists("gnss")
    timeout: 300
```

## tests/drivers/gnss/gnss_dump/testcase.yaml
```yaml
# SPDX-License-Identifier: Apache-2.0

tests:
  gnss.gnss_dump:
    tags: gnss
    platform_allow:
      - native_posix
      - native_posix/native/64
      - native_sim
      - native_sim/native/64
    integration_platforms:
      - native_sim
    harness: console
    harness_config:
      type: multi_line
      regex:
        - "gnss_dev: gnss_info: {satellites_cnt: 0, hdop: 0.0, \
           fix_status: NO_FIX, fix_quality: INVALID}"
        - "gnss_dev: navigation_data: {latitude: 0.000000000, longitude : 0.000000000, \
           bearing 0.000, speed 0.000, altitude: 0.000}"
        - "gnss_dev: gnss_time: {hour: 0, minute: 0, millisecond 0, month_day 0, month: 0, \
           century_year: 0}"
        - "gnss_dev: gnss_info: {satellites_cnt: 6, hdop: 0.7, \
           fix_status: GNSS_FIX, fix_quality: GNSS_PPS}"
        - "gnss_dev: navigation_data: {latitude: 10.000000001, longitude : 20.000000002, \
           bearing 3.003, speed 4.004, altitude: 5.005}"
        - "gnss_dev: gnss_time: {hour: 1, minute: 2, millisecond 3, month_day 4, month: 5, \
           century_year: 6}"
        - "gnss_dev: navigation_data: {latitude: 0.000000001, longitude : 0.000000002, \
           bearing 0.003, speed 0.004, altitude: 0.005}"
        - "gnss_dev: navigation_data: {latitude: -10.000000001, longitude : -20.000000002, \
           bearing 0.003, speed 0.004, altitude: -5.005}"
        - "gnss_dev: navigation_data: {latitude: -0.000000001, longitude : -0.000000002, \
           bearing 0.003, speed 0.004, altitude: -0.005}"
        - "gnss_dev: gnss_satellite: {prn: 0, snr: 0, elevation 0, azimuth 0, system: unknown, \
           is_tracked: 0}"
        - "gnss_dev: gnss_satellite: {prn: 1, snr: 2, elevation 0, azimuth 3, system: GALILEO, \
           is_tracked: 1}"
```

## tests/drivers/gnss/gnss_emul/testcase.yaml
```yaml
# Copyright (c) 2025 Embeint Pty Ltd
# SPDX-License-Identifier: Apache-2.0

tests:
  drivers.gnss.gnss_emul:
    platform_allow:
      - native_sim
    integration_platforms:
      - native_sim
    tags:
      - gnss
```

## tests/drivers/gnss/gnss_nmea0183/testcase.yaml
```yaml
# Copyright (c) 2023 Trackunit Corporation
# SPDX-License-Identifier: Apache-2.0

tests:
  drivers.gnss.gnss_nmea0183:
    tags:
      - drivers
      - gnss
      - parse
      - nmea0183
```

## tests/drivers/gnss/gnss_parse/testcase.yaml
```yaml
# Copyright (c) 2023 Trackunit Corporation
# SPDX-License-Identifier: Apache-2.0

tests:
  drivers.gnss.gnss_parse:
    tags:
      - drivers
      - gnss
      - parse
```

## tests/drivers/gpio/gpio_api_1pin/boards/nrf54h20dk_nrf54h20_cpuflpr_xip.conf
```kconfig
# Copyright (c) 2026 Nordic Semiconductor ASA
# SPDX-License-Identifier: Apache-2.0

CONFIG_GPIO_NRFX_INTERRUPT=n
```

## tests/drivers/gpio/gpio_api_1pin/dts/bindings/test-gpio-external-pulldown.yaml
```yaml
#
# Copyright (c) 2024 Andrew Featherstone <andrew.featherstone@gmail.com>
#
# SPDX-License-Identifier: Apache-2.0
#

description: |
    This binding provides resources required to build and run the
    tests/drivers/gpio/gpio_api_1pin test in Zephyr on certain hardware.

compatible: "test-gpio-external-pulldown"

properties:
  gpios:
    type: phandle-array
    required: true
    description: |
      Identity of a GPIO that will be configured as both an output and input.
```

## tests/drivers/gpio/gpio_api_1pin/testcase.yaml
```yaml
common:
  tags:
    - drivers
    - gpio
  depends_on: gpio
  min_flash: 48
tests:
  drivers.gpio.1pin:
    filter: >
      dt_enabled_alias_with_parent_compat("led0", "gpio-leds")
      and not dt_compat_enabled("test-gpio-external-pulldown")
    # Fix exclude when we can exclude just sim run
    platform_exclude:
      - mps2/an385
      - mps2/an521/cpu0
      - mps2/an383
      - mps2/an386
      - mps2/an500
      - neorv32/neorv32/minimalboot
      - neorv32/neorv32/up5kdemo
  drivers.gpio.1pin.aw9523b:
    tags:
      - drivers
      - gpio
    depends_on:
      - gpio
      - arduino_gpio
      - i2c
      - arduino_i2c
    min_flash: 48
    harness_config:
      fixture: aw9523b_on_arduino_header
    filter: dt_enabled_alias_with_parent_compat("led0", "gpio-leds") and
            dt_compat_enabled("arduino-header-r3")
    extra_dtc_overlay_files:
      - "boards/aw9523b_on_arduino_header.overlay"
  drivers.gpio.1pin.external_pull_down:
    # For testing boards that require a test fixture that provides a pulldown
    # resistor on the GPIO used for the test.
    filter: dt_compat_enabled("test-gpio-external-pulldown")
    harness_config:
      fixture: gpio_external_pull_down
```

## tests/drivers/gpio/gpio_arduino/dts/bindings/test-arduino-gpio.yaml
```yaml
#
# Copyright (c) 2024 NXP
#
# SPDX-License-Identifier: Apache-2.0
#

description: |
    This binding provides resources required to build and run the
    tests/drivers/gpio/gpio_arduino test in Zephyr.

compatible: "test-arduino-gpio"

properties:
  in-gpios:
    type: phandle-array
    required: true

  out-gpios:
    type: phandle-array
    required: true
```

## tests/drivers/gpio/gpio_arduino/testcase.yaml
```yaml
common:
  tags:
    - drivers
    - gpio
  depends_on:
    - gpio
  harness: ztest

tests:
  drivers.gpio.arduino:
    depends_on:
      - gpio
      - arduino_gpio
    filter: dt_compat_enabled("arduino-header-r3")
    integration_platforms:
      - frdm_k64f
    platform_exclude:
      # below boards are mikro bus not arduino
      - da14695_dk_usb
      - stm32h735g_disco
      - stm32h750b_dk
    harness_config:
      fixture: arduino_gpio
  drivers.gpio.arduino.native_sim:
    integration_platforms:
      - native_sim
    platform_allow:
      - native_sim
```

## tests/drivers/gpio/gpio_basic_api/Kconfig
```kconfig
# Copyright (c) 2023 Nordic Semiconductor ASA
# SPDX-License-Identifier: Apache-2.0

source "Kconfig.zephyr"

config SKIP_PULL_TEST
	bool "Skip the pull test even if the driver supports it"

config GPIO_TEST_READ_DELAY
	int "GPIO basic API test read delay in ms"
	default 0
	help
	  Delay, in milliseconds, before reading the GPIO input in this
	  test. This can help boards with slower GPIO signal propagation.
```

## tests/drivers/gpio/gpio_basic_api/boards/native_posix_64.conf
```kconfig
# Copyright (c) 2020 Friedt Professional Engineering Services, Inc
# SPDX-License-Identifier: Apache-2.0

CONFIG_GPIO_EMUL=y
```
