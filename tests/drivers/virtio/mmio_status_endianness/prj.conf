## CMakeLists.txt
```
# SPDX-FileCopyrightText: Copyright The Zephyr Project Contributors
# SPDX-License-Identifier: Apache-2.0

cmake_minimum_required(VERSION 3.28.0)
find_package(Zephyr REQUIRED HINTS $ENV{ZEPHYR_BASE})
project(virtio_mmio_status_endianness)

target_include_directories(app PRIVATE
  ${ZEPHYR_BASE}/drivers/virtio
)

target_sources(app PRIVATE src/main.c)
```

## prj.conf
```kconfig
# SPDX-FileCopyrightText: Copyright The Zephyr Project Contributors
# SPDX-License-Identifier: Apache-2.0

CONFIG_ZTEST=y
CONFIG_VIRTIO=y
CONFIG_VIRTIO_MMIO=y
```

## src/main.c
```c
/*
 * SPDX-FileCopyrightText: Copyright The Zephyr Project Contributors
 *
 * SPDX-License-Identifier: Apache-2.0
 */

#include <stdint.h>

#include <zephyr/ztest.h>

#include "virtio_mmio_status.h"

ZTEST(virtio_mmio_status_endianness, test_status_bits_stay_in_cpu_byte_order)
{
	uint32_t status = BIT(7);

	status = virtio_mmio_status_with_bit(status, 0);
	zassert_equal(status, BIT(7) | BIT(0));

	status = virtio_mmio_status_with_bit(status, 3);
	zassert_equal(status, BIT(7) | BIT(3) | BIT(0));
}

ZTEST_SUITE(virtio_mmio_status_endianness, NULL, NULL, NULL, NULL, NULL);
```
