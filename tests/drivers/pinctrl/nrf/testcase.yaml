## tests/drivers/pinctrl/nrf/testcase.yaml
```yaml
tests:
  drivers.pinctrl.nrf:
    tags:
      - drivers
      - pinctrl
    vendor_allow:
      - nordic
    platform_exclude:
      - thingy53/nrf5340/cpunet
    integration_platforms:
      - qemu_cortex_m0/nrf51822
```

## tests/drivers/pinmux/pinmux_basic_api/testcase.yaml
```yaml
tests:
  drivers.pinmux:
    tags: drivers
    harness: loopback
    filter: dt_alias_exists("gpio-0") or dt_alias_exists("gpio-1")
    depends_on: gpio
```

## tests/drivers/psi5/psi5_api/testcase.yaml
```yaml
tests:
  drivers.psi5:
    tags:
      - drivers
      - psi5
    depends_on: psi5
    filter: dt_alias_exists("psi5-0")
```

## tests/drivers/pwm/pwm_api/Kconfig
```kconfig
# Copyright (c) 2025 Tenstorrent AI ULC
# SPDX-License-Identifier: Apache-2.0

mainmenu "PWM GPIO API test"

source "Kconfig.zephyr"

config DEFAULT_PWM_PORT
	int "Default PWM port/channel"
	default 1 if PWM_STM32 || PWM_MCHP_G1_TCC
	default 0
	help
	  PWM port matching the channel associated with PWM pin.

config INVALID_PWM_PORT
	int "Invalid PWM port/channel"
	default 9 if PWM_NRFX || PWM_MCHP_G1_TCC
	default -1
	help
	  Invalid PWM port/channel for negative testing.

config DEFAULT_PERIOD_CYCLE
	int "Default PWM period in cycles"
	default 1024 if SOC_MK64F12 || SOC_MKW41Z4 || SOC_ESP32S2 || SOC_ESP32S3 || SOC_ESP32C3
	default 32768 if PWM_INTEL_BLINKY
	default 64000
	help
	  Default PWM period in clock cycles.

config DEFAULT_PULSE_CYCLE
	int "Default PWM pulse in cycles"
	default 512 if SOC_MK64F12 || SOC_MKW41Z4 || SOC_ESP32S2 || SOC_ESP32S3 || SOC_ESP32C3
	default 16384 if PWM_INTEL_BLINKY
	default 32000
	help
	  Default PWM pulse in clock cycles.

config DEFAULT_PERIOD_NSEC
	int "Default PWM period in nanoseconds"
	default 4000000 if SOC_FAMILY_MCXW
	default 546000 if PWM_MCHP_G1_TCC
	default 2000000
	help
	  Default PWM period in nanoseconds.

config DEFAULT_PULSE_NSEC
	int "Default PWM pulse in nanoseconds"
	default 500000 if SOC_MK64F12 || SOC_MKW41Z4 || SOC_ESP32S2 || SOC_ESP32S3 || SOC_ESP32C3
	default 500000 if PWM_INTEL_BLINKY
	default 2000000 if SOC_FAMILY_MCXW
	default 273000 if PWM_MCHP_G1_TCC
	default 1000000
	help
	  Default PWM pulse in nanoseconds.
```

## tests/drivers/pwm/pwm_api/boards/colibri_imx7d_mcimx7d_m4.conf
```kconfig
CONFIG_DEFAULT_PERIOD_CYCLE=1024
CONFIG_DEFAULT_PULSE_CYCLE=512
CONFIG_DEFAULT_PERIOD_NSEC=2000000
CONFIG_DEFAULT_PULSE_NSEC=500000
```

## tests/drivers/pwm/pwm_api/boards/frdm_mcxe31b.conf
```kconfig
# Copyright 2026 NXP
# SPDX-License-Identifier: Apache-2.0

# Use eMIOS channel 3 (OPWFMB, internal counter, 10 MHz) as PWM test output.
CONFIG_DEFAULT_PWM_PORT=3
```

## tests/drivers/pwm/pwm_api/boards/frdm_rw612.conf
```kconfig
#
# Copyright 2025 NXP
#
# SPDX-License-Identifier Apache-2.0
#
CONFIG_PM=y
CONFIG_PWM_MCUX_SCT_KEEP_STATE=n
```

## tests/drivers/pwm/pwm_api/boards/imx93_evk_mimx9352_m33.conf
```kconfig
#
# Copyright 2025 NXP
#
# SPDX-License-Identifier: Apache-2.0
#
CONFIG_TEST_USERSPACE=n
```

## tests/drivers/pwm/pwm_api/boards/sama7g54_ek.conf
```kconfig
#
# Copyright (c) 2026 Microchip Technology Inc.
#
# SPDX-License-Identifier: Apache-2.0
#

CONFIG_DEFAULT_PWM_PORT=2
CONFIG_INVALID_PWM_PORT=4
```

## tests/drivers/pwm/pwm_api/dts/bindings/test-pwm-api.yaml
```yaml
#
# Copyright (c) 2024 Espressif Systems (Shanghai) Co., Ltd.
#
# SPDX-License-Identifier: Apache-2.0
#

description: |
    This binding provides resources required to build and run the test
    tests/drivers/pwm/pwm_api when CONFIG_ENABLE_TIMING_CHECK is enabled.

compatible: "test-pwm-api"

properties:
  in-gpios:
    type: phandle-array
    required: true
    description: |
      GPIO to be used as input to check and validate PWM timing.
```

## tests/drivers/pwm/pwm_api/testcase.yaml
```yaml
tests:
  drivers.pwm:
    tags:
      - drivers
      - pwm
      - userspace
    filter: dt_alias_exists("pwm-test")
    depends_on: pwm
  drivers.pwm.pwm_flexio:
    tags:
      - drivers
      - pwm
      - userspace

    extra_args:
      - platform:frdm_ke17z:DTC_OVERLAY_FILE="boards/frdm_ke1xz_flexio_pwm.overlay"
      - platform:frdm_ke17z512:DTC_OVERLAY_FILE="boards/frdm_ke1xz_flexio_pwm.overlay"
      - platform:mimxrt700_evk/mimxrt798s/cm33_cpu0:DTC_OVERLAY_FILE="boards/mimxrt700_evk_mimxrt798s_cm33_cpu0_flexio_pwm.overlay"
      - platform:mimxrt1180_evk/mimxrt1189/cm33:DTC_OVERLAY_FILE="boards/mimxrt1180_evk_flexio_pwm.overlay"
      - platform:mimxrt1180_evk/mimxrt1189/cm7:DTC_OVERLAY_FILE="boards/mimxrt1180_evk_flexio_pwm.overlay"
      - platform:frdm_mcxa366/mcxa366:DTC_OVERLAY_FILE="boards/frdm_mcxa366_flexio_pwm.overlay"
      - platform:frdm_mcxa266/mcxa266:DTC_OVERLAY_FILE="boards/frdm_mcxa266_flexio_pwm.overlay"
      - platform:frdm_mcxe247/mcxe247:DTC_OVERLAY_FILE="boards/frdm_mcxe247_flexio_pwm.overlay"
    platform_allow:
      - frdm_ke17z
      - frdm_ke17z512
      - mimxrt700_evk/mimxrt798s/cm33_cpu0
      - mimxrt1180_evk/mimxrt1189/cm33
      - mimxrt1180_evk/mimxrt1189/cm7
      - frdm_mcxa366/mcxa366
      - frdm_mcxa266/mcxa266
      - frdm_mcxe247
    filter: dt_alias_exists("pwm-test") and CONFIG_DT_HAS_NXP_FLEXIO_ENABLED
     and CONFIG_DT_HAS_NXP_FLEXIO_PWM_ENABLED
    depends_on: pwm
  drivers.pwm.pwm_fast:
    tags:
      - drivers
      - pwm
      - userspace
    extra_args: DTC_OVERLAY_FILE="boards/nrf54h20dk_nrf54h20_cpuapp_fast.overlay"
    platform_allow:
      - nrf54h20dk/nrf54h20/cpuapp
    filter: dt_alias_exists("pwm-test")
  drivers.pwm.mcxn947_cpu0_sctimer:
    extra_args: DTC_OVERLAY_FILE="boards/frdm_mcxn947_mcxn947_cpu0_sctimer.overlay"
    platform_allow:
      - frdm_mcxn947/mcxn947/cpu0
      - frdm_mcxn947/mcxn947/cpu0/qspi
      - mcx_n9xx_evk/mcxn947/cpu0
      - mcx_n9xx_evk/mcxn947/cpu0/qspi
    filter: dt_alias_exists("pwm-test")
  drivers.pwm.native_sim:
    platform_allow:
      - native_sim
    integration_platforms:
      - native_sim
    filter: dt_alias_exists("pwm-test")
  drivers.pwm.mcxw7x_flexio_pwm:
    tags:
      - drivers
      - pwm
      - userspace
    extra_args: DTC_OVERLAY_FILE="boards/frdm_mcxw7x_flexio_pwm.overlay"
    platform_allow:
      - frdm_mcxw71
      - frdm_mcxw72/mcxw727c/cpu0
    filter: dt_alias_exists("pwm-test") and CONFIG_DT_HAS_NXP_FLEXIO_ENABLED
     and CONFIG_DT_HAS_NXP_FLEXIO_PWM_ENABLED
    depends_on: pwm
  drivers.pwm.mchp_tcc0:
    extra_args:
      - DTC_OVERLAY_FILE="boards/microchip/sam_e54_xpro_tcc0.overlay"
      - DTC_OVERLAY_FILE="boards/microchip/pic32cx_sg61_cult_tcc0.overlay"
    platform_allow:
      - sam_e54_xpro
      - pic32cx_sg61_cult
    filter: dt_alias_exists("pwm-test")
  drivers.pwm.mchp_tcc1:
    extra_args:
      - DTC_OVERLAY_FILE="boards/microchip/sam_e54_xpro_tcc1.overlay"
      - DTC_OVERLAY_FILE="boards/microchip/pic32cx_sg61_cult_tcc1.overlay"
    platform_allow:
      - sam_e54_xpro
      - pic32cx_sg61_cult
    filter: dt_alias_exists("pwm-test")
  drivers.pwm.mchp_tcc2:
    extra_args:
      - DTC_OVERLAY_FILE="boards/microchip/sam_e54_xpro_tcc2.overlay"
      - DTC_OVERLAY_FILE="boards/microchip/pic32cx_sg61_cult_tcc2.overlay"
    platform_allow:
      - sam_e54_xpro
      - pic32cx_sg61_cult
    filter: dt_alias_exists("pwm-test")
  drivers.pwm.mchp_tcc3:
    extra_args:
      - DTC_OVERLAY_FILE="boards/microchip/sam_e54_xpro_tcc3.overlay"
      - DTC_OVERLAY_FILE="boards/microchip/pic32cx_sg61_cult_tcc3.overlay"
    platform_allow:
      - sam_e54_xpro
      - pic32cx_sg61_cult
    filter: dt_alias_exists("pwm-test")
  drivers.pwm.mchp_tcc4:
    extra_args:
      - DTC_OVERLAY_FILE="boards/microchip/sam_e54_xpro_tcc4.overlay"
      - DTC_OVERLAY_FILE="boards/microchip/pic32cx_sg61_cult_tcc4.overlay"
    platform_allow:
      - sam_e54_xpro
      - pic32cx_sg61_cult
    filter: dt_alias_exists("pwm-test")
  drivers.pwm.mchp_tc0:
    extra_args: DTC_OVERLAY_FILE="boards/microchip/sam_e54_xpro_tc0.overlay"
    platform_allow:
      - sam_e54_xpro
    filter: dt_alias_exists("pwm-test")
  drivers.pwm.mchp_tc1:
    extra_args: DTC_OVERLAY_FILE="boards/microchip/sam_e54_xpro_tc1.overlay"
    platform_allow:
      - sam_e54_xpro
    filter: dt_alias_exists("pwm-test")
  drivers.pwm.mchp_tc2:
    extra_args: DTC_OVERLAY_FILE="boards/microchip/sam_e54_xpro_tc2.overlay"
    platform_allow:
      - sam_e54_xpro
    filter: dt_alias_exists("pwm-test")
  drivers.pwm.mchp_tc3:
    extra_args: DTC_OVERLAY_FILE="boards/microchip/sam_e54_xpro_tc3.overlay"
    platform_allow:
      - sam_e54_xpro
    filter: dt_alias_exists("pwm-test")
  drivers.pwm.mchp_tc4:
    extra_args: DTC_OVERLAY_FILE="boards/microchip/sam_e54_xpro_tc4.overlay"
    platform_allow:
      - sam_e54_xpro
    filter: dt_alias_exists("pwm-test")
  drivers.pwm.mchp_tc5:
    extra_args:
      - DTC_OVERLAY_FILE="boards/microchip/sam_e54_xpro_tc5.overlay"
      - DTC_OVERLAY_FILE="boards/microchip/pic32cx_sg41_cult_tc5.overlay"
    platform_allow:
      - sam_e54_xpro
      - pic32cx_sg41_cult
    filter: dt_alias_exists("pwm-test")
  drivers.pwm.mchp_tc6:
    extra_args: DTC_OVERLAY_FILE="boards/microchip/sam_e54_xpro_tc6.overlay"
    platform_allow:
      - sam_e54_xpro
    filter: dt_alias_exists("pwm-test")
  drivers.pwm.mchp_tc7:
    extra_args: DTC_OVERLAY_FILE="boards/microchip/sam_e54_xpro_tc7.overlay"
    platform_allow:
      - sam_e54_xpro
    filter: dt_alias_exists("pwm-test")
  drivers.pwm.s32k5xxcvb_s32k566_ftm:
    tags:
      - drivers
      - pwm
      - userspace
    extra_args: DTC_OVERLAY_FILE="boards/s32k5xxcvb_s32k566_ftm.overlay"
    platform_allow:
      - s32k5xxcvb/s32k566/m7
      - s32k5xxcvb/s32k566/r52
    depends_on: pwm
```

## tests/drivers/pwm/pwm_dma_api/Kconfig
```kconfig
# SPDX-FileCopyrightText: Copyright The Zephyr Project Contributors
# SPDX-License-Identifier: Apache-2.0

mainmenu "PWM DMA API test"

source "Kconfig.zephyr"

config DEFAULT_PWM_PORT
	int "Default PWM port/channel"
	default 3 if PWM_STM32
	default 0
	help
	  PWM port matching the channel associated with PWM pin.

config DEFAULT_PERIOD_CYCLE
	int "Default PWM period in cycles"
	default 1200
	help
	  Default PWM period in clock cycles.

config DEFAULT_PERIOD_NSEC
	int "Default PWM period in nanoseconds"
	default 20000000
	help
	  Default PWM period in nanoseconds.

config DEFAULT_STEP_NUMBER
	int "Number of steps in sequence"
	default 30
	help
	  Number of steps in sequence.
```

## tests/drivers/pwm/pwm_dma_api/testcase.yaml
```yaml
tests:
  drivers.pwm:
    tags:
      - drivers
      - pwm
      - userspace
    filter: dt_alias_exists("pwm-test")
    depends_on: 
      - pwm
```

## tests/drivers/pwm/pwm_gpio_loopback/Kconfig
```kconfig
# Copyright (c) 2024 Espressif Systems (Shanghai) Co., Ltd.
# SPDX-License-Identifier: Apache-2.0

mainmenu "PWM GPIO loopback test"

source "Kconfig.zephyr"

config SAMPLING_TIME
	int "Sampling wait time (ms)"
	default 50
	help
	  Time to wait for PWM edge sampling, in milliseconds.

config SKIP_EDGE_NUM
	int "Number of edges to skip before sampling PWM"
	default 2
	help
	  Number of PWM edges to skip before starting sampling.
	  This parameter improves measurement precision as there can be significant
	  latency in the first sampled edge.

config ALLOWED_DEVIATION
	int "Allowed deviation (%) for PWM timing checks"
	default 5
	range 0 100
	help
	  Maximum allowed deviation (%) from the programmed values for the test to be
	  considered a PASS. For example, if set to 5, the measured period or duty cycle
	  can deviate by up to 5% from the programmed values for the test to pass.
```

## tests/drivers/pwm/pwm_gpio_loopback/boards/bl54l15_dvk_nrf54l15_cpuapp.conf
```kconfig
# Copyright (c) 2024 Nordic Semiconductor ASA
# Copyright (c) 2025 Ezurio LLC
# SPDX-License-Identifier: Apache-2.0

CONFIG_SKIP_EDGE_NUM=4
```

## tests/drivers/pwm/pwm_gpio_loopback/boards/sam_e54_xpro.conf
```kconfig
# Copyright (c) 2025 Microchip Technology Inc.
# SPDX-License-Identifier: Apache-2.0

CONFIG_GPIO=y
```

## tests/drivers/pwm/pwm_gpio_loopback/dts/bindings/test-pwm-gpio-loopback.yaml
```yaml
#
# Copyright (c) 2024 Espressif Systems (Shanghai) Co., Ltd.
#
# SPDX-License-Identifier: Apache-2.0
#

description: |
    This binding provides resources required to build and run the test
    tests/drivers/pwm/pwm_gpio_loopback.

compatible: "test-pwm-gpio-loopback"

properties:
  in-gpios:
    type: phandle-array
    required: true
    description: |
      GPIO to be used as input to check and validate PWM timing.
```

## tests/drivers/pwm/pwm_gpio_loopback/testcase.yaml
```yaml
common:
  depends_on: pwm
  tags:
    - drivers
    - pwm
  harness: ztest
  harness_config:
    fixture: gpio_loopback
tests:
  drivers.pwm.gpio_loopback.esp:
    platform_allow:
      - esp32_devkitc/esp32/procpu
      - esp8684_devkitm
      - esp32c3_devkitm
      - esp32c6_devkitc/esp32c6/hpcore
      - esp32s2_saola
      - esp32s3_devkitc/esp32s3/procpu

  drivers.pwm.gpio_loopback.nrf:
    platform_allow:
      - nrf54h20dk/nrf54h20/cpuapp
      - nrf54l15dk/nrf54l15/cpuapp
      - nrf54l15dk/nrf54l15/cpuapp/ns
      - nrf54lm20dk/nrf54lm20a/cpuapp
      - ophelia4ev/nrf54l15/cpuapp

  drivers.pwm.gpio_loopback.silabs:
    platform_allow:
      - xg29_rb4412a
      - bg29_rb4420a
      - xg24_rb4187c

  drivers.pwm.gpio_loopback.ifx:
    platform_allow:
      - cyw920829m2evk_02/cyw20829b1340
      - cyw920829m2evk_02/cyw20829b1010
      - cyw920829m2evk_02/cyw20829b0lkml
      - kit_pse84_eval/pse846gps2dbzc4a/m33
      - kit_pse84_eval/pse846gps2dbzc4a/m55
  drivers.pwm.gpio_loopback_tc0.mchp:
    extra_args: DTC_OVERLAY_FILE="boards/microchip/sam_e54_xpro_tc0.overlay"
    platform_allow:
      - sam_e54_xpro

  drivers.pwm.gpio_loopback_tc1.mchp:
    extra_args: DTC_OVERLAY_FILE="boards/microchip/sam_e54_xpro_tc1.overlay"
    platform_allow:
      - sam_e54_xpro

  drivers.pwm.gpio_loopback_tc4.mchp:
    extra_args: DTC_OVERLAY_FILE="boards/microchip/sam_e54_xpro_tc4.overlay"
    platform_allow:
      - sam_e54_xpro

  drivers.pwm.gpio_loopback_tc5.mchp:
    extra_args: DTC_OVERLAY_FILE="boards/microchip/sam_e54_xpro_tc5.overlay"
    platform_allow:
      - sam_e54_xpro

  drivers.pwm.gpio_loopback_tc6.mchp:
    extra_args: DTC_OVERLAY_FILE="boards/microchip/sam_e54_xpro_tc6.overlay"
    platform_allow:
      - sam_e54_xpro

  drivers.pwm.gpio_loopback_tc7.mchp:
    extra_args: DTC_OVERLAY_FILE="boards/microchip/sam_e54_xpro_tc7.overlay"
    platform_allow:
      - sam_e54_xpro
```
