/*
 * Copyright (c) 2023 Meta
 *
 * SPDX-License-Identifier: Apache-2.0
 */

&dma {
	dma-channels = <2>;
	dma-requests = <4>;
	status = "okay";
};

/ {
	zephyr,user {
		dma-test-devs = <&dma>;
	};
};
