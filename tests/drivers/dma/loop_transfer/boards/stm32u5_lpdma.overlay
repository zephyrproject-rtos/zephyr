/*
 * Copyright (c) 2026 Mario Paja
 *
 * SPDX-License-Identifier: Apache-2.0
 */

#include <zephyr/dt-bindings/memory-attr/memory-attr-arm.h>

&sram1 {
	compatible = "zephyr,memory-region", "mmio-sram";
	zephyr,memory-region = "SRAM4";
	zephyr,memory-attr = <DT_MEM_ARM(ATTR_MPU_RAM_NOCACHE)>;
};

&lpdma1 {
	status = "okay";
};

/ {
	zephyr,user {
		dma-test-devs = <&lpdma1>;
	};
};
