/*
 * Copyright (c) 2024 Antmicro <www.antmicro.com>
 *
 * SPDX-License-Identifier: Apache-2.0
 */

&dma2 {
	status = "okay";
};

&sram0 {
	zephyr,memory-attr = <DT_MEM_ARM(ATTR_MPU_RAM_NOCACHE)>;
};

/ {
	zephyr,user {
		dma-test-devs = <&dma2>;
	};
};
