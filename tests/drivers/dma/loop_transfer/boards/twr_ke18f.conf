## tests/drivers/dma/loop_transfer/boards/xmc45_relax_kit.conf
```kconfig
# Copyright (c) 2025 Andriy Gelman
# SPDX-License-Identifier: Apache-2.0

CONFIG_DMA_LOOP_TRANSFER_SIZE=4095
```

## tests/drivers/dma/loop_transfer_dt_configuration/testcase.yaml
```yaml
tests:
  drivers.dma.loop_transfer_dt_configuration:
    depends_on: dma
    tags: drivers dma
    filter: dt_nodelabel_enabled("test_dma0")
```

## tests/drivers/dma/scatter_gather/Kconfig
```kconfig
# Copyright (c) 2022 Intel Corporation
# SPDX-License-Identifier: Apache-2.0

mainmenu "DMA Scatter Gather Test"

source "Kconfig.zephyr"

config DMA_SG_DRV_NAME
	string "DMA device name to use for test"
	default "DMA_0"

config DMA_SG_CHANNEL_NR
	int "DMA channel to use"
	default 0
```

## tests/drivers/dma/scatter_gather/boards/sltb010a.conf
```kconfig
# Copyright (c) 2024 Silicon Laboratories, Inc.
# SPDX-License-Identifier: Apache-2.0

CONFIG_DMA_SG_XFER_SIZE=4096
```

## tests/drivers/dma/scatter_gather/boards/stm32mp257f_ev1_stm32mp257fxx_m33.conf
```kconfig
# Copyright (C) 2025 Savoir-faire Linux, Inc.
# SPDX-License-Identifier: Apache-2.0

CONFIG_DMA_SG_CHANNEL_NR=0
```

## tests/drivers/dma/scatter_gather/boards/xmc45_relax_kit.conf
```kconfig
# Copyright (c) 2025 Andriy Gelman
# SPDX-License-Identifier: Apache-2.0

CONFIG_DMA_SG_XFER_SIZE=4096
```

## tests/drivers/dma/scatter_gather/testcase.yaml
```yaml
tests:
  drivers.dma.scatter_gather:
    depends_on: dma
    tags:
      - drivers
      - dma
    platform_allow:
      - intel_adsp/cavs25
      - frdm_k64f
      - mimxrt1010_evk
      - mimxrt685_evk/mimxrt685s/cm33
      - mimxrt1060_evk/mimxrt1062/qspi
      - lpcxpresso55s36
      - native_sim
      - native_sim/native/64
      - xmc45_relax_kit
      - xmc47_relax_kit
    filter: dt_alias_exists("dma0")
    integration_platforms:
      - intel_adsp/cavs25
      - native_sim
      - native_sim/native/64
```

## tests/drivers/dma/usermode/testcase.yaml
```yaml
tests:
  drivers.dma.usermode:
    filter: CONFIG_ARCH_HAS_USERSPACE
    tags:
      - drivers
      - userspace
      - dma
```

## tests/drivers/edac/mecc/testcase.yaml
```yaml
common:
  arch_allow:
    - arm
  platform_allow:
    - mimxrt1180_evk/mimxrt1189/cm33
    - mimxrt1180_evk/mimxrt1189/cm7
  depends_on:
    - mecc
  tags:
    - edac
    - mecc

tests:
  edac.mecc.production:
    extra_configs:
      - CONFIG_EDAC_ERROR_INJECT=n

  edac.mecc.injection:
    extra_configs:
      - CONFIG_EDAC_ERROR_INJECT=y
```

## tests/drivers/eeprom/api/boards/qemu_x86_64.conf
```kconfig
CONFIG_DYNAMIC_INTERRUPTS=y
CONFIG_PCIE=y

CONFIG_SMBUS=y
CONFIG_SMBUS_INTEL_PCH=y
```

## tests/drivers/eeprom/api/testcase.yaml
```yaml
common:
  depends_on: eeprom
  tags:
    - drivers
    - eeprom
tests:
  drivers.eeprom.api:
    # Tests overwrite EEPROM content, only run on select boards
    platform_allow:
      - native_sim
      - native_sim/native/64
      - qemu_x86
      - nucleo_l152re
      - nucleo_l073rz
    integration_platforms:
      - qemu_x86
  drivers.eeprom.api.w_at2x_emul:
    # Tests overwrite EEPROM content, only run on select boards
    extra_args:
      - DTC_OVERLAY_FILE=at2x_emul.overlay
      - EXTRA_CONF_FILE=at2x_emul.conf
    platform_allow:
      - native_sim
      - native_sim/native/64
    integration_platforms:
      - native_sim
  drivers.eeprom.api.build:
    # Build-only test for boards with EEPROMs
    build_only: true
    platform_exclude:
      - native_sim
      - native_sim/native/64
      - qemu_x86
      - nucleo_l152re
      - nucleo_l073rz
```

## tests/drivers/eeprom/boards/native_posix.conf
```kconfig
# Copyright (c) 2020 Nordic Semiconductor ASA
# SPDX-License-Identifier: Apache-2.0

CONFIG_EMUL=y
CONFIG_EEPROM_INIT_PRIORITY=75
CONFIG_EMUL_EEPROM_AT2X=y
```

## tests/drivers/eeprom/eeprom_st25dv/testcase.yaml
```yaml
common:
  tags:
    - drivers
tests:
  drivers.eeprom.eeprom_st25dv:
    # Tests overwrite EEPROM content, only run on select boards
    platform_allow:
      - nucleo_g0b1re
    extra_args: SHIELD=x_nucleo_nfc04a1
    harness_config:
      fixture: fixture_shield_x_nucleo_nfc04a1
  drivers.eeprom.eeprom_st25dv.build:
    # Build-only test for boards with EEPROMs
    build_only: true
    platform_allow:
      - nucleo_g0b1re
    extra_args: SHIELD=x_nucleo_nfc04a1
```

## tests/drivers/eeprom/shell/testcase.yaml
```yaml
tests:
  drivers.eeprom.shell:
    integration_platforms:
      - native_sim
      - native_sim/native/64
    tags:
      - drivers
      - eeprom
      - shell
```

## tests/drivers/eeprom/testcase.yaml
```yaml
tests:
  peripheral.eeprom:
    platform_allow: |
      native_posix native_posix_64 qemu_x86
      nucleo_l152re nucleo_l073rz
    tags: drivers userspace
  peripheral.eeprom.generic:
    build_only: true
    depends_on: eeprom
    tags: drivers userspace
```

## tests/drivers/enc28j60/testcase.yaml
```yaml
tests:
  test_enc28j60_build:
    build_only: true
    platform_whitelist: arduino_101
    tags: drivers
```

## tests/drivers/entropy/api/Kconfig
```kconfig
# Copyright NXP 2022
# SPDX-License-Identifier: Apache-2.0

mainmenu "Entropy API Test"

source "Kconfig.zephyr"
source "tests/drivers/entropy/api/Kconfig.mcux"

config RANDOM_BUFFER_NOCACHED
	bool "Put the buffer of randomly generated numbers in nocache region."
```
