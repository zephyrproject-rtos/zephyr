/*
 * Copyright (c) 2025 STMicroelectronics
 *
 * SPDX-License-Identifier: Apache-2.0
 */
&dma1 {
	status = "okay";
};

&dmamux1 {
	status = "okay";
};

/ {
	zephyr,user {
		dma-test-devs = <&dmamux1>;
	};
};
