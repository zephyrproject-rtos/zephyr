## tests/drivers/dma/loop_transfer/boards/fpb_ra6e2.conf
```kconfig
# Copyright (c) 2025 Renesas Electronics Corporation
# SPDX-License-Identifier: Apache-2.0

CONFIG_DMA_LOOP_TRANSFER_SIZE=1024
```

## tests/drivers/dma/loop_transfer/boards/frdm_ke15z.conf
```kconfig
# KE15Z has only 24 KB SRAM. Default 8 KB buffers × 5 = 40 KB won't fit.
# 1 KB × 5 = 5 KB keeps the test within reach.
CONFIG_DMA_LOOP_TRANSFER_SIZE=1024
```

## tests/drivers/dma/loop_transfer/boards/frdm_mcxc444.conf
```kconfig
# Copyright 2025 NXP
# SPDX-License-Identifier: Apache-2.0

CONFIG_DMA_LOOP_TRANSFER_SIZE=1024
```

## tests/drivers/dma/loop_transfer/boards/frdm_mcxe31b.conf
```kconfig
# Copyright (c) 2025 NXP
# SPDX-License-Identifier: Apache-2.0

# DMA loop transfer test configuration
CONFIG_DMA_LOOP_TRANSFER_SIZE=256
```

## tests/drivers/dma/loop_transfer/boards/frdm_rw612.conf
```kconfig
# Copyright 2026 NXP
# SPDX-License-Identifier: Apache-2.0

# Test both dma0 and gdma controllers
CONFIG_DMA_LOOP_TRANSFER_SIZE=1024
CONFIG_DMA_LOOP_TRANSFER_NUMBER_OF_DMAS=2
```

## tests/drivers/dma/loop_transfer/boards/imx95_evk_mimx9596_m7.conf
```kconfig
# Copyright 2026 NXP
# SPDX-License-Identifier: Apache-2.0

CONFIG_NOCACHE_MEMORY=y
```

## tests/drivers/dma/loop_transfer/boards/intel_adsp_ace15_mtpm.conf
```kconfig
CONFIG_PM=n
CONFIG_PM_DEVICE=n
CONFIG_PM_DEVICE_RUNTIME=n
CONFIG_PM_DEVICE_POWER_DOMAIN=n
CONFIG_POWER_DOMAIN=y
```

## tests/drivers/dma/loop_transfer/boards/mimxrt1160_evk_mimxrt1166_cm4.conf
```kconfig
CONFIG_CODE_DATA_RELOCATION=y
CONFIG_MEM_ATTR_HEAP=y
CONFIG_DMA_LOOP_TRANSFER_RELOCATE_SECTION="SRAM1"
```

## tests/drivers/dma/loop_transfer/boards/nucleo_h753zi.conf
```kconfig
CONFIG_DMA_LOOP_TRANSFER_CHANNEL_NR=5
CONFIG_DMA_LOOP_TRANSFER_NUMBER_OF_DMAS=2

# Required by BDMA which only has access to
# a NOCACHE SRAM4 section. All other DMAs also
# has access to this section.
CONFIG_CODE_DATA_RELOCATION=y
CONFIG_DMA_LOOP_TRANSFER_RELOCATE_SECTION="SRAM4"
```

## tests/drivers/dma/loop_transfer/boards/nucleo_wb09ke.conf
```kconfig
# SPDX-FileCopyrightText: Copyright The Zephyr Project Contributors
# SPDX-License-Identifier: Apache-2.0

CONFIG_DMA_LOOP_TRANSFER_CHANNEL_NR=7
```

## tests/drivers/dma/loop_transfer/boards/nucleo_wl55jc.conf
```kconfig
CONFIG_DMA_LOOP_TRANSFER_DRV_NAME="DMAMUX_1"
CONFIG_DMA_LOOP_TRANSFER_CHANNEL_NR=11
```

## tests/drivers/dma/loop_transfer/boards/pic32cm_pl10_cnano.conf
```kconfig
# Copyright (c) 2026 Microchip Technology Inc.
# SPDX-License-Identifier: Apache-2.0

CONFIG_DMA_LOOP_TRANSFER_SIZE=512
```

## tests/drivers/dma/loop_transfer/boards/rtl87x2g_evb_a_rtl8762gku.conf
```kconfig
# Copyright (c) 2026, Realtek Semiconductor Corporation
# SPDX-License-Identifier: Apache-2.0

CONFIG_DMA_LOOP_TRANSFER_SIZE=4096
```

## tests/drivers/dma/loop_transfer/boards/s32z2xxdc2_s32z270_rtu1.conf
```kconfig
CONFIG_CODE_DATA_RELOCATION=y
CONFIG_DMA_LOOP_TRANSFER_RELOCATE_SECTION="SRAMNOCACHE"
```

## tests/drivers/dma/loop_transfer/boards/sama7g54_ek.conf
```kconfig
#
# Copyright (c) 2026 Microchip Technology Inc.
#
# SPDX-License-Identifier: Apache-2.0
#

CONFIG_DMA_LOOP_TRANSFER_NUMBER_OF_DMAS=3
CONFIG_DMA_LOOP_TRANSFER_CHANNEL_NR=7
```

## tests/drivers/dma/loop_transfer/boards/samr34_xpro.conf
```kconfig
# Copyright (c) 2025 Gerson Fernando Budke <nandojve@gmail.com>
#
# SPDX-License-Identifier: Apache-2.0

CONFIG_DMA_LOOP_TRANSFER_SIZE=2048
```

## tests/drivers/dma/loop_transfer/boards/sgrm.conf
```kconfig
# Copyright (c) 2024 GARDENA GmbH
#
# SPDX-License-Identifier: Apache-2.0

CONFIG_DMA_LOOP_TRANSFER_CHANNEL_NR=0
CONFIG_DMA_LOOP_TRANSFER_SIZE=1024
```

## tests/drivers/dma/loop_transfer/boards/sltb010a.conf
```kconfig
# Copyright (c) 2024 Silicon Laboratories, Inc.
# SPDX-License-Identifier: Apache-2.0

CONFIG_DMA_LOOP_TRANSFER_SIZE=2048
```

## tests/drivers/dma/loop_transfer/boards/stm32h750b_dk.conf
```kconfig
CONFIG_DMA_LOOP_TRANSFER_CHANNEL_NR=3
CONFIG_DMA_LOOP_TRANSFER_NUMBER_OF_DMAS=2

# Required by BDMA which only has access to
# SRAM4 & the driver excpects it to be uncached as well.
# Other DMAs have access to SRAM4 as well.
CONFIG_CODE_DATA_RELOCATION=y
CONFIG_DMA_LOOP_TRANSFER_RELOCATE_SECTION="SRAM4"
```
