/*
 * Copyright (c) 2022 Kumar Gala <galak@kernel.org>
 * Copyright (c) 2025 Gerson Fernando Budke <nandojve@gmail.com>
 *
 * SPDX-License-Identifier: Apache-2.0
 */

&dmac {
	status = "okay";
};

/ {
	zephyr,user {
		dma-test-devs = <&dmac>;
	};
};
