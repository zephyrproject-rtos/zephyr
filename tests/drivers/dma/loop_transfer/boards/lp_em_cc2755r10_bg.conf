## tests/drivers/dma/loop_transfer/boards/lp_mspm0l2228.conf
```kconfig
# SPDX-FileCopyrightText: 2026 Texas Instruments Incorporated
# SPDX-License-Identifier: Apache-2.0

CONFIG_DMA_LOOP_TRANSFER_SIZE=2048
```

## tests/drivers/dma/loop_transfer/boards/stm32h7_bdma_only.conf
```kconfig
# SPDX-FileCopyrightText: Copyright The Zephyr Project Contributors
# SPDX-License-Identifier: Apache-2.0

CONFIG_DMA_LOOP_TRANSFER_NUMBER_OF_DMAS=1
```

## tests/drivers/dma/loop_transfer/boards/stm32h7_renode_reference_platform.conf
```kconfig
# Copyright (c) 2026 Antmicro <www.antmicro.com>
# SPDX-License-Identifier: Apache-2.0

CONFIG_DMA_LOOP_TRANSFER_CHANNEL_NR=5
CONFIG_DMA_LOOP_TRANSFER_NUMBER_OF_DMAS=1
```

## tests/drivers/dma/loop_transfer/boards/stm32u5_lpdma.conf
```kconfig
# Copyright (c) 2026 Mario Paja
# SPDX-License-Identifier: Apache-2.0

CONFIG_DMA_LOOP_TRANSFER_CHANNEL_NR=0

# LPDMA1 can only access SRAM4 (16 KB)
CONFIG_CODE_DATA_RELOCATION=y
CONFIG_DMA_LOOP_TRANSFER_RELOCATE_SECTION="SRAM4"
CONFIG_DMA_LOOP_TRANSFER_SIZE=2048
```

## tests/drivers/dma/loop_transfer/testcase.yaml
```yaml
tests:
  drivers.dma.loop_transfer:
    depends_on: dma
    tags:
      - drivers
      - dma
    integration_platforms:
      - native_sim
      - native_sim/native/64
    platform_allow:
      - lp_em_cc2340r5
      - lp_em_cc2340r53
      - lp_em_cc2340r53_wcsp
      - lp_em_cc2340r5moda
      - lp_em_cc2745r10_q1/cc2745r10_q1
      - lp_em_cc2745r10_q1/cc2755r10
      - lp_em_cc2755p10
    filter: dt_nodelabel_enabled("tst_dma0")
```

## tests/drivers/dma/scatter_gather/boards/lp_mspm0g3507.conf
```kconfig
# SPDX-FileCopyrightText: 2026 Texas Instruments Incorporated
# SPDX-License-Identifier: Apache-2.0

CONFIG_DMA_SG_XFER_SIZE=2048
```

## tests/drivers/dma/scatter_gather/boards/sama7g54_ek.conf
```kconfig
#
# Copyright (c) 2026 Microchip Technology Inc.
#
# SPDX-License-Identifier: Apache-2.0
#

CONFIG_DMA_SG_XFER_SIZE=256
```

## tests/drivers/dma/stm32_hal_config/Kconfig
```kconfig
# SPDX-FileCopyrightText: Copyright The Zephyr Project Contributors
# SPDX-License-Identifier: Apache-2.0

mainmenu "STM32 DMA HAL configuration tests"

source "Kconfig.zephyr"

config STM32_DMA_HAL_CONFIG_TEST
	bool
	default y
	select USE_STM32_HAL_DMA
```

## tests/drivers/entropy/api/boards/kit_pse84_eval_pse846gps2dbzc4a_m55.conf
```kconfig
# SPDX-FileCopyrightText: Copyright (c) 2026 Infineon Technologies AG,
# SPDX-FileCopyrightText: or an affiliate of Infineon Technologies AG. All rights reserved.
#
# SPDX-License-Identifier: Apache-2.0

# Enable MXCRYPTO TRNG entropy driver
CONFIG_ENTROPY_GENERATOR=y
CONFIG_ENTROPY_INFINEON_MXCRYPTO_TRNG=y

# Enable MXCRYPTO hardware crypto driver
CONFIG_CRYPTO=y
CONFIG_CRYPTO_INFINEON_MXCRYPTO=y
```

## tests/drivers/ethernet/phy_loopback/Kconfig
```kconfig
# Copyright (c) 2026, Ylhyra ehf.
# SPDX-License-Identifier: Apache-2.0

mainmenu "Ethernet PHY loopback test"

config TEST_ETH_PHY_LOOPBACK_REQUIRE_PRESSURE
	bool "Require receive-buffer pressure"
	help
	  Require the burst test to lose at least one accepted frame.

source "Kconfig.zephyr"
```

## tests/drivers/flash/common/boards/kit_psoc4_hvms_64k_lite.conf
```kconfig
CONFIG_FLASH_FILL_BUFFER_SIZE=256

CONFIG_ISR_STACK_SIZE=512
CONFIG_MAIN_STACK_SIZE=1024
CONFIG_IDLE_STACK_SIZE=128
CONFIG_SYSTEM_WORKQUEUE_STACK_SIZE=512

CONFIG_ZTEST_STACK_SIZE=2048

CONFIG_THREAD_MAX_NAME_LEN=12

CONFIG_COMMON_LIBC_MALLOC_ARENA_SIZE=0
```

## tests/drivers/flash/common/boards/kit_psoc4_hvpa_144k_lite.conf
```kconfig
# SPDX-FileCopyrightText: Copyright (c) 2026 Infineon Technologies AG,
# SPDX-FileCopyrightText: or an affiliate of Infineon Technologies AG. All rights reserved.
#
# SPDX-License-Identifier: Apache-2.0

# Multiple of the 128-byte flash row
CONFIG_FLASH_FILL_BUFFER_SIZE=256
CONFIG_TEST_DRIVER_FLASH_SIZE=131072

# Fit the 8 KB SRAM
CONFIG_ZTEST_STACK_SIZE=2048
CONFIG_MAIN_STACK_SIZE=1024
```

## tests/drivers/flash/common/boards/stm32h573i_dk.conf
```kconfig
# SPDX-FileCopyrightText: Copyright The Zephyr Project Contributors
# SPDX-License-Identifier: Apache-2.0

CONFIG_TEST_FORCE_STORAGE_PARTITION=y
```

## tests/drivers/flash/common/boards/stm32h7_renode_reference_board.conf
```kconfig
# Copyright (c) 2026 Antmicro <www.antmicro.com>
# SPDX-License-Identifier: Apache-2.0

CONFIG_TEST_DRIVER_FLASH_SIZE=134217728
```

## tests/drivers/flash/common/boards/stm32n6570_dk.conf
```kconfig
# Copyright (c) 2026 EXALT Technologies
# SPDX-License-Identifier: Apache-2.0

CONFIG_LOG=y
CONFIG_MSPI_LOG_LEVEL_INF=y
CONFIG_TEST_DRIVER_FLASH_SIZE=134217728
```

## tests/drivers/flash/erase_blocks/boards/kit_psc3m6_evk.conf
```kconfig
# SPDX-FileCopyrightText: Copyright (c) 2026 Infineon Technologies AG,
# SPDX-FileCopyrightText: or an affiliate of Infineon Technologies AG. All rights reserved.
#
# SPDX-License-Identifier: Apache-2.0

CONFIG_TEST_FLASH_ERASE_BLOCKS_BUFFER_SIZE=1024
```

## tests/drivers/flash/interface_test/boards/stm32n6570_dk.conf
```kconfig
# Copyright (c) 2026 EXALT Technologies
# SPDX-License-Identifier: Apache-2.0

CONFIG_MSPI=y
CONFIG_LOG=y
CONFIG_MSPI_LOG_LEVEL_INF=y
```
