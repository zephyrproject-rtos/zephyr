/*
 * Copyright (c) 2026 Renesas Electronics Corporation
 *
 * SPDX-License-Identifier: Apache-2.0
 */

&dma0 {
	status = "okay";
	interrupts = <95 1>, <94 1>, <93 1>;
	interrupt-names = "ch0", "ch1", "ch2";
};

/ {
	zephyr,user {
		dma-test-devs = <&dma0>;
	};
};
