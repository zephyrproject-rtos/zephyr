/*
 * Copyright (c) 2020 Erwin Rol <erwin@erwinrol.com>
 *
 * SPDX-License-Identifier: Apache-2.0
 */

&dma1 {
	status = "okay";
};

&dma2 {
	status = "okay";
};

/ {
	zephyr,user {
		dma-test-devs = <&dma2>;
	};
};
