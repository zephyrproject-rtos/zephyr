/*
 * Copyright (c) 2026 Antmicro <www.antmicro.com>
 *
 * SPDX-License-Identifier: Apache-2.0
 */

&dma1 {
	status = "okay";
};

&dma2 {
	status = "okay";
};

tst_dma0: &dmamux1 {
	status = "okay";
};
