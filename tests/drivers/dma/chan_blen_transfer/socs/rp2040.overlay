/*
 * Copyright (c) 2024 Andrew Featherstone <andrew.featherstone@gmail.com>
 *
 * SPDX-License-Identifier: Apache-2.0
 */

&dma {
	status = "okay";
};

/ {
	zephyr,user {
		dma-test-devs = <&dma>;
	};
};
