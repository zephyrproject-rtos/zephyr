/*
 * SPDX-FileCopyrightText: Copyright (c) 2026 Infineon Technologies AG,
 * SPDX-FileCopyrightText: or an affiliate of Infineon Technologies AG. All rights reserved.
 *
 * SPDX-License-Identifier: Apache-2.0
 */

&dma0 {
	status = "okay";
};

&dma1 {
	status = "okay";
};

/ {
	zephyr,user {
		dma-test-devs = <&dma0>, <&dma1>;
	};
};
