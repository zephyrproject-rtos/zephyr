/*
 * SPDX-License-Identifier: Apache-2.0
 *
 * Copyright (c) 2024 Andrew Featherstone <andrew.featherstone@gmail.com>
 */

/* RP2350A is compatible with the RP2040, so reuse. */
#include "rp2040.overlay"
