/*
 * Copyright (c) 2022 Kumar Gala <galak@kernel.org>
 *
 * SPDX-License-Identifier: Apache-2.0
 */

/* The test driver expects the SRAM0 region to be non-cachable */
&sram0 {
	zephyr,memory-attr = <DT_MEM_ARM(ATTR_MPU_RAM_NOCACHE)>;
};

/ {
	zephyr,user {
		dma-test-devs = <&dma2>;
	};
};
