## tests/drivers/dma/chan_blen_transfer/boards/nucleo_h743zi.conf
```kconfig
CONFIG_DMA_TRANSFER_CHANNEL_NR_0=4
CONFIG_DMA_TRANSFER_CHANNEL_NR_1=6
CONFIG_DMA_LOOP_TRANSFER_NUMBER_OF_DMAS=2

# Required by BDMA which only has access to
# a NOCACHE SRAM4 section. All other DMAs also
# has access to this section.
CONFIG_CODE_DATA_RELOCATION=y
CONFIG_DMA_LOOP_TRANSFER_RELOCATE_SECTION="SRAM4"
```

## tests/drivers/dma/chan_blen_transfer/boards/nucleo_l476rg.conf
```kconfig
# SPDX-FileCopyrightText: Copyright The Zephyr Project Contributors
# SPDX-License-Identifier: Apache-2.0

CONFIG_DMA_TRANSFER_CHANNEL_NR_0=4
CONFIG_DMA_TRANSFER_CHANNEL_NR_1=2
```

## tests/drivers/dma/chan_blen_transfer/boards/nucleo_wb07cc.conf
```kconfig
# Use lowest- and highest-numbered channels to make sure the whole range works
CONFIG_DMA_TRANSFER_CHANNEL_NR_0=0
CONFIG_DMA_TRANSFER_CHANNEL_NR_1=7
```

## tests/drivers/dma/chan_blen_transfer/boards/nucleo_wb55rg.conf
```kconfig
# SPDX-FileCopyrightText: Copyright The Zephyr Project Contributors
# SPDX-License-Identifier: Apache-2.0

CONFIG_DMA_TRANSFER_CHANNEL_NR_0=6
CONFIG_DMA_TRANSFER_CHANNEL_NR_1=10
```

## tests/drivers/dma/chan_blen_transfer/boards/s32z2xxdc2_s32z270_rtu0.conf
```kconfig
CONFIG_DMA_TRANSFER_CHANNEL_NR_0=0
CONFIG_DMA_TRANSFER_CHANNEL_NR_1=16
CONFIG_CODE_DATA_RELOCATION=y
CONFIG_DMA_LOOP_TRANSFER_RELOCATE_SECTION="SRAMNOCACHE"
```

## tests/drivers/dma/chan_blen_transfer/boards/sama7g54_cpro.conf
```kconfig
#
# Copyright (c) 2026 Microchip Technology Inc.
#
# SPDX-License-Identifier: Apache-2.0
#

CONFIG_DMA_LOOP_TRANSFER_NUMBER_OF_DMAS=3
CONFIG_DMA_TRANSFER_CHANNEL_NR_0=4
CONFIG_DMA_TRANSFER_CHANNEL_NR_1=7
```

## tests/drivers/dma/chan_blen_transfer/boards/siwx917_rb4338a.conf
```kconfig
CONFIG_DMA_TRANSFER_CHANNEL_NR_0=1
CONFIG_DMA_TRANSFER_CHANNEL_NR_1=2
CONFIG_DMA_LOOP_TRANSFER_NUMBER_OF_DMAS=2
CONFIG_DMA_TRANSFER_BURST16=n
```

## tests/drivers/dma/chan_blen_transfer/boards/stm32f3_disco.conf
```kconfig
CONFIG_DMA_TRANSFER_DRV_NAME="DMA_1"
CONFIG_DMA_TRANSFER_CHANNEL_NR_0=4
CONFIG_DMA_TRANSFER_CHANNEL_NR_1=2
```

## tests/drivers/dma/chan_blen_transfer/boards/stm32mp257f_ev1_stm32mp257fxx_m33.conf
```kconfig
# Copyright (C) 2025 Savoir-faire Linux, Inc.
# SPDX-License-Identifier: Apache-2.0

CONFIG_DMA_TRANSFER_CHANNEL_NR_0=0
CONFIG_DMA_TRANSFER_CHANNEL_NR_1=13
```

## tests/drivers/dma/chan_blen_transfer/boards/versalnet_apu.conf
```kconfig
# Copyright (c) 2025 Advanced Micro Devices
# SPDX-License-Identifier: Apache-2.0

# Xilinx ADMA: Each device instance represents a single channel
# Test uses same device (adma0) which only supports channel 0
CONFIG_DMA_TRANSFER_CHANNEL_NR_0=0
CONFIG_DMA_TRANSFER_CHANNEL_NR_1=0
```

## tests/drivers/dma/chan_blen_transfer/boards/xg27_dk2602a.conf
```kconfig
# Copyright (c) 2024 Silicon Laboratories, Inc.
# SPDX-License-Identifier: Apache-2.0

CONFIG_CODE_DATA_RELOCATION=y
```

## tests/drivers/dma/chan_link_transfer/Kconfig
```kconfig
# Copyright (c) 2025 Alex Apostolu
# SPDX-License-Identifier: Apache-2.0

mainmenu "DMA Link Transfer Test"

source "Kconfig.zephyr"

config DMA_LINK_ALIGNMENT
	int "TX and RX data alignment in bytes"
	default 32
```

## tests/drivers/dma/chan_link_transfer/testcase.yaml
```yaml
tests:
  drivers.dma.chan_link_transfer:
    min_ram: 16
    depends_on: dma
    tags:
      - drivers
      - dma
    platform_allow:
      - frdm_k64f
      - mimxrt595_evk/mimxrt595s/cm33
      - mimxrt1050_evk
      - mimxrt1060_evk
      - mimxrt1064_evk
      - mimxrt1160_evk/mimxrt1166/cm7
      - mimxrt1170_evk/mimxrt1176/cm7
      - mimxrt1024_evk
      - lpcxpresso55s69/lpc55s69/cpu0
      - lpcxpresso55s36
      - native_sim
      - native_sim/native/64
    integration_platforms:
      - frdm_k64f
      - native_sim
      - native_sim/native/64
```

## tests/drivers/dma/cyclic/Kconfig
```kconfig
# Copyright (c) 2025 Andriy Gelman
# SPDX-License-Identifier: Apache-2.0

mainmenu "DMA Cyclic Test"

source "Kconfig.zephyr"

config DMA_CYCLIC_CHANNEL_NR
	int "DMA channel to use"
	default 0

config DMA_CYCLIC_XFER_SIZE
	int "Number of bytes to transfer"
	default 4096
```

## tests/drivers/dma/cyclic/testcase.yaml
```yaml
tests:
  drivers.dma.cyclic:
    depends_on: dma
    tags:
      - drivers
      - dma
    platform_allow:
      - xmc47_relax_kit
      - xmc45_relax_kit
    filter: dt_nodelabel_enabled("tst_dma0")
```

## tests/drivers/dma/loop_transfer/Kconfig
```kconfig
# Copyright (c) 2020 Erwin Rol <erwin@erwinrol.com>
# SPDX-License-Identifier: Apache-2.0

mainmenu "DMA Loop Transfer Test"

source "Kconfig.zephyr"

config DMA_LOOP_TRANSFER_CHANNEL_NR
	int "DMA channel to use"
	default 0

config DMA_LOOP_TRANSFER_SRAM_SECTION
	string "the section to place the memory buffers."
	depends on NOCACHE_MEMORY
	default ".nocache"

config DMA_LOOP_TRANSFER_NUMBER_OF_DMAS
	int "Number of DMAs to test"
	default 1

config DMA_LOOP_TRANSFER_SIZE
	int "Number of bytes to transfer"
	default 8192
```

## tests/drivers/dma/loop_transfer/boards/cy8cproto_041tp.conf
```kconfig
# Copyright (c) 2025 Infineon Technologies AG,
# or an affiliate of Infineon Technologies AG.
#
# SPDX-License-Identifier: Apache-2.0

CONFIG_DMA_LOOP_TRANSFER_SIZE=64
```
