/*
 * Copyright (c) 2025 Renesas Electronics Corporation
 *
 * SPDX-License-Identifier: Apache-2.0
 */

&dma0 {
	interrupts = <31 1>, <30 1>;
	interrupt-names = "ch0", "ch1";
	status = "okay";
};

tst_dma0: &dma0 {};
