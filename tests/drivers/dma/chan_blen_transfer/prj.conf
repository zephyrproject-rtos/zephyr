## CMakeLists.txt
```
# SPDX-License-Identifier: Apache-2.0

cmake_minimum_required(VERSION 3.28.0)
find_package(Zephyr REQUIRED HINTS $ENV{ZEPHYR_BASE})
project(chan_blen_transfer)

target_sources(app PRIVATE src/main.c)

if(CONFIG_DMA_TEST_CHANNEL_API)
  target_sources(app PRIVATE src/test_dma_channels.c)
else()
  target_sources(app PRIVATE
    src/test_dma.c
    src/test_buffers.c
  )

  if(CONFIG_DMA_LOOP_TRANSFER_RELOCATE_SECTION)
    zephyr_code_relocate(
      FILES src/test_buffers.c
      LOCATION "${CONFIG_DMA_LOOP_TRANSFER_RELOCATE_SECTION}"
    )
  endif()
endif()
```

## Kconfig
```
# Copyright (c) 2020 STMicroelectronics
# SPDX-License-Identifier: Apache-2.0

mainmenu "DMA Loop Transfer Test"

source "Kconfig.zephyr"

config DMA_TRANSFER_CHANNEL_NR_0
	int "first DMA channel to use"
	default 0

config DMA_TRANSFER_CHANNEL_NR_1
	int "second DMA channel to use"
	default 1

config DMA_LOOP_TRANSFER_RELOCATE_SECTION
	string "the section to place the memory buffers."
	depends on CODE_DATA_RELOCATION
	default "RAM"

config DMA_LOOP_TRANSFER_NUMBER_OF_DMAS
	int "Number of DMAs to test"
	default 1

config DMA_TRANSFER_BURST16
	bool "Enable loop transfers of 16-beat bursts"
	default y

config DMA_TRANSFER_LONG_BLOCK_SIZE
	int "Size in bytes of an additional long single-block transfer"
	default 0
	help
	  When non-zero, also copy one block of this many bytes with
	  one-byte bursts. Set it above what one descriptor of the
	  controller can carry to exercise a driver that splits a block.

config DMA_TRANSFER_LONG_BLOCK_RELOAD
	bool "Reload the channel after the long block"
	depends on DMA_TRANSFER_LONG_BLOCK_SIZE > 0
	help
	  For a driver that splits a long block on dma_config() but sends a
	  reload out as one descriptor: check that a reload of the long size
	  is refused with -EINVAL, and that a short reload then copies its
	  data and nothing else.

config DMA_TRANSFER_OVERSIZE_BLOCK_SIZE
	int "Size in bytes of a single block the driver must reject"
	default 0
	help
	  When non-zero, check that dma_config() rejects one block of this
	  many bytes with -EINVAL, returns with interrupts unlocked, and
	  leaves the channel usable for the next transfer.

config DMA_TEST_CHANNEL_API
	bool "Test DMA channel API state and bounds"
	depends on DMA_MCUX_LPC
	help
	  Run channel validation and transfer restart tests instead of burst tests.
	  These cases check the LPC driver's channel-state expectations.
```

## prj.conf
```kconfig
CONFIG_DMA=y
CONFIG_ZTEST=y
CONFIG_SYS_LOG=y
CONFIG_SYS_LOG_DMA_LEVEL=1
```

## generic_board_stm32_v1.conf
```kconfig
CONFIG_DMA_2=y
```

## generic_board_stm32_v2.conf
```kconfig
CONFIG_DMA_1=y
```

## prj_shell.conf
```kconfig
CONFIG_DMA=y
CONFIG_DMA_QMSI=y
CONFIG_ZTEST=y
CONFIG_CONSOLE_HANDLER=y
CONFIG_SHELL=y
```

## boards/b_u585i_iot02a.conf
```kconfig
# SPDX-FileCopyrightText: Copyright The Zephyr Project Contributors
# SPDX-License-Identifier: Apache-2.0

CONFIG_DMA_TRANSFER_CHANNEL_NR_0=5
CONFIG_DMA_TRANSFER_CHANNEL_NR_1=10
```

## boards/disco_l475_iot1.conf
```kconfig
CONFIG_DMA_TRANSFER_CHANNEL_NR_0=4
CONFIG_DMA_TRANSFER_CHANNEL_NR_1=2
```

## boards/esp32c3_devkitm.conf
```kconfig
CONFIG_DMA_TRANSFER_CHANNEL_NR_0=5
CONFIG_DMA_TRANSFER_CHANNEL_NR_1=0
CONFIG_HEAP_MEM_POOL_SIZE=32768
```

## boards/adafruit_trinket_m0.overlay
```dts
/*
 * Copyright (c) 2022 Kumar Gala <galak@kernel.org>
 *
 * SPDX-License-Identifier: Apache-2.0
 */

test_dma0: &dmac { };
```

## boards/adma.overlay
```dts
/*
 * Copyright (c) 2025 Advance Micro Devices
 *
 * SPDX-License-Identifier: Apache-2.0
 */

tst_dma0: &adma0 {};
```

## boards/adp_xc7k_ae350_clic.overlay
```dts
/*
 * Copyright (c) 2025 Andes Technology Corporation.
 *
 * SPDX-License-Identifier: Apache-2.0
 */

&dma0 {
	status = "okay";
};

/ {
	zephyr,user {
		dma-test-devs = <&dma0>;
	};
};
```

## boards/arduino_nano_33_iot.overlay
```dts
/*
 * Copyright (c) 2022 Kumar Gala <galak@kernel.org>
 *
 * SPDX-License-Identifier: Apache-2.0
 */

tst_dma0: &dmac {};
```

## boards/atsaml21_xpro.overlay
```dts
/*
 * Copyright (c) 2022 Kumar Gala <galak@kernel.org>
 *
 * SPDX-License-Identifier: Apache-2.0
 */

test_dma: &dmac { };
```

## boards/cy8cproto_062_4343w.overlay
```dts
/*
 * SPDX-License-Identifier: Apache-2.0
 */

&dma0 {
	status = "okay";
};

&dma1 {
	status = "okay";
};

/ {
	zephyr,user {
		dma-test-devs = <&dma0>, <&dma1>;
	};
};
```

## src/main.c
```c
/*
 * Copyright (c) 2016 Intel Corporation
 *
 * SPDX-License-Identifier: Apache-2.0
 */


#include <zephyr/kernel.h>
#include <zephyr/ztest.h>

ZTEST_SUITE(dma_m2m, NULL, NULL, NULL, NULL, NULL);
```

## src/test_buffers.c
```c
/*
 * Copyright (c) 2024 STMicroelectronics
 *
 * SPDX-License-Identifier: Apache-2.0
 */

#include <zephyr/kernel.h>

#include "test_buffers.h"

#define DMA_DATA_ALIGNMENT DT_INST_PROP_OR(tst_dma0, dma_buf_addr_alignment, 32)

__aligned(DMA_DATA_ALIGNMENT) char tx_data[TEST_BUF_SIZE] =
	"It is harder to be kind than to be wise........";
__aligned(DMA_DATA_ALIGNMENT) char rx_data[TEST_BUF_SIZE + GUARD_BUF_SIZE] = {0};

#if CONFIG_DMA_TRANSFER_LONG_BLOCK_SIZE > 0
#if CONFIG_NOCACHE_MEMORY
__aligned(DMA_DATA_ALIGNMENT) uint8_t long_tx_data[LONG_BUF_SIZE] __used
	__attribute__((__section__(".nocache")));
__aligned(DMA_DATA_ALIGNMENT) uint8_t long_rx_data[LONG_BUF_SIZE + GUARD_BUF_SIZE] __used
	__attribute__((__section__(".nocache.dma")));
#else
__aligned(DMA_DATA_ALIGNMENT) uint8_t long_tx_data[LONG_BUF_SIZE];
__aligned(DMA_DATA_ALIGNMENT) uint8_t long_rx_data[LONG_BUF_SIZE + GUARD_BUF_SIZE];
#endif
#endif
```

## src/test_buffers.h
```c
/*
 * Copyright (c) 2024 STMicroelectronics
 *
 * SPDX-License-Identifier: Apache-2.0
 */

#include <stdint.h>

#define GUARD_BUF_SIZE (16)
#define TEST_BUF_SIZE (48)

extern char tx_data[TEST_BUF_SIZE];
extern char rx_data[TEST_BUF_SIZE + GUARD_BUF_SIZE];

#if CONFIG_DMA_TRANSFER_LONG_BLOCK_SIZE > 0
#define LONG_BUF_SIZE CONFIG_DMA_TRANSFER_LONG_BLOCK_SIZE

extern uint8_t long_tx_data[LONG_BUF_SIZE];
extern uint8_t long_rx_data[LONG_BUF_SIZE + GUARD_BUF_SIZE];
#endif
```

## src/test_chan_blen_transfer.c
```c
/*
 * Copyright (c) 2016 Intel Corporation
 * Copyright (c) 2024 STMicroelectronics
 * Copyright 2026 NXP
 *
 * SPDX-License-Identifier: Apache-2.0
 */

/**
 * @file
 * @brief Verify zephyr dma memory to memory transfer
 * @details
 * - Test Steps
 *   -# Set dma channel configuration including source/dest addr, burstlen
 *   -# Set direction memory-to-memory
 *   -# Start transfer
 * - Expected Results
 *   -# Data is transferred correctly from src to dest
 */

#include <string.h>

#include <zephyr/cache.h>
#include <zephyr/kernel.h>
#include <zephyr/drivers/dma.h>
#include <zephyr/ztest.h>

#include "dma_test.h"

#define GUARD_BUF_SIZE (16)
#define TEST_BUF_SIZE (48)

static const char test_pattern[TEST_BUF_SIZE] = "It is harder to be kind than to be wise........";

static DMA_TEST_BUF char tx_data[TEST_BUF_SIZE];
static DMA_TEST_BUF char rx_data[TEST_BUF_SIZE + GUARD_BUF_SIZE];

static K_SEM_DEFINE(transfer_end_sem, 0, 1);
static int dma_complete_status;

static int check_overflow_buffer(const uint8_t *buf, int len)
{
	for (int i = 0; i < len; ++i) {
		if (buf[i] != 0xA5) {
			return 1;
		}
	}

	return 0;
}

static void test_done(const struct device *dma_dev, void *arg,
		      uint32_t id, int status)
{
	dma_complete_status = status;
	k_sem_give((struct k_sem *)arg);
}

static int test_task(const struct device *dma, uint32_t chan_id, uint32_t blen)
{
	struct dma_config dma_cfg = { 0 };
	struct dma_block_config dma_block_cfg = { 0 };
	int res;

	if (!device_is_ready(dma)) {
		TC_PRINT("dma controller device is not ready\n");
		return TC_FAIL;
	}

	dma_cfg.channel_direction = MEMORY_TO_MEMORY;
	dma_cfg.source_data_size = 1U;
	dma_cfg.dest_data_size = 1U;
	dma_cfg.source_burst_length = blen;
	dma_cfg.dest_burst_length = blen;
	dma_cfg.dma_callback = test_done;
	dma_cfg.user_data = &transfer_end_sem;
	dma_cfg.complete_callback_en = 0U;
	dma_cfg.error_callback_dis = 0U;
	dma_cfg.block_count = 1U;
	dma_cfg.head_block = &dma_block_cfg;
#ifdef CONFIG_DMA_MCUX_TEST_SLOT_START
	dma_cfg.dma_slot = CONFIG_DMA_MCUX_TEST_SLOT_START;
#endif

	TC_PRINT("Preparing DMA Controller: Name=%s, Chan_ID=%u, BURST_LEN=%u\n",
		 dma->name, chan_id, blen >> 3);

	TC_PRINT("Starting the transfer\n");
	(void)memcpy(tx_data, test_pattern, TEST_BUF_SIZE);
	(void)memset(rx_data, 0, TEST_BUF_SIZE);
	(void)memset(rx_data + TEST_BUF_SIZE, 0xA5, GUARD_BUF_SIZE);
	dma_block_cfg.block_size = TEST_BUF_SIZE;
#ifdef CONFIG_DMA_64BIT
	dma_block_cfg.source_address = (uint64_t)tx_data;
	dma_block_cfg.dest_address = (uint64_t)rx_data;
#else
	dma_block_cfg.source_address = (uint32_t)tx_data;
	dma_block_cfg.dest_address = (uint32_t)rx_data;
#endif

	if (dma_config(dma, chan_id, &dma_cfg)) {
		TC_PRINT("ERROR: transfer\n");
		return TC_FAIL;
	}

	k_sem_reset(&transfer_end_sem);

	/*
	 * Flush tx_data so the DMA reads committed data from memory, and
	 * invalidate rx_data (including guard area) so the CPU will not observe
	 * stale cache lines after the DMA writes to it.
	 */
	sys_cache_data_flush_range(tx_data, TEST_BUF_SIZE);
	sys_cache_data_flush_and_invd_range(rx_data, TEST_BUF_SIZE + GUARD_BUF_SIZE);

	if (dma_start(dma, chan_id)) {
		TC_PRINT("ERROR: transfer\n");
		return TC_FAIL;
	}

	/*
	 * Use a timeout to ensure the test never deadlocks
	 * even if the DMA driver is buggy and doesn't call
	 * the registered user callback.
	 */
	res = k_sem_take(&transfer_end_sem, K_MSEC(2000));
	if (res == -EAGAIN) {
		TC_PRINT("ERROR: transfer timeout (dma_callback not called)\n");
		if (dma_stop(dma, chan_id)) {
			TC_PRINT("ERROR: failed to stop DMA transfer");
		}
		return TC_FAIL;
	} /* else: res == 0 (-EBUSY cannot have been returned here)*/

	if (dma_complete_status != DMA_STATUS_COMPLETE) {
		TC_PRINT("DMA transfer error\n");
		return TC_FAIL;
	}

	/*
	 * Invalidate rx_data again after DMA completion to ensure the CPU reads
	 * what the DMA actually wrote, not any speculatively cached lines.
	 */
	sys_cache_data_invd_range(rx_data, TEST_BUF_SIZE + GUARD_BUF_SIZE);

	TC_PRINT("DMA transfer successful\n");
	TC_PRINT("%s\n", rx_data);
	if (strcmp(tx_data, rx_data) != 0) {
		return TC_FAIL;
	}
	if (check_overflow_buffer(rx_data + TEST_BUF_SIZE, GUARD_BUF_SIZE)) {
		TC_PRINT("Guard pattern has been overwritten.");
		return TC_FAIL;
	}
	return TC_PASS;
}

/* Run the transfer on every channel the board or the driver gives the test. */
static void run_dma_m2m_test(const struct dma_test_dev *td, uint32_t blen)
{
	struct dma_test_channels chans;

	zassert_ok(dma_test_channels_get(td, DMA_TEST_MAX_CHANNELS, &chans));

	for (size_t i = 0; i < chans.count; i++) {
		zassert_true(test_task(td->dev, chans.id[i], blen) == TC_PASS,
			     "%s failed chan %u burst %u", td->dev->name, chans.id[i], blen);
	}

	dma_test_channels_put(td, &chans);
}

/* Generate one set of test cases per DMA controller under test so a failure
 * on one controller does not prevent the remaining controllers from running.
 */
#define DEFINE_DMA_M2M_BURST8_TESTS(idx, _)                                                        \
	ZTEST(dma_m2m, test_dma##idx##_m2m_burst8)                                                 \
	{                                                                                          \
		run_dma_m2m_test(&dma_test_devs[idx], 8);                                          \
	}

LISTIFY(DMA_TEST_DEV_COUNT, DEFINE_DMA_M2M_BURST8_TESTS, ())

/* Skipped on a controller the board limits to shorter bursts. */
#define DEFINE_DMA_M2M_BURST16_TESTS(idx, _)                                                       \
	ZTEST(dma_m2m, test_dma##idx##_m2m_burst16)                                                \
	{                                                                                          \
		if (dma_test_devs[idx].max_burst_length != 0 &&                                    \
		    dma_test_devs[idx].max_burst_length < 16) {                                    \
			ztest_test_skip();                                                         \
		}                                                                                  \
		run_dma_m2m_test(&dma_test_devs[idx], 16);                                         \
	}

LISTIFY(DMA_TEST_DEV_COUNT, DEFINE_DMA_M2M_BURST16_TESTS, ())

ZTEST_SUITE(dma_m2m, NULL, NULL, NULL, NULL, NULL);
```

## src/test_dma.c
```c
/*
 * Copyright (c) 2016 Intel Corporation
 * Copyright 2026 NXP
 *
 * SPDX-License-Identifier: Apache-2.0
 */

/**
 * @file
 * @brief Verify zephyr dma memory to memory transfer
 * @details
 * - Test Steps
 *   -# Set dma channel configuration including source/dest addr, burstlen
 *   -# Set direction memory-to-memory
 *   -# Start transfer
 * - Expected Results
 *   -# Data is transferred correctly from src to dest
 */

#include <zephyr/cache.h>
#include <zephyr/kernel.h>
#include <zephyr/drivers/dma.h>
#include <zephyr/ztest.h>

#include "test_buffers.h"

#define DMA_TEST_NODE      DT_PATH(zephyr_user)
#define DMA_TEST_DEVS_PROP dma_test_devs

#if DT_NODE_HAS_PROP(DMA_TEST_NODE, DMA_TEST_DEVS_PROP)
/* Boards list the DMA controllers to test in a zephyr,user dma-test-devs
 * phandle list.
 */
#define DMA_TEST_DEV_COUNT DT_PROP_LEN(DMA_TEST_NODE, DMA_TEST_DEVS_PROP)
#define DMA_TEST_DEV_GET(idx, _)                                                                   \
	DEVICE_DT_GET(DT_PHANDLE_BY_IDX(DMA_TEST_NODE, DMA_TEST_DEVS_PROP, idx))
#else
/* Legacy boards use tst_dmaN devicetree labels and
 * CONFIG_DMA_LOOP_TRANSFER_NUMBER_OF_DMAS.
 */
#define DMA_TEST_DEV_COUNT CONFIG_DMA_LOOP_TRANSFER_NUMBER_OF_DMAS
#define DMA_TEST_DEV_GET(idx, _) DEVICE_DT_GET(DT_NODELABEL(tst_dma##idx))
#endif

static const struct device *const dma_test_devs[] = {
	LISTIFY(DMA_TEST_DEV_COUNT, DMA_TEST_DEV_GET, (,))
};

static K_SEM_DEFINE(transfer_end_sem, 0, 1);
static int dma_complete_status;

static int check_overflow_buffer(const uint8_t *buf, int len)
{
	for (int i = 0; i < len; ++i) {
		if (buf[i] != 0xA5) {
			return 1;
		}
	}

	return 0;
}

static void test_done(const struct device *dma_dev, void *arg,
		      uint32_t id, int status)
{
	dma_complete_status = status;
	k_sem_give((struct k_sem *)arg);
}

static int test_task(const struct device *dma, uint32_t chan_id, uint32_t blen)
{
	struct dma_config dma_cfg = { 0 };
	struct dma_block_config dma_block_cfg = { 0 };
	int res;

	if (!device_is_ready(dma)) {
		TC_PRINT("dma controller device is not ready\n");
		return TC_FAIL;
	}

	dma_cfg.channel_direction = MEMORY_TO_MEMORY;
	dma_cfg.source_data_size = 1U;
	dma_cfg.dest_data_size = 1U;
	dma_cfg.source_burst_length = blen;
	dma_cfg.dest_burst_length = blen;
	dma_cfg.dma_callback = test_done;
	dma_cfg.user_data = &transfer_end_sem;
	dma_cfg.complete_callback_en = 0U;
	dma_cfg.error_callback_dis = 0U;
	dma_cfg.block_count = 1U;
	dma_cfg.head_block = &dma_block_cfg;
#ifdef CONFIG_DMA_MCUX_TEST_SLOT_START
	dma_cfg.dma_slot = CONFIG_DMA_MCUX_TEST_SLOT_START;
#endif

	TC_PRINT("Preparing DMA Controller: Name=%s, Chan_ID=%u, BURST_LEN=%u\n",
		 dma->name, chan_id, blen >> 3);

	TC_PRINT("Starting the transfer\n");
	(void)memset(rx_data, 0, TEST_BUF_SIZE);
	(void)memset(rx_data + TEST_BUF_SIZE, 0xA5, GUARD_BUF_SIZE);
	dma_block_cfg.block_size = TEST_BUF_SIZE;
#ifdef CONFIG_DMA_64BIT
	dma_block_cfg.source_address = (uint64_t)tx_data;
	dma_block_cfg.dest_address = (uint64_t)rx_data;
#else
	dma_block_cfg.source_address = (uint32_t)tx_data;
	dma_block_cfg.dest_address = (uint32_t)rx_data;
#endif

	if (dma_config(dma, chan_id, &dma_cfg)) {
		TC_PRINT("ERROR: transfer\n");
		return TC_FAIL;
	}

	k_sem_reset(&transfer_end_sem);

	/*
	 * Flush tx_data so the DMA reads committed data from memory, and
	 * invalidate rx_data (including guard area) so the CPU will not observe
	 * stale cache lines after the DMA writes to it.
	 */
	sys_cache_data_flush_range(tx_data, TEST_BUF_SIZE);
	sys_cache_data_flush_and_invd_range(rx_data, TEST_BUF_SIZE + GUARD_BUF_SIZE);

	if (dma_start(dma, chan_id)) {
		TC_PRINT("ERROR: transfer\n");
		return TC_FAIL;
	}

	/*
	 * Use a timeout to ensure the test never deadlocks
	 * even if the DMA driver is buggy and doesn't call
	 * the registered user callback.
	 */
	res = k_sem_take(&transfer_end_sem, K_MSEC(2000));
	if (res == -EAGAIN) {
		TC_PRINT("ERROR: transfer timeout (dma_callback not called)\n");
		if (dma_stop(dma, chan_id)) {
			TC_PRINT("ERROR: failed to stop DMA transfer");
		}
		return TC_FAIL;
	} /* else: res == 0 (-EBUSY cannot have been returned here)*/

	if (dma_complete_status != DMA_STATUS_COMPLETE) {
		TC_PRINT("DMA transfer error\n");
		return TC_FAIL;
	}

	/*
	 * Invalidate rx_data again after DMA completion to ensure the CPU reads
	 * what the DMA actually wrote, not any speculatively cached lines.
	 */
	sys_cache_data_invd_range(rx_data, TEST_BUF_SIZE + GUARD_BUF_SIZE);

	TC_PRINT("DMA transfer successful\n");
	TC_PRINT("%s\n", rx_data);
	if (strcmp(tx_data, rx_data) != 0) {
		return TC_FAIL;
	}
	if (check_overflow_buffer(rx_data + TEST_BUF_SIZE, GUARD_BUF_SIZE)) {
		TC_PRINT("Guard pattern has been overwritten.");
		return TC_FAIL;
	}
	return TC_PASS;
}

static void run_dma_m2m_test(const struct device *dma, uint32_t chan, uint32_t blen)
{
	zassert_true(test_task(dma, chan, blen) == TC_PASS, "%s failed chan %u burst %u", dma->name,
		     chan, blen);
}

/* Generate one set of test cases per DMA controller under test so a failure
 * on one controller does not prevent the remaining controllers from running.
 */
#define DEFINE_DMA_M2M_BURST8_TESTS(idx, _)                                                        \
	ZTEST(dma_m2m, test_dma##idx##_m2m_chan0_burst8)                                           \
	{                                                                                          \
		run_dma_m2m_test(dma_test_devs[idx], CONFIG_DMA_TRANSFER_CHANNEL_NR_0, 8);         \
	}                                                                                          \
	ZTEST(dma_m2m, test_dma##idx##_m2m_chan1_burst8)                                           \
	{                                                                                          \
		run_dma_m2m_test(dma_test_devs[idx], CONFIG_DMA_TRANSFER_CHANNEL_NR_1, 8);         \
	}

LISTIFY(DMA_TEST_DEV_COUNT, DEFINE_DMA_M2M_BURST8_TESTS, ())

#if CONFIG_DMA_TRANSFER_BURST16
#define DEFINE_DMA_M2M_BURST16_TESTS(idx, _)                                                       \
	ZTEST(dma_m2m, test_dma##idx##_m2m_chan0_burst16)                                          \
	{                                                                                          \
		run_dma_m2m_test(dma_test_devs[idx], CONFIG_DMA_TRANSFER_CHANNEL_NR_0, 16);        \
	}                                                                                          \
	ZTEST(dma_m2m, test_dma##idx##_m2m_chan1_burst16)                                          \
	{                                                                                          \
		run_dma_m2m_test(dma_test_devs[idx], CONFIG_DMA_TRANSFER_CHANNEL_NR_1, 16);        \
	}

LISTIFY(DMA_TEST_DEV_COUNT, DEFINE_DMA_M2M_BURST16_TESTS, ())
#endif

#if CONFIG_DMA_TRANSFER_LONG_BLOCK_SIZE > 0 || CONFIG_DMA_TRANSFER_OVERSIZE_BLOCK_SIZE > 0
/* One block, one-byte data and bursts, so the block size is the loop count. */
static void one_block_config(struct dma_config *cfg, struct dma_block_config *blk, uintptr_t src,
			     uintptr_t dst, uint32_t size)
{
	*cfg = (struct dma_config){0};
	*blk = (struct dma_block_config){0};

	cfg->channel_direction = MEMORY_TO_MEMORY;
	cfg->source_data_size = 1U;
	cfg->dest_data_size = 1U;
	cfg->source_burst_length = 1U;
	cfg->dest_burst_length = 1U;
	cfg->dma_callback = test_done;
	cfg->user_data = &transfer_end_sem;
	cfg->block_count = 1U;
	cfg->head_block = blk;
#ifdef CONFIG_DMA_MCUX_TEST_SLOT_START
	cfg->dma_slot = CONFIG_DMA_MCUX_TEST_SLOT_START;
#endif

	blk->block_size = size;
	blk->source_address = src;
	blk->dest_address = dst;
}
#endif

#if CONFIG_DMA_TRANSFER_LONG_BLOCK_SIZE > 0
static void run_dma_m2m_long_block_test(const struct device *dma, uint32_t chan)
{
	struct dma_config cfg;
	struct dma_block_config blk;

	zassert_true(device_is_ready(dma), "%s not ready", dma->name);

	for (size_t i = 0; i < LONG_BUF_SIZE; i++) {
		long_tx_data[i] = (uint8_t)(i * 7U + (i >> 8));
	}
	(void)memset(long_rx_data, 0, LONG_BUF_SIZE);
	(void)memset(long_rx_data + LONG_BUF_SIZE, 0xA5, GUARD_BUF_SIZE);

	one_block_config(&cfg, &blk, (uintptr_t)long_tx_data, (uintptr_t)long_rx_data,
			 LONG_BUF_SIZE);
	zassert_ok(dma_config(dma, chan, &cfg), "%s chan %u: config failed", dma->name, chan);

	k_sem_reset(&transfer_end_sem);
	sys_cache_data_flush_range(long_tx_data, LONG_BUF_SIZE);
	sys_cache_data_flush_and_invd_range(long_rx_data, LONG_BUF_SIZE + GUARD_BUF_SIZE);

	zassert_ok(dma_start(dma, chan), "%s chan %u: start failed", dma->name, chan);
	if (k_sem_take(&transfer_end_sem, K_MSEC(2000)) != 0) {
		(void)dma_stop(dma, chan);
		zassert_unreachable("%s chan %u: callback not called", dma->name, chan);
	}
	zassert_equal(dma_complete_status, DMA_STATUS_COMPLETE, "%s chan %u: status %d", dma->name,
		      chan, dma_complete_status);

	sys_cache_data_invd_range(long_rx_data, LONG_BUF_SIZE + GUARD_BUF_SIZE);
	zassert_mem_equal(long_rx_data, long_tx_data, LONG_BUF_SIZE, "%s chan %u: data mismatch",
			  dma->name, chan);
	zassert_false(check_overflow_buffer(long_rx_data + LONG_BUF_SIZE, GUARD_BUF_SIZE),
		      "%s chan %u: guard overwritten", dma->name, chan);

	struct dma_status status;

	zassert_ok(dma_get_status(dma, chan, &status), "%s chan %u: get_status failed", dma->name,
		   chan);
	zassert_false(status.busy, "%s chan %u: still busy after completion", dma->name, chan);

#ifdef CONFIG_DMA_TRANSFER_LONG_BLOCK_RELOAD
	zassert_equal(dma_reload(dma, chan, (uintptr_t)long_tx_data, (uintptr_t)long_rx_data,
				 LONG_BUF_SIZE),
		      -EINVAL, "%s chan %u: long reload not rejected", dma->name, chan);

	/*
	 * A short reload after the long block must run alone. A channel left
	 * holding the finished last piece runs that again first, and signals
	 * completion before the reload has been copied.
	 */
	(void)memset(rx_data, 0, TEST_BUF_SIZE);
	(void)memset(rx_data + TEST_BUF_SIZE, 0xA5, GUARD_BUF_SIZE);
	sys_cache_data_flush_range(tx_data, TEST_BUF_SIZE);
	sys_cache_data_flush_and_invd_range(rx_data, TEST_BUF_SIZE + GUARD_BUF_SIZE);
	k_sem_reset(&transfer_end_sem);

	zassert_ok(dma_reload(dma, chan, (uintptr_t)tx_data, (uintptr_t)rx_data, TEST_BUF_SIZE),
		   "%s chan %u: short reload failed", dma->name, chan);
	zassert_ok(dma_start(dma, chan), "%s chan %u: start after reload failed", dma->name, chan);
	if (k_sem_take(&transfer_end_sem, K_MSEC(2000)) != 0) {
		(void)dma_stop(dma, chan);
		zassert_unreachable("%s chan %u: reload callback not called", dma->name, chan);
	}
	zassert_equal(dma_complete_status, DMA_STATUS_COMPLETE, "%s chan %u: reload status %d",
		      dma->name, chan, dma_complete_status);

	sys_cache_data_invd_range(rx_data, TEST_BUF_SIZE + GUARD_BUF_SIZE);
	zassert_mem_equal(rx_data, tx_data, TEST_BUF_SIZE, "%s chan %u: reload data mismatch",
			  dma->name, chan);
	zassert_false(check_overflow_buffer(rx_data + TEST_BUF_SIZE, GUARD_BUF_SIZE),
		      "%s chan %u: reload guard overwritten", dma->name, chan);
	(void)dma_stop(dma, chan);
#endif
}

#define DEFINE_DMA_M2M_LONG_BLOCK_TESTS(idx, _)                                                    \
	ZTEST(dma_m2m, test_dma##idx##_m2m_chan0_long_block)                                       \
	{                                                                                          \
		run_dma_m2m_long_block_test(dma_test_devs[idx], CONFIG_DMA_TRANSFER_CHANNEL_NR_0); \
	}

LISTIFY(DMA_TEST_DEV_COUNT, DEFINE_DMA_M2M_LONG_BLOCK_TESTS, ())
#endif

#if CONFIG_DMA_TRANSFER_OVERSIZE_BLOCK_SIZE > 0
static void run_dma_m2m_oversize_block_test(const struct device *dma, uint32_t chan)
{
	struct dma_config cfg;
	struct dma_block_config blk;
	unsigned int key;
	int ret;

	zassert_true(device_is_ready(dma), "%s not ready", dma->name);

	/* Rejected before anything is queued, so the small buffers are enough. */
	one_block_config(&cfg, &blk, (uintptr_t)tx_data, (uintptr_t)rx_data,
			 CONFIG_DMA_TRANSFER_OVERSIZE_BLOCK_SIZE);
	ret = dma_config(dma, chan, &cfg);

	key = irq_lock();
	irq_unlock(key);
	zassert_true(arch_irq_unlocked(key), "%s chan %u: config returned with interrupts locked",
		     dma->name, chan);
	zassert_equal(ret, -EINVAL, "%s chan %u: config returned %d", dma->name, chan, ret);

	zassert_equal(test_task(dma, chan, 8), TC_PASS,
		      "%s chan %u: transfer after a rejected config failed", dma->name, chan);
}

#define DEFINE_DMA_M2M_OVERSIZE_BLOCK_TESTS(idx, _)                                                \
	ZTEST(dma_m2m, test_dma##idx##_m2m_chan0_oversize_block)                                   \
	{                                                                                          \
		run_dma_m2m_oversize_block_test(dma_test_devs[idx],                                \
						CONFIG_DMA_TRANSFER_CHANNEL_NR_0);                 \
	}

LISTIFY(DMA_TEST_DEV_COUNT, DEFINE_DMA_M2M_OVERSIZE_BLOCK_TESTS, ())
#endif
```

## src/test_dma_channels.c
```c
/*
 * SPDX-FileCopyrightText: Copyright (c) 2026 Hsiu-Chi Tsai
 * SPDX-License-Identifier: Apache-2.0
 */

#include <errno.h>
#include <stdint.h>

#include <zephyr/device.h>
#include <zephyr/drivers/dma.h>
#include <zephyr/kernel.h>
#include <zephyr/ztest.h>

#define DMA_NODE     DT_COMPAT_GET_ANY_STATUS_OKAY(nxp_lpc_dma)
#define DMA_CHANNELS DT_PROP(DMA_NODE, dma_channels)

static const struct device *const dma = DEVICE_DT_GET(DMA_NODE);
static uint32_t source;
static volatile uint32_t destination;
static bool channel_configured;
static int completion_status;
static K_SEM_DEFINE(completed, 0, 1);

static void assert_unavailable_channel(uint32_t channel, int32_t stop_ret)
{
	struct dma_status status = {
		.busy = true,
		.dir = MEMORY_TO_PERIPHERAL,
		.pending_length = sizeof(source),
	};

	zassert_equal(dma_start(dma, channel), -EINVAL, "Starting channel %u", channel);
	zassert_equal(dma_reload(dma, channel, (uintptr_t)&source, (uintptr_t)&destination,
				 sizeof(source)),
		      -EINVAL, "Reloading channel %u", channel);
	zassert_equal(dma_get_status(dma, channel, &status), -EINVAL, "Querying channel %u",
		      channel);
	zassert_true(status.busy);
	zassert_equal(status.dir, MEMORY_TO_PERIPHERAL);
	zassert_equal(status.pending_length, sizeof(source));
	zassert_equal(dma_stop(dma, channel), stop_ret, "Stopping channel %u", channel);
	zassert_equal(dma_stop(dma, channel), stop_ret, "Repeated stop of channel %u", channel);
}

static void transfer_done(const struct device *dev, void *user_data, uint32_t channel, int status)
{
	completion_status = status;
	k_sem_give(user_data);
}

static void run_transfer(uint32_t channel)
{
	int ret;

	k_sem_reset(&completed);
	completion_status = -EINPROGRESS;
	zassert_ok(dma_start(dma, channel));
	ret = k_sem_take(&completed, K_SECONDS(2));
	zassert_ok(dma_stop(dma, channel));
	zassert_ok(ret, "DMA completion timed out");
	zassert_equal(completion_status, DMA_STATUS_COMPLETE);
	zassert_equal(destination, source);
}

ZTEST(dma_m2m, test_invalid_channel)
{
	zassert_true(device_is_ready(dma));
	assert_unavailable_channel(DMA_CHANNELS, -EINVAL);
	assert_unavailable_channel(UINT32_MAX, -EINVAL);
}

ZTEST(dma_m2m, test_channel_before_and_after_configure)
{
	struct dma_block_config block = {
		.source_address = (uintptr_t)&source,
		.dest_address = (uintptr_t)&destination,
		.block_size = sizeof(source),
	};
	struct dma_config config = {
		.channel_direction = MEMORY_TO_MEMORY,
		.source_data_size = sizeof(source),
		.dest_data_size = sizeof(destination),
		.source_burst_length = sizeof(source),
		.dest_burst_length = sizeof(destination),
		.block_count = 1,
		.head_block = &block,
		.dma_callback = transfer_done,
		.user_data = &completed,
	};
	struct dma_status status;
	uint32_t channel = DMA_CHANNELS - 1U;

	zassert_true(device_is_ready(dma));

	/* The configured slot survives stop and suite repetition. */
	for (uint32_t i = 0; i < DMA_CHANNELS; i++) {
		if (!channel_configured || i != channel) {
			assert_unavailable_channel(i, 0);
		}
	}

	/* The hardware channel ID may exceed the number of allocated slots. */
	zassert_ok(dma_config(dma, channel, &config));
	channel_configured = true;
	for (uint32_t i = 0; i < channel; i++) {
		assert_unavailable_channel(i, 0);
	}

	zassert_ok(dma_get_status(dma, channel, &status));
	zassert_false(status.busy);
	zassert_equal(status.pending_length, 0);
	zassert_equal(status.dir, MEMORY_TO_MEMORY);

	source = 0x12345678U;
	destination = 0U;
	run_transfer(channel);

	source = 0x87654321U;
	destination = 0U;
	zassert_ok(dma_reload(dma, channel, (uintptr_t)&source, (uintptr_t)&destination,
			      sizeof(source)));
	run_transfer(channel);

	zassert_ok(dma_get_status(dma, channel, &status));
	zassert_false(status.busy);
	zassert_equal(status.pending_length, 0);
	zassert_equal(status.dir, MEMORY_TO_MEMORY);
	zassert_ok(dma_stop(dma, channel));
}
```
