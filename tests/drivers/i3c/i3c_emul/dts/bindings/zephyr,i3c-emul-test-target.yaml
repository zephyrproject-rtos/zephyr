## tests/drivers/i3c/i3c_emul/dts/bindings/zephyr,i3c-emul-test-target.yaml
```yaml
# Copyright (c) 2026 Meta Platforms
# SPDX-License-Identifier: Apache-2.0

description: |
  Synthetic I3C peripheral used by tests/drivers/i3c/i3c_emul to exercise the
  Zephyr I3C emulator. The peripheral lives entirely inside the test directory
  and exposes a 32-byte register file plus configurable PID/BCR/DCR.

compatible: "zephyr,i3c-emul-test-target"

include: i3c-device.yaml

properties:
  bcr:
    type: int
    default: 0

  dcr:
    type: int
    default: 0

  supports-hdr-ddr:
    type: boolean
    description: |
      The synthetic peripheral advertises HDR-DDR support in its
      GETCAPS Format 1 response and accepts HDR-DDR private xfers.
```

## tests/drivers/i3c/i3c_i2c/boards/kit_pse84_eval_pse846gps2dbzc4a_m33.conf
```kconfig
# Copyright (c) 2026 Infineon Technologies AG,
# or an affiliate of Infineon Technologies AG.
#
# SPDX-License-Identifier: Apache-2.0

# Required when paired with the DW I3C controller (no clock-stretching support):
# eagerly pre-fetch I2C target read bytes into the SCB TX FIFO so the controller
# captures real data on the first bit instead of the DEFAULT_TX (0xFF) fill.
CONFIG_I2C_INFINEON_PDL_TARGET_PREFETCH=y
```

## tests/drivers/i3c/i3c_i2c/testcase.yaml
```yaml
# Copyright (c) 2026 Infineon Technologies AG,
# or an affiliate of Infineon Technologies AG.
#
# SPDX-License-Identifier: Apache-2.0

common:
  tags:
    - drivers
    - i3c
  depends_on: i3c
  filter: dt_alias_exists("test-i3c") and dt_alias_exists("test-i2c-target")
tests:
  drivers.i3c.i2c: {}
```

## tests/drivers/i3c/i3c_loopback/i3c_controller/Kconfig
```kconfig
# SPDX-FileCopyrightText: <text>Copyright (c) 2026 Infineon Technologies AG,
# or an affiliate of Infineon Technologies AG. All rights reserved.</text>
#
# SPDX-License-Identifier: Apache-2.0

mainmenu "I3C loopback test (controller)"

source "Kconfig.zephyr"

menu "I3C loopback bench options"

config I3C_LOOPBACK_BENCH_HAS_PERMANENT_TARGET
	bool "Bench has a permanent on-bus I3C target besides Board B"
	help
	  Enable on benches where the controller's I3C bus has an
	  unkillable target chip wired in besides the test target on
	  Board B (for example, a sensor permanently mounted on the
	  controller's SOM with no power-enable or isolation).  When
	  enabled, the controller suite attaches a placeholder descriptor
	  for that chip so its participation in ENTDAA does not steal the
	  Board B descriptor's address slot.  The PID/BCR/DCR/init-DA of
	  the permanent target are configured below.

if I3C_LOOPBACK_BENCH_HAS_PERMANENT_TARGET

config I3C_LOOPBACK_BENCH_PERMANENT_TARGET_PID_HI
	hex "Permanent target PID (upper 16 bits)"
	default 0x0770

config I3C_LOOPBACK_BENCH_PERMANENT_TARGET_PID_LO
	hex "Permanent target PID (lower 32 bits)"
	default 0x10331000

config I3C_LOOPBACK_BENCH_PERMANENT_TARGET_INIT_DA
	hex "Permanent target initial dynamic address"
	default 0x09

endif

endmenu
```

## tests/drivers/i3c/i3c_loopback/i3c_controller/boards/kit_pse84_eval_pse846gps2dbzc4a_m33.conf
```kconfig
# SPDX-FileCopyrightText: <text>Copyright (c) 2026 Infineon Technologies AG,
# or an affiliate of Infineon Technologies AG. All rights reserved.</text>
#
# SPDX-License-Identifier: Apache-2.0
#
# Bench configuration for KIT_PSE84_EVAL (PSE846GPS2DBZC4A, M33 core).
#
# The PSE84 SOM has a permanent I3C target chip wired to the same I3C0
# pads the test controller drives, with no power-enable or isolation
# jumper exposed.  It participates in every ENTDAA round, so the
# controller test fixture must declare a placeholder descriptor for it
# (PID captured live from DEV_CHAR_TABLE on this SOM).
CONFIG_I3C_LOOPBACK_BENCH_HAS_PERMANENT_TARGET=y
CONFIG_I3C_LOOPBACK_BENCH_PERMANENT_TARGET_PID_HI=0x0770
CONFIG_I3C_LOOPBACK_BENCH_PERMANENT_TARGET_PID_LO=0x10331000
CONFIG_I3C_LOOPBACK_BENCH_PERMANENT_TARGET_INIT_DA=0x09
```

## tests/drivers/i3c/i3c_loopback/i3c_controller/testcase.yaml
```yaml
# SPDX-FileCopyrightText: <text>Copyright (c) 2026 Infineon Technologies AG,
# or an affiliate of Infineon Technologies AG. All rights reserved.</text>
#
# SPDX-License-Identifier: Apache-2.0

common:
  tags:
    - drivers
    - i3c
  depends_on: i3c
  harness: console
  harness_config:
    fixture: i3c_loopback_pair
tests:
  drivers.i3c.i3c_loopback.i3c_controller:
    platform_allow:
      - kit_pse84_eval/pse846gps2dbzc4a/m33
    filter: dt_compat_enabled("snps,designware-i3c")
```

## tests/drivers/i3c/i3c_loopback/i3c_target/Kconfig
```kconfig
# SPDX-FileCopyrightText: <text>Copyright (c) 2026 Infineon Technologies AG,
# or an affiliate of Infineon Technologies AG. All rights reserved.</text>
#
# SPDX-License-Identifier: Apache-2.0

mainmenu "I3C loopback test (target)"

source "Kconfig.zephyr"

menu "I3C loopback target bench options"

config I3C_LOOPBACK_TARGET_VENDOR_WRAPPER_GATE
	bool "Re-open vendor clock-gate register during SOFT_RST"
	help
	  Some DW I3C IP integrations gate the protocol clock through a
	  vendor wrapper register that must be re-opened before SOFT_RST
	  can self-clear.  Enable this option for those integrations and
	  set the wrapper register offset and write value below.

if I3C_LOOPBACK_TARGET_VENDOR_WRAPPER_GATE

config I3C_LOOPBACK_TARGET_WRAPPER_GATE_OFFSET
	hex "Vendor wrapper-gate register offset from controller base"
	default 0x400

config I3C_LOOPBACK_TARGET_WRAPPER_GATE_VALUE
	hex "Value to write to the wrapper-gate register"
	default 0x80000000

endif

config I3C_LOOPBACK_TARGET_VENDOR_EXT_CMD_KICK
	bool "Issue vendor EXT_CMD kick to re-arm target after RSTDAA"
	help
	  Some DW I3C IP variants require a vendor-specific EXT_CMD
	  sequence to re-arm the target's bus-available detector after
	  the controller broadcasts RSTDAA.  Enable this option for those
	  variants.

config I3C_LOOPBACK_TARGET_SOFT_RST_CLEARS_DEVICE_ADDR
	bool "DW SOFT_RST already clears DEVICE_ADDR (default true)"
	default y
	help
	  On most DW I3C variants, SOFT_RST also clears the DEVICE_ADDR
	  register.  Disable this option for variants where the stale
	  dynamic address from a previous ENTDAA round survives SOFT_RST
	  — the target side will then explicitly zero DEVICE_ADDR after
	  the reset to avoid the target believing it already has a DA
	  during the next enumeration round.

endmenu
```

## tests/drivers/i3c/i3c_loopback/i3c_target/boards/kit_pse84_eval_pse846gps2dbzc4a_m33.conf
```kconfig
# SPDX-FileCopyrightText: <text>Copyright (c) 2026 Infineon Technologies AG,
# or an affiliate of Infineon Technologies AG. All rights reserved.</text>
#
# SPDX-License-Identifier: Apache-2.0
#
# Bench configuration for KIT_PSE84_EVAL (PSE846GPS2DBZC4A, M33 core).
#
# The Infineon DW I3C wrapper on PSE84 v1 silicon has two integration
# quirks the generic DW driver does not cover:
#   - a vendor wrapper-gate register at base+0x400 must be re-opened
#     for SOFT_RST to self-clear (the protocol clock is gated by it);
#   - the target IP requires a vendor EXT_CMD kick after RSTDAA to
#     re-arm its bus-available detector before the next ENTDAA round.
# Both behaviours are gated behind dedicated Kconfig symbols so the
# generic test code stays portable.
CONFIG_I3C_LOOPBACK_TARGET_VENDOR_WRAPPER_GATE=y
CONFIG_I3C_LOOPBACK_TARGET_WRAPPER_GATE_OFFSET=0x400
CONFIG_I3C_LOOPBACK_TARGET_WRAPPER_GATE_VALUE=0x80000000
CONFIG_I3C_LOOPBACK_TARGET_VENDOR_EXT_CMD_KICK=y

# On PSE84 v1 silicon, SOFT_RST does NOT clear DEVICE_ADDR — the stale
# dynamic address from the previous ENTDAA round survives and breaks
# re-enumeration.  Disable so the target zeros DEVICE_ADDR explicitly.
CONFIG_I3C_LOOPBACK_TARGET_SOFT_RST_CLEARS_DEVICE_ADDR=n
```

## tests/drivers/input/gpio_kbd_matrix/testcase.yaml
```yaml
# SPDX-License-Identifier: Apache-2.0

common:
  platform_allow:
    - native_sim
    - native_sim/native/64
  tags:
    - drivers
    - input
  integration_platforms:
    - native_sim
tests:
  input.input_gpio_kbd_matrix: {}
```

## tests/drivers/input/gpio_keys/testcase.yaml
```yaml
# SPDX-License-Identifier: Apache-2.0

tests:
  drivers.input.gpio_keys:
    tags: drivers input
    platform_allow: native_posix native_posix_64
    integration_platforms:
      - native_posix
```

## tests/drivers/input/gpio_kpp/testcase.yaml
```yaml
tests:
  drivers.input.kpp_scan:
    tags: drivers input kpp
    filter: dt_compat_enabled("nxp,mcux-kpp")
    depends_on: kpp
```

## tests/drivers/input/kbd_matrix/Kconfig
```kconfig
# Copyright 2023 Google LLC
# SPDX-License-Identifier: Apache-2.0

config INPUT_KBD_MATRIX
	default y

config INPUT_KBD_DRIVE_COLUMN_HOOK
	default y

source "Kconfig.zephyr"
```

## tests/drivers/input/kbd_matrix/dts/bindings/test-kbd-scan.yaml
```yaml
# Copyright 2023 Google LLC
# SPDX-License-Identifier: Apache-2.0

description: Keyboard scan test binding

compatible: "test-kbd-scan"

include: kbd-matrix-common.yaml
```

## tests/drivers/input/touchscreen_common/Kconfig
```kconfig
# Copyright (c) 2026 Arkadiusz Grzelka
# SPDX-License-Identifier: Apache-2.0

config INPUT_TOUCH
	default y

source "Kconfig.zephyr"
```

## tests/drivers/input/touchscreen_common/dts/bindings/test-display.yaml
```yaml
# SPDX-License-Identifier: Apache-2.0

description: Test display controller providing width/height for phandle sourcing

compatible: "test-display"

include: display-controller.yaml
```

## tests/drivers/input/touchscreen_common/dts/bindings/test-touchscreen-common.yaml
```yaml
# SPDX-License-Identifier: Apache-2.0

description: Test binding for the common touchscreen helper

compatible: "test-touchscreen-common"

include: touchscreen-common.yaml
```

## tests/drivers/input/tsc_keys/testcase.yaml
```yaml
tests:
  drivers.input.stm32_tsc:
    tags: drivers input stm32 tsc
    filter: dt_compat_enabled("st,stm32-tsc")
    depends_on: tsc
    integration_platforms: [stm32u083c_dk]
```

## tests/drivers/interrupt_controller/intc_exti_stm32/dts/bindings/test-st-stm32-exti.yaml
```yaml
#
# Copyright (c) 2025 Alexander Kozhinov <ak.alexander.kozhinov@gmail.com>
#
# SPDX-License-Identifier: Apache-2.0
#

description: |
    This binding provides resources required to build and run the
    tests/drivers/interrupt_controller/intc_exti_stm32 test in Zephyr.

compatible: "test-st-stm32-exti"

properties:

  exti-line-nr:
    type: int
    required: true
    description: |
      Number of the EXTI line to use for the test.

  exti-line-irq-nr:
    type: int
    required: true
    description: |
      IRQn of the interrupt triggered by the specified EXTI line.

  exti-line-irq-prio:
    type: int
    required: true
    description: |
      Priority of the interrupt triggered by the specified EXTI line.
```

## tests/drivers/interrupt_controller/intc_exti_stm32/testcase.yaml
```yaml
# Copyright (c) 2025 Alexander Kozhinov <ak.alexander.kozhinov@gmail.com>
# SPDX-License-Identifier: Apache-2.0

common:
  tags:
    - drivers
    - interrupt
  min_ram: 8
  harness: ztest

tests:
  drivers.interrupt_controller.intc_exti_stm32:
    extra_args:
      - DTC_OVERLAY_FILE="boards/exti_default_resources.overlay"
      - platform:nucleo_c071rb/stm32c071xx:EXTRA_DTC_OVERLAY_FILE="boards/nucleo_c071rb_stm32c071xx.overlay"
      - platform:stm32h7s78_dk/stm32h7s7xx:EXTRA_DTC_OVERLAY_FILE="boards/stm32h7s78_dk_stm32h7s7xx.overlay"
      - platform:stm32n6570_dk/stm32n657xx/sb:EXTRA_DTC_OVERLAY_FILE="boards/stm32n6570_dk_stm32n657xx_sb.overlay"
    filter: dt_compat_enabled("st,stm32-exti") and dt_compat_enabled("test-st-stm32-exti")
```

## tests/drivers/interrupt_controller/intc_irq_mgr/testcase.yaml
```yaml
common:
  platform_allow: qemu_riscv64
  tags:
    - drivers
    - interrupt

tests:
  drivers.interrupt_controller.intc_irq_mgr: {}

  drivers.interrupt_controller.intc_irq_mgr.shell.build_only:
    build_only: true
    extra_configs:
      - CONFIG_SHELL=y
      - CONFIG_IRQ_MANAGER_SHELL=y
```

## tests/drivers/interrupt_controller/intc_nxp_gint/testcase.yaml
```yaml
# Copyright 2026 NXP
# SPDX-License-Identifier: Apache-2.0

common:
  tags:
    - drivers
    - gint

tests:
  drivers.interrupt_controller.intc_nxp_gint:
    extra_args:
      - platform:mcxw23_evk:EXTRA_DTC_OVERLAY_FILE="boards/mcxw23_evk.overlay"
    platform_allow:
      - frdm_mcxw23
      - mcxw23_evk
      - lpcxpresso55s36
      - lpcxpresso51u68
      - lpcxpresso55s06
      - lpcxpresso55s16
      - lpcxpresso55s28
      - lpcxpresso55s69/lpc55s69/cpu0
```

## tests/drivers/interrupt_controller/intc_plic/Kconfig
```kconfig
# Copyright (c) 2023 Antmicro
# SPDX-License-Identifier: Apache-2.0

config TEST_INTC_PLIC
	bool
	default y
	help
	   Declare some intc_plic.c functions in the global scope for verification.

config TEST_INTC_PLIC_ALT_MAPPING
	bool "Test alternate hartid - context mapping"

source "Kconfig"
```

## tests/drivers/interrupt_controller/intc_plic/testcase.yaml
```yaml
common:
  platform_allow: qemu_riscv64
  tags:
    - drivers
    - interrupt
    - plic

tests:
  drivers.interrupt_controller.intc_plic: {}
  drivers.interrupt_controller.intc_plic.alt_mapping:
    extra_args:
      DTC_OVERLAY_FILE="./alt_mapping.overlay"
    extra_configs:
      - CONFIG_TEST_INTC_PLIC_ALT_MAPPING=y
```

## tests/drivers/interrupt_controller/intc_riscv_aia/testcase.yaml
```yaml
# Copyright (c) 2025 Synopsys, Inc.
# SPDX-License-Identifier: Apache-2.0

common:
  arch_allow: riscv
  tags:
    - drivers
    - interrupt
    - riscv
    - aia
    - aplic
    - imsic

tests:
  drivers.interrupt_controller.intc_riscv_aia: {}
```

## tests/drivers/interrupt_controller/intc_riscv_imsic_miselect/testcase.yaml
```yaml
# Copyright (c) 2025 Synopsys, Inc.
# SPDX-License-Identifier: Apache-2.0

common:
  arch_allow: riscv
  tags:
    - drivers
    - interrupt
    - riscv
    - imsic

tests:
  drivers.interrupt_controller.intc_riscv_imsic_miselect:
    platform_allow:
      - qemu_riscv32/qemu_virt_riscv32_aia
```
