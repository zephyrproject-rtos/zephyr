## tests/drivers/i3c/dual_board_loopback/controller_driven/i3c_target/Kconfig
```kconfig
# SPDX-FileCopyrightText: Copyright (c) 2026 Infineon Technologies AG,
# SPDX-FileCopyrightText: or an affiliate of Infineon Technologies AG. All rights reserved.
#
# SPDX-License-Identifier: Apache-2.0

mainmenu "I3C loopback test (target)"

source "Kconfig.zephyr"

menu "I3C loopback target bench options"

config I3C_DUAL_BOARD_LOOPBACK_TARGET_VENDOR_WRAPPER_GATE
	bool "Re-open vendor clock-gate register during SOFT_RST"
	help
	  Some DW I3C IP integrations gate the protocol clock through a
	  vendor wrapper register that must be re-opened before SOFT_RST
	  can self-clear.  Enable this option for those integrations and
	  set the wrapper register offset and write value below.

if I3C_DUAL_BOARD_LOOPBACK_TARGET_VENDOR_WRAPPER_GATE

config I3C_DUAL_BOARD_LOOPBACK_TARGET_WRAPPER_GATE_OFFSET
	hex "Vendor wrapper-gate register offset from controller base"
	default 0x400

config I3C_DUAL_BOARD_LOOPBACK_TARGET_WRAPPER_GATE_VALUE
	hex "Value to write to the wrapper-gate register"
	default 0x80000000

endif

config I3C_DUAL_BOARD_LOOPBACK_TARGET_SOFT_RST_CLEARS_DEVICE_ADDR
	bool "DW SOFT_RST already clears DEVICE_ADDR (default true)"
	default y
	help
	  On most DW I3C variants, SOFT_RST also clears the DEVICE_ADDR
	  register.  Disable this option for variants where the stale
	  dynamic address from a previous ENTDAA round survives SOFT_RST
	  — the target side will then explicitly zero DEVICE_ADDR after
	  the reset to avoid the target believing it already has a DA
	  during the next enumeration round.

endmenu
```

## tests/drivers/i3c/dual_board_loopback/target_driven/i3c_target/Kconfig
```kconfig
# SPDX-FileCopyrightText: Copyright (c) 2026 Infineon Technologies AG,
# SPDX-FileCopyrightText: or an affiliate of Infineon Technologies AG. All rights reserved.
#
# SPDX-License-Identifier: Apache-2.0

mainmenu "I3C loopback test (target)"

source "Kconfig.zephyr"

menu "I3C loopback target bench options"

config I3C_DUAL_BOARD_LOOPBACK_TARGET_VENDOR_WRAPPER_GATE
	bool "Re-open vendor clock-gate register during SOFT_RST"
	help
	  Some DW I3C IP integrations gate the protocol clock through a
	  vendor wrapper register that must be re-opened before SOFT_RST
	  can self-clear.  Enable this option for those integrations and
	  set the wrapper register offset and write value below.

if I3C_DUAL_BOARD_LOOPBACK_TARGET_VENDOR_WRAPPER_GATE

config I3C_DUAL_BOARD_LOOPBACK_TARGET_WRAPPER_GATE_OFFSET
	hex "Vendor wrapper-gate register offset from controller base"
	default 0x400

config I3C_DUAL_BOARD_LOOPBACK_TARGET_WRAPPER_GATE_VALUE
	hex "Value to write to the wrapper-gate register"
	default 0x80000000

endif

config I3C_DUAL_BOARD_LOOPBACK_TARGET_SOFT_RST_CLEARS_DEVICE_ADDR
	bool "DW SOFT_RST already clears DEVICE_ADDR (default true)"
	default y
	help
	  On most DW I3C variants, SOFT_RST also clears the DEVICE_ADDR
	  register.  Disable this option for variants where the stale
	  dynamic address from a previous ENTDAA round survives SOFT_RST
	  — the target side will then explicitly zero DEVICE_ADDR after
	  the reset to avoid the target believing it already has a DA
	  during the next enumeration round.

config I3C_DUAL_BOARD_LOOPBACK_TARGET_ALT_ADDR
	hex "Spare dynamic address for the address-change cases"
	default 0x40
	range 0x08 0x7d
	help
	  Address the SETNEWDA and SETDASA cases move the target to, and
	  then prove carries traffic.  Nothing else on the bus may answer
	  to it: it has to differ from the target's own static address,
	  from the controller's primary-controller-da, and from any
	  target sharing the bus.  Override it per board where the
	  default is taken.
endmenu
```

## tests/drivers/interrupt_controller/bcm2712_mip/Kconfig
```kconfig
# Copyright (c) 2026 Process Mission
# SPDX-License-Identifier: Apache-2.0

config NUM_IRQS
	int
	default 280
	help
	  IRQ limit used by the BCM2712 SoC routing code under test.

source "Kconfig.zephyr"
```

## tests/drivers/interrupt_controller/gicv3_its/Kconfig
```kconfig
# SPDX-FileCopyrightText: Copyright (c) 2026 Process Mission
# SPDX-License-Identifier: Apache-2.0

source "Kconfig.zephyr"

# Expose the driver's capacity settings for native tests.
config GIC_V3_ITS_MAX_DEVICES
	int "Maximum registered devices per controller"

config GIC_V3_ITS_MAX_VECTORS
	int "Maximum MSI vectors per device"

config NUM_IRQS
	int "Number of interrupts for ITS tests"
```

## tests/drivers/interrupt_controller/multi_level_backend/Kconfig
```kconfig
# Copyright (c) 2024 Meta
# SPDX-License-Identifier: Apache-2.0

if RISCV

config NUM_IRQS
	int
	# let's pretend that the level 1 supports 64 lines
	# (MAX_IRQ_PER_2ND_LEVEL_AGGREGATOR x NUM_2ND_LEVEL_AGGREGATORS) +
	# (MAX_IRQ_PER_3RD_LEVEL_AGGREGATOR x NUM_3RD_LEVEL_AGGREGATORS) + 64
	# (64 x 2) + (32 x 2) + 64 = 256, rounded up to 320
	default 320

endif # RISCV

config DUMP_INTC_TABLE
	bool "Enable to dump the content of intc table"

config TEST_ISR_TABLE_PLACEMENT
	bool "Build the tests in isr_table_placement.c"
	help
	  Check the slot gen_isr_tables.py places a statically connected handler
	  in against the slot z_get_sw_isr_table_idx() resolves it to at runtime.
	  Needs the aggregator offsets that the scenario enabling this sets, so
	  it is off by default.

source "Kconfig.zephyr"
```

## tests/drivers/interrupt_controller/ti_k3_intr_router/testcase.yaml
```yaml
# SPDX-License-Identifier: Apache-2.0

common:
  tags:
    - drivers
    - interrupt_controller
    - ti_k3

tests:
  drivers.interrupt_controller.ti_k3_intr_router:
    platform_allow:
      - mps2/an385
      - beagley_ai/j722s/main_r5f0_0
```

## tests/drivers/mipi_dbi/api/Kconfig
```kconfig
# Copyright (c) 2026 Hsiu-Chi Tsai
# SPDX-License-Identifier: Apache-2.0

config TEST_MULTIPLE_INSTANCES
	bool "Also test the mipi_dbi_1 instance"
	help
	  Run the tests on mipi_dbi_1 as well. Both instances have eight data
	  pins, so only the 8-bit 8080 mode is used.

source "Kconfig.zephyr"
```

## tests/drivers/modem/cellular_on_demand_connect/Kconfig
```kconfig
# Copyright (c) 2026 Leica Geosystems AG
# SPDX-License-Identifier: Apache-2.0

source "Kconfig.zephyr"

config TEST_ON_DEMAND_EARLY_ADMIN_UP
	bool "Admit the PPP interface before the modem finishes booting"
	depends on MODEM_CELLULAR_ON_DEMAND_CONNECT
	help
	  Selects the test variant that calls net_if_up() on the PPP interface
	  before the modem emulator is attached, so the NET_EVENT_IF_ADMIN_UP
	  edge arrives while the driver's state machine is still powering up and
	  cannot act on it. Covers the admin level being re-derived on entry to
	  the AWAIT_DIAL state.
```

## tests/drivers/modem/cellular_state_machine/dts/bindings/modem/zephyr,modem-cellular-test.yaml
```yaml
# Copyright (c) 2026 Embeint Inc
# SPDX-License-Identifier: Apache-2.0

description: Zephyr test cellular modem

compatible: "zephyr,modem-cellular-test"

include: zephyr,cellular-modem-device.yaml

properties:
  no-set-baudrate-script:
    type: boolean
    description: Omit the optional UART baud-rate configuration script

  no-network-script:
    type: boolean
    description: Omit the optional network registration script

  no-periodic-script:
    type: boolean
    description: Omit the optional periodic status script

  no-shutdown-script:
    type: boolean
    description: Omit the optional modem shutdown script

  no-dlci-setup-script:
    type: boolean
    description: Omit the optional DLCI setup script

  modem-info-script:
    type: boolean
    description: Query every modem info string as part of the init script

  startup-time-ms:
    type: int
    default: 1
    description: Time to wait for the modem ready indication after power on

  power-pulse-duration-ms:
    type: int
    default: 1
    description: Duration of the power key pulse

  reset-pulse-duration-ms:
    type: int
    default: 1
    description: Duration of the reset pulse

  cmux-disconnect-timeout-ms:
    type: int
    default: 1
    description: Time to wait for the modem to return to AT mode after CMUX disconnects

  shutdown-time-ms:
    type: int
    default: 1
    description: Time to wait for the modem to power off
```

## tests/drivers/mspi/api/boards/stm32h7b3i_dk.conf
```kconfig
# Copyright (c) 2026 Filip Stojanovic <filipembedded@gmail.com>
# SPDX-License-Identifier: Apache-2.0

CONFIG_LOG=y
CONFIG_MSPI_LOG_LEVEL_INF=y
```

## tests/drivers/mspi/api/boards/stm32h7s78_dk.conf
```kconfig
# Copyright (c) 2026 EXALT Technologies
# SPDX-License-Identifier: Apache-2.0

CONFIG_FLASH=y
CONFIG_MSPI_MEMMAP=y
```

## tests/drivers/mspi/api/boards/stm32h7s78_dk_mspi_psram.conf
```kconfig
# Copyright (c) 2026 EXALT Technologies
# SPDX-License-Identifier: Apache-2.0

CONFIG_MEMC=y
CONFIG_MSPI_MEMMAP=y
```

## tests/drivers/mspi/esp32/testcase.yaml
```yaml
# SPDX-License-Identifier: Apache-2.0
# SPDX-FileCopyrightText: Copyright The Zephyr Project Contributors

common:
  tags:
    - drivers
    - mspi
  platform_allow:
    - esp32s3_devkitc/esp32s3/procpu
  integration_platforms:
    - esp32s3_devkitc/esp32s3/procpu
  harness: ztest
tests:
  drivers.mspi.esp32.interrupt: {}
  drivers.mspi.esp32.polling:
    extra_configs:
      - CONFIG_MSPI_ESP32_INTERRUPT=n
    extra_args:
      - EXTRA_DTC_OVERLAY_FILE=polling.overlay
```

## tests/drivers/mspi/flash/boards/art_pi2.conf
```kconfig
# SPDX-FileCopyrightText: Copyright The Zephyr Project Contributors
# SPDX-License-Identifier: Apache-2.0

CONFIG_TEST_LOGGING_DEFAULTS=n
CONFIG_LOG=n
CONFIG_MSPI_DMA=n
```

## tests/drivers/mux/ch446q/dts/bindings/vnd,mux-consumer-test.yaml
```yaml
# SPDX-FileCopyrightText: Copyright The Zephyr Project Contributors
# SPDX-License-Identifier: Apache-2.0

description: |
  Consumer fixture for the CH446Q mux backend test. Carries mux-controls
  and mux-states pointing at the CH446Q controllers under test.

compatible: "vnd,mux-consumer-test"

include: [base.yaml, mux-consumer.yaml]
```
