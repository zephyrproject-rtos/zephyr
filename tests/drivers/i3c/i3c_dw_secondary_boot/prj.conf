## CMakeLists.txt
```
# SPDX-License-Identifier: Apache-2.0

cmake_minimum_required(VERSION 3.28.0)
find_package(Zephyr REQUIRED HINTS $ENV{ZEPHYR_BASE})
project(i3c_dw_secondary_boot)

target_sources(app PRIVATE src/main.c)
```

## prj.conf
```kconfig
# Copyright (c) 2026 Mark Tamas
# SPDX-License-Identifier: Apache-2.0

CONFIG_TEST=y
CONFIG_I3C=y
CONFIG_CLOCK_CONTROL=y
```

## boards/qemu_cortex_m3.conf
```kconfig
# Copyright (c) 2026 Mark Tamas
# SPDX-License-Identifier: Apache-2.0

CONFIG_CLOCK_CONTROL_FIXED_RATE_CLOCK=y
```

## boards/mec_assy6941_mec1653b_nsz.overlay
```dts
/*
 * Copyright (c) 2026 Mark Tamas
 *
 * SPDX-License-Identifier: Apache-2.0
 */

&i3c0 {
	pinctrl-0 = <&i3c00_scl_target_gpio140 &i3c00_sda_target_gpio132>;
	pinctrl-names = "default";

	secondary;
	static-address = <0x5a>;
	tgt-pid = <0x0246 0x456789ab>;
	bcr = <0x66>;
	dcr = <0x5a>;
	status = "okay";
};
```

## boards/qemu_cortex_m3.overlay
```dts
/*
 * Copyright (c) 2026 Mark Tamas
 *
 * SPDX-License-Identifier: Apache-2.0
 */

/ {
	test_fixed_clk: test-fixed-clock {
		compatible = "fixed-clock";
		clock-frequency = <200000000>;
		#clock-cells = <0>;
	};

	i3c1: i3c@cccccccc {
		compatible = "snps,designware-i3c";
		reg = <0xcccccccc 0x400>;
		#address-cells = <3>;
		#size-cells = <0>;
		interrupt-parent = <&nvic>;
		interrupts = <8 1>;
		clocks = <&test_fixed_clk>;
		i3c-scl-hz = <12500000>;
		i2c-scl-hz = <400000>;

		secondary;
		static-address = <0x5a>;
		tgt-pid = <0x0246 0x456789ab>;
		bcr = <0x66>;
		dcr = <0x5a>;
	};
};
```

## src/main.c
```c
/*
 * Copyright (c) 2026 Mark Tamas
 *
 * SPDX-License-Identifier: Apache-2.0
 */

/*
 * Build-only coverage for booting a dual-role snps,designware-i3c as a
 * target via the `secondary` devicetree property.  There is no emulator
 * for this IP, so the value is in the driver compiling and linking with
 * the property set, for both controller-enabled and target-only builds.
 */

int main(void)
{
	return 0;
}
```
