## tests/drivers/clock_control/stm32_clock_configuration/stm32h5_core/testcase.yaml
```yaml
common:
  timeout: 5
  tags: clock_control

tests:
  drivers.clock.stm32_clock_configuration.h5.sysclksrc_pll_csi_100:
    extra_args: DTC_OVERLAY_FILE="boards/clear_clocks.overlay;boards/pll_csi_100.overlay"
    platform_allow: stm32h573i_dk
  drivers.clock.stm32_clock_configuration.h5.sysclksrc_pll_csi_240:
    extra_args: DTC_OVERLAY_FILE="boards/clear_clocks.overlay;boards/pll_csi_240.overlay"
    platform_allow: stm32h573i_dk
  drivers.clock.stm32_clock_configuration.h5.sysclksrc_pll_hsi_240:
    extra_args: DTC_OVERLAY_FILE="boards/clear_clocks.overlay;boards/pll_hsi_240.overlay"
    platform_allow: stm32h573i_dk
  drivers.clock.stm32_clock_configuration.h5.sysclksrc_pll_hse25_100:
    extra_args: DTC_OVERLAY_FILE="boards/clear_clocks.overlay;boards/pll_hse25_100.overlay"
    platform_allow: stm32h573i_dk
  drivers.clock.stm32_clock_configuration.h5.sysclksrc_pll_hse25_240:
    extra_args: DTC_OVERLAY_FILE="boards/clear_clocks.overlay;boards/pll_hse25_240.overlay"
    platform_allow: stm32h573i_dk
  drivers.clock.stm32_clock_configuration.h5.sysclksrc_csi4:
    extra_args: DTC_OVERLAY_FILE="boards/clear_clocks.overlay;boards/csi4.overlay"
    platform_allow: stm32h573i_dk
  drivers.clock.stm32_clock_configuration.h5.sysclksrc_hse_25:
    extra_args: DTC_OVERLAY_FILE="boards/clear_clocks.overlay;boards/hse25.overlay"
    platform_allow: stm32h573i_dk
  drivers.clock.stm32_clock_configuration.h5.pll_csi_ahb_2_100:
    extra_args: DTC_OVERLAY_FILE="boards/clear_clocks.overlay;boards/pll_csi_ahb_2_100.overlay"
    platform_allow: stm32h573i_dk
  drivers.clock.stm32_clock_configuration.h5.pll_hse25_ahb_2_100:
    extra_args: DTC_OVERLAY_FILE="boards/clear_clocks.overlay;boards/pll_hse25_ahb_2_100.overlay"
    platform_allow: stm32h573i_dk
```

## tests/drivers/clock_control/stm32_clock_configuration/stm32h7/testcase.yaml
```yaml
common:
    timeout: 5
    platform_allow: nucleo_h723zg
tests:
  drivers.stm32_clock_configuration.h7.sysclksrc_pll_hse_96:
    extra_args: DTC_OVERLAY_FILE="boards/clear_clocks.overlay;boards/pll_hse_96.overlay"
  drivers.stm32_clock_configuration.h7.sysclksrc_pll_hsi_96:
    extra_args: DTC_OVERLAY_FILE="boards/clear_clocks.overlay;boards/pll_hsi_96.overlay"
  drivers.stm32_clock_configuration.h7.sysclksrc_hsi_64:
    extra_args: DTC_OVERLAY_FILE="boards/clear_clocks.overlay;boards/hsi_64.overlay"
  drivers.stm32_clock_configuration.h7.sysclksrc_csi_4:
    extra_args: DTC_OVERLAY_FILE="boards/clear_clocks.overlay;boards/csi_4.overlay"
  drivers.stm32_clock_configuration.h7.sysclksrc_hse_8:
    extra_args: DTC_OVERLAY_FILE="boards/clear_clocks.overlay;boards/hse_8.overlay"
  drivers.stm32_clock_configuration.h7.sysclksrc_pll_csi_96:
    extra_args: DTC_OVERLAY_FILE="boards/clear_clocks.overlay;boards/pll_csi_96.overlay"
  drivers.stm32_clock_configuration.h7.sysclksrc_pll_hse_550:
    extra_args: DTC_OVERLAY_FILE="boards/clear_clocks.overlay;boards/pll_hse_550.overlay"
    platform_allow: nucleo_h723zg stm32h735g_disco
```

## tests/drivers/clock_control/stm32_clock_configuration/stm32h7_core/testcase.yaml
```yaml
common:
    timeout: 5
tests:
  drivers.stm32_clock_configuration.h7_core.sysclksrc_pll_hse_96:
    extra_args: DTC_OVERLAY_FILE="boards/clear_clocks.overlay;boards/pll_hse_96.overlay"
    platform_allow: nucleo_h743zi
  drivers.stm32_clock_configuration.h7_core.sysclksrc_pll_hsi_96:
    extra_args: DTC_OVERLAY_FILE="boards/clear_clocks.overlay;boards/pll_hsi_96.overlay"
    platform_allow: nucleo_h743zi
  drivers.stm32_clock_configuration.h7_core.sysclksrc_hsi_64:
    extra_args: DTC_OVERLAY_FILE="boards/clear_clocks.overlay;boards/hsi_64.overlay"
    platform_allow: nucleo_h743zi
  drivers.stm32_clock_configuration.h7_core.sysclksrc_csi_4:
    extra_args: DTC_OVERLAY_FILE="boards/clear_clocks.overlay;boards/csi_4.overlay"
    platform_allow: nucleo_h743zi
  drivers.stm32_clock_configuration.h7_core.sysclksrc_hse_8:
    extra_args: DTC_OVERLAY_FILE="boards/clear_clocks.overlay;boards/hse_8.overlay"
    platform_allow: nucleo_h743zi
  drivers.stm32_clock_configuration.h7_core.sysclksrc_pll_csi_96:
    extra_args: DTC_OVERLAY_FILE="boards/clear_clocks.overlay;boards/pll_csi_96.overlay"
    platform_allow: nucleo_h743zi
  drivers.stm32_clock_configuration.h7_core.sysclksrc_pll_hse_550:
    extra_args: DTC_OVERLAY_FILE="boards/clear_clocks.overlay;boards/pll_hse_550.overlay"
    platform_allow: nucleo_h723zg stm32h735g_disco
```

## tests/drivers/clock_control/stm32_clock_configuration/stm32h7_devices/testcase.yaml
```yaml
common:
  timeout: 5
  platform_allow: nucleo_h723zg
tests:
  drivers.stm32_clock_configuration.h7_dev.spi1_pllq_1_d1ppre_1:
    extra_args: DTC_OVERLAY_FILE="boards/core_init.overlay;boards/spi1_pllq_1_d1ppre_1.overlay"
  drivers.stm32_clock_configuration.h7_dev.spi1_pllq_2_d1ppre_4:
    extra_args: DTC_OVERLAY_FILE="boards/core_init.overlay;boards/spi1_pllq_2_d1ppre_4.overlay"
  drivers.stm32_clock_configuration.h7_dev.spi1_pll2p_1:
    extra_args: DTC_OVERLAY_FILE="boards/core_init.overlay;boards/spi1_pll2p_1.overlay"
  drivers.stm32_clock_configuration.h7_dev.spi1_pll3p_1_d1ppre_4:
    extra_args: DTC_OVERLAY_FILE="boards/core_init.overlay;boards/spi1_pll3p_1_d1ppre_4.overlay"
  drivers.stm32_clock_configuration.h7_dev.spi1_per_ck_d1ppre_1:
    extra_args: DTC_OVERLAY_FILE="boards/core_init.overlay;boards/spi1_per_ck_d1ppre_1.overlay"
  drivers.stm32_clock_configuration.h7_dev.spi1_per_ck_hsi:
    extra_args: DTC_OVERLAY_FILE="boards/core_init.overlay;boards/spi1_per_ck_hsi.overlay"
  drivers.stm32_clock_configuration.h7_dev.spi1_per_ck_hse:
    extra_args: DTC_OVERLAY_FILE="boards/core_init.overlay;boards/spi1_per_ck_hse.overlay"
```

## tests/drivers/clock_control/stm32_clock_configuration/stm32u5_core/testcase.yaml
```yaml
common:
  timeout: 5
  platform_allow: b_u585i_iot02a
tests:
  drivers.stm32_clock_configuration.u5.sysclksrc_pll_msis_160:
    extra_args: DTC_OVERLAY_FILE="boards/clear_clocks.overlay;boards/pll_msis_160.overlay"
  drivers.stm32_clock_configuration.u5.pll_msis_ahb_2_40:
    extra_args: DTC_OVERLAY_FILE="boards/clear_clocks.overlay;boards/pll_msis_ahb_2_40.overlay"
  drivers.stm32_clock_configuration.u5.sysclksrc_pll_hsi_160:
    extra_args: DTC_OVERLAY_FILE="boards/clear_clocks.overlay;boards/pll_hsi_160.overlay"
  drivers.stm32_clock_configuration.u5.sysclksrc_pll_hsi_40:
    extra_args: DTC_OVERLAY_FILE="boards/clear_clocks.overlay;boards/pll_hsi_40.overlay"
  drivers.stm32_clock_configuration.u5.sysclksrc_msis_48:
    extra_args: DTC_OVERLAY_FILE="boards/clear_clocks.overlay;boards/msis_48.overlay"
  drivers.stm32_clock_configuration.u5.sysclksrc_msis_24:
    extra_args: DTC_OVERLAY_FILE="boards/clear_clocks.overlay;boards/msis_24.overlay"
  drivers.stm32_clock_configuration.u5.sysclksrc_hsi_16:
    extra_args: DTC_OVERLAY_FILE="boards/clear_clocks.overlay;boards/hsi_16.overlay"
  drivers.stm32_clock_configuration.u5.sysclksrc_hse_16:
    extra_args: DTC_OVERLAY_FILE="boards/clear_clocks.overlay;boards/hse_16.overlay"
    # Build only as HSE not implemened on available boards
    build_only: true
  drivers.stm32_clock_configuration.u5.sysclksrc_pll_hse_160:
    extra_args: DTC_OVERLAY_FILE="boards/clear_clocks.overlay;boards/pll_hse_160.overlay"
    # Build only as HSE not implemened on available boards
    build_only: true
```

## tests/drivers/clock_control/stm32_clock_configuration/stm32u5_devices/testcase.yaml
```yaml
common:
  timeout: 5
  platform_allow: b_u585i_iot02a
tests:
  drivers.stm32_clock_configuration.dev_u5.spi1_pclk2:
    extra_args: DTC_OVERLAY_FILE="boards/core_init.overlay;boards/spi1_pclk2.overlay"
  drivers.stm32_clock_configuration.dev_u5.spi1_hsi_16:
    extra_args: DTC_OVERLAY_FILE="boards/core_init.overlay;boards/spi1_hsi_16.overlay"
  drivers.stm32_clock_configuration.dev_u5.spi1_msik:
    extra_args: DTC_OVERLAY_FILE="boards/core_init.overlay;boards/spi1_msik.overlay"
  drivers.stm32_clock_configuration.dev_u5.spi1_sysclk:
    extra_args: DTC_OVERLAY_FILE="boards/core_init.overlay;boards/spi1_sysclk.overlay"
```

## tests/drivers/clock_control/stm32_clock_configuration/stm32wba_core/testcase.yaml
```yaml
common:
  timeout: 5
  platform_allow: nucleo_wba52cg
tests:
  drivers.clock.stm32_clock_configuration.wba.sysclksrc_hsi_32:
    extra_args: DTC_OVERLAY_FILE="boards/clear_clocks.overlay;boards/hsi_16.overlay"
  drivers.clock.stm32_clock_configuration.wba.sysclksrc_hsi_32_ahb5_div:
    extra_args: DTC_OVERLAY_FILE="boards/clear_clocks.overlay;boards/hsi_16_ahb5_div.overlay"
  drivers.clock.stm32_clock_configuration.wba.sysclksrc_hse_16:
    extra_args: DTC_OVERLAY_FILE="boards/clear_clocks.overlay;boards/hse_16.overlay"
  drivers.clock.stm32_clock_configuration.wba.sysclksrc_hse_32:
    extra_args: DTC_OVERLAY_FILE="boards/clear_clocks.overlay;boards/hse_32.overlay"
  drivers.clock.stm32_clock_configuration.wba.sysclksrc_pll_hse_100:
    extra_args: DTC_OVERLAY_FILE="boards/clear_clocks.overlay;boards/pll_hse_100.overlay"
  drivers.clock.stm32_clock_configuration.wba.sysclksrc_pll_hse_50:
    extra_args: DTC_OVERLAY_FILE="boards/clear_clocks.overlay;boards/pll_hse_100_ahb_50.overlay"
```

## tests/drivers/clock_control/stm32_clock_configuration/testcase.yaml
```yaml
tests:
  drivers.stm32_clock_configuration.u5.sysclksrc_pll_msis_160:
    timeout: 5
    platform_allow: b_u585i_iot02a
  drivers.stm32_clock_configuration.u5.sysclksrc_pll_msis_80:
    extra_args: DTC_OVERLAY_FILE=boards/b_u585i_iot02a_pll_msi_80.overlay
    timeout: 5
    platform_allow: b_u585i_iot02a
  drivers.stm32_clock_configuration.u5.sysclksrc_pll_hsi_160:
    extra_args: DTC_OVERLAY_FILE=boards/b_u585i_iot02a_pll_hsi_160.overlay
    platform_allow: b_u585i_iot02a
    timeout: 5
  drivers.stm32_clock_configuration.u5.sysclksrc_pll_hsi_40:
    extra_args: DTC_OVERLAY_FILE=boards/b_u585i_iot02a_pll_hsi_40.overlay
    platform_allow: b_u585i_iot02a
    timeout: 5
  drivers.stm32_clock_configuration.u5.sysclksrc_msis_48:
    extra_args: DTC_OVERLAY_FILE=boards/b_u585i_iot02a_msis_48.overlay
    platform_allow: b_u585i_iot02a
    timeout: 5
  drivers.stm32_clock_configuration.u5.sysclksrc_msis_24:
    extra_args: DTC_OVERLAY_FILE=boards/b_u585i_iot02a_msis_24.overlay
    platform_allow: b_u585i_iot02a
    timeout: 5
  drivers.stm32_clock_configuration.u5.sysclksrc_pll_hse_160:
    extra_args: DTC_OVERLAY_FILE=boards/nucleo_u575zi_q_pll_hse_160.overlay
    timeout: 5
    platform_allow: nucleo_u575zi_q
    build_only: true # Build only as HSE not implemened on the board
```

## tests/drivers/clock_management/clock_management_api/dts/bindings/vnd,emul-clock-div.yaml
```yaml
# Copyright 2024 NXP
#
# SPDX-License-Identifier: Apache-2.0

description: |
  Binding for emulated clock divider node. This divider will divide
  the input clock by an integer value, up to the max divider value set
  for the node. The node accepts one specifier, the integer value to divide
  the clock by.

compatible: "vnd,emul-clock-div"

include: [clock-node.yaml]

properties:
  max-div:
    type: int
    required: true
    description: |
      Maximum divider value this node can support.

  input:
    type: phandle
    required: true
    description: |
      Clock node that is the input to this clock gate.

  "#clock-cells":
    const: 1

clock-cells:
  - divider
```

## tests/drivers/clock_management/clock_management_api/dts/bindings/vnd,emul-clock-gateable.yaml
```yaml
# Copyright (c) 2025, Tenstorrent AI ULC
#
# SPDX-License-Identifier: Apache-2.0

description: |
  Binding for emulated clock gate node. This clock node simply can be turned on
  and off, and is used within the API test to verify the framework functions
  correctly.

compatible: "vnd,emul-clock-gateable"

include: [clock-node.yaml]

properties:
  input:
    type: phandle
    required: true
    description: |
      Clock node that is the input to this clock gate.

  "#clock-cells":
    const: 0
```

## tests/drivers/clock_management/clock_management_api/testcase.yaml
```yaml
tests:
  drivers.clock_management.api:
    tags:
      - drivers
      - clock_management
    integration_platforms:
      - native_sim
    filter: dt_compat_enabled("vnd,emul-clock-consumer")
```

## tests/drivers/clock_management/clock_management_hw/testcase.yaml
```yaml
tests:
  drivers.clock_management.hw:
    tags:
      - drivers
      - clock_management
    integration_platforms:
      - lpcxpresso55s69/lpc55s69/cpu0
    filter: dt_compat_enabled("vnd,emul-clock-consumer")
```

## tests/drivers/clock_management/clock_management_minimal/dts/bindings/vnd,emul-clock-mux.yaml
```yaml
# Copyright 2024 NXP
#
# SPDX-License-Identifier: Apache-2.0

description: |
  Binding for emulated clock multiplexer node. This multiplexer will select
  an input clock from the clock nodes provided in the "input" property.
  The node accepts one specifier, the integer index (0 based) of the input
  to select.

compatible: "vnd,emul-clock-mux"

include: [clock-node.yaml]

properties:
  inputs:
    type: phandles
    required: true
    description: |
      Input clock sources available for this multiplexer.

  "#clock-cells":
    const: 1

clock-cells:
  - multiplexer
```

## tests/drivers/clock_management/common/dts/bindings/vnd,emul-clock-div.yaml
```yaml
# Copyright 2024 NXP
#
# SPDX-License-Identifier: Apache-2.0

description: |
  Binding for emulated clock divider node. This divider will divide
  the input clock by an integer value, up to the max divider value set
  for the node. The node accepts one specifier, the integer value to divide
  the clock by.

compatible: "vnd,emul-clock-div"

include: [clock-node.yaml]

properties:
  max-div:
    type: int
    required: true
    description: |
      Maximum divider value this node can support.

  "#clock-cells":
    const: 1

clock-cells:
  - divider
```

## tests/drivers/clock_mgmt/clock_mgmt_api/dts/bindings/vnd,emul-clock-consumer.yaml
```yaml
# Copyright 2024 NXP
#
# SPDX-License-Identifier: Apache-2.0

description: |
  Binding for emulated clock consumer device. This device is used in testing
  to verify that clock states are applied as expected.

compatible: "vnd,emul-clock-consumer"

include: [clock-device.yaml]

properties:
  default-freq:
    type: int
    required: true
    description: |
      Frequency this consumer expects to read when applying default clock
      management state

  shared-freq:
    type: int
    required: true
    description: |
      Frequency this consumer expects to read when applying shared clock
      management state

  setrate-freq:
    type: int
    required: true
    description: |
      Frequency this consumer expects to read when applying setrate clock
      management state

  setrate1-freq:
    type: int
    required: true
    description: |
      Frequency this consumer expects to read when applying setrate1 clock
      management state
```

## tests/drivers/clock_mgmt/clock_mgmt_api/testcase.yaml
```yaml
tests:
  drivers.clock_mgmt.api:
    tags:
      - drivers
      - clock_mgmt
    integration_platforms:
      - native_sim
    filter: dt_compat_enabled("vnd,emul-clock-consumer")
```
