## tests/drivers/clock_control/stm32_clock_configuration/stm32_common_core/testcase.yaml
```yaml
# Note: On most ST development boards, external clock "HSE 8MHz" is provided thanks to ST-Link
# via its MCO line. On some boards, ST-Link MCO sloder brigde is not set out of the box.
# To reflect this constraint on such boards, a specific fixture "mco_sb_closed" is provided.
# To run HSE tests on these boards:
# - add the sloder bridge
# - add the fixture in map file
common:
  timeout: 5
  tags:
    - clock_control
tests:
  drivers.clock.stm32_clock_configuration.common_core.l4_l5.sysclksrc_pll_48_msi_4:
    extra_args:
      DTC_OVERLAY_FILE="boards/clear_clocks.overlay;boards/clear_msi.overlay;boards/pll_48_msi_4.overlay"
    platform_allow:
      - disco_l475_iot1/stm32l475xx
      - nucleo_l4r5zi/stm32l4r5xx
      - stm32l562e_dk/stm32l562xx
    integration_platforms:
      - disco_l475_iot1/stm32l475xx
  drivers.clock.stm32_clock_configuration.common_core.l4_l5.sysclksrc_pll_64_hsi_16:
    extra_args:
      DTC_OVERLAY_FILE="boards/clear_clocks.overlay;boards/clear_msi.overlay;boards/pll_64_hsi_16.overlay"
    platform_allow:
      - disco_l475_iot1/stm32l475xx
      - nucleo_l4r5zi/stm32l4r5xx
      - stm32l562e_dk/stm32l562xx
    integration_platforms:
      - disco_l475_iot1/stm32l475xx
  drivers.clock.stm32_clock_configuration.common_core.sysclksrc_hsi_16:
    extra_args:
      DTC_OVERLAY_FILE="boards/clear_clocks.overlay;boards/clear_msi.overlay;boards/hsi_16.overlay"
    platform_allow:
      - disco_l475_iot1/stm32l475xx
      - nucleo_l4r5zi/stm32l4r5xx
      - stm32l562e_dk/stm32l562xx
      - nucleo_wb55rg/stm32wb55xx
      - nucleo_wl55jc/stm32wl55xx
    integration_platforms:
      - disco_l475_iot1/stm32l475xx
  drivers.clock.stm32_clock_configuration.common_core.sysclksrc_msi_48:
    extra_args:
      DTC_OVERLAY_FILE="boards/clear_clocks.overlay;boards/clear_msi.overlay;boards/msi_range11.overlay"
    platform_allow:
      - disco_l475_iot1/stm32l475xx
      - nucleo_l4r5zi/stm32l4r5xx
      - stm32l562e_dk/stm32l562xx
      - nucleo_wl55jc/stm32wl55xx
      - nucleo_wb55rg/stm32wb55xx
    integration_platforms:
      - disco_l475_iot1/stm32l475xx
  drivers.clock.stm32_clock_configuration.common_core.l4_l5.sysclksrc_hse_8.fixup:
    extra_args:
      DTC_OVERLAY_FILE="boards/clear_clocks.overlay;boards/clear_msi.overlay;boards/hse_8.overlay"
    platform_allow:
      - disco_l475_iot1/stm32l475xx
      - nucleo_l4r5zi/stm32l4r5xx
      - stm32l562e_dk/stm32l562xx
    harness: ztest
    harness_config:
      fixture: mco_sb_closed
    integration_platforms:
      - disco_l475_iot1/stm32l475xx
  drivers.clock.stm32_clock_configuration.common_core.l4_l5.sysclksrc_pll_64_hse_8.fixup:
    extra_args:
      DTC_OVERLAY_FILE="boards/clear_clocks.overlay;boards/clear_msi.overlay;boards/pll_64_hse_8.overlay"
    platform_allow:
      - disco_l475_iot1/stm32l475xx
      - nucleo_l4r5zi/stm32l4r5xx
      - stm32l562e_dk/stm32l562xx
    harness: ztest
    harness_config:
      fixture: mco_sb_closed
    integration_platforms:
      - disco_l475_iot1/stm32l475xx
  drivers.clock.stm32_clock_configuration.common_core.g0.sysclksrc_pll_64_hse_8:
    extra_args: DTC_OVERLAY_FILE="boards/clear_clocks.overlay;boards/pll_64_hse_8.overlay"
    platform_allow: nucleo_g071rb/stm32g071xx
    harness: ztest
    harness_config:
      fixture: mco_sb_closed
    integration_platforms:
      - nucleo_g071rb/stm32g071xx
  drivers.clock.stm32_clock_configuration.common_core.g0.sysclksrc_hsi_g0_16_div_2:
    extra_args: DTC_OVERLAY_FILE="boards/clear_clocks.overlay;boards/hsi_g0_16_div_2.overlay"
    platform_allow: nucleo_g071rb/stm32g071xx
    integration_platforms:
      - nucleo_g071rb/stm32g071xx
  drivers.clock.stm32_clock_configuration.common_core.g0.sysclksrc_hsi_g0_16_div_4:
    extra_args: DTC_OVERLAY_FILE="boards/clear_clocks.overlay;boards/hsi_g0_16_div_4.overlay"
    platform_allow: nucleo_g071rb/stm32g071xx
    integration_platforms:
      - nucleo_g071rb/stm32g071xx
  drivers.clock.stm32_clock_configuration.common_core.g4.sysclksrc_pll_64_hsi_16:
    extra_args: DTC_OVERLAY_FILE="boards/clear_clocks.overlay;boards/pll_64_hsi_16.overlay"
    platform_allow: nucleo_g474re/stm32g474xx
    integration_platforms:
      - nucleo_g474re/stm32g474xx
  drivers.clock.stm32_clock_configuration.common_core.g0.sysclksrc_pll_g0_64_hsi_16:
    extra_args: DTC_OVERLAY_FILE="boards/clear_clocks.overlay;boards/pll_g0_64_hsi_16.overlay"
    platform_allow: nucleo_g071rb/stm32g071xx
    integration_platforms:
      - nucleo_g071rb/stm32g071xx
  drivers.clock.stm32_clock_configuration.common_core.g4.sysclksrc_hsi_16:
    extra_args: DTC_OVERLAY_FILE="boards/clear_clocks.overlay;boards/hsi_16.overlay"
    platform_allow: nucleo_g474re/stm32g474xx
    integration_platforms:
      - nucleo_g474re/stm32g474xx
  drivers.clock.stm32_clock_configuration.common_core.g0.sysclksrc_hsi_g0_16:
    extra_args: DTC_OVERLAY_FILE="boards/clear_clocks.overlay;boards/hsi_g0_16.overlay"
    platform_allow: nucleo_g071rb/stm32g071xx
    integration_platforms:
      - nucleo_g071rb/stm32g071xx
  drivers.clock.stm32_clock_configuration.common_core.g4.sysclksrc_hse_24:
    extra_args: DTC_OVERLAY_FILE="boards/clear_clocks.overlay;boards/hse_24.overlay"
    platform_allow: nucleo_g474re/stm32g474xx
  drivers.clock.stm32_clock_configuration.common_core.g4.sysclksrc_hse_24.css:
    extra_args:
      DTC_OVERLAY_FILE="boards/clear_clocks.overlay;boards/hse_24.overlay;boards/hse_css.overlay"
    platform_allow: nucleo_g474re/stm32g474xx
  drivers.clock.stm32_clock_configuration.common_core.l0_l1.sysclksrc_hse_8:
    extra_args:
      DTC_OVERLAY_FILE="boards/clear_clocks.overlay;boards/clear_msi.overlay;boards/hse_8.overlay"
    platform_allow:
      - nucleo_l152re/stm32l152xe
      - nucleo_l073rz/stm32l073xx
    integration_platforms:
      - nucleo_l152re/stm32l152xe
  drivers.clock.stm32_clock_configuration.common_core.l0_l1.sysclksrc_pll_32_hse_8:
    extra_args: DTC_OVERLAY_FILE="boards/clear_clocks.overlay;boards/pll_32_hse_8.overlay"
    platform_allow:
      - nucleo_l152re/stm32l152xe
      - nucleo_l073rz/stm32l073xx
    integration_platforms:
      - nucleo_l152re/stm32l152xe
  drivers.clock.stm32_clock_configuration.common_core.l0_l1.sysclksrc_pll_32_hsi_16:
    extra_args: DTC_OVERLAY_FILE="boards/clear_clocks.overlay;boards/pll_32_hsi_16.overlay"
    platform_allow:
      - nucleo_l152re/stm32l152xe
      - nucleo_l073rz/stm32l073xx
    integration_platforms:
      - nucleo_l152re/stm32l152xe
  drivers.clock.stm32_clock_configuration.common_core.l0_l1.sysclksrc_msi_range6:
    extra_args: DTC_OVERLAY_FILE="boards/clear_clocks.overlay;boards/msi_range6.overlay"
    platform_allow:
      - nucleo_l152re/stm32l152xe
      - nucleo_l073rz/stm32l073xx
    integration_platforms:
      - nucleo_l152re/stm32l152xe
  drivers.clock.stm32_clock_configuration.common_core.wl.sysclksrc_pll_48_hsi_16:
    extra_args: DTC_OVERLAY_FILE="boards/clear_clocks.overlay;boards/pll_48_hsi_16.overlay"
    platform_allow: nucleo_wl55jc/stm32wl55xx
    integration_platforms:
      - nucleo_wl55jc/stm32wl55xx
  drivers.clock.stm32_clock_configuration.common_core.wl.sysclksrc_pll_48_hse_32:
    extra_args: DTC_OVERLAY_FILE="boards/clear_clocks.overlay;boards/wl_pll_48_hse_32.overlay"
    platform_allow: nucleo_wl55jc/stm32wl55xx
    integration_platforms:
      - nucleo_wl55jc/stm32wl55xx
  drivers.clock.stm32_clock_configuration.common_core.wl.sysclksrc_hse_32:
    extra_args: DTC_OVERLAY_FILE="boards/clear_clocks.overlay;boards/wl_32_hse.overlay"
    platform_allow: nucleo_wl55jc/stm32wl55xx
    integration_platforms:
      - nucleo_wl55jc/stm32wl55xx
  drivers.clock.stm32_clock_configuration.common_core.wb.sysclksrc_hse_32:
    extra_args: DTC_OVERLAY_FILE="boards/clear_clocks.overlay;boards/hse_32.overlay"
    platform_allow: nucleo_wb55rg/stm32wb55xx
    integration_platforms:
      - nucleo_wb55rg/stm32wb55xx
  drivers.clock.stm32_clock_configuration.common_core.wb.sysclksrc_pll_48_hsi_16:
    extra_args: DTC_OVERLAY_FILE="boards/clear_clocks.overlay;boards/wb_pll_48_hsi_16.overlay"
    platform_allow: nucleo_wb55rg/stm32wb55xx
    integration_platforms:
      - nucleo_wb55rg/stm32wb55xx
  drivers.clock.stm32_clock_configuration.common_core.wb.sysclksrc_pll_64_hse_32:
    extra_args: DTC_OVERLAY_FILE="boards/clear_clocks.overlay;boards/wb_pll_64_hse_32.overlay"
    platform_allow: nucleo_wb55rg/stm32wb55xx
    integration_platforms:
      - nucleo_wb55rg/stm32wb55xx
  drivers.clock.stm32_clock_configuration.common_core.wb.sysclksrc_pll_48_msi_4:
    extra_args: DTC_OVERLAY_FILE="boards/clear_clocks.overlay;boards/wb_pll_48_msi_4.overlay"
    platform_allow: nucleo_wb55rg/stm32wb55xx
    integration_platforms:
      - nucleo_wb55rg/stm32wb55xx
  drivers.clock.stm32_clock_configuration.common_core.f0_f3.sysclksrc_hsi_8:
    extra_args: DTC_OVERLAY_FILE="boards/clear_f0_f1_f3_clocks.overlay;boards/hsi_8.overlay"
    platform_allow:
      - nucleo_f091rc/stm32f091xc
      - stm32f3_disco/stm32f303xc
    integration_platforms:
      - nucleo_f091rc/stm32f091xc
  drivers.clock.stm32_clock_configuration.common_core.f0_f3.sysclksrc_hse_8:
    extra_args: DTC_OVERLAY_FILE="boards/clear_f0_f1_f3_clocks.overlay;boards/hse_8_bypass.overlay"
    platform_allow:
      - nucleo_f091rc/stm32f091xc
      - stm32f3_disco/stm32f303xc
    integration_platforms:
      - nucleo_f091rc/stm32f091xc
  drivers.clock.stm32_clock_configuration.common_core.f0_f3.sysclksrc_pll_32_hsi_8:
    extra_args:
      DTC_OVERLAY_FILE="boards/clear_f0_f1_f3_clocks.overlay;boards/f0_f3_pll_32_hsi_8.overlay"
    platform_allow:
      - nucleo_f091rc/stm32f091xc
      - stm32f3_disco/stm32f303xc
    integration_platforms:
      - nucleo_f091rc/stm32f091xc
  drivers.clock.stm32_clock_configuration.common_core.f0_f3.sysclksrc_pll_32_hse_8:
    extra_args:
      DTC_OVERLAY_FILE="boards/clear_f0_f1_f3_clocks.overlay;boards/f0_f3_pll_32_hse_8.overlay"
    platform_allow:
      - nucleo_f091rc/stm32f091xc
      - stm32f3_disco/stm32f303xc
    integration_platforms:
      - nucleo_f091rc/stm32f091xc
  drivers.clock.stm32_clock_configuration.common_core.f1.sysclksrc_hsi_8:
    extra_args: DTC_OVERLAY_FILE="boards/clear_f0_f1_f3_clocks.overlay;boards/hsi_8.overlay"
    platform_allow: nucleo_f103rb/stm32f103xb
    integration_platforms:
      - nucleo_f103rb/stm32f103xb
  drivers.clock.stm32_clock_configuration.common_core.f1.sysclksrc_hse_8:
    extra_args: DTC_OVERLAY_FILE="boards/clear_f0_f1_f3_clocks.overlay;boards/hse_8.overlay"
    platform_allow: nucleo_f103rb/stm32f103xb
    integration_platforms:
      - nucleo_f103rb/stm32f103xb
  drivers.clock.stm32_clock_configuration.common_core.f1.sysclksrc_pll_64_hsi_8:
    extra_args:
      DTC_OVERLAY_FILE="boards/clear_f0_f1_f3_clocks.overlay;boards/f1_pll_64_hsi_8.overlay"
    platform_allow: nucleo_f103rb/stm32f103xb
    integration_platforms:
      - nucleo_f103rb/stm32f103xb
  drivers.clock.stm32_clock_configuration.common_core.f1.sysclksrc_pll_64_hse_8:
    extra_args:
      DTC_OVERLAY_FILE="boards/clear_f0_f1_f3_clocks.overlay;boards/f1_pll_64_hse_8.overlay"
    platform_allow: nucleo_f103rb/stm32f103xb
    integration_platforms:
      - nucleo_f103rb/stm32f103xb
  drivers.clock.stm32_clock_configuration.common_core.f2_f4_f7.sysclksrc_hsi_16:
    extra_args: DTC_OVERLAY_FILE="boards/clear_f2_f4_f7_clocks.overlay;boards/hsi_16.overlay"
    platform_allow:
      - nucleo_f207zg/stm32f207xx
      - nucleo_f429zi/stm32f429xx
      - nucleo_f446re/stm32f446xx
      - nucleo_f746zg/stm32f746xx
    integration_platforms:
      - nucleo_f207zg/stm32f207xx
  drivers.clock.stm32_clock_configuration.common_core.f2_f4_f7.sysclksrc_hse_8:
    extra_args: DTC_OVERLAY_FILE="boards/clear_f2_f4_f7_clocks.overlay;boards/hse_8.overlay"
    platform_allow:
      - nucleo_f207zg/stm32f207xx
      - nucleo_f429zi/stm32f429xx
      - nucleo_f446re/stm32f446xx
      - nucleo_f746zg/stm32f746xx
    integration_platforms:
      - nucleo_f207zg/stm32f207xx
  drivers.clock.stm32_clock_configuration.common_core.f2_f4_f7.sysclksrc_pll_64_hsi_16:
    extra_args:
      DTC_OVERLAY_FILE="boards/clear_f2_f4_f7_clocks.overlay;boards/f2_f4_f7_pll_64_hsi_16.overlay"
    platform_allow:
      - nucleo_f207zg/stm32f207xx
      - nucleo_f429zi/stm32f429xx
      - nucleo_f446re/stm32f446xx
      - nucleo_f746zg/stm32f746xx
    integration_platforms:
      - nucleo_f207zg/stm32f207xx
  drivers.clock.stm32_clock_configuration.common_core.f2_f4_f7.sysclksrc_pll_64_hse_8:
    extra_args:
      DTC_OVERLAY_FILE="boards/clear_f2_f4_f7_clocks.overlay;boards/f2_f4_f7_pll_64_hse_8.overlay"
    platform_allow:
      - nucleo_f207zg/stm32f207xx
      - nucleo_f429zi/stm32f429xx
      - nucleo_f446re/stm32f446xx
      - nucleo_f746zg/stm32f746xx
    integration_platforms:
      - nucleo_f207zg/stm32f207xx
  drivers.clock.stm32_clock_configuration.common_core.f2_f4_f7.sysclksrc_pll_100_hsi_16_ahb2:
    extra_args:
      DTC_OVERLAY_FILE="boards/clear_f2_f4_f7_clocks.overlay;boards/f2_f4_f7_pll_100_hsi_16_ahb_2.overlay"
    platform_allow:
      - nucleo_f207zg/stm32f207xx
      - nucleo_f429zi/stm32f429xx
      - nucleo_f446re/stm32f446xx
      - nucleo_f746zg/stm32f746xx
    integration_platforms:
      - nucleo_f207zg/stm32f207xx
```

## tests/drivers/clock_control/stm32_clock_configuration/stm32_common_devices/testcase.yaml
```yaml
common:
  timeout: 5
tests:
  drivers.clock.stm32_clock_configuration.common_device.wb.i2c1_hsi_lptim1_lse:
    extra_args: DTC_OVERLAY_FILE="boards/wb_i2c1_hsi_lptim1_lse.overlay"
    platform_allow: nucleo_wb55rg
  drivers.clock.stm32_clock_configuration.common_device.wb.i2c1_sysclk_lptim1_lsi:
    extra_args: DTC_OVERLAY_FILE="boards/wb_i2c1_sysclk_lptim1_lsi.overlay"
    platform_allow: nucleo_wb55rg
  drivers.clock.stm32_clock_configuration.common_device.g0.i2c1_sysclk_lptim1_lsi:
    extra_args: DTC_OVERLAY_FILE="boards/g0_i2c1_sysclk_lptim1_lsi.overlay"
    platform_allow: nucleo_g071rb
  drivers.clock.stm32_clock_configuration.common_device.g0.i2c1_hsi_lptim1_lse_adc1_pllp:
    extra_args: DTC_OVERLAY_FILE="boards/g0_i2c1_hsi_lptim1_lse_adc1_pllp.overlay"
    platform_allow: nucleo_g071rb
  drivers.clock.stm32_clock_configuration.common_device.wl.i2c1_hsi_lptim1_lse_adc1_pllp:
    extra_args: DTC_OVERLAY_FILE="boards/wl_i2c1_hsi_lptim1_lse_adc1_pllp.overlay"
    platform_allow: nucleo_wl55jc
  drivers.clock.stm32_clock_configuration.common_device.wl.i2c1_sysclk_lptim1_lsi:
    extra_args: DTC_OVERLAY_FILE="boards/wl_i2c1_sysclk_lptim1_lsi.overlay"
    platform_allow: nucleo_wl55jc
  drivers.clock.stm32_clock_configuration.common_device.l4.i2c1_sysclk_lptim1_lsi:
    extra_args: DTC_OVERLAY_FILE="boards/l4_i2c1_sysclk_lptim1_lsi.overlay"
    platform_allow: disco_l475_iot1
  drivers.clock.stm32_clock_configuration.common_device.l4.i2c1_hsi_lptim1_lse:
    extra_args: DTC_OVERLAY_FILE="boards/l4_i2c1_hsi_lptim1_lse.overlay"
    platform_allow: disco_l475_iot1
  drivers.clock.stm32_clock_configuration.common_device.g4.i2c1_hsi_adc1_pllp:
    extra_args: DTC_OVERLAY_FILE="boards/g4_i2c1_hsi_adc1_pllp.overlay"
    platform_allow: nucleo_g474re
  drivers.clock.stm32_clock_configuration.common_device.f0.i2c1_hsi:
    extra_args: DTC_OVERLAY_FILE="boards/f0_i2c1_hsi.overlay"
    platform_allow: nucleo_f091rc
  drivers.clock.stm32_clock_configuration.common_device.f3.i2c1_hsi:
    extra_args: DTC_OVERLAY_FILE="boards/f3_i2c1_hsi.overlay"
    platform_allow: stm32f3_disco
```

## tests/drivers/clock_control/stm32_clock_configuration/stm32c5_core/Kconfig
```kconfig
# STM32C5 clock test configuration options

# Copyright (c) 2026 STMicroelectronics
# SPDX-License-Identifier: Apache-2.0

config CLOCK_CFG_USE_STM32_HAL_RCC
	bool "Use HAL RCC"
	default y
	select USE_STM32_HAL_RCC

source "Kconfig.zephyr"
```
