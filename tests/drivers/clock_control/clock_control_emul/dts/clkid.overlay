/*
 * SPDX-FileCopyrightText: Copyright (c) 2026 TOKITA Hiroshi
 * SPDX-License-Identifier: Apache-2.0
 */

/ {
	test_clk: clock-controller {
		compatible = "zephyr,clock-controller-emul-clkid";
		#clock-cells = <1>;
		clock-ids = <11 12>;
		clock-initial-values = <12000000 24000000>;
	};
};
