/*
 * SPDX-FileCopyrightText: Copyright (c) 2024 Infineon Technologies AG,
 * SPDX-FileCopyrightText: or an affiliate of Infineon Technologies AG. All rights reserved.
 * SPDX-FileCopyrightText: Copyright (c) 2026 Linumiz
 *
 * SPDX-License-Identifier: Apache-2.0
 */

/* Expected rates: fPLL0 300 MHz, fPLL2 200 MHz */
/ {
	zephyr,user {
		sri-hz = <300000000>;
		spb-hz = <100000000>;
		fsi-hz = <100000000>;
		stm-hz = <100000000>;
		asclinf-hz = <200000000>;
	};
};
