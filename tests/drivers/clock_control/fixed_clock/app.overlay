/*
 * Copyright (c) 2022 Google, LLC
 *
 * SPDX-License-Identifier: Apache-2.0
 *
 */

/ {
	test {
		test_fixed_rate_clk0: clk {
			compatible = "fixed-clock";
			clock-frequency = <100>;
			#clock-cells = <0>;
		};
	};
};
