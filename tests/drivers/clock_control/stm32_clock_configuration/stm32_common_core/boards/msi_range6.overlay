/*
 * Copyright (c) 2022 STMicroelectronics
 *
 * SPDX-License-Identifier: Apache-2.0
 */

/*
 * Warning: This overlay performs configuration from clean sheet.
 * It is assumed that it is applied after clear_clocks.overlay file.
 */

&clk_msi {
	msi-range = <6>;
	status = "okay";
};

&rcc {
	clocks = <&clk_msi>;
	clock-frequency = <4194304>;
};
