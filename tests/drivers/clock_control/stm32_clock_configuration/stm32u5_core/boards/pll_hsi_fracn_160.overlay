/*
 * Copyright (c) 2023 Jatty Andriean <jandriea@outlook.com>
 *
 * SPDX-License-Identifier: Apache-2.0
 */

/*
 * Warning: This overlay performs configuration from clean sheet.
 * It is assumed that it is applied after clear_clocks.overlay file.
 */

&clk_hsi {
	status = "okay";
};

&pll1 {
	div-m = <1>;
	mul-n = <20>;
	div-p = <2>;
	div-q = <2>;
	div-r = <2>;
	fracn = <0>;
	clocks = <&clk_hsi>;
	status = "okay";
};

&rcc {
	clocks = <&pll>;
	clock-frequency = <DT_FREQ_M(160)>;
	ahb-prescaler = <1>;
	apb1-prescaler = <1>;
	apb2-prescaler = <1>;
	apb3-prescaler = <1>;
};
