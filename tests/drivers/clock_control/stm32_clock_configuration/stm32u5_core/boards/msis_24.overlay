/*
 * Copyright (c) 2021 Linaro Limited
 *
 * SPDX-License-Identifier: Apache-2.0
 */

/*
 * Warning: This overlay performs configuration from clean sheet.
 * It is assumed that it is applied after clear_clocks.overlay file.
 */

&clk_lse {
	status = "okay";
};

&clk_msis {
	status = "okay";
	msi-range = <1>;
	msi-pll-mode;
};

&rcc {
	clocks = <&clk_msis>;
	clock-frequency = <DT_FREQ_M(24)>;
	ahb-prescaler = <1>;
	apb1-prescaler = <1>;
	apb2-prescaler = <1>;
	apb3-prescaler = <1>;
};
