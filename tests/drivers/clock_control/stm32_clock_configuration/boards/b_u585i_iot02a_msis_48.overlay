/*
 * Copyright (c) 2021 Linaro Limited
 *
 * SPDX-License-Identifier: Apache-2.0
 */

/*
 * Warning: This overlay relies on initial board configuration.
 *          For clarity, nodes are over written instead of deleted.
 *          Any change to board configuration has impact on this file.
 */

&clk_lse {
	status = "okay";
};

&clk_msis {
	status = "okay";
	msi-range = <0>;			/* Range 0: 48MHz */
	msi-pll-mode;
};

&pll1 { 					/* PLL disabled */
	/delete-property/ div-m;
	/delete-property/ mul-n;
	/delete-property/ div-q;
	/delete-property/ div-r;
	/delete-property/ clocks;
	status = "disabled";
};

&rcc {
	clocks = <&clk_msis>;			/* clck src MSIS */
	clock-frequency = <DT_FREQ_M(48)>;	/* clck freq 48MHz */
	ahb-prescaler = <1>;
	apb1-prescaler = <1>;
	apb2-prescaler = <1>;
	apb3-prescaler = <1>;
};
