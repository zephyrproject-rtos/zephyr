/*
 * Copyright (c) 2024 Kickmaker
 *
 * SPDX-License-Identifier: Apache-2.0
 */

/*
 * Warning: This overlay performs configuration from clean sheet.
 * It is assumed that it is applied after clear_clocks.overlay file.
 */

&clk_hsi {
	hsi-div = <1>;		/* HSI RC: 64MHz, hsi_clk = 64MHz */
	status = "okay";
};

&pll {
	div-m = <4>;
	mul-n = <34>;
	div-p = <1>;
	div-q = <4>;
	div-r = <2>;
	clocks = <&clk_hsi>;
	fracn = <3072>;
	status = "okay";
};

&rcc {
	clocks = <&pll>;
	clock-frequency = <DT_FREQ_M(550)>;
	d1cpre = <1>;
	hpre = <2>;
	d1ppre = <2>;
	d2ppre1 = <2>;
	d2ppre2 = <2>;
	d3ppre = <2>;
};
