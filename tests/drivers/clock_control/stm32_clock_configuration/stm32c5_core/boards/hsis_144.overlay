/*
 * Copyright (c) 2026 STMicroelectronics
 *
 * SPDX-License-Identifier: Apache-2.0
 */

/*
 * Warning: This overlay performs configuration from clean sheet.
 * It is assumed that it is applied after clear_clocks.overlay file.
 */

&clk_hsis {
	clock-frequency = <DT_FREQ_M(144)>;
	status = "okay";
};

&rcc {
	clocks = <&clk_hsis>;
	clock-frequency = <DT_FREQ_M(144)>;
	ahb-prescaler = <1>;
	apb1-prescaler = <2>;
	apb2-prescaler = <2>;
	apb3-prescaler = <2>;
};
