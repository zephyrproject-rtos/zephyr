/* Copyright (c) 2020 Nordic Semiconductor ASA
 * SPDX-License-Identifier: Apache-2.0
 */

/ {
	aliases {
		accel-0 = &bmi;
	};
};

&spi0 {
	bmi: bmi@3 {
		compatible = "bosch,bmi160";
		spi-max-frequency = <50000000>;
		reg = <3>;
		label = "accel";
	};
};
