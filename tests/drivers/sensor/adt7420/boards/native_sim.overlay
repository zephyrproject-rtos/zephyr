/*
 * Copyright (c) 2026, Analog Devices, Inc.
 * SPDX-License-Identifier: Apache-2.0
 */

&i2c0 {
	status = "okay";

	adt7420_default_test: adt7420@48 {
		compatible = "adi,adt7420";
		reg = <0x48>;
		op-mode = "one-shot";
		set-resolution = <16>;
		set-comparator-mode;
	};
};

/ {
	aliases {
		adt7420 = &adt7420_default_test;
	};
};
