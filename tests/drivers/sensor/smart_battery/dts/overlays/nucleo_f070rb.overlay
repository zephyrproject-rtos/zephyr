/*
 * Copyright (c) 2021 Leica Geosystems AG
 *
 * SPDX-License-Identifier: Apache-2.0
 */

&i2c1 {
	clock-frequency = <I2C_BITRATE_STANDARD>;
	timings = <32000000 I2C_BITRATE_STANDARD 0x10E03E52>;
	smartbattery0: smartbattery@0B {
		compatible = "smart-battery";
		reg = <0x0B>;
		label = "SMARTBATTERY";
		status = "okay";
	};
};

/ {
	aliases {
		bat0 = &smartbattery0;
	};
};
