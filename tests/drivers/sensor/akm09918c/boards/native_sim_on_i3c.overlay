/* Copyright (c) 2026 Meta Platforms
 * SPDX-License-Identifier: Apache-2.0
 *
 * akm09918c reparented under zephyr,i3c-emul via the legacy-I2C-on-I3C
 * bridge. reg = <addr 0 0> per the i3c subsystem's i2c-device convention.
 */

&i2c0 {
	status = "disabled";
};

&i3c0 {
	akm09918c: akm09918c@0c0000000000000000 {
		compatible = "asahi-kasei,akm09918c";
		reg = <0xc 0 0>;
	};
};
