/*
 * Copyright (c) 2026 HawkEye 360
 * SPDX-License-Identifier: Apache-2.0
 */

/ {
	rf_power_detector: power-detector {
		compatible = "qorvo,cmd170p4";
		io-channels = <&adc0 0>;
		status = "okay";
	};

	adc0: adc {
		compatible = "zephyr,adc-emul";
		nchannels = <1>;
		ref-internal-mv = <5000>;
		#io-channel-cells = <1>;
		status = "okay";
	};
};

&adc0 {
	#address-cells = <1>;
	#size-cells = <0>;

	channel@0 {
		reg = <0>;
		zephyr,gain = "ADC_GAIN_1";
		zephyr,reference = "ADC_REF_INTERNAL";
		zephyr,acquisition-time = <ADC_ACQ_TIME_DEFAULT>;
		zephyr,resolution = <12>;
	};
};
