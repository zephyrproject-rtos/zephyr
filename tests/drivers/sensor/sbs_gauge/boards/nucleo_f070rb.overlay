/*
 * Copyright (c) 2021 Leica Geosystems AG
 *
 * SPDX-License-Identifier: Apache-2.0
 */

&i2c1 {
	clock-frequency = <I2C_BITRATE_STANDARD>;
	timings = <32000000 I2C_BITRATE_STANDARD 0x10E03E52>;
	smartbattery0: smartbattery@b {
		compatible = "sbs,sbs-gauge";
		reg = <0x0B>;
		status = "okay";
	};
};
