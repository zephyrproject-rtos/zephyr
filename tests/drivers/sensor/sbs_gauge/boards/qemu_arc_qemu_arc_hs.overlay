/*
 * Copyright (c) 2023 Google LLC
 *
 * SPDX-License-Identifier: Apache-2.0
 */

#include <zephyr/dt-bindings/i2c/i2c.h>

/ {
	/* qemu_cortex_a9 board isn't configured with an I2C node */
	fake_i2c_bus: i2c@100 {
		compatible = "zephyr,i2c-emul-controller";
		reg = <0x100 4>;
		clock-frequency = <I2C_BITRATE_STANDARD>;
		#address-cells = <1>;
		#size-cells = <0>;
		status = "okay";
	};
};

&fake_i2c_bus {
	compatible = "zephyr,i2c-emul-controller";
	clock-frequency = <I2C_BITRATE_STANDARD>;

	smartbattery0: smartbattery@b {
		compatible = "sbs,sbs-gauge";
		reg = <0x0b>;
		status = "okay";
	};
};
