## CMakeLists.txt
```
# SPDX-License-Identifier: Apache-2.0

cmake_minimum_required(VERSION 3.28.0)
find_package(Zephyr REQUIRED HINTS $ENV{ZEPHYR_BASE})
project(device)

function(generate_q31_test_cases FILENAME)
  set(FILEPATH ${ZEPHYR_BINARY_DIR}/include/generated/${FILENAME})

  add_custom_command(
    OUTPUT ${FILEPATH}
    COMMAND
    ${PYTHON_EXECUTABLE}
    ${CMAKE_CURRENT_LIST_DIR}/generate_q31_test_cases.py
    ${FILEPATH})

  generate_unique_target_name_from_filename(${FILEPATH} TARGET_NAME)
  add_custom_target(${TARGET_NAME} DEPENDS
    ${FILEPATH})
  add_dependencies(app ${TARGET_NAME})
endfunction()
generate_q31_test_cases(q31_test_cases.inc)

FILE(GLOB app_sources src/*.c)
target_sources(app PRIVATE ${app_sources})
```

## prj.conf
```kconfig
CONFIG_ZTEST=y
CONFIG_SENSOR=y
CONFIG_SENSOR_LOG_LEVEL_DBG=y
```

## prj_fpu.conf
```kconfig
CONFIG_ZTEST=y
CONFIG_FPU=y
CONFIG_SENSOR=y
CONFIG_SENSOR_LOG_LEVEL_DBG=y
```

## src/main.c
```c
/*
 * Copyright (c) 2020 Intel Corporation.
 *
 * SPDX-License-Identifier: Apache-2.0
 */

/**
 * @defgroup driver_sensor_subsys_tests sensor_subsys
 * @ingroup all_tests
 * @{
 * @}
 */

#include <zephyr/ztest.h>
#include "dummy_sensor.h"

K_SEM_DEFINE(sem, 0, 1);
#define RETURN_SUCCESS  (0)

struct channel_sequence {
	enum sensor_channel chan;
	struct sensor_value data;
};

struct trigger_sequence {
	struct sensor_trigger trig;
	struct sensor_value data;
	enum sensor_attribute attr;
};

static struct channel_sequence chan_elements[] = {
	{ SENSOR_CHAN_LIGHT, { 0, 0 } },
	{ SENSOR_CHAN_RED, { 1, 1 } },
	{ SENSOR_CHAN_GREEN, { 2, 4 } },
	{ SENSOR_CHAN_BLUE, { 3, 9 } },
	{ SENSOR_CHAN_PROX, { 4, 16 } }
};

static struct trigger_sequence trigger_elements[] = {
	/* trigger for SENSOR_TRIG_THRESHOLD */
	{ {SENSOR_TRIG_THRESHOLD, SENSOR_CHAN_PROX},
	{ 127, 0 }, SENSOR_ATTR_UPPER_THRESH },

	/* trigger for SENSOR_TRIG_TIMER */
	{ {SENSOR_TRIG_TIMER, SENSOR_CHAN_PROX},
	{ 130, 127 }, SENSOR_ATTR_UPPER_THRESH },

	/* trigger for SENSOR_TRIG_DATA_READY */
	{ {SENSOR_TRIG_DATA_READY, SENSOR_CHAN_PROX},
	{ 150, 130 }, SENSOR_ATTR_UPPER_THRESH },

	/* trigger for SENSOR_TRIG_DELTA */
	{ {SENSOR_TRIG_DELTA, SENSOR_CHAN_PROX},
	{ 180, 150 }, SENSOR_ATTR_UPPER_THRESH },

	/* trigger for SENSOR_TRIG_NEAR_FAR */
	{ {SENSOR_TRIG_NEAR_FAR, SENSOR_CHAN_PROX},
	{ 155, 180 }, SENSOR_ATTR_UPPER_THRESH }
};

static struct {
	struct sensor_value in;
	int8_t shift;
	q31_t expected;
} q31_test_cases[] =
#include <q31_test_cases.inc>
	;

#define TOTAL_CHAN_ELEMENTS (sizeof(chan_elements) / \
		sizeof(struct channel_sequence))
#define TOTAL_TRIG_ELEMENTS (sizeof(trigger_elements) / \
		sizeof(struct trigger_sequence))

/**
 * @brief Test get multiple channels values.
 *
 * @ingroup driver_sensor_subsys_tests
 *
 * @details
 * Test Objective:
 * - get multiple channels values consistently in two operations:
 * fetch sample and get the values of each channel individually.
 * - check the results with sensor_value type avoids use of
 * floating point values
 *
 * Testing techniques:
 * - function and block box testing,Interface testing,
 * Dynamic analysis and testing, Equivalence classes.
 *
 * Prerequisite Conditions:
 * - N/A
 *
 * Input Specifications:
 * - N/A
 *
 * Test Procedure:
 * -# Define a device and bind to dummy sensor.
 * -# Fetch the sample of dummy senor and check the result.
 * -# Get SENSOR_CHAN_LIGHT/SENSOR_CHAN_RED/SENSOR_CHAN_GREEN/
 * SENSOR_CHAN_BLUE/SENSOR_CHAN_BLUE channels from the sensor,
 * and check the result.
 *
 * Expected Test Result:
 * - Application can get multiple channels for dummy sensor.
 *
 * Pass/Fail Criteria:
 * - Successful if check points in test procedure are all passed, otherwise failure.
 *
 * Assumptions and Constraints:
 * - N/A
 *
 * @see sensor_sample_fetch(), sensor_channel_get()
 */
ZTEST(sensor_api, test_sensor_get_channels)
{
	const struct device *dev;
	struct sensor_value data;

	dev = device_get_binding(DUMMY_SENSOR_NAME);
	zassert_not_null(dev, "failed: dev is null");

	/* test fetch single channel */
	zassert_equal(sensor_sample_fetch_chan(dev, chan_elements[0].chan),
				RETURN_SUCCESS,	"fail to fetch sample");
	/* Get and check channel 0 value. */
	zassert_equal(sensor_channel_get(dev, chan_elements[0].chan,
				&data), RETURN_SUCCESS, "fail to get channel");
	zassert_equal(data.val1, chan_elements[0].data.val1,
				"the data does not match");
	zassert_equal(data.val2, chan_elements[0].data.val2,
				"the data does not match");

	/* test fetch all channel */
	zassert_equal(sensor_sample_fetch(dev), RETURN_SUCCESS,
			"fail to fetch sample");
	/* Get and check channels value except for channel 0. */
	for (int i = 1; i < TOTAL_CHAN_ELEMENTS; i++) {
		zassert_equal(sensor_channel_get(dev, chan_elements[i].chan,
				&data), RETURN_SUCCESS, "fail to get channel");
		zassert_equal(data.val1, chan_elements[i].data.val1,
				"the data does not match");
		zassert_equal(data.val2, chan_elements[i].data.val2,
				"the data does not match");
	}

	/* Get data with invalid channel. */
	zassert_not_equal(sensor_channel_get(dev, SENSOR_CHAN_DISTANCE,
				&data), RETURN_SUCCESS, "should fail for invalid channel");
}

static void trigger_handler(const struct device *dev,
			    const struct sensor_trigger *trigger)
{
	ARG_UNUSED(dev);
	ARG_UNUSED(trigger);

	k_sem_give(&sem);
}

/**
 * @brief Test sensor multiple triggers.
 *
 * @ingroup driver_sensor_subsys_tests
 *
 * @details
 * Test Objective:
 * Check if sensor subsys can set multiple triggers and
 * can set/get sensor attribute.
 *
 * Testing techniques:
 * - function and block box testing,Interface testing,
 * Dynamic analysis and testing.
 *
 * Prerequisite Conditions:
 * - N/A
 *
 * Input Specifications:
 * - N/A
 *
 * Test Procedure:
 * -# Define a device and bind to dummy sensor and
 * check the result.
 * -# set multiple triggers for the dummy sensor and no trig sensor.
 * then check the result.
 * -# Handle different types of triggers, based on time, data,threshold,
 * based on a delta value, near/far events and single/double tap and
 * check the result.
 *
 * Expected Test Result:
 * - Application can get multiple channels for dummy sensor.
 *
 * Pass/Fail Criteria:
 * - Successful if check points in test procedure are all passed, otherwise failure.
 *
 * Assumptions and Constraints:
 * - N/A
 *
 * @see sensor_attr_set(), sensor_trigger_set()
 */
ZTEST(sensor_api, test_sensor_handle_triggers)
{
	const struct device *dev;
	const struct device *dev_no_trig;
	struct sensor_value data;

	dev = device_get_binding(DUMMY_SENSOR_NAME);
	dev_no_trig = device_get_binding(DUMMY_SENSOR_NAME_NO_TRIG);
	zassert_not_null(dev, "failed: dev is null");

	zassert_equal(sensor_sample_fetch(dev), RETURN_SUCCESS,
			"fail to fetch sample");

	/* setup multiple triggers */
	for (int i = 0; i < TOTAL_TRIG_ELEMENTS; i++) {
		/* set attributes for trigger */
		zassert_equal(sensor_attr_set(dev,
				trigger_elements[i].trig.chan,
				trigger_elements[i].attr,
				&trigger_elements[i].data),
				RETURN_SUCCESS, "fail to set attributes");

		/* read-back attributes for trigger */
		zassert_equal(sensor_attr_get(dev,
				trigger_elements[i].trig.chan,
				trigger_elements[i].attr,
				&data),
				RETURN_SUCCESS, "fail to get attributes");
		zassert_equal(trigger_elements[i].data.val1,
			      data.val1, "read-back returned wrong val1");
		zassert_equal(trigger_elements[i].data.val2,
			      data.val2, "read-back returned wrong val2");

		/* setting a sensor's trigger and handler */
		zassert_equal(sensor_trigger_set(dev,
				&trigger_elements[i].trig,
				trigger_handler),
				RETURN_SUCCESS, "fail to set trigger");

		/* get channels value after trigger fired */
		k_sem_take(&sem, K_FOREVER);
		zassert_equal(sensor_channel_get(dev,
				trigger_elements[i].trig.chan,
				&data), RETURN_SUCCESS, "fail to get channel");

		/* check the result of the trigger channel */
		zassert_equal(data.val1, trigger_elements[i].data.val1,
				"retrieved data does not match");
		zassert_equal(data.val2, trigger_elements[i].data.val2,
				"retrieved data does not match");

		/* set attributes for no trig dev */
		zassert_equal(sensor_attr_set(dev_no_trig,
				trigger_elements[i].trig.chan,
				trigger_elements[i].attr,
				&trigger_elements[i].data),
				-ENOSYS, "fail to set attributes");

		/* read-back attributes for no trig dev*/
		zassert_equal(sensor_attr_get(dev_no_trig,
				trigger_elements[i].trig.chan,
				trigger_elements[i].attr,
				&data),
				-ENOSYS, "fail to get attributes");

		/* setting a sensor's trigger and handler for no trig dev */
		zassert_equal(sensor_trigger_set(dev_no_trig,
				&trigger_elements[i].trig,
				trigger_handler),
				-ENOSYS, "fail to set trigger");
	}
}

/**
 * @brief Test unit conversion of sensor module
 * @details Verify helper function to convert acceleration from
 * Gs to m/s^2 and from m/s^2 to Gs.  Verify helper function
 * to convert radians to degrees and degrees to radians.  Verify
 * helper function for converting struct sensor_value to double.
 * Verify helper functions for converting to milli and micro prefix
 * units.
 */
ZTEST(sensor_api, test_sensor_unit_conversion)
{
	struct sensor_value data;
	int ret;

	/* Test acceleration unit conversion */
	sensor_g_to_ms2(1, &data);
	zassert_equal(data.val1, SENSOR_G/1000000LL,
			"the data does not match");
	zassert_equal(data.val2, SENSOR_G%(data.val1 * 1000000LL),
			"the data does not match");
	zassert_equal(sensor_ms2_to_g(&data), 1,
			"the data does not match");
	/* set test data to negative value */
	data.val1 = -data.val1;
	data.val2 = -data.val2;
	zassert_equal(sensor_ms2_to_g(&data), -1,
			"the data does not match");

	/* Test the conversion between angle and radian */
	sensor_degrees_to_rad(180, &data);
	zassert_equal(data.val1, SENSOR_PI/1000000LL,
			"the data does not match");
	zassert_equal(data.val2, SENSOR_PI%(data.val1 * 1000000LL),
			"the data does not match");
	zassert_equal(sensor_rad_to_degrees(&data), 180,
			"the data does not match");
	/* set test data to negative value */
	data.val1 = -data.val1;
	data.val2 = -data.val2;
	zassert_equal(sensor_rad_to_degrees(&data), -180,
			"the data does not match");

	/* reset test data to positive value */
	data.val1 = -data.val1;
	data.val2 = -data.val2;
#if defined(CONFIG_FPU)
	/* Test struct sensor_value to double and float */
	zassert_equal((long long)(sensor_value_to_double(&data) * 1000000LL),
			SENSOR_PI, "the data does not match");
	zassert_equal((long long)(sensor_value_to_float(&data) * 1000000LL),
			SENSOR_PI, "the data does not match");

	/* Test struct sensor_value from double and float */
	sensor_value_from_double(&data, (double)(SENSOR_PI) / 1000000.0);
	zassert_equal(data.val1, SENSOR_PI/1000000LL,
			"the data does not match");
	zassert_equal(data.val2, SENSOR_PI%(data.val1 * 1000000LL),
			"the data does not match");

	sensor_value_from_float(&data, (float)(SENSOR_PI) / 1000000.0f);
	zassert_equal(data.val1, SENSOR_PI/1000000LL,
			"the data does not match");
	zassert_equal(data.val2, SENSOR_PI%(data.val1 * 1000000LL),
			"the data does not match");

	/* Extensive tests for edge cases */
	sensor_value_from_double(&data, -2147483648.0);
	zassert_equal(data.val1, -2147483648, "the data does not match");
	zassert_equal(data.val2, 0, "the data does not match");

	ret = sensor_value_from_double(&data, -2147483649.0);
	zassert_equal(ret, -ERANGE, "range error expected");

	sensor_value_from_double(&data, 2147483647.0);
	zassert_equal(data.val1, 2147483647, "the data does not match");
	zassert_equal(data.val2, 0, "the data does not match");

	ret = sensor_value_from_double(&data, 2147483648.0);
	zassert_equal(ret, -ERANGE, "range error expected");

	sensor_value_from_float(&data, -2147483648.0f);
	zassert_equal(data.val1, -2147483648, "the data does not match");
	zassert_equal(data.val2, 0, "the data does not match");

	ret = sensor_value_from_float(&data, -2147483904.0f);
	zassert_equal(ret, -ERANGE, "range error expected");

	sensor_value_from_float(&data, 2147483520.0f);
	zassert_equal(data.val1, 2147483520, "the data does not match");
	zassert_equal(data.val2, 0, "the data does not match");

	ret = sensor_value_from_float(&data, 2147483584.0f);
	zassert_equal(ret, -ERANGE, "range error expected");

#endif
	/* Test struct sensor_value to q31 */
	ARRAY_FOR_EACH_PTR(q31_test_cases, tc) {
		q31_t q = sensor_value_to_q31(&tc->in, tc->shift);

		zassert_equal(q, tc->expected, "val1: %d, val2: %d, shift: %d: expected %d, got %d",
			      tc->in.val1, tc->in.val2, tc->shift, (uint32_t)tc->expected,
			      (uint32_t)q);
	}

	/* Test struct sensor_value to fixed point */
	uint32_t val;

	data.val1 = -1;
	data.val2 = -500000;
	ret = sensor_value_to_fixed_point(&val, &data, 1, 30, true);
	zassert_equal(ret, 0, "success expected");
	zassert_equal(val, 0xA0000000U, "the result does not match");

	data.val1 = 1;
	data.val2 = 500000;
	ret = sensor_value_to_fixed_point(&val, &data, 1, 30, true);
	zassert_equal(ret, 0, "success expected");
	zassert_equal(val, 0x60000000U, "the result does not match");

	data.val1 = 25;
	data.val2 = 500000;
	ret = sensor_value_to_fixed_point(&val, &data, 12, 4, false);
	zassert_equal(ret, 0, "success expected");
	zassert_equal(val, 0x00000198U, "the result does not match");

	data.val1 = -25;
	data.val2 = -500000;
	ret = sensor_value_to_fixed_point(&val, &data, 11, 4, true);
	zassert_equal(ret, 0, "success expected");
	zassert_equal(val, 0x0000FE68U, "the result does not match");

	/* Test struct sensor_value from fixed point */
	ret = sensor_value_from_fixed_point(&data, 0xA0000000U, 1, 30, true);
	zassert_equal(ret, 0, "success expected");
	zassert_equal(data.val1, -1, "the result does not match");
	zassert_equal(data.val2, -500000, "the result does not match");

	ret = sensor_value_from_fixed_point(&data, 0x60000000U, 1, 30, true);
	zassert_equal(ret, 0, "success expected");
	zassert_equal(data.val1, 1, "the result does not match");
	zassert_equal(data.val2, 500000, "the result does not match");

	ret = sensor_value_from_fixed_point(&data, 0x00000198U, 12, 4, false);
	zassert_equal(ret, 0, "success expected");
	zassert_equal(data.val1, 25, "the result does not match");
	zassert_equal(data.val2, 500000, "the result does not match");

	ret = sensor_value_from_fixed_point(&data, 0x0000FE68U, 11, 4, true);
	zassert_equal(ret, 0, "success expected");
	zassert_equal(data.val1, -25, "the result does not match");
	zassert_equal(data.val2, -500000, "the result does not match");

	/* Test edge cases for struct sensor_value to/from fixed point */
	ret = sensor_value_to_fixed_point(&val, &data, 10, 30, false);
	zassert_equal(ret, -EINVAL, "invalid argument error expected");

	ret = sensor_value_from_fixed_point(&data, val, 10, 30, false);
	zassert_equal(ret, -EINVAL, "invalid argument error expected");

	ret = sensor_value_to_fixed_point(&val, &data, 0, 32, true);
	zassert_equal(ret, -EINVAL, "invalid argument error expected");

	ret = sensor_value_from_fixed_point(&data, val, 0, 32, true);
	zassert_equal(ret, -EINVAL, "invalid argument error expected");

	ret = sensor_value_to_fixed_point(&val, &data, 10, 0, true);
	zassert_equal(ret, -EINVAL, "invalid argument error expected");

	ret = sensor_value_from_fixed_point(&data, val, 10, 0, true);
	zassert_equal(ret, -EINVAL, "invalid argument error expected");

	data.val1 = 1;
	data.val2 = 0;
	ret = sensor_value_to_fixed_point(&val, &data, 0, 31, true);
	zassert_equal(ret, -ERANGE, "range error expected");

	data.val1 = -1;
	data.val2 = 0;
	ret = sensor_value_to_fixed_point(&val, &data, 0, 31, true);
	zassert_equal(ret, 0, "success expected");
	zassert_equal(val, 0x80000000U, "the result does not match");

	ret = sensor_value_from_fixed_point(&data, 0x80000000U, 0, 31, true);
	zassert_equal(ret, 0, "success expected");
	zassert_equal(data.val1, -1, "the result does not match");
	zassert_equal(data.val2, 0, "the result does not match");

	data.val1 = 0;
	data.val2 = 0;
	ret = sensor_value_to_fixed_point(&val, &data, 0, 31, true);
	zassert_equal(ret, 0, "success expected");
	zassert_equal(val, 0x00000000U, "the result does not match");

	ret = sensor_value_from_fixed_point(&data, 0x00000000U, 0, 31, true);
	zassert_equal(ret, 0, "success expected");
	zassert_equal(data.val1, 0, "the result does not match");
	zassert_equal(data.val2, 0, "the result does not match");

	data.val1 = 0;
	data.val2 = 500000;
	ret = sensor_value_to_fixed_point(&val, &data, 0, 1, false);
	zassert_equal(ret, 0, "success expected");
	zassert_equal(val, 0x00000001U, "the result does not match");

	ret = sensor_value_from_fixed_point(&data, 0x00000001U, 0, 1, false);
	zassert_equal(ret, 0, "success expected");
	zassert_equal(data.val1, 0, "the result does not match");
	zassert_equal(data.val2, 500000, "the result does not match");

	ret = sensor_value_from_fixed_point(&data, 0x7FFFFFFFU, 0, 31, true);
	zassert_equal(ret, 0, "success expected");
	zassert_equal(data.val1, 0, "the result does not match");
	zassert_equal(data.val2, 999999, "the result does not match");

	/* reset test data to positive value */
	data.val1 = 3;
	data.val2 = 300000;
	zassert_equal(sensor_value_to_deci(&data), 33LL,
			"the result does not match");
	zassert_equal(sensor_value_to_centi(&data), 330LL,
			"the result does not match");
	zassert_equal(sensor_value_to_milli(&data), 3300LL,
			"the result does not match");
	zassert_equal(sensor_value_to_micro(&data), 3300000LL,
			"the result does not match");
	/* reset test data to negative value */
	data.val1 = -data.val1;
	data.val2 = -data.val2;
	zassert_equal(sensor_value_to_deci(&data), -33LL,
		"the result does not match");
	zassert_equal(sensor_value_to_centi(&data), -330LL,
		"the result does not match");
	zassert_equal(sensor_value_to_milli(&data), -3300LL,
			"the result does not match");
	zassert_equal(sensor_value_to_micro(&data), -3300000LL,
			"the result does not match");
	/* Test when result is greater than 32-bit wide */
	data.val1 = 2123456789;
	data.val2 = 876543;
	zassert_equal(sensor_value_to_deci(&data), 21234567898LL,
			"the result does not match");
	zassert_equal(sensor_value_to_centi(&data), 212345678987LL,
			"the result does not match");
	data.val1 = 5432109;
	data.val2 = 876543;
	zassert_equal(sensor_value_to_milli(&data), 5432109876LL,
			"the result does not match");
	zassert_equal(sensor_value_to_micro(&data), 5432109876543LL,
			"the result does not match");

	struct sensor_value data2, out;

	/* Testing sensor_value additions */
	data.val1 = 0;
	data.val2 = 500000;
	data2.val1 = 0;
	data2.val2 = 500000;
	ret = sensor_value_add(&data, &data2, &out);
	zassert_equal(ret, 0, "success expected");
	zassert_equal(out.val1, 1, "the result does not match");
	zassert_equal(out.val2, 0, "the result does not match");

	data.val1 = 1;
	data.val2 = 0;
	data2.val1 = 0;
	data2.val2 = -250000;
	ret = sensor_value_add(&data, &data2, &out);
	zassert_equal(ret, 0, "success expected");
	zassert_equal(out.val1, 0, "the result does not match");
	zassert_equal(out.val2, 750000, "the result does not match");

	/* Testing sensor_value subtractions */
	data.val1 = 1;
	data.val2 = 0;
	data2.val1 = 0;
	data2.val2 = 250000;
	ret = sensor_value_subtract(&data, &data2, &out);
	zassert_equal(ret, 0, "success expected");
	zassert_equal(out.val1, 0, "the result does not match");
	zassert_equal(out.val2, 750000, "the result does not match");

	data.val1 = 0;
	data.val2 = -250000;
	data2.val1 = 1;
	data2.val2 = 0;
	ret = sensor_value_subtract(&data, &data2, &out);
	zassert_equal(ret, 0, "success expected");
	zassert_equal(out.val1, -1, "the result does not match");
	zassert_equal(out.val2, -250000, "the result does not match");

	/* Testing sensor_value multiplications */
	data.val1 = 1;
	data.val2 = 500000;
	data2.val1 = 2;
	data2.val2 = 0;
	ret = sensor_value_multiply(&data, &data2, &out);
	zassert_equal(ret, 0, "success expected");
	zassert_equal(out.val1, 3, "the result does not match");
	zassert_equal(out.val2, 0, "the result does not match");

	data.val1 = 0;
	data.val2 = 500000;
	data2.val1 = 0;
	data2.val2 = -500000;
	ret = sensor_value_multiply(&data, &data2, &out);
	zassert_equal(ret, 0, "success expected");
	zassert_equal(out.val1, 0, "the result does not match");
	zassert_equal(out.val2, -250000, "the result does not match");

	/* Testing sensor_value scaling */
	data.val1 = 0;
	data.val2 = 750000;
	ret = sensor_value_scale(&data, 2, &out);
	zassert_equal(ret, 0, "success expected");
	zassert_equal(out.val1, 1, "the result does not match");
	zassert_equal(out.val2, 500000, "the result does not match");

	data.val1 = -1;
	data.val2 = -500000;
	ret = sensor_value_scale(&data, -3, &out);
	zassert_equal(ret, 0, "success expected");
	zassert_equal(out.val1, 4, "the result does not match");
	zassert_equal(out.val2, 500000, "the result does not match");

	/* Testing out-of-range edge cases for sensor_value arithmetic functions */
	data.val1 = INT32_MAX;
	data.val2 = 999999;
	data2.val1 = 0;
	data2.val2 = 1;
	ret = sensor_value_add(&data, &data2, &out);
	zassert_equal(ret, -ERANGE, "range error expected");

	data.val1 = INT32_MIN;
	data.val2 = -999999;
	data2.val1 = 0;
	data2.val2 = 1;
	ret = sensor_value_subtract(&data, &data2, &out);
	zassert_equal(ret, -ERANGE, "range error expected");

	data.val1 = INT32_MAX;
	data.val2 = 0;
	data2.val1 = 2;
	data2.val2 = 0;
	ret = sensor_value_multiply(&data, &data2, &out);
	zassert_equal(ret, -ERANGE, "range error expected");

	data.val1 = INT32_MAX;
	data.val2 = 0;
	ret = sensor_value_scale(&data, 2, &out);
	zassert_equal(ret, -ERANGE, "range error expected");
}

ZTEST_SUITE(sensor_api, NULL, NULL, ztest_simple_1cpu_before, ztest_simple_1cpu_after, NULL);
```

## src/dummy_sensor.c
```c
/*
 * Copyright (c) 2020 Intel Corporation
 *
 * SPDX-License-Identifier: Apache-2.0
 */

#include "dummy_sensor.h"
#include <zephyr/drivers/sensor.h>
#include <zephyr/device.h>
#include <zephyr/logging/log.h>
#include <zephyr/ztest.h>

LOG_MODULE_REGISTER(dummy_sensor, LOG_LEVEL_DBG);
static struct dummy_sensor_data dummy_data;
/**
 * @brief config bus address at compile time
 */
static const struct dummy_sensor_config dummy_config = {
	.i2c_name = "dummy I2C",
	.i2c_address = 123
};

static int dummy_sensor_sample_fetch(const struct device *dev,
				     enum sensor_channel chan)
{
	ARG_UNUSED(dev);
	ARG_UNUSED(chan);

	/* Just return success due to dummy sensor driver here. */
	return 0;
}

static int dummy_sensor_channel_get(const struct device *dev,
				    enum sensor_channel chan,
				    struct sensor_value *val)
{
	struct dummy_sensor_data *data = dev->data;

	switch (chan) {
	case SENSOR_CHAN_LIGHT:
		val->val1 = data->val[0].val1;
		val->val2 = data->val[0].val2;
		break;
	case SENSOR_CHAN_RED:
		val->val1 = data->val[1].val1;
		val->val2 = data->val[1].val2;
		break;
	case SENSOR_CHAN_GREEN:
		val->val1 = data->val[2].val1;
		val->val2 = data->val[2].val2;
		break;
	case SENSOR_CHAN_BLUE:
		val->val1 = data->val[3].val1;
		val->val2 = data->val[3].val2;
		break;
	case SENSOR_CHAN_PROX:
		val->val1 = data->val[4].val1;
		val->val2 = data->val[4].val2;
		break;
	default:
		return -ENOTSUP;
	}

	return 0;
}

/* return 0 for dummy driver to imitate interrupt */
static int dummy_init_interrupt(const struct device *dev)
{
	ARG_UNUSED(dev);

	return 0;
}

static int dummy_sensor_init(const struct device *dev)
{
	struct dummy_sensor_data *data = dev->data;
	const struct dummy_sensor_config *config = dev->config;
	/* i2c should be null for dummy driver */
	const struct device *i2c = device_get_binding(config->i2c_name);

	/* Bus and address should be configured. */
	zassert_str_equal(config->i2c_name, "dummy I2C");
	zassert_equal(config->i2c_address, 123);

	if (i2c != NULL) {
		LOG_ERROR("Should be Null for %s device!", config->i2c_name);
		return -1;
	}

	if (dummy_init_interrupt(dev) < 0) {
		LOG_ERROR("Failed to initialize interrupt!");
		return -1;
	}

	/* initialize the channels value for dummy driver */
	for (int i = 0; i < SENSOR_CHANNEL_NUM; i++) {
		data->val[i].val1 = i;
		data->val[i].val2 = i*i;
	}

	return 0;
}

int dummy_sensor_attr_set(const struct device *dev,
			  enum sensor_channel chan,
			  enum sensor_attribute attr,
			  const struct sensor_value *val)
{
	struct dummy_sensor_data *data = dev->data;

	if (chan == SENSOR_CHAN_PROX &&
	    attr == SENSOR_ATTR_UPPER_THRESH) {
		data->val[4].val1 = val->val1;
		data->val[4].val2 = val->val2;
		return 0;
	}

	return -ENOTSUP;
}

int dummy_sensor_attr_get(const struct device *dev,
			  enum sensor_channel chan,
			  enum sensor_attribute attr,
			  struct sensor_value *val)
{
	struct dummy_sensor_data *data = dev->data;

	if (chan == SENSOR_CHAN_PROX &&
	    attr == SENSOR_ATTR_UPPER_THRESH) {
		val->val1 = data->val[4].val1;
		val->val2 = data->val[4].val2;
		return 0;
	}

	return -ENOTSUP;
}

int dummy_sensor_trigger_set(const struct device *dev,
			     const struct sensor_trigger *trig,
			     sensor_trigger_handler_t handler)
{
	struct dummy_sensor_data *data = dev->data;

	switch (trig->type) {
	case SENSOR_TRIG_THRESHOLD:
	case SENSOR_TRIG_TIMER:
	case SENSOR_TRIG_DATA_READY:
	case SENSOR_TRIG_DELTA:
	case SENSOR_TRIG_NEAR_FAR:
		/* Use the same action to dummy above triggers */
		if (handler != NULL) {
			data->handler = handler;
			data->handler(dev, NULL);
		}
		break;
	default:
		return -ENOTSUP;
	}

	return 0;
}

static DEVICE_API(sensor, dummy_sensor_api) = {
	.sample_fetch = &dummy_sensor_sample_fetch,
	.channel_get = &dummy_sensor_channel_get,
	.attr_set = dummy_sensor_attr_set,
	.attr_get = dummy_sensor_attr_get,
	.trigger_set = dummy_sensor_trigger_set,
};

static DEVICE_API(sensor, dummy_sensor_no_trig_api) = {
	.sample_fetch = &dummy_sensor_sample_fetch,
	.channel_get = &dummy_sensor_channel_get,
	.attr_set = NULL,
	.attr_get = NULL,
	.trigger_set = NULL,
};

DEVICE_DEFINE(dummy_sensor, DUMMY_SENSOR_NAME, &dummy_sensor_init,
		    NULL, &dummy_data, &dummy_config, POST_KERNEL,
		    CONFIG_KERNEL_INIT_PRIORITY_DEFAULT, &dummy_sensor_api);

DEVICE_DEFINE(dummy_sensor_no_trig, DUMMY_SENSOR_NAME_NO_TRIG, &dummy_sensor_init,
		    NULL, &dummy_data, &dummy_config, POST_KERNEL,
		    CONFIG_KERNEL_INIT_PRIORITY_DEFAULT, &dummy_sensor_no_trig_api);
```

## src/dummy_sensor.h
```c
/*
 * Copyright (c) 2020 Intel Corporation.
 *
 * SPDX-License-Identifier: Apache-2.0
 */

#ifndef __TEST_DUMMY_SENSOR_H__
#define __TEST_DUMMY_SENSOR_H__

#include <zephyr/kernel.h>
#include <zephyr/device.h>
#include <zephyr/drivers/sensor.h>
#define DUMMY_SENSOR_NAME	"dummy_sensor"
#define DUMMY_SENSOR_NAME_NO_TRIG	"dummy_sensor_no_trig"
#define SENSOR_CHANNEL_NUM	5

struct dummy_sensor_data {
	sensor_trigger_handler_t handler;
	struct sensor_value val[SENSOR_CHANNEL_NUM];
};

struct dummy_sensor_config {
	char *i2c_name;
	uint8_t i2c_address;
};

#endif //__TEST_DUMMY_SENSOR_H__
```
