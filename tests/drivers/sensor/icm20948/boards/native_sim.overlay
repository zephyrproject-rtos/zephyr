/* Copyright (c) 2026 Ali Talha Yurtseven
 * SPDX-License-Identifier: Apache-2.0
 */

&spi0 {
	icm20948: icm20948@0 {
		compatible = "invensense,icm20948";
		reg = <0>;
		spi-max-frequency = <1000000>;
	};
};
