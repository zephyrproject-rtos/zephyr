## CMakeLists.txt
```
# SPDX-License-Identifier: Apache-2.0

cmake_minimum_required(VERSION 3.28.0)
find_package(Zephyr REQUIRED HINTS $ENV{ZEPHYR_BASE})
project(sensor_shell)

target_sources(app PRIVATE src/main.c)
```

## prj.conf
```kconfig
CONFIG_ZTEST=y
CONFIG_SENSOR=y
CONFIG_SENSOR_SHELL=y
CONFIG_SHELL=y
CONFIG_SHELL_BACKEND_SERIAL=n
CONFIG_SHELL_BACKEND_DUMMY=y
```

## boards/qemu_x86.overlay
```dts
/ {
    dummy: dummy {
        compatible = "dummy-sensor";
        i2c-name = "dummy I2C";
        i2c-address = <123>;
    };
};
```

## dts/bindings/dummy-sensor.yaml
```yaml
description: Dummy Sensor

compatible: "dummy-sensor"

properties:
  i2c-address:
    type: int
  i2c-name:
    type: string
```

## src/main.c
```c
/*
 * Copyright (c) 2026 Brandon Edmonds
 *
 * SPDX-License-Identifier: Apache-2.0
 */

#include <errno.h>
#include <stdio.h>

#include <zephyr/device.h>
#include <zephyr/drivers/sensor.h>
#include <zephyr/kernel.h>
#include <zephyr/shell/shell.h>
#include <zephyr/shell/shell_dummy.h>
#include <zephyr/ztest.h>

static struct sensor_value captured_value;
static unsigned int attr_set_calls;

static int test_sensor_attr_set(const struct device *dev, enum sensor_channel chan,
				enum sensor_attribute attr, const struct sensor_value *value)
{
	ARG_UNUSED(dev);
	zassert_equal(chan, SENSOR_CHAN_AMBIENT_TEMP);
	zassert_equal(attr, SENSOR_ATTR_SAMPLING_FREQUENCY);
	captured_value = *value;
	attr_set_calls++;
	return 0;
}

static DEVICE_API(sensor, test_sensor_api) = {
	.attr_set = test_sensor_attr_set,
};

DEVICE_DEFINE(test_sensor, "test_sensor", NULL, NULL, NULL, NULL, POST_KERNEL,
	      CONFIG_SENSOR_INIT_PRIORITY, &test_sensor_api);

static int set_value(const char *input)
{
	char command[128];

	attr_set_calls = 0;
	snprintf(command, sizeof(command),
		 "sensor attr_set test_sensor ambient_temp sampling_frequency %s", input);
	return shell_execute_cmd(shell_backend_dummy_get_ptr(), command);
}

static void assert_value(const char *input, int32_t val1, int32_t val2)
{
	zassert_ok(set_value(input), "Rejected %s", input);
	zassert_equal(attr_set_calls, 1, "Driver not called for %s", input);
	zassert_equal(captured_value.val1, val1, "Wrong integer part for %s", input);
	zassert_equal(captured_value.val2, val2, "Wrong fraction for %s", input);
}

ZTEST(sensor_shell, test_zero_fraction)
{
	/* The old parser never returned for an all-zero fraction. */
	assert_value("50.0", 50, 0);
	assert_value("50.000000", 50, 0);
}

ZTEST(sensor_shell, test_decimal_fraction)
{
	assert_value("50.005", 50, 5000);
	assert_value("50.000001", 50, 1);
	assert_value("50.1", 50, 100000);
	assert_value("50.08", 50, 80000);
	assert_value("50.123456", 50, 123456);
}

ZTEST(sensor_shell, test_decimal_integer)
{
	assert_value("050.5", 50, 500000);
	assert_value("010.2", 10, 200000);
	assert_value("08.5", 8, 500000);
	assert_value("-050.5", -50, -500000);
	assert_value("050", 50, 0);
}

ZTEST(sensor_shell, test_negative_value)
{
	assert_value("-50.005", -50, -5000);
	assert_value("-0.005", 0, -5000);
}

ZTEST(sensor_shell, test_trailing_zeros)
{
	assert_value("50.1234560", 50, 123456);
	assert_value("50.0000000", 50, 0);
}

ZTEST(sensor_shell, test_invalid_value)
{
	static const char *const inputs[] = {
		"50.1234567", "50.0000001", "50.0x10", "50.-5", "50.+5", "50.", "50.1.2",
		"0x32", "0x32.5",
	};

	for (size_t i = 0; i < ARRAY_SIZE(inputs); i++) {
		zassert_equal(set_value(inputs[i]), -EINVAL, "Accepted %s", inputs[i]);
		zassert_equal(attr_set_calls, 0, "Driver called for %s", inputs[i]);
	}
}

static void *sensor_shell_setup(void)
{
	const struct shell *sh = shell_backend_dummy_get_ptr();

	/* Wait for the initialization of the shell dummy backend. */
	WAIT_FOR(shell_ready(sh), 20000, k_msleep(1));
	zassert_true(shell_ready(sh), "Timed out waiting for dummy shell backend");
	return NULL;
}

ZTEST_SUITE(sensor_shell, NULL, sensor_shell_setup, NULL, NULL, NULL);
```

## src/dummy_sensor.c
```c
/*
 * Copyright (c) 2024 THE ARC GmbH
 *
 * SPDX-License-Identifier: Apache-2.0
 */

#include "dummy_sensor.h"
#include <zephyr/drivers/sensor.h>
#include <zephyr/device.h>
#include <zephyr/logging/log.h>

LOG_MODULE_REGISTER(dummy_sensor, LOG_LEVEL_DBG);
#define DT_DRV_COMPAT dummy_sensor

static int dummy_sensor_sample_fetch(const struct device *dev, enum sensor_channel chan)
{
	ARG_UNUSED(dev);
	ARG_UNUSED(chan);

	/* Just return success due to dummy sensor driver here. */
	return 0;
}

static int get_data_index(enum sensor_channel chan)
{
	switch (chan) {
	case SENSOR_CHAN_LIGHT:
		return 0;
	case SENSOR_CHAN_PROX:
		return 1;
	default:
		return -ENOTSUP;
	}
}

static int dummy_sensor_channel_get(const struct device *dev, enum sensor_channel chan,
				    struct sensor_value *val)
{
	struct dummy_sensor_data *data = dev->data;
	int data_idx = get_data_index(chan);

	if (data_idx < 0) {
		return data_idx;
	}
	val->val1 = data->val[data_idx].val1;
	val->val2 = data->val[data_idx].val2;

	return 0;
}

int dummy_sensor_set_value(const struct device *dev, enum sensor_channel chan,
			   struct sensor_value *val)
{
	struct dummy_sensor_data *data = dev->data;
	int data_idx = get_data_index(chan);

	if (data_idx < 0) {
		return data_idx;
	}
	data->val[data_idx].val1 = val->val1;
	data->val[data_idx].val2 = val->val2;
	return 0;
}

static int dummy_sensor_init(const struct device *dev)
{
	struct dummy_sensor_data *data = dev->data;
	const struct dummy_sensor_config *config = dev->config;
	/* i2c should be null for dummy driver */
	const struct device *i2c = device_get_binding(config->i2c_name);

	if (i2c != NULL) {
		LOG_ERR("Should be Null for %s device!", config->i2c_name);
		return -1;
	}

	/* initialize the channels value for dummy driver */
	for (int i = 0; i < SENSOR_CHANNEL_NUM; i++) {
		data->val[i].val1 = i;
		data->val[i].val2 = i * i;
	}

	return 0;
}

static const struct sensor_driver_api dummy_sensor_api = {
	.sample_fetch = &dummy_sensor_sample_fetch,
	.channel_get = &dummy_sensor_channel_get,
	.trigger_set = NULL,
	.attr_set = NULL,
	.attr_get = NULL,
	.get_decoder = NULL,
	.submit = NULL,
};

#define DUMMY_SENSOR_INIT(inst)                                                                    \
	static struct dummy_sensor_data dummy_sensor_data_##inst;                                  \
                                                                                                   \
	static const struct dummy_sensor_config dummy_sensor_config_##inst = {                     \
		.i2c_name = DT_INST_PROP(inst, i2c_name),                                          \
		.i2c_address = DT_INST_PROP(inst, i2c_address)};                                   \
                                                                                                   \
	DEVICE_DT_INST_DEFINE(inst, dummy_sensor_init, NULL, &dummy_sensor_data_##inst,            \
			      &dummy_sensor_config_##inst, POST_KERNEL,                            \
			      CONFIG_SENSOR_INIT_PRIORITY, &dummy_sensor_api);

DT_INST_FOREACH_STATUS_OKAY(DUMMY_SENSOR_INIT)
```

## src/dummy_sensor.h
```c
/*
 * Copyright (c) 2024 THE ARC GmbH
 *
 * SPDX-License-Identifier: Apache-2.0
 */

#ifndef __TEST_DUMMY_SENSOR_H__
#define __TEST_DUMMY_SENSOR_H__

#include <zephyr/kernel.h>
#include <zephyr/device.h>
#include <zephyr/drivers/sensor.h>

#define SENSOR_CHANNEL_NUM 2

struct dummy_sensor_data {
	sensor_trigger_handler_t handler;
	struct sensor_value val[SENSOR_CHANNEL_NUM];
};

struct dummy_sensor_config {
	char *i2c_name;
	uint8_t i2c_address;
};

int dummy_sensor_set_value(const struct device *dev, enum sensor_channel chan,
			   struct sensor_value *val);

#endif /* __TEST_DUMMY_SENSOR_H__ */
```
