/*
 * Copyright (c) 2026 Embeint Inc
 *
 * SPDX-License-Identifier: Apache-2.0
 */

/ {
	test_sensor: test_sensor {
		compatible = "zephyr,generic-emul-sensor";
		status = "okay";
	};

	fail_sensor: fail_sensor {
		compatible = "zephyr,generic-emul-sensor";
		negated-init-rc = <2>;
		status = "okay";
	};

	test_sensor_pm: test_sensor_pm {
		compatible = "zephyr,generic-emul-sensor";
		zephyr,pm-device-runtime-auto;
		status = "okay";
	};
};
