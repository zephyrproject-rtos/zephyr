/*
 * Copyright (c) 2026 Analog Devices Inc.
 * SPDX-License-Identifier: Apache-2.0
 */

#include <zephyr/dt-bindings/sensor/maxm86161.h>

&i2c0 {
	status = "okay";

	maxm86161_test: maxm86161@62 {
		compatible = "adi,maxm86161";
		reg = <0x62>;
		status = "okay";

		interrupt-gpios = <&gpio0 1 GPIO_ACTIVE_LOW>;

		ppg-time-integration = <MAXM86161_DT_117p3US>;
		ppg-adc-range = <MAXM86161_DT_16384NA>;
		ppg-sample-rate = <MAXM86161_DT_50p027SPS_1PPS>;
		ppg-sample-averaging = <MAXM86161_DT_SMP_AVG_1>;
		led-settling-time = <MAXM86161_DT_LED_SETTLNG_12US>;
		photodiode-bias-cap = <MAXM86161_DT_PD_BIAS_65PF_TO_130PF>;

		led1-range = <MAXM86161_DT_LED_RANGE_124MA>;
		led2-range = <MAXM86161_DT_LED_RANGE_124MA>;
		led3-range = <MAXM86161_DT_LED_RANGE_124MA>;
		led1-pulse-amplitude = <255>;
		led2-pulse-amplitude = <255>;
		led3-pulse-amplitude = <255>;

		fifo-watermark = <15>;
		fifo-rollover-mode = <MAXM86161_DT_FIFO_MODE_STREAM>;

		led-sequence-slot1 = <MAXM86161_DT_EXPOSURE_GREEN>;
		led-sequence-slot2 = <MAXM86161_DT_EXPOSURE_IR>;
		led-sequence-slot3 = <MAXM86161_DT_EXPOSURE_RED>;
		led-sequence-slot4 = <MAXM86161_DT_EXPOSURE_NONE>;
		led-sequence-slot5 = <MAXM86161_DT_EXPOSURE_NONE>;
		led-sequence-slot6 = <MAXM86161_DT_EXPOSURE_NONE>;
	};
};
