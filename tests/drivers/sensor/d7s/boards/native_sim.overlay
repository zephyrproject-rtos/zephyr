/*
 * Copyright (c) 2026 RAKwireless Technology Limited
 * SPDX-License-Identifier: Apache-2.0
 */

#include <zephyr/dt-bindings/gpio/gpio.h>

&i2c0 {
	status = "okay";

	d7s: d7s@55 {
		compatible = "omron,d7s";
		reg = <0x55>;
		int1-gpios = <&gpio0 2 GPIO_ACTIVE_LOW>;
		int2-gpios = <&gpio0 3 GPIO_ACTIVE_LOW>;
	};
};

/ {
	aliases {
		d7s = &d7s;
	};
};
