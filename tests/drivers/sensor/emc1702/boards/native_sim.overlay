/*
 * Copyright (c) 2026  Microchip Technology Inc. and its subsidiaries
 * SPDX-License-Identifier: Apache-2.0
 *
 */

&i2c0 {
	status = "okay";
	clock-frequency = <I2C_BITRATE_STANDARD>;

	emc1702_simulate_test: emc1702@4c {
		compatible = "microchip,emc1702";
		reg = <0x4c>;
		sense-resistor-milliohms = <10>;
		current-sense-range-mv = <10>;
		current-sense-sampling-time = <82>;
		current-sense-queue = <1>;
		voltage-source-queue = <1>;
		resistance-error-correction;
		conversion-rate = <4000>;
		external-diode-is-present;
		status = "okay";
	};
};
