/*
 * Copyright (c) 2026  Microchip Technology Inc. and its subsidiaries
 * SPDX-License-Identifier: Apache-2.0
 *
 */

&i2c0 {
	clock-frequency = <I2C_BITRATE_STANDARD>;
	status = "okay";

	emc1702_simulate_test: emc1702@4c {
		compatible = "microchip,emc1702";
		reg = <0x4c>;
		sense-resistor-milliohms = <10>;
		current-sense-range-mv = <10>;
		current-sense-sampling-time-ms = <82>;
		current-sense-queue = <1>;
		voltage-source-queue = <1>;
		resistance-error-correction;
		conversion-rate-mhz = <4000>;
		external-diode-is-present;
		alert-gpios = <&gpio0 10 (GPIO_ACTIVE_LOW | GPIO_PULL_UP)>;
		status = "okay";
	};
};
