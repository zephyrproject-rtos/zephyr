## tests/drivers/sensor/hc-sr04/testcase.yaml
```yaml
# Copyright (c) 2024 Adrien Leravat
# SPDX-License-Identifier: Apache-2.0

tests:
  drivers.sensor.hc-sr04:
    tags:
      - drivers
      - sensor
      - subsys
    platform_allow:
      - native_sim
```

## tests/drivers/sensor/icm42688/Kconfig
```kconfig
# Copyright (c) 2024 CogniPilot Foundation
# SPDX-License-Identifier: Apache-2.0

mainmenu "ICM42688 Test"

source "Kconfig.zephyr"

config ICM42688_TEST_EMUL
	bool "run emulation test"
```

## tests/drivers/sensor/icm42688/boards/vmu_rt1170_mimxrt1176_cm7.conf
```kconfig
CONFIG_ICM42688_TEST_EMUL=n
CONFIG_DEBUG=y
CONFIG_SPEED_OPTIMIZATIONS=n
CONFIG_SIZE_OPTIMIZATIONS=n
CONFIG_SENSOR_SHELL_STREAM=y
CONFIG_SENSOR_LOG_LEVEL_DBG=n
CONFIG_RTIO_SUBMIT_SEM=y
CONFIG_SPI_RTIO=y
CONFIG_SPI_ASYNC=y
CONFIG_SYS_CLOCK_TICKS_PER_SEC=10000
```

## tests/drivers/sensor/icm42688/testcase.yaml
```yaml
# Copyright (c) 2023 Google LLC
# SPDX-License-Identifier: Apache-2.0

common:
  tags:
    - drivers
    - sensor
    - subsys
  platform_allow:
    - native_sim

tests:
  drivers.sensor.icm42688.spi: {}
  drivers.sensor.icm42688.i2c:
    extra_dtc_overlay_files:
      - "./boards/native_sim_i2c.overlay"
```

## tests/drivers/sensor/ina228/testcase.yaml
```yaml
# Copyright (c) 2025 Jonas Berg
# SPDX-License-Identifier: Apache-2.0

tests:
  drivers.sensor.ina228:
    tags:
      - drivers
      - sensor
      - subsys
    platform_allow:
      - native_sim
```

## tests/drivers/sensor/ina237/testcase.yaml
```yaml
# Copyright (c) 2023 North River Systems Ltd
# SPDX-License-Identifier: Apache-2.0

tests:
  drivers.sensor.ina237:
    tags:
      - drivers
      - sensor
      - subsys
    platform_allow: native_posix
```

## tests/drivers/sensor/mtch9010/testcase.yaml
```yaml
# Copyright (c) 2025 Microchip Technology Inc.
# SPDX-License-Identifier: Apache-2.0

common:
  tags:
    - drivers
    - sensor
    - subsys
  platform_allow:
    - native_sim
tests:
  drivers.sensor.mtch9010_capacitive:
    extra_args: EXTRA_DTC_OVERLAY_FILE=./test_configs/operating_mode/capacitive.overlay
  drivers.sensor.mtch9010_conductive:
    extra_args: EXTRA_DTC_OVERLAY_FILE=./test_configs/operating_mode/conductive.overlay
  drivers.sensor.mtch9010_current_output:
    extra_args: EXTRA_DTC_OVERLAY_FILE=./test_configs/data_format/current.overlay
  drivers.sensor.mtch9010_delta_output:
    extra_args: EXTRA_DTC_OVERLAY_FILE=./test_configs/data_format/delta.overlay
  drivers.sensor.mtch9010_both_outputs:
    extra_args: EXTRA_DTC_OVERLAY_FILE=./test_configs/data_format/both.overlay
  drivers.sensor.mtch9010_data_visualizer_output:
    extra_args: EXTRA_DTC_OVERLAY_FILE=./test_configs/data_format/data_visualizer.overlay
  drivers.sensor.mtch9010_unspecified_output:
    extra_args: EXTRA_DTC_OVERLAY_FILE=./test_configs/data_format/unspecified.overlay
```

## tests/drivers/sensor/photosensor/testcase.yaml
```yaml
# Copyright (c) 2026 Nordic Semiconductor
# SPDX-License-Identifier: Apache-2.0

common:
  platform_allow:
    - native_sim
    - native_sim/native/64
  tags:
    - drivers
    - sensor
tests:
  drivers.sensor.photosensor.a:
    extra_args: FILE_SUFFIX=a
  drivers.sensor.photosensor.b:
    extra_args: FILE_SUFFIX=b
  drivers.sensor.photosensor.c:
    extra_args: FILE_SUFFIX=c
  drivers.sensor.photosensor.d:
    extra_args: FILE_SUFFIX=d
```

## tests/drivers/sensor/sbs_gauge/boards/native_posix.conf
```kconfig
# Copyright (c) 2022 Nordic Semiconductor ASA
# SPDX-License-Identifier: Apache-2.0

CONFIG_EMUL=y
CONFIG_EMUL_SBS_GAUGE=y
CONFIG_I2C=y
CONFIG_I2C_EMUL=y
```

## tests/drivers/sensor/sbs_gauge/boards/qemu_arc_hs.conf
```kconfig
# Copyright (c) 2023 Google LLC
# SPDX-License-Identifier: Apache-2.0

CONFIG_EMUL=y
```

## tests/drivers/sensor/sbs_gauge/testcase.yaml
```yaml
tests:
  # section.subsection
  drivers.sensor.sbs_gauge:
    build_only: true
    tags:
      - drivers
      - sensors
    filter:
      dt_compat_enabled("sbs,sbs-gauge") and not dt_compat_enabled("zephyr,i2c-emul-controller")
    integration_platforms:
      - nucleo_f070rb/stm32f070xb
  drivers.sensor.sbs_gauge.emulated:
    tags:
      - drivers
      - sensors
    filter: dt_compat_enabled("sbs,sbs-gauge")
    platform_allow:
      - native_sim/native
      - qemu_cortex_a9/xc7z007s
      - qemu_arc/qemu_arc_hs
    integration_platforms:
      - native_sim/native
    extra_configs:
      - CONFIG_EMUL=y
```

## tests/drivers/sensor/sensor_sim_async/testcase.yaml
```yaml
tests:
  sensor_sim_async.testing.ztest:
    tags:
      - drivers
      - sensors
    platform_allow:
      - native_sim
    sysbuild: true
```

## tests/drivers/sensor/shell/dts/bindings/dummy-sensor.yaml
```yaml
description: Dummy Sensor

compatible: "dummy-sensor"

properties:
  i2c-address:
    type: int
  i2c-name:
    type: string
```

## tests/drivers/sensor/shell/testcase.yaml
```yaml
tests:
  drivers.sensor.shell:
    tags:
      - drivers
      - sensor
      - shell
    platform_allow:
      - native_sim
      - qemu_x86
```

## tests/drivers/sensor/smart_battery/testcase.yaml
```yaml
tests:
  # section.subsection
  testing.drivers.smartbattery:
    build_only: true
    tags: test_framework
    filter: dt_alias_exists("bat0")
    integration_platforms:
      - nucleo_f070rb
```

## tests/drivers/sensor/temp_sensor/testcase.yaml
```yaml
tests:
  drivers.sensor.temp_sensor:
    tags:
      - drivers
      - sensors
    filter: dt_nodelabel_enabled("temp_sensor")
    integration_platforms:
      - nrf52840dk/nrf52840
      - nrf54h20dk/nrf54h20/cpuapp
```

## tests/drivers/sensor/thermistor/testcase.yaml
```yaml
tests:
  drivers.sensor.thermistor:
    depends_on: adc
    tags: sensors drivers temperature
    filter: dt_compat_enabled("infineon,thermistor")
    integration_platforms:
      - cy8cproto_062_4343w
```

## tests/drivers/sensor/tmp11x/testcase.yaml
```yaml
# Copyright (c) 2026 Junseo Pyun
# SPDX-License-Identifier: Apache-2.0

tests:
  drivers.sensor.tmp11x:
    tags:
      - drivers
      - sensor
    platform_allow:
      - native_sim
    integration_platforms:
      - native_sim
```

## tests/drivers/sensor/utils/testcase.yaml
```yaml
tests:
  drivers.sensor.utils:
    integration_platforms:
      - native_sim
    tags:
      - drivers
      - sensor
```

## tests/drivers/smbus/smbus_api/testcase.yaml
```yaml
common:
  depends_on:
    - smbus
  tags: smbus
tests:
  drivers.smbus.api.access.io:
    extra_configs:
      - CONFIG_SMBUS_INTEL_PCH_ACCESS_IO=y
  drivers.smbus.api.access.mmio:
    platform_exclude: qemu_x86_64
    extra_configs:
      - CONFIG_SMBUS_INTEL_PCH_ACCESS_MMIO=y
  drivers.smbus.api_user:
    extra_configs:
      - CONFIG_USERSPACE=y
  drivers.smbus.api_stats:
    extra_configs:
      - CONFIG_STATS=y
  drivers.smbus.api.no_smbalert:
    extra_configs:
      - CONFIG_SMBUS_INTEL_PCH_SMBALERT=n
  drivers.smbus.api.no_host_notify:
    extra_configs:
      - CONFIG_SMBUS_INTEL_PCH_HOST_NOTIFY=n
  drivers.smbus.api.debug:
    extra_configs:
      - CONFIG_SMBUS_LOG_LEVEL_DBG=y
```

## tests/drivers/smbus/smbus_emul/testcase.yaml
```yaml
common:
  platform_allow:
    - native_sim
  integration_platforms:
    - native_sim
tests:
  drivers.smbus.emul:
    tags: smbus
  drivers.smbus.emul.peripheral.interrupt:
    tags: smbus
    extra_args: EXTRA_CFLAGS=-DPERIPHERAL_INT=1
```

## tests/drivers/spi/dt_spec/testcase.yaml
```yaml
tests:
  drivers.spi.dt_spec:
    tags: drivers spi devicetree gpio
    depends_on: spi gpio
```

## tests/drivers/spi/spi_basic_api/testcase.yaml
```yaml
tests:
  test_spi:
    platform_whitelist: quark_se_c1000_devboard quark_d2000_crb
      galileo frdm_k64f
    tags: apps
```
