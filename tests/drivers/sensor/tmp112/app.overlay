/*
 * Copyright (c) 2026, Iomico
 *
 * SPDX-License-Identifier: Apache-2.0
 */

&i2c0 {
	status = "okay";

	tmp112: temperature-sensor@48 {
		compatible = "ti,tmp112";
		reg = <0x48>;
		conversion-rate = <0>;
	};
};
