/* Copyright (c) 2026 Arkadiusz Grzelka
 * SPDX-License-Identifier: Apache-2.0
 */

/ {
	aliases {
		lsm6dsl = &lsm6dsl;
	};
};

&i2c0 {
	status = "okay";

	lsm6dsl: lsm6dsl@6a {
		compatible = "st,lsm6dsl";
		reg = <0x6a>;
		irq-gpios = <&gpio0 1 GPIO_ACTIVE_HIGH>;
	};
};
