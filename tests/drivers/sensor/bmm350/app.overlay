/* Copyright (c) 2026 Meta Platforms
 * SPDX-License-Identifier: Apache-2.0
 */

#include <zephyr/dt-bindings/gpio/gpio.h>

&i2c0 {
	bmm350: bmm350@14 {
		compatible = "bosch,bmm350";
		reg = <0x14>;
		drdy-gpios = <&gpio0 0 GPIO_ACTIVE_HIGH>;
	};
};
