/*
 * Copyright 2021 Google LLC
 *
 * SPDX-License-Identifier: Apache-2.0
 */

&espi0 {
	espi_host: espi-host@0 {
		status = "okay";
		compatible = "zephyr,espi-emul-espi-host";
		reg = <0x0>;
	};
};
