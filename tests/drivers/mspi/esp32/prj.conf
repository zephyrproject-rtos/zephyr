## CMakeLists.txt
```
# SPDX-License-Identifier: Apache-2.0
# SPDX-FileCopyrightText: Copyright The Zephyr Project Contributors

cmake_minimum_required(VERSION 3.20.0)
find_package(Zephyr REQUIRED HINTS $ENV{ZEPHYR_BASE})
project(mspi_esp32)
target_sources(app PRIVATE src/main.c)
```

## prj.conf
```kconfig
# SPDX-License-Identifier: Apache-2.0
# SPDX-FileCopyrightText: Copyright The Zephyr Project Contributors

CONFIG_ZTEST=y
CONFIG_SPI=n
CONFIG_MSPI=y
CONFIG_MSPI_ESP32=y
CONFIG_HEAP_MEM_POOL_SIZE=4096
```

## app.overlay
```dts
/* SPDX-License-Identifier: Apache-2.0 */
/* SPDX-FileCopyrightText: Copyright The Zephyr Project Contributors */
&spi2 {
	compatible = "espressif,esp32-mspi";
	peripheral-id = <0>;
	clock-frequency = <10000000>;
	/* Exercise the documented fallback to peripheral-id. */
	/delete-property/ dma-host;
};

&spi3 {
	status = "disabled";
};
```

## polling.overlay
```dts
/* SPDX-License-Identifier: Apache-2.0 */
/* SPDX-FileCopyrightText: Copyright The Zephyr Project Contributors */
&spi2 {
	/delete-property/ interrupts;
};
```

## src/main.c
```c
/* SPDX-License-Identifier: Apache-2.0 */
/* SPDX-FileCopyrightText: Copyright The Zephyr Project Contributors */

#include <zephyr/device.h>
#include <zephyr/drivers/mspi.h>
#include <zephyr/ztest.h>

static const struct device *const controller = DEVICE_DT_GET(DT_NODELABEL(spi2));

ZTEST(mspi_esp32, test_idle_channel)
{
	zassert_true(device_is_ready(controller));
	/* Exercise the public API, which dispatches through get_channel_status. */
	zassert_ok(mspi_get_channel_status(controller, 0));
}

ZTEST(mspi_esp32, test_invalid_channel)
{
	zassert_equal(mspi_get_channel_status(controller, 1), -EINVAL);
}

ZTEST_SUITE(mspi_esp32, NULL, NULL, NULL, NULL, NULL);
```
