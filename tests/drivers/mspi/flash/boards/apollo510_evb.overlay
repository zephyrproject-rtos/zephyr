/*
 * Copyright (c) 2025, Ambiq Micro Inc. <www.ambiq.com>
 *
 * SPDX-License-Identifier: Apache-2.0
 */

/ {
	aliases {
		mspi0 = &mspi1;
	};
};

&mspi1 {
	status = "okay";
};

&is25wx064 {
	status = "okay";
};
