/*
 * Copyright (c) 2026 STMicroelectronics
 *
 * SPDX-License-Identifier: Apache-2.0
 */

/ {
	aliases {
		mspi0 = &octospi2;
	};
};

/* Delete the ext_flash_ctrl since MSPI_MAX_DEVICE is 1 */
/delete-node/ &ext_flash_ctrl;

&octospi2 {
	mspi_device: mspi_device@0 {
		status = "okay";
		compatible = "zephyr,emul-device-mspi";
		reg = <0x0>;
		mspi-max-frequency = <48000000>;
	};
};
