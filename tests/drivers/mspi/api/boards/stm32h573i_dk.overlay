/*
 * Copyright (c) 2026 STMicroelectronics
 *
 * SPDX-License-Identifier: Apache-2.0
 */

/ {
	aliases {
		mspi0 = &xspi1;
	};
};

/* Delete the ext_flash_ctrl since MSPI_MAX_DEVICE is 1 */
/delete-node/ &ext_flash_ctrl;

&xspi1 {
	mspi_device: mspi_device@0 {
		status = "okay";
		compatible = "zephyr,emul-device-mspi";
		reg = <0x0>;
		mspi-max-frequency = <DT_FREQ_M(48)>;
	};
};
