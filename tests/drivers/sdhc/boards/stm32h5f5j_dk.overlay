/*
 * Copyright (c) 2026 EXALT Technologies
 *
 * SPDX-License-Identifier: Apache-2.0
 */

/ {
	aliases {
		sdhc0 = &sdhc;
	};
};

sdhc: &sdmmc1 {
	pinctrl-0 = <&sdmmc1_d0_pc8 &sdmmc1_d1_pf7
		     &sdmmc1_d2_pc10 &sdmmc1_d3_pc11
		     &sdmmc1_ck_pk8 &sdmmc1_cmd_pk7>;
	pinctrl-names = "default";
	disk-name = "SD";
	bus-width = <4>;
	hw-flow-control;
	min-bus-freq = <DT_FREQ_K(400)>;
	max-bus-freq = <DT_FREQ_M(208)>;
	status = "okay";

	sdmmc {
		compatible = "zephyr,sdmmc-disk";
		disk-name = "SD";
		status = "okay";
	};
};
