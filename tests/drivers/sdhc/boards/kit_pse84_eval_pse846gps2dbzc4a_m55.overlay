/*
 * Copyright (c) 2025 Infineon Technologies AG,
 * or an affiliate of Infineon Technologies AG.
 *
 * SPDX-License-Identifier: Apache-2.0
 */

/ {
	aliases {
		sdhc0 = &sdhc1;
	};
};

&sdhc1 {
	status = "okay";
};
