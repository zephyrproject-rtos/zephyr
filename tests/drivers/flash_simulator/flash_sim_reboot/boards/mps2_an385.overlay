#include <mem.h>

/ {
	sram_203F0000:sram@203F0000 {
		compatible = "zephyr,memory-region", "mmio-sram";
		reg = <0x203F0000 0x10000>;
		zephyr,memory-region = "FlashSim";
		status = "okay";
	};

	sim_flash_controller: sim_flash_controller {
		compatible = "zephyr,sim-flash";

		#address-cells = <1>;
		#size-cells = <1>;
		erase-value = <0xff>;
		memory-region = <&sram_203F0000>;

		flash_sim0: flash_sim@0 {
			compatible = "soc-nv-flash";
			reg = <0x00000000 0x10000>;

			erase-block-size = <1024>;
			write-block-size = <4>;
		};
	};
};
