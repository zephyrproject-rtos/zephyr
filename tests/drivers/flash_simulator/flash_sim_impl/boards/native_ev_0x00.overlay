/*
 * Copyright (c) 2020 Nordic Semiconductor ASA
 *
 * SPDX-License-Identifier: Apache-2.0
 */

&flashcontroller0 {
	erase-value = <0x00>;
};

&flash0 {
	reg = <0x00000000 DT_SIZE_K(1024)>;
	erase-block-size = <1024>;
	write-block-size = <4>;
};
