/*
 * SPDX-FileCopyrightText: 2026 NXP
 *
 * SPDX-License-Identifier: Apache-2.0
 */

/ {
	clock-monitor-test {
		compatible = "test-clock-monitor";

		/* fmeas: NXP FREQME (BASIC), MEASURE mode; measures FFRO.
		 * FFRO is 48 or 60 MHz depending on board clock init.
		 */
		fmeas {
			monitor = <&fmeas>;
			measure-expected-hz = <48000000>;
		};
	};
};

&fmeas {
	status = "okay";
};
