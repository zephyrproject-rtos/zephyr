/*
 * SPDX-FileCopyrightText: 2026 NXP
 *
 * SPDX-License-Identifier: Apache-2.0
 */

/* freqme0 is enabled and fully configured (clocks, INPUTMUX routing) at the
 * SoC / board devicetree level; the test only supplies the fixture node.
 * freqme0 supports both WINDOW and MEASURE, so it is listed once.
 */

#include <zephyr/dt-bindings/clock-monitor/nxp-freqme.h>

/ {
	clock-monitor-test {
		compatible = "test-clock-monitor";

		/*
		 * Reference = 24 MHz system OSC, target = FRO1 (~192 MHz), so the
		 * measured value is ~192 MHz.
		 */
		freqme {
			monitor = <&freqme0>;
			measure-expected-hz = <192000000>;
			/* set_source() test: switch reference to FRO1 (target
			 * stays FRO1, ~192 MHz), then target to the system OSC
			 * (~24 MHz).
			 */
			switch-reference = <NXP_FREQME_RT7XX_REF_FRO1>;
			switch-target = <NXP_FREQME_RT7XX_TAR_OSC_CLK>;
			switch-target-expected-hz = <24000000>;
		};
	};
};
