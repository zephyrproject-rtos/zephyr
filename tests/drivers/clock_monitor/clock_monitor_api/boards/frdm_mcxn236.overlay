/*
 * SPDX-FileCopyrightText: 2026 NXP
 *
 * SPDX-License-Identifier: Apache-2.0
 */

/* freqme0 is enabled and INPUTMUX-routed at the SoC / board devicetree level;
 * the test supplies the fixture node. freqme0 supports both WINDOW and MEASURE,
 * so it is listed once.
 */

#include <zephyr/dt-bindings/clock/mcux_lpc_syscon_clock.h>
#include <zephyr/dt-bindings/clock-monitor/nxp-freqme.h>

/ {
	test-required-clocks {
		compatible = "test-required-clocks";
		clocks = <&syscon MCUX_FRO_12M_CLK>,
			 <&syscon MCUX_FRO_HF_CLK>;
	};

	clock-monitor-test {
		compatible = "test-clock-monitor";

		/*
		 * Reference = 150 MHz CPU/AHB clock, target = FRO_12M, so the
		 * measured value is ~12 MHz.
		 */
		freqme {
			monitor = <&freqme0>;
			measure-expected-hz = <12000000>;
			/* set_source() test: switch reference to FRO_HF (target
			 * stays FRO_12M, ~12 MHz), then target to FRO_HF
			 * (48 MHz: FRO_HF, per board.c).
			 */
			switch-reference = <NXP_FREQME_MCXN_REF_FRO_HF>;
			switch-target = <NXP_FREQME_MCXN_TAR_FRO_HF>;
			switch-target-expected-hz = <48000000>;
		};
	};
};
