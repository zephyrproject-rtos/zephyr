/*
 * Copyright 2025 NXP
 *
 * SPDX-License-Identifier: Apache-2.0
 */

#include <zephyr/dt-bindings/gpio/gpio.h>

/ {
	aliases {
		test-comp = &lpcmp0;
	};

	zephyr,user {
		test-gpios = <&gpio1 2 GPIO_ACTIVE_HIGH>; /* FRDM-MCXN236 J2-10 */
	};
};

&lpcmp0 {
	status = "okay";
	pinctrl-0 = <&pinmux_lpcmp0>;
	pinctrl-names = "default";
	positive-mux-input = "IN0"; /* FRDM-MCXN236 J2-8 */
	negative-mux-input = "DAC";
	dac-value = <127>;
	dac-vref-source = "VREFH1";
};
