/*
 * Copyright (c) 2024 Silicon Labs
 *
 * SPDX-License-Identifier: Apache-2.0
 */

#include <zephyr/dt-bindings/gpio/gpio.h>
#include <zephyr/dt-bindings/comparator/silabs/silabs-acmp.h>

/ {
	aliases {
		test-comp = &acmp0;
	};

	zephyr,user {
		test-gpios = <&gpioc 3 GPIO_ACTIVE_HIGH>;
	};

};

&acmp0 {
	status = "okay";
	hysteresis-mode = "disabled";
	accuracy-mode = "high";
	input-range = "full";
	input-positive = <ACMP_INPUT_PC3>;
	input-negative = <ACMP_INPUT_VREFDIV1V25>;
	vref-divider = <63>;
};
