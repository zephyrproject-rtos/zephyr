/*
 * Copyright 2025 NXP
 *
 * SPDX-License-Identifier: Apache-2.0
 */

#include <zephyr/dt-bindings/gpio/gpio.h>

/* To test this case, please connect J3-1(P2_7,VREFI) to JP8-2(VDD). */
/ {
	aliases {
		test-comp = &lpcmp0;
	};

	zephyr,user {
		test-gpios = <&gpio1 5 GPIO_ACTIVE_HIGH>; /* FRDM-MCXA153 J2-3 */
	};
};

&lpcmp0 {
	status = "okay";
	pinctrl-0 = <&pinmux_lpcmp0>;
	pinctrl-names = "default";
	positive-mux-input = "IN0"; /* FRDM-MCXA153 J2-9 */
	negative-mux-input = "DAC";
	dac-value = <127>;
	dac-vref-source = "VREFH1";
};
