/*
 * Copyright (c) 2025 Nordic Semiconductor
 *
 * SPDX-License-Identifier: Apache-2.0
 */

#include <zephyr/dt-bindings/gpio/gpio.h>

/*
 * P1.30 looped back to P1.31 (AIN1)
 */

/ {
	aliases {
		test-comp = &comp;
	};

	zephyr,user {
		test-gpios = <&gpio1 30 GPIO_ACTIVE_HIGH>;
	};
};

&gpio1 {
	status = "okay";
};
