/*
 * Copyright (c) 2024 Nordic Semiconductor
 *
 * SPDX-License-Identifier: Apache-2.0
 */

#include <zephyr/dt-bindings/gpio/gpio.h>

/*
 * P1.10 looped back to P1.11
 */

/ {
	aliases {
		test-comp = &comp;
	};

	zephyr,user {
		test-gpios = <&gpio1 10 GPIO_ACTIVE_HIGH>;
	};
};

&gpio1 {
	status = "okay";
};
