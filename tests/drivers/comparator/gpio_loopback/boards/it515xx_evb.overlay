/*
 * Copyright (c) 2025 ITE Technology Corporation
 *
 * SPDX-License-Identifier: Apache-2.0
 */

#include <zephyr/dt-bindings/gpio/gpio.h>

/ {
	aliases {
		test-comp = &vcmp1;
	};

	zephyr,user {
		test-gpios = <&gpioa 1 GPIO_ACTIVE_HIGH>;
	};
};

&vcmp1 {
	status = "okay";
	threshold-mv = <1500>;
	scan-period = <0x4>;
	io-channels = <&adc0 3>;
};
