/*
 * Copyright (c) 2025 Nordic Semiconductor
 *
 * SPDX-License-Identifier: Apache-2.0
 */

&comp {
	compatible = "nordic,nrf-lpcomp";
	psel = "AIN1"; /* P1.31 */
	refsel = "VDD_4_8";
	status = "okay";
};
