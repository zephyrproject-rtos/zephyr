/*
 * Copyright (c) 2024 Nordic Semiconductor
 * Copyright (c) 2025 Ezurio LLC
 *
 * SPDX-License-Identifier: Apache-2.0
 */

&comp {
	compatible = "nordic,nrf-lpcomp";
	psel = "AIN4"; /* P1.11 */
	refsel = "VDD_4_8";
	status = "okay";
};
