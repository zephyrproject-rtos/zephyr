/*
 * Copyright (c) 2024 Nordic Semiconductor
 *
 * SPDX-License-Identifier: Apache-2.0
 */

&comp {
	main-mode = "SE";
	psel = "AIN2"; /* P1.02 */
	refsel = "INT_1V2";
	sp-mode = "HIGH";
	th-up = <63>;
	th-down = <59>;
	isource = "DISABLED";
	status = "okay";
};
