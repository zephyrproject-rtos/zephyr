/*
 * Copyright (c) 2026 Nordic Semiconductor
 *
 * SPDX-License-Identifier: Apache-2.0
 */

#include <zephyr/dt-bindings/comparator/nrf-comp.h>

&comp {
	main-mode = "SE";
	psel = <NRF_COMP_AIN0>; /* P0.00 */
	refsel = "INT_1V2";
	sp-mode = "HIGH";
	th-up = <63>;
	th-down = <59>;
	isource = "DISABLED";
	status = "okay";
};
