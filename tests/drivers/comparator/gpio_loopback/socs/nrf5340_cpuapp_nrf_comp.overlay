/*
 * Copyright (c) 2024 Nordic Semiconductor
 *
 * SPDX-License-Identifier: Apache-2.0
 */

#include <zephyr/dt-bindings/comparator/nrf-comp.h>

&comp {
	main-mode = "SE";
	psel = <NRF_COMP_AIN0>; /* P0.04 */
	refsel = "VDD";
	sp-mode = "HIGH";
	th-up = <34>;
	th-down = <30>;
	isource = "DISABLED";
	status = "okay";
};
