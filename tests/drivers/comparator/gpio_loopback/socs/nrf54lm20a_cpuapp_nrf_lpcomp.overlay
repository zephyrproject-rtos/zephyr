/*
 * Copyright (c) 2025 Nordic Semiconductor
 *
 * SPDX-License-Identifier: Apache-2.0
 */

#include <zephyr/dt-bindings/comparator/nrf-comp.h>

&comp {
	compatible = "nordic,nrf-lpcomp";
	psel = <NRF_COMP_AIN1>; /* P1.31 */
	refsel = "VDD_4_8";
	status = "okay";
};
