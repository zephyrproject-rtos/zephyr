/*
 * Copyright (c) 2026 Espressif Systems (Shanghai) Co., Ltd.
 *
 * SPDX-License-Identifier: Apache-2.0
 */

&timer0 {
	status = "okay";

	counter_pm: counter {
		status = "okay";
	};
};

/ {
	aliases {
		counter-pm = &counter_pm;
	};
};
