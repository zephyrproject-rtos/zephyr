/*
 * Copyright (c) 2025 Microchip Technology Inc.
 *
 * SPDX-License-Identifier: Apache-2.0
 */

/ {
	aliases {
		rtc-0 = &rtc;
	};
};

&rtc {
	status = "okay";
	compatible = "microchip,rtc-g1-counter";
	max-bit-width = <32>;
	prescaler = <1024>;
};
