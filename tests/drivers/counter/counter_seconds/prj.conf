## CMakeLists.txt
```
# Copyright (c) 2019 Intel Corp.
# SPDX-License-Identifier: Apache-2.0

cmake_minimum_required(VERSION 3.28.0)

find_package(Zephyr REQUIRED HINTS $ENV{ZEPHYR_BASE})
project(counter_seconds)

target_sources(app PRIVATE src/main.c)
```

## prj.conf
```kconfig
CONFIG_COUNTER=y
CONFIG_ZTEST=y
CONFIG_ZTEST_NEW_API=y
```

## boards/mimxrt1064_evk.conf
```kconfig
CONFIG_COUNTER_MCUX_SNVS=y
```

## boards/mimxrt1064_evk_mimxrt1064.overlay
```dts
/* Copyright (c) 2021 Basalte bv
 * SPDX-License-Identifier: Apache-2.0
 */

/ {
	aliases {
		rtc-0 = &snvs_rtc;
	};
};

&snvs_rtc {
	status = "okay";
};
```

## boards/pic32cm_jh01_cpro.overlay
```dts
/*
 * SPDX-FileCopyrightText: Copyright (c) 2026 Microchip Technology Inc.
 * SPDX-License-Identifier: Apache-2.0
 */

/ {
	aliases {
		rtc-0 = &rtc;
	};
};

/* Use the 1 kHz RTC clock source so that, with the /1024 prescaler below,
 * the counter ticks at 1024 / 1024 = 1 Hz (1 tick == 1 second), which is
 * what the counter_seconds test expects. The binding default (XOSC32K,
 * 32768 Hz) would give 32768 / 1024 = 32 Hz and bust the test's bounds.
 */
&rtcclock {
	rtc-src = "ULP1K";
};

&rtc {
	compatible = "microchip,rtc-g1-counter";
	max-bit-width = <32>;
	prescaler = <1024>;
	status = "okay";
};
```

## boards/pic32cx_sg41_cult.overlay
```dts
/*
 * SPDX-FileCopyrightText: Copyright 2026 Microchip Technology Inc.
 * SPDX-License-Identifier: Apache-2.0
 */

/ {
	aliases {
		rtc-0 = &rtc;
	};
};

&rtc {
	compatible = "microchip,rtc-g1-counter";
	max-bit-width = <32>;
	prescaler = <1024>;
	status = "okay";
};
```

## boards/pic32cx_sg61_cult.overlay
```dts
/*
 * Copyright (c) 2026 Microchip Technology Inc.
 *
 * SPDX-License-Identifier: Apache-2.0
 */

/ {
	aliases {
		rtc-0 = &rtc;
	};
};

&rtc {
	compatible = "microchip,rtc-g1-counter";
	max-bit-width = <32>;
	prescaler = <1024>;
	status = "okay";
};
```

## boards/sam_e54_xpro.overlay
```dts
/*
 * Copyright (c) 2026 Microchip Technology Inc.
 *
 * SPDX-License-Identifier: Apache-2.0
 */

&rtc {
	status = "okay";
	compatible = "microchip,rtc-g1-counter";
	max-bit-width = <32>;
	prescaler = <1024>;
};
```

## src/main.c
```c
/*
 * Copyright (c) 2019 Intel Corp.
 * SPDX-License-Identifier: Apache-2.0
 */

#include <zephyr/drivers/counter.h>
#include <zephyr/ztest.h>
#include <zephyr/kernel.h>

/*
 * Basic test to ensure that the clock is ticking at roughly 1Hz.
 */

#ifdef CONFIG_COUNTER_CMOS
#define CTR_DEV		DT_COMPAT_GET_ANY_STATUS_OKAY(motorola_mc146818)
#else
#define CTR_DEV		DT_ALIAS(rtc_0)
#endif

#define DELAY_MS 1200	/* pause 1.2 seconds should always pass */
#define MIN_BOUND 1	/* counter must report at least MIN_BOUND .. */
#define MAX_BOUND 2	/* .. but at most MAX_BOUND seconds elapsed */

ZTEST(seconds_counter, test_seconds_rate)
{
	const struct device *const dev = DEVICE_DT_GET(CTR_DEV);
	const struct counter_driver_api *api = DEVICE_API_GET(counter, dev);
	uint32_t start, elapsed;
	int err;

	zassert_true(device_is_ready(dev), "counter device is not ready");

	if (api->start != NULL) {
		err = counter_start(dev);
		zassert_equal(0, err, "counter_start failed");
	} else {
		TC_PRINT("counter_start not supported (free-running)\n");
	}

	err = counter_get_value(dev, &start);
	zassert_true(err == 0, "failed to read counter device");

	k_msleep(DELAY_MS);

	err = counter_get_value(dev, &elapsed);
	zassert_true(err == 0, "failed to read counter device");
	elapsed -= start;

	zassert_true(elapsed >= MIN_BOUND, "busted minimum bound");
	zassert_true(elapsed <= MAX_BOUND, "busted maximum bound");
}

ZTEST_SUITE(seconds_counter, NULL, NULL, NULL, NULL, NULL);
```
