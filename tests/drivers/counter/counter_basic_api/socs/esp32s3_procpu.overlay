/*
 * Copyright (c) 2025 Espressif Systems (Shanghai) Co., Ltd.
 *
 * SPDX-License-Identifier: Apache-2.0
 */

&timer0 {
	status = "okay";
	counter {
		status = "okay";
	};
};

&rtc_timer {
	status = "okay";
};

&clock {
	slow-clk-src = <ESP32_RTC_SLOW_CLK_SRC_RC_FAST_D256>;
};
