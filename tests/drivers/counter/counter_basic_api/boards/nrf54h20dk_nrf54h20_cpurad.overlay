/* SPDX-License-Identifier: Apache-2.0 */

#include "nrf54h20dk_nrf54h20_common.dtsi"

&timer020 {
	prescaler = <7>;
	status = "okay";
};

&timer021 {
	prescaler = <7>;
	status = "okay";
};

&timer022 {
	prescaler = <7>;
	status = "okay";
};

&rtc {
	status = "okay";
};
