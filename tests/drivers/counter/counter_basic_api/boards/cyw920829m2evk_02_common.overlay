/*
 * SPDX-FileCopyrightText: <text>Copyright (c) 2026 Infineon Technologies AG,
 * or an affiliate of Infineon Technologies AG. All rights reserved.</text>
 *
 * SPDX-License-Identifier: Apache-2.0
 */

#include <zephyr/dt-bindings/pwm/pwm_ifx_tcpwm.h>

&tcpwm0_1 {
	status = "okay";

	counter0_1 {
		status = "okay";
		/*
		 * Use the highest group1 16-bit divider channel. The console
		 * UART's legacy CAT1 HAL dynamically allocates the lowest free
		 * group1 16-bit divider (peri0_group1_16bit_0) for its baud
		 * clock, which would otherwise clobber the counter's divider
		 * and run it at ~923 kHz instead of the configured 10 kHz.
		 */
		clocks = <&peri0_group1_16bit_3>;
	};
};

&peri0_group1_16bit_3 {
	status = "okay";
	clock-div = <9599>;
};
