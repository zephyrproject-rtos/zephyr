/*
 * SPDX-FileCopyrightText: Copyright 2026 Microchip Technology Inc.
 * SPDX-License-Identifier: Apache-2.0
 */

&tc5 {
	compatible = "microchip,tc-g1-counter";
	max-bit-width = <16>;
	prescaler = <64>;
	status = "okay";
};

&tc0 {
	status = "disabled";  /* TC0 shares IRQ 20 with TC5 */
};
