/*****************************************************************************
 * SPDX-FileCopyrightText: 2025 Ambiq Micro Inc.
 *
 * SPDX-License-Identifier: Apache-2.0
 ***************************************************************************
 */

&timer0 {
	counter0: counter {
		status = "okay";
	};
};
