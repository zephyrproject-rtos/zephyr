/*
 * Copyright 2025 NXP
 *
 * SPDX-License-Identifier: Apache-2.0
 */

&pit_0_channel0 {
	status = "okay";
};

&pit_0_channel1 {
	status = "okay";
};

&pit_0_channel2 {
	status = "okay";
};

&pit_0_channel3 {
	status = "okay";
};
