## tests/drivers/counter/counter_basic_api/boards/nrf52840_pca10056.conf
```kconfig
CONFIG_COUNTER_TIMER0=y
CONFIG_COUNTER_TIMER0_PRESCALER=4
CONFIG_COUNTER_TIMER1=y
CONFIG_COUNTER_TIMER1_PRESCALER=4
CONFIG_COUNTER_TIMER2=y
CONFIG_COUNTER_TIMER2_PRESCALER=4
CONFIG_COUNTER_TIMER3=y
CONFIG_COUNTER_TIMER3_PRESCALER=4
CONFIG_COUNTER_TIMER4=y
CONFIG_COUNTER_TIMER4_PRESCALER=4
CONFIG_COUNTER_RTC0=y
CONFIG_COUNTER_RTC2=y
```

## tests/drivers/counter/counter_basic_api/boards/nrf52840dk_nrf52840.conf
```kconfig
CONFIG_COUNTER_TIMER0=y
CONFIG_COUNTER_TIMER1=y
CONFIG_COUNTER_TIMER2=y
CONFIG_COUNTER_TIMER3=y
CONFIG_COUNTER_TIMER4=y
CONFIG_COUNTER_RTC0=y
CONFIG_COUNTER_RTC2=y
```

## tests/drivers/counter/counter_basic_api/boards/nrf52840dk_nrf52840_zli.conf
```kconfig
CONFIG_COUNTER_TIMER0=y
CONFIG_COUNTER_TIMER0_ZLI=y
CONFIG_COUNTER_TIMER1=y
CONFIG_COUNTER_TIMER1_ZLI=y
CONFIG_COUNTER_TIMER2=y
CONFIG_COUNTER_TIMER2_ZLI=y
CONFIG_COUNTER_TIMER3=y
CONFIG_COUNTER_TIMER3_ZLI=y
CONFIG_COUNTER_TIMER4=y
CONFIG_COUNTER_TIMER4_ZLI=y
CONFIG_COUNTER_RTC0=y
CONFIG_COUNTER_RTC0_ZLI=y
CONFIG_COUNTER_RTC2=y
CONFIG_COUNTER_RTC2_ZLI=y
```

## tests/drivers/counter/counter_basic_api/boards/rtl8752h_evb_rtl8752hjl.conf
```kconfig
# Copyright (c) 2026, Realtek Semiconductor Corporation
# SPDX-License-Identifier: Apache-2.0

CONFIG_TEST_DRIVER_COUNTER_TOLERANCE=20
```

## tests/drivers/counter/counter_basic_api/testcase.yaml
```yaml
tests:
  drivers.counter.basic_api:
    tags:
      - drivers
      - counter
    depends_on: counter
    min_ram: 16
    platform_exclude:
      - nucleo_f302r8
      - sam_e54_xpro
      - pic32cx_sg41_cult
    timeout: 600
  drivers.counter.basic_api.nrf_zli:
    tags:
      - drivers
      - counter
    depends_on: counter
    platform_allow:
      - nrf52840dk/nrf52840
    timeout: 400
    extra_configs:
      - CONFIG_ZERO_LATENCY_IRQS=y
    extra_args:
      DTC_OVERLAY_FILE="boards/nrf52840dk_nrf52840.overlay;boards/nrf52840dk_nrf52840_zli.overlay"
  drivers.counter.basic_api.stm32_subsec:
    tags:
      - drivers
      - counter
    depends_on: counter
    platform_allow:
      - nucleo_f429zi
      - nucleo_wba55cg
      - google_dragonclaw
    timeout: 600
    extra_configs:
      - CONFIG_COUNTER_RTC_STM32_SUBSECONDS=y
  drivers.counter.basic_api.rtc_1khz:
    tags:
      - drivers
      - counter
    depends_on: counter
    platform_allow: mimxrt685_evk/mimxrt685s/cm33
    timeout: 400
    extra_args:
      DTC_OVERLAY_FILE="boards/mimxrt685_evk_rtc_1khz.overlay"
  drivers.counter.basic_api.standby.lpc_rtc_highres:
    tags:
      - drivers
      - counter
    depends_on: counter
    platform_allow: frdm_rw612
    timeout: 400
    extra_configs:
      - CONFIG_TEST_DRIVER_COUNTER_MCUX_LPC_RTC_HIGHRES=n
    extra_args:
      DTC_OVERLAY_FILE="enable_standby.overlay"
  drivers.counter.basic_api.mcux_lptmr_alarm:
    tags:
      - drivers
      - counter
    filter: dt_compat_enabled("nxp,lptmr")
    depends_on: counter
    timeout: 600
    extra_configs:
      - CONFIG_COUNTER_MCUX_LPTMR_ALARM=y
  drivers.counter.basic_api.mchp_tcc1:
    tags:
      - drivers
      - counter
    depends_on: counter
    platform_allow: sam_e54_xpro
    timeout: 600
    extra_args:
      DTC_OVERLAY_FILE="boards/microchip/sam_e54_xpro_tcc1.overlay"
  drivers.counter.basic_api.mchp_tcc2:
    tags:
      - drivers
      - counter
    depends_on: counter
    platform_allow:
      - sam_e54_xpro
      - pic32cx_sg41_cult
    timeout: 600
    extra_args:
      DTC_OVERLAY_FILE="boards/microchip/sam_e54_xpro_tcc2.overlay"
  drivers.counter.basic_api.mchp_tcc3:
    tags:
      - drivers
      - counter
    depends_on: counter
    platform_allow: sam_e54_xpro
    timeout: 600
    extra_args:
      DTC_OVERLAY_FILE="boards/microchip/sam_e54_xpro_tcc3.overlay"
  drivers.counter.basic_api.mchp_tcc4:
    tags:
      - drivers
      - counter
    depends_on: counter
    platform_allow: sam_e54_xpro
    timeout: 600
    extra_args:
      DTC_OVERLAY_FILE="boards/microchip/sam_e54_xpro_tcc4.overlay"
```

## tests/drivers/counter/counter_capture/boards/mimxrt1064_evk.conf
```kconfig
CONFIG_COUNTER_CAPTURE_MCUX_QTMR_XBAR_LOOPBACK=y
CONFIG_COUNTER_CAPTURE_TOLERANCE_US=1000
```

## tests/drivers/counter/counter_capture/dts/bindings/test-counter-capture.yaml
```yaml
#
# Copyright (c) 2026 Meta Platforms
#
# SPDX-License-Identifier: Apache-2.0
#

description: |
    This binding provides resources required to build and run the
    tests/drivers/counter/counter_capture test in Zephyr.

compatible: "test-counter-capture"

properties:
  test-counter-captures:
    type: phandle-array
    required: true
    description: |
      Counter pins that will be used for capturing a rising and falling edge of a
      gpio signal. The first index is the channel number.
```

## tests/drivers/counter/counter_capture/testcase.yaml
```yaml
tests:
  drivers.counter.capture:
    tags:
      - drivers
      - counter
      - gpio
    depends_on: counter
    filter: dt_compat_enabled("test-counter-capture")
    min_ram: 16
    timeout: 600
```

## tests/drivers/counter/counter_conversions/Kconfig
```kconfig
# Copyright 2026 NXP
# SPDX-License-Identifier: Apache-2.0

config TEST_COUNTER_64BITS_FREQ
	bool "Test with 64-bit counter frequency API"
	select COUNTER_64BITS_FREQ
	help
	  Exercise the conversion helpers with the 64-bit frequency
	  configuration, which is otherwise only selectable by counter
	  drivers whose frequency exceeds UINT32_MAX.

source "Kconfig.zephyr"
```

## tests/drivers/counter/counter_generic/boards/nrf9160_pca10090.conf
```kconfig
CONFIG_COUNTER_TIMER0=y
CONFIG_COUNTER_TIMER1=y
CONFIG_COUNTER_TIMER2=y
CONFIG_COUNTER_RTC0=y
```

## tests/drivers/counter/counter_generic/testcase.yaml
```yaml
tests:
  peripheral.counter:
    tags: drivers
    platform_whitelist: nrf51_pca10028 nrf52840_pca10056
    min_ram: 16
```

## tests/drivers/counter/counter_nrf_rtc/fixed_top/testcase.yaml
```yaml
tests:
  drivers.counter.nrf_rtc:
    tags:
      - drivers
      - counter
    depends_on: counter
    platform_allow:
      - nrf52dk/nrf52832
      - nrf52840dk/nrf52840
      - nrf52_bsim
      - nrf54h20dk/nrf54h20/cpuapp
      - nrf54h20dk/nrf54h20/cpurad
      - nrf54h20dk/nrf54h20/cpuppr
    integration_platforms:
      - nrf52840dk/nrf52840
```

## tests/drivers/counter/counter_nxp_lpit_api/testcase.yaml
```yaml
tests:
  drivers.counter.nxp_lpit_api:
    tags:
      - drivers
      - counter
    depends_on: counter
    platform_allow:
      - mimxrt1180_evk/mimxrt1189/cm33
      - mimxrt1180_evk/mimxrt1189/cm7
    timeout: 600
```

## tests/drivers/counter/counter_seconds/testcase.yaml
```yaml
tests:
  drivers.counter.cmos:
    tags:
      - drivers
      - counter
    arch_allow: x86
    extra_configs:
      - CONFIG_COUNTER_CMOS=y
    filter: CONFIG_X86_PC_COMPATIBLE

  drivers.counter.mcux.snvs.rtc:
    tags:
      - drivers
      - counter
    platform_allow: mimxrt1064_evk

  drivers.counter.mchp.rtc:
    tags:
      - drivers
      - counter
    platform_allow:
      - pic32cx_sg61_cult
```

## tests/drivers/counter/maxim_ds3231_api/testcase.yaml
```yaml
tests:
  drivers.counter.maxim_ds3231:
    tags: drivers counter
    depends_on: counter i2c
    min_ram: 16
    timeout: 400
    filter: dt_compat_enabled("maxim,ds3231")
    harness: ztest
    harness_config:
      fixture: maxim_ds3231
```

## tests/drivers/counter/rpi_pico_pit/testcase.yaml
```yaml
# Copyright (c) 2024 Navimatix GmbH
# SPDX-License-Identifier: Apache-2.0

tests:
  drivers.counter.rpi_pico_pit:
    tags:
      - drivers
      - counter
      - api
      - pwm
    depends_on: counter
    min_ram: 16
    platform_allow:
      - rpi_pico
    timeout: 600
```

## tests/drivers/crc/testcase.yaml
```yaml
# SPDX-License-Identifier: Apache-2.0

tests:
  drivers.crc:
    depends_on: crc
    tags:
      - drivers
      - crc
```

## tests/drivers/dac/dac_api/Kconfig
```kconfig
# Copyright (c) 2025 Renesas Electronics Corporation
# SPDX-License-Identifier: Apache-2.0

mainmenu "DAC API test"

source "Kconfig.zephyr"

config DAC_BUFFER_NOT_SUPPORT
	bool "DAC on board/SoC does not support output buffer mode"
	help
	  If this config is turned on, the test will run with no output buffer enabled
```
