/*
 * Copyright 2024 NXP
 *
 * SPDX-License-Identifier: Apache-2.0
 */

&lpit0 {
	status = "okay";
};

&lpit1_channel0 {
	status = "okay";
};

&lpit1_channel1 {
	status = "okay";
};

&lpit1_channel3 {
	status = "okay";
};
