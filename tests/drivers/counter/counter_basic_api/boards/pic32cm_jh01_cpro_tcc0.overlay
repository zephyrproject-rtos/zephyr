/*
 * SPDX-FileCopyrightText: Copyright 2026 Microchip Technology Inc.
 * SPDX-License-Identifier: Apache-2.0
 */

&tcc0 {
	compatible = "microchip,tcc-g1-counter";
	max-bit-width = <24>;
	prescaler = <64>;
	status = "okay";
};

&tcc1 {
	status = "disabled";
};

&tcc2 {
	status = "disabled";
};
