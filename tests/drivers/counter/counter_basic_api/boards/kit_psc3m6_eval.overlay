/*
 * SPDX-FileCopyrightText: Copyright (c) 2026 Infineon Technologies AG,
 * SPDX-FileCopyrightText: or an affiliate of Infineon Technologies AG. All rights reserved.
 *
 * SPDX-License-Identifier: Apache-2.0
 */

&tcpwm0_1 {
	status = "okay";

	counter0_1 {
		status = "okay";
		clocks = <&peri0_group0_16bit_2>;
	};
};
