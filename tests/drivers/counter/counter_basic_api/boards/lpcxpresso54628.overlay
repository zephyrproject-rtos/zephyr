/*
 * Copyright The Zephyr Project Contributors
 *
 * SPDX-License-Identifier: Apache-2.0
 */

&mrt0_channel1 {
	status = "okay";
};

/* channel 2 disabled to test disabled channel not breaking things */

&mrt0_channel3 {
	status = "okay";
};
