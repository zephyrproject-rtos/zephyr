/*
 * SPDX-FileCopyrightText: Copyright (c) 2026 Infineon Technologies AG,
 * SPDX-FileCopyrightText: or an affiliate of Infineon Technologies AG. All rights reserved.
 *
 * SPDX-License-Identifier: Apache-2.0
 */

&tcpwm0_0 {
	status = "okay";
};

counter0: &counter0_0 {
	status = "okay";
	clocks = <&peri_clk_div3>;
};

&peri_clk_div3 {
	status = "okay";
	clock-div = <999>;
};
