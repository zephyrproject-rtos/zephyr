/*
 * SPDX-FileCopyrightText: Copyright RAKwireless Technology Limited
 * SPDX-License-Identifier: Apache-2.0
 */

#include <zephyr/dt-bindings/gpio/gpio.h>

/ {
	pps: counter-gpio {
		compatible = "zephyr,counter-gpio";
		gpios = <&gpio0 0 GPIO_ACTIVE_HIGH>, <&gpio0 1 GPIO_ACTIVE_HIGH>,
			<&gpio0 2 GPIO_ACTIVE_HIGH>;
		#counter-capture-cells = <2>;
	};
};
