## tests/drivers/clock_mgmt/clock_mgmt_hw/testcase.yaml
```yaml
tests:
  drivers.clock_mgmt.hw:
    tags:
      - drivers
      - clock_mgmt
    integration_platforms:
      - lpcxpresso55s69/lpc55s69/cpu0
    filter: dt_compat_enabled("vnd,emul-clock-consumer")
```

## tests/drivers/clock_monitor/clock_monitor_api/Kconfig
```kconfig
# SPDX-FileCopyrightText: 2026 NXP
# SPDX-License-Identifier: Apache-2.0

source "Kconfig.zephyr"

config TEST_CLOCK_MONITOR_EXPECTED_HZ
	int "Clock monitor expected frequency (Hz), 0 = auto"
	default 0
	help
	  Nominal expected frequency of the monitored clock, in Hz.
	  Set to 0 to let the back-end auto-derive it from the monitored
	  clock via the clock control driver.

config TEST_CLOCK_MONITOR_TOLERANCE_PPM
	int "Clock monitor tolerance (parts-per-million)"
	default 50000
	help
	  Acceptable plus/minus deviation from the expected frequency,
	  in parts-per-million.

config TEST_CLOCK_MONITOR_WINDOW_NS
	int "Clock monitor window duration (ns)"
	default 1000000
	help
	  Check window duration in nanoseconds

config TEST_CLOCK_MONITOR_MEASURE_NS
	int "Clock monitor measure duration (ns)"
	default 1000000
	help
	  Duration in nanoseconds for frequency measurement
```

## tests/drivers/clock_monitor/clock_monitor_api/dts/bindings/test-clock-monitor.yaml
```yaml
# SPDX-FileCopyrightText: 2026 NXP
# SPDX-License-Identifier: Apache-2.0

description: |
  Test fixture binding for the clock_monitor API test suite.

  Each child node names one clock_monitor instance to exercise and
  carries optional per-instance expectations, e.g.:

    / {
        clock-monitor-test {
            compatible = "test-clock-monitor";

            fm {
                monitor = <&cmu_1>;
                measure-expected-hz = <48000000>;
            };
        };
    };

compatible: "test-clock-monitor"

child-binding:
  description: One clock_monitor instance under test.

  properties:
    monitor:
      type: phandle
      required: true
      description: The clock_monitor device to exercise.

    measure-expected-hz:
      type: int
      default: 0
      description: |
        Nominal frequency (Hz) of the clock measured by this instance.
        When non-zero, the suite asserts that the measured value lies
        within measure-tolerance-ppm of this value. 0 skips the
        accuracy check (e.g. for WINDOW-only instances).

    measure-tolerance-ppm:
      type: int
      default: 50000
      description: |
        Accepted plus/minus deviation of the measured frequency from
        measure-expected-hz, in parts-per-million.

    switch-reference:
      type: int
      default: 0
      description: |
        Alternate reference-clock cookie (opaque, back-end specific) for the
        set_source() test. When non-zero, the suite switches the reference to
        this source, reconfigures, and asserts the same target still measures
        within tolerance of measure-expected-hz.

    switch-target:
      type: int
      default: 0
      description: |
        Alternate target-clock cookie for the set_source() test. When non-zero,
        the suite switches the target to this source, reconfigures, and
        re-measures - the measured value becomes this target's frequency.

    switch-target-expected-hz:
      type: int
      default: 0
      description: |
        Expected measured frequency (Hz) after switching the target to
        switch-target. When non-zero, the measured value must lie within
        measure-tolerance-ppm of it. 0 only logs the measured value.
```

## tests/drivers/clock_monitor/clock_monitor_api/dts/bindings/test-required-clocks.yaml
```yaml
# SPDX-FileCopyrightText: 2026 NXP
# SPDX-License-Identifier: Apache-2.0

description: Clocks the clock_monitor API test suite enables during setup.

compatible: "test-required-clocks"

properties:
  clocks:
    type: phandle-array
    required: true
    description: Clocks to enable during test setup.
```

## tests/drivers/clock_monitor/clock_monitor_api/testcase.yaml
```yaml
# Copyright 2026 NXP
# SPDX-License-Identifier: Apache-2.0

common:
  tags:
    - drivers
    - clock_monitor
tests:
  drivers.clock_monitor.api.nxp:
    filter: dt_compat_enabled("nxp,cmu-fc") or dt_compat_enabled("nxp,cmu-fm")
```

## tests/drivers/cobs_uart_async/testcase.yaml
```yaml
tests:
  drivers.cobs_uart_async_sockets:
    tags:
      - net
      - cobs
      - uart
      - sockets
    platform_allow:
      - native_sim
      - nrf5340dk_nrf5340_cpuapp
    integration_platforms:
      - native_sim
```

## tests/drivers/comparator/gpio_loopback/Kconfig
```kconfig
# Copyright (c) 2025 Renesas Electronics Corporation
# SPDX-License-Identifier: Apache-2.0

mainmenu "GPIO_loopback test additional options"

source "Kconfig.zephyr"

ZEPHYR_USER := zephyr,user

config DAC_REFERENCE_SOURCE
	bool
	default y if $(dt_node_has_prop,/$(ZEPHYR_USER),dac)
	select DAC
```

## tests/drivers/comparator/gpio_loopback/boards/it515xx_evb.conf
```kconfig
# Copyright (c) 2025 ITE Technology Corporation
# SPDX-License-Identifier: Apache-2.0

CONFIG_ADC=y
```

## tests/drivers/comparator/gpio_loopback/boards/kit_psc3m5_evk_csg.conf
```kconfig
# Copyright (c) 2026 Infineon Technologies AG,
# or an affiliate of Infineon Technologies AG.
#
# SPDX-License-Identifier: Apache-2.0
#
# Companion conf for boards/kit_psc3m5_evk_csg.overlay (FILE_SUFFIX=csg).
# Pulls in the HPPASS MFD and CSG DAC needed by the CSG comparator.

CONFIG_MFD=y
CONFIG_DAC=y
```

## tests/drivers/comparator/gpio_loopback/testcase.yaml
```yaml
# Copyright (c) 2024 Nordic Semiconductor
# SPDX-License-Identifier: Apache-2.0

common:
  harness_config:
    fixture: gpio_loopback
  tags:
    - drivers
    - comparator
tests:
  drivers.comparator.gpio_loopback.silabs_acmp:
    platform_allow:
      - slwrb4180a
      - xg23_rb4210a
      - xg24_dk2601b
      - xg24_rb4187c
      - xg28_rb4401c
      - xg29_rb4412a
      - bg29_rb4420a
  drivers.comparator.gpio_loopback.mcux_acmp:
    platform_allow:
      - frdm_ke15z
      - frdm_mcxe247
  drivers.comparator.gpio_loopback.nrf_comp:
    extra_args:
      - FILE_SUFFIX="nrf_comp"
    platform_allow:
      - nrf5340dk/nrf5340/cpuapp
      - nrf54h20dk/nrf54h20/cpuapp
      - nrf54l15dk/nrf54l15/cpuapp
      - nrf54l15dk/nrf54l15/cpuapp/ns
      - nrf54lm20dk/nrf54lm20a/cpuapp
      - ophelia4ev/nrf54l15/cpuapp
  drivers.comparator.gpio_loopback.nrf_lpcomp:
    extra_args:
      - FILE_SUFFIX="nrf_lpcomp"
    platform_allow:
      - nrf5340dk/nrf5340/cpuapp
      - nrf54h20dk/nrf54h20/cpuapp
      - nrf54l15dk/nrf54l15/cpuapp
      - nrf54l15dk/nrf54l15/cpuapp/ns
      - nrf54lm20dk/nrf54lm20a/cpuapp
      - ophelia4ev/nrf54l15/cpuapp
  drivers.comparator.gpio_loopback.stm32_comp:
    platform_allow:
      - nucleo_h745zi_q/stm32h745xx/m7
      - nucleo_g474re/stm32g474xx
  drivers.comparator.gpio_loopback.nxp_hscmp:
    platform_allow:
      - lpcxpresso55s36
  drivers.comparator.gpio_loopback.nxp_acomp:
    platform_allow:
      - frdm_rw612
  drivers.comparator.gpio_loopback.nxp_lpcmp:
    platform_allow:
      - frdm_mcxa153
      - frdm_mcxa156
      - frdm_mcxa266
      - frdm_mcxa346
      - frdm_mcxa366
      - frdm_mcxe31b
      - frdm_mcxn236
      - frdm_mcxn947/mcxn947/cpu0/qspi
      - frdm_mcxn947/mcxn947/cpu0
      - mcx_n9xx_evk/mcxn947/cpu0/qspi
      - mcx_n9xx_evk/mcxn947/cpu0
  drivers.comparator.gpio_loopback.mchp:
    platform_allow:
      - sam_e54_xpro
      - pic32cx_sg41_cult
  drivers.comparator.gpio_loopback.ite:
    platform_allow:
      - it51xxx_evb/it51526aw
```

## tests/drivers/comparator/shell/testcase.yaml
```yaml
# Copyright (c) 2024 Nordic Semiconductor
# SPDX-License-Identifier: Apache-2.0

tests:
  drivers.comparator.shell:
    platform_allow:
      - native_sim
      - native_sim/native/64
    tags:
      - drivers
      - comparator
      - shell
```

## tests/drivers/console/line_splitting/testcase.yaml
```yaml
common:
  tags:
    - drivers
    - console
  platform_allow: hifive1 hifive_unleashed
  harness: robot

tests:
  drivers.console.line_splitting:
    harness_config:
      robot_testsuite: line_splitting.robot
  drivers.console.line_splitting.plus.some_option:
    harness_config:
      robot_testsuite: line_splitting.robot
      robot_option: --exclude some_flag
```

## tests/drivers/console/testcase.yaml
```yaml
common:
  tags: drivers console
  harness: console
  harness_config:
    type: one_line
    regex:
      - "Hello World from Console"

tests:
  drivers.console.uart:
    tags: drivers console uart
    filter: CONFIG_UART_CONSOLE
  drivers.console.semihost:
    tags: drivers console semihost
    arch_allow: arm arm64 riscv32 riscv64
    platform_type:
      - qemu
    extra_args: CONF_FILE=prj_semihost.conf
```

## tests/drivers/console_switching/testcase.yaml
```yaml
common:
  tags:
    - drivers
    - console
    - emul
    - devmux
  platform_allow:
    - qemu_riscv/qemu_virt_riscv/rv64
  integration_platforms:
    - qemu_riscv/qemu_virt_riscv/rv64

tests:
  drivers.devmux.console_switching: {}
  drivers.devmux.console_switching.user:
    extra_configs:
      - CONFIG_USERSPACE=y
```

## tests/drivers/cordic/cordic_api/testcase.yaml
```yaml
# Copyright (c) 2025 Alexander Kozhinov <ak.alexander.kozhinov@gmail.com>
# SPDX-License-Identifier: Apache-2.0

common:
  tags:
    - drivers
    - cordic

tests:
  drivers.cordic.api.stm32_cordic:
    vendor_allow:
      - st
    filter: dt_compat_enabled("st,stm32-cordic")
```

## tests/drivers/coredump/coredump_api/boards/acrn_ehl_crb_elkhart_lake.conf
```kconfig
# Give 1 second delay when running on ACRN.
# Because the zephyr's log from ACRN console
# cannot output completedly before this time.
CONFIG_BOOT_DELAY=1000
```

## tests/drivers/coredump/coredump_api/testcase.yaml
```yaml
# Copyright Meta Platforms, Inc. and its affiliates.
# SPDX-License-Identifier: Apache-2.0

tests:
  drivers.coredump.api.qemu_riscv32:
    tags: ignore_faults ignore_qemu_crash
    filter: CONFIG_ARCH_SUPPORTS_COREDUMP
    platform_allow: qemu_riscv32
    harness: console
    harness_config:
      type: multi_line
      # Verify core dump contains test values saved in memory
      regex:
        - "E: #CD:BEGIN#"
        - "E: #CD:5([aA])45([0-9a-fA-F]+)"
        - "E: #CD:4([dD])([0-9a-fA-F]+)"
        - "E: #CD:4([dD])([0-9a-fA-F]+)"
        - "E: #CD:4([dD])([0-9a-fA-F]+)"
        - "E: #CD:12121212"
        - "E: #CD:4([dD])([0-9a-fA-F]+)"
        - "E: #CD:34343434"
        - "E: #CD:4([dD])([0-9a-fA-F]+)"
        - "E: #CD:ababababcdcdcdcdefefefef"
        - "E: #CD:4([dD])([0-9a-fA-F]+)"
        - "E: #CD:565656567878787890909090"
        - "E: #CD:4([dD])([0-9a-fA-F]+)"
        - "E: #CD:babababa"
        - "E: #CD:END#"
  drivers.coredump.api:
    tags: ignore_faults ignore_qemu_crash
    filter: CONFIG_ARCH_SUPPORTS_COREDUMP
    platform_exclude: qemu_riscv32
    harness: console
    harness_config:
      type: multi_line
      # Verify core dump contains test values saved in memory
      regex:
        - "E: #CD:BEGIN#"
        - "E: #CD:5([aA])45([0-9a-fA-F]+)"
        - "E: #CD:4([dD])([0-9a-fA-F]+)"
        - "E: #CD:4([dD])([0-9a-fA-F]+)"
        - "E: #CD:4([dD])([0-9a-fA-F]+)"
        - "E: #CD:ababababcdcdcdcdefefefef"
        - "E: #CD:4([dD])([0-9a-fA-F]+)"
        - "E: #CD:babababa"
        - "E: #CD:END#"
```

## tests/drivers/counter/counter_basic_api/boards/da1469x_dk_pro.conf
```kconfig
CONFIG_COUNTER_TIMER1=y
CONFIG_COUNTER_TIMER2=y
CONFIG_COUNTER_TIMER3=y
CONFIG_COUNTER_TIMER4=y
```

## tests/drivers/counter/counter_basic_api/boards/frdm_ke17z.conf
```kconfig
#
# Copyright 2025 NXP
#
# SPDX-License-Identifier: Apache-2.0
#
CONFIG_COUNTER_MCUX_FTM=y
```

## tests/drivers/counter/counter_basic_api/boards/mimxrt1180_evk_mimxrt1189_cm7.conf
```kconfig
#
# Copyright 2024-2025 NXP
#
# SPDX-License-Identifier: Apache-2.0
#
CONFIG_COUNTER_MCUX_QTMR=y
CONFIG_COUNTER_MCUX_LPIT=y
```
