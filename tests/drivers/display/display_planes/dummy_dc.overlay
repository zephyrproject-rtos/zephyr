/*
 * Copyright 2026 NXP
 *
 * SPDX-License-Identifier: Apache-2.0
 */

/ {
	chosen {
		zephyr,display = &dummy_dc;
	};

	dummy_dc: dummy_dc {
		compatible = "zephyr,dummy-dc";
		height = <240>;
		width = <320>;
	};
};
