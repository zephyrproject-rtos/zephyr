/*
 * SPDX-FileCopyrightText: Copyright The Zephyr Project Contributors
 * SPDX-License-Identifier: Apache-2.0
 */

#include <zephyr/dt-bindings/display/panel.h>

&matrix {
	pixel-format = <PANEL_PIXEL_FORMAT_ARGB_8888>;
};
