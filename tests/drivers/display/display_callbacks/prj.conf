## CMakeLists.txt
```
# SPDX-FileCopyrightText: Copyright The Zephyr Project Contributors
# SPDX-License-Identifier: Apache-2.0

cmake_minimum_required(VERSION 3.28.0)
find_package(Zephyr REQUIRED HINTS $ENV{ZEPHYR_BASE})
project(display_callbacks)

FILE(GLOB app_sources src/*.c)
target_sources(app PRIVATE ${app_sources})
```

## Kconfig
```
# Private config options for display_check test
# Copyright (c) 2026 STMicroelectronics
# SPDX-License-Identifier: Apache-2.0

source "samples/drivers/display/Kconfig"
```

## prj.conf
```kconfig
# Copyright 2025 NXP
# SPDX-License-Identifier: Apache-2.0

CONFIG_LOG=y
CONFIG_DISPLAY=y
CONFIG_ZTEST=y
CONFIG_ZTEST_ASSERT_HOOK=y
```

## boards/esp32p4x_function_ev_board_esp32p4_hpcore.overlay
```dts
/*
 * SPDX-FileCopyrightText: Copyright The Zephyr Project Contributors
 *
 * SPDX-License-Identifier: Apache-2.0
 */

/ {
	aliases {
		test-display-ctrl = &dsi_display;
	};
};
```

## boards/mimxrt1170_evk_mimxrt1176_cm7_A.overlay
```dts
/*
 * SPDX-FileCopyrightText: Copyright The Zephyr Project Contributors
 *
 * SPDX-License-Identifier: Apache-2.0
 */

/ {
	aliases {
		/* Display controller assigned to 'zephyr,display' chosen property
		 * is not necessarily the one that supports Events Callback, which
		 * is what we are testing here.
		 */
		test-display-ctrl = &lcdif;
	};
};

&lcdif {
	status = "okay";
};
```

## boards/stm32h7s78_dk_stm32h7s7xx.overlay
```dts
/*
 * SPDX-FileCopyrightText: Copyright The Zephyr Project Contributors
 *
 * SPDX-License-Identifier: Apache-2.0
 */

/ {
	aliases {
		/* Display controller assigned to 'zephyr,display' chosen property
		 * is not necessarily the one that supports Events Callback, which
		 * is what we are testing here.
		 */
		test-display-ctrl = &ltdc;
	};
};

&ltdc {
	status = "okay";
};
```

## src/main.c
```c
/*
 * Copyright (c) 2026 STMicroelectronics
 * SPDX-FileCopyrightText: 2026 Abderrahmane JARMOUNI
 * SPDX-License-Identifier: Apache-2.0
 */

#include <zephyr/ztest.h>
#include <zephyr/ztest_error_hook.h>

#include <zephyr/drivers/display.h>

static const struct device *dev = DEVICE_DT_GET(DT_ALIAS(test_display_ctrl));
static struct display_capabilities disp_capabilities;
static enum display_event_result display_cb_handler(const struct device *dev, uint32_t evt,
	const struct display_event_data *data, void *user_data);
static uint32_t cb_handle;

static enum display_event_result display_cb_handler(const struct device *dev, uint32_t evt,
	const struct display_event_data *data, void *user_data)
{
	return DISPLAY_EVENT_RESULT_HANDLED;
}

static void display_callbacks_before(void *text_fixture)
{
	/* Reset callback handle in case a previous testcase failed to */
	if (cb_handle != 0U) {
		display_unregister_event_cb(dev, cb_handle);
		cb_handle = 0U;
	}

	display_get_capabilities(dev, &disp_capabilities);
}

ZTEST(display_callbacks, test_supported_events_registration)
{
	/* Test all supported events */
	uint32_t events[] = {
		DISPLAY_EVENT_LINE_INT,
		DISPLAY_EVENT_VSYNC,
		DISPLAY_EVENT_FRAME_DONE,
		DISPLAY_EVENT_FIFO_UNDERFLOW,
	};

	for (size_t i = 0; i < ARRAY_SIZE(events); i++) {
		uint32_t event = events[i];

		if (!(disp_capabilities.supported_events & event)) {
			continue;
		}

		/* Reset callback handle for this iteration */
		if (cb_handle != 0U) {
			display_unregister_event_cb(dev, cb_handle);
			cb_handle = 0U;
		}

		int res = display_register_event_cb(dev, display_cb_handler, NULL, event,
						    true, &cb_handle);

		if (res == -ENOTSUP) {
			/* ISR context not supported, try thread context */
			res = display_register_event_cb(dev, display_cb_handler, NULL, event,
							false, &cb_handle);
		}

		zassert_ok(res, "Failed to register callback for event %u. Result: %i", event, res);
		zassert_not_equal(cb_handle, 0U,
			"Registration failed for event %u, handle should be non-zero", event);
	}
}

ZTEST(display_callbacks, test_empty_event_mask)
{
	int res = display_register_event_cb(dev, display_cb_handler, NULL, 0U, true,
					    &cb_handle);

	zassert_equal(res, -EINVAL,
		"Empty event_mask should be rejected with -EINVAL. Got: %i", res);
}

ZTEST(display_callbacks, test_unsupported_event)
{
	/* Use an event bit that's unlikely to ever be defined */
	uint32_t unsupported_event = BIT(31);

	if (disp_capabilities.supported_events & unsupported_event) {
		ztest_test_skip();
	}

	int res = display_register_event_cb(dev, display_cb_handler, NULL, unsupported_event,
					    true, &cb_handle);

	zassert_equal(res, -EINVAL,
		"Unsupported event should be rejected with -EINVAL. Got: %i", res);
}

ZTEST(display_callbacks, test_double_registration)
{
	uint32_t event = disp_capabilities.supported_events & -disp_capabilities.supported_events;
	/* Second registration should fail with -EBUSY */
	uint32_t cb_handle_2;

	/* First registration should succeed */
	int res = display_register_event_cb(dev, display_cb_handler, NULL, event, true,
					    &cb_handle);
	if (res == -ENOTSUP) {
		res = display_register_event_cb(dev, display_cb_handler, NULL, event, false,
						&cb_handle);
	}
	zassert_ok(res, "First callback registration failed. Result: %i", res);

	res = display_register_event_cb(dev, display_cb_handler, NULL, event, true,
					&cb_handle_2);
	zassert_equal(res, -EBUSY, "Second callback should be rejected with -EBUSY. Got: %i", res);
}

ZTEST_SUITE(display_callbacks, NULL, NULL, display_callbacks_before, NULL, NULL);
```
