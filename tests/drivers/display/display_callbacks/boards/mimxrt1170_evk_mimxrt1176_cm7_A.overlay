/*
 * SPDX-FileCopyrightText: Copyright The Zephyr Project Contributors
 *
 * SPDX-License-Identifier: Apache-2.0
 */

/ {
	aliases {
		/* Display controller assigned to 'zephyr,display' chosen property
		 * is not necessarily the one that supports Events Callback, which
		 * is what we are testing here.
		 */
		test-display-ctrl = &lcdif;
	};
};

&lcdif {
	status = "okay";
};
