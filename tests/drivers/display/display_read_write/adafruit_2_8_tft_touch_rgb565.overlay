/*
 * Copyright 2024 NXP
 *
 * SPDX-License-Identifier: Apache-2.0
 */


&adafruit_2_8_tft_touch_v2_ili9340 {
	pixel-format = "rgb565";
};

&adafruit_2_8_tft_touch_v2_mipi_dbi {
	/delete-property/ write-only;
};
