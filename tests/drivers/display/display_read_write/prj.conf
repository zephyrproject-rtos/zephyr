## CMakeLists.txt
```
# Copyright 2024 (c) TOKITA Hiroshi
# SPDX-License-Identifier: Apache-2.0

cmake_minimum_required(VERSION 3.28.0)
find_package(Zephyr REQUIRED HINTS $ENV{ZEPHYR_BASE})

project(display_read_write)

target_sources(app PRIVATE src/main.c)
```

## Kconfig
```
# Copyright (c) 2024 Renesas Electronics Corporation
# SPDX-License-Identifier: Apache-2.0

mainmenu "Display Read Write Test"

source "Kconfig.zephyr"

config DISPLAY_BUFFER_USE_GENERIC_SECTION
	bool "Place the display buffer in a specific memory section"
	help
	  Place the display buffer in a specific memory section.

config DISPLAY_BUFFER_ALIGNMENT
	int "Display buffer memory alignment"
	default 32
	help
	  Specific display buffer alignment.

if DISPLAY_BUFFER_USE_GENERIC_SECTION

config DISPLAY_BUFFER_SECTION
	string "Memory section to place Display Buffer"
	help
	  Specific memory section to place the display buffer.

endif # DISPLAY_BUFFER_USE_GENERIC_SECTION
```

## prj.conf
```kconfig
# Copyright 2024 (c) TOKITA Hiroshi
# SPDX-License-Identifier: Apache-2.0

CONFIG_ZTEST=y
CONFIG_DISPLAY=y

CONFIG_HEAP_MEM_POOL_SIZE=16384

CONFIG_LOG=y
```

## boards/aik_ra8d1.conf
```kconfig
# Copyright (c) 2026 Renesas Electronics Corporation
# SPDX-License-Identifier: Apache-2.0

CONFIG_DISPLAY_BUFFER_USE_GENERIC_SECTION=y
CONFIG_DISPLAY_BUFFER_SECTION="SDRAM"
CONFIG_DISPLAY_BUFFER_ALIGNMENT=64
```

## boards/ek_ra8d1.conf
```kconfig
# Copyright (c) 2024 Renesas Electronics Corporation
# SPDX-License-Identifier: Apache-2.0

CONFIG_DISPLAY_BUFFER_USE_GENERIC_SECTION=y
CONFIG_DISPLAY_BUFFER_SECTION="SDRAM"
CONFIG_DISPLAY_BUFFER_ALIGNMENT=64
```

## boards/ek_ra8d2_r7ka8d2kflcac_cm85.conf
```kconfig
# Copyright (c) 2025 Renesas Electronics Corporation
# SPDX-License-Identifier: Apache-2.0

CONFIG_DISPLAY_BUFFER_USE_GENERIC_SECTION=y
CONFIG_DISPLAY_BUFFER_SECTION="SDRAM"
CONFIG_DISPLAY_BUFFER_ALIGNMENT=64
```

## boards/ek_ra8p1_r7ka8p1kflcac_cm85.conf
```kconfig
# Copyright (c) 2025 Renesas Electronics Corporation
# SPDX-License-Identifier: Apache-2.0

CONFIG_DISPLAY_BUFFER_USE_GENERIC_SECTION=y
CONFIG_DISPLAY_BUFFER_SECTION=".sdram"
CONFIG_DISPLAY_BUFFER_ALIGNMENT=64
```

## boards/native_sim_native_64.conf
```kconfig
CONFIG_SDL_DISPLAY_USE_HARDWARE_ACCELERATOR=n
```

## boards/rza3m_ek.conf
```kconfig
# Copyright (c) 2025 Renesas Electronics Corporation
# SPDX-License-Identifier: Apache-2.0

CONFIG_GPIO=y
```

## adafruit_2_8_tft_touch_rgb565.overlay
```dts
/*
 * Copyright 2024 NXP
 *
 * SPDX-License-Identifier: Apache-2.0
 */

#include <zephyr/dt-bindings/display/panel.h>

&adafruit_2_8_tft_touch_v2_ili9340 {
	pixel-format = <PANEL_PIXEL_FORMAT_RGB_565>;
};

&adafruit_2_8_tft_touch_v2_mipi_dbi {
	/delete-property/ write-only;
};
```

## native_sim_abgr_8888.overlay
```dts
/*
 * Copyright (c) 2026 Muhammad Waleed Badar
 *
 * SPDX-License-Identifier: Apache-2.0
 */
#include <zephyr/dt-bindings/display/panel.h>

&sdl_dc {
	pixel-format = <PANEL_PIXEL_FORMAT_ABGR_8888>;
};
```

## native_sim_al_88.overlay
```dts
/*
 * Copyright (c) 2026 Muhammad Waleed Badar
 *
 * SPDX-License-Identifier: Apache-2.0
 */
#include <zephyr/dt-bindings/display/panel.h>

&sdl_dc {
	pixel-format = <PANEL_PIXEL_FORMAT_AL_88>;
};
```

## native_sim_argb_8888.overlay
```dts
/*
 * Copyright (c) 2026 Muhammad Waleed Badar
 *
 * SPDX-License-Identifier: Apache-2.0
 */
#include <zephyr/dt-bindings/display/panel.h>

&sdl_dc {
	pixel-format = <PANEL_PIXEL_FORMAT_ARGB_8888>;
};
```

## native_sim_bgr_888.overlay
```dts
/*
 * Copyright (c) 2026 Muhammad Waleed Badar
 *
 * SPDX-License-Identifier: Apache-2.0
 */
#include <zephyr/dt-bindings/display/panel.h>

&sdl_dc {
	pixel-format = <PANEL_PIXEL_FORMAT_BGR_888>;
};
```

## native_sim_bgra_8888.overlay
```dts
/*
 * Copyright (c) 2026 Muhammad Waleed Badar
 *
 * SPDX-License-Identifier: Apache-2.0
 */
#include <zephyr/dt-bindings/display/panel.h>

&sdl_dc {
	pixel-format = <PANEL_PIXEL_FORMAT_BGRA_8888>;
};
```

## src/main.c
```c
/*
 * Copyright 2024 (c) TOKITA Hiroshi
 * Copyright 2026 NXP
 *
 * SPDX-License-Identifier: Apache-2.0
 */

#include <zephyr/drivers/display.h>
#include <zephyr/ztest.h>
#include <zephyr/device.h>
#include <zephyr/logging/log.h>
#include <zephyr/sys/util.h>

LOG_MODULE_DECLARE(display_api, CONFIG_DISPLAY_LOG_LEVEL);

static const struct device *dev = DEVICE_DT_GET(DT_CHOSEN(zephyr_display));
static const uint32_t display_width = DT_PROP(DT_CHOSEN(zephyr_display), width);
static const uint32_t display_height = DT_PROP(DT_CHOSEN(zephyr_display), height);
#ifdef CONFIG_DISPLAY_BUFFER_USE_GENERIC_SECTION
Z_GENERIC_SECTION(CONFIG_DISPLAY_BUFFER_SECTION)
#endif
static uint8_t disp_buffer[DT_PROP(DT_CHOSEN(zephyr_display), width) *
			   DT_PROP(DT_CHOSEN(zephyr_display), height) * 4]
	__aligned(CONFIG_DISPLAY_BUFFER_ALIGNMENT);
static struct display_capabilities cfg;
static uint8_t bpp;
static bool is_vtiled;
static bool is_htiled;

static inline size_t buffer_size(size_t width, size_t height)
{
	if (is_vtiled || is_htiled) {
		return DIV_ROUND_UP(width * height, 8U);
	}

	return width * height * bpp;
}

static inline uint8_t bytes_per_pixel(uint32_t pixel_format)
{
	switch (pixel_format) {
	case PIXEL_FORMAT_ARGB_8888:
	case PIXEL_FORMAT_XRGB_8888:
	case PIXEL_FORMAT_ABGR_8888:
	case PIXEL_FORMAT_RGBA_8888:
	case PIXEL_FORMAT_BGRA_8888:
		return 4;
	case PIXEL_FORMAT_RGB_888:
	case PIXEL_FORMAT_BGR_888:
		return 3;
	case PIXEL_FORMAT_RGB_565:
	case PIXEL_FORMAT_RGB_565X:
	case PIXEL_FORMAT_AL_88:
		return 2;
	case PIXEL_FORMAT_L_8:
	case PIXEL_FORMAT_MONO01:
	case PIXEL_FORMAT_MONO10:
	default:
		return 1;
	}

	return 0;
}

static void verify_bytes_of_area(uint8_t *data, int cmp_x, int cmp_y, size_t width, size_t height)
{
	struct display_buffer_descriptor desc = {
		.height = height,
		.pitch = width,
		.width = width,
		.buf_size = buffer_size(width, height),
	};

	int err = display_read(dev, cmp_x, cmp_y, &desc, disp_buffer);

	zassert_ok(err, "display_read failed");

	zassert_mem_equal(data, disp_buffer, buffer_size(width, height));
}

static void verify_background_color(int x, int y, size_t width, size_t height, uint32_t color)
{
	size_t buf_size = buffer_size(width, height);
	struct display_buffer_descriptor desc = {
		.height = height,
		.pitch = width,
		.width = width,
		.buf_size = buf_size,
	};
	uint32_t *buf32 = (void *)disp_buffer;
	uint16_t *buf16 = (void *)disp_buffer;
	uint8_t *buf8 = disp_buffer;
	int err;

	err = display_read(dev, x, y, &desc, disp_buffer);
	zassert_ok(err, "display_read failed");

	for (size_t i = 0; i < width * height; i++) {
		switch (bpp) {
		case 4:
			zassert_equal(buf32[i], color, "@%zu", i);
			break;
		case 2:
			zassert_equal(buf16[i], (uint16_t)color, "@%zu", i);
			break;
		case 1:
			if (is_vtiled) {
				uint16_t x = i % (width);
				uint16_t line = (i - x) / width;
				uint16_t tile = line / 8;
				uint16_t y = line % 8;

				uint8_t *tptr = disp_buffer + (tile * width + x);

				zassert_equal(!!(*tptr & BIT(y)), !!(color), "@%zu", i);
			} else if (is_htiled) {
				uint8_t *tptr = disp_buffer + i / 8;

				zassert_equal(!!(*tptr & BIT(i % 8)), !!(color), "@%zu", i);
			} else {
				zassert_equal(buf8[i], (uint8_t)color, "@%zu", i);
			}
			break;
		}
	}
}

/**
 * Fill the buffer with 0 before running tests.
 */
static void display_before(void *text_fixture)
{
	display_get_capabilities(dev, &cfg);
	bpp = bytes_per_pixel(cfg.current_pixel_format);
	is_vtiled = (bpp == 1 && (cfg.screen_info & SCREEN_INFO_MONO_VTILED));
	is_htiled = (bpp == 1 && !(cfg.screen_info & SCREEN_INFO_MONO_VTILED));

	struct display_buffer_descriptor desc = {
		.height = display_height,
		.pitch = display_width,
		.width = display_width,
		.buf_size = display_height * display_width * bpp,
	};

	memset(disp_buffer, 0, sizeof(disp_buffer));
	display_write(dev, 0, 0, &desc, disp_buffer);
}

/*
 * Verify that we can get a color of '0' from all pixels
 * when after zeroing the buffer.
 */
ZTEST(display_read_write, test_clear)
{
	verify_background_color(0, 0, display_width, display_height, 0);
}

/*
 * Write to the head of the buffer and check that
 * the same value can be read.
 */
ZTEST(display_read_write, test_write_to_buffer_head)
{
	uint8_t data[4] = {0xFA, 0xAF, 0x9F, 0xFA};
	uint8_t height = (is_vtiled ? 8 : 1);
	uint16_t width = sizeof(data) / bpp * (is_htiled ? 8 : 1);
	uint16_t buf_size = width * bpp;
	struct display_buffer_descriptor desc = {
		.height = height,
		.pitch = width,
		.width = width,
		.buf_size = buf_size,
	};

	/* write data to head of buffer */
	display_write(dev, 0, 0, &desc, data);

	/* check write data and read data are same */
	verify_bytes_of_area(data, 0, 0, width, height);

	/* check remaining region still black */
	verify_background_color(0, height, display_width, display_height - height, 0);
	verify_background_color(width, 0, display_width - width, display_height, 0);
}

/*
 * Write to the tail of the buffer and check that
 * the same value can be read.
 */
ZTEST(display_read_write, test_write_to_buffer_tail)
{
	uint8_t data[4] = {0xFA, 0xAF, 0x9F, 0xFA};
	uint16_t height = (is_vtiled ? 8 : 1);
	uint16_t width = sizeof(data) / bpp * (is_htiled ? 8 : 1);
	uint16_t buf_size = width * bpp;
	struct display_buffer_descriptor desc = {
		.height = height,
		.pitch = width,
		.width = width,
		.buf_size = buf_size,
	};
	struct display_buffer_descriptor desc_whole = {
		.height = display_height,
		.pitch = display_width,
		.width = display_width,
		.buf_size = buffer_size(display_width, display_height),
	};
	int err;

	/* write data to tail of buffer */
	display_write(dev, display_width - width, display_height - height, &desc, data);

	/* read entire displayed data */
	err = display_read(dev, 0, 0, &desc_whole, disp_buffer);
	zassert_ok(err, "display_read failed");

	/* check write data and read data are same */
	size_t total_bytes = buffer_size(display_width, display_height);
	size_t area_bytes = buffer_size(width, height);
	uint8_t *compare = disp_buffer + (total_bytes - area_bytes);

	zassert_mem_equal(data, compare, area_bytes);

	/* check remaining region still black */
	verify_background_color(0, 0, display_width, display_height - height, 0);
	verify_background_color(0, display_height - height, display_width - width, height, 0);
}

/*
 * Verify that it will keep the drawn content even if display_read is executed
 */
ZTEST(display_read_write, test_read_does_not_clear_existing_buffer)
{
	uint8_t data[4] = {0xFA, 0xAF, 0x9F, 0xFA};
	uint8_t height = (is_vtiled ? 8 : 1);
	uint16_t width = sizeof(data) / bpp * (is_htiled ? 8 : 1);
	uint16_t buf_size = width * bpp;
	struct display_buffer_descriptor desc = {
		.height = height,
		.pitch = width,
		.width = width,
		.buf_size = buf_size,
	};
	struct display_buffer_descriptor desc_whole = {
		.height = display_height,
		.pitch = display_width,
		.width = display_width,
		.buf_size = buffer_size(display_width, display_height),
	};
	int err;

	/* write data to head of buffer */
	display_write(dev, 0, 0, &desc, data);

	/* check write data and read data are same */
	verify_bytes_of_area(data, 0, 0, width, height);

	/* check remaining region still black */
	verify_background_color(0, height, display_width, display_height - height, 0);
	verify_background_color(width, 0, display_width - width, display_height, 0);

	/* write data to tail of buffer */
	display_write(dev, display_width - width, display_height - height, &desc, data);

	/* read entire displayed data */
	err = display_read(dev, 0, 0, &desc_whole, disp_buffer);
	zassert_ok(err, "display_read failed");

	/* checking correctly write to the tail of buffer */
	size_t total_bytes = buffer_size(display_width, display_height);
	size_t area_bytes = buffer_size(width, height);
	uint8_t *compare = disp_buffer + (total_bytes - area_bytes);

	zassert_mem_equal(data, compare, area_bytes);

	/* checking if the content written before reading is kept */
	verify_bytes_of_area(data, 0, 0, width, height);

	/* checking remaining region is still black */
	verify_background_color(width, 0, display_width - width, display_height - height, 0);
	verify_background_color(0, height, display_width - width, display_height - height, 0);
}

ZTEST_SUITE(display_read_write, NULL, NULL, display_before, NULL, NULL);
```
