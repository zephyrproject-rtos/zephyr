## tests/drivers/display/display_check/boards/ek_ra8d1.conf
```kconfig
# Copyright (c) 2024 Renesas Electronics Corporation
# SPDX-License-Identifier: Apache-2.0

CONFIG_HEAP_MEM_POOL_SIZE=90440
```

## tests/drivers/display/display_check/boards/mimxrt595_evk_mimxrt595s_cm33.conf
```kconfig
#
# Copyright 2023, NXP
#
# SPDX-License-Identifier: Apache-2.0
#

# Sample will allocate buffer equal to: (panelwidth / 8) * (panelwidth / 4) * pixel depth. For a
# 1280x720 display in a 32-bpp format (e.g. ARGB8888), this is (720 / 8) * (720 / 4) * 4 = 64800
# bytes. We include 128 bytes of padding for kernel heap structures
CONFIG_HEAP_MEM_POOL_SIZE=64928
```

## tests/drivers/display/display_check/boards/mimxrt700_evk_mimxrt798s_cm33_cpu0.conf
```kconfig
#
# Copyright 2025 NXP
#
# SPDX-License-Identifier: Apache-2.0
#

CONFIG_SAMPLE_BUFFER_ADDR_ALIGN=64
CONFIG_SAMPLE_PITCH_ALIGN=64
```

## tests/drivers/display/display_check/testcase.yaml
```yaml
common:
  tags:
    - drivers
    - display
  harness: display_capture
  harness_config:
    pytest_dut_scope: session
    display_capture_config: "${DISPLAY_TEST_DIR}/display_config.yaml"
tests:
  tests.drivers.display.check.g1120b0mipi:
    platform_allow:
      - mimxrt595_evk/mimxrt595s/cm33
      - mimxrt700_evk/mimxrt798s/cm33_cpu0
    extra_args: SHIELD=g1120b0mipi
    extra_configs:
      - CONFIG_PM=y
      - CONFIG_PM_DEVICE=y
      - CONFIG_IDLE_STACK_SIZE=400
      - CONFIG_TEST=y
    harness_config:
      pytest_dut_scope: session
      fixture: fixture_display_g1120b0mipi
      display_capture_config: "${DISPLAY_TEST_DIR}/display_config.yaml"
  tests.drivers.display.check.st_b_lcd40_dsi1_mb1166_a09:
    filter: dt_compat_enabled("frida,nt35510")
    platform_allow: stm32h747i_disco/stm32h747xx/m7
    extra_args: SHIELD=st_b_lcd40_dsi1_mb1166_a09
    harness_config:
      fixture: fixture_display
      pytest_dut_scope: session
      display_capture_config: "${DISPLAY_TEST_DIR}/display_config.yaml"
  tests.drivers.display.check.rk043fn02h_ct:
    platform_allow:
      - mimxrt1064_evk
      - mimxrt1060_evk@A/mimxrt1062/qspi
      - mimxrt1060_evk@B/mimxrt1062/qspi
      - mimxrt1060_evk@C/mimxrt1062/qspi
      - mimxrt1050_evk/mimxrt1052/hyperflash
      - mimxrt1040_evk
    integration_platforms:
      - mimxrt1040_evk
    extra_args: SHIELD=rk043fn02h_ct
    harness_config:
      fixture: fixture_display
      pytest_dut_scope: session
      display_capture_config: "${DISPLAY_TEST_DIR}/display_config.yaml"
  tests.drivers.display.check.shield:
    # This test case is intended to verify support for shields on boards
    # known to support them. It is not intended to cover all combinations
    # of boards and shields, but rather serve as a method to test each
    # display shield within Zephyr.
    # Boards with built-in displays are also covered by this testcase.
    filter: dt_chosen_enabled("zephyr,display")
    harness_config:
      fixture: fixture_display
      pytest_dut_scope: session
      display_capture_config: "${DISPLAY_TEST_DIR}/display_config.yaml"
    extra_args:
      - platform:lpcxpresso55s69/lpc55s69/cpu0:SHIELD=adafruit_2_8_tft_touch_v2
      - platform:nrf52840dk/nrf52840:SHIELD=ssd1306_128x32
      - platform:frdm_k64f/mk64f12:SHIELD=ssd1306_128x64
      - platform:mimxrt685_evk/mimxrt685/cm33:SHIELD=waveshare_epaper_gdeh0213b1
      - platform:nucleo_l433rc_p/stm32l433xx:SHIELD=waveshare_epaper_gdew042t2
      - platform:nrf52dk/nrf52832:SHIELD=st7789v_tl019fqv01
      - platform:mimxrt1010_evk/mimxrt1011:SHIELD=st7789v_waveshare_240x240
      - platform:frdm_k22f/mk22f51212:SHIELD=ls013b7dh03
      - platform:nrf52833dk/nrf52833:SHIELD=st7735r_ada_160x128
      - platform:mimxrt1170_evk/mimxrt1176/cm7:SHIELD=rk055hdmipi4ma0
      - platform:da1469x_dk_pro/da14699:DTC_OVERLAY_FILE=da1469x_dk_pro_mipi_dbi.overlay
      - platform:nrf52840dk/nrf52840:SHIELD=max7219_8x8
      - platform:stm32h747i_disco/stm32h747xx/m7:SHIELD=st_b_lcd40_dsi1_mb1166
      - platform:mimxrt1064_evk/mimxrt1064:SHIELD=rk043fn66hs_ctg
      - platform:mimxrt1060_evk/mimxrt1062:SHIELD=rk043fn66hs_ctg
      - platform:mimxrt1050_evk/mimxrt1052:SHIELD=rk043fn66hs_ctg
      - platform:mimxrt1040_evk/mimxrt1042:SHIELD=rk043fn66hs_ctg
      - platform:frdm_mcxn947/mcxn947/cpu0:SHIELD=lcd_par_s035_8080
      - platform:mcx_n9xx_evk/mcxn947/cpu0:SHIELD=lcd_par_s035_8080
      - platform:frdm_mcxn236/mcxn236:SHIELD=lcd_par_s035_8080
      - platform:frdm_mcxa156/mcxa156:SHIELD=lcd_par_s035_8080
      - platform:frdm_rw612:SHIELD=lcd_par_s035_spi
      - platform:ek_ra8d1:SHIELD=rtkmipilcdb00000be
      - platform:ek_ra8d1:SHIELD=rtk7eka6m3b00001bu
      - platform:nucleo_g071rb/stm32g071xx:SHIELD=x_nucleo_gfx01m2
```

## tests/drivers/display/display_read_write/Kconfig
```kconfig
# Copyright (c) 2024 Renesas Electronics Corporation
# SPDX-License-Identifier: Apache-2.0

mainmenu "Display Read Write Test"

source "Kconfig.zephyr"

config DISPLAY_BUFFER_USE_GENERIC_SECTION
	bool "Place the display buffer in a specific memory section"
	help
	  Place the display buffer in a specific memory section.

config DISPLAY_BUFFER_ALIGNMENT
	int "Display buffer memory alignment"
	default 32
	help
	  Specific display buffer alignment.

if DISPLAY_BUFFER_USE_GENERIC_SECTION

config DISPLAY_BUFFER_SECTION
	string "Memory section to place Display Buffer"
	help
	  Specific memory section to place the display buffer.

endif # DISPLAY_BUFFER_USE_GENERIC_SECTION
```

## tests/drivers/display/display_read_write/boards/ek_ra8d1.conf
```kconfig
# Copyright (c) 2024 Renesas Electronics Corporation
# SPDX-License-Identifier: Apache-2.0

CONFIG_DISPLAY_BUFFER_USE_GENERIC_SECTION=y
CONFIG_DISPLAY_BUFFER_SECTION=".sdram"
CONFIG_DISPLAY_BUFFER_ALIGNMENT=64
```

## tests/drivers/display/display_read_write/boards/ek_ra8p1_r7ka8p1kflcac_cm85.conf
```kconfig
# Copyright (c) 2025 Renesas Electronics Corporation
# SPDX-License-Identifier: Apache-2.0

CONFIG_DISPLAY_BUFFER_USE_GENERIC_SECTION=y
CONFIG_DISPLAY_BUFFER_SECTION=".sdram"
CONFIG_DISPLAY_BUFFER_ALIGNMENT=64
```

## tests/drivers/display/display_read_write/testcase.yaml
```yaml
# Copyright 2024 (c) TOKITA Hiroshi
# SPDX-License-Identifier: Apache-2.0

common:
  tags:
    - drivers
    - display
  harness: ztest
  harness_config:
    fixture: display
tests:
  drivers.display.read_write.sdl.argb8888:
    platform_allow:
      - native_sim
      - native_sim/native/64
    extra_configs:
      - CONFIG_SDL_DISPLAY_DEFAULT_PIXEL_FORMAT_ARGB_8888=y
  drivers.display.read_write.sdl.al88:
    platform_allow:
      - native_sim
      - native_sim/native/64
    extra_configs:
      - CONFIG_SDL_DISPLAY_DEFAULT_PIXEL_FORMAT_AL_88=y
  drivers.display.read_write.sdl.rgb888:
    platform_allow:
      - native_sim
      - native_sim/native/64
    extra_configs:
      - CONFIG_SDL_DISPLAY_DEFAULT_PIXEL_FORMAT_RGB_888=y
  drivers.display.read_write.sdl.mono01.vtiled.msbfirst:
    platform_allow:
      - native_sim
      - native_sim/native/64
    extra_configs:
      - CONFIG_SDL_DISPLAY_DEFAULT_PIXEL_FORMAT_MONO01=y
  drivers.display.read_write.sdl.mono10.vtiled.msbfirst:
    platform_allow:
      - native_sim
      - native_sim/native/64
    extra_configs:
      - CONFIG_SDL_DISPLAY_DEFAULT_PIXEL_FORMAT_MONO10=y
  drivers.display.read_write.sdl.mono01.htiled.msbfirst:
    platform_allow:
      - native_sim
      - native_sim/native/64
    extra_configs:
      - CONFIG_SDL_DISPLAY_DEFAULT_PIXEL_FORMAT_MONO01=y
      - CONFIG_SDL_DISPLAY_MONO_VTILED=n
  drivers.display.read_write.sdl.mono10.htiled.msbfirst:
    platform_allow:
      - native_sim
      - native_sim/native/64
    extra_configs:
      - CONFIG_SDL_DISPLAY_DEFAULT_PIXEL_FORMAT_MONO10=y
      - CONFIG_SDL_DISPLAY_MONO_VTILED=n
  drivers.display.read_write.sdl.mono01.vtiled.lsbfirst:
    platform_allow:
      - native_sim
      - native_sim/native/64
    extra_configs:
      - CONFIG_SDL_DISPLAY_DEFAULT_PIXEL_FORMAT_MONO01=y
      - CONFIG_SDL_DISPLAY_MONO_MSB_FIRST=n
  drivers.display.read_write.sdl.mono10.vtiled.lsbfirst:
    platform_allow:
      - native_sim
      - native_sim/native/64
    extra_configs:
      - CONFIG_SDL_DISPLAY_DEFAULT_PIXEL_FORMAT_MONO10=y
      - CONFIG_SDL_DISPLAY_MONO_MSB_FIRST=n
  drivers.display.read_write.sdl.mono01.htiled.lsbfirst:
    platform_allow:
      - native_sim
      - native_sim/native/64
    extra_configs:
      - CONFIG_SDL_DISPLAY_DEFAULT_PIXEL_FORMAT_MONO01=y
      - CONFIG_SDL_DISPLAY_MONO_VTILED=n
      - CONFIG_SDL_DISPLAY_MONO_MSB_FIRST=n
  drivers.display.read_write.sdl.mono10.htiled.lsbfirst:
    platform_allow:
      - native_sim
      - native_sim/native/64
    extra_configs:
      - CONFIG_SDL_DISPLAY_DEFAULT_PIXEL_FORMAT_MONO10=y
      - CONFIG_SDL_DISPLAY_MONO_VTILED=n
      - CONFIG_SDL_DISPLAY_MONO_MSB_FIRST=n
  drivers.display.read_write.sdl.rgb565:
    platform_allow:
      - native_sim
      - native_sim/native/64
    extra_configs:
      - CONFIG_SDL_DISPLAY_DEFAULT_PIXEL_FORMAT_RGB_565=y
  drivers.display.read_write.sdl.bgr565:
    platform_allow:
      - native_sim
      - native_sim/native/64
    extra_configs:
      - CONFIG_SDL_DISPLAY_DEFAULT_PIXEL_FORMAT_BGR_565=y
  drivers.display.read_write.ili9340:
    tags:
      - shield
    extra_args:
      - SHIELD=adafruit_2_8_tft_touch_v2
      - EXTRA_DTC_OVERLAY_FILE=adafruit_2_8_tft_touch_rgb565.overlay
    extra_configs:
      - CONFIG_ILI9XXX_READ=y
    # Use platform_allow, because we cannot filter the test based on the
    # presence of the arduino_spi DT nodelabel
    platform_allow:
      - mimxrt685_evk/mimxrt685s/cm33
  drivers.display.read_write.renesas_ra_glcdc:
    tags:
      - shield
    filter: dt_compat_enabled("renesas,ra-glcdc")
    extra_args:
      - platform:ek_ra8d1/r7fa8d1bhecbd:SHIELD=rtkmipilcdb00000be
      - platform:ek_ra8d1/r7fa8d1bhecbd:SHIELD="rtk7eka6m3b00001bu;ek_ra8d1_rtk7eka6m3b00001bu"
```

## tests/drivers/dma/bcm2835_memcpy/testcase.yaml
```yaml
tests:
  drivers.dma.bcm2835_memcpy:
    platform_allow:
      - rpi_zero_w
    tags:
      - dma
      - rpi
    filter: dt_compat_enabled("brcm,bcm2835-dma")
```

## tests/drivers/dma/chan_blen_transfer/boards/esp32c3_devkitm.conf
```kconfig
CONFIG_DMA_TRANSFER_CHANNEL_NR_0=5
CONFIG_DMA_TRANSFER_CHANNEL_NR_1=0
CONFIG_HEAP_MEM_POOL_SIZE=32768
```

## tests/drivers/dma/chan_blen_transfer/boards/frdm_rw612.conf
```kconfig
# Copyright 2026 NXP
# SPDX-License-Identifier: Apache-2.0

# Test both dma0 (lpc-dma) and gdma controllers
CONFIG_DMA_LOOP_TRANSFER_NUMBER_OF_DMAS=2
```

## tests/drivers/dma/chan_blen_transfer/boards/imx95_evk_mimx9596_m7.conf
```kconfig
CONFIG_DMA_NXP_EDMA=y
CONFIG_DMA_TRANSFER_CHANNEL_NR_0=0
CONFIG_DMA_TRANSFER_CHANNEL_NR_1=2
```

## tests/drivers/dma/chan_blen_transfer/boards/max32651evkit.conf
```kconfig
# Copyright (c) 2026 Analog Devices, Inc.
# SPDX-License-Identifier: Apache-2.0

CONFIG_CODE_DATA_RELOCATION=y
```

## tests/drivers/dma/chan_blen_transfer/boards/max32672evkit.conf
```kconfig
# Copyright (c) 2024 Analog Devices, Inc.
# SPDX-License-Identifier: Apache-2.0

CONFIG_CODE_DATA_RELOCATION=y
```

## tests/drivers/dma/chan_blen_transfer/boards/nucleo_f429zi.conf
```kconfig
CONFIG_DMA_TRANSFER_DRV_NAME="DMA_2"
CONFIG_DMA_TRANSFER_CHANNEL_NR_0=1
CONFIG_DMA_TRANSFER_CHANNEL_NR_1=2
```

## tests/drivers/dma/chan_blen_transfer/boards/nucleo_f767zi.conf
```kconfig
CONFIG_DMA_TRANSFER_DRV_NAME="DMA_2"
CONFIG_DMA_TRANSFER_CHANNEL_NR_0=0
CONFIG_DMA_TRANSFER_CHANNEL_NR_1=4
CONFIG_NOCACHE_MEMORY=y
```

## tests/drivers/dma/chan_blen_transfer/boards/nucleo_g071rb.conf
```kconfig
CONFIG_DMA_TRANSFER_DRV_NAME="DMAMUX_1"
CONFIG_DMA_TRANSFER_CHANNEL_NR_0=0
CONFIG_DMA_TRANSFER_CHANNEL_NR_1=6
```

## tests/drivers/dma/chan_blen_transfer/boards/nucleo_g0b1re.conf
```kconfig
CONFIG_DMA_TRANSFER_DRV_NAME="DMAMUX_1"
CONFIG_DMA_TRANSFER_CHANNEL_NR_0=5
CONFIG_DMA_TRANSFER_CHANNEL_NR_1=9
```

## tests/drivers/dma/chan_blen_transfer/boards/nucleo_g474re.conf
```kconfig
# SPDX-FileCopyrightText: Copyright The Zephyr Project Contributors
# SPDX-License-Identifier: Apache-2.0

CONFIG_DMA_TRANSFER_CHANNEL_NR_0=5
CONFIG_DMA_TRANSFER_CHANNEL_NR_1=9
```
