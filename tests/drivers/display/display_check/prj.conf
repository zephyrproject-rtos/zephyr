## CMakeLists.txt
```
# SPDX-License-Identifier: Apache-2.0

cmake_minimum_required(VERSION 3.28.0)
find_package(Zephyr REQUIRED HINTS $ENV{ZEPHYR_BASE})
project(display)

# This project uses C source code from driver display sample
target_sources(app PRIVATE src/main.c ${ZEPHYR_BASE}/samples/drivers/display/src/display.c)
target_include_directories(app PRIVATE ${ZEPHYR_BASE}/samples/drivers/display/src/)
```

## prj.conf
```kconfig
# Copyright 2025 NXP
# SPDX-License-Identifier: Apache-2.0

CONFIG_LOG=y
CONFIG_DISPLAY=y
CONFIG_ZTEST=y
```

## boards/ek_ra8d1.conf
```kconfig
# Copyright (c) 2024 Renesas Electronics Corporation
# SPDX-License-Identifier: Apache-2.0

CONFIG_HEAP_MEM_POOL_SIZE=90440
```

## boards/frdm_rw612.conf
```kconfig
#
# Copyright 2025 NXP
#
# SPDX-License-Identifier: Apache-2.0
#
CONFIG_PM=y
```

## boards/mimxrt595_evk_mimxrt595s_cm33.conf
```kconfig
#
# Copyright 2023, NXP
#
# SPDX-License-Identifier: Apache-2.0
#

# Sample will allocate buffer equal to: (panelwidth / 8) * (panelwidth / 4) * pixel depth. For a
# 1280x720 display in a 32-bpp format (e.g. ARGB8888), this is (720 / 8) * (720 / 4) * 4 = 64800
# bytes. We include 128 bytes of padding for kernel heap structures
CONFIG_HEAP_MEM_POOL_SIZE=64928
```

## boards/mimxrt700_evk_mimxrt798s_cm33_cpu0.conf
```kconfig
#
# Copyright 2025 NXP
#
# SPDX-License-Identifier: Apache-2.0
#

CONFIG_SAMPLE_BUFFER_ADDR_ALIGN=64
CONFIG_SAMPLE_WIDTH_ALIGN=64
```

## src/main.c
```c
/*
 * Copyright (c) 2026 STMicroelectronics
 * SPDX-License-Identifier: Apache-2.0
 */

#include <zephyr/ztest.h>

#include "display.h"

ZTEST(display_test, test_display_by_capture)
{
	sample_display_draw();
}

ZTEST_SUITE(display_test, NULL, NULL, NULL, NULL, NULL);
```
