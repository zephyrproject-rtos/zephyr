/*
 * Copyright (c) 2021 Intel Corporation
 *
 * SPDX-License-Identifier: Apache-2.0
 */
#include <zephyr/dt-bindings/pcie/pcie.h>

/ {
	pcie0 {
		ivshmem0: ivshmem0 {
			compatible = "qemu,ivshmem";

			vendor-id = <0x1af4>;
			device-id = <0x1110>;

			status = "okay";
		};
	};
};
