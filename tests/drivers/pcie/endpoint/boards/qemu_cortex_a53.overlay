/*
 * SPDX-FileCopyrightText: Copyright The Zephyr Project Contributors
 * SPDX-License-Identifier: Apache-2.0
 */

#include "../app.overlay"

&pcie {
	status = "disabled";
};

&eth0 {
	status = "disabled";
};
