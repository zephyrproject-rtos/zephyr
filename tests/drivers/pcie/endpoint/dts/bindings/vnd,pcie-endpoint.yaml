## tests/drivers/pcie/endpoint/dts/bindings/vnd,pcie-endpoint.yaml
```yaml
# SPDX-FileCopyrightText: Copyright The Zephyr Project Contributors
# SPDX-License-Identifier: Apache-2.0

description: Fake PCIe endpoint for controller identity tests
compatible: "vnd,pcie-endpoint"
include: [base.yaml, pcie-device.yaml]
```

## tests/drivers/power_domain/gpio_monitor/dts/bindings/test-power-domain-child.yaml
```yaml
# SPDX-FileCopyrightText: Copyright 2026 NXP
#
# SPDX-License-Identifier: Apache-2.0

description: Test device on a GPIO-monitored power domain

compatible: "test-power-domain-child"

include: [base.yaml, pm.yaml]
```

## tests/drivers/pwm/pwm_api/boards/frdm_kl25z.conf
```kconfig
# Copyright (c) 2026 Gabriel Ivo <gabriel.bozi@usp.br>
#
# SPDX-License-Identifier: Apache-2.0

CONFIG_DEFAULT_PERIOD_CYCLE=1024
CONFIG_DEFAULT_PULSE_CYCLE=512
CONFIG_DEFAULT_PERIOD_NSEC=1000000
CONFIG_DEFAULT_PULSE_NSEC=500000
```

## tests/drivers/pwm/pwm_gpio_loopback/boards/pic32cx_sg61_cult.conf
```kconfig
# Copyright (c) 2026 Microchip Technology Inc.
# SPDX-License-Identifier: Apache-2.0

CONFIG_GPIO=y
```

## tests/drivers/pwm/pwm_loopback/testcase.yaml
```yaml
common:
  tags:
    - pwm
    - drivers
    - userspace
  depends_on: pwm
  filter: dt_compat_enabled("test-pwm-loopback")
  harness: ztest
  harness_config:
    fixture: pwm_loopback

tests:
  drivers.pwm.loopback:
    extra_args:
      - platform:am62l_evm/am62l3/a53:SNIPPET=ti-io-exp
  drivers.pwm.s32k5xxcvb_s32k566_ftm.loopback:
    extra_args: DTC_OVERLAY_FILE="boards/s32k5xxcvb_s32k566_ftm.overlay"
    platform_allow:
      - s32k5xxcvb/s32k566/m7
      - s32k5xxcvb/s32k566/r52
    depends_on: pwm
    filter: dt_compat_enabled("test-pwm-loopback")

  drivers.pwm.loopback.lp_em_cc2340r5:
    tags:
      - pwm
      - drivers
    platform_allow:
      - lp_em_cc2340r5
    extra_configs:
      - CONFIG_PWM_CAPTURE=y
    harness: ztest
    harness_config:
      fixture: pwm_loopback

  drivers.pwm.loopback.lp_em_cc2745r10_q1:
    tags:
      - pwm
      - drivers
    platform_allow:
      - lp_em_cc2745r10_q1/cc2745r10_q1
    extra_configs:
      - CONFIG_PWM_CAPTURE=y
    harness: ztest
    harness_config:
      fixture: pwm_loopback

  drivers.pwm.loopback.lp_em_cc2340r53:
    tags:
      - pwm
      - drivers
    platform_allow:
      - lp_em_cc2340r53
    extra_configs:
      - CONFIG_PWM_CAPTURE=y
    harness: ztest
    harness_config:
      fixture: pwm_loopback

  drivers.pwm.loopback.lp_em_cc2340r53_wcsp:
    tags:
      - pwm
      - drivers
    platform_allow:
      - lp_em_cc2340r53_wcsp
    extra_configs:
      - CONFIG_PWM_CAPTURE=y
    harness: ztest
    harness_config:
      fixture: pwm_loopback

  drivers.pwm.loopback.lp_em_cc2340r5moda:
    tags:
      - pwm
      - drivers
    platform_allow:
      - lp_em_cc2340r5moda
    extra_configs:
      - CONFIG_PWM_CAPTURE=y
    harness: ztest
    harness_config:
      fixture: pwm_loopback

  drivers.pwm.loopback.lp_em_cc2745r10_q1_cc2755r10:
    tags:
      - pwm
      - drivers
    platform_allow:
      - lp_em_cc2745r10_q1/cc2755r10
    extra_configs:
      - CONFIG_PWM_CAPTURE=y
    harness: ztest
    harness_config:
      fixture: pwm_loopback

  drivers.pwm.loopback.lp_em_cc2755p10:
    tags:
      - pwm
      - drivers
    platform_allow:
      - lp_em_cc2755p10
    extra_configs:
      - CONFIG_PWM_CAPTURE=y
    harness: ztest
    harness_config:
      fixture: pwm_loopback
```

## tests/drivers/rfid/testcase.yaml
```yaml
tests:
  drivers.rfid.cr95hf:
    tags:
      - drivers
      - rfid
    harness: ztest
    platform_allow:
      - native_sim
```

## tests/drivers/rtc/rtc_api/boards/mimxrt2660_evk_mimxrt2663_cm85.conf
```kconfig
# SPDX-FileCopyrightText: Copyright 2026 NXP
# SPDX-License-Identifier: Apache-2.0

CONFIG_RTC_ALARM=y
CONFIG_RTC_CALIBRATION=y
CONFIG_TEST_RTC_ALARM_TIME_MASK=63
```

## tests/drivers/rtc/rtc_api/boards/pic32cm_gc00_cpro.conf
```kconfig
# Copyright (c) 2026 Arkadiusz Grzelka
# SPDX-License-Identifier: Apache-2.0

CONFIG_RTC_ALARM=y
CONFIG_TEST_RTC_ALARM_TIME_MASK=63
CONFIG_RTC_CALIBRATION=y
```

## tests/drivers/sdhc/boards/stm32h573i_dk.conf
```kconfig
# Copyright (c) 2026 EXALT Technologies
# SPDX-License-Identifier: Apache-2.0

CONFIG_SDMMC_STM32=n
```

## tests/drivers/sdhc/boards/stm32h735g_disco.conf
```kconfig
# Copyright (c) 2026 EXALT Technologies
# SPDX-License-Identifier: Apache-2.0

CONFIG_SDMMC_STM32=n
CONFIG_HEAP_MEM_POOL_SIZE=2048
```

## tests/drivers/spi/spi_controller_peripheral/boards/lp_em_cc2745r10_q1_cc2755r10.conf
```kconfig
CONFIG_SPI=y
CONFIG_SPI_SLAVE=y
CONFIG_SPI_ASYNC=y
CONFIG_SPI_CC23X0_CC27XX_DMA_DRIVEN=y
CONFIG_PM=y
```

## tests/drivers/spi/spi_controller_peripheral/boards/nucleo_u385rg_q_half_duplex.conf
```kconfig
# SPDX-FileCopyrightText: Copyright (c) 2026 STMicroelectronics
# SPDX-License-Identifier: Apache-2.0

CONFIG_TEST_SPI_NO_HOLD_ON_CS=y
```

## tests/drivers/spi/spi_controller_peripheral/boards/rza3ul_smarc.conf
```kconfig
CONFIG_SPI_RENESAS_RZ_RSPI_INTERRUPT=n
CONFIG_SPI_RENESAS_RZ_RSPI_DMAC=y
CONFIG_TESTED_SPI_MODE=1
```

## tests/drivers/spi/spi_loopback/Kconfig
```kconfig
# SPDX-License-Identifier: Apache-2.0

mainmenu "SPI Loopback Test"

source "Kconfig.zephyr"

config SPI_LOOPBACK_MODE_LOOP
	bool "Configure the SPI in LOOP mode, so that no extra wiring is needed"

config SPI_LARGE_BUFFER_SIZE
	int "Large buffer size"
	default 8192

config SPI_IDEAL_TRANSFER_DURATION_SCALING
	int "Scaling factor to compare ideal and measured SPI transfer duration"
	default 40 if SPI_NXP_LPSPI_DMA || SPI_MCUX_FLEXIO
	default 8

config SPI_LOOPBACK_TEST_BUSY_DEINIT
	bool "Exercise device_deinit() while a transfer is in flight"
	depends on SPI_ASYNC
	help
	  Enable test_spi_deinit_busy, which asserts the driver rejects
	  device_deinit() with -EBUSY while an asynchronous transfer is still in
	  flight, then succeeds once it completes. Select this only on drivers
	  that implement that busy guard.

if SOC_SERIES_STM32H7X

config SPI_LOOPBACK_16BITS_FRAMES
	bool "Use 16 bits frames for tests"

config DT_DEFINED_NOCACHE
	bool "Enable this if nocache regions are defined in devicetree"

if DT_DEFINED_NOCACHE

config DT_DEFINED_NOCACHE_NAME
	string "Name of the nocache region defined in devicetree (capitals)"

endif # DT_DEFINED_NOCACHE

endif # SOC_SERIES_STM32H7X
```

## tests/drivers/spi/spi_loopback/boards/aik_ra8d1.conf
```kconfig
# Copyright (c) 2026 Renesas Electronics Corporation
# SPDX-License-Identifier: Apache-2.0

CONFIG_SPI_LOOPBACK_MODE_LOOP=y
CONFIG_SPI_INTERRUPT_DRIVEN=y
CONFIG_SPI_DMA=y
```

## tests/drivers/spi/spi_loopback/boards/am62l_evm_am62l3_a53.conf
```kconfig
# SPDX-FileCopyrightText: 2026 Texas Instruments Incorporated
#
# SPDX-License-Identifier: Apache-2.0

CONFIG_SPI_LOOPBACK_MODE_LOOP=y
CONFIG_SPI_IDEAL_TRANSFER_DURATION_SCALING=30
```

## tests/drivers/spi/spi_loopback/boards/beagley_ai_j722s_mcu_r5f0_0.conf
```kconfig
# Copyright (C) 2026 BeagleBoard.org Foundation
# Copyright (C) 2026 Dhruv Menon <dhruvmenon1104@gmail.com>
#
# SPDX-License-Identifier: Apache-2.0

CONFIG_SPI_LOOPBACK_MODE_LOOP=y
```

## tests/drivers/spi/spi_loopback/boards/ek_ra4e2.conf
```kconfig
# Copyright (c) 2024 Renesas Electronics Corporation
# SPDX-License-Identifier: Apache-2.0

CONFIG_SPI_LOOPBACK_MODE_LOOP=y
```

## tests/drivers/spi/spi_loopback/boards/ek_ra4m1.conf
```kconfig
# Copyright (c) 2025 Renesas Electronics Corporation
# SPDX-License-Identifier: Apache-2.0

CONFIG_SPI_LOOPBACK_MODE_LOOP=y
CONFIG_SPI_LARGE_BUFFER_SIZE=4096
```
