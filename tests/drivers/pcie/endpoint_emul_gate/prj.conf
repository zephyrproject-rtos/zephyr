## CMakeLists.txt
```
# SPDX-FileCopyrightText: Copyright (c) 2026 Process Mission
#
# SPDX-License-Identifier: Apache-2.0

cmake_minimum_required(VERSION 3.20.0)
find_package(Zephyr REQUIRED HINTS $ENV{ZEPHYR_BASE})
project(pcie_ep_emul_gate)

target_sources(app PRIVATE src/main.c)
```

## prj.conf
```kconfig
# SPDX-FileCopyrightText: Copyright (c) 2026 Process Mission
#
# SPDX-License-Identifier: Apache-2.0

# Request the driver without providing any zephyr,pcie-ep-emul node.
CONFIG_TEST=y
CONFIG_PCIE_ENDPOINT=y
CONFIG_PCIE_EP_EMUL=y
CONFIG_IRQ_OFFLOAD=y
```

## src/main.c
```c
/*
 * SPDX-FileCopyrightText: Copyright (c) 2026 Process Mission
 *
 * SPDX-License-Identifier: Apache-2.0
 */

#include <zephyr/sys/util.h>

/*
 * prj.conf requests CONFIG_PCIE_EP_EMUL=y, but this application has no
 * zephyr,pcie-ep-emul devicetree node. The driver's
 * DT_HAS_ZEPHYR_PCIE_EP_EMUL_ENABLED dependency must keep the symbol
 * off so the driver is not compiled with zero instances. If the gate
 * is dropped, the symbol turns on and this assert fails the build.
 */
BUILD_ASSERT(!IS_ENABLED(CONFIG_PCIE_EP_EMUL),
	     "PCIE_EP_EMUL must stay gated off without a zephyr,pcie-ep-emul node");

int main(void)
{
	return 0;
}
```
