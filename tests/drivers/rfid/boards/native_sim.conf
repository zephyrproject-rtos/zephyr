## tests/drivers/rfid/boards/native_sim.conf
```kconfig
# Copyright (c) 2025 Conny Marco Menebröcker
#
# SPDX-License-Identifier: Apache-2.0


CONFIG_EMUL=y
CONFIG_SPI=y
CONFIG_GPIO=y
CONFIG_SPI_EMUL=y
CONFIG_GPIO_EMUL=y
CONFIG_RFID=y
CONFIG_RFID_CR95HF=y
CONFIG_RFID_ISO14443=y
CONFIG_RFID_ISO14443A=y
CONFIG_CRC=y
CONFIG_EMUL_CR95HF=y
```

## tests/drivers/rtc/rtc_api/Kconfig
```kconfig
# Copyright (c) 2024 Bjarki Arge Andreasen
# SPDX-License-Identifier: Apache-2.0

source "Kconfig.zephyr"

if RTC_ALARM

config TEST_RTC_ALARM_TIME_MASK
	int "Alarm fields to set"
	default 6
	range 1 511
	help
	  Set the RTC_ALARM_TIME_MASK_ bitmask to use when setting
	  RTC alarms during testing.

endif # RTC_ALARM
```

## tests/drivers/rtc/rtc_api/boards/apollo4p_evb.conf
```kconfig
# Copyright (c) 2024, Ambiq Micro Inc. <www.ambiq.com>
# SPDX-License-Identifier: Apache-2.0

CONFIG_RTC_ALARM=y
CONFIG_TEST_RTC_ALARM_TIME_MASK=79
```

## tests/drivers/rtc/rtc_api/boards/ek_ra4l1.conf
```kconfig
# Copyright (c) 2025 Renesas Electronics Corporation
# SPDX-License-Identifier: Apache-2.0

CONFIG_RTC_ALARM=y
CONFIG_RTC_UPDATE=y
CONFIG_TEST_RTC_ALARM_TIME_MASK=63
```

## tests/drivers/rtc/rtc_api/boards/frdm_ke15z.conf
```kconfig
#
# Copyright 2025 NXP
#
# SPDX-License-Identifier: Apache-2.0
#

CONFIG_RTC_ALARM=y
CONFIG_RTC_UPDATE=y
CONFIG_RTC_CALIBRATION=y
```

## tests/drivers/rtc/rtc_api/boards/it82xx2_evb.conf
```kconfig
# Copyright (c) 2026 ITE Technology Corporation
# SPDX-License-Identifier: Apache-2.0

CONFIG_RTC_ALARM=y
CONFIG_TEST_RTC_ALARM_TIME_MASK=95
```

## tests/drivers/rtc/rtc_api/boards/kit_pse84_eval_pse846gps2dbzc4a_m55.conf
```kconfig
# SPDX-FileCopyrightText: <text>Copyright (c) 2026 Infineon Technologies AG,
# or an affiliate of Infineon Technologies AG. All rights reserved.</text>
#
# SPDX-License-Identifier: Apache-2.0

CONFIG_RTC_CALIBRATION=y
```

## tests/drivers/rtc/rtc_api/boards/kv260_r5.conf
```kconfig
# Copyright (c) 2026 Advanced Micro Devices, Inc.
# SPDX-License-Identifier: Apache-2.0

CONFIG_RTC_ALARM=y
CONFIG_RTC_CALIBRATION=y
CONFIG_RTC_INIT_PRIORITY=70
CONFIG_COUNTER_CALIBRATION=y
CONFIG_TEST_RTC_ALARM_TIME_MASK=255
```

## tests/drivers/rtc/rtc_api/boards/lpcxpresso55s69_lpc55s69_cpu0.conf
```kconfig
#
# Copyright 2025 NXP
#
# SPDX-License-Identifier: Apache-2.0
#

CONFIG_RTC_ALARM=y
CONFIG_RTC_INIT_PRIORITY=70
CONFIG_TEST_RTC_ALARM_TIME_MASK=255
```

## tests/drivers/rtc/rtc_api/boards/max32670evkit.conf
```kconfig
# Copyright (c) 2024 Analog Devices, Inc.
# SPDX-License-Identifier: Apache-2.0

CONFIG_RTC_ALARM=y
CONFIG_RTC_UPDATE=y
CONFIG_RTC_CALIBRATION=y
```

## tests/drivers/rtc/rtc_api/boards/mpfs_icicle_polarfire_u54.conf
```kconfig
# Copyright (c) 2026 Microchip Technology Inc.
# SPDX-License-Identifier: Apache-2.0

CONFIG_RTC_ALARM=y
CONFIG_TEST_RTC_ALARM_TIME_MASK=63
```

## tests/drivers/rtc/rtc_api/boards/nucleo_h7s3l8.conf
```kconfig
# SPDX-FileCopyrightText: Copyright The Zephyr Project Contributors
# SPDX-License-Identifier: Apache-2.0

CONFIG_RTC_CALIBRATION=y
CONFIG_RTC_ALARM=y
```

## tests/drivers/rtc/rtc_api/boards/nucleo_wb09ke.conf
```kconfig
CONFIG_RTC_CALIBRATION=y
# RTC alarms disabled due to STM32WB09xE erratum ES0584 §2.5.2:
# RTC interrupts may be lost in Run mode (LSI/LSE clock)
CONFIG_RTC_ALARM=n
```

## tests/drivers/rtc/rtc_api/boards/pic32cx_sg41_cult.conf
```kconfig
# Copyright (c) 2025 Microchip Technology Inc.
# SPDX-License-Identifier: Apache-2.0

CONFIG_RTC_ALARM=y
CONFIG_TEST_RTC_ALARM_TIME_MASK=63
CONFIG_RTC_CALIBRATION=y
```

## tests/drivers/rtc/rtc_api/boards/qemu_x86_atom.conf
```kconfig
# Copyright (c) 2023 Bjarki Arge Andreasen
# SPDX-License-Identifier: Apache-2.0

CONFIG_RTC_ALARM=y
CONFIG_RTC_UPDATE=y
```

## tests/drivers/rtc/rtc_api/boards/rtl8752h_evb_rtl8752hjl.conf
```kconfig
# Copyright (c) 2026, Realtek Semiconductor Corporation
# SPDX-License-Identifier: Apache-2.0

CONFIG_RTC_ALARM=y
CONFIG_TEST_RTC_ALARM_TIME_MASK=255
CONFIG_RTC_INIT_PRIORITY=70
```

## tests/drivers/rtc/rtc_api/boards/rtl87x2g_evb_a_rtl8762gku.conf
```kconfig
# Copyright (c) 2026, Realtek Semiconductor Corporation
# SPDX-License-Identifier: Apache-2.0

CONFIG_RTC_BEE=y
CONFIG_RTC_ALARM=y
CONFIG_RTC_UPDATE=y
CONFIG_TEST_RTC_ALARM_TIME_MASK=319
```
