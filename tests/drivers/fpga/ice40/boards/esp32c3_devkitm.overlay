&spi2 {
	cs-gpios = <&gpio0 10 (GPIO_PULL_UP | GPIO_OPEN_DRAIN | GPIO_ACTIVE_LOW)>;

	fpga0: fpga@0 {
		status = "okay";
		compatible = "lattice,ice40-fpga";

		reg = <0>;
		spi-max-frequency = <1000000>;

		cdone-gpios = <&gpio0 18 0>;
		creset-gpios = <&gpio0 19 GPIO_OPEN_DRAIN>;
		config-delay-us = <2000>;
		creset-delay-ns = <200>;
		additional-clocks = <160>;
	};
};
