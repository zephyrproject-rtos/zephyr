## CMakeLists.txt
```
# SPDX-License-Identifier: Apache-2.0

cmake_minimum_required(VERSION 3.20.0)
find_package(Zephyr REQUIRED HINTS $ENV{ZEPHYR_BASE})
project(lan78xx_build)

target_sources(app PRIVATE src/main.c)
```

## prj.conf
```kconfig
CONFIG_TEST=y
CONFIG_NETWORKING=y
CONFIG_ETH_DRIVER=y
CONFIG_NET_L2_ETHERNET=y
CONFIG_USB_HOST_STACK=y
CONFIG_ENTROPY_GENERATOR=y
CONFIG_TEST_RANDOM_GENERATOR=y
```

## app.overlay
```dts
/*
 * SPDX-FileCopyrightText: Copyright (c) 2026 Narek Aydinyan
 * SPDX-License-Identifier: Apache-2.0
 */

/ {
	chosen {
		zephyr,uhc = &usbotg_hs;
	};

	lan78xx: ethernet {
		compatible = "microchip,lan78xx";
		local-mac-address = [02 00 00 00 00 01];
		uhc = <&usbotg_hs>;
		status = "okay";
	};
};

&usbotg_hs {
	dr-mode = "host";
};
```

## src/main.c
```c
/*
 * SPDX-FileCopyrightText: Copyright (c) 2026 Narek Aydinyan
 * SPDX-License-Identifier: Apache-2.0
 */

int main(void)
{
	return 0;
}
```
