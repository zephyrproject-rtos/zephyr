## CMakeLists.txt
```
# SPDX-License-Identifier: Apache-2.0

cmake_minimum_required(VERSION 3.20.0)

find_package(Zephyr REQUIRED HINTS $ENV{ZEPHYR_BASE})
project(w6300_http_server)

target_sources(app PRIVATE src/main.c src/http_server.c)

# Add driver directory to include path
target_include_directories(app PRIVATE ${ZEPHYR_BASE}/drivers/ethernet)
```

## prj.conf
```kconfig
# RPi Pico drivers
CONFIG_CLOCK_CONTROL=y
CONFIG_CLOCK_CONTROL_RPI_PICO=y
CONFIG_RESET=y
CONFIG_RESET_RPI_PICO=y
CONFIG_GPIO=y
CONFIG_SPI=y

# Networking
CONFIG_NETWORKING=y
CONFIG_NET_L2_ETHERNET=y
CONFIG_ETH_W6300=y
CONFIG_NET_NATIVE=y
CONFIG_NET_IPV4=y
CONFIG_NET_TCP=y
CONFIG_NET_SOCKETS=y

# Network Configuration (Static IP)
CONFIG_NET_CONFIG_SETTINGS=y
CONFIG_NET_CONFIG_NEED_IPV4=y
CONFIG_NET_CONFIG_MY_IPV4_ADDR="192.168.11.2"
CONFIG_NET_CONFIG_MY_IPV4_GW="192.168.11.1"
CONFIG_NET_CONFIG_MY_IPV4_NETMASK="255.255.255.0"
CONFIG_NET_DHCPV4=n

# Required for networking stack
CONFIG_ENTROPY_GENERATOR=y
CONFIG_TEST_RANDOM_GENERATOR=y

# Logging
CONFIG_LOG=y
CONFIG_LOG_DEFAULT_LEVEL=3
CONFIG_NET_LOG=y
CONFIG_PRINTK=y
CONFIG_LOG_MODE_IMMEDIATE=y

# Memory settings from reference
CONFIG_MAIN_STACK_SIZE=4096
CONFIG_HEAP_MEM_POOL_SIZE=8192
CONFIG_NET_PKT_RX_COUNT=2
CONFIG_NET_PKT_TX_COUNT=2
CONFIG_NET_BUF_RX_COUNT=4
CONFIG_NET_BUF_TX_COUNT=4
```

## src/main.c
```c
#include <errno.h>
#include <stdio.h>

#include <zephyr/kernel.h>
#include <zephyr/logging/log.h>
#include <zephyr/net/net_config.h>
#include <zephyr/net/net_if.h>
#include <zephyr/net/net_mgmt.h>
#include <zephyr/net/socket.h>

#include "http_server.h"

LOG_MODULE_REGISTER(w6300_http_server, LOG_LEVEL_INF);

#define DHCP_WAIT_TIMEOUT K_SECONDS(10)

static struct net_mgmt_event_callback mgmt_cb;
static struct k_sem dhcp_ready_sem;

static void net_event_handler(struct net_mgmt_event_callback *cb,
			      uint64_t mgmt_event, struct net_if *iface)
{
	ARG_UNUSED(cb);
	ARG_UNUSED(iface);

	if (mgmt_event == NET_EVENT_IPV4_ADDR_ADD) {
		k_sem_give(&dhcp_ready_sem);
	}
}

static void setup_ipv4_watch(void)
{
	k_sem_init(&dhcp_ready_sem, 0, 1);
	net_mgmt_init_event_callback(&mgmt_cb, net_event_handler, NET_EVENT_IPV4_ADDR_ADD);
	net_mgmt_add_event_callback(&mgmt_cb);
}

static void print_network_info(struct net_if *iface)
{
	struct net_if_config *config = net_if_get_config(iface);
	char buf[NET_IPV4_ADDR_LEN];

	LOG_INF("Network Information:");
	
	if (config->ip.ipv4) {
		for (int i = 0; i < NET_IF_MAX_IPV4_ADDR; i++) {
			if (config->ip.ipv4->unicast[i].ipv4.is_used) {
				net_addr_ntop(AF_INET, 
					      &config->ip.ipv4->unicast[i].ipv4.address.in_addr, 
					      buf, sizeof(buf));
				LOG_INF("  IP      : %s", buf);
				
				net_addr_ntop(AF_INET, 
					      &config->ip.ipv4->unicast[i].netmask, 
					      buf, sizeof(buf));
				LOG_INF("  Subnet  : %s", buf);
				
				net_addr_ntop(AF_INET, 
					      &config->ip.ipv4->gw, 
					      buf, sizeof(buf));
				LOG_INF("  Gateway : %s", buf);
			}
		}
	}

	struct net_linkaddr *link = net_if_get_link_addr(iface);
	if (link->len >= 6) {
		LOG_INF("  MAC     : %02X:%02X:%02X:%02X:%02X:%02X",
			link->addr[0], link->addr[1], link->addr[2],
			link->addr[3], link->addr[4], link->addr[5]);
	}
}

static void wait_for_ipv4_address(void)
{
	int ret;

	ret = k_sem_take(&dhcp_ready_sem, DHCP_WAIT_TIMEOUT);
	if (ret == 0) {
		LOG_INF("IPv4 address acquired");
		print_network_info(net_if_get_default());
	} else {
		LOG_WRN("Timed out waiting for IPv4 address");
	}
}

void main(void)
{
	LOG_INF("Starting W6300 HTTP server");

	setup_ipv4_watch();
	(void)net_config_init_app(NULL, "Configuring network");
	wait_for_ipv4_address();

	http_server_init();
	http_server_run();
}
```

## src/http_server.c
```c
#include <zephyr/logging/log.h>
#include <zephyr/net/socket.h>
#include "http_server.h"

LOG_MODULE_DECLARE(w6300_http_server, LOG_LEVEL_INF);

static const char http_response[] =
	"HTTP/1.1 200 OK\r\n"
	"Content-Type: text/html\r\n"
	"Connection: close\r\n"
	"\r\n"
	"<!DOCTYPE html>"
	"<html>"
	"<head>"
	"<title>W6300 Server</title>"
	"<meta name='viewport' content='width=device-width, initial-scale=1'>"
	"<style>"
	"body { font-family: sans-serif; text-align: center; margin-top: 50px; background-color: #f0f0f0; }"
	"h1 { color: #0055aa; }"
	".card { background: white; padding: 20px; margin: auto; max-width: 400px; border-radius: 10px; box-shadow: 0 4px 8px rgba(0,0,0,0.1); }"
	".status { color: green; font-weight: bold; }"
	"</style>"
	"</head>"
	"<body>"
	"<div class='card'>"
	"<h1>W6300 HTTP Server</h1>"
	"<p>Board: <strong>W6300 EVB PICO2</strong></p>"
	"<p>Status: <span class='status'>Online</span></p>"
	"<p>Core: Hazard3 (RISC-V)</p>"
	"</div>"
	"</body>"
	"</html>";

void http_server_init(void)
{
    LOG_INF("Initializing HTTP Server");
}

void http_server_run(void)
{
    int server_fd;
    struct sockaddr_in addr = {
        .sin_family = AF_INET,
        .sin_port = htons(HTTP_SERVER_PORT),
        .sin_addr = {
            .s_addr = htonl(INADDR_ANY),
        },
    };

    server_fd = zsock_socket(AF_INET, SOCK_STREAM, IPPROTO_TCP);
    if (server_fd < 0) {
        LOG_ERR("Failed to create socket: %d", errno);
        return;
    }

    if (zsock_bind(server_fd, (struct sockaddr *)&addr, sizeof(addr)) < 0) {
        LOG_ERR("Failed to bind socket: %d", errno);
        zsock_close(server_fd);
        return;
    }

    if (zsock_listen(server_fd, MAX_HTTP_CLIENTS) < 0) {
        LOG_ERR("Failed to listen: %d", errno);
        zsock_close(server_fd);
        return;
    }

    LOG_INF("HTTP server listening on port %d", HTTP_SERVER_PORT);

    while (true) {
        struct sockaddr_in client_addr;
        socklen_t client_addr_len = sizeof(client_addr);
        int client_fd = zsock_accept(server_fd, (struct sockaddr *)&client_addr,
                        &client_addr_len);

        if (client_fd < 0) {
            LOG_ERR("Failed to accept connection: %d", errno);
            k_sleep(K_MSEC(100));
            continue;
        }

        char client_ip[INET_ADDRSTRLEN];
        zsock_inet_ntop(AF_INET, &client_addr.sin_addr, client_ip, sizeof(client_ip));
        LOG_INF("Client connected from %s", client_ip);

        char recv_buf[HTTP_RX_BUF_SIZE];
        ssize_t total_received = 0;
        ssize_t received;

        /* Set receive timeout to prevent hanging */
        struct zsock_timeval tv = {
            .tv_sec = 2,
            .tv_usec = 0,
        };
        zsock_setsockopt(client_fd, SOL_SOCKET, SO_RCVTIMEO, &tv, sizeof(tv));

        /* Simple read loop to drain request headers */
        do {
            received = zsock_recv(client_fd, recv_buf + total_received, 
                          HTTP_RX_BUF_SIZE - total_received - 1, 0);
            if (received > 0) {
                total_received += received;
                recv_buf[total_received] = '\0';
                if (strstr(recv_buf, "\r\n\r\n")) {
                    break;
                }
            } else {
                break;
            }
        } while (total_received < HTTP_RX_BUF_SIZE - 1);

        if (total_received > 0) {
            LOG_INF("Request received from %s (%d bytes)", client_ip, (int)total_received);
        }

        ssize_t sent = zsock_send(client_fd, http_response, sizeof(http_response) - 1, 0);
        if (sent < 0) {
            LOG_ERR("Failed to send response to %s: %d", client_ip, errno);
        }

        k_sleep(K_MSEC(50)); /* Give client time to receive */
        zsock_close(client_fd);
        LOG_INF("Client %s disconnected", client_ip);
    }
}
```

## src/http_server.h
```c
#ifndef __HTTP_SERVER_H__
#define __HTTP_SERVER_H__

#include <zephyr/kernel.h>
#include <zephyr/net/socket.h>

/* HTTP Server Configuration */
#define HTTP_SERVER_PORT 8080
#define MAX_HTTP_CLIENTS 4
#define HTTP_RX_BUF_SIZE 2048
#define HTTP_TX_BUF_SIZE 2048

/* Function Prototypes */
void http_server_init(void);
void http_server_run(void);

#endif /* __HTTP_SERVER_H__ */
```
