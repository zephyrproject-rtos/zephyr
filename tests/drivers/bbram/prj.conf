## CMakeLists.txt
```
# Copyright 2021 Google LLC
# SPDX-License-Identifier: Apache-2.0

cmake_minimum_required(VERSION 3.20.0)

find_package(Zephyr REQUIRED HINTS $ENV{ZEPHYR_BASE})
project(bbram)

FILE(GLOB app_sources src/*.c)
target_sources(app PRIVATE ${app_sources})
```

## prj.conf
```kconfig
# Copyright 2021 Google LLC
# SPDX-License-Identifier: Apache-2.0

CONFIG_ZTEST=y
CONFIG_BBRAM=y
CONFIG_BBRAM_EMUL=y
```

## it8xxx2.conf
```kconfig
# Copyright 2021 Google LLC
# SPDX-License-Identifier: Apache-2.0

CONFIG_ZTEST=y
CONFIG_ZTEST_NEW_API=y
CONFIG_BBRAM=y
CONFIG_BBRAM_IT8XXX2=y
```

## npcx.conf
```kconfig
# Copyright 2021 Google LLC
# SPDX-License-Identifier: Apache-2.0

CONFIG_ZTEST=y
CONFIG_ZTEST_NEW_API=y
CONFIG_BBRAM=y
CONFIG_BBRAM_NPCX=y
```

## stm32.conf
```kconfig
# SPDX-FileCopyrightText: Copyright The Zephyr Project Contributors
# SPDX-License-Identifier: Apache-2.0

CONFIG_COUNTER=y
```

## stm32_rtc.conf
```kconfig
# SPDX-FileCopyrightText: Copyright The Zephyr Project Contributors
# SPDX-License-Identifier: Apache-2.0

CONFIG_RTC=y
```

## boards/qemu_riscv32.overlay
```dts
/*
 * Copyright 2021 Google LLC
 *
 * SPDX-License-Identifier: Apache-2.0
 */

/ {
	bbram: bbram@80 {
		compatible = "ite,it8xxx2-bbram";
		status = "okay";
		reg = <0x80 0xff>;
	};
};
```

## src/main.c
```c
/*
 * Copyright 2021 Google LLC
 * SPDX-License-Identifier: Apache-2.0
 */

#include <zephyr/ztest.h>

void test_main(void)
{
	/* Build only test, this is a stub. */
}
```
