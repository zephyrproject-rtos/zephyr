/*
 * SPDX-FileCopyrightText: Copyright (c) 2026 Linumiz
 * SPDX-License-Identifier: Apache-2.0
 */

/ {
	fake_pwm: fake-pwm {
		compatible = "zephyr,fake-pwm";
		#pwm-cells = <2>;
		frequency = <80000000>;
		status = "okay";
	};

	ir_tx: ir-tx {
		compatible = "pwm-ir-transmitter";
		pwms = <&fake_pwm 0 0>;
		counter = <&counter0>;
	};
};
