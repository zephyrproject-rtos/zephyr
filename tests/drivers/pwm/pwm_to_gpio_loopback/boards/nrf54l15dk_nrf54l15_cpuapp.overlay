/*
 * Copyright (c) 2024 Nordic Semiconductor ASA
 *
 * SPDX-License-Identifier: Apache-2.0
 */

#include <zephyr/dt-bindings/pwm/pwm.h>
#include <zephyr/dt-bindings/gpio/nordic-nrf-gpio.h>

/ {
	pwm_to_gpio_loopback: pwm_to_gpio_loopback {
		compatible = "test-pwm-to-gpio-loopback";
		pwms = <&pwm20 0 0 PWM_POLARITY_NORMAL>;
		gpios = <&gpio1 11 GPIO_ACTIVE_HIGH>;
	};
};
