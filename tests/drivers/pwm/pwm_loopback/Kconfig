## tests/drivers/pwm/pwm_loopback/Kconfig
```kconfig
# Copyright 2025 NXP
#
# SPDX-License-Identifier: Apache-2.0

mainmenu "PWM loopback test"

config TEST_PWM_PERIOD_NSEC
	int "Test PWM period in nanoseconds"
	default 100000000

config TEST_PWM_PULSE_NSEC
	int "Test PWM pulse in nanoseconds"
	default 15000000

config TEST_PWM_PERIOD_USEC
	int "Test PWM period in microseconds"
	default 100000

config TEST_PWM_PULSE_USEC
	int "Test PWM pulse in microseconds"
	default 75000

source "Kconfig.zephyr"
```

## tests/drivers/pwm/pwm_loopback/boards/frdm_imxrt1186_mimxrt1186_cm33.conf
```kconfig
CONFIG_TEST_PWM_PERIOD_NSEC=20000000
CONFIG_TEST_PWM_PULSE_NSEC=10000000

CONFIG_TEST_PWM_PERIOD_USEC=20000
CONFIG_TEST_PWM_PULSE_USEC=10000
```

## tests/drivers/pwm/pwm_loopback/boards/kg100s_rb4332a.conf
```kconfig
# Copyright (c) 2026 Martin Moya <martin.moya@focus.uy>
# SPDX-License-Identifier: Apache-2.0

# TIMER1 (capture, 16-bit) at 76.8 MHz EM01GRPACLK overflows after ~853 us.
# Use 800 us period so the capture value fits in the 16-bit counter.
CONFIG_TEST_PWM_PERIOD_NSEC=800000
CONFIG_TEST_PWM_PULSE_NSEC=400000
CONFIG_TEST_PWM_PERIOD_USEC=800
CONFIG_TEST_PWM_PULSE_USEC=400
```

## tests/drivers/pwm/pwm_loopback/boards/mimxrt1180_evk_mimxrt1189_cm33.conf
```kconfig
CONFIG_TEST_PWM_PERIOD_NSEC=10000000
CONFIG_TEST_PWM_PULSE_NSEC=1500000

CONFIG_TEST_PWM_PERIOD_USEC=10000
CONFIG_TEST_PWM_PULSE_USEC=7500
```

## tests/drivers/pwm/pwm_loopback/dts/bindings/test-pwm-loopback.yaml
```yaml
#
# Copyright (c) 2020-2021 Vestas Wind Systems A/S
#
# SPDX-License-Identifier: Apache-2.0
#

description: |
    This binding provides resources required to build and run the
    tests/drivers/pwm/pwm_loopback test in Zephyr.

compatible: "test-pwm-loopback"

properties:
  pwms:
    type: phandle-array
    required: true
    description: |
      PWM pins that will be used for generating and capturing a pulse-width
      modulated signal. The pin at the first index will be used for signal
      generation while the pin at the second index will be used for capuring
      the generated signal. The two pins must be physically connected to
      each other.
```

## tests/drivers/pwm/pwm_to_gpio_loopback/Kconfig
```kconfig
#
# Copyright (c) 2024 Nordic Semiconductor ASA
#
# SPDX-License-Identifier: Apache-2.0
#

config TEST_PWM_PERIOD_USEC
	int "PWM period in microseconds"
	default 200000
	help
	  Set PWM signal period to TEST_PWM_PERIOD_USEC microseconds.
	  In the test, PWM pulse width will be set to half of this value.
	  The maximum allowable PWM period value is limited by the hardware design.

source "Kconfig.zephyr"
```

## tests/drivers/pwm/pwm_to_gpio_loopback/dts/bindings/test-pwm-to-gpio-loopback.yaml
```yaml
#
# Copyright (c) 2024 Nordic Semiconductor ASA
#
# SPDX-License-Identifier: Apache-2.0
#

description: |
    This binding provides resources required to build and run the
    tests/drivers/pwm/pwm_to_gpio_loopback test in Zephyr.

compatible: "test-pwm-to-gpio-loopback"

properties:
  pwms:
    type: phandle-array
    required: true
    description: |
      PWM pin that will be used for generating a pulse-width modulated signal.
  gpios:
    type: phandle-array
    required: true
    description: |
      GPIO pin will be used for capturing the generated signal. The PWM and GPIO
      pins must be physically connected to each other.
```

## tests/drivers/pwm/pwm_to_gpio_loopback/testcase.yaml
```yaml
common:
  tags:
    - pwm
    - drivers
    - ci_tests_drivers_pwm
  depends_on: pwm
  filter: dt_compat_enabled("test-pwm-to-gpio-loopback")
  harness: ztest
  harness_config:
    fixture: gpio_loopback

tests:
  drivers.pwm.gpio_loopback:
    platform_allow:
      - nrf54h20dk/nrf54h20/cpuapp
      - nrf54l15dk/nrf54l15/cpuapp
    integration_platforms:
      - nrf54h20dk/nrf54h20/cpuapp
      - nrf54l15dk/nrf54l15/cpuapp

  drivers.pwm.gpio_loopback.fast_p7_0:
    platform_allow:
      - nrf54h20dk/nrf54h20/cpuapp
    integration_platforms:
      - nrf54h20dk/nrf54h20/cpuapp
    extra_args:
      DTC_OVERLAY_FILE="boards/nrf54h20dk_nrf54h20_cpuapp_fast_p7_0.overlay"
      CONFIG_TEST_PWM_PERIOD_USEC=10000

  drivers.pwm.gpio_loopback.fast_p7_1:
    platform_allow:
      - nrf54h20dk/nrf54h20/cpuapp
    integration_platforms:
      - nrf54h20dk/nrf54h20/cpuapp
    extra_args:
      DTC_OVERLAY_FILE="boards/nrf54h20dk_nrf54h20_cpuapp_fast_p7_1.overlay"
      CONFIG_TEST_PWM_PERIOD_USEC=10000

  drivers.pwm.gpio_loopback.fast_p7_6:
    build_only: true
    platform_allow:
      - nrf54h20dk/nrf54h20/cpuapp
    integration_platforms:
      - nrf54h20dk/nrf54h20/cpuapp
    extra_args:
      DTC_OVERLAY_FILE="boards/nrf54h20dk_nrf54h20_cpuapp_fast_p7_6.overlay"
      CONFIG_TEST_PWM_PERIOD_USEC=10000

  drivers.pwm.gpio_loopback.fast_p7_7:
    build_only: true
    platform_allow:
      - nrf54h20dk/nrf54h20/cpuapp
    integration_platforms:
      - nrf54h20dk/nrf54h20/cpuapp
    extra_args:
      DTC_OVERLAY_FILE="boards/nrf54h20dk_nrf54h20_cpuapp_fast_p7_7.overlay"
      CONFIG_TEST_PWM_PERIOD_USEC=10000
```

## tests/drivers/quark_clock/testcase.yaml
```yaml
tests:
  test_quark_clock_build:
    build_only: true
    platform_whitelist: arduino_101
    tags: drivers
```

## tests/drivers/regulator/api/testcase.yaml
```yaml
# Copyright (c) 2022 Nordic Semiconductor ASA
# SPDX-License-Identifier: Apache-2.0

common:
  platform_allow:
    - native_posix
    - native_posix/native/64
    - native_sim
    - native_sim/native/64
  integration_platforms:
    - native_sim
tests:
  drivers.regulator.api:
    tags:
      - drivers
      - regulator
  drivers.regulator.api.nothreadsaferefcnt:
    tags:
      - drivers
      - regulator
    extra_configs:
      - CONFIG_REGULATOR_THREAD_SAFE_REFCNT=n
```

## tests/drivers/regulator/fixed/dts/bindings/test,regulator-fixed.yaml
```yaml
# Copyright 2020 Peter Bigot Consulting, LLC
# SPDX-License-Identifier: Apache-2.0

description: |
    This binding provides resources required to build and run the
    tests/drivers/regulator/fixed test in Zephyr.

compatible: "test,regulator-fixed"

properties:
    check-gpios:
        type: phandle-array
        required: true
        description: |
          Identity of a GPIO that is shorted to the GPIO identified in the
          test regulator enable-gpios property.  This is used to confirm that
          signal's state.

          The active level in the flags cell of this must match the
          active level of the flags cell in the regulator's enable-gpios
          property, and the flags must include a PULL to the inactive
          level.
```

## tests/drivers/regulator/fixed/testcase.yaml
```yaml
tests:
  drivers.regulator.fixed:
    tags:
      - drivers
      - regulator
    harness: ztest
    harness_config:
      fixture: gpio_loopback
    depends_on: gpio
    platform_allow:
      - nrf52840dk/nrf52840
      - nrf5340dk/nrf5340/cpuapp
      - nrf9160dk/nrf9160
    integration_platforms:
      - nrf52840dk/nrf52840
      - nrf5340dk/nrf5340/cpuapp
      - nrf9160dk/nrf9160
```

## tests/drivers/regulator/pca9420/testcase.yaml
```yaml
common:
  tags: drivers i2c
  depends_on: i2c adc
  filter: dt_compat_enabled("nxp,pca9420")
  harness: ztest
  harness_config:
    fixture: pmic

tests:
  drivers.regulator.i2c.onoff:
    depends_on: i2c adc
```

## tests/drivers/regulator/pmic/Kconfig
```kconfig
# Copyright (c) 2021 NXP
# SPDX-License-Identifier: Apache-2.0

mainmenu "PMIC Regulator Test"

source "Kconfig.zephyr"

config TEST_PMIC_REGULATOR_NAME
	string "PMIC regulator label to use for the test"
	default "" # Must be set by board overlay
```

## tests/drivers/regulator/pmic/testcase.yaml
```yaml
common:
  tags: drivers i2c
  depends_on: i2c adc
  filter: dt_compat_enabled("regulator-pmic")
  harness: ztest
  harness_config:
    fixture: regulator_pmic

tests:
  drivers.regulator.i2c.onoff:
    depends_on: i2c adc
```

## tests/drivers/regulator/voltage/dts/bindings/test-regulator-voltage.yaml
```yaml
# Copyright 2022 Nordic Semiconductor ASA
# SPDX-License-Identifier: Apache-2.0

description: |
    This binding provides resources required to build and run the
    tests/drivers/regulator/voltage test in Zephyr.

compatible: "test-regulator-voltage"

properties:
  regulators:
    type: phandles
    required: true
    description: |
      Regulators to be tested. Each entry must have a matching ADC entry in
      io-channels.

  io-channels:
    type: phandle-array
    required: true
    description: |
      ADC channels to be used. Each entry must have a matching entry in
      regulators.

  tolerance-microvolt:
    type: array
    required: true
    description: |
      Tolerance (+/-) when reading configured voltages using ADC. This should
      be set at most to the regulator resolution. Some noisy regulators may
      require more, though. Each entry must have a matching entry in
      regulators.

  adc-avg-count:
    type: int
    default: 1
    description: |
      Number of ADC readings to average. Defaults to 1 (no average).

  set-read-delay-ms:
    type: int
    default: 0
    description: |
      Delay between voltage set and ADC read. Defaults to 0 (no delay).
```

## tests/drivers/regulator/voltage/testcase.yaml
```yaml
# Copyright (c) 2022 Nordic Semiconductor ASA
# SPDX-License-Identifier: Apache-2.0

common:
  tags: drivers regulator
  harness: ztest

tests:
  drivers.regulator.voltage.nrf52840dk_nrf52840_npm6001:
    platform_allow: nrf52840dk_nrf52840
    extra_args: DTC_OVERLAY_FILE=boards/nrf52840dk_nrf52840_npm6001.overlay SHIELD=npm6001_ek
    harness_config:
      fixture: npm6001_ek_to_adc
```

## tests/drivers/retained_mem/api/Kconfig
```kconfig
#
# Copyright (c) 2023, Nordic Semiconductor ASA
#
# SPDX-License-Identifier: Apache-2.0
#

mainmenu "Retained memory test"

config RETAINED_MEM_SIZE_LIMITED
	bool "Size limited test"
	help
	  Will limit data size for test to 1 byte instead of 10 bytes

source "Kconfig.zephyr"
```

## tests/drivers/retained_mem/api/boards/bl54l15_dvk_nrf54l15_cpuapp.conf
```kconfig
# Copyright (c) 2024 Nordic Semiconductor ASA
# Copyright (c) 2025 Ezurio LLC
#
# SPDX-License-Identifier: Apache-2.0

CONFIG_POWEROFF=y
```

## tests/drivers/retained_mem/api/testcase.yaml
```yaml
tests:
  drivers.retained_mem.api.gpregret:
    platform_allow: nrf52840dk/nrf52840
    tags:
      - drivers
      - retained_mem
  drivers.retained_mem.api.ram:
    platform_allow:
      - esp32_devkitc/esp32/procpu
      - esp32c3_devkitm
      - esp32c6_devkitc/esp32c6/hpcore
      - esp32h2_devkitm
      - esp32s2_devkitc
      - esp32s3_devkitc/esp32s3/procpu
      - qemu_cortex_m3
      - nrf5340dk/nrf5340/cpuapp
      - nrf54h20dk/nrf54h20/cpuapp
      - nrf54h20dk/nrf54h20/cpurad
      - nrf54l15dk/nrf54l05/cpuapp
      - nrf54l15dk/nrf54l10/cpuapp
      - nrf54l15dk/nrf54l15/cpuapp
      - nrf54lm20dk/nrf54lm20a/cpuapp
      - nrf7120dk/nrf7120/cpuapp
      - nucleo_h723zg/stm32h723xx
      - ophelia4ev/nrf54l15/cpuapp
    integration_platforms:
      - qemu_cortex_m3
    tags:
      - drivers
      - retained_mem
  drivers.retained_mem.api.ram.nrf52840dk_nrf52840:
    platform_allow: nrf52840dk/nrf52840
    extra_args:
      - FILE_SUFFIX="ram"
    tags:
      - drivers
      - retained_mem
  drivers.retained_mem.api.buram:
    platform_allow:
      - slwrb4180b
      - xg24_rb4187c
      - xg29_rb4412a
    tags:
      - drivers
      - retained_mem
```
