/*
 * Copyright (c) 2026 Renesas Electronics Corporation
 *
 * SPDX-License-Identifier: Apache-2.0
 */

#include <zephyr/dt-bindings/pwm/pwm.h>
#include <zephyr/dt-bindings/pwm/renesas_rz_pwm.h>

/*
 * Wiring: connect GTIOC3A (PMOD0 pin 8) to GTIOC5A (PMOD1 pin 2, GPIO11).
 */

/ {
	pwm_loopback_0 {
		compatible = "test-pwm-loopback";
		pwms = <&pwm3 RZ_PWM_GPT_IO_A 0 PWM_POLARITY_NORMAL>,
		       <&pwm5 RZ_PWM_GPT_IO_A 0 PWM_POLARITY_NORMAL>;
	};
};

&gpt5 {
	status = "okay";

	pwm5: pwm {
		pinctrl-0 = <&gpt5_pins>;
		pinctrl-names = "default";
		status = "okay";
	};
};
