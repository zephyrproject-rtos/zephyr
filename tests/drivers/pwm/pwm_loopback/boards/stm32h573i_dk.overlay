/*
 * Copyright (c) 2023 STMicroelectronics
 *
 * SPDX-License-Identifier: Apache-2.0
 */

/ {
	pwm_loopback_0 {
		compatible = "test-pwm-loopback";
		/* first index must be a 32-Bit timer */
		pwms = <&pwm2 4 0 PWM_POLARITY_NORMAL>,
			<&pwm3 2 0 PWM_POLARITY_NORMAL>;
	};
};
