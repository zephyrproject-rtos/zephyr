/*
 * SPDX-FileCopyrightText: 2026 Texas Instruments Incorporated
 * SPDX-License-Identifier: Apache-2.0
 */

#include <zephyr/dt-bindings/pwm/pwm.h>

/ {
	pwm_loopback_0 {
		compatible = "test-pwm-loopback";
		/*
		 * Generate on eCAP0 APWM (PB3 / OUTPUTXBAR8), capture on
		 * eCAP1 (PB4 / INPUTXBAR1). Connect PB3 to PB4 on the board.
		 */
		pwms = <&ecap0 0 0 PWM_POLARITY_NORMAL>,
		       <&ecap1 0 0 PWM_POLARITY_NORMAL>;
	};
};
