/*
 * Copyright (c) 2020-2021 Vestas Wind Systems A/S
 *
 * SPDX-License-Identifier: Apache-2.0
 */

#include <dt-bindings/pwm/pwm.h>

/ {
	pwm_loopback_0 {
		compatible = "test,pwm_loopback";
		pwms = <&ftm0 0 0 PWM_POLARITY_NORMAL>, /* PTC1, J1 pin 5 */
		       <&ftm3 4 0 PWM_POLARITY_NORMAL>; /* PTC8, J1 pin 7 */
	};
};

/* per default nxp_k6x.dtsi defines prescaler values of 16,
 * override those to make sure output timer is 4-times slower
 */

&ftm3 {
	prescaler = <16>;
};

&ftm0 {
	prescaler = <64>;
};
