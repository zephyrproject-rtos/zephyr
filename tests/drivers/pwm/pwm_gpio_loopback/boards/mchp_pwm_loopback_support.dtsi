/*
 * SPDX-FileCopyrightText: Copyright 2026 Microchip Technology Inc.
 * SPDX-License-Identifier: Apache-2.0
 */

#include <zephyr/dt-bindings/gpio/gpio.h>

/*
 * PWM_NODE   - TC peripheral label (e.g. tc0)
 * pwm_PINCTRL - pinctrl state label (e.g. tc0_pwm_default)
 * Both must be defined by the including overlay.
 *
 * In 16-bit MPWM mode the PWM waveform appears on WO[1]; wire the WO[1]
 * output pin to the GPIO input pin defined in the including overlay.
 */

&PWM_NODE {
	compatible = "microchip,tc-g1-pwm";
	#pwm-cells = <3>;
	pinctrl-0 = <&PWM_PINCTRL>;
	pinctrl-names = "default";
	max-bit-width = <16>;
	prescaler = <256>;
	status = "okay";
};
