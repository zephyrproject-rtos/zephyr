/*
 * Copyright (c) 2024 Analog Devices, Inc.
 *
 * SPDX-License-Identifier: Apache-2.0
 */

/ {
	aliases {
		pwm-0 = &pwm0;
	};
};

&timer0 {
	status = "okay";
	pwm0: pwm {
		status = "okay";
		pinctrl-0 = <&tmr0c_oa_p0_17>;
		pinctrl-names = "default";
	};
};
