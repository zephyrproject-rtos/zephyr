/*
 * Copyright (c) 2025 Renesas Electronics Corporation
 *
 * SPDX-License-Identifier: Apache-2.0
 */

/ {
	aliases {
		pwm-test = &pwm4;
	};
};

&gpt4 {
	status = "okay";

	pwm4: pwm {
		pinctrl-0 = <&gpt4_pins>;
		pinctrl-names = "default";
		status = "okay";
	};
};
