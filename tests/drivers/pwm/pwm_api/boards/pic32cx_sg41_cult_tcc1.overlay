/*
 * SPDX-FileCopyrightText: Copyright 2026 Microchip Technology Inc.
 * SPDX-License-Identifier: Apache-2.0
 */

#define PWM_NODE    tcc1
#define PWM_PINCTRL tcc1_pwm_default
#include "mchp_pwm_api_support.dtsi"

&pinctrl {
	tcc1_pwm_default: tcc1_pwm_default {
		group1 {
			pinmux = <PA8G_TCC1_WO4>;
		};
	};
};
