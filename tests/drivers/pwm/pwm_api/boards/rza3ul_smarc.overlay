/*
 * Copyright (c) 2025 Renesas Electronics Corporation
 *
 * SPDX-License-Identifier: Apache-2.0
 */

&mtu1 {
	prescaler = <4>;
	status = "okay";

	pwm1: pwm {
		status = "okay";
		pinctrl-0 = <&mtu1_pins>;
		pinctrl-names = "default";
	};
};
