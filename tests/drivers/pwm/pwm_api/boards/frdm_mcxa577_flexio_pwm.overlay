/*
 * Copyright 2026 NXP
 *
 * SPDX-License-Identifier: Apache-2.0
 */

/* PWM output in P2_6(J8-27). */
/ {
	aliases {
		pwm-test = &flexio0_pwm;
	};
};

&flexio0_pwm {
	status = "okay";
	pinctrl-0 = <&pinmux_flexio_pwm>;
	pinctrl-names = "default";

	pwm_0 {
		pin-id = <14>;
		prescaler = <1>;
	};
};
