/*
 * Copyright (c) 2025 Renesas Electronics Corporation
 *
 * SPDX-License-Identifier: Apache-2.0
 */

&gpt32e6 {
	status = "okay";

	pwm6: pwm {
		status = "okay";
		pinctrl-0 = <&gpt6_pins>;
		pinctrl-names = "default";
	};
};
