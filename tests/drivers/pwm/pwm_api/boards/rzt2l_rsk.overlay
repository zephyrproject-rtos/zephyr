/*
 * Copyright (c) 2025 Renesas Electronics Corporation
 *
 * SPDX-License-Identifier: Apache-2.0
 */

/ {
	aliases {
		pwm-test = &pwm5;
	};
};

&gpt5 {
	status = "okay";

	pwm5: pwm {
		status = "okay";
		pinctrl-0 = <&gpt5_pins>;
		pinctrl-names = "default";
	};
};
