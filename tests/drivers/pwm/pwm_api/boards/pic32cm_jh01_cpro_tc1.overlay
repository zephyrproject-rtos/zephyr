/*
 * SPDX-FileCopyrightText: Copyright 2026 Microchip Technology Inc.
 * SPDX-License-Identifier: Apache-2.0
 */

#define PWM_NODE    tc1
#define PWM_PINCTRL tc1_pwm_default
#include "mchp_pwm_api_support.dtsi"

&pinctrl {
	tc1_pwm_default: tc1_pwm_default {
		group1 {
			pinmux = <PA24E_TC1_WO0>;
		};
	};
};
