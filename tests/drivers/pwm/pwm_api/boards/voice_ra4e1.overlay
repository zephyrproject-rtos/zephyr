/*
 * Copyright (c) 2025 Renesas Electronics Corporation
 *
 * SPDX-License-Identifier: Apache-2.0
 */


&pinctrl {
	pwm2_default: pwm2_default {
		group1 {
			/* GTIOC2A GTIOC2B */
			psels = <RA_PSEL(RA_PSEL_GPT1, 1, 3)>,
				<RA_PSEL(RA_PSEL_GPT1, 1, 2)>;
		};
	};
};

&pwm2 {
	pinctrl-0 = <&pwm2_default>;
	pinctrl-names = "default";
	interrupts = <63 1>, <64 1>;
	interrupt-names = "gtioca", "overflow";
	status = "okay";
};
