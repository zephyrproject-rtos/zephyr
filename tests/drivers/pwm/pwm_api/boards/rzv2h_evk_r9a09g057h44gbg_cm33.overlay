/*
 * Copyright (c) 2025 Renesas Electronics Corporation
 *
 * SPDX-License-Identifier: Apache-2.0
 */

/ {
	aliases {
		pwm-test = &pwm3;
	};
};

&gpt3 {
	pwm3: pwm {
		status = "okay";
		pinctrl-0 = <&gpt3_pins>;
		pinctrl-names = "default";
	};
};
