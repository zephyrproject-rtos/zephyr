/*
 * SPDX-FileCopyrightText: Copyright 2026 Microchip Technology Inc.
 * SPDX-License-Identifier: Apache-2.0
 */

#define PWM_NODE    tc7
#define PWM_PINCTRL tc7_pwm_default
#include "mchp_pwm_api_support.dtsi"

&pinctrl {
	tc7_pwm_default: tc7_pwm_default {
		group1 {
			pinmux = <PA20E_TC7_WO0>;
		};
	};
};
