/*
 * SPDX-FileCopyrightText: Copyright 2026 Microchip Technology Inc.
 * SPDX-License-Identifier: Apache-2.0
 */

#define PWM_NODE    tc6
#define PWM_PINCTRL tc6_pwm_default
#include "mchp_pwm_api_support.dtsi"

&pinctrl {
	tc6_pwm_default: tc6_pwm_default {
		group1 {
			pinmux = <PA30E_TC6_WO0>;
		};
	};
};
