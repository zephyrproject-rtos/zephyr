/*
 * SPDX-FileCopyrightText: Copyright 2026 Microchip Technology Inc.
 * SPDX-License-Identifier: Apache-2.0
 */

#define PWM_NODE    tcc2
#define PWM_PINCTRL tcc2_pwm_default
#define PWM_COMPAT "microchip,tcc-g1-pwm"
#include "mchp_pwm_api_support.dtsi"

&pinctrl {
	tcc2_pwm_default: tcc2_pwm_default {
		group1 {
			pinmux = <PA14F_TCC2_WO0>;
		};
	};
};
