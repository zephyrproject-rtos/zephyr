/*
 * Copyright (c) 2024 Renesas Electronics Corporation
 *
 * SPDX-License-Identifier: Apache-2.0
 */

&gpt32e3 {
	pwm3: pwm {
		status = "okay";
		pinctrl-0 = <&gpt3_pins>;
		pinctrl-names = "default";
	};
};
