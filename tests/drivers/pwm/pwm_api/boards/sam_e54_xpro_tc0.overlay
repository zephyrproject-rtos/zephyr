/*
 * Copyright (c) 2025-2026 Microchip Technology Inc.
 * SPDX-License-Identifier: Apache-2.0
 */

#define PWM_NODE    tc0
#define PWM_PINCTRL tc0_pwm_default
#include "mchp_pwm_api_support.dtsi"

&pinctrl {
	tc1_pwm_default: tc1_pwm_default {
		group1 {
			pinmux = <PA9E_TC0_WO1>;
		};
	};
};
