/*
 * Copyright (c) 2025-2026 Microchip Technology Inc.
 * SPDX-License-Identifier: Apache-2.0
 */

#define PWM_NODE     tc5
#define PWM_PINCTRL  tc5_pwm_default
#include "mchp_pwm_api_support.dtsi"

&pinctrl {
	tc5_pwm_default: tc5_pwm_default {
		group1 {
			pinmux = <PA24E_TC5_WO0>;
		};
	};
};
