/*
 * SPDX-FileCopyrightText: Copyright 2026 Microchip Technology Inc.
 * SPDX-License-Identifier: Apache-2.0
 */

#define PWM_NODE    tc2
#define PWM_PINCTRL tc2_pwm_default
#define PWM_COMPAT "microchip,tc-g1-pwm"
#include "mchp_pwm_api_support.dtsi"

&pinctrl {
	tc2_pwm_default: tc2_pwm_default {
		group1 {
			pinmux = <PA0E_TC2_WO0>;
		};
	};
};
