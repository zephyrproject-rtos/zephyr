/*
 * SPDX-FileCopyrightText: Copyright The Zephyr Project Contributors
 * SPDX-License-Identifier: Apache-2.0
 */

/ {
	aliases {
		pwm-test = &pwm2;
	};
};

&timers2 {
	st,prescaler = <10000>;
	status = "okay";

	pwm2: pwm {
		pinctrl-0 = <&tim2_ch3_pb10>;
		pinctrl-names = "default";
		status = "okay";
	};
};
