/*
 * Copyright (c) 2026 Microchip Technology Inc.
 *
 * SPDX-License-Identifier: Apache-2.0
 */

#include <zephyr/dt-bindings/pwm/pwm.h>

/ {
	aliases {
		pwm-test = &pwm1;
	};
};

&pwm1 {
	compatible = "microchip,xec-pwm";
	status = "okay";
	pinctrl-0 = <&pwm1_gpio054>;
	pinctrl-names = "default";

	/* Encode PCR index/bit */
	pcr-scr = <MCHP_XEC_SCR_ENCODE(1, 20)>;
};
