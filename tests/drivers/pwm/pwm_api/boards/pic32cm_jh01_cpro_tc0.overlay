/*
 * SPDX-FileCopyrightText: Copyright 2026 Microchip Technology Inc.
 * SPDX-License-Identifier: Apache-2.0
 */

#define PWM_NODE    tc0
#define PWM_PINCTRL tc0_pwm_default
#define PWM_COMPAT "microchip,tc-g1-pwm"
#include "mchp_pwm_api_support.dtsi"

&pinctrl {
	tc0_pwm_default: tc0_pwm_default {
		group1 {
			pinmux = <PA22E_TC0_WO0>;
		};
	};
};
