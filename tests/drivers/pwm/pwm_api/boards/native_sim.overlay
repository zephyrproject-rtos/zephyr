/*
 * Copyright (c) 2024 Kickmaker
 *
 * SPDX-License-Identifier: Apache-2.0
 */

/ {
	pwm0: pwm0 {
		compatible = "zephyr,fake-pwm";
		#pwm-cells = <2>;
		frequency = <10000000>;
		status = "okay";
	};

	aliases {
		pwm-test = &pwm0;
	};
};
