/*
 * Copyright 2025 NXP
 *
 * SPDX-License-Identifier: Apache-2.0
 */

/ {
	aliases {
		/*
		 * Check signal from the connector J44 Pin10(M1_LED_TP1) via logic analyzer.
		 */
		pwm-test = &flexio1_pwm;
	};
};
