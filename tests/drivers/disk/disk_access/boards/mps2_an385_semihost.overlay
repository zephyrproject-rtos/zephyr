/*
 * Copyright (c) 2026 RBR Ltd.
 *
 * SPDX-License-Identifier: Apache-2.0
 */

/ {
	semihost_disk0 {
		compatible = "zephyr,semihost-disk";
		disk-name = "SEMIHOST";
		sector-size = <512>;
		sector-count = <2048>;
	};
};
