/*
 * Copyright (c) 2026 Texas Instruments
 *
 * SPDX-License-Identifier: Apache-2.0
 */

&main_sdhci0 {
	mmc {
		disk-name = "SD2";
	};
};

&main_sdhci1 {
	status = "disabled";

	sd {
		status = "disabled";
	};
};
