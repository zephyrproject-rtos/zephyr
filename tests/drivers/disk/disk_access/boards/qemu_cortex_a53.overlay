/*
 * Copyright (c) 2026 Qualcomm Innovation Center, Inc.
 * SPDX-License-Identifier: Apache-2.0
 */

&pcie {
	nvme0: nvme0 {
		compatible = "nvme-controller";

		vendor-id = <0x1b36>;
		device-id = <0x0010>;

		status = "okay";
	};
};
