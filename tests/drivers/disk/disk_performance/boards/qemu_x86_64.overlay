/* SPDX-License-Identifier: Apache-2.0 */

#include <zephyr/dt-bindings/pcie/pcie.h>

/ {
	pcie0 {
		nvme0: nvme0 {
			compatible = "nvme-controller";

			vendor-id = <0x1B36>;
			device-id = <0x0010>;

			status = "okay";
		};
	};
};
