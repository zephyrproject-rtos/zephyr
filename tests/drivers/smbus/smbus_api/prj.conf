## CMakeLists.txt
```
# Copyright (c) 2023 Intel Corporation
# SPDX-License-Identifier: Apache-2.0

cmake_minimum_required(VERSION 3.28.0)
find_package(Zephyr REQUIRED HINTS $ENV{ZEPHYR_BASE})
project(smbus_api)

target_include_directories(app PRIVATE ${ZEPHYR_BASE}/drivers/smbus)

target_sources(app PRIVATE src/test_smbus.c)
target_sources_ifdef(CONFIG_BOARD_QEMU_X86_64 app PRIVATE src/test_smbus_qemu.c)
```

## prj.conf
```kconfig
CONFIG_ZTEST=y

CONFIG_SMBUS=y
CONFIG_SMBUS_INTEL_PCH=y
```

## boards/intel_btl_s_crb.overlay
```dts
/*
 * Copyright (c) 2025 Intel Corporation
 *
 * SPDX-License-Identifier: Apache-2.0
 */

&smbus0 {
	status = "okay";
};
```

## src/test_smbus.c
```c
/*
 * Copyright (c) 2022 Intel Corporation
 *
 * SPDX-License-Identifier: Apache-2.0
 */

/**
 * Verify SMBUS Basic API, tests should work on any board
 */

#include <zephyr/kernel.h>
#include <zephyr/ztest.h>
#include <zephyr/drivers/smbus.h>

#include <smbus_utils.h>

BUILD_ASSERT(DT_NODE_HAS_STATUS_OKAY(DT_NODELABEL(smbus0)),
	     "SMBus node is disabled!");

#define FAKE_ADDRESS	0x10

/**
 * The test is run in userspace only if CONFIG_USERSPACE option is
 * enabled, otherwise it is the same as ZTEST()
 */
ZTEST_USER(test_smbus_general, test_smbus_basic_api)
{
	const struct device *const dev = DEVICE_DT_GET(DT_NODELABEL(smbus0));
	uint32_t cfg = SMBUS_MODE_CONTROLLER;
	uint32_t cfg_tmp;
	int ret;

	zassert_true(device_is_ready(dev), "Device is not ready");

	ret = smbus_configure(dev, cfg);
	zassert_ok(ret, "SMBUS config failed");

	ret = smbus_get_config(dev, &cfg_tmp);
	zassert_ok(ret, "SMBUS get_config failed");

	zassert_equal(cfg, cfg_tmp, "get_config returned invalid config");
}

/**
 * The test is run in userspace only if CONFIG_USERSPACE option is
 * enabled, otherwise it is the same as ZTEST()
 */
ZTEST(test_smbus_general, test_smbus_smbalert_api)
{
	const struct device *const dev = DEVICE_DT_GET(DT_NODELABEL(smbus0));
	void *dummy; /* For the dummy function pointer use this */
	int ret;

	/* Note! Only for test using stack variables to ease userspace tests */
	struct smbus_callback callback = {
		.handler = (void *)&dummy,
		.addr = FAKE_ADDRESS,
	};

	zassert_true(device_is_ready(dev), "Device is not ready");

	/* Smbalert callbacks */

	/* Try to remove not existing callback */
	ret = smbus_smbalert_remove_cb(dev, &callback);
	if (IS_ENABLED(CONFIG_SMBUS_INTEL_PCH_SMBALERT)) {
		zassert_equal(ret, -ENOENT, "Callback remove failed");
	} else {
		zassert_equal(ret, -ENOSYS, "Check for ENOSYS failed");
	}

	/* Set callback */
	ret = smbus_smbalert_set_cb(dev, &callback);
	if (IS_ENABLED(CONFIG_SMBUS_INTEL_PCH_SMBALERT)) {
		zassert_ok(ret, "Callback set failed");
	} else {
		zassert_equal(ret, -ENOSYS, "Check for ENOSYS failed");
	}

	/* Remove existing callback */
	ret = smbus_smbalert_remove_cb(dev, &callback);
	if (IS_ENABLED(CONFIG_SMBUS_INTEL_PCH_SMBALERT)) {
		zassert_ok(ret, "Callback remove failed");
	} else {
		zassert_equal(ret, -ENOSYS, "Check for ENOSYS failed");
	}
}

/**
 * The test is run in userspace only if CONFIG_USERSPACE option is
 * enabled, otherwise it is the same as ZTEST()
 */
ZTEST(test_smbus_general, test_smbus_host_notify_api)
{
	const struct device *const dev = DEVICE_DT_GET(DT_NODELABEL(smbus0));
	void *dummy; /* For the dummy function pointer use this */
	int ret;

	/* Note! Only for test using stack variables to ease userspace tests */
	struct smbus_callback callback = {
		.handler = (void *)&dummy,
		.addr = FAKE_ADDRESS,
	};

	zassert_true(device_is_ready(dev), "Device is not ready");

	/* Host Notify callbacks */

	/* Try to remove not existing callback */
	ret = smbus_host_notify_remove_cb(dev, &callback);
	if (IS_ENABLED(CONFIG_SMBUS_INTEL_PCH_HOST_NOTIFY)) {
		zassert_equal(ret, -ENOENT, "Callback remove failed");
	} else {
		zassert_equal(ret, -ENOSYS, "Check for ENOSYS failed");
	}

	/* Set callback */
	ret = smbus_host_notify_set_cb(dev, &callback);
	if (IS_ENABLED(CONFIG_SMBUS_INTEL_PCH_HOST_NOTIFY)) {
		zassert_ok(ret, "Callback set failed");
	} else {
		zassert_equal(ret, -ENOSYS, "Check for ENOSYS failed");
	}

	/* Remove existing callback */
	ret = smbus_host_notify_remove_cb(dev, &callback);
	if (IS_ENABLED(CONFIG_SMBUS_INTEL_PCH_HOST_NOTIFY)) {
		zassert_ok(ret, "Callback remove failed");
	} else {
		zassert_equal(ret, -ENOSYS, "Check for ENOSYS failed");
	}
}

/**
 * The test is run in userspace only if CONFIG_USERSPACE option is
 * enabled, otherwise it is the same as ZTEST()
 */
ZTEST_USER(test_smbus_general, test_smbus_api_errors)
{
	const struct device *const dev = DEVICE_DT_GET(DT_NODELABEL(smbus0));
	uint8_t fake_addr = 0x10;
	uint8_t buf[2];
	uint8_t rcv_buf[SMBUS_BLOCK_BYTES_MAX];
	uint8_t rcv_count;
	int ret;

	zassert_true(device_is_ready(dev), "Device is not ready");

	/* Test parsing SMBus quick */
	ret = smbus_quick(dev, fake_addr, 3);
	zassert_equal(ret, -EINVAL, "Wrong parameter check failed");

	/* Test parsing SMBus block_write */
	ret = smbus_block_write(dev, fake_addr, 0, 0, buf);
	zassert_equal(ret, -EINVAL, "Wrong parameter check failed");
	ret = smbus_block_write(dev, fake_addr, 0, SMBUS_BLOCK_BYTES_MAX + 1,
				buf);
	zassert_equal(ret, -EINVAL, "Wrong parameter check failed");

	/* Test parsing SMBus block_pcall */
	ret = smbus_block_pcall(dev, fake_addr, 0, 0, buf, &rcv_count, rcv_buf);
	zassert_equal(ret, -EINVAL, "Wrong parameter check failed");
	ret = smbus_block_pcall(dev, fake_addr, 0, SMBUS_BLOCK_BYTES_MAX + 1,
				buf, &rcv_count, rcv_buf);
	zassert_equal(ret, -EINVAL, "Wrong parameter check failed");
}

/* Setup is needed for userspace access */
static void *smbus_test_setup(void)
{
	const struct device *const dev = DEVICE_DT_GET(DT_NODELABEL(smbus0));

	zassert_true(device_is_ready(dev), "Device is not ready");

	k_object_access_grant(dev, k_current_get());

	return NULL;
}

ZTEST_SUITE(test_smbus_general, NULL, smbus_test_setup, NULL, NULL, NULL);
```

## src/test_smbus_qemu.c
```c
/*
 * Copyright (c) 2022 Intel Corporation
 *
 * SPDX-License-Identifier: Apache-2.0
 */

/*
 * @addtogroup t_smbus_basic
 * @{
 * @defgroup t_smbus
 * @brief TestPurpose: verify SMBUS can read and write
 * @}
 */

#include <zephyr/kernel.h>
#include <zephyr/ztest.h>
#include <zephyr/drivers/smbus.h>

BUILD_ASSERT(DT_NODE_HAS_STATUS_OKAY(DT_NODELABEL(smbus0)),
	     "SMBus node is disabled!");

/* Qemu q35 has default emulated EEPROM-like devices */
#define QEMU_SMBUS_EEPROM_ADDR	0x50
#define QEMU_SMBUS_EEPROM_SIZE	256

/**
 * The test is run in userspace only if CONFIG_USERSPACE option is
 * enabled, otherwise it is the same as ZTEST()
 */
ZTEST_USER(test_smbus_qemu, test_smbus_api_read_write)
{
	int ret;

	const struct device *const dev = DEVICE_DT_GET(DT_NODELABEL(smbus0));

	zassert_true(device_is_ready(dev), "Device is not ready");

	/* Test SMBus quick */
	ret = smbus_quick(dev, QEMU_SMBUS_EEPROM_ADDR, SMBUS_MSG_WRITE);
	zassert_ok(ret, "SMBUS Quick W failed, ret %d", ret);

	ret = smbus_quick(dev, QEMU_SMBUS_EEPROM_ADDR, SMBUS_MSG_READ);
	zassert_ok(ret, "SMBUS Quick R failed, ret %d", ret);

	/* Test SMBus Read / Write Byte Data */
	for (uint16_t addr = 0; addr < QEMU_SMBUS_EEPROM_SIZE; addr++) {
		/* Randomize buffer */
		uint8_t send_byte = (uint8_t)addr;
		uint8_t recv_byte;

		ret = smbus_byte_data_write(dev, QEMU_SMBUS_EEPROM_ADDR, addr,
					    send_byte);
		zassert_ok(ret, "SMBUS write byte data failed, ret %d", ret);

		ret = smbus_byte_data_read(dev, QEMU_SMBUS_EEPROM_ADDR, addr,
					   &recv_byte);
		zassert_ok(ret, "SMBUS read byte data failed, ret %d", ret);

		zassert_equal(send_byte, recv_byte, "SMBUS data compare fail");
	}

	/* Test SMBus Read / Write Word Data */
	for (uint16_t addr = 0; addr < QEMU_SMBUS_EEPROM_SIZE; addr += 2) {
		uint16_t send_word = addr;
		uint16_t recv_word;

		ret = smbus_word_data_write(dev, QEMU_SMBUS_EEPROM_ADDR, addr,
					    send_word);
		zassert_ok(ret, "SMBUS write word data failed, ret %d", ret);

		ret = smbus_word_data_read(dev, QEMU_SMBUS_EEPROM_ADDR, addr,
					   &recv_word);
		zassert_ok(ret, "SMBUS read word data failed, ret %d", ret);

		zassert_equal(send_word, recv_word, "SMBUS data compare fail");
	}

	/* Test SMBus Read / Write Byte on special Qemu SMBus peripheral */
	for (uint16_t addr = 0; addr < QEMU_SMBUS_EEPROM_SIZE; addr++) {
		/* Randomize buffer */
		uint8_t send_byte = (uint8_t)addr;
		uint8_t recv_byte;

		/* Write byte data to EEPROM device */
		ret = smbus_byte_data_write(dev, QEMU_SMBUS_EEPROM_ADDR, addr,
					    send_byte);
		zassert_ok(ret, "SMBUS write byte data failed, ret %d", ret);

		/**
		 * Reading is done through executing two consecutive
		 * operations: write, which sets offset, followed by read, which
		 * reads data from given offset
		 */

		ret = smbus_byte_write(dev, QEMU_SMBUS_EEPROM_ADDR, addr);
		zassert_ok(ret, "SMBUS write byte failed, ret %d", ret);

		ret = smbus_byte_read(dev, QEMU_SMBUS_EEPROM_ADDR, &recv_byte);
		zassert_ok(ret, "SMBUS read byte failed, ret %d", ret);
		zassert_equal(send_byte, recv_byte, "SMBUS data compare fail");
	}

	/**
	 * The Qemu SMBus implementation does not always correctly
	 * emulate SMBus Block protocol, however it is good enough
	 * to test Block Write followed by Block Read
	 */

	/* Test SMBus Block Write / Block Read */
	for (uint16_t addr = 0; addr < QEMU_SMBUS_EEPROM_SIZE;
	     addr += SMBUS_BLOCK_BYTES_MAX) {
		uint8_t send_block[SMBUS_BLOCK_BYTES_MAX];
		uint8_t recv_block[SMBUS_BLOCK_BYTES_MAX];
		uint8_t count;

		/* Poor man randomize ;) */
		for (int i = 0; i < sizeof(send_block); i++) {
			send_block[i] = addr + i;
		}
		ret = smbus_block_write(dev, QEMU_SMBUS_EEPROM_ADDR, addr,
					sizeof(send_block), send_block);
		zassert_ok(ret, "SMBUS write block failed, ret %d", ret);

		ret = smbus_block_read(dev, QEMU_SMBUS_EEPROM_ADDR, addr,
				       &count, recv_block);
		zassert_ok(ret, "SMBUS read block failed, ret %d", ret);

		zassert_equal(count, SMBUS_BLOCK_BYTES_MAX,
			      "Read wrong %d of bytes", count);

		zassert_true(!memcmp(send_block, recv_block, count),
			     "Read / Write data differs");
	}
}

/* Setup is needed for userspace access */
static void *smbus_test_setup(void)
{
	const struct device *const dev = DEVICE_DT_GET(DT_NODELABEL(smbus0));

	zassert_true(device_is_ready(dev), "Device is not ready");

	k_object_access_grant(dev, k_current_get());

	return NULL;
}

ZTEST_SUITE(test_smbus_qemu, NULL, smbus_test_setup, NULL, NULL, NULL);
```
