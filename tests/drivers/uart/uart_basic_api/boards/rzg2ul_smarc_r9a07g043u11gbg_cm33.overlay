/*
 * Copyright (c) 2025 Renesas Electronics Corporation
 * SPDX-License-Identifier: Apache-2.0
 */

/ {
	chosen {
		zephyr,console = &scif0;
		zephyr,shell-uart = &scif0;
	};
};

&scif0 {
	current-speed = <115200>;
	pinctrl-0 = <&scif0_pins>;
	pinctrl-names = "default";
	status = "okay";
};
