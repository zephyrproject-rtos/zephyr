## tests/drivers/uart/uart_basic_api/testcase.yaml
```yaml
common:
  harness: keyboard
  filter: CONFIG_UART_CONSOLE
  tags:
    - drivers
    - uart
tests:
  drivers.uart.basic_api:
    integration_platforms:
      - mps2/an385
  drivers.uart.basic_api.wide:
    extra_configs:
      - CONFIG_UART_WIDE_DATA=y
    tags: drivers uart
    arch_allow: arm
    platform_allow: nucleo_h743zi
    integration_platforms:
      - nucleo_h743zi
    extra_args: DTC_OVERLAY_FILE="boards/nucleo_h743zi.overlay"
  drivers.uart.basic_api.poll:
    extra_args: CONF_FILE=prj_poll.conf
    integration_platforms:
      - mps2/an385
  drivers.uart.basic_api.shell:
    extra_args: CONF_FILE=prj_shell.conf
    min_flash: 64
    integration_platforms:
      - mps2/an385
  drivers.uart.basic_api.cdc_acm:
    extra_args:
      - EXTRA_CONF_FILE="overlay-usb.conf"
      - DTC_OVERLAY_FILE="usb.overlay"
    depends_on: usb_device
  drivers.uart.basic_api.shell_ke17z9_uart:
    platform_allow: frdm_ke17z512
    extra_args:
      - CONF_FILE=prj_shell.conf
      - DTC_OVERLAY_FILE="boards/frdm_ke17z512_uart.overlay"
```

## tests/drivers/uart/uart_basic_poll_api/testcase.yaml
```yaml
tests:
-   test_uart:
        build_only: true
        platform_whitelist: esp32
        tags: drivers
```

## tests/drivers/uart/uart_elementary/testcase.yaml
```yaml
common:
  tags:
    - drivers
    - uart
  depends_on: gpio
  harness: ztest
  harness_config:
    fixture: gpio_loopback
tests:
  drivers.uart.uart_elementary:
    filter: CONFIG_SERIAL_SUPPORT_INTERRUPT
    platform_allow:
      - nrf54h20dk/nrf54h20/cpuapp
      - nrf54l15dk/nrf54l15/cpuapp
      - nrf54l15dk/nrf54l15/cpuflpr
      - nrf54lm20dk/nrf54lm20a/cpuapp
      - nrf54lm20dk/nrf54lm20a/cpuflpr
      - nrf5340dk/nrf5340/cpuapp
      - ophelia4ev/nrf54l15/cpuapp
      - ophelia4ev/nrf54l15/cpuflpr
      - esp32_devkitc/esp32/procpu
      - esp8684_devkitm
      - esp32c3_devkitm
      - esp32c6_devkitc/esp32c6/hpcore
      - esp32h2_devkitm
      - esp32s2_saola
      - esp32s3_devkitm/esp32s3/procpu
      - xg24_rb4187c
      - bg29_rb4420a
      - xg29_rb4412a
      - b_u585i_iot02a
      - nucleo_f091rc
      - nucleo_g071rb
      - nucleo_g474re
      - nucleo_h743zi
      - nucleo_l152re
      - stm32n6570_dk/stm32n657xx/sb
      - stm32u083c_dk
    integration_platforms:
      - nrf54h20dk/nrf54h20/cpuapp
  drivers.uart.uart_elementary_dual_nrf54h:
    filter: CONFIG_SERIAL_SUPPORT_INTERRUPT
    platform_allow:
      - nrf54h20dk/nrf54h20/cpuapp
    extra_args: DTC_OVERLAY_FILE="boards/nrf54h20dk_nrf54h20_cpuapp_dual_uart.overlay"
    extra_configs:
      - CONFIG_DUAL_UART_TEST=y
  drivers.uart.uart_elementary_dual_nrf54h.pm:
    filter: CONFIG_SERIAL_SUPPORT_INTERRUPT
    platform_allow:
      - nrf54h20dk/nrf54h20/cpuapp
    extra_args: DTC_OVERLAY_FILE="boards/nrf54h20dk_nrf54h20_cpuapp_dual_uart.overlay"
    extra_configs:
      - CONFIG_DUAL_UART_TEST=y
      - CONFIG_PM_DEVICE=y
      - CONFIG_PM_DEVICE_RUNTIME=y
  drivers.uart.uart_elementary_dual_setup_mismatch_nrf54h:
    filter: CONFIG_SERIAL_SUPPORT_INTERRUPT
    platform_allow:
      - nrf54h20dk/nrf54h20/cpuapp
    extra_args: DTC_OVERLAY_FILE="boards/nrf54h20dk_nrf54h20_cpuapp_dual_uart.overlay"
    extra_configs:
      - CONFIG_DUAL_UART_TEST=y
      - CONFIG_SETUP_MISMATCH_TEST=y
  drivers.uart.uart_elementary_dual_nrf54l:
    filter: CONFIG_SERIAL_SUPPORT_INTERRUPT
    platform_allow:
      - nrf54l15dk/nrf54l15/cpuapp
      - nrf54l15dk/nrf54l15/cpuflpr
      - nrf54lm20dk/nrf54lm20a/cpuapp
      - nrf54lm20dk/nrf54lm20a/cpuflpr
      - ophelia4ev/nrf54l15/cpuapp
      - ophelia4ev/nrf54l15/cpuflpr
    extra_args:
      - platform:nrf54l15dk/nrf54l15/cpuapp:"DTC_OVERLAY_FILE=boards/nrf54l15dk_nrf54l15_dual_uart.overlay"
      - platform:nrf54l15dk/nrf54l15/cpuflpr:"DTC_OVERLAY_FILE=boards/nrf54l15dk_nrf54l15_dual_uart.overlay"
      - platform:nrf54lm20dk/nrf54lm20a/cpuapp:"DTC_OVERLAY_FILE=boards/nrf54lm20dk_nrf54lm20a_dual_uart.overlay"
      - platform:nrf54lm20dk/nrf54lm20a/cpuflpr:"DTC_OVERLAY_FILE=boards/nrf54lm20dk_nrf54lm20a_dual_uart.overlay"
      - platform:ophelia4ev/nrf54l15/cpuapp:"DTC_OVERLAY_FILE=boards/nrf54l15dk_nrf54l15_dual_uart.overlay"
      - platform:ophelia4ev/nrf54l15/cpuflpr:"DTC_OVERLAY_FILE=boards/nrf54l15dk_nrf54l15_dual_uart.overlay"
    extra_configs:
      - CONFIG_DUAL_UART_TEST=y
  drivers.uart.uart_elementary_dual_setup_mismatch_nrf54l:
    filter: CONFIG_SERIAL_SUPPORT_INTERRUPT
    platform_allow:
      - nrf54l15dk/nrf54l15/cpuapp
      - nrf54l15dk/nrf54l15/cpuflpr
      - nrf54lm20dk/nrf54lm20a/cpuapp
      - nrf54lm20dk/nrf54lm20a/cpuflpr
      - ophelia4ev/nrf54l15/cpuapp
      - ophelia4ev/nrf54l15/cpuflpr
    extra_args:
      - platform:nrf54l15dk/nrf54l15/cpuapp:"DTC_OVERLAY_FILE=boards/nrf54l15dk_nrf54l15_dual_uart.overlay"
      - platform:nrf54l15dk/nrf54l15/cpuflpr:"DTC_OVERLAY_FILE=boards/nrf54l15dk_nrf54l15_dual_uart.overlay"
      - platform:nrf54lm20dk/nrf54lm20a/cpuapp:"DTC_OVERLAY_FILE=boards/nrf54lm20dk_nrf54lm20a_dual_uart.overlay"
      - platform:nrf54lm20dk/nrf54lm20a/cpuflpr:"DTC_OVERLAY_FILE=boards/nrf54lm20dk_nrf54lm20a_dual_uart.overlay"
      - platform:ophelia4ev/nrf54l15/cpuapp:"DTC_OVERLAY_FILE=boards/nrf54l15dk_nrf54l15_dual_uart.overlay"
      - platform:ophelia4ev/nrf54l15/cpuflpr:"DTC_OVERLAY_FILE=boards/nrf54l15dk_nrf54l15_dual_uart.overlay"
    extra_configs:
      - CONFIG_DUAL_UART_TEST=y
      - CONFIG_SETUP_MISMATCH_TEST=y
  drivers.uart.uart_elementary_cross_domain:
    filter: CONFIG_SERIAL_SUPPORT_INTERRUPT
    harness_config:
      fixture: uart_p1_p2_loopback
    platform_allow:
      - nrf54l15dk/nrf54l15/cpuapp
    extra_args: DTC_OVERLAY_FILE="boards/nrf54l15dk_nrf54l15_cpuapp_cross_domain.overlay"
    extra_configs:
      - CONFIG_NRF_SYS_EVENT=y
```

## tests/drivers/uart/uart_emul/boards/native_posix.conf
```kconfig
# Copyright (c) 2023 Trackunit Corporation
# SPDX-License-Identifier: Apache-2.0

CONFIG_NATIVE_UART_0_ON_STDINOUT=y
```

## tests/drivers/uart/uart_emul/dts/bindings/uart-dummy.yaml
```yaml
# Copyright (c) 2024 Basalte bv
# SPDX-License-Identifier: Apache-2.0

description: Properties for dummy emulated driver.

compatible: "uart-dummy"

include: uart-device.yaml
```

## tests/drivers/uart/uart_emul/testcase.yaml
```yaml
common:
  tags:
    - drivers
    - uart
  platform_allow:
    - qemu_x86
    - native_sim
  extra_args: DTC_OVERLAY_FILE="uart_emul.overlay"
  harness: ztest
tests:
  drivers.uart.emul.polling: {}
  drivers.uart.emul.interrupt_driven:
    extra_configs:
      - CONFIG_UART_INTERRUPT_DRIVEN=y
  drivers.uart.emul.async:
    extra_configs:
      - CONFIG_EVENTS=y
      - CONFIG_UART_ASYNC_API=y
```

## tests/drivers/uart/uart_errors/testcase.yaml
```yaml
common:
  tags:
    - drivers
    - uart
  depends_on: gpio
  harness: ztest
  harness_config:
    fixture: gpio_loopback
  timeout: 30
tests:
  drivers.uart.uart_errors.int_driven:
    filter: CONFIG_SERIAL_SUPPORT_INTERRUPT
    platform_allow:
      - nrf54h20dk/nrf54h20/cpuapp
      - nrf54l15dk/nrf54l15/cpuapp
      - nrf54lm20dk/nrf54lm20a/cpuapp
      - nrf5340dk/nrf5340/cpuapp
      - ophelia4ev/nrf54l15/cpuapp
      - sam_e54_xpro
  drivers.uart.uart_errors.async:
    filter: CONFIG_SERIAL_SUPPORT_ASYNC
    platform_allow:
      - nrf54h20dk/nrf54h20/cpuapp
      - nrf54l15dk/nrf54l15/cpuapp
      - nrf54lm20dk/nrf54lm20a/cpuapp
      - nrf5340dk/nrf5340/cpuapp
      - ophelia4ev/nrf54l15/cpuapp
    extra_configs:
      - CONFIG_UART_ASYNC_API=y
      - CONFIG_UART_INTERRUPT_DRIVEN=n
      - CONFIG_PM_DEVICE=n
```

## tests/drivers/uart/uart_mix_fifo_poll/Kconfig
```kconfig
# Copyright (c) 2024 Nordic Semiconductor ASA
# SPDX-License-Identifier: Apache-2.0

config STRESS_TEST_REPS
	int "Number of loops in the stress test"
	# For the simulated devices, which are run by default in CI, we set it to less to not spend too
	# much CI time
	default 500 if SOC_SERIES_BSIM_NRFXX
	default 10000
	help
	  For how many loops will the stress test run. The higher this number the longer the
	  test and therefore the higher likelihood an unlikely race/event will be triggered.

# Include Zephyr's Kconfig
source "Kconfig"
```

## tests/drivers/uart/uart_mix_fifo_poll/testcase.yaml
```yaml
common:
  tags:
    - drivers
    - uart
  depends_on: gpio
  harness: ztest
  platform_allow:
    - nrf52840dk/nrf52840
    - nrf9160dk/nrf9160
    - nrf5340dk/nrf5340/cpuapp
    - nrf5340bsim/nrf5340/cpuapp
    - nrf54l09pdk/nrf54l09/cpuapp
    - nrf54l15dk/nrf54l15/cpuapp
    - nrf54l20pdk/nrf54l20/cpuapp
    - nrf54l15bsim/nrf54l15/cpuapp
    - nrf54h20dk/nrf54h20/cpuapp
    - nrf54h20dk/nrf54h20/cpurad
    - nrf52_bsim
  integration_platforms:
    - nrf52840dk/nrf52840
  harness_config:
    fixture: uart_loopback
tests:
  drivers.uart.uart_mix_poll:
    extra_configs:
      - CONFIG_UART_INTERRUPT_DRIVEN=n
      - CONFIG_UART_ASYNC_API=n
      - CONFIG_UART_0_ENHANCED_POLL_OUT=n

  drivers.uart.uart_mix_poll_fifo:
    extra_configs:
      - CONFIG_UART_INTERRUPT_DRIVEN=y
      - CONFIG_UART_0_INTERRUPT_DRIVEN=y
      - CONFIG_UART_0_ENHANCED_POLL_OUT=n

  drivers.uart.uart_mix_poll_async_api:
    extra_configs:
      - CONFIG_UART_ASYNC_API=y
      - CONFIG_UART_0_INTERRUPT_DRIVEN=n
      - CONFIG_UART_0_ASYNC=y
      - CONFIG_UART_0_ENHANCED_POLL_OUT=n

  drivers.uart.uart_mix_poll_async_api_const:
    extra_args: TEST_CONST_BUFFER=1
    extra_configs:
      - CONFIG_UART_ASYNC_API=y
      - CONFIG_UART_0_INTERRUPT_DRIVEN=n
      - CONFIG_UART_0_ASYNC=y
      - CONFIG_UART_0_ENHANCED_POLL_OUT=n
      - CONFIG_UART_0_TX_CACHE_SIZE=2
    tags: bsim_skip_CI # We skip a few tests to save CI time, as they give little extra coverage

  drivers.uart.uart_mix_poll_with_ppi:
    extra_configs:
      - CONFIG_UART_INTERRUPT_DRIVEN=n
      - CONFIG_UART_ASYNC_API=n
      - CONFIG_UART_0_ENHANCED_POLL_OUT=y
    platform_allow:
      - nrf52840dk/nrf52840
      - nrf5340dk/nrf5340/cpuapp
      - nrf9160dk/nrf9160

  drivers.uart.uart_mix_poll_fifo_with_ppi:
    extra_configs:
      - CONFIG_UART_INTERRUPT_DRIVEN=y
      - CONFIG_UART_0_INTERRUPT_DRIVEN=y
      - CONFIG_UART_0_ENHANCED_POLL_OUT=y
    platform_allow:
      - nrf52840dk/nrf52840
      - nrf5340dk/nrf5340/cpuapp
      - nrf9160dk/nrf9160

  drivers.uart.uart_mix_poll_async_api_with_ppi:
    extra_configs:
      - CONFIG_UART_ASYNC_API=y
      - CONFIG_UART_0_INTERRUPT_DRIVEN=n
      - CONFIG_UART_0_ASYNC=y
      - CONFIG_UART_0_ENHANCED_POLL_OUT=y
    platform_allow:
      - nrf52840dk/nrf52840
      - nrf5340dk/nrf5340/cpuapp
      - nrf9160dk/nrf9160
```

## tests/drivers/uart/uart_pm/testcase.yaml
```yaml
common:
  tags:
    - drivers
    - uart
  harness: ztest
  platform_allow:
    - nrf52_bsim
    - nrf52840dk/nrf52840
    - nrf5340bsim/nrf5340/cpuapp
    - nrf54h20dk/nrf54h20/cpuapp
    - nrf54l15dk/nrf54l15/cpuapp
    - nrf54l15bsim/nrf54l15/cpuapp
    - nrf54lm20dk/nrf54lm20a/cpuapp
    - nrf54lm20bsim/nrf54lm20a/cpuapp
    - ophelia4ev/nrf54l15/cpuapp
  harness_config:
    fixture: gpio_loopback
  depends_on: gpio
  integration_platforms:
    - nrf52840dk/nrf52840
tests:
  drivers.uart.pm:
    extra_configs:
      - CONFIG_UART_INTERRUPT_DRIVEN=n
      - CONFIG_UART_ASYNC_API=n
      - CONFIG_UART_0_ENHANCED_POLL_OUT=n

  drivers.uart.pm.no_rxpin:
    extra_configs:
      - CONFIG_UART_INTERRUPT_DRIVEN=n
      - CONFIG_UART_ASYNC_API=n
      - CONFIG_UART_0_ENHANCED_POLL_OUT=n
    extra_args: DTC_OVERLAY_FILE="boards/nrf52840dk_nrf52840.overlay;nrf_rx_disable.overlay"
    platform_exclude:
      - nrf52_bsim
      - nrf5340bsim/nrf5340/cpuapp
      - nrf54h20dk/nrf54h20/cpuapp
      - nrf54l15dk/nrf54l15/cpuapp
      - nrf54l15bsim/nrf54l15/cpuapp
      - nrf54lm20dk/nrf54lm20a/cpuapp
      - nrf54lm20bsim/nrf54lm20a/cpuapp
      - ophelia4ev/nrf54l15/cpuapp

  drivers.uart.pm.enhanced_poll:
    extra_configs:
      - CONFIG_UART_INTERRUPT_DRIVEN=n
      - CONFIG_UART_ASYNC_API=n
      - CONFIG_UART_0_ENHANCED_POLL_OUT=y
    platform_exclude:
      - nrf54h20dk/nrf54h20/cpuapp
      - nrf54l15dk/nrf54l15/cpuapp
      - nrf54lm20dk/nrf54lm20a/cpuapp
      - ophelia4ev/nrf54l15/cpuapp

  drivers.uart.pm.int_driven:
    extra_configs:
      - CONFIG_UART_INTERRUPT_DRIVEN=y
      - CONFIG_UART_0_INTERRUPT_DRIVEN=y
      - CONFIG_UART_ASYNC_API=n
      - CONFIG_UART_0_ENHANCED_POLL_OUT=n

  drivers.uart.pm.int_driven.enhanced_poll:
    extra_configs:
      - CONFIG_UART_INTERRUPT_DRIVEN=y
      - CONFIG_UART_0_INTERRUPT_DRIVEN=y
      - CONFIG_UART_ASYNC_API=n
      - CONFIG_UART_0_ENHANCED_POLL_OUT=y
    platform_exclude:
      - nrf54h20dk/nrf54h20/cpuapp
      - nrf54l15dk/nrf54l15/cpuapp
      - nrf54lm20dk/nrf54lm20a/cpuapp
      - ophelia4ev/nrf54l15/cpuapp

  drivers.uart.pm.async:
    extra_configs:
      - CONFIG_UART_INTERRUPT_DRIVEN=n
      - CONFIG_UART_ASYNC_API=y
      - CONFIG_UART_0_ASYNC=y
      - CONFIG_UART_0_NRF_HW_ASYNC=y
      - CONFIG_UART_0_NRF_HW_ASYNC_TIMER=2
      - CONFIG_NRFX_TIMER2=y
      - CONFIG_UART_0_ENHANCED_POLL_OUT=n

  drivers.uart.pm.async.enhanced_poll:
    extra_configs:
      - CONFIG_UART_INTERRUPT_DRIVEN=n
      - CONFIG_UART_ASYNC_API=y
      - CONFIG_UART_0_ASYNC=y
      - CONFIG_UART_0_NRF_HW_ASYNC=y
      - CONFIG_UART_0_NRF_HW_ASYNC_TIMER=2
      - CONFIG_NRFX_TIMER2=y
      - CONFIG_UART_0_ENHANCED_POLL_OUT=y
    platform_exclude:
      - nrf54h20dk/nrf54h20/cpuapp
      - nrf54l15dk/nrf54l15/cpuapp
      - nrf54lm20dk/nrf54lm20a/cpuapp
      - ophelia4ev/nrf54l15/cpuapp
```

## tests/drivers/udc/testcase.yaml
```yaml
common:
  tags:
    - usb
    - drivers
tests:
  drivers.usb.udc:
    depends_on: usbd
    integration_platforms:
      - nrf52840dk/nrf52840
      - frdm_k64f
      - nucleo_f413zh
      - mimxrt1050_evk/mimxrt1052/hyperflash
      - rpi_pico
    platform_exclude:
      - nrf54h20dk/nrf54h20/cpuapp
  drivers.usb.udc.build_only:
    build_only: true
    # Platform excluded above, only to build, with justification.
    platform_allow:
      # The controller cannot be enabled without VBUS, but the device should
      # not be connected to the host during testing.
      - nrf54h20dk/nrf54h20/cpuapp
  drivers.usb.udc.skeleton:
    extra_args:
      - EXTRA_DTC_OVERLAY_FILE="udc_skeleton.overlay"
      - CONFIG_UDC_BUF_POOL_SIZE=32768
    platform_allow:
      - native_sim/native/64
```

## tests/drivers/usb/uhc/testcase.yaml
```yaml
tests:
  drivers.usb.uhc:
    tags:
      - drivers
      - usbh
    depends_on: usbh
```

## tests/drivers/usb/vbus_detect/boards/native_sim.conf
```kconfig
# Copyright (c) 2026 Leica Geosystems AG
# SPDX-License-Identifier: Apache-2.0

CONFIG_SYS_CLOCK_TICKS_PER_SEC=1000000
CONFIG_UHC_DRIVER=y
CONFIG_USB_HOST_STACK=y
```

## tests/drivers/usb/vbus_detect/testcase.yaml
```yaml
# Copyright (c) 2026 Leica Geosystems AG
# SPDX-License-Identifier: Apache-2.0

tests:
  drivers.usb.vbus_detect:
    tags:
      - drivers
      - usb
      - vbus
    platform_allow: native_sim
```

## tests/drivers/video/api/testcase.yaml
```yaml
# Copyright (c) 2024-2025 tinyVision.ai Inc.
# SPDX-License-Identifier: Apache-2.0

tests:
  drivers.video.api:
    min_ram: 32
    tags:
      - drivers
      - video
    platform_allow: native_sim
```
