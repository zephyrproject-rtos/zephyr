/* SPDX-License-Identifier: Apache-2.0 */

#include "nrf54h20dk_nrf54h20_common.dtsi"

&timer137 {
	interrupts = <467 (NRF_DEFAULT_IRQ_PRIORITY + 1)>;
};

&dut {
	interrupts = <470 (NRF_DEFAULT_IRQ_PRIORITY + 1)>;
};

/* PPR cannot use that instance. */
&uart120 {
	status = "disabled"
};
