/* SPDX-License-Identifier: Apache-2.0 */

&uart1 {
	current-speed = <115200>;
	compatible = "nordic,nrf-uarte";
	status = "okay";
	tx-gpios = <&gpio0 10 0>;
	rx-gpios = <&gpio0 11 0>;
	rts-gpios = <&gpio0 12 0>;
	cts-gpios = <&gpio0 13 0>;
	hw-flow-control;
};

&rtc1 {
	interrupts = <21 2>;
};
