/*
 * Copyright (c) 2026 Texas Instruments Incorporated
 *
 * SPDX-License-Identifier: Apache-2.0
 */

/* TX (PA2) and RX (PA10) must be connected together for loopback */

#include <dt-bindings/uart/mspm0_uart.h>

&unicomm0 {
	status = "okay";
};

dut: &unicomm0_uart {
	pinctrl-0 = <&uc0_tx_sda_pico_pa2 &uc0_rx_scl_sclk_pa10>;
	pinctrl-names = "default";
	current-speed = <115200>;
	rx-fifo-threshold = <MSPM0_UART_RX_FIFO_LEVEL_ONE_ENTRY>;
	status = "okay";
};

counter_dev: &counterg12_0 {
	status = "okay";
};

&timg12_0 {
	status = "okay";
};
