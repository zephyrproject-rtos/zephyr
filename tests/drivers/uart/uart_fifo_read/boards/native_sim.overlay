/*
 * SPDX-FileCopyrightText: Copyright The Zephyr Project Contributors
 * SPDX-License-Identifier: Apache-2.0
 */

/ {
	dut: uart-emul {
		compatible = "zephyr,uart-emul";
		current-speed = <115200>;
		loopback;
		rx-fifo-size = <2>;
		tx-fifo-size = <16>;
		latch-buffer-size = <2>;
		status = "okay";
	};
};
