/*
 * Copyright (c) 2025 STMicroelectronics
 *
 * SPDX-License-Identifier: Apache-2.0
 */

dut: &usart3 {
	pinctrl-0 = <&usart3_tx_pc4 &usart3_rx_pc5 &usart3_rts_pb14 &usart3_cts_pb13>;
	dmas = <&dmamux1 5 74 STM32_DMA_PERIPH_TX>,
	       <&dmamux1 4 73 STM32_DMA_PERIPH_RX>;
	dma-names = "tx", "rx";
	hw-flow-control;
};

&dma1 {
	status = "okay";
};

&dma2 {
	status = "okay";
};

&dmamux1 {
	status = "okay";
};
