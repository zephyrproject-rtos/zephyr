/*
 * Copyright (c) 2025 STMicroelectronics
 *
 * SPDX-License-Identifier: Apache-2.0
 */

dut: &usart3 {
	pinctrl-0 = <&usart3_tx_pd8 &usart3_rx_pd9 &usart3_rts_pd2 &usart3_cts_pb13>;
	dmas = <&gpdma1 0 29 STM32_DMA_PERIPH_TX>,
	       <&gpdma1 1 28 STM32_DMA_PERIPH_RX>;
	dma-names = "tx", "rx";
	hw-flow-control;
};
