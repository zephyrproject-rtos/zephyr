/*
 * Copyright (c) 2026 Texas Instruments Incorporated
 *
 * SPDX-License-Identifier: Apache-2.0
 */

/* TX (PB4) and RX (PB5) must be connected together for loopback */
/* RTS (PB3) and CTS (PB8) must be connected together for flow control */

/ {
	soc {
		dut: uart1: uart@4010a000 {
			pinctrl-0 = <&uart1_tx_pb4 &uart1_rx_pb5 &uart1_rts_pb3 &uart1_cts_pb8>;
			pinctrl-names = "default";
			hw-flow-control;
			status = "okay";
		};
	};
};
