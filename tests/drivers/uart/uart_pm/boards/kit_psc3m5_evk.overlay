/*
 * SPDX-FileCopyrightText: Copyright (c) 2026 Infineon Technologies AG,
 * SPDX-FileCopyrightText: or an affiliate of Infineon Technologies AG. All rights reserved.
 *
 * SPDX-License-Identifier: Apache-2.0
 */

/*
 * Loopback jumper: P3.3 (TX) to P3.2 (RX).
 */

dut: &scb4 {
	compatible = "infineon,uart";
	status = "okay";
	current-speed = <115200>;

	clocks = <&peri0_group4_16bit_0>;

	pinctrl-0 = <&p3_3_scb4_uart_tx &p3_2_scb4_uart_rx>;
	pinctrl-names = "default";
};

&p3_3_scb4_uart_tx {
	drive-push-pull;
};

&p3_2_scb4_uart_rx {
	input-enable;
};

&peri0_group4_16bit_0 {
	status = "okay";
	clock-div = <103>;
};
