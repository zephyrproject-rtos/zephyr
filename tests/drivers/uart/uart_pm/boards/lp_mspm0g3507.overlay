/*
 * Copyright (c) 2026 Texas Instruments Incorporated
 *
 * SPDX-License-Identifier: Apache-2.0
 */

#include <zephyr/dt-bindings/uart/mspm0_uart.h>

/* TX (PB4) and RX (PB7) must be connected together for loopback. */

dut: &uart1 {
	pinctrl-0 = <&uart1_tx_pb4 &uart1_rx_pb7>;
	pinctrl-names = "default";
	current-speed = <9600>;
	rx-fifo-threshold = <MSPM0_UART_RX_FIFO_LEVEL_ONE_ENTRY>;
	status = "okay";
};

&cpu0 {
	cpu-power-states = <&run0 &run1 &run2>;
};
