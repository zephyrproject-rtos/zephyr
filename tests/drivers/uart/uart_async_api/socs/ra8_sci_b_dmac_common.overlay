/*
 * Copyright (c) 2026 Renesas Electronics Corporation
 * SPDX-License-Identifier: Apache-2.0
 */

&dma0 {
	interrupts = <91 1>, <90 1>;
	interrupt-names = "ch0", "ch1";
	status = "okay";
};

&dut {
	/delete-property/ tx-dtc;
	/delete-property/ rx-dtc;
	dmas = <&dma0 0>, <&dma0 1>;
	dma-names = "tx", "rx";
};
