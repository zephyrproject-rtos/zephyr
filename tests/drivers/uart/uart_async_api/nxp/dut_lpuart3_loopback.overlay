/*
 * Copyright 2024 NXP
 * SPDX-License-Identifier: Apache-2.0
 */

/*
 * Except testing with "nxp,loopback"
 *
 * frdm_mcxa346: Short J5.3 and J5.4
 * frdm_mcxa266: Short J5.3 and J5.4
 */

dut: &lpuart3 {
	status = "okay";
	current-speed = <115200>;
	nxp,loopback;
};
