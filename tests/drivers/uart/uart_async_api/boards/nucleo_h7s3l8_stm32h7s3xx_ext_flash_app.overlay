/*
 * Copyright The Zephyr Project Contributors
 *
 * SPDX-License-Identifier: Apache-2.0
 */

dut: &usart2 {
	pinctrl-0 = <&usart2_tx_pd5 &usart2_rx_pd6>;
	pinctrl-names = "default";
	current-speed = <115200>;
	status = "okay";
	dmas = <&gpdma1 0 76 STM32_DMA_PERIPH_TX>,
	       <&gpdma1 1 75 STM32_DMA_PERIPH_RX>;
	dma-names = "tx", "rx";
};

&gpdma1 {
	status = "okay";
};
