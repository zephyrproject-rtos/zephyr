/* SPDX-License-Identifier: Apache-2.0 */

dut: &usart1 {
	dmas = <&dmamux1 51 STM32_DMA_PERIPH_TX>,
	       <&dmamux1 50 STM32_DMA_PERIPH_RX>;
	dma-names = "tx", "rx";
};

&dma1 {
	status = "okay";
};

&dmamux1 {
	status = "okay";
};
