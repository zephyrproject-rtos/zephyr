/*
 * Copyright (c) 2026 Daniel Kampert
 *
 * SPDX-License-Identifier: Apache-2.0
 */

/*
 * Reduce the USART1 kernel clock (APB2) to 96 MHz / 16 = 6 MHz. 500 kbit/s then exceeds
 * fCK / 16 (375 kbit/s) and requires oversampling by 8
 * (USARTDIV = 6 MHz / (8 * 500 kbit/s) = 1.5, no baud rate error).
 *
 * A reduced kernel clock is used instead of a baud rate of several Mbit/s, because the
 * async API tests need reception across RX buffer boundaries without data loss.
 */
&rcc {
	apb2-prescaler = <16>;
};

&usart1 {
	current-speed = <500000>;
};
