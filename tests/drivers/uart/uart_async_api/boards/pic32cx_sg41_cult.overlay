/*
 * Copyright (c) 2026 Microchip Technology Inc.
 *
 * SPDX-License-Identifier: Apache-2.0
 */

dut: &sercom0 {
	compatible = "microchip,sercom-g1-uart";
	#address-cells = <1>;
	#size-cells = <0>;
	current-speed = <115200>;

	/* sercom0 is configured for SPI, drop SPI-related properties to allow UART use */
	/delete-property/ dipo;
	/delete-property/ dopo;
	/delete-property/ cs-gpios;

	/* Internally loop-back TX and RX on PAD0 */
	rxpo = <0>;
	txpo = <0>;

	pinctrl-0 = <&sercom0_uart_default>;
	pinctrl-names = "default";

	dmas = <&dmac 5 0x04>, <&dmac 6 0x05>;
	dma-names = "rx", "tx";
	status = "okay";
};

&pinctrl {
	sercom0_uart_default: sercom0_uart_default {
		group1 {
			pinmux = <PB24C_SERCOM0_PAD0>,
				 <PB25C_SERCOM0_PAD1>;
		};
	};
};
