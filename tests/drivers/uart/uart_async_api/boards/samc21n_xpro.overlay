/* SPDX-License-Identifier: Apache-2.0 */

&dmac {
	status = "okay";
};

dut: &sercom0 {
	/* Internally loop-back TX and RX on PAD0 */
	rxpo = <0>;
	txpo = <0>;

	/* Configure DMA channels for async operation */
	dmas = <&dmac 0 0x02>, <&dmac 1 0x03>;
	dma-names = "rx", "tx";
};

&sercom2 {
	status = "disabled";
};

&sercom4 {
	/* configure DMA channels for async operation */
	dmas = <&dmac 10 0x0A>, <&dmac 11 0x0B>;
	dma-names = "rx", "tx";
};
