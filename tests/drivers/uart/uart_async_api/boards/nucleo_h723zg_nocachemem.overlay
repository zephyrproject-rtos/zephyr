/*
 * Copyright (c) 2024 STMicroelectronics
 *
 * SPDX-License-Identifier: Apache-2.0
 */

#include <zephyr/dt-bindings/memory-attr/memory-attr-arm.h>

&sram1 {
	zephyr,memory-attr = <DT_MEM_ARM_MPU_RAM_NOCACHE>;
	zephyr,memory-region = "RAM_NOCACHE";
};
