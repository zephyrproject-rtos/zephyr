/*
 * Copyright (c) 2025 STMicroelectronics
 *
 * SPDX-License-Identifier: Apache-2.0
 */
dut: &usart3 {
	dmas = <&gpdma1 26 STM32_DMA_PERIPH_TX>,
	       <&gpdma1 25 STM32_DMA_PERIPH_RX>;
	dma-names = "tx", "rx";
};
