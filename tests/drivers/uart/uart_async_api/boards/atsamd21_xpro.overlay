/* SPDX-License-Identifier: Apache-2.0 */

&sercom1 {
	/* Internally loop-back TX and RX on PAD0 */
	rxpo = <0>;
	txpo = <0>;

	/* Configure DMA channels for async operation */
	dmas = <&dmac 0 3>, <&dmac 1 4>;
	dma-names = "rx", "tx";
};
