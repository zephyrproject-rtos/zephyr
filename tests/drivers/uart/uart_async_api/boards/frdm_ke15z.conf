## tests/drivers/uart/uart_async_api/boards/kit_psc3m5_evk.conf
```kconfig
# SPDX-FileCopyrightText: Copyright (c) 2026 Infineon Technologies AG,
# SPDX-FileCopyrightText: or an affiliate of Infineon Technologies AG. All rights reserved.
#
# SPDX-License-Identifier: Apache-2.0

CONFIG_TEST_USERSPACE=n
CONFIG_TEST_LONG_BUFFER_SIZE=256
```

## tests/drivers/uart/uart_async_api/boards/kit_t2g_c2d6m_lite_cyt4dnjbzs_m7_0.conf
```kconfig
# SPDX-FileCopyrightText: Copyright (c) 2026 Linumiz
# SPDX-License-Identifier: Apache-2.0

CONFIG_TEST_LONG_BUFFER_SIZE=256
CONFIG_MUX=y
```

## tests/drivers/uart/uart_async_api/boards/nucleo_h7s3l8_stm32h7s3xx_ext_flash_app.conf
```kconfig
# SPDX-FileCopyrightText: Copyright The Zephyr Project Contributors
# SPDX-License-Identifier: Apache-2.0

CONFIG_DCACHE=n
CONFIG_VAR_LENGTH_BUFFER_TEST_BAUDRATE_LIMIT=19200
```

## tests/drivers/uart/uart_async_dual/boards/nrf54h20dk_nrf54h20_cpuppr.conf
```kconfig
CONFIG_NRFX_GPPI_V1=y
CONFIG_UART_NRFX_UARTE_BOUNCE_BUF_SWAP_LATENCY=1000
CONFIG_UART_NRFX_UARTE_BOUNCE_BUF_LEN=512

# To reduca memory footprint
CONFIG_PM_DEVICE_RUNTIME_ASYNC=n
```

## tests/drivers/uart/uart_elementary/Kconfig
```kconfig
# UART test configuration options
# Copyright (c) 2024 Nordic Semiconductor ASA
# SPDX-License-Identifier: Apache-2.0

config DUAL_UART_TEST
	bool "Enable dual UART test"

config SETUP_MISMATCH_TEST
	bool "Enable mismatched configuration in dual UART test"

config UART_BAUDRATE_MISMATCH
	int "UART baudrate for DUT_AUX to test mismatch case"
	depends on SETUP_MISMATCH_TEST
	default 9600
	help
	  UART baudrate for DUT_AUX that is intentionally different from DUT
	  to test error detection.

config UART_ELEMENTARY_NO_FLOW_CTRL
	bool "Skip hardware flow control in elementary UART tests"
	help
	  Use UART_CFG_FLOW_CTRL_NONE instead of UART_CFG_FLOW_CTRL_RTS_CTS
	  for boards whose UART driver does not support hardware flow control.

source "Kconfig.zephyr"
```

## tests/drivers/uart/uart_interrupt_api/testcase.yaml
```yaml
tests:
  drivers.uart.interrupt_api:
    tags:
      - uart
    filter: CONFIG_SERIAL_SUPPORT_INTERRUPT
    vendor_allow:
      - adi
  drivers.uart.interrupt_api.lp_mspm:
    tags:
      - uart
    filter: CONFIG_SERIAL_SUPPORT_INTERRUPT
    harness: ztest
    platform_allow:
      - lp_mspm0g3507
      - lp_mspm0g3519
      - lp_mspm0l2228
      - lp_mspm33c321a
    integration_platforms:
      - lp_mspm0g3507
      - lp_mspm0g3519
      - lp_mspm0l2228
      - lp_mspm33c321a
  drivers.uart.interrupt_api.lp_mspm.pm:
    tags:
      - pm_runtime
      - uart
    filter: CONFIG_SERIAL_SUPPORT_INTERRUPT
    harness: ztest
    platform_allow:
      - lp_mspm0g3507
      - lp_mspm0g3519
      - lp_mspm0l2228
    extra_args:
      - EXTRA_DTC_OVERLAY_FILE="../uart_mix_fifo_poll/boards/${BOARD}.overlay"
    extra_configs:
      - CONFIG_PM_DEVICE=y
      - CONFIG_PM_DEVICE_RUNTIME=y
  drivers.uart.interrupt_api.lp_mspm.pm.policy:
    tags:
      - pm_runtime
      - pm_policy
      - uart
    filter: CONFIG_SERIAL_SUPPORT_INTERRUPT
    harness: ztest
    platform_allow:
      - lp_mspm0g3507
      - lp_mspm0g3519
      - lp_mspm0l2228
    extra_args:
      - EXTRA_DTC_OVERLAY_FILE="../uart_mix_fifo_poll/boards/${BOARD}.overlay;pm_policy.overlay"
    extra_configs:
      - CONFIG_PM=y
      - CONFIG_PM_DEVICE=y
      - CONFIG_PM_DEVICE_RUNTIME=y
      - CONFIG_PM_POLICY_DEVICE_CONSTRAINTS=y
      - CONFIG_TICKLESS_KERNEL=y
      - CONFIG_COUNTER=y
      - CONFIG_SYSTEM_TIMER_LPM_COMPANION_COUNTER=y
      - CONFIG_PM_PREWAKEUP_CONV_MODE_CEIL=y
  drivers.uart.interrupt_api.lp_am13e230:
    tags:
      - uart
    filter: CONFIG_SERIAL_SUPPORT_INTERRUPT
    harness: ztest
    platform_allow:
      - lp_am13e230
    integration_platforms:
      - lp_am13e230
```

## tests/drivers/video/htpa_processor/dts/bindings/video/zephyr,htpa-test-source.yaml
```yaml
# SPDX-FileCopyrightText: Copyright The Zephyr Project Contributors
# SPDX-License-Identifier: Apache-2.0

description: Test HTPA frame source
compatible: "zephyr,htpa-test-source"
include: base.yaml
```

## tests/drivers/virtio/buf_addressability/Kconfig
```kconfig
# SPDX-FileCopyrightText: Copyright (c) 2026 Process Mission
# SPDX-License-Identifier: Apache-2.0

mainmenu "Virtio buffer addressability tests"

config TEST_VIRTIO_MAPS_ALL_RAM
	bool "Map all RAM at boot in the test image"
	help
	  Drives the hidden ARCH_MAPS_ALL_RAM option through its default. The
	  option has no prompt and cannot be assigned from an extra configuration.

config ARCH_MAPS_ALL_RAM
	bool
	default y if TEST_VIRTIO_MAPS_ALL_RAM

source "Kconfig.zephyr"
```

## tests/drivers/virtio/pci/dts/bindings/interrupt-controller/zephyr,test-irq-controller.yaml
```yaml
# SPDX-FileCopyrightText: Copyright The Zephyr Project Contributors
# SPDX-License-Identifier: Apache-2.0

description: Test interrupt controller for VirtIO PCI

compatible: "zephyr,test-irq-controller"

include: [interrupt-controller.yaml, base.yaml]

properties:
  "#interrupt-cells":
    const: 2

interrupt-cells:
  - irq
  - priority
```

## tests/drivers/watchdog/wdt_basic_api/boards/lpcxpresso54628.conf
```kconfig
# Copyright 2026 NXP
# SPDX-License-Identifier: Apache-2.0

CONFIG_TEST_WDT_NOINIT_SECTION="SRAMX"
CONFIG_WDT_MCUX_WWDT_WARNING_INTERRUPT_CFG=10
```

## tests/drivers/watchdog/wdt_error_cases/boards/kit_t2g_c2d6m_lite_cyt4dnjbzs_m7_0.conf
```kconfig
# SPDX-FileCopyrightText: Copyright (c) 2026 Linumiz
#
# SPDX-License-Identifier: Apache-2.0

CONFIG_TEST_WDT_FLAG_RESET_NONE_SUPPORTED=y
CONFIG_TEST_WDT_WINDOW_MIN_SUPPORTED=y
CONFIG_TEST_WDT_WINDOW_MAX_ALLOWED=0x07CFFFFF
CONFIG_TEST_WDT_FEED_CAN_STALL=y
```
