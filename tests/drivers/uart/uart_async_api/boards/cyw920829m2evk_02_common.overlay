/*
 * SPDX-FileCopyrightText: Copyright (c) 2026 Infineon Technologies AG,
 * SPDX-FileCopyrightText: or an affiliate of Infineon Technologies AG. All rights reserved.
 *
 * SPDX-License-Identifier: Apache-2.0
 */

&dma0 {
	compatible = "infineon,dma";
	#address-cells = <1>;
	#size-cells = <0>;

	status = "okay";
};

dut: &scb1 {
	compatible = "infineon,uart";
	current-speed = <115200>;

	dmas = <&dma0 6>, <&dma0 7>;
	dma-names = "tx", "rx";

	pinctrl-0 = <&p1_3_scb1_uart_tx &p1_2_scb1_uart_rx>;
	pinctrl-names = "default";
	status = "okay";
};

&p1_3_scb1_uart_tx {
	drive-push-pull;
};

&p1_2_scb1_uart_rx {
	input-enable;
};
