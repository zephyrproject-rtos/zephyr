/* SPDX-License-Identifier: Apache-2.0 */

#include "nrf54h20dk_nrf54h20_common.dtsi"

&dut {
	memory-regions = <&cpuapp_dma_region>;
};

&dut2 {
	status = "okay";
	memory-regions = <&dma_fast_region>;
};

&dma_fast_region {
	status = "okay";
};
