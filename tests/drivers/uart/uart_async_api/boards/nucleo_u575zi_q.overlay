/*
 * Copyright (c) 2022 STMicroelectronics
 *
 * SPDX-License-Identifier: Apache-2.0
 */

&usart2 {
	dmas = <&gpdma1 0 27 STM32_DMA_PERIPH_TX
		&gpdma1 1 26 STM32_DMA_PERIPH_RX>;
	dma-names = "tx", "rx";
};
