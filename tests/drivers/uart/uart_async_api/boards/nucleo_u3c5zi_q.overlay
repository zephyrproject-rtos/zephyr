/*
 * Copyright (c) 2026 Mario Paja
 *
 * SPDX-License-Identifier: Apache-2.0
 */

/* LPUART1 on PG7 (TX) / PG8 (RX): wire them together for the loopback */
dut: &lpuart1 {
	dmas = <&gpdma1 0 35 STM32_DMA_PERIPH_TX>,
	       <&gpdma1 1 34 STM32_DMA_PERIPH_RX>;
	dma-names = "tx", "rx";
};
