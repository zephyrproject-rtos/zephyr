## tests/drivers/uart/uart_async_api/boards/kit_pse84_eval_pse846gps2dbzc4a_m33.conf
```kconfig
# SPDX-FileCopyrightText: <text>Copyright (c) 2026 Infineon Technologies AG,
# or an affiliate of Infineon Technologies AG. All rights reserved.</text>
#
# SPDX-License-Identifier: Apache-2.0

CONFIG_TEST_USERSPACE=n
CONFIG_TEST_LONG_BUFFER_SIZE=256
```

## tests/drivers/uart/uart_async_api/boards/mimxrt1160_evk_cm7.conf
```kconfig
CONFIG_OCRAM_NOCACHE=y
# Custom MPU regions for noncacheable SRAM do not support userspace
CONFIG_TEST_USERSPACE=n
```

## tests/drivers/uart/uart_async_api/boards/mimxrt1180_evk_mimxrt1189_cm7.conf
```kconfig
#
# Copyright 2024 NXP
#
# SPDX-License-Identifier: Apache-2.0
#
CONFIG_DMA_MCUX_USE_DTCM_FOR_DMA_DESCRIPTORS=n
```

## tests/drivers/uart/uart_async_api/boards/nrf54h20dk_nrf54h20_cpuapp.conf
```kconfig
CONFIG_PM_DEVICE=y
CONFIG_PM_DEVICE_RUNTIME=y
CONFIG_VAR_LENGTH_BUFFER_TEST_BUADRATE_LIMIT=57600
```

## tests/drivers/uart/uart_async_api/boards/nrf54h20dk_nrf54h20_cpurad.conf
```kconfig
CONFIG_TEST_LONG_BUFFER_SIZE=128
CONFIG_VAR_LENGTH_BUFFER_TEST_BUADRATE_LIMIT=57600
```

## tests/drivers/uart/uart_async_api/boards/nucleo_f746zg.conf
```kconfig
CONFIG_NOCACHE_MEMORY=y
# Not enough MPU regions when both CONFIG_NOCACHE_MEMORY & CONFIG_USERSPACE are set
CONFIG_USERSPACE=n
```

## tests/drivers/uart/uart_async_api/boards/rtl8721f_evb.conf
```kconfig
# Copyright (c) 2026 Realtek Semiconductor Corp.
# SPDX-License-Identifier: Apache-2.0

CONFIG_DCACHE=n
```

## tests/drivers/uart/uart_async_api/boards/stm32h750b_dk.conf
```kconfig
CONFIG_DCACHE=y
CONFIG_NOCACHE_MEMORY=y
# Not enough MPU regions when both CONFIG_NOCACHE_MEMORY & CONFIG_USERSPACE are set
CONFIG_USERSPACE=n

# LPUART1 only works with BDMA, & the later can only access SRAM4
CONFIG_CODE_DATA_RELOCATION=y
CONFIG_UART_ASYNC_RELOCATE_SECTION="SRAM4"
```

## tests/drivers/uart/uart_async_api/testcase.yaml
```yaml
common:
  platform_exclude:
    - stamp_c3
    - wio_terminal
    - xiao_esp32c3
  tags:
    - drivers
    - uart
tests:
  drivers.uart.async_api:
    filter: CONFIG_SERIAL_SUPPORT_ASYNC and not CONFIG_UART_MCUX_LPUART
    harness: ztest
    harness_config:
      fixture: gpio_loopback
    depends_on: gpio
    extra_args:
      - platform:lpcxpresso55s69/lpc55s69/cpu0:"DTC_OVERLAY_FILE=nxp/dut_flexcomm2.overlay"
      - platform:mimxrt685_evk/mimxrt685s/cm33:"DTC_OVERLAY_FILE=nxp/dut_flexcomm4.overlay"
      - platform:mimxrt595_evk/mimxrt595s/cm33:"DTC_OVERLAY_FILE=nxp/dut_flexcomm12.overlay"
      - platform:frdm_rw612/rw612:"DTC_OVERLAY_FILE=nxp/dut_lpc_flexcomm0.overlay"
  drivers.uart.async_api.fast:
    harness: ztest
    harness_config:
      fixture: uart_fast_loopback
    platform_allow:
      - nrf54lm20dk/nrf54lm20a/cpuapp
    extra_args:
      - DTC_OVERLAY_FILE="boards/nrf54lm20dk_nrf54lm20a_cpuapp_uart00.overlay"
  drivers.uart.wide:
    filter: CONFIG_SERIAL_SUPPORT_ASYNC and not CONFIG_UART_MCUX_LPUART
    harness: ztest
    harness_config:
      fixture: gpio_loopback
    depends_on: gpio
    extra_configs:
      - CONFIG_UART_WIDE_DATA=y
    arch_allow: arm
    platform_allow: nucleo_h743zi
    integration_platforms:
      - nucleo_h743zi
  drivers.uart.async_api.nrf_uart:
    filter: CONFIG_SERIAL_SUPPORT_ASYNC
    harness: ztest
    platform_allow: nrf52840dk/nrf52840
    harness_config:
      fixture: gpio_loopback
    depends_on: gpio
    extra_args: DTC_OVERLAY_FILE="boards/nrf52840dk_nrf52840.overlay;boards/nrf_uart.overlay"
    integration_platforms:
      - nrf52840dk/nrf52840
  drivers.uart.async_api.rtt:
    filter: CONFIG_SERIAL_SUPPORT_ASYNC and CONFIG_HAS_SEGGER_RTT
      and not CONFIG_UART_MCUX_LPUART and not CONFIG_UART_MCUX_FLEXCOMM
    extra_args: DTC_OVERLAY_FILE=boards/segger_rtt.overlay
    extra_configs:
      - CONFIG_USE_SEGGER_RTT=y
      - CONFIG_UART_RTT=y
    platform_exclude:
      - xmc45_relax_kit
      - xmc47_relax_kit
    build_only: true
    integration_platforms:
      - qemu_cortex_m0
  drivers.uart.async_api.lpuart:
    filter: CONFIG_SERIAL_SUPPORT_ASYNC and CONFIG_UART_MCUX_LPUART and not CONFIG_CPU_HAS_DCACHE
    harness: ztest
    harness_config:
      fixture: gpio_loopback
    depends_on: dma
    extra_configs:
      - CONFIG_USERSPACE=n
      - CONFIG_TEST_USERSPACE=n
    extra_args:
      - platform:frdm_k82f/mk82f25615:"DTC_OVERLAY_FILE=nxp/dut_lpuart0_loopback.overlay"
      - platform:frdm_mcxa156/mcxa156:"DTC_OVERLAY_FILE=nxp/dut_lpuart1.overlay"
      - platform:frdm_mcxa153/mcxa153:"DTC_OVERLAY_FILE=nxp/dut_lpuart2_loopback.overlay;nxp/enable_edma0.overlay"
      - platform:frdm_mcxa346/mcxa346:"DTC_OVERLAY_FILE=nxp/dut_lpuart3_loopback.overlay;nxp/enable_edma0.overlay"
      - platform:frdm_mcxa266/mcxa266:"DTC_OVERLAY_FILE=nxp/dut_lpuart3_loopback.overlay;nxp/enable_edma0.overlay"
      - platform:mimxrt1160_evk/mimxrt1166/cm4:"DTC_OVERLAY_FILE=nxp/dut_lpuart2_loopback.overlay"
      - platform:mimxrt1170_evk@A/mimxrt1176/cm4:"DTC_OVERLAY_FILE=nxp/dut_lpuart2_loopback.overlay"
      - platform:mimxrt1170_evk@B/mimxrt1176/cm4:"DTC_OVERLAY_FILE=nxp/dut_lpuart2_loopback.overlay"
      - platform:frdm_mcxn236/mcxn236:"DTC_OVERLAY_FILE=nxp/dut_flexcomm2_lpuart2.overlay"
      - platform:frdm_mcxn947/mcxn947/cpu0:"DTC_OVERLAY_FILE=nxp/dut_flexcomm2_lpuart2.overlay"
      - platform:frdm_mcxn947/mcxn947/cpu0/qspi:"DTC_OVERLAY_FILE=nxp/dut_flexcomm2_lpuart2.overlay"
  drivers.uart.async_api.lpuart.rt_nocache:
    filter: CONFIG_SERIAL_SUPPORT_ASYNC and CONFIG_UART_MCUX_LPUART and CONFIG_CPU_HAS_DCACHE
    harness: ztest
    depends_on: dma
    extra_configs:
      - CONFIG_DCACHE=y
      - CONFIG_NOCACHE_MEMORY=y
      - CONFIG_USERSPACE=n
      - CONFIG_TEST_USERSPACE=n
    extra_args:
      - platform:mimxrt1010_evk/mimxrt1011:"DTC_OVERLAY_FILE=nxp/dut_lpuart4_loopback.overlay"
      - platform:mimxrt1015_evk/mimxrt1015:"DTC_OVERLAY_FILE=nxp/dut_lpuart4_loopback.overlay"
      - platform:mimxrt1020_evk/mimxrt1021:"DTC_OVERLAY_FILE=nxp/dut_lpuart2_loopback.overlay"
      - platform:mimxrt1024_evk/mimxrt1024:"DTC_OVERLAY_FILE=nxp/dut_lpuart2_loopback.overlay"
      - platform:mimxrt1160_evk/mimxrt1166/cm7:"DTC_OVERLAY_FILE=nxp/dut_lpuart2_loopback.overlay"
      - platform:mimxrt1170_evk@A/mimxrt1176/cm7:"DTC_OVERLAY_FILE=nxp/dut_lpuart2_loopback.overlay"
      - platform:mimxrt1170_evk@B/mimxrt1176/cm7:"DTC_OVERLAY_FILE=nxp/dut_lpuart2_loopback.overlay"
      - platform:vmu_rt1170/mimxrt1176/cm7:"DTC_OVERLAY_FILE=nxp/dut_lpuart4_loopback.overlay"
      - platform:mimxrt1180_evk/mimxrt1189/cm33:"DTC_OVERLAY_FILE=nxp/dut_lpuart3_loopback.overlay"
      - platform:mimxrt1050_evk/mimxrt1052/hyperflash:"DTC_OVERLAY_FILE=nxp/dut_lpuart3_loopback.overlay"
      - platform:mimxrt1060_evk/mimxrt1062/hyperflash:"DTC_OVERLAY_FILE=nxp/dut_lpuart3_loopback.overlay"
      - platform:mimxrt1060_evk@A/mimxrt1062/qspi:"DTC_OVERLAY_FILE=nxp/dut_lpuart3_loopback.overlay"
      - platform:mimxrt1060_evk@B/mimxrt1062/qspi:"DTC_OVERLAY_FILE=nxp/dut_lpuart3_loopback.overlay"
      - platform:mimxrt1060_evk@C/mimxrt1062/qspi:"DTC_OVERLAY_FILE=nxp/dut_lpuart3_loopback.overlay"
      - platform:mimxrt1064_evk/mimxrt1064:"DTC_OVERLAY_FILE=nxp/dut_lpuart3_loopback.overlay"
  drivers.uart.async_api.sam0:
    filter: CONFIG_SERIAL_SUPPORT_ASYNC and CONFIG_SOC_FAMILY_ATMEL_SAM0
    platform_allow:
      - samc21n_xpro
      - samd21_xpro
      - saml21_xpro
      - samr21_xpro
      - samr34_xpro
      - same54_xpro
    extra_configs:
      - CONFIG_UART_SAM0_ASYNC=y
      - CONFIG_DMA=y
    build_only: true
    integration_platforms:
      - samc21n_xpro
  drivers.uart.async_api.nocache_mem:
    # nocache memory region is defined by the linker
    filter: CONFIG_SERIAL_SUPPORT_ASYNC and CONFIG_CPU_HAS_DCACHE
    harness: ztest
    harness_config:
      fixture: gpio_loopback
    depends_on: gpio
    platform_allow:
      - nucleo_f746zg
      - nucleo_h723zg
    extra_args:
      - EXTRA_CONF_FILE=stm32_nocache_mem.conf
  drivers.uart.async_api.nocache_mem_dt.nucleo_f746zg:
    # nocache memory region is defined in DT
    harness: ztest
    harness_config:
      fixture: gpio_loopback
    depends_on: gpio
    platform_allow:
      - nucleo_f746zg
    extra_args:
      - DTC_OVERLAY_FILE="boards/nucleo_f746zg.overlay;boards/nucleo_f746zg_nocachemem.overlay"
      - EXTRA_CONF_FILE=stm32_nocache_mem_dt.conf
    extra_configs:
      - CONFIG_TEST_USERSPACE=n
  drivers.uart.async_api.nocache_mem_dt.nucleo_h723zg:
    # nocache memory region is defined in DT
    harness: ztest
    harness_config:
      fixture: gpio_loopback
    depends_on: gpio
    platform_allow:
      - nucleo_h723zg
    extra_args:
      - DTC_OVERLAY_FILE="boards/nucleo_h723zg.overlay;boards/nucleo_h723zg_nocachemem.overlay"
      - EXTRA_CONF_FILE=stm32_nocache_mem_dt.conf
```

## tests/drivers/uart/uart_async_dual/Kconfig
```kconfig
# Copyright (c) 2024 Nordic Semiconductor ASA
# SPDX-License-Identifier: Apache-2.0

config UART_ASYNC_DUAL_TEST_TIMEOUT
	int "Single test case length (in milliseconds)"
	# For the simulated devices, which are run by default in CI, we set it to less to not spend too
	# much CI time
	default 500 if SOC_SERIES_BSIM_NRFXX
	default 3000
	help
	  For how many loops will the stress test run. The higher this number the longer the
	  test and therefore the higher likelihood an unlikely race/event will be triggered.

config PM_RUNTIME_IN_TEST
	bool "Use runtime PM in the test"
	select PM_DEVICE
	select PM_DEVICE_RUNTIME

config TEST_CHOPPED_TX
	bool "Test chopped TX data"
	default y
	help
	  When enabled then test cases that transmits TX packets in random chunks are
	  performed. Some driver implementation do not support case when new TX data
	  collides with handling of the RX timeout.

# Include Zephyr's Kconfig
source "Kconfig"
```

## tests/drivers/uart/uart_async_dual/testcase.yaml
```yaml
common:
  tags:
    - drivers
    - uart
  timeout: 120
tests:
  drivers.uart.async_dual:
    harness: ztest
    harness_config:
      fixture: uart_loopback
    depends_on: gpio
    platform_allow:
      - nrf54l15dk/nrf54l15/cpuapp
      - nrf54h20dk/nrf54h20/cpurad
      - nrf54h20dk/nrf54h20/cpuppr
      - nrf9160dk/nrf9160
      - nrf52_bsim
  drivers.uart.async_dual.busy_sim:
    harness: ztest
    harness_config:
      fixture: uart_loopback
    depends_on: gpio
    platform_allow:
      - nrf54l15dk/nrf54l15/cpuapp
      - nrf54h20dk/nrf54h20/cpurad
      - nrf54h20dk/nrf54h20/cpuppr
      - nrf9160dk/nrf9160
      - nrf52_bsim
    extra_configs:
      - CONFIG_TEST_BUSY_SIM=y
  drivers.uart.async_dual.pm_runtime:
    harness: ztest
    harness_config:
      fixture: uart_loopback
    depends_on: gpio
    platform_allow:
      - nrf54l15dk/nrf54l15/cpuapp
      - nrf54h20dk/nrf54h20/cpuapp
      - nrf54h20dk/nrf54h20/cpurad
      - nrf54h20dk/nrf54h20/cpuppr
      - nrf9160dk/nrf9160
      - nrf52_bsim
    extra_configs:
      - CONFIG_PM_DEVICE_RUNTIME=y
      - CONFIG_PM_DEVICE=y
  drivers.uart.async_dual.pm_runtime.busy_sim:
    harness: ztest
    harness_config:
      fixture: uart_loopback
    depends_on: gpio
    platform_allow:
      - nrf54l15dk/nrf54l15/cpuapp
      - nrf54h20dk/nrf54h20/cpuapp
      - nrf54h20dk/nrf54h20/cpurad
      - nrf54h20dk/nrf54h20/cpuppr
      - nrf9160dk/nrf9160
      - nrf52_bsim
    extra_configs:
      - CONFIG_PM_DEVICE_RUNTIME=y
      - CONFIG_PM_DEVICE=y
      - CONFIG_TEST_BUSY_SIM=y
  drivers.uart.async_dual.pm_runtime.explicit:
    harness: ztest
    harness_config:
      fixture: uart_loopback
    depends_on: gpio
    platform_allow:
      - nrf54l15dk/nrf54l15/cpuapp
      - nrf54h20dk/nrf54h20/cpuapp
      - nrf54h20dk/nrf54h20/cpurad
      - nrf54h20dk/nrf54h20/cpuppr
      - nrf9160dk/nrf9160
      - nrf52_bsim
    extra_configs:
      - CONFIG_PM_RUNTIME_IN_TEST=y
  drivers.uart.async_dual.no_tx_chopped:
    harness: ztest
    harness_config:
      fixture: uart_loopback
    depends_on: gpio
    platform_allow:
      - nrf54l15dk/nrf54l15/cpuapp
      - nrf54h20dk/nrf54h20/cpuapp
      - nrf54h20dk/nrf54h20/cpurad
      - nrf54h20dk/nrf54h20/cpuppr
      - nrf9160dk/nrf9160
      - nrf52_bsim
    extra_configs:
      - CONFIG_TEST_CHOPPED_TX=n
      - CONFIG_UARTE_NRFX_UARTE_COUNT_BYTES_WITH_TIMER=n
```

## tests/drivers/uart/uart_async_rx/testcase.yaml
```yaml
tests:
  drivers.uart.async_rx:
    filter: CONFIG_SERIAL_HAS_DRIVER
    tags: drivers uart
    integration_platforms:
      - native_sim
  drivers.uart.async_rx.ztress:
    tags: drivers uart
    platform_allow:
      - qemu_cortex_m3
      - qemu_x86
      - qemu_x86_64
      - qemu_riscv32
    integration_platforms:
      - qemu_x86
    extra_configs:
      - CONFIG_SYS_CLOCK_TICKS_PER_SEC=10000
```

## tests/drivers/uart/uart_async_slip/testcase.yaml
```yaml
common:
  tags:
    - drivers
    - uart
  depends_on: dma
  harness: ztest
  platform_allow:
    - esp32s3_devkitc/esp32s3/procpu
    - esp32c6_devkitc/esp32c6/hpcore
  integration_platforms:
    - esp32s3_devkitc/esp32s3/procpu
tests:
  drivers.uart.async_slip.tx:
    extra_args:
      - EXTRA_DTC_OVERLAY_FILE=slip_tx.overlay
  drivers.uart.async_slip.rx:
    extra_args:
      - EXTRA_DTC_OVERLAY_FILE=slip_rx.overlay
```
