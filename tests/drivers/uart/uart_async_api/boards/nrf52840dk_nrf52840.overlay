/* SPDX-License-Identifier: Apache-2.0 */

/ {
	chosen {
		zephyr,console = &uart1;
	};
};

&uart1 {
	current-speed = <115200>;
	status = "okay";
	tx-pin = <6>;
	rx-pin = <8>;
	rts-pin = <0>;
	cts-pin = <0>;
};

&uart0 {
	compatible = "nordic,nrf-uart";
	current-speed = <115200>;
	status = "okay";
	tx-pin = <33>;
	rx-pin = <34>;
	rts-pin = <5>;
	cts-pin = <7>;
};
