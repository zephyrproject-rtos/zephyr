/*
 * Copyright (c) 2026 Mario Paja
 *
 * SPDX-License-Identifier: Apache-2.0
 */

/* USART2 on PD5 (TX) and PD6 (RX): connect PD5 to PD6 */
dut: &usart2 {
	dmas = <&dmamux1 2 44 STM32_DMA_PERIPH_TX>,
	       <&dmamux1 3 43 STM32_DMA_PERIPH_RX>;
	dma-names = "tx", "rx";
	pinctrl-0 = <&usart2_tx_pd5 &usart2_rx_pd6>;
	pinctrl-names = "default";
	current-speed = <115200>;
	status = "okay";
};

&dma1 {
	status = "okay";
};

&dma2 {
	status = "okay";
};

&dmamux1 {
	status = "okay";
};
