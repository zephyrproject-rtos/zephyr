/*
 * Copyright (c) 2025 STMicroelectronics
 *
 * SPDX-License-Identifier: Apache-2.0
 */

dut: &lpuart1 {
	dmas = <&gpdma1 0 35 STM32_DMA_PERIPH_TX>,
	       <&gpdma1 1 34 STM32_DMA_PERIPH_RX>;
	dma-names = "tx", "rx";
};

&gpdma1 {
	status = "okay";
};
