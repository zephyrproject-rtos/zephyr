/* SPDX-License-Identifier: Apache-2.0 */

#include <zephyr/dt-bindings/dma/infineon-xmc4xxx-dma.h>

dut: &usic2ch0 {
	compatible = "infineon,xmc4xxx-uart";
	current-speed = <921600>;
	pinctrl-0 = <&uart_tx_p5_0_u2c0 &uart_rx_p5_1_u2c0>;
	pinctrl-names = "default";
	input-src = "DX0G";
	interrupts = <96 1 97 1>;
	interrupt-names = "tx", "rx";
	dmas = <&dma1 1 0 XMC4XXX_SET_CONFIG(10, 6)>, <&dma1 2 0 XMC4XXX_SET_CONFIG(11, 6)>;
	dma-names = "tx", "rx";
	fifo-start-offset = <0>;
	fifo-tx-size = <0>;
	fifo-rx-size = <0>;
	status = "okay";
};

&uart_tx_p5_0_u2c0 {
	drive-strength = "strong-soft-edge";
	drive-push-pull;
	hwctrl = "disabled";
};

&uart_rx_p5_1_u2c0 {
	drive-strength = "strong-soft-edge";
	hwctrl = "disabled";
};

&dma1 {
	status = "okay";
};
