/*
 * Copyright (c) 2024 Analog Devices, Inc.
 *
 * SPDX-License-Identifier: Apache-2.0
 */

dut: &uart0 {
	status = "okay";
	pinctrl-0 = <&uart0_tx_p0_9 &uart0_rx_p0_10>;
	pinctrl-names = "default";

	dmas = <&dma0 1 MAX32_DMA_SLOT_UART0_TX>, <&dma0 2 MAX32_DMA_SLOT_UART0_RX>;
	dma-names = "tx", "rx";

	current-speed = <115200>;
	data-bits = <8>;
	parity = "none";
};
