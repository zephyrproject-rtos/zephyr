/*
 * Copyright (c) 2026 Analog Devices, Inc.
 *
 * SPDX-License-Identifier: Apache-2.0
 */

dut: &uart2 {
	status = "okay";
	pinctrl-0 = <&uart2_tx_p1_10 &uart2_rx_p1_9>;
	pinctrl-names = "default";

	dmas = <&dma0 4 MAX32_DMA_SLOT_UART2_TX>, <&dma0 5 MAX32_DMA_SLOT_UART2_RX>;
	dma-names = "tx", "rx";

	current-speed = <115200>;
	data-bits = <8>;
	parity = "none";
};
