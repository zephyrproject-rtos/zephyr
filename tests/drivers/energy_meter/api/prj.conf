## CMakeLists.txt
```
# Copyright (c) 2025 Pedro Ramos
# SPDX-License-Identifier: Apache-2.0

cmake_minimum_required(VERSION 3.28.0)
find_package(Zephyr REQUIRED HINTS $ENV{ZEPHYR_BASE})
project(energy_meter_api)

target_sources(app PRIVATE src/fake_meter.c src/test_api.c)
```

## prj.conf
```kconfig
CONFIG_ZTEST=y
CONFIG_ENERGY_METER=y
```

## src/fake_meter.c
```c
/*
 * Copyright (c) 2025 Pedro Ramos
 *
 * SPDX-License-Identifier: Apache-2.0
 */

#include <zephyr/device.h>
#include <zephyr/drivers/energy_meter.h>

#include "fake_meter.h"

#define PHASE_QUANTITIES                                                                           \
	(BIT(ENERGY_METER_VOLTAGE) | BIT(ENERGY_METER_CURRENT) | BIT(ENERGY_METER_ACTIVE_POWER) |  \
	 BIT(ENERGY_METER_POWER_FACTOR))

#define TOTAL_QUANTITIES                                                                           \
	(BIT(ENERGY_METER_ACTIVE_POWER) | BIT(ENERGY_METER_FREQUENCY) |                            \
	 BIT(ENERGY_METER_ACTIVE_ENERGY_IMPORT) | BIT(ENERGY_METER_ACTIVE_ENERGY_EXPORT))

static const uint32_t fake_quantities[ENERGY_METER_LINE_COUNT] = {
	[ENERGY_METER_LINE_A] = PHASE_QUANTITIES,
	[ENERGY_METER_LINE_B] = PHASE_QUANTITIES,
	[ENERGY_METER_LINE_C] = PHASE_QUANTITIES,
	[ENERGY_METER_LINE_N] = BIT(ENERGY_METER_CURRENT),
	[ENERGY_METER_LINE_TOTAL] = TOTAL_QUANTITIES,
};

static struct {
	int64_t energy;
	energy_meter_event_cb_t cb;
	void *user_data;
} fake_state;

int64_t fake_meter_value(uint8_t quantity, uint8_t line)
{
	switch (quantity) {
	case ENERGY_METER_VOLTAGE:
		return 230000000LL + line * 1000000LL;
	case ENERGY_METER_CURRENT:
		return 5000000LL + line * 250000LL;
	case ENERGY_METER_ACTIVE_POWER:
		return (line == ENERGY_METER_LINE_TOTAL) ? 3450000000LL : -1150000000LL;
	case ENERGY_METER_POWER_FACTOR:
		return 985000;
	case ENERGY_METER_FREQUENCY:
		return 50010000;
	case ENERGY_METER_ACTIVE_ENERGY_IMPORT:
	case ENERGY_METER_ACTIVE_ENERGY_EXPORT:
		return fake_state.energy;
	case FAKE_METER_STATUS:
		return FAKE_METER_STATUS_VALUE;
	default:
		return 0;
	}
}

void fake_meter_add_energy(int64_t uwh)
{
	fake_state.energy += uwh;
}

void fake_meter_raise(uint8_t type, uint8_t index)
{
	const struct energy_meter_event event = {.type = type, .index = index};

	if (fake_state.cb != NULL) {
		fake_state.cb(fake_meter, &event, fake_state.user_data);
	}
}

static bool fake_supported(const struct energy_meter_channel *channel)
{
	if (channel->line >= ENERGY_METER_LINE_COUNT) {
		return false;
	}

	if (channel->quantity == FAKE_METER_STATUS) {
		return channel->line == ENERGY_METER_LINE_TOTAL;
	}

	return (channel->quantity < ENERGY_METER_QUANTITY_COMMON_COUNT) &&
	       ((fake_quantities[channel->line] & BIT(channel->quantity)) != 0U);
}

static int fake_get_info(const struct device *dev, struct energy_meter_info *info)
{
	ARG_UNUSED(dev);

	info->phases = 3;
	for (size_t i = 0; i < ENERGY_METER_LINE_COUNT; i++) {
		info->quantities[i] = fake_quantities[i];
	}

	return 0;
}

static int fake_get(const struct device *dev, const struct energy_meter_channel *channels,
		    int64_t *values, size_t count)
{
	ARG_UNUSED(dev);

	for (size_t i = 0; i < count; i++) {
		if (!fake_supported(&channels[i])) {
			return -ENOTSUP;
		}
	}

	for (size_t i = 0; i < count; i++) {
		values[i] = fake_meter_value(channels[i].quantity, channels[i].line);
	}

	return 0;
}

static int fake_reset_energy(const struct device *dev)
{
	ARG_UNUSED(dev);

	fake_state.energy = 0;

	return 0;
}

static int fake_set_event_callback(const struct device *dev, energy_meter_event_cb_t cb,
				   void *user_data)
{
	ARG_UNUSED(dev);

	fake_state.cb = cb;
	fake_state.user_data = user_data;

	return 0;
}

static DEVICE_API(energy_meter, fake_api) = {
	.get_info = fake_get_info,
	.get = fake_get,
	.reset_energy = fake_reset_energy,
	.set_event_callback = fake_set_event_callback,
};

static int fake_faulty_get_info(const struct device *dev, struct energy_meter_info *info)
{
	ARG_UNUSED(dev);
	ARG_UNUSED(info);

	return -EIO;
}

static int fake_faulty_get(const struct device *dev, const struct energy_meter_channel *channels,
			   int64_t *values, size_t count)
{
	ARG_UNUSED(dev);
	ARG_UNUSED(channels);
	ARG_UNUSED(values);
	ARG_UNUSED(count);

	return -EIO;
}

/* Fails every access without touching the output buffers */
static DEVICE_API(energy_meter, fake_faulty_api) = {
	.get_info = fake_faulty_get_info,
	.get = fake_faulty_get,
};

/* Implements only the mandatory operations */
static DEVICE_API(energy_meter, fake_minimal_api) = {
	.get_info = fake_get_info,
	.get = fake_get,
};

DEVICE_DEFINE(fake_meter, "fake_meter", NULL, NULL, NULL, NULL, POST_KERNEL,
	      CONFIG_ENERGY_METER_INIT_PRIORITY, &fake_api);

DEVICE_DEFINE(fake_meter_minimal, "fake_meter_minimal", NULL, NULL, NULL, NULL, POST_KERNEL,
	      CONFIG_ENERGY_METER_INIT_PRIORITY, &fake_minimal_api);

DEVICE_DEFINE(fake_meter_faulty, "fake_meter_faulty", NULL, NULL, NULL, NULL, POST_KERNEL,
	      CONFIG_ENERGY_METER_INIT_PRIORITY, &fake_faulty_api);

const struct device *const fake_meter = DEVICE_GET(fake_meter);
const struct device *const fake_meter_minimal = DEVICE_GET(fake_meter_minimal);
const struct device *const fake_meter_faulty = DEVICE_GET(fake_meter_faulty);
```

## src/fake_meter.h
```c
/*
 * Copyright (c) 2025 Pedro Ramos
 *
 * SPDX-License-Identifier: Apache-2.0
 */

#ifndef FAKE_METER_H_
#define FAKE_METER_H_

#include <zephyr/drivers/energy_meter.h>

/* A device-specific quantity of the fake meter: a raw status word on the total line */
#define FAKE_METER_STATUS (ENERGY_METER_QUANTITY_PRIV_START + 0)

#define FAKE_METER_STATUS_VALUE 0x1234

extern const struct device *const fake_meter;
extern const struct device *const fake_meter_minimal;
extern const struct device *const fake_meter_faulty;

/* Value the fake meter reports for a quantity on a line */
int64_t fake_meter_value(uint8_t quantity, uint8_t line);

/* Add energy to every energy quantity of the fake meter */
void fake_meter_add_energy(int64_t uwh);

/* Raise an event through the callback set on the fake meter */
void fake_meter_raise(uint8_t type, uint8_t index);

#endif /* FAKE_METER_H_ */
```

## src/test_api.c
```c
/*
 * Copyright (c) 2025 Pedro Ramos
 *
 * SPDX-License-Identifier: Apache-2.0
 */

#include <stddef.h>
#include <string.h>

#include <zephyr/drivers/energy_meter.h>
#include <zephyr/ztest.h>

#include "fake_meter.h"

ZTEST_USER(energy_meter_api, test_get_info)
{
	struct energy_meter_info info;

	zassert_ok(energy_meter_get_info(fake_meter, &info));
	zassert_equal(info.phases, 3);
	zassert_true((info.quantities[ENERGY_METER_LINE_B] & BIT(ENERGY_METER_VOLTAGE)) != 0U);
	zassert_true((info.quantities[ENERGY_METER_LINE_N] & BIT(ENERGY_METER_VOLTAGE)) == 0U);
	zassert_true((info.quantities[ENERGY_METER_LINE_TOTAL] & BIT(ENERGY_METER_FREQUENCY)) !=
		     0U);
}

ZTEST_USER(energy_meter_api, test_get_info_failure_keeps_buffer)
{
	struct energy_meter_info info;
	uint8_t expected[sizeof(info)];

	memset(&info, 0xa5, sizeof(info));
	memset(expected, 0xa5, sizeof(expected));

	zassert_equal(energy_meter_get_info(fake_meter_faulty, &info), -EIO);
	zassert_mem_equal(&info, expected, sizeof(info), "buffer changed by a failed call");
}

ZTEST_USER(energy_meter_api, test_get_info_padding_cleared)
{
	struct energy_meter_info info;
	const uint8_t *bytes = (const uint8_t *)&info;

	/* Only the syscall handler clears the padding; drivers fill the fields */
	Z_TEST_SKIP_IFNDEF(CONFIG_USERSPACE);

	memset(&info, 0xa5, sizeof(info));

	zassert_ok(energy_meter_get_info(fake_meter, &info));

	for (size_t i = sizeof(info.phases); i < offsetof(struct energy_meter_info, quantities);
	     i++) {
		zassert_equal(bytes[i], 0, "padding byte %zu not cleared", i);
	}
}

ZTEST_USER(energy_meter_api, test_get_batch)
{
	static const struct energy_meter_channel channels[] = {
		{ENERGY_METER_VOLTAGE, ENERGY_METER_LINE_A},
		{ENERGY_METER_VOLTAGE, ENERGY_METER_LINE_C},
		{ENERGY_METER_CURRENT, ENERGY_METER_LINE_N},
		{ENERGY_METER_ACTIVE_POWER, ENERGY_METER_LINE_TOTAL},
		{ENERGY_METER_FREQUENCY, ENERGY_METER_LINE_TOTAL},
	};
	int64_t values[ARRAY_SIZE(channels)];

	zassert_ok(energy_meter_get(fake_meter, channels, values, ARRAY_SIZE(channels)));

	for (size_t i = 0; i < ARRAY_SIZE(channels); i++) {
		zassert_equal(values[i], fake_meter_value(channels[i].quantity, channels[i].line),
			      "channel %zu", i);
	}
}

/* More channels than the syscall handler passes to the driver at once */
ZTEST_USER(energy_meter_api, test_get_large_batch)
{
	struct energy_meter_channel channels[2 * ENERGY_METER_QUANTITY_COMMON_COUNT + 3];
	int64_t values[ARRAY_SIZE(channels)];

	for (size_t i = 0; i < ARRAY_SIZE(channels); i++) {
		channels[i].quantity = ENERGY_METER_VOLTAGE;
		channels[i].line = i % 3;
	}

	zassert_ok(energy_meter_get(fake_meter, channels, values, ARRAY_SIZE(channels)));

	for (size_t i = 0; i < ARRAY_SIZE(channels); i++) {
		zassert_equal(values[i], fake_meter_value(ENERGY_METER_VOLTAGE, i % 3),
			      "channel %zu", i);
	}

	/* An unsupported channel in a later group still fails the call */
	channels[ARRAY_SIZE(channels) - 1].line = ENERGY_METER_LINE_N;
	zassert_equal(energy_meter_get(fake_meter, channels, values, ARRAY_SIZE(channels)),
		      -ENOTSUP);
}

ZTEST_USER(energy_meter_api, test_get_one_and_device_specific_quantity)
{
	int64_t value;

	zassert_ok(energy_meter_get_one(fake_meter, ENERGY_METER_ACTIVE_POWER, ENERGY_METER_LINE_B,
					&value));
	zassert_equal(value, -1150000000LL, "negative power must survive the API");

	zassert_ok(energy_meter_get_one(fake_meter, FAKE_METER_STATUS, ENERGY_METER_LINE_TOTAL,
					&value));
	zassert_equal(value, FAKE_METER_STATUS_VALUE);
}

ZTEST_USER(energy_meter_api, test_unsupported_channel)
{
	static const struct energy_meter_channel channels[] = {
		{ENERGY_METER_VOLTAGE, ENERGY_METER_LINE_A},
		{ENERGY_METER_VOLTAGE, ENERGY_METER_LINE_N},
	};
	int64_t values[ARRAY_SIZE(channels)];
	int64_t value;

	zassert_equal(energy_meter_get(fake_meter, channels, values, ARRAY_SIZE(channels)),
		      -ENOTSUP);
	zassert_equal(energy_meter_get_one(fake_meter, ENERGY_METER_TEMPERATURE,
					   ENERGY_METER_LINE_TOTAL, &value),
		      -ENOTSUP);
}

ZTEST_USER(energy_meter_api, test_reset_energy_syscall)
{
	int64_t value;

	zassert_ok(energy_meter_reset_energy(fake_meter));
	zassert_ok(energy_meter_get_one(fake_meter, ENERGY_METER_ACTIVE_ENERGY_IMPORT,
					ENERGY_METER_LINE_TOTAL, &value));
	zassert_equal(value, 0);

	zassert_equal(energy_meter_reset_energy(fake_meter_minimal), -ENOSYS);
}

/* Adding energy to the fake meter touches kernel memory, so this test runs in kernel mode */
ZTEST(energy_meter_api, test_reset_energy)
{
	int64_t value;

	fake_meter_add_energy(1500000);
	zassert_ok(energy_meter_get_one(fake_meter, ENERGY_METER_ACTIVE_ENERGY_IMPORT,
					ENERGY_METER_LINE_TOTAL, &value));
	zassert_true(value >= 1500000);

	zassert_ok(energy_meter_reset_energy(fake_meter));
	zassert_ok(energy_meter_get_one(fake_meter, ENERGY_METER_ACTIVE_ENERGY_IMPORT,
					ENERGY_METER_LINE_TOTAL, &value));
	zassert_equal(value, 0);
}

ZTEST(energy_meter_api, test_snapshot)
{
	struct energy_meter_snapshot snap;

	zassert_ok(energy_meter_get_snapshot(fake_meter, &snap));
	zassert_equal(snap.phases, 3);

	zassert_equal(snap.valid[ENERGY_METER_LINE_A],
		      BIT(ENERGY_METER_VOLTAGE) | BIT(ENERGY_METER_CURRENT) |
			      BIT(ENERGY_METER_ACTIVE_POWER) | BIT(ENERGY_METER_POWER_FACTOR));
	zassert_equal(snap.line[ENERGY_METER_LINE_B].voltage,
		      fake_meter_value(ENERGY_METER_VOLTAGE, ENERGY_METER_LINE_B));
	zassert_equal(snap.line[ENERGY_METER_LINE_C].power_factor, 985000);
	zassert_equal(snap.line[ENERGY_METER_LINE_N].current,
		      fake_meter_value(ENERGY_METER_CURRENT, ENERGY_METER_LINE_N));
	zassert_equal(snap.line[ENERGY_METER_LINE_TOTAL].active_power, 3450000000LL);
	zassert_equal(snap.line[ENERGY_METER_LINE_TOTAL].frequency, 50010000);

	/* Unsupported fields are zero and flagged invalid */
	zassert_equal(snap.line[ENERGY_METER_LINE_N].voltage, 0);
	zassert_equal(snap.valid[ENERGY_METER_LINE_N] & BIT(ENERGY_METER_VOLTAGE), 0);
	zassert_equal(snap.line[ENERGY_METER_LINE_TOTAL].temperature, 0);

	/* Named fields and the quantity index agree */
	zassert_equal(energy_meter_line_value(&snap.line[ENERGY_METER_LINE_TOTAL],
					      ENERGY_METER_FREQUENCY),
		      snap.line[ENERGY_METER_LINE_TOTAL].frequency);
}

struct event_record {
	const struct device *dev;
	struct energy_meter_event event;
	int calls;
};

static void event_cb(const struct device *dev, const struct energy_meter_event *event,
		     void *user_data)
{
	struct event_record *rec = user_data;

	rec->dev = dev;
	rec->event = *event;
	rec->calls++;
}

ZTEST(energy_meter_api, test_event_callback)
{
	struct event_record rec = {0};

	zassert_ok(energy_meter_set_event_callback(fake_meter, event_cb, &rec));
	fake_meter_raise(ENERGY_METER_EVENT_PULSE, 2);
	zassert_equal(rec.calls, 1);
	zassert_equal_ptr(rec.dev, fake_meter);
	zassert_equal(rec.event.type, ENERGY_METER_EVENT_PULSE);
	zassert_equal(rec.event.index, 2);

	zassert_ok(energy_meter_set_event_callback(fake_meter, NULL, NULL));
	fake_meter_raise(ENERGY_METER_EVENT_ALARM, 0);
	zassert_equal(rec.calls, 1);

	zassert_equal(energy_meter_set_event_callback(fake_meter_minimal, event_cb, &rec), -ENOSYS);
}

static void *energy_meter_api_setup(void)
{
	zassert_true(device_is_ready(fake_meter));

#ifdef CONFIG_USERSPACE
	k_object_access_all_grant(fake_meter);
	k_object_access_all_grant(fake_meter_minimal);
	k_object_access_all_grant(fake_meter_faulty);
#endif

	return NULL;
}

ZTEST_SUITE(energy_meter_api, NULL, energy_meter_api_setup, NULL, NULL, NULL);
```

## src/test_shell.c
```c
/*
 * Copyright (c) 2025 Pedro Ramos
 *
 * SPDX-License-Identifier: Apache-2.0
 */

#include <string.h>

#include <zephyr/shell/shell.h>
#include <zephyr/shell/shell_dummy.h>
#include <zephyr/ztest.h>

#include "fake_meter.h"

static const char *run(const char *cmd, int expected)
{
	const struct shell *sh = shell_backend_dummy_get_ptr();
	size_t size;

	shell_backend_dummy_clear_output(sh);
	zassert_equal(shell_execute_cmd(sh, cmd), expected, "%s", cmd);

	return shell_backend_dummy_get_output(sh, &size);
}

static void assert_contains(const char *out, const char *text)
{
	zassert_not_null(strstr(out, text), "\"%s\" not found in:\n%s", text, out);
}

ZTEST(energy_meter_shell, test_info)
{
	const char *out = run("energy_meter info fake_meter", 0);

	assert_contains(out, "phases: 3");
	assert_contains(out, "voltage current active_power power_factor");
	assert_contains(out, "frequency");
}

ZTEST(energy_meter_shell, test_get_prints_table)
{
	const char *out = run("energy_meter get fake_meter", 0);

	/* Header, per-phase values, unsupported cells and negative values */
	assert_contains(out, "total");
	assert_contains(out, "voltage [V]");
	assert_contains(out, "231.000");
	assert_contains(out, "-1150.000");
	assert_contains(out, "50.010");
	assert_contains(out, "-");
}

ZTEST(energy_meter_shell, test_watch)
{
	const char *out = run("energy_meter watch fake_meter 1 2", 0);
	const char *second = strstr(out, "frequency");

	zassert_not_null(second);
	zassert_not_null(strstr(second + 1, "frequency"), "expected two tables");

	run("energy_meter watch fake_meter 0", -EINVAL);
	run("energy_meter watch fake_meter 2147483648", -EINVAL);
}

ZTEST(energy_meter_shell, test_get_failure)
{
	assert_contains(run("energy_meter get fake_meter_faulty", -EIO), "Failed to read");
}

ZTEST(energy_meter_shell, test_read)
{
	assert_contains(run("energy_meter read fake_meter voltage b", 0), "231.000 V");
	assert_contains(run("energy_meter read fake_meter frequency", 0), "50.010 Hz");
	assert_contains(run("energy_meter read fake_meter 16", 0), "4660 (0x1234)");

	run("energy_meter read fake_meter voltage x", -EINVAL);
	run("energy_meter read fake_meter bogus", -EINVAL);
	run("energy_meter read fake_meter temperature", -ENOTSUP);
}

ZTEST(energy_meter_shell, test_reset_energy)
{
	fake_meter_add_energy(2000000);
	run("energy_meter reset_energy fake_meter", 0);
	assert_contains(run("energy_meter read fake_meter active_energy_import", 0), "0.000 Wh");

	run("energy_meter reset_energy fake_meter_minimal", -ENOSYS);
}

ZTEST(energy_meter_shell, test_rejects_other_devices)
{
	run("energy_meter get nonexistent", -ENODEV);
}

static void *energy_meter_shell_setup(void)
{
	const struct shell *sh = shell_backend_dummy_get_ptr();

	WAIT_FOR(shell_ready(sh), 20000, k_msleep(1));
	zassert_true(shell_ready(sh), "dummy shell backend not ready");

	return NULL;
}

ZTEST_SUITE(energy_meter_shell, NULL, energy_meter_shell_setup, NULL, NULL, NULL);
```
