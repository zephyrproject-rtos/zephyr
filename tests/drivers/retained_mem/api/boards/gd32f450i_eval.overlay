/*
 * Copyright (c) 2026 Aleksandr Senin <al@meshium.net>
 *
 * SPDX-License-Identifier: Apache-2.0
 */

/ {
	aliases {
		retainedmemtestdevice = &backup_sram;
	};
};

&backup_sram {
	vin-supply = <&bldo>;
	status = "okay";
};

&bldo {
	regulator-boot-on;
	status = "okay";
};
