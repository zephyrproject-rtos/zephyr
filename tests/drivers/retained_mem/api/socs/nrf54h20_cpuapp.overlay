/ {
	cpuapp_ram0_ret@22004000 {
		compatible = "zephyr,memory-region", "mmio-sram";
		reg = <0x22004000 DT_SIZE_K(16)>;
		ranges = <0x0 0x22004000 DT_SIZE_K(16)>;
		#address-cells = <1>;
		#size-cells = <1>;
		zephyr,memory-region = "RetainedMem";
		status = "okay";

		retainedmem0: retainedmem {
			compatible = "zephyr,retained-ram";
			ranges;
			#address-cells = <1>;
			#size-cells = <1>;
			status = "okay";
		};
	};

	aliases {
		retainedmemtestdevice = &retainedmem0;
	};
};
