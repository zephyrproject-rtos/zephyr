/ {
	cpurad_ram0_ret@2302c000 {
		compatible = "zephyr,memory-region", "mmio-sram";
		reg = <0x2302c000 DT_SIZE_K(16)>;
		ranges = <0x0 0x2302c000 DT_SIZE_K(16)>;
		zephyr,memory-region = "RetainedMem";
		status = "okay";
		#address-cells = <1>;
		#size-cells = <1>;

		retainedmem0: retainedmem {
			compatible = "zephyr,retained-ram";
			status = "okay";
			ranges;
			#address-cells = <1>;
			#size-cells = <1>;
		};
	};

	aliases {
		retainedmemtestdevice = &retainedmem0;
	};
};
