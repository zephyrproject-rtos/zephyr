/*
 * Copyright (c) 2024 Meta Platforms
 *
 * SPDX-License-Identifier: Apache-2.0
 */

/ {
	soc {
		plic: interrupt-controller@c000000 {
			riscv,max-priority = <7>;
			riscv,ndev = <1024>;
			reg = <0x0c000000 0x04000000>;
			interrupts-extended = <&hlic0 0x0b
					       &hlic1 0x0b &hlic1 0x09
					       &hlic2 0x0b &hlic2 0x09
					       &hlic3 0x0b &hlic3 0x09
					       &hlic4 0x0b &hlic4 0x09
					       &hlic5 0x0b &hlic5 0x09
					       &hlic6 0x0b &hlic6 0x09
					       &hlic7 0x0b &hlic7 0x09>;
			interrupt-controller;
			compatible = "sifive,plic-1.0.0";
			#address-cells = <0x00>;
			#interrupt-cells = <0x02>;
		};
	};
};
