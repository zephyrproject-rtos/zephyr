## CMakeLists.txt
```
# Copyright 2026 Google LLC
# SPDX-License-Identifier: Apache-2.0

cmake_minimum_required(VERSION 3.20.0)
find_package(Zephyr REQUIRED HINTS $ENV{ZEPHYR_BASE})
project(intc_ite_it8xxx2)

target_include_directories(app PRIVATE
	include
)

zephyr_include_directories(
	include
	${ZEPHYR_BASE}/soc/ite/ec/common
	${ZEPHYR_BASE}/soc/ite/ec/it8xxx2
)

target_sources(app PRIVATE
	src/main.c
)

if(CONFIG_TEST_IT8XXX2_INTC_V1)
	zephyr_compile_definitions(CONFIG_SOC_IT8XXX2_REG_SET_V1=1)
	target_sources(app PRIVATE
		${ZEPHYR_BASE}/drivers/interrupt_controller/intc_ite_it8xxx2.c
	)
elseif(CONFIG_TEST_IT8XXX2_INTC_V2)
	zephyr_compile_definitions(CONFIG_SOC_IT8XXX2_REG_SET_V2=1)
	target_sources(app PRIVATE
		${ZEPHYR_BASE}/drivers/interrupt_controller/intc_ite_it8xxx2_v2.c
	)
endif()
```

## Kconfig
```
# Copyright 2026 Google LLC
# SPDX-License-Identifier: Apache-2.0

source "Kconfig.zephyr"

config NUM_IRQS
	int
	default 186

config HAS_ITE_INTC
	bool
	default y

config TEST_IT8XXX2_INTC_V1
	bool "Test IT8XXX2 V1 interrupt controller"
	help
	  Select the IT8XXX2 V1 interrupt controller driver for unit testing.

config TEST_IT8XXX2_INTC_V2
	bool "Test IT8XXX2 V2 interrupt controller"
	help
	  Select the IT8XXX2 V2 interrupt controller driver for unit testing.
```

## prj.conf
```kconfig
# Copyright 2026 Google LLC
# SPDX-License-Identifier: Apache-2.0

CONFIG_ZTEST=y
CONFIG_ASSERT=y
```

## boards/native_sim.overlay
```dts
/*
 * Copyright 2026 Google LLC
 *
 * SPDX-License-Identifier: Apache-2.0
 */

/ {
	intc: interrupt-controller@f03f00 {
		compatible = "vnd,intc";
		#address-cells = <0>;
		#interrupt-cells = <2>;
		interrupt-controller;
		reg = <0x00f03f00 0x0100>;
	};
};
```

## src/main.c
```c
/*
 * Copyright 2026 Google LLC
 *
 * SPDX-License-Identifier: Apache-2.0
 */

#include <string.h>

#include <zephyr/dt-bindings/interrupt-controller/ite-intc.h>
#include <zephyr/ztest.h>

#include <soc.h>

volatile uint8_t fake_intc_regs[0x100];
struct wdt_it8xxx2_regs fake_wdt_regs;
struct gctrl_it8xxx2_regs fake_gctrl_regs;
volatile uint8_t fake_smb_slviselr;

static void it8xxx2_intc_before(void *fixture)
{
	ARG_UNUSED(fixture);

	memset((void *)fake_intc_regs, 0, sizeof(fake_intc_regs));
	memset(&fake_wdt_regs, 0, sizeof(fake_wdt_regs));
	memset(&fake_gctrl_regs, 0, sizeof(fake_gctrl_regs));
	fake_smb_slviselr = 0;
	soc_interrupt_init();
}

ZTEST_SUITE(it8xxx2_intc, NULL, NULL, it8xxx2_intc_before, NULL, NULL);

ZTEST(it8xxx2_intc, test_max_valid_irq_185)
{
	const unsigned int max_valid_irq = CONFIG_NUM_IRQS - 1;

	zassert_equal(CONFIG_NUM_IRQS, 186);
	zassert_equal(ite_intc_irq_is_enable(max_valid_irq), 0);

	ite_intc_irq_enable(max_valid_irq);
	zassert_not_equal(ite_intc_irq_is_enable(max_valid_irq), 0);

	ite_intc_irq_disable(max_valid_irq);
	zassert_equal(ite_intc_irq_is_enable(max_valid_irq), 0);
}

ZTEST(it8xxx2_intc, test_oob_irq_bounds_rejected)
{
	const unsigned int oob_irq = CONFIG_NUM_IRQS;
	uint8_t zero_regs[sizeof(fake_intc_regs)] = { 0 };

	/*
	 * Verify that irq == CONFIG_NUM_IRQS and irq > CONFIG_NUM_IRQS are
	 * rejected by all INTC operations without mutating any hardware
	 * register.
	 */
	ite_intc_irq_enable(oob_irq);
	ite_intc_irq_polarity_set(oob_irq, IRQ_TYPE_EDGE_FALLING);
	ite_intc_isr_clear(oob_irq);
	zassert_equal(ite_intc_irq_is_enable(oob_irq), 0);
	zassert_mem_equal((const void *)fake_intc_regs, zero_regs,
			  sizeof(fake_intc_regs));

	ite_intc_irq_enable(oob_irq + 1);
	ite_intc_irq_polarity_set(oob_irq + 1, IRQ_TYPE_LEVEL_HIGH);
	ite_intc_isr_clear(oob_irq + 1);
	zassert_equal(ite_intc_irq_is_enable(oob_irq + 1), 0);
	zassert_mem_equal((const void *)fake_intc_regs, zero_regs,
			  sizeof(fake_intc_regs));

	/*
	 * Pre-fill registers with 0xFF and verify out-of-bounds disable and
	 * is_enable still reject irq == CONFIG_NUM_IRQS without touching
	 * registers or returning enabled.
	 */
	memset((void *)fake_intc_regs, 0xFF, sizeof(fake_intc_regs));
	zassert_equal(ite_intc_irq_is_enable(oob_irq), 0);
	ite_intc_irq_disable(oob_irq);
	for (size_t i = 0; i < sizeof(fake_intc_regs); i++) {
		zassert_equal(fake_intc_regs[i], 0xFF,
			      "reg[0x%zx] modified on OOB disable", i);
	}
}
```

## include/chip_chipregs.h
```c
/*
 * Copyright 2026 Google LLC
 *
 * SPDX-License-Identifier: Apache-2.0
 */

#ifndef ZEPHYR_TESTS_DRIVERS_INTC_ITE_IT8XXX2_CHIP_CHIPREGS_H_
#define ZEPHYR_TESTS_DRIVERS_INTC_ITE_IT8XXX2_CHIP_CHIPREGS_H_

#include <../soc/ite/ec/it8xxx2/chip_chipregs.h>
#include <soc_common.h>

extern volatile uint8_t fake_intc_regs[0x100];
extern struct wdt_it8xxx2_regs fake_wdt_regs;
extern struct gctrl_it8xxx2_regs fake_gctrl_regs;
extern volatile uint8_t fake_smb_slviselr;

void soc_interrupt_init(void);

#undef ECREG
#define ECREG(x) (fake_intc_regs[(uintptr_t)(x) - (EC_REG_BASE_ADDR + 0x3F00)])

#undef WDT_IT8XXX2_REGS_BASE
#define WDT_IT8XXX2_REGS_BASE (&fake_wdt_regs)

#undef GCTRL_IT8XXX2_REGS_BASE
#define GCTRL_IT8XXX2_REGS_BASE (&fake_gctrl_regs)

#undef IT8XXX2_SMB_SLVISELR
#define IT8XXX2_SMB_SLVISELR (fake_smb_slviselr)

#endif /* ZEPHYR_TESTS_DRIVERS_INTC_ITE_IT8XXX2_CHIP_CHIPREGS_H_ */
```
