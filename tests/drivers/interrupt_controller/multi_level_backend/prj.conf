## CMakeLists.txt
```
# Copyright (c) 2024 Meta
# SPDX-License-Identifier: Apache-2.0

cmake_minimum_required(VERSION 3.28.0)
find_package(Zephyr REQUIRED HINTS $ENV{ZEPHYR_BASE})
project(intc_multi_level_backend)

# required for "sw_isr_common.h"
zephyr_library_include_directories(${ZEPHYR_BASE}/arch/common/include)

FILE(GLOB app_sources src/*.c)
target_sources(app PRIVATE ${app_sources})
```

## Kconfig
```
# Copyright (c) 2024 Meta
# SPDX-License-Identifier: Apache-2.0

if RISCV

config NUM_IRQS
	int
	# let's pretend that the level 1 supports 64 lines
	# (MAX_IRQ_PER_2ND_LEVEL_AGGREGATOR x NUM_2ND_LEVEL_AGGREGATORS) +
	# (MAX_IRQ_PER_3RD_LEVEL_AGGREGATOR x NUM_3RD_LEVEL_AGGREGATORS) + 64
	# (64 x 2) + (32 x 2) + 64 = 256, rounded up to 320
	default 320

endif # RISCV

config DUMP_INTC_TABLE
	bool "Enable to dump the content of intc table"

config TEST_ISR_TABLE_PLACEMENT
	bool "Build the tests in isr_table_placement.c"
	help
	  Check the slot gen_isr_tables.py places a statically connected handler
	  in against the slot z_get_sw_isr_table_idx() resolves it to at runtime.
	  Needs the aggregator offsets that the scenario enabling this sets, so
	  it is off by default.

source "Kconfig.zephyr"
```

## prj.conf
```kconfig
# Copyright (c) 2024 Meta
# SPDX-License-Identifier: Apache-2.0

CONFIG_ZTEST=y
CONFIG_MAX_IRQ_PER_AGGREGATOR=64
CONFIG_2ND_LEVEL_INTERRUPT_BITS=9
CONFIG_NUM_2ND_LEVEL_AGGREGATORS=2
CONFIG_3RD_LEVEL_INTERRUPTS=y
CONFIG_NUM_3RD_LEVEL_AGGREGATORS=2
# Exercise the per-level aggregator sizes: L3 windows are half the L2 ones
CONFIG_MAX_IRQ_PER_2ND_LEVEL_AGGREGATOR=64
CONFIG_MAX_IRQ_PER_3RD_LEVEL_AGGREGATOR=32

# Uncomment the following to dump the contents of intc_table
# CONFIG_DUMP_INTC_TABLE=y
```

## src/main.c
```c
/*
 * Copyright (c) 2024 Meta
 *
 * SPDX-License-Identifier: Apache-2.0
 */

#include "sw_isr_common.h"

#include <stdint.h>

#include <zephyr/irq_multilevel.h>
#include <zephyr/sys/iterable_sections.h>
#include <zephyr/ztest.h>

#ifdef CONFIG_DUMP_INTC_TABLE
#define DEBUG_PRINT(...) PRINT(__VA_ARGS__)
#else
#define DEBUG_PRINT(...)
#endif

/**
 * Fake device pointers
 */
/* Device pointer to level 2 intc 1 */
#define INTC_1_DEV UINT_TO_POINTER(21)
/* Device pointer to level 2 intc 2 */
#define INTC_2_DEV UINT_TO_POINTER(22)
/* Device pointer to level 3 intc 3*/
#define INTC_3_DEV UINT_TO_POINTER(31)
/* Device pointer to level 3 intc 4 */
#define INTC_4_DEV UINT_TO_POINTER(32)

/**
 * Interrupt controller's local IRQ
 */
/* Local IRQ of level 2 intc 1 */
#define INTC_1_IRQ 4
/* Local IRQ of level 2 intc 2 */
#define INTC_2_IRQ 5
/* Local IRQ of level 3 intc 3 */
#define INTC_3_IRQ 9
/* Local IRQ of level 3 intc 4 */
#define INTC_4_IRQ 10

/**
 * Interrupt controller's IRQ in Zephyr format
 */
/* Zephyr IRQ of level 2 intc 1 */
#define INTC_1_IRQN INTC_1_IRQ
/* Zephyr IRQ of level 2 intc 2 */
#define INTC_2_IRQN INTC_2_IRQ
/* Zephyr IRQ of level 3 intc 3*/
#define INTC_3_IRQN (IRQ_TO_L2(INTC_3_IRQ) | INTC_1_IRQN)
/* Zephyr IRQ of level 3 intc 4 */
#define INTC_4_IRQN (IRQ_TO_L2(INTC_4_IRQ) | INTC_2_IRQN)

/**
 *  Register all interrupt controller with the intc table
 */
/* Helpers to calculate the stride for each intc in the ISR table: the first
 * L2-sized window is left to the level 1 IRQs, then the L2 windows, then the
 * L3 windows (which may have a different size than the L2 ones).
 */
#define INTC_L2_COUNT(n) ((n) * CONFIG_MAX_IRQ_PER_2ND_LEVEL_AGGREGATOR)
#define INTC_L3_COUNT(n)                                                                           \
	(INTC_L2_COUNT(1 + CONFIG_NUM_2ND_LEVEL_AGGREGATORS) +                                     \
	 ((n) * CONFIG_MAX_IRQ_PER_3RD_LEVEL_AGGREGATOR))
#define INTC_1_OFFSET INTC_L2_COUNT(1)
#define INTC_2_OFFSET INTC_L2_COUNT(2)
#define INTC_3_OFFSET INTC_L3_COUNT(0)
#define INTC_4_OFFSET INTC_L3_COUNT(1)
IRQ_PARENT_ENTRY_DEFINE(intc_l2_1, INTC_1_DEV, INTC_1_IRQN, INTC_1_OFFSET, 2);
IRQ_PARENT_ENTRY_DEFINE(intc_l2_2, INTC_2_DEV, INTC_2_IRQN, INTC_2_OFFSET, 2);
IRQ_PARENT_ENTRY_DEFINE(intc_l3_3, INTC_3_DEV, INTC_3_IRQN, INTC_3_OFFSET, 3);
IRQ_PARENT_ENTRY_DEFINE(intc_l3_4, INTC_4_DEV, INTC_4_IRQN, INTC_4_OFFSET, 3);

/**
 *  Test IRQs in local format
 */
#define TEST_IRQ_1 2
#define TEST_IRQ_2 3
#define TEST_IRQ_3 4
#define TEST_IRQ_4 5

/**
 *  Test IRQs in Zephyr format
 */
/* TEST_IRQ_1 handled by intc_l2_1 */
#define TEST_IRQN_1 (IRQ_TO_L2(TEST_IRQ_1) | INTC_1_IRQN)
/* TEST_IRQ_2 handled by intc_l2_2 */
#define TEST_IRQN_2 (IRQ_TO_L2(TEST_IRQ_2) | INTC_2_IRQN)
/* TEST_IRQ_3 handled by intc_l3_1 */
#define TEST_IRQN_3 (IRQ_TO_L3(TEST_IRQ_3) | INTC_3_IRQN)
/* TEST_IRQ_4 handled by intc_l3_2 */
#define TEST_IRQN_4 (IRQ_TO_L3(TEST_IRQ_4) | INTC_4_IRQN)

ZTEST(intc_multi_level_backend, test_irq_from_device)
{
	/* degenerate cases */
	if (!IS_ENABLED(CONFIG_ASSERT)) {
		/* Return 0 if dev not found in the LUT */
		zassert_equal(z_get_sw_isr_irq_from_device(UINT_TO_POINTER(42)), 0);
	}

	zassert_equal(z_get_sw_isr_irq_from_device(INTC_1_DEV), INTC_1_IRQN);
	zassert_equal(z_get_sw_isr_irq_from_device(INTC_2_DEV), INTC_2_IRQN);
	zassert_equal(z_get_sw_isr_irq_from_device(INTC_3_DEV), INTC_3_IRQN);
	zassert_equal(z_get_sw_isr_irq_from_device(INTC_4_DEV), INTC_4_IRQN);
}

ZTEST(intc_multi_level_backend, test_device_from_irq)
{
	/* degenerate cases */
	if (!IS_ENABLED(CONFIG_ASSERT)) {
		/* Return NULL if can't find anything to handle the IRQ */
		zassert_equal_ptr(z_get_sw_isr_device_from_irq(IRQ_TO_L2(9) | 8), NULL);
	}

	zassert_equal_ptr(z_get_sw_isr_device_from_irq(TEST_IRQN_1), INTC_1_DEV);
	zassert_equal_ptr(z_get_sw_isr_device_from_irq(TEST_IRQN_2), INTC_2_DEV);
	zassert_equal_ptr(z_get_sw_isr_device_from_irq(TEST_IRQN_3), INTC_3_DEV);
	zassert_equal_ptr(z_get_sw_isr_device_from_irq(TEST_IRQN_4), INTC_4_DEV);
}

ZTEST(intc_multi_level_backend, test_table_idx_from_irq)
{
	/* degenerate cases */
	if (!IS_ENABLED(CONFIG_ASSERT)) {
		/* 2nd level aggregator that doesn't exist */
		const unsigned int first_level_agg = 8;
		const unsigned int unhandled_irqn = IRQ_TO_L2(TEST_IRQ_1) | first_level_agg;

		zassert_equal(z_get_sw_isr_table_idx(unhandled_irqn),
			      unhandled_irqn - CONFIG_GEN_IRQ_START_VECTOR);

		/* local_irq exceeded CONFIG_MAX_IRQ_PER_2ND_LEVEL_AGGREGATOR */
		const unsigned int local_irq = CONFIG_MAX_IRQ_PER_2ND_LEVEL_AGGREGATOR + 1;
		const unsigned int overflown_irqn = IRQ_TO_L2(local_irq) | INTC_1_IRQN;

		zassert_equal(z_get_sw_isr_table_idx(overflown_irqn),
			      local_irq + INTC_1_OFFSET - CONFIG_GEN_IRQ_START_VECTOR);

		/* Overflow SW ISR table */
		const unsigned int local_irq2 = (CONFIG_MAX_IRQ_PER_3RD_LEVEL_AGGREGATOR - 1);
		const unsigned int overflown_irqn2 = IRQ_TO_L3(local_irq2) | INTC_4_IRQN;

		zassert_equal(z_get_sw_isr_table_idx(overflown_irqn2),
			      local_irq2 + INTC_4_OFFSET - CONFIG_GEN_IRQ_START_VECTOR);
	}

	/* Level 1 */
	zassert_equal(z_get_sw_isr_table_idx(INTC_1_IRQN),
		      INTC_1_IRQN - CONFIG_GEN_IRQ_START_VECTOR);
	zassert_equal(z_get_sw_isr_table_idx(1), 1 - CONFIG_GEN_IRQ_START_VECTOR);

	/* Level 2 */
	zassert_equal(z_get_sw_isr_table_idx(TEST_IRQN_1),
		      TEST_IRQ_1 + INTC_1_OFFSET - CONFIG_GEN_IRQ_START_VECTOR);
	zassert_equal(z_get_sw_isr_table_idx(TEST_IRQN_2),
		      TEST_IRQ_2 + INTC_2_OFFSET - CONFIG_GEN_IRQ_START_VECTOR);

	/* Level 3 */
	zassert_equal(z_get_sw_isr_table_idx(TEST_IRQN_3),
		      TEST_IRQ_3 + INTC_3_OFFSET - CONFIG_GEN_IRQ_START_VECTOR);
	zassert_equal(z_get_sw_isr_table_idx(TEST_IRQN_4),
		      TEST_IRQ_4 + INTC_4_OFFSET - CONFIG_GEN_IRQ_START_VECTOR);
}

static void *setup(void)
{
	DEBUG_PRINT("=============== intc table ===============\n");
	DEBUG_PRINT("         dev |  level |    irq |  offset\n");
	DEBUG_PRINT("==========================================\n");
	STRUCT_SECTION_FOREACH_ALTERNATE(intc_table, _irq_parent_entry, intc)
	{
		DEBUG_PRINT("%12p | %6u | %6X | %7u\n", intc->dev, intc->level, intc->irq,
			    intc->offset);
	}
	DEBUG_PRINT("==========================================\n");

	return NULL;
}

ZTEST_SUITE(intc_multi_level_backend, NULL, setup, NULL, NULL, NULL);
```

## src/isr_table_placement.c
```c
/*
 * Copyright (c) 2026 Espressif Systems (Shanghai) Co., Ltd.
 *
 * SPDX-License-Identifier: Apache-2.0
 */

/*
 * Where gen_isr_tables.py put a statically connected handler, against where
 * z_get_sw_isr_table_idx() looks for it at runtime.
 *
 * The two indices are computed by entirely separate code: the build-time one by
 * the Kconfig arithmetic in gen_isr_tables.py, the runtime one by adding the
 * local IRQ to the offset an aggregator registered with IRQ_PARENT_ENTRY_DEFINE
 * (INTC_INST_ISR_TBL_OFFSET() for a devicetree-declared controller). Nothing
 * makes them agree but the two using the same window sizes, and when they
 * disagree every interrupt on the affected aggregator dispatches to the wrong
 * slot with no build diagnostic at all.
 *
 * Level-2 aggregator 0 is the platform's own interrupt controller, so that half
 * of the check is end to end. The other aggregators are fabricated: their
 * offsets come from this file and their sources are never enabled, only placed.
 */

#include "sw_isr_common.h"

#include <zephyr/irq_multilevel.h>
#include <zephyr/sw_isr_table.h>
#include <zephyr/ztest.h>

#ifdef CONFIG_TEST_ISR_TABLE_PLACEMENT

/* CPU line of level-2 aggregator 0, the platform interrupt controller. */
#define AGG2_0_LINE CONFIG_2ND_LVL_INTR_00_OFFSET
/* CPU line of level-2 aggregator 1, fabricated by this test. */
#define AGG2_1_LINE CONFIG_2ND_LVL_INTR_01_OFFSET
/* Level-2 local IRQs hosting the two level-3 aggregators. */
#define AGG3_0_L2 CONFIG_3RD_LVL_INTR_00_OFFSET
#define AGG3_1_L2 CONFIG_3RD_LVL_INTR_01_OFFSET

/* Local IRQs connected inside each aggregator's window. */
#define L2_LOCAL 20
#define L3_LOCAL 6

#define AGG2_1_IRQN AGG2_1_LINE
#define L2_0_IRQN   (IRQ_TO_L2(L2_LOCAL) | AGG2_0_LINE)
#define L2_1_IRQN   (IRQ_TO_L2(L2_LOCAL) | AGG2_1_LINE)
#define AGG3_0_IRQN (IRQ_TO_L2(AGG3_0_L2) | AGG2_0_LINE)
#define AGG3_1_IRQN (IRQ_TO_L2(AGG3_1_L2) | AGG2_0_LINE)
#define L3_0_IRQN   (IRQ_TO_L3(L3_LOCAL) | AGG3_0_IRQN)
#define L3_1_IRQN   (IRQ_TO_L3(L3_LOCAL) | AGG3_1_IRQN)

/* The fixed-width window arithmetic, spelled out once. Each aggregator owns
 * MAX_IRQ_PER_*_LEVEL_AGGREGATOR consecutive slots from its level's base,
 * picked by its position in the CONFIG_*_LVL_INTR_*_OFFSET list.
 */
#define L2_SLOT(agg, local)                                                                        \
	(CONFIG_2ND_LVL_ISR_TBL_OFFSET + ((agg) * CONFIG_MAX_IRQ_PER_2ND_LEVEL_AGGREGATOR) +       \
	 (local))
#define L3_SLOT(agg, local)                                                                        \
	(CONFIG_3RD_LVL_ISR_TBL_OFFSET + ((agg) * CONFIG_MAX_IRQ_PER_3RD_LEVEL_AGGREGATOR) +       \
	 (local))

BUILD_ASSERT(L3_SLOT(0, 0) >= L2_SLOT(CONFIG_NUM_2ND_LEVEL_AGGREGATORS, 0),
	     "level-3 window overlaps the level-2 one");
BUILD_ASSERT(L3_SLOT(CONFIG_NUM_3RD_LEVEL_AGGREGATORS, 0) <= CONFIG_NUM_IRQS,
	     "level-3 window runs past the end of the table");

/* Fake devices, only ever compared by pointer. */
#define AGG2_1_DEV UINT_TO_POINTER(0x21)
#define AGG3_0_DEV UINT_TO_POINTER(0x31)
#define AGG3_1_DEV UINT_TO_POINTER(0x32)

IRQ_PARENT_ENTRY_DEFINE(placement_l2_1, AGG2_1_DEV, AGG2_1_IRQN, L2_SLOT(1, 0), 2);
IRQ_PARENT_ENTRY_DEFINE(placement_l3_0, AGG3_0_DEV, AGG3_0_IRQN, L3_SLOT(0, 0), 3);
IRQ_PARENT_ENTRY_DEFINE(placement_l3_1, AGG3_1_DEV, AGG3_1_IRQN, L3_SLOT(1, 0), 3);

#define PARAM_AGG2_1 UINT_TO_POINTER(0xA1)
#define PARAM_L2_0   UINT_TO_POINTER(0xB0)
#define PARAM_L2_1   UINT_TO_POINTER(0xB1)
#define PARAM_L3_0   UINT_TO_POINTER(0xC0)
#define PARAM_L3_1   UINT_TO_POINTER(0xC1)

/* Never called: this test places handlers, it does not dispatch them. */
#define PLACEHOLDER_HANDLER(name)                                                                  \
	static void name(const void *arg)                                                          \
	{                                                                                          \
		ARG_UNUSED(arg);                                                                   \
	}

PLACEHOLDER_HANDLER(agg2_1_handler)
PLACEHOLDER_HANDLER(l2_0_handler)
PLACEHOLDER_HANDLER(l2_1_handler)
PLACEHOLDER_HANDLER(l3_0_handler)
PLACEHOLDER_HANDLER(l3_1_handler)

/* Z_ISR_DECLARE rather than IRQ_CONNECT: it is the half of IRQ_CONNECT that
 * feeds .intList, without the z_riscv_irq_priority_set() call that would
 * program a controller for IRQs this test only ever places.
 */
Z_ISR_DECLARE(AGG2_1_IRQN, 0, agg2_1_handler, PARAM_AGG2_1);
Z_ISR_DECLARE(L2_0_IRQN, 0, l2_0_handler, PARAM_L2_0);
Z_ISR_DECLARE(L2_1_IRQN, 0, l2_1_handler, PARAM_L2_1);
Z_ISR_DECLARE(L3_0_IRQN, 0, l3_0_handler, PARAM_L3_0);
Z_ISR_DECLARE(L3_1_IRQN, 0, l3_1_handler, PARAM_L3_1);

static void assert_placed_at(unsigned int slot, void (*isr)(const void *isr_arg), const void *arg,
			     const char *what)
{
	zassert_true(slot < CONFIG_NUM_IRQS, "%s: slot %u past the end of the table", what, slot);
	zassert_equal_ptr(_sw_isr_table[slot - CONFIG_GEN_IRQ_START_VECTOR].isr, isr,
			  "%s: slot %u holds %p, expected %p", what, slot,
			  _sw_isr_table[slot - CONFIG_GEN_IRQ_START_VECTOR].isr, isr);
	zassert_equal_ptr(_sw_isr_table[slot - CONFIG_GEN_IRQ_START_VECTOR].arg, arg,
			  "%s: slot %u carries argument %p, expected %p", what, slot,
			  _sw_isr_table[slot - CONFIG_GEN_IRQ_START_VECTOR].arg, arg);
}

/**
 * @brief The generator places each level's handlers in its own window
 *
 * @details Read back the slot the fixed-width arithmetic predicts for a level 1,
 * level 2 and level 3 handler and check the generated _sw_isr_table holds that
 * handler and its argument. The level-2 and level-3 windows have different
 * sizes here, so a placement that used one size for both lands elsewhere.
 */
ZTEST(intc_isr_table_placement, test_generator_placement)
{
	assert_placed_at(AGG2_1_IRQN, agg2_1_handler, PARAM_AGG2_1, "level 1");
	assert_placed_at(L2_SLOT(0, L2_LOCAL), l2_0_handler, PARAM_L2_0, "level 2 aggregator 0");
	assert_placed_at(L2_SLOT(1, L2_LOCAL), l2_1_handler, PARAM_L2_1, "level 2 aggregator 1");
	assert_placed_at(L3_SLOT(0, L3_LOCAL), l3_0_handler, PARAM_L3_0, "level 3 aggregator 0");
	assert_placed_at(L3_SLOT(1, L3_LOCAL), l3_1_handler, PARAM_L3_1, "level 3 aggregator 1");
}

/**
 * @brief The runtime lookup resolves to the slot the generator wrote
 *
 * @details z_get_sw_isr_table_idx() derives its index from the offset an
 * aggregator registered with IRQ_PARENT_ENTRY_DEFINE, which for the platform
 * interrupt controller comes from INTC_INST_ISR_TBL_OFFSET(). This is the check
 * that the header macro and the generator size their windows the same way.
 */
ZTEST(intc_isr_table_placement, test_runtime_lookup_agrees)
{
	const struct {
		unsigned int irqn;
		unsigned int slot;
		void (*isr)(const void *arg);
	} cases[] = {
		{L2_0_IRQN, L2_SLOT(0, L2_LOCAL), l2_0_handler},
		{L2_1_IRQN, L2_SLOT(1, L2_LOCAL), l2_1_handler},
		{L3_0_IRQN, L3_SLOT(0, L3_LOCAL), l3_0_handler},
		{L3_1_IRQN, L3_SLOT(1, L3_LOCAL), l3_1_handler},
	};

	for (size_t i = 0; i < ARRAY_SIZE(cases); i++) {
		unsigned int idx = z_get_sw_isr_table_idx(cases[i].irqn);

		zassert_equal(idx, cases[i].slot - CONFIG_GEN_IRQ_START_VECTOR,
			      "IRQ %#x: runtime index %u, generator slot %u", cases[i].irqn, idx,
			      cases[i].slot - CONFIG_GEN_IRQ_START_VECTOR);
		zassert_equal_ptr(_sw_isr_table[idx].isr, cases[i].isr,
				  "IRQ %#x: runtime index %u holds the wrong handler",
				  cases[i].irqn, idx);
	}
}

/**
 * @brief Windows do not spill into their neighbours
 *
 * @details A window sized from the wrong Kconfig symbol still places its first
 * entries correctly and only overruns at the end, so check the slots framing
 * each window are untouched.
 */
ZTEST(intc_isr_table_placement, test_windows_do_not_overlap)
{
	const unsigned int boundaries[] = {
		L2_SLOT(0, 0),
		L2_SLOT(1, 0) - 1,
		L2_SLOT(1, 0),
		L2_SLOT(CONFIG_NUM_2ND_LEVEL_AGGREGATORS, 0) - 1,
		L3_SLOT(0, 0),
		L3_SLOT(1, 0) - 1,
		L3_SLOT(1, 0),
		L3_SLOT(CONFIG_NUM_3RD_LEVEL_AGGREGATORS, 0) - 1,
	};

	for (size_t i = 0; i < ARRAY_SIZE(boundaries); i++) {
		unsigned int slot = boundaries[i] - CONFIG_GEN_IRQ_START_VECTOR;

		zassert_equal_ptr(_sw_isr_table[slot].isr, z_irq_spurious,
				  "slot %u should be unconnected, holds %p", boundaries[i],
				  _sw_isr_table[slot].isr);
	}
}

/**
 * @brief An aggregator's CPU line keeps its own handler
 *
 * @details The level-1 slot of the line a level-2 aggregator sits on holds the
 * handler connected to that line, while the aggregator's sources are placed in
 * its window.
 */
ZTEST(intc_isr_table_placement, test_line_slot_keeps_its_handler)
{
	unsigned int slot = AGG2_1_IRQN - CONFIG_GEN_IRQ_START_VECTOR;

	zassert_equal_ptr(_sw_isr_table[slot].isr, agg2_1_handler);
	zassert_equal_ptr(_sw_isr_table[slot].arg, PARAM_AGG2_1);
}

ZTEST_SUITE(intc_isr_table_placement, NULL, NULL, NULL, NULL, NULL);

#endif /* CONFIG_TEST_ISR_TABLE_PLACEMENT */
```
