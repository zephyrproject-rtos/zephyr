## CMakeLists.txt
```
# SPDX-License-Identifier: Apache-2.0

cmake_minimum_required(VERSION 3.20.0)
find_package(Zephyr REQUIRED HINTS $ENV{ZEPHYR_BASE})
project(swi)

FILE(GLOB app_sources src/*.c)
target_sources(app PRIVATE ${app_sources})
```

## prj.conf
```kconfig
CONFIG_ZTEST=y
CONFIG_ZTRESS=y
CONFIG_ZTRESS_MAX_THREADS=4
```

## boards/nrf52840dk_nrf52840.conf
```kconfig
CONFIG_INTC_NRF_EGU=y
CONFIG_INTC_SWI_NRF_EGU=y
```

## boards/nrf52840dk_nrf52840.overlay
```dts
/* SPDX-License-Identifier: Apache-2.0 */

/ {
	chosen {
		nordic,swi-egu = &egu0;
	};
};

/* Set RTC1 (k_timer) interrupt priority above EGU (SWI) */

&rtc1 {
	interrupts = <17 1>;
};

&egu0 {
	interrupts = <20 2>;
};
```

## src/main.c
```c
/*
 * Copyright (c) 2022 Nordic Semiconductor ASA
 *
 * SPDX-License-Identifier: Apache-2.0
 */

#include <ztest.h>
#include <drivers/interrupt_controller/intc_swi.h>

#define TEST_TIMEOUT K_MSEC(100)

static struct swi_channel swi;
static K_SEM_DEFINE(swi_sem, 0, 1);

static void swi_cb(struct swi_channel *swi)
{
	k_sem_give(&swi_sem);
}

static void teardown(void)
{
	swi_channel_deinit(&swi);
	k_sem_reset(&swi_sem);
}

static void test_intc_swi_init_deinit_shall_succeed(void)
{
	int result;

	/* Init SWI twice. */
	result = swi_channel_init(&swi, swi_cb);
	zassert_true(result == 0, "swi_channel_init errno: %d", -result);
	result = swi_channel_deinit(&swi);
	zassert_true(result == 0, "swi_channel_deinit errno: %d", -result);
	result = swi_channel_init(&swi, swi_cb);
	zassert_true(result == 0, "swi_channel_init errno: %d", -result);
}

static void test_intc_swi_double_init_shall_fail(void)
{
	int result;

	result = swi_channel_init(&swi, swi_cb);
	zassert_true(result == 0, "swi_channel_init errno: %d", -result);
	result = swi_channel_init(&swi, swi_cb);
	zassert_true(result == -EALREADY, "swi_channel_init errno: %d", -result);
}

static void test_intc_swi_trigger_shall_call_function(void)
{
	int result;

	result = swi_channel_init(&swi, swi_cb);
	zassert_true(result == 0, "swi_channel_init errno: %d", -result);
	result = swi_channel_trigger(&swi);
	zassert_true(result == 0, "swi_channel_trigger errno: %d", -result);

	result = k_sem_take(&swi_sem, TEST_TIMEOUT);
	zassert_true(result == 0, "SWI trigger test timed out");
}

extern void test_intc_swi_stress(void);

void test_main(void)
{
	ztest_test_suite(test_intc_swi,
			 ztest_unit_test_setup_teardown(test_intc_swi_init_deinit_shall_succeed,
							unit_test_noop, teardown),
			 ztest_unit_test_setup_teardown(test_intc_swi_double_init_shall_fail,
							unit_test_noop, teardown),
			 ztest_unit_test_setup_teardown(test_intc_swi_trigger_shall_call_function,
							unit_test_noop, teardown),
			 ztest_unit_test(test_intc_swi_stress));
	ztest_run_test_suite(test_intc_swi);
}
```

## src/stress.c
```c
/*
 * Copyright (c) 2022 Nordic Semiconductor ASA
 *
 * SPDX-License-Identifier: Apache-2.0
 */

#include <ztest.h>
#include <ztress.h>
#include <sys/atomic.h>
#include <drivers/interrupt_controller/intc_swi.h>

#define STRESS_SWI_COUNT 3

struct swi_stress_ctx {
	struct swi_channel swi;
	uint32_t cb_count;
	atomic_t trigger_count;
};

static struct swi_stress_ctx stress_swi[STRESS_SWI_COUNT];

static void swi_stress_cb(struct swi_channel *swi)
{
	struct swi_stress_ctx *ctx = CONTAINER_OF(swi, struct swi_stress_ctx, swi);

	ctx->cb_count++;
}

static bool stress_func(void *user_data, uint32_t iter_cnt, bool last, int prio)
{
	struct swi_stress_ctx *ctx = user_data;
	int result;

	result = swi_channel_trigger(&ctx->swi);
	if (result == 0) {
		atomic_inc(&ctx->trigger_count);
	} else  if (result != -EALREADY) {
		return false;
	}

	return true;
}

void test_intc_swi_stress(void)
{
	for (int i = 0; i < STRESS_SWI_COUNT; i++) {
		swi_channel_init(&stress_swi[i].swi, swi_stress_cb);
	}

	ztress_set_timeout(K_MSEC(10000));
	ZTRESS_EXECUTE(ZTRESS_TIMER(stress_func, &stress_swi[0], 0, Z_TIMEOUT_TICKS(20)),
		       ZTRESS_THREAD(stress_func, &stress_swi[0], 0, 2000, Z_TIMEOUT_TICKS(20)),
		       ZTRESS_THREAD(stress_func, &stress_swi[1], 0, 2000, Z_TIMEOUT_TICKS(20)),
		       ZTRESS_THREAD(stress_func, &stress_swi[2], 0, 2000, Z_TIMEOUT_TICKS(20)));

	for (int i = 0; i < STRESS_SWI_COUNT; i++) {
		swi_channel_deinit(&stress_swi[i].swi);
		zassert_equal(stress_swi[i].trigger_count, stress_swi[i].cb_count,
			      "Number of successful SWI triggers does not match the number "
			      "of executed callbacks: %u != %u",
			      stress_swi[i].trigger_count, stress_swi[i].cb_count);
	}
}
```
