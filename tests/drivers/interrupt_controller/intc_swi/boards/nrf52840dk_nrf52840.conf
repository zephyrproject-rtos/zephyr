## tests/drivers/interrupt_controller/intc_swi/testcase.yaml
```yaml
common:
  tags: drivers intc_swi
  build_only: true
tests:
  intc_swi.build.nrf5:
    platform_allow: nrf52840dk_nrf52840
```

## tests/drivers/interrupt_controller/multi_level_backend/testcase.yaml
```yaml
# Copyright (c) 2024 Meta
# SPDX-License-Identifier: Apache-2.0

common:
  tags:
    - drivers
    - interrupt
  filter: CONFIG_MULTI_LEVEL_INTERRUPTS
  platform_allow:
    - m2gl025_miv/miv
    - qemu_riscv/qemu_virt_riscv/rv32
    - qemu_riscv/qemu_virt_riscv/rv32/smp
    - qemu_riscv/qemu_virt_riscv/rv64
    - qemu_riscv/qemu_virt_riscv/rv64/smp
    - qemu_riscv/qemu_virt_riscv/rv32e
tests:
  interrupt_controller.intc_multi_level_backend.default: {}
  interrupt_controller.intc_multi_level_backend.no_assert:
    extra_configs:
      - CONFIG_ASSERT=n
```

## tests/drivers/ipm/testcase.yaml
```yaml
tests:
  drivers.ipc.mailbox:
    arch_exclude:
      - posix
      - xtensa
    tags:
      - drivers
      - ipc
    integration_platforms:
      - qemu_x86
```

## tests/drivers/kscan/kscan_api/testcase.yaml
```yaml
tests:
  drivers.kscan:
    tags:
      - drivers
      - kscan
      - userspace
    depends_on: kscan
    platform_exclude: mec15xxevb_assy6853
    filter: dt_alias_exists("kscan0")
  drivers.kscan.mec15xxevb_assy6853:
    depends_on: kscan
    tags:
      - drivers
      - kscan
    extra_args: CONF_FILE="mec15xxevb_assy6853.conf"
    platform_allow: mec15xxevb_assy6853
```

## tests/drivers/kscan/kscan_input/testcase.yaml
```yaml
# SPDX-License-Identifier: Apache-2.0

tests:
  drivers.input.kscan_input:
    platform_allow:
      - native_sim
      - native_sim/native/64
    tags:
      - drivers
      - kscan
      - input
    integration_platforms:
      - native_sim
```

## tests/drivers/led/led_api/testcase.yaml
```yaml
tests:
  drivers.led_api.i2c:
    tags: drivers led
    depends_on: led
    filter: dt_alias_exists("led-controller-0")
```

## tests/drivers/led/trigger/testcase.yaml
```yaml
tests:
  drivers.led.trigger:
    tags:
      - drivers
      - led
    harness: ztest
    platform_allow:
      - native_sim
      - native_sim/native/64
    integration_platforms:
      - native_sim
      - native_sim/native/64
```

## tests/drivers/led_strip/api/testcase.yaml
```yaml
tests:
  drivers.led_strip.api:
    integration_platforms:
      - native_sim
    platform_allow:
      - native_sim
    tags:
      - drivers
      - led_strip_api
```

## tests/drivers/lin/lin_api/testcase.yaml
```yaml
common:
  tags:
    - lin
    - drivers
  depends_on: lin
tests:
  drivers.lin.api:
    integration_platforms:
      - ek_ra8m1/r7fa8m1ahecbd
```

## tests/drivers/location/testcase.yaml
```yaml
tests:
  location.api:
    tags: location_driver_api
    platform_allow: native_posix
```

## tests/drivers/mbox/mbox_data/Kconfig
```kconfig
# Copyright 2024-2025 NXP
#
# SPDX-License-Identifier: Apache-2.0

source "Kconfig.zephyr"

config INCLUDE_REMOTE_DIR
	bool "Include remote core header directory"
	help
	  Include remote build header files. Can be used if primary image
	  needs to be aware of size or base address of secondary image

config TEST_SINGLE_CPU
	bool "Enable mailbox test on single CPU core"
	help
	  Perform a test in which a CPU uses a mailbox channel to exchange messages with itself

config CHANNELS_TO_TEST
	int "Number of mbox TX/RX channel pairs to test"
	default 4
	help
		The number of TX/RX channel pairs that should be exercise by
		this test. This should match the number of pairs set in the
		devicetree.
```

## tests/drivers/mbox/mbox_data/Kconfig.sysbuild
```kconfig
# Copyright 2024 NXP
#
# SPDX-License-Identifier: Apache-2.0

source "share/sysbuild/Kconfig"

config REMOTE_BOARD
string
	default "mimxrt1170_evkb/mimxrt1176/cm4" if $(BOARD) = "mimxrt1170_evkb"
	default "mimxrt1170_evk/mimxrt1176/cm4" if $(BOARD) = "mimxrt1170_evk"
	default "mimxrt1160_evk/mimxrt1166/cm4" if $(BOARD) = "mimxrt1160_evk"
	default "lpcxpresso55s69/lpc55s69/cpu1" if $(BOARD) = "lpcxpresso55s69"
	default "mimxrt1180_evk/mimxrt1189/cm7" if $(BOARD) = "mimxrt1180_evk"
```

## tests/drivers/mbox/mbox_data/boards/ek_ra8p1_r7ka8p1kflcac_cm85.conf
```kconfig
# Copyright (c) 2025 Renesas Electronics Corporation
# SPDX-License-Identifier: Apache-2.0

CONFIG_SOC_RA_ENABLE_START_SECOND_CORE=y
```

## tests/drivers/mbox/mbox_data/remote/Kconfig
```kconfig
# Copyright 2025 Analog Devices, Inc
#
# SPDX-License-Identifier: Apache-2.0

source "Kconfig.zephyr"

config CHANNELS_TO_TEST
	int "Number of mbox TX/RX channel pairs to test"
	default 4
	help
		The number of TX/RX channel pairs that should be exercised by
		this test. This should match the number of pairs set in the
		devicetree.
```

## tests/drivers/mbox/mbox_data/testcase.yaml
```yaml
common:
  tags:
    - drivers
    - mbox
  filter: dt_compat_enabled("vnd,mbox-consumer")
tests:
  drivers.mbox_data:
    sysbuild: true
    integration_platforms:
      - mimxrt1170_evk/mimxrt1176/cm7
      - lpcxpresso55s69/lpc55s69/cpu0
    platform_exclude:
      - s32z2xxdc2/s32z270/rtu0
      - s32z2xxdc2/s32z270/rtu1
      - s32z2xxdc2@D/s32z270/rtu0
      - s32z2xxdc2@D/s32z270/rtu1
  drivers.mbox_data.single_cpu:
    platform_allow:
      - s32z2xxdc2/s32z270/rtu0
      - s32z2xxdc2/s32z270/rtu1
      - s32z2xxdc2@D/s32z270/rtu0
      - s32z2xxdc2@D/s32z270/rtu1
    extra_configs:
      - CONFIG_TEST_SINGLE_CPU=y
```

## tests/drivers/mbox/mbox_error_cases/Kconfig
```kconfig
#
# Copyright (c) 2026 Nordic Semiconductor ASA
#
# SPDX-License-Identifier: Apache-2.0
#

mainmenu "MBOX Negative Test"

config TEST_EXPECTED_MTU_VALUE
	int "Maximum data field size"
	default 0
	help
	  Expected value that mbox_mtu_get_dt() shall return.
	  Maximum number of bytes possible in an outbound message.

config TEST_REMOTE_BUSY_NOT_SUPPORTED
	bool "Remote busy is NOT supported"
	default y
	help
	  Value of 'y' means that transmitter is NOT able to detect
	  if the remote hasn't yet read the last data sent.

source "Kconfig.zephyr"
```

## tests/drivers/mbox/mbox_error_cases/sample.yaml
```yaml
sample:
  name: MBOX IPC negative test cases
common:
  tags: drivers mbox
  harness: ztest
tests:

  tests.drivers.mbox_error_cases:
    platform_allow:
      - nrf54h20dk/nrf54h20/cpuapp
      - nrf54h20dk/nrf54h20/cpuppr
    integration_platforms:
      - nrf54h20dk/nrf54h20/cpuapp

  tests.drivers.mbox_error_cases.nrf54l:
    platform_allow:
      - nrf54l15pdk/nrf54l15/cpuapp
    integration_platforms:
      - nrf54l15pdk/nrf54l15/cpuapp
    extra_args: SNIPPET=nordic-flpr
```

## tests/drivers/memc/ram/boards/b_u585i_iot02a_mspi_aps6408l.conf
```kconfig
# SPDX-FileCopyrightText: Copyright The Zephyr Project Contributors
# SPDX-License-Identifier: Apache-2.0

CONFIG_LOG=y
CONFIG_MSPI_LOG_LEVEL_INF=y
CONFIG_MSPI_XIP=y
CONFIG_MSPI_TIMING=y
```

## tests/drivers/memc/ram/boards/max32690evkit_max32690_m4.conf
```kconfig
CONFIG_ZTEST=y
CONFIG_MEMC=y
CONFIG_CLOCK_CONTROL_INIT_PRIORITY=15
CONFIG_MEMC_INIT_PRIORITY=20
```
