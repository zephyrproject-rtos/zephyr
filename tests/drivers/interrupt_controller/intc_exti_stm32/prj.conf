## CMakeLists.txt
```
# Copyright (c) 2025 Alexander Kozhinov <ak.alexander.kozhinov@gmail.com>
# SPDX-License-Identifier: Apache-2.0

cmake_minimum_required(VERSION 3.28.0)

find_package(Zephyr REQUIRED HINTS $ENV{ZEPHYR_BASE})

project(test_intc_exti_stm32)

target_sources(app PRIVATE src/main.c)

target_include_directories(app PRIVATE inc)

target_compile_definitions(app PRIVATE _POSIX_C_SOURCE=200809L)
```

## Kconfig
```
# Copyright (c) 2025 Alexander Kozhinov <ak.alexander.kozhinov@gmail.com>
# SPDX-License-Identifier: Apache-2.0

source "Kconfig.zephyr"
```

## prj.conf
```kconfig
# Copyright (c) 2025 Alexander Kozhinov <ak.alexander.kozhinov@gmail.com>
# SPDX-License-Identifier: Apache-2.0

CONFIG_ZTEST=y
```

## boards/exti_default_resources.overlay
```dts
/*
 * Copyright (c) 2025 Alexander Kozhinov <ak.alexander.kozhinov@gmail.com>
 *
 * SPDX-License-Identifier: Apache-2.0
 */

/**
 * NOTE: For this test, a _configurable_ EXTI line that doesn't conflict
 * with other users should be specified, along with the associated IRQn.
 *
 * On most STM32 series so far, EXTI line 16 is configurable, generates an
 * interrupt on IRQn 1, and corresponds to events raised by the PVD. Since
 * the PVD is not available in Zephyr yet, there is no risk of conflict.
 *
 * This overlay will be used by default and configures EXTI line 16 with
 * IRQn 1 for use by the test, which should work on most hardware. Series
 * where this does not apply can define their own overlay to override it.
 */

/ {
	resources {
		compatible = "test-st-stm32-exti";
		exti-line-nr = <16>;
		exti-line-irq-nr = <1>;
		exti-line-irq-prio = <0>;
		status = "okay";
	};
};
```

## boards/nucleo_c071rb_stm32c071xx.overlay
```dts
/*
 * Copyright (c) 2025 Alexander Kozhinov <ak.alexander.kozhinov@gmail.com>
 *
 * SPDX-License-Identifier: Apache-2.0
 */

/ {
	resources {
		exti-line-nr = <34>;
	};
};
```

## boards/nucleo_f030r8_stm32f030x8.overlay
```dts
/*
 * Copyright (c) 2025 Alexander Kozhinov <ak.alexander.kozhinov@gmail.com>
 *
 * SPDX-License-Identifier: Apache-2.0
 */

/ {
	resources {
		compatible = "test-st-stm32-exti";
		exti-line-nr = <19>;
		exti-line-irq-nr = <4>;
		exti-line-irq-prio = <0>;
		status = "okay";
	};
};
```

## boards/nucleo_f091rc_stm32f091xc.overlay
```dts
/*
 * Copyright (c) 2025 Alexander Kozhinov <ak.alexander.kozhinov@gmail.com>
 *
 * SPDX-License-Identifier: Apache-2.0
 */

/ {
	resources {
		compatible = "test-st-stm32-exti";
		exti-line-nr = <21>;
		exti-line-irq-nr = <12>;
		exti-line-irq-prio = <0>;
		status = "okay";
	};
};
```

## boards/nucleo_g0b1re_stm32g0b1xx.overlay
```dts
/*
 * Copyright (c) 2025 Alexander Kozhinov <ak.alexander.kozhinov@gmail.com>
 *
 * SPDX-License-Identifier: Apache-2.0
 */

/ {
	resources {
		compatible = "test-st-stm32-exti";
		exti-line-nr = <16>;
		exti-line-irq-nr = <1>;
		exti-line-irq-prio = <0>;
		status = "okay";
	};
};
```

## boards/nucleo_g474re_stm32g474xx.overlay
```dts
/*
 * Copyright (c) 2025 Alexander Kozhinov <ak.alexander.kozhinov@gmail.com>
 *
 * SPDX-License-Identifier: Apache-2.0
 */

/ {
	resources {
		compatible = "test-st-stm32-exti";
		exti-line-nr = <17>;
		exti-line-irq-nr = <41>;
		exti-line-irq-prio = <0>;
		status = "okay";
	};
};
```

## dts/bindings/test-st-stm32-exti.yaml
```yaml
#
# Copyright (c) 2025 Alexander Kozhinov <ak.alexander.kozhinov@gmail.com>
#
# SPDX-License-Identifier: Apache-2.0
#

description: |
    This binding provides resources required to build and run the
    tests/drivers/interrupt_controller/intc_exti_stm32 test in Zephyr.

compatible: "test-st-stm32-exti"

properties:

  exti-line-nr:
    type: int
    required: true
    description: |
      Number of the EXTI line to use for the test.

  exti-line-irq-nr:
    type: int
    required: true
    description: |
      IRQn of the interrupt triggered by the specified EXTI line.

  exti-line-irq-prio:
    type: int
    required: true
    description: |
      Priority of the interrupt triggered by the specified EXTI line.
```

## src/main.c
```c
/*
 * Copyright (c) 2025 Alexander Kozhinov <ak.alexander.kozhinov@gmail.com>
 *
 * SPDX-License-Identifier: Apache-2.0
 */

#include <zephyr/ztest.h>
#include <zephyr/irq.h>
#include <zephyr/init.h>
#include <zephyr/device.h>
#include <zephyr/kernel.h>
#include <zephyr/sys/atomic.h>
#include <zephyr/drivers/interrupt_controller/intc_exti_stm32.h>


#define EXTI_DT_NODE		DT_INST(0, st_stm32_exti)
#define EXTI_NUM_LINES_TOTAL	DT_PROP(EXTI_DT_NODE, num_lines)
#define EXTI_NUM_LINES_GPIO	DT_PROP(EXTI_DT_NODE, num_gpio_lines)

#define TEST_EXTI_LINE_NR	DT_PROP(DT_INST(0, test_st_stm32_exti), exti_line_nr)
#define TEST_EXTI_IRQ_NR	DT_PROP(DT_INST(0, test_st_stm32_exti), exti_line_irq_nr)
#define TEST_EXTI_IRQ_PRIO	DT_PROP(DT_INST(0, test_st_stm32_exti), exti_line_irq_prio)


BUILD_ASSERT(TEST_EXTI_LINE_NR < EXTI_NUM_LINES_TOTAL, "Invalid EXTI line number");

static atomic_t is_test_exti_isr_called;

static void test_exti_isr(void)
{
	zassert_true(stm32_exti_is_pending(TEST_EXTI_LINE_NR));
	stm32_exti_clear_pending(TEST_EXTI_LINE_NR);

	atomic_set(&is_test_exti_isr_called, true);
}

ZTEST(intc_exti_stm32, test_sw_interrupt_rising_trigger)
{
	int ret = 0;

	ret = stm32_exti_enable(TEST_EXTI_LINE_NR,
				STM32_EXTI_TRIG_RISING,
				STM32_EXTI_MODE_IT);
	zassert_ok(ret, "Failed to enable EXTI line %d", TEST_EXTI_LINE_NR);

	atomic_set(&is_test_exti_isr_called, false);

	ret = stm32_exti_sw_interrupt(TEST_EXTI_LINE_NR);
	zassert_ok(ret, "Failed to fire SW interrupt on EXTI line %d",
		   TEST_EXTI_LINE_NR);

	zassert_equal(is_test_exti_isr_called, true,
		      "ISR was not called for EXTI line %d", TEST_EXTI_LINE_NR);
}

ZTEST(intc_exti_stm32, test_sw_interrupt_falling_trigger)
{
	int ret = 0;

	ret = stm32_exti_enable(TEST_EXTI_LINE_NR,
				STM32_EXTI_TRIG_FALLING,
				STM32_EXTI_MODE_IT);
	zassert_ok(ret, "Failed to enable EXTI line %d", TEST_EXTI_LINE_NR);

	atomic_set(&is_test_exti_isr_called, false);

	ret = stm32_exti_sw_interrupt(TEST_EXTI_LINE_NR);
	zassert_ok(ret, "Failed to fire SW interrupt on EXTI line %d",
		   TEST_EXTI_LINE_NR);

	zassert_equal(is_test_exti_isr_called, true,
		      "ISR was not called for EXTI line %d", TEST_EXTI_LINE_NR);
}

ZTEST(intc_exti_stm32, test_sw_interrupt_both_triggers)
{
	int ret = 0;

	ret = stm32_exti_enable(TEST_EXTI_LINE_NR,
				STM32_EXTI_TRIG_BOTH,
				STM32_EXTI_MODE_IT);
	zassert_ok(ret, "Failed to enable EXTI line %d", TEST_EXTI_LINE_NR);

	atomic_set(&is_test_exti_isr_called, false);

	ret = stm32_exti_sw_interrupt(TEST_EXTI_LINE_NR);
	zassert_ok(ret, "Failed to fire SW interrupt on EXTI line %d",
		   TEST_EXTI_LINE_NR);

	zassert_equal(is_test_exti_isr_called, true,
		      "ISR was not called for EXTI line %d", TEST_EXTI_LINE_NR);
}

static void *test_exti_intc_init(void)
{
	IRQ_CONNECT(
		TEST_EXTI_IRQ_NR, TEST_EXTI_IRQ_PRIO,
		test_exti_isr, NULL, 0
	);

	irq_enable(TEST_EXTI_IRQ_NR);

	return NULL;
}

ZTEST_SUITE(intc_exti_stm32, NULL, test_exti_intc_init, NULL, NULL, NULL);
```

## src/test_intc_exti_stm32.c
```c
/*
 * Copyright (c) 2025 Alexander Kozhinov <ak.alexander.kozhinov@gmail.com>
 *
 * SPDX-License-Identifier: Apache-2.0
 */

#include <zephyr/ztest.h>
#include <zephyr/irq.h>
#include <zephyr/init.h>
#include <zephyr/device.h>
#include <zephyr/kernel.h>
#include <zephyr/sys/atomic.h>
#include <zephyr/drivers/interrupt_controller/intc_exti_stm32.h>


#define EXTI_DT_NODE		DT_INST(0, st_stm32_exti)
#define EXTI_NUM_LINES_TOTAL	DT_PROP(EXTI_DT_NODE, num_lines)
#define EXTI_NUM_LINES_GPIO	DT_PROP(EXTI_DT_NODE, num_gpio_lines)

#define TEST_EXTI_LINE_NR	DT_PROP(DT_INST(0, test_st_stm32_exti), exti_line_nr)
#define TEST_EXTI_IRQ_NR	DT_PROP(DT_INST(0, test_st_stm32_exti), exti_line_irq_nr)
#define TEST_EXTI_IRQ_PRIO	DT_PROP(DT_INST(0, test_st_stm32_exti), exti_line_irq_prio)


BUILD_ASSERT(TEST_EXTI_LINE_NR < EXTI_NUM_LINES_TOTAL, "Invlaid EXTI line number");

static atomic_t is_test_exti_isr_called;

static void test_exti_isr(void)
{
	zassert_true(stm32_exti_is_pending(TEST_EXTI_LINE_NR));
	stm32_exti_clear_pending(TEST_EXTI_LINE_NR);

	atomic_set(&is_test_exti_isr_called, true);
}

ZTEST(intc_exti_stm32, test_sw_interrupt_rising_trigger)
{
	int ret = 0;

	ret = stm32_exti_enable(TEST_EXTI_LINE_NR,
				STM32_EXTI_TRIG_RISING,
				STM32_EXTI_MODE_IT);
	zassert_ok(ret, "Failed to enable EXTI line %d", TEST_EXTI_LINE_NR);

	atomic_set(&is_test_exti_isr_called, false);

	ret = stm32_exti_sw_interrupt(TEST_EXTI_LINE_NR);
	zassert_ok(ret, "Failed to fire SW interrupt on EXTI line %d",
		   TEST_EXTI_LINE_NR);

	zassert_equal(is_test_exti_isr_called, true,
		      "ISR was not called for EXTI line %d", TEST_EXTI_LINE_NR);
}

ZTEST(intc_exti_stm32, test_sw_interrupt_falling_trigger)
{
	int ret = 0;

	ret = stm32_exti_enable(TEST_EXTI_LINE_NR,
				STM32_EXTI_TRIG_FALLING,
				STM32_EXTI_MODE_IT);
	zassert_ok(ret, "Failed to enable EXTI line %d", TEST_EXTI_LINE_NR);

	atomic_set(&is_test_exti_isr_called, false);

	ret = stm32_exti_sw_interrupt(TEST_EXTI_LINE_NR);
	zassert_ok(ret, "Failed to fire SW interrupt on EXTI line %d",
		   TEST_EXTI_LINE_NR);

	zassert_equal(is_test_exti_isr_called, true,
		      "ISR was not called for EXTI line %d", TEST_EXTI_LINE_NR);
}

ZTEST(intc_exti_stm32, test_sw_interrupt_both_triggers)
{
	int ret = 0;

	ret = stm32_exti_enable(TEST_EXTI_LINE_NR,
				STM32_EXTI_TRIG_BOTH,
				STM32_EXTI_MODE_IT);
	zassert_ok(ret, "Failed to enable EXTI line %d", TEST_EXTI_LINE_NR);

	atomic_set(&is_test_exti_isr_called, false);

	ret = stm32_exti_sw_interrupt(TEST_EXTI_LINE_NR);
	zassert_ok(ret, "Failed to fire SW interrupt on EXTI line %d",
		   TEST_EXTI_LINE_NR);

	zassert_equal(is_test_exti_isr_called, true,
		      "ISR was not called for EXTI line %d", TEST_EXTI_LINE_NR);
}

static int test_exti_intc_init(void)
{
	IRQ_CONNECT(
		TEST_EXTI_IRQ_NR, TEST_EXTI_IRQ_PRIO,
		test_exti_isr, NULL, 0
	);

	irq_enable(TEST_EXTI_IRQ_NR);

	return 0;
}

SYS_INIT(test_exti_intc_init, PRE_KERNEL_1, CONFIG_INTC_INIT_PRIORITY);
```
