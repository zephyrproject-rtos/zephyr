/*
 * Copyright (c) 2024 Meta Platforms.
 *
 * SPDX-License-Identifier: Apache-2.0
 */

#include "../src/config.h"

/ {
	irq_mgr: irq_manager {
		compatible = "zephyr,irq-manager";
		interrupt-parent = <&plic>;
		interrupts = < TEST_DT_IRQ_BASE 0 >;
		nr-irqs = < TEST_NR_IRQS >;
	};
};
