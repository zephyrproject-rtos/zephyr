## CMakeLists.txt
```
# SPDX-FileCopyrightText: Copyright The Zephyr Project Contributors
# SPDX-License-Identifier: Apache-2.0

cmake_minimum_required(VERSION 3.20.0)
find_package(Zephyr REQUIRED HINTS $ENV{ZEPHYR_BASE})
project(intc_riscv_aia)

target_sources(app PRIVATE src/main.c)

# Delivery-mode-specific tests
target_sources_ifdef(CONFIG_RISCV_APLIC_MSI app PRIVATE src/aplic_msi_imsic.c)
target_sources_ifdef(CONFIG_RISCV_APLIC_DIRECT app PRIVATE src/aplic_direct.c)
```

## prj.conf
```kconfig
# SPDX-FileCopyrightText: Copyright The Zephyr Project Contributors
# SPDX-License-Identifier: Apache-2.0

CONFIG_ZTEST=y

CONFIG_ZTEST_FATAL_HOOK=y
CONFIG_DYNAMIC_INTERRUPTS=y
CONFIG_SHARED_INTERRUPTS=y
CONFIG_TEST_RANDOM_GENERATOR=y
```

## src/main.c
```c
/*
 * SPDX-FileCopyrightText: Copyright The Zephyr Project Contributors
 *
 * SPDX-License-Identifier: Apache-2.0
 */

/*
 * Generic APLIC tests, valid in both MSI and direct delivery mode.
 *
 * Delivery-mode-specific tests live in separate source files gated by
 * the matching Kconfig option (see CMakeLists.txt):
 *   - aplic_msi_imsic.c: CONFIG_RISCV_APLIC_MSI (APLIC MSI mode + IMSIC)
 *   - aplic_direct.c: CONFIG_RISCV_APLIC_DIRECT (APLIC direct mode)
 */

#include <stdint.h>
#include <zephyr/irq.h>
#include <zephyr/ztest.h>
#include <zephyr/drivers/interrupt_controller/riscv_aplic.h>

ZTEST_SUITE(intc_riscv_aia, NULL, NULL, NULL, NULL, NULL);

/* Test APLIC register offset calculations */
ZTEST(intc_riscv_aia, test_aplic_sourcecfg_offset)
{
	/* Test sourcecfg offset calculation: SOURCECFG_BASE + (src - 1) * 4 */
	zassert_equal(0x0004, aplic_sourcecfg_off(1), "source 1 offset");
	zassert_equal(0x0008, aplic_sourcecfg_off(2), "source 2 offset");
	zassert_equal(0x000C, aplic_sourcecfg_off(3), "source 3 offset");
	zassert_equal(0x0010, aplic_sourcecfg_off(4), "source 4 offset");
	zassert_equal(0x0104, aplic_sourcecfg_off(65), "source 65 offset");
}

ZTEST(intc_riscv_aia, test_aplic_target_offset)
{
	/* Test target register offset calculation: TARGET_BASE + (src - 1) * 4 */
	zassert_equal(0x3004, aplic_target_off(1), "target 1 offset");
	zassert_equal(0x3008, aplic_target_off(2), "target 2 offset");
	zassert_equal(0x300C, aplic_target_off(3), "target 3 offset");
	zassert_equal(0x3010, aplic_target_off(4), "target 4 offset");
	zassert_equal(0x3104, aplic_target_off(65), "target 65 offset");
}

/* Test APLIC register address constants common to both delivery modes */
ZTEST(intc_riscv_aia, test_aplic_register_addresses)
{
	/* Verify critical APLIC register offsets per AIA spec */
	zassert_equal(0x0000, APLIC_DOMAINCFG, "DOMAINCFG offset");
	zassert_equal(0x0004, APLIC_SOURCECFG_BASE, "SOURCECFG_BASE offset");
	zassert_equal(0x1C00, APLIC_SETIP_BASE, "SETIP_BASE offset");
	zassert_equal(0x1CDC, APLIC_SETIPNUM, "SETIPNUM offset");
	zassert_equal(0x1E00, APLIC_SETIE_BASE, "SETIE_BASE offset");
	zassert_equal(0x1EDC, APLIC_SETIENUM, "SETIENUM offset");
	zassert_equal(0x1F00, APLIC_CLRIE_BASE, "CLRIE_BASE offset");
	zassert_equal(0x1FDC, APLIC_CLRIENUM, "CLRIENUM offset");
	zassert_equal(0x3004, APLIC_TARGET_BASE, "TARGET_BASE offset");
}

/* Test APLIC DOMAINCFG bit definitions */
ZTEST(intc_riscv_aia, test_aplic_domaincfg_bits)
{
	/* Test DOMAINCFG register bit field definitions */
	zassert_equal(BIT(8), APLIC_DOMAINCFG_IE, "IE bit");
	zassert_equal(BIT(2), APLIC_DOMAINCFG_DM, "DM bit");
	zassert_equal(BIT(0), APLIC_DOMAINCFG_BE, "BE bit");
}

/* Test APLIC source mode constants */
ZTEST(intc_riscv_aia, test_aplic_source_modes)
{
	/* Test source mode values per AIA spec */
	zassert_equal(0x0, APLIC_SM_INACTIVE, "SM_INACTIVE");
	zassert_equal(0x1, APLIC_SM_DETACHED, "SM_DETACHED");
	zassert_equal(0x4, APLIC_SM_EDGE_RISE, "SM_EDGE_RISE");
	zassert_equal(0x5, APLIC_SM_EDGE_FALL, "SM_EDGE_FALL");
	zassert_equal(0x6, APLIC_SM_LEVEL_HIGH, "SM_LEVEL_HIGH");
	zassert_equal(0x7, APLIC_SM_LEVEL_LOW, "SM_LEVEL_LOW");
}

/* Test hart index encoding boundaries */
ZTEST(intc_riscv_aia, test_hart_index_boundaries)
{
	/* AIA supports 14-bit hart index (0-16383), same field in both modes */

	/* Test hart 0 */
	uint32_t hart_0 = 0;

	uint32_t encoded_0 = (hart_0 & APLIC_TARGET_HART_MASK) << APLIC_TARGET_HART_SHIFT;

	zassert_equal(0x00000000, encoded_0, "Hart 0 encoding");

	/* Test hart 1 */
	uint32_t hart_1 = 1;

	uint32_t encoded_1 = (hart_1 & APLIC_TARGET_HART_MASK) << APLIC_TARGET_HART_SHIFT;

	zassert_equal(0x00040000, encoded_1, "Hart 1 encoding");

	/* Test hart 2 */
	uint32_t hart_2 = 2;

	uint32_t encoded_2 = (hart_2 & APLIC_TARGET_HART_MASK) << APLIC_TARGET_HART_SHIFT;

	zassert_equal(0x00080000, encoded_2, "Hart 2 encoding");

	/* Test maximum 14-bit hart index (16383) */
	uint32_t hart_max = 16383;

	uint32_t encoded_max = (hart_max & APLIC_TARGET_HART_MASK) << APLIC_TARGET_HART_SHIFT;

	zassert_equal(0xFFFC0000, encoded_max, "Hart 16383 encoding");

	/* Test that values beyond 14-bit are masked correctly */
	uint32_t hart_overflow = 0xFFFFFFFFU;
	uint32_t encoded_overflow = (hart_overflow & APLIC_TARGET_HART_MASK)
				    << APLIC_TARGET_HART_SHIFT;
	zassert_equal(0xFFFC0000, encoded_overflow, "Hart overflow masking");
}

/* Verify functionality of SMAIA extension introduced by AIA */
ZTEST(intc_riscv_aia, test_smaia_isa_ext)
{
	if (!IS_ENABLED(CONFIG_RISCV_ISA_EXT_SMAIA)) {
		ztest_test_skip();
	}

	int ret = -1;

	csr_write(mie, 0);
#ifndef CONFIG_64BIT
	csr_write(mieh, 0);
#endif

	/*
	 * Start at bit 16: bits 0-15 include standard interrupt bits with
	 * architecture-defined WARL behavior (e.g. VSSIE, VSTIE require H-extension).
	 * Bits 16-63 are AIA local interrupt enables and are unconditionally writable.
	 */
	for (uint32_t irq = 16; irq < 64; irq++) {
		irq_enable(irq);
		ret = irq_is_enabled(irq);
		zassert_equal(ret, 1, "Expected IRQ %u in mie is enabled. ret = %d", irq, ret);

		irq_disable(irq);
		ret = irq_is_enabled(irq);
		zassert_equal(ret, 0, "Expected IRQ %u in mie is disabled. ret = %d", irq, ret);
	}
}
```

## src/aplic_direct.c
```c
/*
 * Copyright (c) Qualcomm Technologies, Inc.
 * SPDX-License-Identifier: Apache-2.0
 */

/*
 * APLIC direct delivery mode tests.
 *
 * Only built when CONFIG_RISCV_APLIC_DIRECT is enabled (see CMakeLists.txt);
 */

#include <stdlib.h>

#include <zephyr/arch/arch_inlines.h>
#include <zephyr/arch/cpu.h>
#include <zephyr/devicetree.h>
#include <zephyr/drivers/interrupt_controller/riscv_aia.h>
#include <zephyr/drivers/interrupt_controller/riscv_aplic_direct.h>
#include <zephyr/irq.h>
#include <zephyr/irq_multilevel.h>
#include <zephyr/kernel.h>
#include <zephyr/random/random.h>
#include <zephyr/sys/sys_io.h>
#include <zephyr/ztest.h>
#include <zephyr/ztest_error_hook.h>

#define APLIC_NODE         DT_NODELABEL(aplic)
#define APLIC_BASE         DT_REG_ADDR(APLIC_NODE)
#define APLIC_MAX_PRIORITY DT_PROP(APLIC_NODE, riscv_max_priority)
#define APLIC_NUM_SOURCES  DT_PROP(APLIC_NODE, riscv_num_sources)

#define TEST_IRQ_ID_INVALID 0 /**< Invalid ID per AIA specification */

#define TEST_IRQ_ID    9 /**< First IRQ not used in DT */
#define TEST_IRQ_ID_L2 (IRQ_TO_L2(TEST_IRQ_ID) | CONFIG_2ND_LVL_INTR_00_OFFSET)

#define TEST_IRQ_PRIORITY 1

static struct k_sem isr_sem;      /**< Semaphore used to block until an ISR fires */
static volatile uint32_t hart_id; /**< Captured hart ID set inside the ISR */

/*
 * =====================================================================
 *   Helper functions
 * =====================================================================
 */

static void get_hart_id_isr(const void *arg)
{
	hart_id = arch_proc_id();
	k_sem_give(&isr_sem);
}

static int trigger_aplic_irq(uint32_t irq_id, uint32_t hart)
{
	const uint32_t aplic_setipnum_address = APLIC_BASE + APLIC_SETIPNUM;

	sys_write32(irq_id, aplic_setipnum_address);

	int ret = k_sem_take(&isr_sem, K_SECONDS(1));

	if (ret != 0) {
		const uint32_t topi_address = APLIC_BASE + aplic_topi_off(hart);
		const uint32_t topi_value = sys_read32(topi_address);

		printk("An error occurred while triggering IRQ %u. ret = %d, topi = %u\n", irq_id,
		       ret, topi_value);
	}

	return ret;
}

static uint32_t read_claimi_address(uint32_t hart)
{
	const uint32_t claimi_address = APLIC_BASE + aplic_claimi_off(hart);

	return sys_read32(claimi_address);
}

void ztest_post_fatal_error_hook(unsigned int reason, const struct arch_esf *pEsf)
{
	/* Used in test_aplic_spurious_interrupt to verify conditions of spurious interrupt */

	ARG_UNUSED(pEsf);

	zassert_equal(reason, K_ERR_SPURIOUS_IRQ, "Expected spurious IRQ, got reason %u", reason);

	/* Expect IRQ 0 since aplic_irq_handler is invoked with a clear claimi register */
	zassert_equal(0, riscv_aplic_get_saved_irq(), "Expected IRQ ID %d, got %u", 0,
		      riscv_aplic_get_saved_irq());
}

#ifndef CONFIG_RISCV_APLIC_DIRECT_IRQ_AFFINITY
int riscv_aplic_irq_set_affinity(const struct device *dev, uint32_t irq, uint32_t hart)
{
	/*
	 * Define stub if IRQ affinity is not configured.
	 * Tests that intend to verify affinity behavior are skipped if not configured;
	 * this stub allows the tests to compile without checking if
	 * CONFIG_RISCV_APLIC_DIRECT_IRQ_AFFINITY is defined across the entire suite
	 */
	return 0;
}

int riscv_aia_route_to_hart(uint32_t irq, uint32_t hart)
{
	/*
	 * Define stub if IRQ affinity is not configured.
	 * Tests that intend to verify affinity behavior are skipped if not configured;
	 * this stub allows the tests to compile without checking if
	 * CONFIG_RISCV_APLIC_DIRECT_IRQ_AFFINITY is defined across the entire suite
	 */
	return 0;
}
#endif

/*
 * =====================================================================
 *   Initialize Test Suite
 * =====================================================================
 */

static void *aplic_direct_suite_setup(void)
{
	k_sem_init(&isr_sem, 0, 1);

	irq_connect_dynamic(TEST_IRQ_ID_L2, TEST_IRQ_PRIORITY, get_hart_id_isr, NULL,
			    APLIC_SM_EDGE_RISE);

	return NULL;
}

static void aplic_direct_suite_teardown(void *fixture)
{
	ARG_UNUSED(fixture);

	irq_disconnect_dynamic(TEST_IRQ_ID_L2, TEST_IRQ_PRIORITY, get_hart_id_isr, NULL,
			       APLIC_SM_EDGE_RISE);
}

static void aplic_direct_before_test_setup(void *fixture)
{
	ARG_UNUSED(fixture);

	k_sem_reset(&isr_sem);

	hart_id = 0xDEADBEEFU;

	irq_enable(TEST_IRQ_ID_L2);
}

static void aplic_direct_after_test_setup(void *fixture)
{
	ARG_UNUSED(fixture);

	ztest_set_fault_valid(false);

	/* Ensure any extraneous interrupts are cleared between tests */
	for (uint32_t hart = 0; hart < arch_num_cpus(); hart++) {
		read_claimi_address(hart);
	}

	/* Set interrupt to route to Hart 0 with priority 1 (common case) */
	riscv_aia_route_to_hart(TEST_IRQ_ID_L2, 0);
	riscv_aia_set_priority(TEST_IRQ_ID_L2, 1);

	irq_disable(TEST_IRQ_ID_L2);
}

ZTEST_SUITE(aplic_direct, NULL, aplic_direct_suite_setup, aplic_direct_before_test_setup,
	    aplic_direct_after_test_setup, aplic_direct_suite_teardown);

/*
 * =====================================================================
 *   APLIC Functionality Unit Tests
 * =====================================================================
 */

ZTEST(aplic_direct, test_aplic_direct_basic_isr_sequence)
{
	trigger_aplic_irq(TEST_IRQ_ID, 0);

	zassert_equal(hart_id, 0, "Expected hart 0 but ISR ran on hart %u", hart_id);
}

ZTEST(aplic_direct, test_aplic_direct_saved_device_and_irq_saved)
{
	trigger_aplic_irq(TEST_IRQ_ID, 0);

	zassert_equal(riscv_aplic_get_dev(), riscv_aplic_get_saved_dev(),
		      "Expected device %p, Actual device: %p", riscv_aplic_get_dev(),
		      riscv_aplic_get_saved_dev());
	zassert_equal(TEST_IRQ_ID, riscv_aplic_get_saved_irq(), "Expected IRQ %x, Actual IRQ: %x",
		      TEST_IRQ_ID, riscv_aplic_get_saved_irq());
}

ZTEST(aplic_direct, test_aplic_direct_irq_received_on_secondary_core)
{
	if (!IS_ENABLED(CONFIG_RISCV_APLIC_DIRECT_IRQ_AFFINITY)) {
		ztest_test_skip();
	}

	riscv_aia_route_to_hart(TEST_IRQ_ID_L2, 1);

	trigger_aplic_irq(TEST_IRQ_ID, 1);

	zassert_equal(hart_id, 1, "Expected hart 1 but ISR ran on hart %u", hart_id);
}

ZTEST(aplic_direct, test_aplic_direct_priority_within_config_range)
{
	const uint32_t aplic_min_priority = 0;

	const struct device *aplic = riscv_aplic_get_dev();

	for (uint32_t priority = aplic_min_priority; priority < (APLIC_MAX_PRIORITY + 1);
	     priority++) {
		int ret = riscv_aplic_set_priority(aplic, TEST_IRQ_ID, priority);

		zassert_equal(ret, 0, "Expected IRQ priority configuration to succeed");

		trigger_aplic_irq(TEST_IRQ_ID, 0);

		zassert_not_equal(hart_id, 0xDEADBEEF, "Expected ISR to update Hart ID");
	}
}

ZTEST(aplic_direct, test_aplic_direct_priority_outside_of_config_range)
{
	const struct device *aplic = riscv_aplic_get_dev();

	int ret = riscv_aplic_set_priority(aplic, TEST_IRQ_ID_L2, (APLIC_MAX_PRIORITY + 1));

	zassert_not_equal(ret, 0, "Expected IRQ priority configuration to fail");
}

ZTEST(aplic_direct, test_aplic_direct_random_hart_id)
{
	if (!IS_ENABLED(CONFIG_RISCV_APLIC_DIRECT_IRQ_AFFINITY)) {
		ztest_test_skip();
	}

	const uint32_t num_attempts = 1000;

	for (uint32_t attempts = 0; attempts < num_attempts; ++attempts) {
		const uint32_t random_hart = sys_rand32_get() % arch_num_cpus();

		hart_id = 0xDEADBEEFU;

		riscv_aia_route_to_hart(TEST_IRQ_ID_L2, random_hart);

		trigger_aplic_irq(TEST_IRQ_ID, random_hart);

		zassert_equal(hart_id, random_hart, "Expected hart %u. Actual: hart %u\n",
			      random_hart, hart_id);
	}
}

ZTEST(aplic_direct, test_aplic_direct_random_priority)
{
	const uint32_t num_attempts = 1000;
	const uint32_t aplic_min_priority = 1;
	const uint32_t expected_hart_id = 0;
	const struct device *aplic = riscv_aplic_get_dev();

	for (uint32_t attempts = 0; attempts < num_attempts; ++attempts) {
		const uint32_t random_priority =
			sys_rand32_get() % (APLIC_MAX_PRIORITY - aplic_min_priority) +
			aplic_min_priority;

		hart_id = 0xDEADBEEFU;

		int ret = riscv_aplic_set_priority(aplic, TEST_IRQ_ID, random_priority);

		zassert_equal(ret, 0, "Expected IRQ priority configuration to succeed");

		trigger_aplic_irq(TEST_IRQ_ID, expected_hart_id);

		zassert_equal(hart_id, expected_hart_id, "Expected hart %u. Actual: hart %u\n",
			      expected_hart_id, hart_id);
	}
}

ZTEST(aplic_direct, test_aplic_direct_verify_interrupt_enabled)
{
	int ret = riscv_aia_irq_is_enabled(TEST_IRQ_ID_L2);

	zassert_equal(ret, 1, "Expected test IRQ to be enabled");
}

ZTEST(aplic_direct, test_aplic_direct_verify_interrupt_disabled)
{
	int ret = -1;

	/* In-bounds check */
	riscv_aia_irq_disable(TEST_IRQ_ID_L2);
	ret = riscv_aia_irq_is_enabled(TEST_IRQ_ID_L2);
	zassert_equal(ret, 0, "Expected test IRQ to be disabled");
}

ZTEST(aplic_direct, test_aplic_direct_affinity_out_of_bounds)
{
	if (!IS_ENABLED(CONFIG_RISCV_APLIC_DIRECT_IRQ_AFFINITY)) {
		ztest_test_skip();
	}

	const struct device *aplic = riscv_aplic_get_dev();

	int ret = -1;

	ret = riscv_aplic_irq_set_affinity(aplic, TEST_IRQ_ID_INVALID, 0);
	zassert_not_equal(ret, 0,
			  "Expected affinity configuration to fail due to out of bound IRQ");

	ret = riscv_aplic_irq_set_affinity(aplic, TEST_IRQ_ID_L2, 50);
	zassert_not_equal(ret, 0, "Expected affinity configuration to fail due to invalid Hart ID");
}

ZTEST(aplic_direct, test_aplic_direct_source_mode_configuration)
{
	const uint32_t out_of_range_margin = 2;
	const uint32_t aplic_sm_start = (APLIC_SM_INACTIVE - out_of_range_margin);
	const uint32_t aplic_sm_end = (APLIC_SM_LEVEL_LOW + out_of_range_margin);

	const struct device *aplic_dev = riscv_aplic_get_dev();

	int ret = -1;

	for (uint32_t source_mode = aplic_sm_start; source_mode < aplic_sm_end; source_mode++) {
		ret = riscv_aplic_config_src(aplic_dev, TEST_IRQ_ID_L2, source_mode);

		/* Per AIA modes 0x2 and 0x3 are invalid */
		if ((source_mode == 0x2) || (source_mode == 0x3)) {
			zassert_not_equal(
				ret, 0,
				"Expected invalid source mode to return error. Source mode: %d",
				source_mode);
		} else {
			zassert_equal(ret, 0,
				      "Expected source mode to return success. Source mode: %d",
				      source_mode);
		}
	}
}

ZTEST(aplic_direct, test_aplic_direct_spurious_interrupt)
{
	ztest_set_fault_valid(true);

	/*
	 * Fire an interrupt on each active hart to ensure mcause is set
	 * to 11 (RISCV_IRQ_MEXT). Invoking the aplic handler explicitly
	 * omits this step, leading to non-deterministic mcause
	 */
	for (uint32_t cpu = 0; cpu < arch_num_cpus(); cpu++) {
		riscv_aia_route_to_hart(TEST_IRQ_ID_L2, cpu);

		trigger_aplic_irq(TEST_IRQ_ID, cpu);
	}

	/* Invoke the handler directly to simulate spurious interrupt */
	const struct device *dev = riscv_aplic_get_dev();

	aplic_irq_handler(dev);
}
```

## src/aplic_msi_imsic.c
```c
/*
 * SPDX-FileCopyrightText: Copyright The Zephyr Project Contributors
 *
 * SPDX-License-Identifier: Apache-2.0
 */

/*
 * APLIC MSI delivery mode and IMSIC tests.
 *
 * Only built when CONFIG_RISCV_APLIC_MSI is enabled (see CMakeLists.txt);
 * the EIID/GENMSI/MSIADDRCFG fields and the IMSIC interrupt files tested
 * here only exist when the APLIC domain delivers interrupts as MSIs.
 */

#include <stdint.h>
#include <zephyr/ztest.h>
#include <zephyr/drivers/interrupt_controller/riscv_aplic.h>
#include <zephyr/drivers/interrupt_controller/riscv_imsic.h>

/*
 * APLIC MSI Tests
 */

/* Test APLIC register address constants specific to MSI delivery mode */
ZTEST(intc_riscv_aia, test_aplic_msi_register_addresses)
{
	zassert_equal(0x1BC0, APLIC_MSIADDRCFG, "MSIADDRCFG offset");
	zassert_equal(0x1BC4, APLIC_MSIADDRCFGH, "MSIADDRCFGH offset");
	zassert_equal(0x3000, APLIC_GENMSI, "GENMSI offset");
}

/* Test APLIC TARGET register field encoding */
ZTEST(intc_riscv_aia, test_aplic_target_encoding)
{
	/* Test TARGET register field positions and masks */
	zassert_equal(18, APLIC_TARGET_HART_SHIFT, "hart shift");
	zassert_equal(0x3FFF, APLIC_TARGET_HART_MASK, "hart mask (14-bit)");
	zassert_equal(BIT(11), APLIC_TARGET_MSI_DEL, "MSI_DEL bit");
	zassert_equal(0x7FF, APLIC_TARGET_EIID_MASK, "EIID mask (11-bit)");

	/* Test building a TARGET value: hart=2, MMSI mode, EIID=65 */
	uint32_t target_val = ((2 & APLIC_TARGET_HART_MASK) << APLIC_TARGET_HART_SHIFT) |
			      APLIC_TARGET_MSI_DEL | (65 & APLIC_TARGET_EIID_MASK);

	zassert_equal(0x00080841, target_val, "TARGET encoding");
}

/* Test APLIC GENMSI register field encoding */
ZTEST(intc_riscv_aia, test_aplic_genmsi_encoding)
{
	/* Test GENMSI register field positions and masks */
	zassert_equal(18, APLIC_GENMSI_HART_SHIFT, "GENMSI hart shift");
	zassert_equal(0x3FFF, APLIC_GENMSI_HART_MASK, "GENMSI hart mask (14-bit)");
	zassert_equal(13, APLIC_GENMSI_CONTEXT_SHIFT, "GENMSI context shift");
	zassert_equal(0x1F, APLIC_GENMSI_CONTEXT_MASK, "GENMSI context mask (5-bit)");
	zassert_equal(BIT(12), APLIC_GENMSI_BUSY, "GENMSI busy bit");
	zassert_equal(BIT(11), APLIC_GENMSI_MMSI_MODE, "GENMSI MMSI mode bit");
	zassert_equal(0x7FF, APLIC_GENMSI_EIID_MASK, "GENMSI EIID mask (11-bit)");

	/* Test building a GENMSI value: hart=1, context=0, MMSI mode, EIID=70 */
	uint32_t genmsi_val = ((1 & APLIC_GENMSI_HART_MASK) << APLIC_GENMSI_HART_SHIFT) |
			      ((0 & APLIC_GENMSI_CONTEXT_MASK) << APLIC_GENMSI_CONTEXT_SHIFT) |
			      APLIC_GENMSI_MMSI_MODE | (70 & APLIC_GENMSI_EIID_MASK);

	zassert_equal(0x00040846, genmsi_val, "GENMSI encoding");
}

/* Test APLIC MSIADDRCFGH geometry field encoding */
ZTEST(intc_riscv_aia, test_aplic_msi_geometry_fields)
{
	/* Test MSI address geometry field positions and masks */
	zassert_equal(31, APLIC_MSIADDRCFGH_L_BIT, "lock bit position");
	zassert_equal(24, APLIC_MSIADDRCFGH_HHXS_SHIFT, "HHXS shift");
	zassert_equal(0x1F, APLIC_MSIADDRCFGH_HHXS_MASK, "HHXS mask (5-bit)");
	zassert_equal(20, APLIC_MSIADDRCFGH_LHXS_SHIFT, "LHXS shift");
	zassert_equal(0x7, APLIC_MSIADDRCFGH_LHXS_MASK, "LHXS mask (3-bit)");
	zassert_equal(16, APLIC_MSIADDRCFGH_HHXW_SHIFT, "HHXW shift");
	zassert_equal(0x7, APLIC_MSIADDRCFGH_HHXW_MASK, "HHXW mask (3-bit)");
	zassert_equal(12, APLIC_MSIADDRCFGH_LHXW_SHIFT, "LHXW shift");
	zassert_equal(0xF, APLIC_MSIADDRCFGH_LHXW_MASK, "LHXW mask (4-bit)");
	zassert_equal(0xFFF, APLIC_MSIADDRCFGH_BAPPN_MASK, "BAPPN mask (12-bit)");
}

/*
 * IMSIC Tests
 */

/* Test IMSIC CSR address definitions */
ZTEST(intc_riscv_aia, test_imsic_csr_addresses)
{
	/* Test direct CSR addresses */
	zassert_equal(0x35C, CSR_MTOPEI, "MTOPEI CSR");
	zassert_equal(0xFB0, CSR_MTOPI, "MTOPI CSR");
	zassert_equal(0x350, CSR_MISELECT, "MISELECT CSR");
	zassert_equal(0x351, CSR_MIREG, "MIREG CSR");
	zassert_equal(0xFC0, CSR_SETEIPNUM_M, "SETEIPNUM_M CSR");
	zassert_equal(0xFC1, CSR_CLREIPNUM_M, "CLREIPNUM_M CSR");

	/* Test indirect CSR addresses */
	zassert_equal(0x70, ICSR_EIDELIVERY, "EIDELIVERY indirect CSR");
	zassert_equal(0x72, ICSR_EITHRESH, "EITHRESH indirect CSR");

	/* Test EIP register addresses (EIP0-EIP7) */
	zassert_equal(0x80, ICSR_EIP0, "EIP0 indirect CSR");
	zassert_equal(0x81, ICSR_EIP1, "EIP1 indirect CSR");
	zassert_equal(0x82, ICSR_EIP2, "EIP2 indirect CSR");
	zassert_equal(0x87, ICSR_EIP7, "EIP7 indirect CSR");

	/* Test EIE register addresses (EIE0-EIE7) */
	zassert_equal(0xC0, ICSR_EIE0, "EIE0 indirect CSR");
	zassert_equal(0xC1, ICSR_EIE1, "EIE1 indirect CSR");
	zassert_equal(0xC2, ICSR_EIE2, "EIE2 indirect CSR");
	zassert_equal(0xC7, ICSR_EIE7, "EIE7 indirect CSR");
}

/* Test IMSIC MTOPEI field masks */
ZTEST(intc_riscv_aia, test_imsic_mtopei_fields)
{
	/* Test MTOPEI register field masks */
	zassert_equal(0x7FF, MTOPEI_EIID_MASK, "EIID mask (11-bit)");
	zassert_equal(16, MTOPEI_PRIO_SHIFT, "Priority shift");
	zassert_equal(0xFF0000, MTOPEI_PRIO_MASK, "Priority mask (8-bit at bit 16)");

	/* Test extracting EIID from MTOPEI value */
	uint32_t mtopei_val = 0x00410042; /* Priority=0x41, EIID=66 */
	uint32_t eiid = mtopei_val & MTOPEI_EIID_MASK;

	zassert_equal(66, eiid, "EIID extraction");

	/* Test extracting priority from MTOPEI value */
	uint32_t prio = (mtopei_val & MTOPEI_PRIO_MASK) >> MTOPEI_PRIO_SHIFT;

	zassert_equal(0x41, prio, "Priority extraction");
}

/* Test IMSIC EIDELIVERY mode definitions */
ZTEST(intc_riscv_aia, test_imsic_eidelivery_modes)
{
	/* Test EIDELIVERY register field values */
	zassert_equal(BIT(0), EIDELIVERY_ENABLE, "enable bit");
	zassert_equal(0x00000000, EIDELIVERY_MODE_MMSI, "MMSI mode (00)");

	/* Test building EIDELIVERY value for MMSI mode */
	uint32_t eidelivery_mmsi = EIDELIVERY_ENABLE | EIDELIVERY_MODE_MMSI;

	zassert_equal(0x00000001, eidelivery_mmsi, "EIDELIVERY MMSI enabled");
}

/* Test IMSIC EIE register indexing */
ZTEST(intc_riscv_aia, test_imsic_eie_indexing)
{
	/* IMSIC implements 8 EIE registers (EIE0-EIE7), 32 IDs each = 256 total EIIDs */

	/* Test EIID to EIE register mapping */
	/* EIID 0-31 -> EIE0, EIID 32-63 -> EIE1, etc. */

	/* Test register index calculation: eiid / 32 */
	uint32_t reg_index_0 = 0 / 32U;

	zassert_equal(0, reg_index_0, "EIID 0 -> EIE0");

	uint32_t reg_index_31 = 31 / 32U;

	zassert_equal(0, reg_index_31, "EIID 31 -> EIE0");

	uint32_t eiid_32 = 32;
	uint32_t reg_index_32 = eiid_32 / 32U;

	zassert_equal(1, reg_index_32, "EIID 32 -> EIE1");

	uint32_t reg_index_65 = 65 / 32U;

	zassert_equal(2, reg_index_65, "EIID 65 -> EIE2");

	uint32_t reg_index_255 = 255 / 32U;

	zassert_equal(7, reg_index_255, "EIID 255 -> EIE7");

	/* Test bit position calculation: eiid % 32 */

	uint32_t bit_0 = 0 % 32U;

	zassert_equal(0, bit_0, "EIID 0 -> bit 0");

	uint32_t bit_31 = 31 % 32U;

	zassert_equal(31, bit_31, "EIID 31 -> bit 31");

	uint32_t eiid_32_bit = 32;
	uint32_t bit_32 = eiid_32_bit % 32U;

	zassert_equal(0, bit_32, "EIID 32 -> bit 0");

	uint32_t bit_65 = 65 % 32U;

	zassert_equal(1, bit_65, "EIID 65 -> bit 1");
}

/* Test IMSIC EIE bit manipulation */
ZTEST(intc_riscv_aia, test_imsic_eie_bit_operations)
{
	/* Test setting bits in EIE registers */
	uint32_t eie0 = 0x00000000;

	/* Enable EIID 0 (bit 0 of EIE0) */
	eie0 |= BIT(0);
	zassert_equal(0x00000001, eie0, "Enable EIID 0");

	/* Enable EIID 31 (bit 31 of EIE0) */
	eie0 |= BIT(31);
	zassert_equal(0x80000001, eie0, "Enable EIID 31");

	/* Test clearing bits */
	eie0 &= ~BIT(0);
	zassert_equal(0x80000000, eie0, "Disable EIID 0");

	/* Test checking bit state */
	zassert_true(!!(eie0 & BIT(31)), "EIID 31 is enabled");
	zassert_false(!!(eie0 & BIT(0)), "EIID 0 is disabled");
}

/* Test IMSIC CSR address calculation for indirect access */
ZTEST(intc_riscv_aia, test_imsic_indirect_csr_addressing)
{
	/* Test calculating indirect CSR address for EIE registers */
	/* EIE0 = 0xC0, EIE1 = 0xC1, ..., EIE7 = 0xC7 */

	uint32_t eie0_addr = ICSR_EIE0 + 0;

	zassert_equal(0xC0, eie0_addr, "EIE0 address");

	uint32_t eie1_addr = ICSR_EIE0 + 1;

	zassert_equal(0xC1, eie1_addr, "EIE1 address");

	uint32_t eie7_addr = ICSR_EIE0 + 7;

	zassert_equal(0xC7, eie7_addr, "EIE7 address");

	/* Test calculating indirect CSR address for EIP registers */

	/* EIP0 = 0x80, EIP1 = 0x81, ..., EIP7 = 0x87 */

	uint32_t eip0_addr = ICSR_EIP0 + 0;

	zassert_equal(0x80, eip0_addr, "EIP0 address");

	uint32_t eip1_addr = ICSR_EIP0 + 1;

	zassert_equal(0x81, eip1_addr, "EIP1 address");

	uint32_t eip7_addr = ICSR_EIP0 + 7;

	zassert_equal(0x87, eip7_addr, "EIP7 address");
}

/*
 * Integration Tests
 */

/* Test that APLIC and IMSIC work together for MSI routing */
ZTEST(intc_riscv_aia, test_aia_msi_routing_encoding)
{
	/* Test encoding an MSI route: source 10 -> hart 1, EIID 65 */
	uint32_t hart = 1;
	uint32_t eiid = 65;

	/* APLIC TARGET register encoding */
	uint32_t target_val = ((hart & APLIC_TARGET_HART_MASK) << APLIC_TARGET_HART_SHIFT) |
			      APLIC_TARGET_MSI_DEL | (eiid & APLIC_TARGET_EIID_MASK);

	zassert_equal(0x00040841, target_val, "MSI routing encoding");

	/* IMSIC EIE register and bit for EIID 65 */
	uint32_t eie_reg_index = eiid / 32U;                /* 65 / 32 = 2 -> EIE2 */
	uint32_t eie_bit = eiid % 32U;                      /* 65 % 32 = 1 -> bit 1 */
	uint32_t eie_icsr_addr = ICSR_EIE0 + eie_reg_index; /* 0xC0 + 2 = 0xC2 */

	zassert_equal(2, eie_reg_index, "EIID 65 -> EIE2");
	zassert_equal(1, eie_bit, "EIID 65 -> bit 1");
	zassert_equal(0xC2, eie_icsr_addr, "EIE2 address");
}

/* Test EIID range boundaries */
ZTEST(intc_riscv_aia, test_eiid_range_boundaries)
{
	/* AIA supports 11-bit EIID (0-2047), but practical limit depends on CONFIG_NUM_IRQS */

	/* Test EIID 0 (reserved, should not be used) */
	uint32_t eiid_0 = 0;

	zassert_equal(0, eiid_0 & APLIC_TARGET_EIID_MASK, "EIID 0 encoding");

	/* Test minimum valid EIID (1) */
	uint32_t eiid_1 = 1;

	zassert_equal(1, eiid_1 & APLIC_TARGET_EIID_MASK, "EIID 1 encoding");

	/* Test common EIID values used in tests */
	uint32_t eiid_65 = 65;

	zassert_equal(65, eiid_65 & APLIC_TARGET_EIID_MASK, "EIID 65 encoding");

	uint32_t eiid_70 = 70;

	zassert_equal(70, eiid_70 & APLIC_TARGET_EIID_MASK, "EIID 70 encoding");

	/* Test maximum 11-bit EIID (2047) */
	uint32_t eiid_max = 2047;

	zassert_equal(2047, eiid_max & APLIC_TARGET_EIID_MASK, "EIID 2047 encoding");

	/* Test that values beyond 11-bit are masked correctly */
	uint32_t eiid_overflow = 0xFFFFFFFFU;

	zassert_equal(0x7FF, eiid_overflow & APLIC_TARGET_EIID_MASK, "EIID overflow masking");
}
```
