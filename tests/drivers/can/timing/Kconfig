## tests/drivers/can/timing/Kconfig
```kconfig
# Copyright (c) 2024 Vestas Wind Systems A/S
# SPDX-License-Identifier: Apache-2.0

mainmenu "CAN timing test"

config TEST_ALL_BITRATES
	bool "Test all CAN in Automation (CiA) recommended bitrates"
	help
	  Enable test of all bitrates recommended by CAN in Automation (CiA). Not all CAN
	  controllers can meet all of the bitrates listed below, and some board configurations may
	  impose limits on which bitrates can be met due to limitations in the CAN core clock
	  frequency selection.

	  CiA 301 lists the following nominal bitrates as recommended:
	  - 10 kbit/s
	  - 20 kbit/s
	  - 50 kbit/s
	  - 125 kbit/s
	  - 250 kbit/s
	  - 500 kbit/s
	  - 800 kbit/s
	  - 1 Mbit/s

	  CiA 601-2 lists the following exemplary CAN FD data phase bitrates:
	  - 1.0 Mbit/s
	  - 2.0 Mbit/s
	  - 4.0 Mbit/s
	  - 5.0 Mbit/s
	  - 8.0 Mbit/s

	  CiA 601-3 recommends the following CAN FD core clock frequencies for good node
	  interoperability. The higher the frequency, the better:
	  - 20 MHz
	  - 40 MHz
	  - 80 MHz

	  If this option is not enabled, the tests will be limited to a historical, safe set of CAN
	  bitrates.

source "Kconfig.zephyr"
```

## tests/drivers/can/timing/boards/nucleo_n657x0_q_stm32n657xx_sb.conf
```kconfig
# SPDX-FileCopyrightText: Copyright The Zephyr Project Contributors
# SPDX-License-Identifier: Apache-2.0

CONFIG_TEST_ALL_BITRATES=y
CONFIG_TEST_USERSPACE=n
```

## tests/drivers/can/timing/testcase.yaml
```yaml
tests:
  drivers.can.timing:
    tags:
      - drivers
      - can
    depends_on: can
    filter: dt_chosen_enabled("zephyr,canbus") and not dt_compat_enabled("xlnx,canfd-2.0")
```

## tests/drivers/can/utilities/testcase.yaml
```yaml
tests:
  drivers.can.utilities:
    integration_platforms:
      - native_posix
      - native_posix_64
    tags: drivers can
```

## tests/drivers/charger/sbs_charger/boards/qemu_cortex_a53.conf
```kconfig
# Copyright (c) 2023 Cirrus Logic, Inc.
# SPDX-License-Identifier: Apache-2.0

CONFIG_EMUL=y
```

## tests/drivers/charger/sbs_charger/testcase.yaml
```yaml
common:
  platform_key:
    - arch
    - simulation
  tags:
    - drivers
    - charger
tests:
  # section.subsection
  drivers.charger.sbs.emulated:
    filter: dt_compat_enabled("sbs,sbs-charger")
    extra_args:
      CONF_FILE="prj.conf;boards/emulated_board.conf"
      DTC_OVERLAY_FILE="boards/emulated_board.overlay"
    platform_exclude:
      - qemu_cortex_a53
      - qemu_cortex_a53/qemu_cortex_a53/smp
      - qemu_kvm_arm64
      - xenvm
      - xenvm/xenvm/gicv3
      - hifive_unmatched
      - rcar_h3ulcb/r8a77951/a57
      - rcar_salvator_xs
      - numaker_pfm_m467
  drivers.charger.sbs.emulated_64_bit_i2c_addr:
    filter: dt_compat_enabled("sbs,sbs-charger")
    platform_allow:
      - qemu_cortex_a53
      - qemu_cortex_a53/qemu_cortex_a53/smp
      - qemu_kvm_arm64
      - xenvm
      - xenvm/xenvm/gicv3
    extra_args:
      CONF_FILE="prj.conf;boards/qemu_cortex_a53.conf"
      DTC_OVERLAY_FILE="boards/qemu_cortex_a53.overlay"
```

## tests/drivers/clock_control/adsp_clock/testcase.yaml
```yaml
tests:
  drivers.clock.adsp_clock_control:
    tags: drivers clock
    platform_allow: intel_adsp_cavs15 intel_adsp_cavs18 intel_adsp_cavs20 intel_adsp_cavs25
    integration_platforms:
      - intel_adsp_cavs25
```

## tests/drivers/clock_control/cavs_clock/testcase.yaml
```yaml
tests:
  drivers.clock.cavs_clock_control:
    tags: drivers
    platform_allow: intel_adsp_cavs15 intel_adsp_cavs18 intel_adsp_cavs20 intel_adsp_cavs25
```

## tests/drivers/clock_control/clock_control_api/Kconfig
```kconfig
# Copyright (c) 2025 Nordic Semiconductor ASA
# SPDX-License-Identifier: Apache-2.0

config TEST_NRF_HF_STARTUP_TIME_US
	int "Delay required for HF clock startup."
	default 3000 if CONFIG_SOC_SERIES_NRF91X
	default 500
	depends on SOC_FAMILY_NORDIC_NRF
	help
	  Delay in microseconds required for high-frequency
	  clock startup.

source "Kconfig.zephyr"
```

## tests/drivers/clock_control/clock_control_api/boards/sam_e54_xpro.conf
```kconfig
# Copyright (c) 2025 Microchip Technology Inc.
# SPDX-License-Identifier: Apache-2.0

CONFIG_CLOCK_CONTROL_MCHP_ASYNC_ON=y
```

## tests/drivers/clock_control/clock_control_api/testcase.yaml
```yaml
common:
  tags:
    - drivers
    - clock_control
tests:
  drivers.clock.clock_control_api_default:
    platform_allow:
      - esp32_devkitc_wroom/esp32/procpu
      - esp32_devkitc_wrover/esp32/procpu
      - esp32c3_devkitm
      - esp32s2_saola
      - esp32s3_devkitm/esp32s3/procpu
      - sltb010a@0
      - xg24_dk2601b
      - xg27_dk2602a
      - xg29_rb4412a
    integration_platforms:
      - esp32_devkitc_wroom/esp32/procpu
  drivers.clock.clock_control_nrf5:
    platform_allow:
      - nrf51dk/nrf51822
      - nrf52dk/nrf52832
      - nrf52840dk/nrf52840
      - nrf9160dk/nrf9160
      - nrf54l09pdk/nrf54l09/cpuapp
      - nrf54l15dk/nrf54l15/cpuapp
      - nrf54l20pdk/nrf54l20/cpuapp
    integration_platforms:
      - nrf51dk/nrf51822
  drivers.clock.clock_control_nrf5_lfclk_rc:
    platform_allow:
      - nrf51dk/nrf51822
      - nrf52dk/nrf52832
      - nrf52840dk/nrf52840
      - nrf54l09pdk/nrf54l09/cpuapp
      - nrf54l15dk/nrf54l15/cpuapp
      - nrf54l20pdk/nrf54l20/cpuapp
    integration_platforms:
      - nrf51dk/nrf51822
    extra_args: CONF_FILE="nrf_lfclk_rc.conf"
```

## tests/drivers/clock_control/fixed_clock/testcase.yaml
```yaml
tests:
  drivers.clock.clock_control_fixed_clock:
    tags:
      - drivers
      - clock
    platform_allow:
      - native_sim/native/64
```

## tests/drivers/clock_control/nrf2_clock_control/testcase.yaml
```yaml
tests:
  drivers.clock.nrf2_clock_control:
    tags:
      - drivers
      - clock_control
    platform_allow:
      - nrf54h20dk/nrf54h20/cpuapp
```

## tests/drivers/clock_control/nrf_clock_calibration/Kconfig
```kconfig
# Copyright (c) 2020 Nordic Semiconductor ASA
# SPDX-License-Identifier: Apache-2.0

if CLOCK_CONTROL_NRF

config CLOCK_CONTROL_NRF_USES_TEMP_SENSOR
	bool "Internal"
	help
	  Used internally to enable mocking of temperature sensor
endif # CLOCK_CONTROL_NRF

if !CLOCK_CONTROL_NRF
config CLOCK_CONTROL_NRFX_USES_TEMP_SENSOR
	bool "Internal"
	help
	  Used internally to enable mocking of temperature sensor
endif # !CLOCK_CONTROL_NRF

source "Kconfig.zephyr"
```

## tests/drivers/clock_control/nrf_clock_calibration/testcase.yaml
```yaml
tests:
  drivers.clock.nrf5_clock_calibration:
    timeout: 30
    tags:
      - drivers
      - clock_control
    extra_configs:
      - CONFIG_CLOCK_CONTROL_NRF=n
      - CONFIG_CLOCK_CONTROL_NRFX_CALIBRATION_MAX_SKIP=1
      - CONFIG_CLOCK_CONTROL_NRFX_CALIBRATION_TEMP_DIFF=2
      - CONFIG_CLOCK_CONTROL_NRFX_CALIBRATION_PERIOD=150
      - CONFIG_CLOCK_CONTROL_NRFX_CALIBRATION_DEBUG=y
      - CONFIG_CLOCK_CONTROL_NRFX_CALIBRATION_LF_ALWAYS_ON=n
      - CONFIG_CLOCK_CONTROL_NRFX_USES_TEMP_SENSOR=n
    platform_allow:
      - nrf51dk/nrf51822
      - nrf54l15dk/nrf54l15/cpuapp
      - nrf54l15dk/nrf54l15/cpuapp/ns
      - nrf54lm20dk/nrf54lm20a/cpuapp
      - nrf54lm20dk/nrf54lm20b/cpuapp
      - nrf7120dk/nrf7120/cpuapp
      - nrf7120dk/nrf7120/cpuapp/ns
      - ophelia4ev/nrf54l15/cpuapp
    integration_platforms:
      - nrf51dk/nrf51822
    extra_args:
      - EXTRA_DTC_OVERLAY_FILE="boards/nrf5_series.overlay"
  drivers.clock.nrf52_clock_calibration:
    timeout: 30
    tags:
      - drivers
      - clock_control
    extra_configs:
      - CONFIG_CLOCK_CONTROL_NRF=n
      - CONFIG_CLOCK_CONTROL_NRFX_CALIBRATION_MAX_SKIP=1
      - CONFIG_CLOCK_CONTROL_NRFX_CALIBRATION_TEMP_DIFF=2
      - CONFIG_CLOCK_CONTROL_NRFX_CALIBRATION_PERIOD=150
      - CONFIG_CLOCK_CONTROL_NRFX_CALIBRATION_DEBUG=y
      - CONFIG_CLOCK_CONTROL_NRFX_CALIBRATION_LF_ALWAYS_ON=n
      - CONFIG_CLOCK_CONTROL_NRFX_USES_TEMP_SENSOR=n
    platform_allow:
      - nrf52dk/nrf52832
      - nrf52840dk/nrf52840
    integration_platforms:
      - nrf52dk/nrf52832
    extra_args:
      - EXTRA_DTC_OVERLAY_FILE="boards/nrf52_series.overlay"
  drivers.clock.nrf5_clock_calibration.legacy:
    timeout: 30
    tags:
      - drivers
      - clock_control
    extra_configs:
      - CONFIG_CLOCK_CONTROL_NRF=y
      - CONFIG_DEPRECATION_TEST=y
      - CONFIG_CLOCK_CONTROL_NRF_K32SRC_RC=y
      - CONFIG_CLOCK_CONTROL_NRF_CALIBRATION_MAX_SKIP=1
      - CONFIG_CLOCK_CONTROL_NRF_CALIBRATION_TEMP_DIFF=2
      - CONFIG_CLOCK_CONTROL_NRF_CALIBRATION_PERIOD=150
      - CONFIG_CLOCK_CONTROL_NRF_CALIBRATION_DEBUG=y
      - CONFIG_CLOCK_CONTROL_NRF_CALIBRATION_LF_ALWAYS_ON=n
      - CONFIG_CLOCK_CONTROL_NRF_USES_TEMP_SENSOR=n
    platform_allow:
      - nrf51dk/nrf51822
      - nrf54l15dk/nrf54l15/cpuapp
      - nrf54l15dk/nrf54l15/cpuapp/ns
      - nrf54lm20dk/nrf54lm20a/cpuapp
      - nrf54lm20dk/nrf54lm20b/cpuapp
      - nrf7120dk/nrf7120/cpuapp
      - ophelia4ev/nrf54l15/cpuapp
    integration_platforms:
      - nrf51dk/nrf51822
    extra_args:
      - EXTRA_DTC_OVERLAY_FILE="boards/nrf5_series.overlay"
  drivers.clock.nrf52_clock_calibration.legacy:
    timeout: 30
    tags:
      - drivers
      - clock_control
    extra_configs:
      - CONFIG_CLOCK_CONTROL_NRF=y
      - CONFIG_DEPRECATION_TEST=y
      - CONFIG_CLOCK_CONTROL_NRF_K32SRC_RC=y
      - CONFIG_CLOCK_CONTROL_NRF_CALIBRATION_MAX_SKIP=1
      - CONFIG_CLOCK_CONTROL_NRF_CALIBRATION_TEMP_DIFF=2
      - CONFIG_CLOCK_CONTROL_NRF_CALIBRATION_PERIOD=150
      - CONFIG_CLOCK_CONTROL_NRF_CALIBRATION_DEBUG=y
      - CONFIG_CLOCK_CONTROL_NRF_CALIBRATION_LF_ALWAYS_ON=n
      - CONFIG_CLOCK_CONTROL_NRF_USES_TEMP_SENSOR=n
    platform_allow:
      - nrf52dk/nrf52832
      - nrf52840dk/nrf52840
    integration_platforms:
      - nrf52dk/nrf52832
    extra_args:
      - EXTRA_DTC_OVERLAY_FILE="boards/nrf52_series.overlay"
```

## tests/drivers/clock_control/nrf_clock_control/Kconfig
```kconfig
# Copyright (c) 2026 Nordic Semiconductor ASA
# SPDX-License-Identifier: Apache-2.0

config TEST_FLL16M
	bool "Run test on the FLL16M"
	default y if SOC_NRF54H20_CPUAPP
	help
	  When set to 'y' tests of FLL16M are executed.

config TEST_HSFLL_APP
	bool "Run test on the HSFLL APP"
	default y if SOC_NRF54H20_CPUAPP
	help
	  When set to 'y' tests of HSFLL APP are executed.

config TEST_HSFLL_RAD
	bool "Run test on the HSFLL RAD"
	default y if SOC_NRF54H20_CPURAD
	help
	  When set to 'y' tests of HSFLL RAD are executed.

config TEST_DVFS_INIT
	bool "Check DVFS initialization"
	default y if SOC_NRF54H20_CPUAPP
	help
	  When set to 'y' DVFS is initialised at the beginning of the test suite.

source "Kconfig.zephyr"
```

## tests/drivers/clock_control/nrf_clock_control/testcase.yaml
```yaml
tests:
  drivers.clock.nrf_clock_control:
    tags:
      - drivers
      - clock_control
    platform_allow:
      - nrf54h20dk/nrf54h20/cpuapp
```

## tests/drivers/clock_control/nrf_lf_clock_start/testcase.yaml
```yaml
common:
  tags:
    - drivers
    - clock_control
  integration_platforms:
    - nrf51dk/nrf51822
tests:
  drivers.clock.nrf_lf_clock_start_xtal_stable:
    platform_allow:
      - nrf51dk/nrf51822
      - nrf52dk/nrf52832
      - nrf52840dk/nrf52840
      - nrf9160dk/nrf9160
      - nrf5340dk/nrf5340/cpuapp
      - nrf5340dk/nrf5340/cpunet
      - nrf54l15pdk/nrf54l15/cpuapp
    extra_configs:
      - CONFIG_SYSTEM_CLOCK_WAIT_FOR_STABILITY=y
      - CONFIG_CLOCK_CONTROL_NRF_K32SRC_XTAL=y
    integration_platforms:
      - nrf51dk/nrf51822

  drivers.clock.nrf_lf_clock_start_xtal_available:
    platform_allow:
      - nrf51dk/nrf51822
      - nrf52dk/nrf52832
      - nrf52840dk/nrf52840
      - nrf9160dk/nrf9160
      - nrf5340dk/nrf5340/cpuapp
      - nrf5340dk/nrf5340/cpunet
      - nrf54l15pdk/nrf54l15/cpuapp
    extra_configs:
      - CONFIG_SYSTEM_CLOCK_WAIT_FOR_AVAILABILITY=y
      - CONFIG_CLOCK_CONTROL_NRF_K32SRC_XTAL=y
    integration_platforms:
      - nrf51dk/nrf51822

  drivers.clock.nrf_lf_clock_start_xtal_no_wait:
    platform_allow:
      - nrf51dk/nrf51822
      - nrf52dk/nrf52832
      - nrf52840dk/nrf52840
      - nrf9160dk/nrf9160
      - nrf5340dk/nrf5340/cpuapp
      - nrf5340dk/nrf5340/cpunet
      - nrf54l15pdk/nrf54l15/cpuapp
    integration_platforms:
      - nrf51dk/nrf51822
    extra_configs:
      - CONFIG_SYSTEM_CLOCK_NO_WAIT=y
      - CONFIG_CLOCK_CONTROL_NRF_K32SRC_XTAL=y

  drivers.clock.nrf_lf_clock_start_rc_stable:
    platform_allow:
      - nrf51dk/nrf51822
      - nrf52dk/nrf52832
      - nrf52840dk/nrf52840
      - nrf5340dk/nrf5340/cpuapp
      - nrf5340dk/nrf5340/cpunet
      - nrf54l15pdk/nrf54l15/cpuapp
    integration_platforms:
      - nrf51dk/nrf51822
    extra_configs:
      - CONFIG_SYSTEM_CLOCK_WAIT_FOR_STABILITY=y
      - CONFIG_CLOCK_CONTROL_NRF_K32SRC_RC=y

  drivers.clock.nrf_lf_clock_start_rc_available:
    platform_allow:
      - nrf51dk/nrf51822
      - nrf52dk/nrf52832
      - nrf52840dk/nrf52840
      - nrf5340dk/nrf5340/cpuapp
      - nrf5340dk/nrf5340/cpunet
      - nrf54l15pdk/nrf54l15/cpuapp
    integration_platforms:
      - nrf51dk/nrf51822
    extra_configs:
      - CONFIG_SYSTEM_CLOCK_WAIT_FOR_AVAILABILITY=y
      - CONFIG_CLOCK_CONTROL_NRF_K32SRC_RC=y

  drivers.clock.nrf_lf_clock_start_rc_no_wait:
    platform_allow:
      - nrf51dk/nrf51822
      - nrf52dk/nrf52832
      - nrf52840dk/nrf52840
      - nrf5340dk/nrf5340/cpuapp
      - nrf5340dk/nrf5340/cpunet
      - nrf54l15pdk/nrf54l15/cpuapp
    integration_platforms:
      - nrf51dk/nrf51822
    extra_configs:
      - CONFIG_SYSTEM_CLOCK_NO_WAIT=y
      - CONFIG_CLOCK_CONTROL_NRF_K32SRC_RC=y

  drivers.clock.nrf_lf_clock_start_synth_stable:
    platform_allow:
      - nrf51dk/nrf51822
      - nrf52dk/nrf52832
      - nrf52840dk/nrf52840
      - nrf5340dk/nrf5340/cpuapp
      - nrf5340dk/nrf5340/cpunet
      - nrf54l15pdk/nrf54l15/cpuapp
    integration_platforms:
      - nrf51dk/nrf51822
    extra_configs:
      - CONFIG_SYSTEM_CLOCK_WAIT_FOR_STABILITY=y
      - CONFIG_CLOCK_CONTROL_NRF_K32SRC_SYNTH=y

  drivers.clock.nrf_lf_clock_start_synth_available:
    platform_allow:
      - nrf51dk/nrf51822
      - nrf52dk/nrf52832
      - nrf52840dk/nrf52840
      - nrf5340dk/nrf5340/cpuapp
      - nrf5340dk/nrf5340/cpunet
      - nrf54l15pdk/nrf54l15/cpuapp
    integration_platforms:
      - nrf51dk/nrf51822
    extra_configs:
      - CONFIG_SYSTEM_CLOCK_WAIT_FOR_AVAILABILITY=y
      - CONFIG_CLOCK_CONTROL_NRF_K32SRC_SYNTH=y

  drivers.clock.nrf_lf_clock_start_synth_no_wait:
    platform_allow:
      - nrf51dk/nrf51822
      - nrf52dk/nrf52832
      - nrf52840dk/nrf52840
      - nrf5340dk/nrf5340/cpuapp
      - nrf5340dk/nrf5340/cpunet
      - nrf54l15pdk/nrf54l15/cpuapp
    integration_platforms:
      - nrf51dk/nrf51822
    extra_configs:
      - CONFIG_SYSTEM_CLOCK_NO_WAIT=y
      - CONFIG_CLOCK_CONTROL_NRF_K32SRC_SYNTH=y
```

## tests/drivers/clock_control/nrf_onoff_and_bt/testcase.yaml
```yaml
tests:
  drivers.clock.nrf_onoff_and_bt:
    tags:
      - drivers
      - clock_control
    platform_allow:
      - nrf51dk/nrf51822
      - nrf52dk/nrf52832
      - nrf52840dk/nrf52840
      - nrf54l15dk/nrf54l15/cpuapp
    integration_platforms:
      - nrf54l15dk/nrf54l15/cpuapp
```

## tests/drivers/clock_control/nxp_clock_configuration/external/testcase.yaml
```yaml
tests:
  drivers.clock.clock_control.nxp_external:
    tags:
      - drivers
      - clock
    platform_allow:
      - lpcxpresso55s69/lpc55s69/cpu0
```
