/*
 * Copyright (c) 2026 Realtek Semiconductor Corp.
 * SPDX-License-Identifier: Apache-2.0
 */

/ {
	chosen {
		zephyr,canbus = &can0;
	};
};

&can0 {
	status = "okay";
	pinctrl-0 = <&can0_default>;
	pinctrl-names = "default";
};
