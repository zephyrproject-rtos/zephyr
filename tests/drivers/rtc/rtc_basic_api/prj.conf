## CMakeLists.txt
```
# SPDX-License-Identifier: Apache-2.0

cmake_minimum_required(VERSION 3.13.1)
include($ENV{ZEPHYR_BASE}/cmake/app/boilerplate.cmake NO_POLICY_SCOPE)
project(rtc_basic_api)

FILE(GLOB app_sources src/*.c)
target_sources(app PRIVATE ${app_sources})
```

## prj.conf
```kconfig
CONFIG_RTC=y
CONFIG_ZTEST=y
```

## src/main.c
```c
/*
 * Copyright (c) 2016 Intel Corporation
 *
 * SPDX-License-Identifier: Apache-2.0
 */

/**
 * @addtogroup t_driver_rtc
 * @{
 * @defgroup t_rtc_basic_api test_rtc_basic_api
 * @}
 */

#include "test_rtc.h"

void test_main(void)
{
	ztest_test_suite(rtc_basic_test,
			 ztest_unit_test(test_rtc_alarm),
			 ztest_unit_test(test_rtc_calendar));
	ztest_run_test_suite(rtc_basic_test);
}
```

## src/test_rtc.h
```c
/*
 * Copyright (c) 2016 Intel Corporation
 *
 * SPDX-License-Identifier: Apache-2.0
 */

/**
 * @file
 * @brief RTC cases header file
 *
 * Header file for RTC cases
 */

#ifndef __TEST_RTC_H__
#define __TEST_RTC_H__

#include <drivers/rtc.h>
#include <zephyr.h>
#include <ztest.h>

#define RTC_DEVICE_NAME CONFIG_RTC_0_NAME

void test_rtc_calendar(void);
void test_rtc_alarm(void);

#endif /* __TEST_RTC_H__ */
```

## src/test_rtc_alarm.c
```c
/*
 * Copyright (c) 2016 Intel Corporation.
 *
 * SPDX-License-Identifier: Apache-2.0
 */

/*
 * @addtogroup t_rtc_basic_api
 * @{
 * @defgroup t_rtc_alarm test_rtc_alarm
 * @brief TestPurpose: verify RTC alarm work and pending interrupt detected
 * @details
 * - Test Steps
 *   -# Enable RTC internal counter
 *   -# Configure RTC with init_val, alarm_val, cb_fn and enable RTC alarm
 *   -# Sleep for while waiting for RTC alarm
 *   -# Reconfigure RTC to alarm 1 second later using rtc_set_alarm()
 *   -# Sleep for while waiting for RTC alarm
 *   -# Disable RTC internal counter and repeat previous operations
 * - Expected Results
 *   -# When RTC internal counter is enabled, RTC alarm can be invoked using
 *      both rtc_set_config() and rtc_set_alarm()
 *   -# When RTC internal counter is disabled, RTC alarm won't be invoked.
 * @}
 */

#include "test_rtc.h"

static bool rtc_alarm_up;

static void rtc_alarm_callback(struct device *rtc_dev)
{

	TC_PRINT("%s: Invoked\n", __func__);
	TC_PRINT("RTC counter: %u\n", rtc_read(rtc_dev));

	/* Verify rtc_get_pending_int() */
	if (rtc_get_pending_int(rtc_dev)) {
		TC_PRINT("Catch pending RTC interrupt\n");
	} else {
		TC_PRINT("Fail to catch pending RTC interrupt\n");
	}

	rtc_alarm_up = true;
}

static int test_alarm(void)
{
	struct rtc_config config;
	struct device *rtc = device_get_binding(RTC_DEVICE_NAME);

	if (!rtc) {
		TC_PRINT("Cannot get RTC device\n");
		return TC_FAIL;
	}

	config.init_val = 0U;
	config.alarm_enable = 1U;
	config.alarm_val = RTC_ALARM_SECOND;
	config.cb_fn = rtc_alarm_callback;

	rtc_enable(rtc);

	/* 1. Verify rtc_set_config() */
	rtc_alarm_up = false;
	if (rtc_set_config(rtc, &config)) {
		TC_ERROR("Failed to config RTC alarm\n");
		return TC_FAIL;
	}

	k_sleep(2000);

	if (!rtc_alarm_up) {
		TC_PRINT("RTC alarm doesn't work well\n");
		return TC_FAIL;
	}

	/* 2. Verify rtc_set_alarm() */
	rtc_alarm_up = false;
	if (rtc_set_alarm(rtc, rtc_read(rtc) + RTC_ALARM_SECOND)) {
		TC_PRINT("Failed to set RTC Alarm\n");
		return TC_FAIL;
	}

	k_sleep(2000);

	if (!rtc_alarm_up) {
		TC_PRINT("RTC alarm doesn't work well\n");
		return TC_FAIL;
	}

	/* 3. Verify RTC Alarm disabled after disable internal counter */
	rtc_disable(rtc);
	rtc_alarm_up = false;

	if (rtc_set_alarm(rtc, rtc_read(rtc) + RTC_ALARM_SECOND)) {
		TC_PRINT("Failed to set RTC Alarm\n");
		return TC_FAIL;
	}

	k_sleep(1500);

	if (rtc_alarm_up) {
		TC_PRINT("Failed to disable RTC Alarm\n");
		return TC_FAIL;
	}

	TC_PRINT("RTC alarm works well\n");

	return TC_PASS;
}

void test_rtc_alarm(void)
{
	zassert_true(test_alarm() == TC_PASS, NULL);
}
```

## src/test_rtc_calendar.c
```c
/*
 * Copyright (c) 2016 Intel Corporation.
 *
 * SPDX-License-Identifier: Apache-2.0
 */

/*
 * @addtogroup t_rtc_basic_api
 * @{
 * @defgroup t_rtc_calendar test_rtc_calendar
 * @brief TestPurpose: verify RTC internal counter enable/disable/read work
 * @details
 * - Test Steps
 *   -# Enable RTC internal counter
 *   -# Read RTC internal counter and sleep for a while
 *   -# Read RTC internal counter again and compare it with the previous value
 *   -# Disable RTC internal counter and repeat previous operations
 * - Expected Results
 *   -# When enabled, the values read from RTC internal counter increase.
 *   -# When disabled, the values read from RTC internal counter don't change.
 * @}
 */

#include "test_rtc.h"

static int test_task(void)
{
	u32_t val_1 = 0U;
	u32_t val_2 = 0U;
	struct device *rtc = device_get_binding(RTC_DEVICE_NAME);

	if (!rtc) {
		TC_PRINT("Cannot get RTC device\n");
		return TC_FAIL;
	}

	/* 1. Verify rtc_enable() */
	rtc_enable(rtc);

	/* 2. Verify rtc_enable() */
	val_1 = rtc_read(rtc);
	k_sleep(2000);
	val_2 = rtc_read(rtc);

	TC_PRINT("val_1: %u, val_2: %u, delta: %u:%u\n",
		 val_1, val_2,
		 (val_2 - val_1) / RTC_ALARM_SECOND,
		 (val_2 - val_1) % RTC_ALARM_SECOND);

	if (val_2 <= val_1) {
		TC_PRINT("RTC doesn't work well\n");
		return TC_FAIL;
	}

	/* 3. Verify rtc_disable() */
	rtc_disable(rtc);

	val_1 = rtc_read(rtc);
	k_sleep(1000);
	val_2 = rtc_read(rtc);

	if (val_2 != val_1) {
		TC_PRINT("Fail to disable RTC\n");
		return TC_FAIL;
	}

	return TC_PASS;
}

void test_rtc_calendar(void)
{
	zassert_true((test_task() == TC_PASS), NULL);
}
```
