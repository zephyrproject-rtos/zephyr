## CMakeLists.txt
```
# Copyright (c) 2022 Bjarki Arge Andreasen
# SPDX-License-Identifier: Apache-2.0

cmake_minimum_required(VERSION 3.28.0)

find_package(Zephyr REQUIRED HINTS $ENV{ZEPHYR_BASE})

project(rtc_api)

target_sources(app PRIVATE
  src/main.c
  src/test_time_incrementing.c
  src/test_time.c
  src/test_y2k.c
)

if(DEFINED CONFIG_RTC_ALARM)
  target_sources(app PRIVATE
    src/test_alarm_callback.c
    src/test_alarm.c
  )
endif()

if(DEFINED CONFIG_RTC_UPDATE)
  target_sources(app PRIVATE
    src/test_update_callback.c
  )
endif()

if(DEFINED CONFIG_RTC_CALIBRATION)
  target_sources(app PRIVATE
    src/test_calibrate.c
  )
endif()

target_include_directories(app PRIVATE inc)

target_compile_definitions(app PRIVATE _POSIX_C_SOURCE=200809L)
```

## Kconfig
```
# Copyright (c) 2024 Bjarki Arge Andreasen
# SPDX-License-Identifier: Apache-2.0

source "Kconfig.zephyr"

if RTC_ALARM

config TEST_RTC_ALARM_TIME_MASK
	int "Alarm fields to set"
	default 6
	range 1 511
	help
	  Set the RTC_ALARM_TIME_MASK_ bitmask to use when setting
	  RTC alarms during testing.

endif # RTC_ALARM
```

## prj.conf
```kconfig
# Copyright (c) 2022 Bjarki Arge Andreasen
# SPDX-License-Identifier: Apache-2.0

CONFIG_RTC=y
CONFIG_ZTEST=y
```

## boards/adafruit_macropad_rp2040.conf
```kconfig
CONFIG_RTC_ALARM=y
CONFIG_TEST_RTC_ALARM_TIME_MASK=127
```

## boards/apollo4p_evb.conf
```kconfig
# Copyright (c) 2024, Ambiq Micro Inc. <www.ambiq.com>
# SPDX-License-Identifier: Apache-2.0

CONFIG_RTC_ALARM=y
CONFIG_TEST_RTC_ALARM_TIME_MASK=79
```

## boards/apollo510_evb.conf
```kconfig
# Copyright (c) 2025, Ambiq Micro Inc. <www.ambiq.com>
# SPDX-License-Identifier: Apache-2.0

CONFIG_RTC_ALARM=y
CONFIG_TEST_RTC_ALARM_TIME_MASK=79
```

## boards/cyw920829m2evk_02_cyw20829b0lkml.conf
```kconfig
CONFIG_RTC_CALIBRATION=y
CONFIG_RTC_ALARM=y
CONFIG_TEST_RTC_ALARM_TIME_MASK=95
```

## boards/ek_ra4l1.conf
```kconfig
# Copyright (c) 2025 Renesas Electronics Corporation
# SPDX-License-Identifier: Apache-2.0

CONFIG_RTC_ALARM=y
CONFIG_RTC_UPDATE=y
CONFIG_TEST_RTC_ALARM_TIME_MASK=63
```

## boards/ek_ra4m2.conf
```kconfig
# Copyright (c) 2026 Renesas Electronics Corporation
# SPDX-License-Identifier: Apache-2.0

CONFIG_RTC_ALARM=y
CONFIG_RTC_UPDATE=y
CONFIG_TEST_RTC_ALARM_TIME_MASK=63
```

## boards/adafruit_macropad_rp2040.overlay
```dts
/*
 * SPDX-License-Identifier: Apache-2.0
 *
 * Copyright The Zephyr Project Contributors
 */

/ {
	aliases {
		rtc = &rtc;
	};
};

&rtc {
	clocks = <&clocks RPI_PICO_CLKID_CLK_RTC>;
	status = "okay";
};
```

## boards/apollo3_evb.overlay
```dts
/*
 * Copyright (c) 2025 Ambiq Micro Inc. <www.ambiq.com>
 *
 * SPDX-License-Identifier: Apache-2.0
 */

/ {
	aliases {
		rtc = &rtc0;
	};
};

&rtc0 {
	status = "okay";
};
```

## boards/cyw920829m2evk_02.overlay
```dts
/*
 * SPDX-License-Identifier: Apache-2.0
 *
 * Copyright (c) 2024 Cypress Semiconductor Corporation (an Infineon company) or
 * an affiliate of Cypress Semiconductor Corporation
 */

/ {
	aliases {
		rtc = &rtc0;
	};
};

&rtc0 {
	status = "okay";
};
```

## boards/cyw920829m2evk_02_common.overlay
```dts
/*
 * SPDX-FileCopyrightText: <text>Copyright (c) 2026 Infineon Technologies AG,
 * or an affiliate of Infineon Technologies AG. All rights reserved.</text>
 *
 * SPDX-License-Identifier: Apache-2.0
 */

/ {
	aliases {
		rtc = &rtc0;
	};
};

&rtc0 {
	status = "okay";
	alarms-count = <2>;
};
```

## boards/da1469x_dk_pro.overlay
```dts
/*
 * Copyright (c) 2023 Renesas Electronics Corporation
 *
 * SPDX-License-Identifier: Apache-2.0
 */

/ {
	aliases {
		rtc = &rtc;
	};
};

&rtc {
	status = "okay";
};
```

## boards/ek_ra4l1.overlay
```dts
/*
 * Copyright (c) 2025 Renesas Electronics Corporation
 * SPDX-License-Identifier: Apache-2.0
 */

/ {
	aliases {
		rtc = &rtc;
	};
};

&rtc {
	interrupts = <61 1>, <62 1>, <63 1>;
	interrupt-names = "alm", "prd", "cup";
	status = "okay";
};
```

## src/main.c
```c
/*
 * Copyright 2022 Bjarki Arge Andreasen
 *
 * SPDX-License-Identifier: Apache-2.0
 */

#include <zephyr/ztest.h>

ZTEST_SUITE(rtc_api, NULL, NULL, NULL, NULL, NULL);
```

## src/test_alarm.c
```c
/*
 * Copyright (c) 2022 Bjarki Arge Andreasen
 * Copyright (c) 2024 STMicroelectronics
 *
 * SPDX-License-Identifier: Apache-2.0
 */

#include <zephyr/ztest.h>
#include <zephyr/device.h>
#include <zephyr/drivers/rtc.h>
#include <zephyr/sys/atomic.h>
#include <zephyr/sys/util.h>

#define RTC_TEST_ALARM_TEST_NOT_PENDING_DELAY (3)
#define RTC_TEST_ALARM_TEST_PENDING_DELAY     (10)

static const struct device *rtc = DEVICE_DT_GET(DT_ALIAS(rtc));
static const uint16_t alarms_count = DT_PROP(DT_ALIAS(rtc), alarms_count);
static const uint16_t test_alarm_time_mask_set = CONFIG_TEST_RTC_ALARM_TIME_MASK;

/* Tue Dec 31 2024 23:59:55 GMT+0000 */
static const struct rtc_time test_rtc_time_set = {
	.tm_sec = 55,
	.tm_min = 59,
	.tm_hour = 23,
	.tm_mday = 31,
	.tm_mon = 11,
	.tm_year = 124,
	.tm_wday = 2,
	.tm_yday = 365,
	.tm_isdst = -1,
	.tm_nsec = 0,
};

/* Wed Jan 01 2025 00:00:05 GMT+0000 */
static const struct rtc_time test_alarm_time_set = {
	.tm_sec = 5,
	.tm_min = 0,
	.tm_hour = 0,
	.tm_mday = 1,
	.tm_mon = 0,
	.tm_year = 125,
	.tm_wday = 3,
	.tm_yday = 0,
	.tm_isdst = -1,
	.tm_nsec = 0,
};

static const struct rtc_time test_alarm_time_invalid = {
	.tm_sec = 70,
	.tm_min = 70,
	.tm_hour = 25,
	.tm_mday = 35,
	.tm_mon = 15,
	.tm_year = 8000,
	.tm_wday = 8,
	.tm_yday = 370,
	.tm_nsec = INT32_MAX,
};

static const uint16_t test_alarm_time_masks[] = {
	RTC_ALARM_TIME_MASK_SECOND,  RTC_ALARM_TIME_MASK_MINUTE,
	RTC_ALARM_TIME_MASK_HOUR,    RTC_ALARM_TIME_MASK_MONTHDAY,
	RTC_ALARM_TIME_MASK_MONTH,   RTC_ALARM_TIME_MASK_YEAR,
	RTC_ALARM_TIME_MASK_WEEKDAY, RTC_ALARM_TIME_MASK_YEARDAY,
	RTC_ALARM_TIME_MASK_NSEC
};

ZTEST(rtc_api, test_alarm)
{
	int ret;
	uint16_t alarm_time_mask_supported;
	struct rtc_time alarm_time_get;
	uint16_t alarm_time_mask_get;

	/* Clear alarm alarm time */
	for (uint16_t i = 0; i < alarms_count; i++) {
		ret = rtc_alarm_set_time(rtc, i, 0, NULL);

		zassert_ok(ret, "Failed to clear alarm %d time", i);
	}

	/* Disable alarm callback */
	for (uint16_t i = 0; i < alarms_count; i++) {
		ret = rtc_alarm_set_callback(rtc, i, NULL, NULL);

		zassert_true((ret == 0) || (ret == -ENOTSUP),
			     "Failed to clear and disable alarm %d callback", i);
	}

	/* Every supported alarm field should reject invalid values. */
	for (uint16_t i = 0; i < alarms_count; i++) {
		ret = rtc_alarm_get_supported_fields(rtc, i, &alarm_time_mask_supported);
		zassert_ok(ret, "Failed to get supported alarm %d fields", i);

		ARRAY_FOR_EACH(test_alarm_time_masks, j)
		{
			if (test_alarm_time_masks[j] & alarm_time_mask_supported) {
				ret = rtc_alarm_set_time(rtc, i, test_alarm_time_masks[j],
							 &test_alarm_time_invalid);
				zassert_equal(
					-EINVAL, ret,
					"%s: RTC should reject invalid alarm %d time in field %zu.",
					rtc->name, i, j);
			}
		}
	}

	/* Validate alarms supported fields */
	for (uint16_t i = 0; i < alarms_count; i++) {
		ret = rtc_alarm_get_supported_fields(rtc, i, &alarm_time_mask_supported);
		zassert_ok(ret, "Failed to get supported alarm %d fields", i);

		ret = (test_alarm_time_mask_set & (~alarm_time_mask_supported)) ? -EINVAL : 0;
		zassert_ok(ret, "Configured alarm time fields to set are not supported");
	}

	for (uint16_t i = 0; i < alarms_count; i++) {
		ret = rtc_alarm_set_time(rtc, i, test_alarm_time_mask_set, &test_alarm_time_set);
		zassert_ok(ret, "Failed to set alarm %d time", i);
	}

	/* Validate alarm time */
	for (uint16_t i = 0; i < alarms_count; i++) {
		ret = rtc_alarm_get_time(rtc, i, &alarm_time_mask_get, &alarm_time_get);
		zassert_ok(ret, "Failed to set alarm %d time", i);

		zassert_equal(alarm_time_mask_get, test_alarm_time_mask_set,
			      "Incorrect alarm %d time mask", i);

		if (test_alarm_time_mask_set & RTC_ALARM_TIME_MASK_SECOND) {
			zassert_equal(alarm_time_get.tm_sec, test_alarm_time_set.tm_sec,
				      "Incorrect alarm %d tm_sec field", i);
		}

		if (test_alarm_time_mask_set & RTC_ALARM_TIME_MASK_MINUTE) {
			zassert_equal(alarm_time_get.tm_min, test_alarm_time_set.tm_min,
				      "Incorrect alarm %d tm_min field", i);
		}

		if (test_alarm_time_mask_set & RTC_ALARM_TIME_MASK_HOUR) {
			zassert_equal(alarm_time_get.tm_hour, test_alarm_time_set.tm_hour,
				      "Incorrect alarm %d tm_hour field", i);
		}

		if (test_alarm_time_mask_set & RTC_ALARM_TIME_MASK_MONTHDAY) {
			zassert_equal(alarm_time_get.tm_mday, test_alarm_time_set.tm_mday,
				      "Incorrect alarm %d tm_mday field", i);
		}

		if (test_alarm_time_mask_set & RTC_ALARM_TIME_MASK_MONTH) {
			zassert_equal(alarm_time_get.tm_mon, test_alarm_time_set.tm_mon,
				      "Incorrect alarm %d tm_mon field", i);
		}

		if (test_alarm_time_mask_set & RTC_ALARM_TIME_MASK_YEAR) {
			zassert_equal(alarm_time_get.tm_year, test_alarm_time_set.tm_year,
				      "Incorrect alarm %d tm_year field", i);
		}

		if (test_alarm_time_mask_set & RTC_ALARM_TIME_MASK_WEEKDAY) {
			zassert_equal(alarm_time_get.tm_wday, test_alarm_time_set.tm_wday,
				      "Incorrect alarm %d tm_wday field", i);
		}

		if (test_alarm_time_mask_set & RTC_ALARM_TIME_MASK_YEARDAY) {
			zassert_equal(alarm_time_get.tm_yday, test_alarm_time_set.tm_yday,
				      "Incorrect alarm %d tm_yday field", i);
		}

		if (test_alarm_time_mask_set & RTC_ALARM_TIME_MASK_NSEC) {
			zassert_equal(alarm_time_get.tm_nsec, test_alarm_time_set.tm_nsec,
				      "Incorrect alarm %d tm_nsec field", i);
		}
	}

	for (uint8_t k = 0; k < 2; k++) {
		/* Set RTC time */
		ret = rtc_set_time(rtc, &test_rtc_time_set);
		zassert_ok(ret, "Failed to set time");

		/* Clear alarm pending status */
		for (uint16_t i = 0; i < alarms_count; i++) {
			ret = rtc_alarm_is_pending(rtc, i);
			zassert_true(ret > -1, "Failed to clear alarm %d pending status", i);
		}

		/* Wait before validating alarm pending status has not been set prematurely */
		k_sleep(K_SECONDS(RTC_TEST_ALARM_TEST_NOT_PENDING_DELAY));

		/* Validate alarm are not pending */
		for (uint16_t i = 0; i < alarms_count; i++) {
			ret = rtc_alarm_is_pending(rtc, i);
			zassert_ok(ret, "Alarm %d should not be pending", i);
		}

		/* Wait for alarm to trigger */
		k_sleep(K_SECONDS(RTC_TEST_ALARM_TEST_PENDING_DELAY));

		/* Validate alarm is pending */
		for (uint16_t i = 0; i < alarms_count; i++) {
			ret = rtc_alarm_is_pending(rtc, i);
			zassert_equal(ret, 1, "Alarm %d should be pending", i);
		}
	}

	/* Disable and clear alarms */
	for (uint16_t i = 0; i < alarms_count; i++) {
		ret = rtc_alarm_set_time(rtc, i, 0, NULL);
		zassert_ok(ret, "Failed to disable alarm %d", i);

		ret = rtc_alarm_is_pending(rtc, i);
		zassert_true(ret > -1, "Failed to clear alarm %d pending state", i);
	}
}
```

## src/test_alarm_callback.c
```c
/*
 * Copyright (c) 2022 Bjarki Arge Andreasen
 * Copyright (c) 2024 STMicroelectronics
 *
 * SPDX-License-Identifier: Apache-2.0
 */

#include <zephyr/ztest.h>
#include <zephyr/device.h>
#include <zephyr/drivers/rtc.h>
#include <zephyr/sys/atomic.h>

#define RTC_TEST_ALARM_TEST_NOT_CALLED_DELAY (3)
#define RTC_TEST_ALARM_TEST_CALLED_DELAY     (10)

static const struct device *rtc = DEVICE_DT_GET(DT_ALIAS(rtc));
static const uint16_t alarms_count = DT_PROP(DT_ALIAS(rtc), alarms_count);
static uint32_t callback_user_data_odd = 0x4321;
static uint32_t callback_user_data_even = 0x1234;
static atomic_t callback_called_mask_odd;
static atomic_t callback_called_mask_even;

static const uint16_t test_alarm_time_mask_set = CONFIG_TEST_RTC_ALARM_TIME_MASK;

/* Tue Dec 31 2024 23:59:55 GMT+0000 */
static const struct rtc_time test_rtc_time_set = {
	.tm_sec = 55,
	.tm_min = 59,
	.tm_hour = 23,
	.tm_mday = 31,
	.tm_mon = 11,
	.tm_year = 124,
	.tm_wday = 2,
	.tm_yday = 365,
	.tm_isdst = -1,
	.tm_nsec = 0,
};

/* Wed Jan 01 2025 00:00:05 GMT+0000 */
static const struct rtc_time test_alarm_time_set = {
	.tm_sec = 5,
	.tm_min = 0,
	.tm_hour = 0,
	.tm_mday = 1,
	.tm_mon = 0,
	.tm_year = 125,
	.tm_wday = 3,
	.tm_yday = 0,
	.tm_isdst = -1,
	.tm_nsec = 0,
};

static void test_rtc_alarm_callback_handler_odd(const struct device *dev, uint16_t id,
						void *user_data)
{
	atomic_set_bit(&callback_called_mask_odd, id);
}

static void test_rtc_alarm_callback_handler_even(const struct device *dev, uint16_t id,
						 void *user_data)
{
	atomic_set_bit(&callback_called_mask_even, id);
}

ZTEST(rtc_api, test_alarm_callback)
{
	int ret;
	atomic_val_t callback_called_mask_status_odd;
	atomic_val_t callback_called_mask_status_even;
	bool callback_called_status;

	/* Disable alarm callback */
	for (uint16_t i = 0; i < alarms_count; i++) {
		ret = rtc_alarm_set_callback(rtc, i, NULL, NULL);

		if (ret == -ENOTSUP) {
			TC_PRINT("Alarm callbacks not supported\n");
			ztest_test_skip();
		} else {
			zassert_ok(ret, "Failed to clear and disable alarm %d", i);
		}
	}

	for (uint16_t i = 0; i < alarms_count; i++) {
		ret = rtc_alarm_set_time(rtc, i, test_alarm_time_mask_set, &test_alarm_time_set);
		zassert_ok(ret, "Failed to set alarm %d time", i);
	}

	/* Set RTC time */
	ret = rtc_set_time(rtc, &test_rtc_time_set);
	zassert_ok(ret, "Failed to set time");

	/* Clear alarm pending status */
	for (uint16_t i = 0; i < alarms_count; i++) {
		ret = rtc_alarm_is_pending(rtc, i);
		zassert_true(ret > -1, "Failed to clear alarm %d pending status", i);
	}

	/* Set and enable alarm callback */
	for (uint16_t i = 0; i < alarms_count; i++) {
		if (i % 2) {
			ret = rtc_alarm_set_callback(rtc, i,
						test_rtc_alarm_callback_handler_odd,
						&callback_user_data_odd);
		} else {
			ret = rtc_alarm_set_callback(rtc, i,
						test_rtc_alarm_callback_handler_even,
						&callback_user_data_even);
		}

		zassert_ok(ret, "Failed to set alarm %d callback", i);
	}

	for (uint8_t i = 0; i < 2; i++) {
		/* Clear callback called atomics */
		atomic_set(&callback_called_mask_odd, 0);
		atomic_set(&callback_called_mask_even, 0);

		/* Wait before validating alarm callbacks have not been called prematurely */
		k_sleep(K_SECONDS(RTC_TEST_ALARM_TEST_NOT_CALLED_DELAY));

		/* Validate alarm callbacks have not been called prematurely */
		callback_called_mask_status_odd = atomic_get(&callback_called_mask_odd);
		callback_called_mask_status_even = atomic_get(&callback_called_mask_even);

		zassert_equal(callback_called_mask_status_odd, 0,
			      "Alarm callback called prematurely");
		zassert_equal(callback_called_mask_status_even, 0,
			      "Alarm callback called prematurely");

		/* Wait for alarm to trigger */
		k_sleep(K_SECONDS(RTC_TEST_ALARM_TEST_CALLED_DELAY));

		/* Validate alarm callback called */
		for (uint16_t j = 0; j < alarms_count; j++) {
			callback_called_status =
				(j % 2) ? atomic_test_bit(&callback_called_mask_odd, j)
					: atomic_test_bit(&callback_called_mask_even, j);

			zassert_equal(callback_called_status, true,
				      "Alarm %d callback should have been called", j);
		}

		/* Reset RTC time */
		ret = rtc_set_time(rtc, &test_rtc_time_set);
		zassert_ok(ret, "Failed to set time");
	}

	/* Disable and clear alarms */
	for (uint16_t i = 0; i < alarms_count; i++) {
		ret = rtc_alarm_set_callback(rtc, i, NULL, NULL);
		zassert_ok(ret, "Failed to disable alarm %d callback", i);

		ret = rtc_alarm_set_time(rtc, i, 0, NULL);
		zassert_ok(ret, "Failed to disable alarm %d", i);

		ret = rtc_alarm_is_pending(rtc, i);
		zassert_true(ret > -1, "Failed to clear alarm %d pending state", i);
	}
}
```

## src/test_calibrate.c
```c
/*
 * Copyright 2022 Bjarki Arge Andreasen
 *
 * SPDX-License-Identifier: Apache-2.0
 */

#include <zephyr/ztest.h>
#include <zephyr/kernel.h>
#include <zephyr/device.h>
#include <zephyr/drivers/rtc.h>

#define RTC_TEST_CAL_RANGE_LIMIT (200000)
#define RTC_TEST_CAL_RANGE_STEP	 (10000)

static const struct device *rtc = DEVICE_DT_GET(DT_ALIAS(rtc));

static int test_set_get_calibration(int32_t calibrate_set)
{
	int32_t calibrate_get;
	int ret;

	ret = rtc_set_calibration(rtc, calibrate_set);

	/* Check if calibration is within limits of hardware */
	if (ret == -EINVAL) {
		/* skip */
		return -EINVAL;
	}

	/* Validate calibration was set */
	zassert_ok(ret, "Failed to set calibration");

	ret = rtc_get_calibration(rtc, &calibrate_get);

	/* Validate calibration was gotten */
	zassert_ok(ret, "Failed to get calibration");

	/* Print comparison between set and get values */
	printk("Calibrate (set,get): %i, %i\n", calibrate_set, calibrate_get);

	return 0;
}

ZTEST(rtc_api, test_set_get_calibration)
{
	int32_t calibrate_get;
	int ret;
	int32_t range_limit;
	int32_t range_step;

	ret = rtc_set_calibration(rtc, 0);

	/* Validate calibration was set */
	zassert_ok(ret, "Failed to set calibration");

	ret = rtc_get_calibration(rtc, &calibrate_get);

	/* Validate calibration was gotten */
	zassert_ok(ret, "Failed to get calibration");

	/* Validate edge values (0 already tested) */
	test_set_get_calibration(1);
	test_set_get_calibration(-1);

	range_limit = RTC_TEST_CAL_RANGE_LIMIT;
	range_step = RTC_TEST_CAL_RANGE_STEP;

	/* Validate over negative range */
	for (int32_t set = range_step; set <= range_limit; set += range_step) {
		ret = test_set_get_calibration(-set);

		if (ret < 0) {
			/* Limit of hardware capabilities reached */
			break;
		}
	}

	/* Validate over positive range */
	for (int32_t set = range_step; set <= range_limit; set += range_step) {
		ret = test_set_get_calibration(set);

		if (ret < 0) {
			/* Limit of hardware capabilities reached */
			break;
		}
	}
}
```

## src/test_time.c
```c
/*
 * Copyright 2022 Bjarki Arge Andreasen
 *
 * SPDX-License-Identifier: Apache-2.0
 */

#include <zephyr/ztest.h>
#include <zephyr/device.h>
#include <zephyr/drivers/rtc.h>
#include <zephyr/sys/timeutil.h>

#include <time.h>
#include <string.h>

/* Wed Dec 31 2025 23:59:55 GMT+0000 */
#define RTC_TEST_GET_SET_TIME	  (1767225595UL)
#define RTC_TEST_GET_SET_TIME_TOL (1UL)

static const struct device *rtc = DEVICE_DT_GET(DT_ALIAS(rtc));

ZTEST(rtc_api, test_set_get_time)
{
	struct rtc_time datetime_set;
	struct rtc_time datetime_get;
	time_t timer_get;
	time_t timer_set = RTC_TEST_GET_SET_TIME;

	gmtime_r(&timer_set, (struct tm *)(&datetime_set));

	datetime_set.tm_isdst = -1;
	datetime_set.tm_nsec = 0;

	memset(&datetime_get, 0xFF, sizeof(datetime_get));

	zassert_equal(rtc_set_time(rtc, &datetime_set), 0, "Failed to set time");

	zassert_equal(rtc_get_time(rtc, &datetime_get), 0,
		      "Failed to get time using rtc_time_get()");

	zassert_true((datetime_get.tm_sec > -1) && (datetime_get.tm_sec < 60),
		     "Invalid tm_sec");

	zassert_true((datetime_get.tm_min > -1) && (datetime_get.tm_min < 60),
		     "Invalid tm_min");

	zassert_true((datetime_get.tm_hour > -1) && (datetime_get.tm_hour < 24),
		     "Invalid tm_hour");

	zassert_true((datetime_get.tm_mday > 0) && (datetime_get.tm_mday < 32),
		      "Invalid tm_mday");

	zassert_true((datetime_get.tm_year > 124) && (datetime_get.tm_year < 127),
		     "Invalid tm_year");

	zassert_true((datetime_get.tm_wday > -2) && (datetime_get.tm_wday < 7),
		     "Invalid tm_wday");

	zassert_true((datetime_get.tm_yday > -2) && (datetime_get.tm_yday < 366),
		     "Invalid tm_yday");

	zassert_equal(datetime_get.tm_isdst, -1, "Invalid tm_isdst");

	zassert_true((datetime_get.tm_nsec > -1) && (datetime_get.tm_nsec < 1000000000),
		     "Invalid tm_nsec");

	timer_get = timeutil_timegm((struct tm *)(&datetime_get));

	zassert_true((timer_get >= RTC_TEST_GET_SET_TIME) &&
		     (timer_get <= (RTC_TEST_GET_SET_TIME + RTC_TEST_GET_SET_TIME_TOL)),
		     "Got unexpected time");
}
```

## src/test_time_incrementing.c
```c
/*
 * Copyright 2022 Bjarki Arge Andreasen
 *
 * SPDX-License-Identifier: Apache-2.0
 */

#include <zephyr/ztest.h>
#include <zephyr/device.h>
#include <zephyr/drivers/rtc.h>
#include <zephyr/sys/timeutil.h>

#include <time.h>

/* Wed Dec 31 2025 23:59:55 GMT+0000 */
#define RTC_TEST_TIME_COUNTING_SET_TIME	  (1767225595UL)
#define RTC_TEST_TIME_COUNTING_LIMIT	  (RTC_TEST_TIME_COUNTING_SET_TIME + 10UL)
#define RTC_TEST_TIME_COUNTING_POLL_LIMIT (30U)

static const struct device *rtc = DEVICE_DT_GET(DT_ALIAS(rtc));

ZTEST(rtc_api, test_time_counting)
{
	struct rtc_time datetime_set;
	struct rtc_time datetime_get;
	time_t timer_get;
	time_t timer_set = RTC_TEST_TIME_COUNTING_SET_TIME;
	time_t timer_get_last = timer_set;
	uint8_t i;

	gmtime_r(&timer_set, (struct tm *)(&datetime_set));

	datetime_set.tm_isdst = -1;
	datetime_set.tm_nsec = 0;

	zassert_equal(rtc_set_time(rtc, &datetime_set), 0, "Failed to set time");

	for (i = 0; i < RTC_TEST_TIME_COUNTING_POLL_LIMIT; i++) {
		/* Get time */
		zassert_equal(rtc_get_time(rtc, &datetime_get), 0, "Failed to get time");

		timer_get = timeutil_timegm((struct tm *)(&datetime_get));

		/* Validate if time incrementing */
		zassert_true(timer_get_last <= timer_get, "Time is decrementing");

		/* Check if limit reached */
		if (timer_get == RTC_TEST_TIME_COUNTING_LIMIT) {
			break;
		}

		/* Save last timer get */
		timer_get_last = timer_get;

		/* Limit polling rate */
		k_msleep(500);
	}

	zassert_true(i < RTC_TEST_TIME_COUNTING_POLL_LIMIT,
		     "Timeout occurred waiting for time to increment");
}
```

## src/test_update_callback.c
```c
/*
 * Copyright 2022 Bjarki Arge Andreasen
 *
 * SPDX-License-Identifier: Apache-2.0
 */

#include <zephyr/ztest.h>
#include <zephyr/device.h>
#include <zephyr/drivers/rtc.h>
#include <zephyr/sys/atomic.h>

static const struct device *rtc = DEVICE_DT_GET(DT_ALIAS(rtc));
static uint32_t callback_called_counter;
static void *callback_test_user_data_address;
static uint32_t test_user_data = 0x1234;
static struct k_spinlock lock;

static void test_rtc_update_callback_handler(const struct device *dev, void *user_data)
{
	k_spinlock_key_t key = k_spin_lock(&lock);

	callback_called_counter++;
	callback_test_user_data_address = user_data;

	k_spin_unlock(&lock, key);
}

ZTEST(rtc_api, test_update_callback)
{
	int ret;
	k_spinlock_key_t key;
	uint32_t counter;
	void *address;

	ret = rtc_update_set_callback(rtc, NULL, NULL);

	if (ret == -ENOSYS) {
		ztest_test_skip();
	} else {
		zassert_ok(ret, "Failed to clear and disable update callback");
	}

	key = k_spin_lock(&lock);

	callback_called_counter = 0;
	address = callback_test_user_data_address;

	k_spin_unlock(&lock, key);

	k_msleep(5000);

	key = k_spin_lock(&lock);

	counter = callback_called_counter;

	k_spin_unlock(&lock, key);

	zassert_equal(counter, 0, "Update callback should not have been called");

	ret = rtc_update_set_callback(rtc, test_rtc_update_callback_handler, &test_user_data);

	zassert_ok(ret, "Failed to set and enable update callback");

	k_msleep(10000);

	key = k_spin_lock(&lock);

	counter = callback_called_counter;
	address = callback_test_user_data_address;

	k_spin_unlock(&lock, key);

	zassert_true(counter < 12 && counter > 8, "Invalid update callback called counter");

	zassert_equal(address, ((void *)&test_user_data), "Incorrect user data");
	zassert_ok(rtc_update_set_callback(rtc, NULL, NULL),
	    "Failed to clear and disable update callback");
}
```

## src/test_y2k.c
```c
/*
 * Copyright 2023 Meta
 *
 * SPDX-License-Identifier: Apache-2.0
 */

#include <zephyr/ztest.h>
#include <zephyr/device.h>
#include <zephyr/drivers/rtc.h>

#include <time.h>

/* date "+%s" -d "Sat Jan  1 2000 00:00:00 GMT+0000" */
#define Y2K_STAMP 946684800UL

#define SECONDS_BEFORE 1
#define SECONDS_AFTER 1

#define RTC_TEST_START_TIME (Y2K_STAMP - SECONDS_BEFORE)
#define RTC_TEST_STOP_TIME (Y2K_STAMP + SECONDS_AFTER)

static const struct device *rtc = DEVICE_DT_GET(DT_ALIAS(rtc));

ZTEST(rtc_api, test_y2k)
{
	enum test_time {
		Y99,
		Y2K,
	};

	static struct rtc_time rtm[2] = {
		{.tm_isdst = -1, .tm_nsec = 0},
		{.tm_isdst = -1, .tm_nsec = 0},
	};
	struct tm *const tm[2] = {
		(struct tm *const)&rtm[0],
		(struct tm *const)&rtm[1],
	};
	const time_t t[] = {
		[Y99] = RTC_TEST_START_TIME,
		[Y2K] = RTC_TEST_STOP_TIME,
	};

	/* Party like it's 1999 */
	zassert_not_null(gmtime_r(&t[Y99], tm[Y99]));

	int ret = rtc_set_time(rtc, &rtm[Y99]);

	if (ret == -EINVAL) {
		TC_PRINT("Rollover not supported\n");
		ztest_test_skip();
	} else {
		zassert_ok(ret, "RTC Set Time Failed");
	}

	/* Living after midnight */
	k_sleep(K_SECONDS(SECONDS_BEFORE + SECONDS_AFTER));
	zassert_ok(rtc_get_time(rtc, &rtm[Y2K]));

	/* It's the end of the world as we know it */
	zassert_equal(rtm[Y2K].tm_year + 1900, 2000, "wrong year: %d", rtm[Y2K].tm_year + 1900);
	zassert_equal(rtm[Y2K].tm_mon, 0, "wrong month: %d", rtm[Y2K].tm_mon);
	zassert_equal(rtm[Y2K].tm_mday, 1, "wrong day-of-month: %d", rtm[Y2K].tm_mday);
	zassert_true(rtm[Y2K].tm_yday == 0 || rtm[Y2K].tm_yday == -1, "wrong day-of-year: %d",
		     rtm[Y2K].tm_yday);
	zassert_true(rtm[Y2K].tm_wday == 6 || rtm[Y2K].tm_wday == -1, "wrong day-of-week: %d",
		     rtm[Y2K].tm_wday);
	zassert_equal(rtm[Y2K].tm_hour, 0, "wrong hour: %d", rtm[Y2K].tm_hour);
	zassert_equal(rtm[Y2K].tm_min, 0, "wrong minute: %d", rtm[Y2K].tm_min);
	/* We're testing Y2K rollover, not precise timing. Seconds should be small but exact value
	 * doesn't matter
	 */
	zassert_true(rtm[Y2K].tm_sec <= SECONDS_AFTER + 1, "seconds out of valid range: %d",
		     rtm[Y2K].tm_sec);
}
```
