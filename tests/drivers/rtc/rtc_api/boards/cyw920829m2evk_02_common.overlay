/*
 * Copyright (c) 2025 Infineon Technologies AG,
 * or an affiliate of Infineon Technologies AG.
 *
 * SPDX-License-Identifier: Apache-2.0
 */

/ {
	aliases {
		rtc = &rtc0;
	};
};

&rtc0 {
	status = "okay";
};
