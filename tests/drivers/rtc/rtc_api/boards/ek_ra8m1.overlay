/*
 * Copyright (c) 2025 Renesas Electronics Corporation
 * SPDX-License-Identifier: Apache-2.0
 */

/ {
	aliases {
		rtc = &rtc;
	};
};

&rtc {
	interrupts = <95 1>, <94 1>, <93 1>;
	interrupt-names = "alm", "prd", "cup";
	status = "okay";
};
