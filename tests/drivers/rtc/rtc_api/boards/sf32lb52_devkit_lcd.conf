## tests/drivers/rtc/rtc_api/boards/sf32lb52_devkit_lcd.conf
```kconfig
# Copyright (c) 2025, Qingsong Gou <gouqs@hotmail.com>
# SPDX-License-Identifier: Apache-2.0

CONFIG_RTC_ALARM=y
```

## tests/drivers/rtc/rtc_api/testcase.yaml
```yaml
# Copyright (c) 2022 Bjarki Arge Andreasen
# Copyright 2025 NXP
# SPDX-License-Identifier: Apache-2.0

tests:
  drivers.rtc.rtc_api:
    tags:
      - drivers
      - rtc
      - api
    filter: dt_alias_exists("rtc") and not dt_compat_enabled("zephyr,rtc-counter")
    depends_on: rtc
    timeout: 100
    platform_exclude:
      - qemu_x86_64

  drivers.rtc.rtc_api.rtc_counter:
    tags:
      - drivers
      - rtc
      - api
    filter: dt_alias_exists("rtc") and dt_compat_enabled("zephyr,rtc-counter")
    depends_on: rtc
    timeout: 100
    extra_configs:
      - CONFIG_RTC_ALARM=y
      - CONFIG_RTC_INIT_PRIORITY=70
      - CONFIG_TEST_RTC_ALARM_TIME_MASK=255
```

## tests/drivers/rtc/rtc_api_helpers/testcase.yaml
```yaml
# Copyright (c) 2022 Bjarki Arge Andreasen
# Copyright 2025 NXP
# SPDX-License-Identifier: Apache-2.0

tests:
  drivers.rtc.rtc_api_helpers:
    tags:
      - drivers
      - rtc
      - api
      - helpers
    filter: not dt_compat_enabled("zephyr,rtc-counter")
    depends_on: rtc
```

## tests/drivers/rtc/rtc_utils/testcase.yaml
```yaml
# Copyright (c) 2024 Andrew Featherstone
# Copyright 2025 NXP
# SPDX-License-Identifier: Apache-2.0

tests:
  drivers.rtc.rtc_utils:
    tags:
      - drivers
      - rtc
    filter: not dt_compat_enabled("zephyr,rtc-counter")
    depends_on: rtc
```

## tests/drivers/rtc/shell/testcase.yaml
```yaml
tests:
  drivers.rtc.shell:
    integration_platforms:
      - native_sim
      - native_sim/native/64
    tags:
      - drivers
      - rtc
      - shell
    filter: dt_alias_exists("rtc") and not dt_compat_enabled("zephyr,rtc-counter")
    depends_on: rtc
```

## tests/drivers/saej2716/saej2716_api/testcase.yaml
```yaml
tests:
  drivers.saej2716:
    tags:
      - drivers
      - saej2716
    depends_on: saej2716
    filter: dt_alias_exists("saej2716-node")
```

## tests/drivers/sdhc/emul/Kconfig
```kconfig
# Copyright 2026 Alif Semiconductor
# SPDX-License-Identifier: Apache-2.0

source "Kconfig.zephyr"
```

## tests/drivers/sdhc/emul/boards/native_sim.conf
```kconfig
CONFIG_ZTEST=y
CONFIG_SDHC=y
CONFIG_SDHC_EMUL=y
CONFIG_LOG=y
CONFIG_SDHC_LOG_LEVEL_DBG=y
CONFIG_SYS_HEAP_AUTO=y
```

## tests/drivers/sdhc/emul/testcase.yaml
```yaml
common:
  tags:
    - drivers
    - sdhc
    - emul
  platform_allow:
    - native_sim
    - native_sim/native/64
  extra_configs:
    - CONFIG_SDHC=y
    - CONFIG_SDHC_EMUL=y
    - CONFIG_ZTEST=y

tests:
  drivers.sdhc.emul.sd: {}

  drivers.sdhc.emul.emmc:
    tags: emmc

  drivers.sdhc.emul.sdio:
    tags: sdio net
    extra_configs:
      - CONFIG_SDHC=y
      - CONFIG_NETWORKING=y
      - CONFIG_NET_L2_ETHERNET=y
      - CONFIG_SDHC_EMUL_SDIO_NET=y

  drivers.sdhc.emul.faults:
    tags: fault

  drivers.sdhc.emul.framework:
    tags: emul framework
    extra_args:
      - DTC_OVERLAY_FILE="boards/native_sim_emul_fw.overlay"
    extra_configs:
      - CONFIG_SDHC=y
      - CONFIG_SDHC_EMUL_CONTROLLER=y
      - CONFIG_SDHC_EMUL_CARD=y
      - CONFIG_ZTEST=y
```

## tests/drivers/sdhc/testcase.yaml
```yaml
common:
  depends_on: sdhc
  tags:
    - drivers
    - sdhc
tests:
  drivers.sdhc.sdhc_api:
    harness: ztest
    harness_config:
      fixture: fixture_sdhc
    filter: dt_alias_exists("sdhc0")
    tags: sdhc
    integration_platforms:
      - mimxrt1064_evk
    platform_exclude:
      - mimxrt700_evk/mimxrt798s/cm33_cpu0
  drivers.sdhc.sdhc_api.renesas_ra_sci_b_spi:
    depends_on: spi
    harness: ztest
    harness_config:
      fixture: fixture_sdhc
    filter: dt_alias_exists("sdhc0") and dt_compat_enabled("zephyr,sdhc-spi-slot")
      and dt_compat_enabled("renesas,ra-spi-sci-b")
    extra_args:
      - DTC_OVERLAY_FILE="boards/${BOARD}_sci_b_spi.overlay"
    integration_platforms:
      - ek_ra8m1
    platform_allow:
      - ek_ra8m1
      - ek_ra8d1
      - mck_ra8t1
  drivers.sdhc.sdhc_spi.renesas_ra_sci_b_spi_ra8x2:
    depends_on: spi
    harness: ztest
    harness_config:
      fixture: fixture_sdhc
    filter: dt_alias_exists("sdhc0") and dt_compat_enabled("zephyr,sdhc-spi-slot")
      and dt_compat_enabled("renesas,ra-spi-sci-b")
    extra_args:
      - DTC_OVERLAY_FILE="boards/${BOARD}${NORMALIZED_BOARD_QUALIFIERS}_sci_b_spi.overlay"
    platform_allow:
      - ek_ra8p1/r7ka8p1kflcac/cm85
```

## tests/drivers/sensor/accel/boards/native_posix.conf
```kconfig
# Copyright (c) 2020 Nordic Semiconductor ASA
# SPDX-License-Identifier: Apache-2.0

CONFIG_EMUL=y
CONFIG_I2C=y
CONFIG_I2C_EMUL=y
CONFIG_SPI=y
CONFIG_SPI_EMUL=y
CONFIG_BMI160=y
CONFIG_EMUL_BMI160=y
CONFIG_SENSOR=y
CONFIG_BMI160_TRIGGER_NONE=y
```

## tests/drivers/sensor/accel/testcase.yaml
```yaml
tests:
  drivers.sensor:
    tags: drivers sensor subsys
    platform_allow: native_posix
```

## tests/drivers/sensor/adltc2990/testcase.yaml
```yaml
# SPDX-FileCopyrightText: Copyright (c) 2023 Carl Zeiss Meditec AG
# SPDX-License-Identifier: Apache-2.0

tests:
  drivers.sensor.adltc2990:
    tags:
      - drivers
      - sensor
      - subsys
    platform_allow:
      - native_sim
```

## tests/drivers/sensor/adxl345/testcase.yaml
```yaml
tests:
  drivers.sensor.adxl345:
    tags:
      - drivers
      - sensor
    type: unit
    extra_args:
      # add -g to allow debugging in vscode
      - EXTRA_CPPFLAGS="-g"
```

## tests/drivers/sensor/adxl34x/boards/native_sim.conf
```kconfig
#
# Copyright (c) 2024 Chaim Zax
# SPDX-License-Identifier: Apache-2.0
#

CONFIG_I2C=y
CONFIG_SPI=y
```

## tests/drivers/sensor/adxl34x/boards/qemu_cortex_m0.conf
```kconfig
#
# Copyright (c) 2024 Chaim Zax
# SPDX-License-Identifier: Apache-2.0
#

CONFIG_I2C=y
CONFIG_SPI=y

CONFIG_QEMU_ICOUNT=y
```

## tests/drivers/sensor/adxl34x/testcase.yaml
```yaml
#
# Copyright (c) 2024 Chaim Zax
# SPDX-License-Identifier: Apache-2.0
#

common:
  tags:
    - drivers
    - sensor
tests:
  drivers.sensor.adxl34x.basic:
    extra_args: EXTRA_CFLAGS=-DADXL34X_TEST_BASIC
    extra_configs:
      - CONFIG_ADXL34X_DECODER=n
      - CONFIG_ADXL34X_FIFO_MODE_BYPASS=y
    platform_allow: native_sim
    integration_platforms:
      - native_sim
  drivers.sensor.adxl34x.basic.compatible:
    extra_args: EXTRA_CFLAGS=-DADXL34X_TEST_BASIC
    extra_configs:
      - CONFIG_ADXL34X_ADXL345_COMPATIBLE=y
    platform_allow: native_sim
    integration_platforms:
      - native_sim
  drivers.sensor.adxl34x.basic.pm:
    extra_args: EXTRA_CFLAGS=-DADXL34X_TEST_BASIC
    extra_configs:
      - CONFIG_ADXL34X_DECODER=n
      - CONFIG_ADXL34X_FIFO_MODE_BYPASS=y
      - CONFIG_PM_DEVICE=y
      - CONFIG_PM_DEVICE_RUNTIME=y
    platform_allow: native_sim
    integration_platforms:
      - native_sim
  drivers.sensor.adxl34x.basic.arm:
    extra_args: EXTRA_CFLAGS=-DADXL34X_TEST_BASIC
    extra_configs:
      - CONFIG_ADXL34X_DECODER=n
      - CONFIG_ADXL34X_FIFO_MODE_BYPASS=y
    platform_allow: qemu_cortex_m0
    integration_platforms:
      - qemu_cortex_m0
    build_only: true
  drivers.sensor.adxl34x.decoder:
    extra_args: EXTRA_CFLAGS=-DADXL34X_TEST_DECODER
    extra_configs:
      - CONFIG_ADXL34X_DECODER=y
      - CONFIG_ADXL34X_DATA_TYPE_SENSOR_VALUE=y
      - CONFIG_ADXL34X_FIFO_MODE_BYPASS=y
    platform_allow: native_sim
    integration_platforms:
      - native_sim
  drivers.sensor.adxl34x.streaming:
    extra_args: EXTRA_CFLAGS=-DADXL34X_TEST_STREAMING
    extra_configs:
      - CONFIG_ADXL34X_DECODER=n
      - CONFIG_ADXL34X_FIFO_MODE_STREAM=y
    platform_allow: native_sim
    integration_platforms:
      - native_sim
  drivers.sensor.adxl34x.extended:
    extra_args: EXTRA_CFLAGS=-DADXL34X_TEST_EXTENDED
    extra_configs:
      - CONFIG_ADXL34X_DECODER=y
      - CONFIG_ADXL34X_DATA_TYPE_Q31=y
      - CONFIG_ADXL34X_FIFO_MODE_STREAM=y
    platform_allow: native_sim
    integration_platforms:
      - native_sim
  drivers.sensor.adxl34x.i2c:
    extra_args:
      - EXTRA_CFLAGS=-DADXL34X_TEST_I2C
      - DTC_OVERLAY_FILE="boards/adxl34x-i2c.overlay"
    extra_configs:
      - CONFIG_ADXL34X_DECODER=y
      - CONFIG_ADXL34X_DATA_TYPE_Q31=y
      - CONFIG_ADXL34X_FIFO_MODE_STREAM=y
    platform_allow: native_sim
    integration_platforms:
      - native_sim
  drivers.sensor.adxl34x.i2c.arm:
    extra_args:
      - EXTRA_CFLAGS=-DADXL34X_TEST_I2C
      - DTC_OVERLAY_FILE="boards/qemu_cortex_m0-i2c.dtsi"
    extra_configs:
      - CONFIG_ADXL34X_DECODER=y
      - CONFIG_ADXL34X_DATA_TYPE_Q31=y
      - CONFIG_ADXL34X_FIFO_MODE_STREAM=y
    platform_allow: qemu_cortex_m0
    integration_platforms:
      - qemu_cortex_m0
    build_only: true
  drivers.sensor.adxl34x.spi:
    extra_args:
      - EXTRA_CFLAGS=-DADXL34X_TEST_SPI
      - DTC_OVERLAY_FILE="boards/adxl34x-spi.overlay"
    extra_configs:
      - CONFIG_ADXL34X_DECODER=y
      - CONFIG_ADXL34X_DATA_TYPE_Q31=y
      - CONFIG_ADXL34X_FIFO_MODE_STREAM=y
    platform_allow: native_sim
    integration_platforms:
      - native_sim
  drivers.sensor.adxl34x.spi.arm:
    extra_args:
      - EXTRA_CFLAGS=-DADXL34X_TEST_SPI
      - DTC_OVERLAY_FILE="boards/qemu_cortex_m0-spi.dtsi"
    extra_configs:
      - CONFIG_ADXL34X_DECODER=y
      - CONFIG_ADXL34X_DATA_TYPE_Q31=y
      - CONFIG_ADXL34X_FIFO_MODE_STREAM=y
    platform_allow: qemu_cortex_m0
    integration_platforms:
      - qemu_cortex_m0
    build_only: true
```

## tests/drivers/sensor/bmi160/testcase.yaml
```yaml
tests:
  drivers.sensor.accel:
    tags:
      - drivers
      - sensor
      - subsys
    platform_allow:
      - native_sim
```

## tests/drivers/sensor/flow_meter/testcase.yaml
```yaml
# Copyright (c) 2026 Nicolas Belin <nbelin@baylibre.com>
# SPDX-License-Identifier: Apache-2.0

tests:
  drivers.sensor.flow_meter:
    tags:
      - drivers
      - sensor
      - subsys
    platform_allow:
      - native_sim
```

## tests/drivers/sensor/generator/testcase.yaml
```yaml
# Copyright (c) 2024 Google Inc
# SPDX-License-Identifier: BDS-3-Clause

tests:
  drivers.sensor.generator:
    tags:
      - drivers
      - sensor
      - subsys
    platform_allow:
      - native_sim
```

## tests/drivers/sensor/generic/testcase.yaml
```yaml
common:
  integration_platforms:
    - qemu_x86
    - mps2_an385
tests:
  drivers.sensor.generic:
    tags: drivers sensor
  drivers.sensor.generic.fpu:
    extra_args: CONF_FILE=prj_fpu.conf
    tags: drivers sensor
```
