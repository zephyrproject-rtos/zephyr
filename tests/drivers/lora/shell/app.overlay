/*
 * Copyright (c) 2026 Embeint Inc
 *
 * SPDX-License-Identifier: Apache-2.0
 */

/ {
	aliases {
		lora0 = &fake_lora;
	};

	fake_lora: lora {
		compatible = "zephyr,fake-lora";
		status = "okay";
	};
};
