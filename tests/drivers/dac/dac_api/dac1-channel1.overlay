/*
 * Copyright (c) 2026 Analog Devices, Inc
 *
 * SPDX-License-Identifier: Apache-2.0
 */

/ {
	zephyr,user {
		io-channels = <&dac1 1>;
		io-channel-names = "dac1";
	};
};

&dac1 {

	#address-cells = <1>;
	#size-cells = <0>;
	status = "okay";

	channel@1 {
		reg = <1>;
		zephyr,resolution = <12>;
	};
};
