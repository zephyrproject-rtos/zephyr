/*
 * SPDX-FileCopyrightText: <text>Copyright (c) 2026 Infineon Technologies AG,
 * or an affiliate of Infineon Technologies AG. All rights reserved.</text>
 *
 * SPDX-License-Identifier: Apache-2.0
 */

#include <zephyr/dt-bindings/dac/infineon-autanalog-ctdac.h>

/ {
	zephyr,user {
		/* FW channel. Output to P14.6 */
		io-channels = <&dac0 15>;
		io-channel-names = "dac1";
	};
};

&dac0 {
	status = "okay";
	clocks = <&peri0_group2_8bit_0>;
	vref-source = <IFX_AUTANALOG_CTDAC_VREF_VDDA>;
	topology = <IFX_AUTANALOG_CTDAC_TOPO_BUFFERED_EXTERNAL>;
	out-buf-pwr = <IFX_AUTANALOG_CTDAC_OUT_BUF_PWR_ULTRA_LOW>;
};

/* Peripheral clock divider for DAC0 (PERI0, group 2, CLK_HF9) */
&peri0_group2_8bit_0 {
	status = "okay";
	clock-div = <1>;
};
