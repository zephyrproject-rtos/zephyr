/*
 * Copyright 2026 NXP
 *
 * SPDX-License-Identifier: Apache-2.0
 */

/ {
	chosen {
		zephyr,console = &lpuart3;
		zephyr,shell-uart = &lpuart3;
	};
};

&lpuart2 {
	status = "disabled";
};

&lpuart3 {
	status = "okay";
};
