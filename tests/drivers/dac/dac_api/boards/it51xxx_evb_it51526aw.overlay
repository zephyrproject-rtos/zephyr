/*
 * Copyright (c) 2026 ITE Corporation. All Rights Reserved.
 *
 * SPDX-License-Identifier: Apache-2.0
 */

/ {
	zephyr,user {
		io-channels = <&dac0 0>;
		io-channel-names = "dac1";
	};
};

&dac0 {
	channel@0 {
		reg = <0>;
		zephyr,resolution = <8>;
	};
};
