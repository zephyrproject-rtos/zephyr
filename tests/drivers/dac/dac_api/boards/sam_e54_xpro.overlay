/*
 * Copyright (c) 2025-2026 Microchip Technology Inc.
 *
 * SPDX-License-Identifier: Apache-2.0
 */

/ {
	zephyr,user {
		io-channels = <&dac 0>;
		io-channel-names = "dac1";
	};
};

&dac {
	status = "okay";
	refsel = "int_ref";
	#address-cells = <1>;
	#size-cells = <0>;

	dac0: channel@0 {
		reg = <0>;
		rate = <1000>;
		zephyr,resolution = <12>;
	};
};
