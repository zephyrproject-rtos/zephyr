## tests/drivers/dac/dac_api/boards/lp_mspm0g3507.conf
```kconfig
# Copyright (c) 2026 Linumiz
# SPDX-License-Identifier: Apache-2.0

CONFIG_DAC=y
```

## tests/drivers/dac/dac_api/boards/sam_e54_xpro.conf
```kconfig
# Copyright (c) 2025 Microchip Technology Inc.
# SPDX-License-Identifier: Apache-2.0

CONFIG_DAC_BUFFER_NOT_SUPPORT=y
```

## tests/drivers/dac/dac_api/testcase.yaml
```yaml
common:
  depends_on: dac
  min_ram: 16
  tags:
    - dac
    - drivers
    - userspace
tests:
  drivers.dac.api:
    filter: dt_node_has_prop("/zephyr,user", "io-channels")
  drivers.dac.api.dac_channel0:
    extra_args:
      - EXTRA_DTC_OVERLAY_FILE="dac-channel0.overlay"
    platform_allow:
      - esp32c3_devkitc
      - esp32_devkitc/esp32/procpu
      - esp_wrover_kit/esp32/procpu
      - esp32s2_saola
      - esp32s2_devkitc
      - gd32a503v_eval
      - gd32e103v_eval
      - gd32f450i_eval
      - gd32f450z_eval
      - gd32f470i_eval
      - yd_esp32/esp32/appcpu
      - mimxrt1170_evk@A/mimxrt1176/cm4
      - mimxrt1170_evk@B/mimxrt1176/cm4
      - mimxrt1170_evk@A/mimxrt1176/cm7
      - mimxrt1170_evk@B/mimxrt1176/cm7
      - mimxrt1180_evk/mimxrt1189/cm33
      - mimxrt1180_evk/mimxrt1189/cm7
      - frdm_mcxc444
      - phyboard_atlas/mimxrt1176/cm7
  drivers.dac.api.dacc_channel0:
    platform_allow:
      - sam4l_ek
    extra_args:
      - EXTRA_DTC_OVERLAY_FILE="dacc-channel0.overlay"
  drivers.dac.api.dac0_no_channel:
    extra_args:
      - EXTRA_DTC_OVERLAY_FILE="dac0-no-channel.overlay"
    platform_allow:
      - arduino_zero
      - arduino_mkrzero
      - seeeduino_xiao
      - sparkfun_samd21_breakout
  drivers.dac.api.dac0_channel0:
    extra_args:
      - EXTRA_DTC_OVERLAY_FILE="dac0-channel0.overlay"
    platform_allow:
      - twr_ke18f
      - frdm_k64f
      - frdm_k22f
      - frdm_mcxn947/mcxn947/cpu0
      - mcx_n9xx_evk/mcxn947/cpu0
      - frdm_mcxa156
      - lpcxpresso55s36
      - same54_xpro
      - bl652_dvk
      - bl653_dvk
      - bl5340_dvk/nrf5340/cpuapp
  drivers.dac.api.dac1_channel1:
    extra_args:
      - EXTRA_DTC_OVERLAY_FILE="dac1-channel1.overlay"
    platform_allow:
      - nucleo_f091rc
      - nucleo_f207zg
      - stm32f3_disco
      - nucleo_f429zi
      - nucleo_f439zi
      - nucleo_f746zg
      - nucleo_f767zi
      - nucleo_f722ze
      - nucleo_g071rb
      - nucleo_g431rb
      - nucleo_g474re
      - nucleo_h723zg
      - nucleo_h743zi
      - nucleo_h753zi
      - nucleo_l073rz
      - nucleo_l152re
      - disco_l475_iot1
      - nucleo_l552ze_q
      - stm32l562e_dk
      - stm32h5f5j_dk
      - stm32h573i_dk
      - stm32u083c_dk
      - b_u585i_iot02a
      - nucleo_u083rc
      - nucleo_u385rg_q
      - nucleo_u575zi_q
      - nucleo_u5a5zj_q
      - nucleo_wl55jc
      - ronoth_lodev
      - arduino_uno_q
    integration_platforms:
      - nucleo_f207zg
  drivers.dac.api.dac1_channel2:
    extra_args:
      - EXTRA_DTC_OVERLAY_FILE="dac1-channel2.overlay"
    platform_allow:
      - nucleo_h563zi
  drivers.dac.api.renesas_dac0_channel0:
    vendor_allow:
      - renesas
    filter: dt_compat_enabled("renesas,ra-dac")
    extra_args:
      - EXTRA_DTC_OVERLAY_FILE="dac0-channel0.overlay"
  drivers.dac.api.silabs_s2_vdac0_channel0:
    platform_allow:
      - xg23_rb4210a
      - xg24_dk2601b
      - xg24_ek2703a
      - xg24_rb4187c
    extra_args:
      - EXTRA_DTC_OVERLAY_FILE="xg2x.overlay"
```

## tests/drivers/dac/dac_emul/testcase.yaml
```yaml
tests:
  drivers.dac.emul:
    tags:
      - drivers
      - dac
    platform_allow:
      - native_sim
    integration_platforms:
      - native_sim
```

## tests/drivers/dac/dac_loopback/testcase.yaml
```yaml
common:
  tags:
    - dac
    - drivers
  depends_on:
    - dac
    - adc
  harness: ztest
  harness_config:
    fixture: dac_adc_loopback
tests:
  drivers.dac.loopback:
    filter: dt_node_has_prop("/zephyr,user", "io-channels")
  drivers.dac.loopback.xg2x:
    extra_args:
      - EXTRA_DTC_OVERLAY_FILE="xg2x.overlay"
    platform_allow:
      - xg23_rb4210a
      - xg24_dk2601b
      - xg24_ek2703a
      - xg24_rb4187c
  drivers.dac.loopback.dac1_chan1_adc1_chan0:
    extra_args:
      - EXTRA_DTC_OVERLAY_FILE="dac1-channel1-adc1-channel0.overlay"
    platform_allow:
      - nucleo_f207zg
      - nucleo_f429zi
      - nucleo_f746zg
      - nucleo_g071rb
      - nucleo_l073rz
    integration_platforms:
      - nucleo_f207zg
  drivers.dac.loopback.nxp_dac0_adc23_internal:
    extra_args:
      - EXTRA_DTC_OVERLAY_FILE="nxp-dac0-adc23-internal.overlay"
    extra_configs:
      - CONFIG_DAC_MCUX_DAC32_TESTOUT=y
    platform_allow:
      - frdm_k22f
      - frdm_k64f
      - twr_ke18f
  drivers.dac.loopback.blxxx_dvk:
    extra_args:
      - EXTRA_DTC_OVERLAY_FILE="blxxx_dvk.overlay"
    platform_allow:
      - bl652_dvk
      - bl653_dvk
      - bl654_dvk
      - bl5340_dvk/nrf5340/cpuapp
```

## tests/drivers/dai/virtual_dai_api/testcase.yaml
```yaml
common:
  tags:
    - dai
    - drivers
tests:
  drivers.dai.virtual_dai_api:
    depends_on: dai
```

## tests/drivers/disk/disk_access/Kconfig
```kconfig
# SPDX-License-Identifier: Apache-2.0
# Copyright 2022 NXP

mainmenu "Disk driver access test"

config MAIN_STACK_SIZE
	default 1280 if (MMC_STACK && IMX_USDHC)

config TEST_MAX_DISK_SECTOR_SIZE
	int "Maximum sector size of disk device under test"
	default 512
	help
	  Maximum sector size of the disk device the test will validate against.

source "Kconfig.zephyr"
```

## tests/drivers/disk/disk_access/boards/ek_ra8m1_sci_b_spi.conf
```kconfig
# Copyright (c) 2025 Renesas Electronics Corporation
# SPDX-License-Identifier: Apache-2.0

CONFIG_MAIN_STACK_SIZE=1280
```

## tests/drivers/disk/disk_access/boards/intel_nvl_s_rvp.conf
```kconfig
CONFIG_NVME=y
CONFIG_PCIE_MSI=y
CONFIG_PCIE_MSI_X=y
CONFIG_PCIE_MSI_MULTI_VECTOR=y
```

## tests/drivers/disk/disk_access/boards/nrf7120dk_nrf7120_cpuapp.conf
```kconfig
# Copyright (c) 2026 Nordic Semiconductor ASA
# SPDX-License-Identifier: Apache-2.0

CONFIG_MEMC=y
CONFIG_MSPI=y
CONFIG_MAIN_STACK_SIZE=4096
CONFIG_ZTEST_STACK_SIZE=4096
```

## tests/drivers/disk/disk_access/boards/stm32h573i_dk.conf
```kconfig
# Copyright (c) 2026 STMicroelectronics
# SPDX-License-Identifier: Apache-2.0

CONFIG_SDMMC_STM32_HWFC=y
```

## tests/drivers/disk/disk_access/testcase.yaml
```yaml
common:
  harness: ztest
  tags: disk
tests:
  drivers.disk.usdhc:
    harness_config:
      fixture: fixture_sdhc
    filter: CONFIG_SDHC
    extra_configs:
      - CONFIG_DISK_DRIVER_SDMMC=y
    tags: mcux
    integration_platforms:
      - mimxrt1060_evk
      - mimxrt1050_evk
      - mimxrt1064_evk
  drivers.disk.ram:
    platform_allow: qemu_x86_64
  drivers.disk.nvme:
    extra_configs:
      - CONFIG_NVME=y
    platform_allow: qemu_x86_64
  drivers.disk.flash:
    extra_configs:
      - CONFIG_DISK_DRIVER_FLASH=y
    platform_allow:
      - native_sim/native/64
      - native_sim
  drivers.disk.loopback:
    extra_configs:
      - CONFIG_DISK_DRIVER_LOOPBACK=y
      - CONFIG_FILE_SYSTEM=y
      - CONFIG_FILE_SYSTEM_MKFS=y
      - CONFIG_FAT_FILESYSTEM_ELM=y
    platform_allow:
      - native_sim/native/64
      - native_sim
  drivers.disk.stm32_sdhc:
    filter: dt_compat_enabled("st,stm32-sdmmc")
  drivers.disk.simulator.no_explicit_erase:
    extra_args: DTC_OVERLAY_FILE=boards/native_sim_no_explicit_erase.overlay
    extra_configs:
      - CONFIG_DISK_DRIVER_FLASH=y
      - CONFIG_FLASH_SIMULATOR_EXPLICIT_ERASE=n
    platform_allow:
      - native_sim/native/64
      - native_sim
```

## tests/drivers/disk/disk_performance/Kconfig
```kconfig
# SPDX-License-Identifier: Apache-2.0
# Copyright 2022 NXP

mainmenu "Disk driver performance test"

config MAIN_STACK_SIZE
	default 1280 if (MMC_STACK && IMX_USDHC)

source "Kconfig.zephyr"
```

## tests/drivers/disk/disk_performance/boards/apollo510_evb.conf
```kconfig
CONFIG_DISK_DRIVER_MMC=y
CONFIG_MMC_STACK=y
CONFIG_SDHC=y
CONFIG_MMC_SUBSYS=y

CONFIG_MAIN_STACK_SIZE=8192
CONFIG_IDLE_STACK_SIZE=4096
CONFIG_AMBIQ_SDIO_ASYNC=y
CONFIG_MMC_DDR50=y
CONFIG_MMC_CARD_8BIT_WIDTH=y
```

## tests/drivers/disk/disk_performance/testcase.yaml
```yaml
common:
  harness: ztest
  tags: disk
tests:
  drivers.disk.disk_performance.sdhc:
    depends_on: sdhc
    harness: ztest
    harness_config:
      fixture: fixture_sdhc
    tags: sdhc
    integration_platforms:
      - mimxrt1064_evk
      - mimxrt595_evk/mimxrt595s/cm33
    extra_args:
      - platform:ek_ra8m1/r7fa8m1ahecbd:SHIELD=pmod_sd
      - platform:ek_ra8p1/r7ka8p1kflcac/cm85:SHIELD=pmod_sd
  drivers.disk.disk_performance.disk.nvme:
    extra_configs:
      - CONFIG_NVME=y
    platform_allow: qemu_x86_64
  drivers.disk.disk_performance.disk.memc_ram:
    build_only: true
    filter: dt_compat_enabled("zephyr,memc-ram-disk") and CONFIG_DISK_DRIVER_MEMC_RAM
    integration_platforms:
      - nrf7120dk/nrf7120/cpuapp
  drivers.disk.disk_performance.ftl.spi_nand.mikroe_flash_5_click:
    harness_config:
      fixture: mikroe_flash_5_click
    extra_configs:
      - CONFIG_ZTEST_STACK_SIZE=4096
      - CONFIG_DISK_DRIVER_SDMMC=n
    extra_args:
      - SHIELD=mikroe_flash_5_click
      - DTC_OVERLAY_FILE="./boards/mikroe_flash_5_click.overlay"
    platform_allow:
      - frdm_mcxn947/mcxn947/cpu0
```

## tests/drivers/disk/ffat/testcase.yaml
```yaml
tests:
  drivers.ffat:
    tags:
      - disk
    integration_platforms:
      - native_sim/native/64
```

## tests/drivers/disk/testcase.yaml
```yaml
tests:
  drivers.disk.usdhc:
    harness: ztest
    harness_config:
      fixture: fixture_sdhc
    filter: CONFIG_SDMMC_USDHC
    tags: disk mcux
    integration_platforms:
      - mimxrt1060_evk
      - mimxrt1050_evk
      - mimxrt1064_evk
```

## tests/drivers/display/display_callbacks/Kconfig
```kconfig
# Private config options for display_check test
# Copyright (c) 2026 STMicroelectronics
# SPDX-License-Identifier: Apache-2.0

source "samples/drivers/display/Kconfig"
```
