/*
 * Copyright (c) 2020 Libre Solar Technologies GmbH
 *
 * SPDX-License-Identifier: Apache-2.0
 */

/*
 * @addtogroup test_dac_loopback
 * @{
 * @defgroup t_dac_basic_loopback test_dac_loopback
 * @brief TestPurpose: read back DAC driver output with ADC
 * @}
 */

#include <zephyr/drivers/dac.h>
#include <zephyr/drivers/adc.h>
#include <zephyr/kernel.h>
#include <zephyr/ztest.h>

/*
 * We need to define an ADC channel to read back the output generated by the
 * ADC. The two pins need to be connected with a jumper in order to pass the
 * test in actual hardware.
 *
 * ADC and DAC need to use the same reference voltage, as the test sampling
 * point is at half of the full scale voltage.
 */

static const struct dac_dt_spec dac_spec =
	DAC_DT_SPEC_GET_BY_NAME_OR(DT_PATH(zephyr_user), dac1, {0});
static const struct adc_dt_spec adc_spec =
	ADC_DT_SPEC_GET_BY_NAME_OR(DT_PATH(zephyr_user), adc1, {0});

static int init_dac(void)
{
	int ret;

	if (!dac_spec.dev) {
		return -ENODEV;
	}

	zassert_true(dac_is_ready_dt(&dac_spec), "DAC device is not ready");

	ret = dac_channel_setup_dt(&dac_spec);
	zassert_ok(ret, "Setting up of the first channel failed with code %d", ret);
	return 0;
}

/* ADC necessary to read back the value from DAC */
static int init_adc(void)
{
	int ret;

	if (!adc_spec.dev) {
		return -ENODEV;
	}

	zassert_true(adc_is_ready_dt(&adc_spec), "ADC device is not ready");

	ret = adc_channel_setup_dt(&adc_spec);
	zassert_ok(ret, "Setting up of the ADC channel failed with code %d", ret);
	return 0;
}

/*
 * test_dac_loopback
 */
static int test_task_loopback(void)
{
	int ret;

	ret = init_adc();
	if (ret == -ENODEV) {
		TC_PRINT("No io-channel named 'adc1' available for testing.\n");
		ztest_test_skip();
		return TC_SKIP;
	}

	ret = init_dac();

	if (ret == -ENODEV) {
		TC_PRINT("No io-channel named 'dac1' available for testing.\n");
		ztest_test_skip();
		return TC_SKIP;
	}

	/* write a value of half the full scale resolution */
	ret = dac_write_value_dt(&dac_spec, (1U << dac_spec.channel_cfg.resolution) / 2);
	zassert_ok(ret, "dac_write_value() failed with code %d", ret);

	/* wait to let DAC output settle */
	k_sleep(K_MSEC(10));

	static int16_t m_sample_buffer[1];
	static struct adc_sequence sequence = {
		.buffer      = m_sample_buffer,
		.buffer_size = sizeof(m_sample_buffer),
	};

	adc_sequence_init_dt(&adc_spec, &sequence);

	ret = adc_read_dt(&adc_spec, &sequence);
	zassert_ok(ret, "adc_read() failed with code %d", ret);
	zassert_within(m_sample_buffer[0],
		(1U << adc_spec.resolution) / 2, 32,
		"Value %d read from ADC does not match expected range.",
		m_sample_buffer[0]);

	return TC_PASS;
}

ZTEST(dac_loopback, test_dac_loopback)
{
	zassert_true(test_task_loopback() == TC_PASS);
}

ZTEST_SUITE(dac_loopback, NULL, NULL, NULL, NULL, NULL);
