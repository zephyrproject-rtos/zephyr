/*
 * Copyright (c) 2022 Caspar Friedrich <c.s.w.friedrich@gmail.com>
 *
 * SPDX-License-Identifier: Apache-2.0
 */

&arduino_serial {
	status = "okay";

	w1_0: w1 {
		compatible = "zephyr,w1-serial";
	};
};

#include "w1_devices.dtsi"
