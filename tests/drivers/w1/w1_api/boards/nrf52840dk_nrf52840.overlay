/*
 * Copyright (c) 2022 Thomas Stranger
 *
 * SPDX-License-Identifier: Apache-2.0
 */

/* external connection of TX-pin to RX-pin needed */
&pinctrl {
	uart1_default: uart1_default {
		group1 {
			psels = <NRF_PSEL(UART_RX, 1, 1)>;
			bias-pull-up;
		};
		group2 {
			psels = <NRF_PSEL(UART_TX, 1, 2)>;
			/* max. 5mA drive strength: */
			nordic,drive-mode = <NRF_DRIVE_H0D1>;
		};
	};
};
