/*
 * Copyright (c) 2024 Analog Devices, Inc.
 *
 * SPDX-License-Identifier: Apache-2.0
 */

&owm_io_p0_6 {
	power-source=<MAX32_VSEL_VDDIOH>;
};

&owm_pe_p0_7 {
	power-source=<MAX32_VSEL_VDDIOH>;
};

w1_0: &w1 {
	status = "okay";
	pinctrl-0 = <&owm_io_p0_6 &owm_pe_p0_7>;
	pinctrl-names = "default";
	internal-pullup = <1>;
	external-pullup = <0>;
	long-line-mode = <0>;
};

#include "../w1_devices.dtsi"
