/*
 * Copyright (c) 2023 Caspar Friedrich <c.s.w.friedrich@gmail.com>
 *
 * SPDX-License-Identifier: Apache-2.0
 */

&arduino_i2c {
	w1@18 {
		compatible = "maxim,ds2482-800";
		reg = <0x18>;

		#address-cells = <1>;
		#size-cells = <0>;

		w1_0: ch@0 {
			compatible = "maxim,ds2482-800-channel";
			reg = <0>;
		};
	};
};

#include "w1_devices.dtsi"
