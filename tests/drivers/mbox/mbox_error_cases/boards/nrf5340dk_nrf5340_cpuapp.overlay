/*
 * Copyright 2026 Nordic Semiconductor ASA
 * SPDX-License-Identifier: Apache-2.0
 */

/ {
	mbox-consumer {
		compatible = "zephyr,mbox-consumer";
		mboxes = <&mbox 1>, <&mbox 0>;
		mbox-names = "tx0", "rx0";
		bidirectional-channels;
	};
};
