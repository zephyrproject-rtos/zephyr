## CMakeLists.txt
```
#
# Copyright 2024 Nordic Semiconductor ASA
# SPDX-License-Identifier: Apache-2.0
#

cmake_minimum_required(VERSION 3.28.0)

find_package(Zephyr REQUIRED HINTS $ENV{ZEPHYR_BASE})
project(mbox_error_cases)

target_sources(app PRIVATE src/main.c)
```

## Kconfig
```
#
# Copyright (c) 2026 Nordic Semiconductor ASA
#
# SPDX-License-Identifier: Apache-2.0
#

mainmenu "MBOX Negative Test"

config TEST_EXPECTED_MTU_VALUE
	int "Maximum data field size"
	default 0
	help
	  Expected value that mbox_mtu_get_dt() shall return.
	  Maximum number of bytes possible in an outbound message.

config TEST_REMOTE_BUSY_NOT_SUPPORTED
	bool "Remote busy is NOT supported"
	default y
	help
	  Value of 'y' means that transmitter is NOT able to detect
	  if the remote hasn't yet read the last data sent.

config TEST_CHANNEL_IS_BIDIRECTIONAL
	bool "Channel can be used for both TX and RX"
	help
	  When set to 'y' an MBOX channel can be used for both
	  sending and receiving messages.

source "Kconfig.zephyr"
```

## sample.yaml
```
sample:
  name: MBOX IPC negative test cases
common:
  tags:
    - drivers
    - mbox
  harness: ztest
tests:

  drivers.mbox.mbox_error_cases:
    platform_allow:
      - nrf5340dk/nrf5340/cpuapp
      - nrf54h20dk/nrf54h20/cpuapp
      - nrf54h20dk/nrf54h20/cpuppr
    integration_platforms:
      - nrf54h20dk/nrf54h20/cpuapp

  drivers.mbox.mbox_error_cases.nrf54l:
    platform_allow:
      - nrf54l15dk/nrf54l15/cpuapp
      - nrf54lm20dk/nrf54lm20a/cpuapp
      - nrf54lm20dk/nrf54lm20b/cpuapp
      - nrf7120dk/nrf7120/cpuapp
      - ophelia4ev/nrf54l15/cpuapp
    integration_platforms:
      - nrf54l15dk/nrf54l15/cpuapp
      - nrf54lm20dk/nrf54lm20a/cpuapp
      - nrf7120dk/nrf7120/cpuapp
      - ophelia4ev/nrf54l15/cpuapp
    extra_args: SNIPPET=nordic-flpr
```

## prj.conf
```kconfig
CONFIG_ZTEST=y

CONFIG_MBOX=y
```

## boards/nrf5340dk_nrf5340_cpuapp.conf
```kconfig
CONFIG_TEST_CHANNEL_IS_BIDIRECTIONAL=y
```

## boards/rzg3s_smarc_r9a08g045s33gbg_cm33.conf
```kconfig
CONFIG_TEST_EXPECTED_MTU_VALUE=4
```

## boards/rzv2l_smarc_r9a07g054l23gbg_cm33.conf
```kconfig
CONFIG_TEST_EXPECTED_MTU_VALUE=4
CONFIG_TEST_CHANNEL_IS_BIDIRECTIONAL=y
```

## socs/pse846gps2dbzc4a_m33_ns.conf
```kconfig
# SPDX-FileCopyrightText: Copyright (c) 2026 Infineon Technologies AG,
# SPDX-FileCopyrightText: or an affiliate of Infineon Technologies AG. All rights reserved.
#
# SPDX-License-Identifier: Apache-2.0

CONFIG_TEST_EXPECTED_MTU_VALUE=8
CONFIG_TEST_CHANNEL_IS_BIDIRECTIONAL=y
```

## boards/bl54l15_dvk_nrf54l15_cpuapp.overlay
```dts
/*
 * Copyright 2024 Nordic Semiconductor ASA
 * Copyright 2025 Ezurio LLC
 * SPDX-License-Identifier: Apache-2.0
 */

/ {
	mbox-consumer {
		compatible = "zephyr,mbox-consumer";
		mboxes = <&cpuapp_vevif_tx 21>, <&cpuapp_vevif_rx 20>;
		mbox-names = "tx0", "rx0";
	};
};

&cpuapp_vevif_rx {
	status = "okay";
};

&cpuapp_vevif_tx {
	status = "okay";
};
```

## boards/bl54l15u_dvk_nrf54l15_cpuapp.overlay
```dts
/*
 * Copyright 2024 Nordic Semiconductor ASA
 * Copyright 2025 Ezurio LLC
 * SPDX-License-Identifier: Apache-2.0
 */

/ {
	mbox-consumer {
		compatible = "vnd,mbox-consumer";
		mboxes = <&cpuapp_vevif_tx 21>, <&cpuapp_vevif_tx 32>,
				 <&cpuapp_vevif_rx 20>, <&cpuapp_vevif_rx 32>;
		mbox-names = "remote_valid", "remote_incorrect",
					 "local_valid", "local_incorrect";
	};
};

&cpuapp_vevif_rx {
	status = "okay";
};

&cpuapp_vevif_tx {
	status = "okay";
};
```

## boards/nrf5340dk_nrf5340_cpuapp.overlay
```dts
/*
 * Copyright 2026 Nordic Semiconductor ASA
 * SPDX-License-Identifier: Apache-2.0
 */

/ {
	mbox-consumer {
		compatible = "zephyr,mbox-consumer";
		mboxes = <&mbox 1>, <&mbox 0>;
		mbox-names = "tx0", "rx0";
		bidirectional-channels;
	};
};
```

## boards/nrf54h20dk_nrf54h20_cpuapp.overlay
```dts
/*
 * Copyright 2024 Nordic Semiconductor ASA
 * SPDX-License-Identifier: Apache-2.0
 */

/ {
	mbox-consumer {
		compatible = "vnd,mbox-consumer";
		mboxes = <&cpuppr_vevif 15>, <&cpuppr_vevif 32>,
			 <&cpuapp_bellboard 18>, <&cpuapp_bellboard 32>;
		mbox-names = "remote_valid", "remote_incorrect",
			     "local_valid", "local_incorrect";
	};
};

&cpuapp_bellboard {
	status = "okay";
};

&cpuppr_vevif {
	status = "okay";
};
```

## boards/nrf54h20dk_nrf54h20_cpuppr.overlay
```dts
/*
 * Copyright 2024 Nordic Semiconductor ASA
 * SPDX-License-Identifier: Apache-2.0
 */

/ {
	mbox-consumer {
		compatible = "vnd,mbox-consumer";
		mboxes = <&cpuapp_bellboard 18>, <&cpuapp_bellboard 32>,
			 <&cpuppr_vevif 15>, <&cpuppr_vevif 32>;
		mbox-names = "remote_valid", "remote_incorrect",
			     "local_valid", "local_incorrect";
	};
};

&cpuapp_bellboard {
	status = "okay";
};

&cpuppr_vevif {
	status = "okay";
};
```

## boards/nrf54l15dk_nrf54l15_cpuapp.overlay
```dts
/*
 * Copyright 2024 Nordic Semiconductor ASA
 * SPDX-License-Identifier: Apache-2.0
 */

/ {
	mbox-consumer {
		compatible = "vnd,mbox-consumer";
		mboxes = <&cpuapp_vevif_tx 21>, <&cpuapp_vevif_tx 32>,
				 <&cpuapp_vevif_rx 20>, <&cpuapp_vevif_rx 32>;
		mbox-names = "remote_valid", "remote_incorrect",
					 "local_valid", "local_incorrect";

	};
};

&cpuapp_vevif_rx {
	status = "okay";
};

&cpuapp_vevif_tx {
	status = "okay";
};
```

## src/main.c
```c
/*
 * Copyright (c) 2024, Nordic Semiconductor ASA
 *
 * SPDX-License-Identifier: Apache-2.0
 */

#include <zephyr/kernel.h>
#include <zephyr/ztest.h>
#include <zephyr/drivers/mbox.h>

#if DT_HAS_COMPAT_STATUS_OKAY(zephyr_mbox_consumer)
#define MBOX_CONSUMER_NODE DT_COMPAT_GET_ANY_STATUS_OKAY(zephyr_mbox_consumer)
#define TX_CHANNEL_NAME    tx0
#define RX_CHANNEL_NAME    rx0
#elif DT_HAS_COMPAT_STATUS_OKAY(vnd_mbox_consumer)
#define MBOX_CONSUMER_NODE DT_COMPAT_GET_ANY_STATUS_OKAY(vnd_mbox_consumer)
#define TX_CHANNEL_NAME    remote_valid
#define RX_CHANNEL_NAME    local_valid
#else
#error "No zephyr,mbox-consumer or vnd,mbox-consumer node in the devicetree"
#endif

#define TX_CHANNEL_SPEC MBOX_DT_SPEC_GET(MBOX_CONSUMER_NODE, TX_CHANNEL_NAME)
#define RX_CHANNEL_SPEC MBOX_DT_SPEC_GET(MBOX_CONSUMER_NODE, RX_CHANNEL_NAME)

#define TEST_BIDIRECTIONAL_CHANNELS DT_PROP_OR(MBOX_CONSUMER_NODE, bidirectional_channels, 0)
#define TEST_EXPECTED_MTU_VALUE     DT_PROP_OR(MBOX_CONSUMER_NODE, mtu, 0)
#define TEST_REMOTE_BUSY_DETECTION  DT_PROP_OR(MBOX_CONSUMER_NODE, remote_busy_detection, 0)

int dummy_value[] = {1, 2, 3, 4};

/* Channel ids run from 0 to (maximum number of channels - 1), so the
 * maximum itself is always an incorrect channel id.
 */
static struct mbox_dt_spec incorrect_channel(const struct mbox_dt_spec *valid)
{
	struct mbox_dt_spec spec = *valid;
	int max_channels = mbox_max_channels_get_dt(valid);

	zassert_true(max_channels > 0,
		     "mbox_max_channels_get_dt() shall return value greater than 0"
		     " got unexpected %d", max_channels);
	spec.channel_id = (mbox_channel_id_t)max_channels;

	return spec;
}

static void dummy_callback(const struct device *dev, mbox_channel_id_t channel_id,
		     void *user_data, struct mbox_msg *data)
{
	ARG_UNUSED(dev);
	ARG_UNUSED(channel_id);
	ARG_UNUSED(user_data);
	ARG_UNUSED(data);
	/* Nothing here */
}

static void dummy_callback_2(const struct device *dev, mbox_channel_id_t channel_id,
		     void *user_data, struct mbox_msg *data)
{
	ARG_UNUSED(dev);
	ARG_UNUSED(channel_id);
	ARG_UNUSED(data);

	int *temp = (int *) user_data;
	(*temp)++;
}

/**
 * @brief mbox_is_ready_dt() positive test
 *
 * Confirm that mbox_is_ready_dt() returns True
 * on valid local and remote mbox channels.
 *
 */
ZTEST(mbox_error_cases, test_01a_mbox_is_ready_positive)
{
	const struct mbox_dt_spec rx_channel = RX_CHANNEL_SPEC;
	const struct mbox_dt_spec tx_channel = TX_CHANNEL_SPEC;
	bool ret;

	ret = mbox_is_ready_dt(&tx_channel);
	zassert_true(
		ret,
		"mbox_is_ready_dt(tx_channel) should return True,"
		" got unexpected value of %d",
		ret
	);

	ret = mbox_is_ready_dt(&rx_channel);
	zassert_true(
		ret,
		"mbox_is_ready_dt(rx_channel) should return True,"
		" got unexpected value of %d",
		ret
	);
}

/**
 * @brief mbox_is_ready_dt() on incorrect channels
 *
 * Confirm that mbox_is_ready_dt() returns True
 * on invalid local and remote mbox channel.
 * (Device is ready, channel is not checked.)
 *
 */
ZTEST(mbox_error_cases, test_01b_mbox_is_ready_negative)
{
	const struct mbox_dt_spec rx_valid = RX_CHANNEL_SPEC;
	const struct mbox_dt_spec tx_valid = TX_CHANNEL_SPEC;
	const struct mbox_dt_spec rx_channel = incorrect_channel(&rx_valid);
	const struct mbox_dt_spec tx_channel = incorrect_channel(&tx_valid);
	bool ret;

	ret = mbox_is_ready_dt(&tx_channel);
	zassert_true(
		ret,
		"mbox_is_ready_dt(tx_invalid_channel) should return True,"
		" got unexpected value of %d",
		ret
	);

	ret = mbox_is_ready_dt(&rx_channel);
	zassert_true(
		ret,
		"mbox_is_ready_dt(rx_invalid_channel) should return True,"
		" got unexpected value of %d", ret
	);
}

/**
 * @brief mbox_send_dt() on invalid TX channel shall fail
 *
 * Confirm that mbox_send_dt() returns
 * -EINVAL when TX channel is invalid.
 *
 */
ZTEST(mbox_error_cases, test_02a_mbox_send_on_invalid_tx_channel)
{
	const struct mbox_dt_spec tx_valid = TX_CHANNEL_SPEC;
	const struct mbox_dt_spec tx_channel = incorrect_channel(&tx_valid);
	int ret;

	ret = mbox_send_dt(&tx_channel, NULL);
	zassert_true(
		(ret == -EINVAL),
		"mbox_send_dt(incorrect_tx_channel) shall return -EINVAL (-22)"
		" got unexpected %d",
		ret
	);
}

/**
 * @brief mbox_send_dt() on RX channel shall fail
 *
 * Confirm that mbox_send_dt() returns
 * -ENOSYS when user tries to send on RX channel.
 *
 */
ZTEST(mbox_error_cases, test_02b_mbox_send_on_rx_channel)
{
	const struct mbox_dt_spec rx_channel = RX_CHANNEL_SPEC;
	int ret;

	if (TEST_BIDIRECTIONAL_CHANNELS) {
		ztest_test_skip();
	}

	ret = mbox_send_dt(&rx_channel, NULL);
	zassert_true(
		(ret == -ENOSYS),
		"mbox_send_dt(rx_channel) shall return -ENOSYS (-88)"
		" got unexpected %d",
		ret
	);
}

/**
 * @brief mbox_send_dt() with too large data
 *
 * Confirm that mbox_send_dt() returns
 * -EMSGSIZE If the supplied data size is unsupported by the driver.
 *
 */
ZTEST(mbox_error_cases, test_02c_mbox_send_message_data_too_large)
{
	const struct mbox_dt_spec tx_channel = TX_CHANNEL_SPEC;
	struct mbox_msg data_msg = {0};
	int ret;

	ret = mbox_mtu_get_dt(&tx_channel);

	if (ret == 0) {
		/* Skip this test because driver supports signalling mode only. */
		ztest_test_skip();
	}

	data_msg.data = dummy_value;
	data_msg.size = ret + 1;

	ret = mbox_send_dt(&tx_channel, &data_msg);
	zassert_true(
		(ret == -EMSGSIZE),
		"mbox_send_dt(rx_channel, data) shall return -EMSGSIZE (-122)"
		" got unexpected %d",
		ret
	);
}

/**
 * @brief mbox_send_dt() remote busy
 *
 * Confirm that mbox_send_dt() returns
 * -EBUSY when remote hasn’t yet read the last data sent.
 *
 */
ZTEST(mbox_error_cases, test_02d_mbox_send_message_remote_busy)
{
	const struct mbox_dt_spec tx_channel = TX_CHANNEL_SPEC;
	int ret;

	/* Skip this test when driver can't detect that remote is busy. */
	if (!TEST_REMOTE_BUSY_DETECTION) {
		ztest_test_skip();
	}

	ret = mbox_send_dt(&tx_channel, NULL);
	zassert_true(
		(ret == 0),
		"mbox_send_dt(rx_channel) shall return 0"
		" got unexpected %d",
		ret
	);

	ret = mbox_send_dt(&tx_channel, NULL);
	zassert_true(
		(ret == -EBUSY),
		"mbox_send_dt(rx_channel) shall return -EBUSY (-16)"
		" got unexpected %d",
		ret
	);
}

/**
 * @brief mbox_register_callback_dt() on TX channel shall fail
 *
 * Confirm that mbox_register_callback_dt() returns
 * -ENOSYS when user tries to register callback on TX mbox channel.
 *
 */
ZTEST(mbox_error_cases, test_03a_mbox_register_callback_on_remote_channel)
{
	const struct mbox_dt_spec tx_channel = TX_CHANNEL_SPEC;
	int ret;

	if (TEST_BIDIRECTIONAL_CHANNELS) {
		ztest_test_skip();
	}

	ret = mbox_register_callback_dt(&tx_channel, dummy_callback, NULL);
	zassert_true(
		(ret == -ENOSYS),
		"mbox_register_callback(remote_channel) shall return -ENOSYS (-88)"
		" got unexpected %d",
		ret
	);
}

/**
 * @brief mbox_register_callback_dt() on incorrect channel shall fail
 *
 * Confirm that mbox_register_callback_dt() returns
 * -EINVAL when user tries to register callback on incorrect mbox channel.
 *
 */
ZTEST(mbox_error_cases, test_03b_mbox_register_callback_on_invalid_channel)
{
	const struct mbox_dt_spec rx_valid = RX_CHANNEL_SPEC;
	const struct mbox_dt_spec rx_channel = incorrect_channel(&rx_valid);
	int ret;

	ret = mbox_register_callback_dt(&rx_channel, dummy_callback, NULL);
	zassert_true(
		(ret == -EINVAL),
		"mbox_register_callback(incorrect_channel) shall return -EINVAL (-22)"
		" got unexpected %d",
		ret
	);
}

/**
 * @brief mbox_register_callback_dt() multiple use on same channel
 *
 * Confirm that mbox_register_callback_dt() returns
 * 0 when user tries to register callback
 * on already configured mbox channel.
 *
 */
ZTEST(mbox_error_cases, test_03c_mbox_register_callback_twice_on_same_channel)
{
	const struct mbox_dt_spec rx_channel = RX_CHANNEL_SPEC;
	int ret;

	ret = mbox_register_callback_dt(&rx_channel, dummy_callback, NULL);
	zassert_true(
		(ret == 0),
		"mbox_register_callback(valid_channel) shall return 0"
		" got unexpected %d",
		ret
	);

	ret = mbox_register_callback_dt(&rx_channel, dummy_callback_2, &dummy_value);
	zassert_true(
		(ret == 0),
		"mbox_register_callback(valid_channel) shall return 0"
		" got unexpected %d",
		ret
	);
}

/**
 * @brief mbox_mtu_get_dt() on RX channel shall fail
 *
 * Confirm that mbox_mtu_get_dt() returns
 * -ENOSYS for RX mbox channel.
 *
 */
ZTEST(mbox_error_cases, test_04a_mbox_mtu_get_on_rx_channel)
{
	const struct mbox_dt_spec rx_channel = RX_CHANNEL_SPEC;
	int ret;

	if (TEST_BIDIRECTIONAL_CHANNELS) {
		ztest_test_skip();
	}

	ret = mbox_mtu_get_dt(&rx_channel);
	zassert_true(
		(ret == -ENOSYS),
		"mbox_mtu_get_dt(rx_channel) shall return -ENOSYS (-88)"
		" got unexpected %d",
		ret
	);
}

/**
 * @brief mbox_mtu_get_dt() on TX channel functional test
 *
 * Confirm that mbox_mtu_get_dt() returns
 * expected value for TX mbox channel.
 * (No matter if channel is valid or incorrect.)
 *
 */
ZTEST(mbox_error_cases, test_04b_mbox_mtu_get_on_tx_channel)
{
	const struct mbox_dt_spec tx_channel = TX_CHANNEL_SPEC;
	const struct mbox_dt_spec tx_channel_incorrect = incorrect_channel(&tx_channel);
	int ret;

	ret = mbox_mtu_get_dt(&tx_channel);
	zassert_true(
		(ret == TEST_EXPECTED_MTU_VALUE),
		"mbox_mtu_get_dt(tx_channel) shall return %d"
		" got unexpected %d",
		TEST_EXPECTED_MTU_VALUE,
		ret
	);

	ret = mbox_mtu_get_dt(&tx_channel_incorrect);
	zassert_true(
		(ret == TEST_EXPECTED_MTU_VALUE),
		"mbox_mtu_get_dt(tx_channel_incorrect) shall return %d"
		" got unexpected %d",
		TEST_EXPECTED_MTU_VALUE,
		ret
	);
}

/**
 * @brief mbox_set_enabled_dt() - Enable TX channel shall fail
 *
 * Confirm that mbox_set_enabled_dt() returns
 * -ENOSYS for TX mbox channel.
 *
 */
ZTEST(mbox_error_cases, test_05a_mbox_set_enabled_on_tx_channel)
{
	const struct mbox_dt_spec tx_channel = TX_CHANNEL_SPEC;
	int ret;

	if (TEST_BIDIRECTIONAL_CHANNELS) {
		ztest_test_skip();
	}

	ret = mbox_set_enabled_dt(&tx_channel, true);
	zassert_true(
		(ret == -ENOSYS),
		"mbox_set_enabled_dt(tx_channel, true) shall return -ENOSYS (-88)"
		" got unexpected %d",
		ret
	);
}

/**
 * @brief mbox_set_enabled_dt() - Enable incorrect channel shall fail
 *
 * Confirm that mbox_set_enabled_dt() returns
 * -EINVAL for incorrect RX mbox channel.
 *
 */
ZTEST(mbox_error_cases, test_05b_mbox_set_enabled_on_incorrect_rx_channel)
{
	const struct mbox_dt_spec rx_valid = RX_CHANNEL_SPEC;
	const struct mbox_dt_spec rx_channel = incorrect_channel(&rx_valid);
	int ret;

	ret = mbox_set_enabled_dt(&rx_channel, true);
	zassert_true(
		(ret == -EINVAL),
		"mbox_set_enabled_dt(incorrect_channel, true) shall return -EINVAL (-22)"
		" got unexpected %d",
		ret
	);
}

/**
 * @brief mbox_set_enabled_dt() - Enable already enabled channel shall fail
 *
 * Confirm that mbox_set_enabled_dt() returns
 * -EALREADY when user tries to enable already enabled RX mbox channel.
 *
 */
ZTEST(mbox_error_cases, test_05c_mbox_set_enabled_on_already_enabled_rx_channel)
{
	const struct mbox_dt_spec rx_channel = RX_CHANNEL_SPEC;
	int ret;

	/* The user must take care of installing a proper callback
	 * on the channel before enabling it.
	 */
	ret = mbox_register_callback_dt(&rx_channel, dummy_callback, NULL);
	zassert_true(
		(ret == 0),
		"mbox_register_callback(tx_channel) shall return 0"
		" got unexpected %d",
		ret
	);

	ret = mbox_set_enabled_dt(&rx_channel, true);
	zassert_true(
		(ret == 0),
		"mbox_set_enabled_dt(tx_channel, true) shall return 0"
		" got unexpected %d",
		ret
	);

	ret = mbox_set_enabled_dt(&rx_channel, true);
	zassert_true(
		(ret == -EALREADY),
		"mbox_set_enabled_dt(enabled_tx_channel, true) shall return -EALREADY (-120)"
		" got unexpected %d",
		ret
	);

	/* Cleanup - disable mbox channel */
	ret = mbox_set_enabled_dt(&rx_channel, false);
	zassert_true(
		(ret == 0),
		"mbox_set_enabled_dt(enabled_tx_channel, false) shall return 0"
		" got unexpected %d",
		ret
	);
}

/**
 * @brief mbox_set_enabled_dt() - Disable already disabled channel shall fail
 *
 * Confirm that mbox_set_enabled_dt() returns
 * -EALREADY when user tries to disable already disabled RX mbox channel.
 *
 */
ZTEST(mbox_error_cases, test_05d_mbox_set_disable_on_already_disabled_rx_channel)
{
	const struct mbox_dt_spec rx_channel = RX_CHANNEL_SPEC;
	int ret;

	/* The user must take care of installing a proper callback
	 * on the channel before enabling it.
	 */
	ret = mbox_register_callback_dt(&rx_channel, dummy_callback, NULL);
	zassert_true(
		(ret == 0),
		"mbox_register_callback(tx_channel) shall return 0"
		" got unexpected %d",
		ret
	);

	ret = mbox_set_enabled_dt(&rx_channel, true);
	zassert_true(
		(ret == 0),
		"mbox_set_enabled_dt(tx_channel, true) shall return 0"
		" got unexpected %d",
		ret
	);

	ret = mbox_set_enabled_dt(&rx_channel, false);
	zassert_true(
		(ret == 0),
		"mbox_set_enabled_dt(enabled_tx_channel, false) shall return 0"
		" got unexpected %d",
		ret
	);

	ret = mbox_set_enabled_dt(&rx_channel, false);
	zassert_true(
		(ret == -EALREADY),
		"mbox_set_enabled_dt(disabled_tx_channel, false) shall return -EALREADY (-120)"
		" got unexpected %d",
		ret
	);
}

/**
 * @brief mbox_max_channels_get_dt() functional test
 *
 * Confirm that mbox_max_channels_get_dt() returns
 * >0 Maximum possible number of supported channels on success
 * (No matter if channel is valid or incorrect.)
 *
 */
ZTEST(mbox_error_cases, test_06_mbox_max_channels_get_functional)
{
	const struct mbox_dt_spec tx_channel = TX_CHANNEL_SPEC;
	const struct mbox_dt_spec tx_channel_incorrect = incorrect_channel(&tx_channel);
	const struct mbox_dt_spec rx_channel = RX_CHANNEL_SPEC;
	const struct mbox_dt_spec rx_channel_incorrect = incorrect_channel(&rx_channel);
	int ret1, ret2;

	ret1 = mbox_max_channels_get_dt(&tx_channel);
	TC_PRINT("mbox_max_channels_get_dt(tx_channel): %d\n", ret1);
	zassert_true(
		(ret1 > 0),
		"mbox_max_channels_get_dt(tx_channel) shall return value greater than 0"
		" got unexpected %d",
		ret1
	);

	ret2 = mbox_max_channels_get_dt(&tx_channel_incorrect);
	TC_PRINT("mbox_max_channels_get_dt(tx_channel_incorrect): %d\n", ret2);
	zassert_true(
		(ret2 > 0),
		"mbox_max_channels_get_dt(tx_channel_incorrect) shall return value greater than 0"
		" got unexpected %d",
		ret2
	);

	zassert_true(
		(ret1 == ret2),
		"mbox_max_channels_get_dt() shall return same value disregarding channel No."
		" got unexpected %d and %d",
		ret1,
		ret2
	);

	ret1 = mbox_max_channels_get_dt(&rx_channel);
	TC_PRINT("mbox_max_channels_get_dt(rx_channel): %d\n", ret1);
	zassert_true(
		(ret1 > 0),
		"mbox_max_channels_get_dt(rx_channel) shall return value greater than 0"
		" got unexpected %d",
		ret1
	);

	ret2 = mbox_max_channels_get_dt(&rx_channel_incorrect);
	TC_PRINT("mbox_max_channels_get_dt(rx_channel_incorrect): %d\n", ret2);
	zassert_true(
		(ret2 > 0),
		"mbox_max_channels_get_dt(rx_channel_incorrect) shall return value greater than 0"
		" got unexpected %d",
		ret2
	);

	zassert_true(
		(ret1 == ret2),
		"mbox_max_channels_get_dt() shall return same value disregarding channel No."
		" got unexpected %d and %d",
		ret1,
		ret2
	);
}

static void *suite_setup(void)
{
	TC_PRINT("Test executed on %s\n", CONFIG_BOARD_TARGET);
	TC_PRINT("===================================================================\n");

	return NULL;
}

ZTEST_SUITE(mbox_error_cases, NULL, suite_setup, NULL, NULL, NULL);
```
