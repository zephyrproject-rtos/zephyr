/*
 * Copyright 2024 Nordic Semiconductor ASA
 * SPDX-License-Identifier: Apache-2.0
 */

/ {
	mbox-consumer {
		compatible = "zephyr,mbox-consumer";
		mboxes = <&cpuapp_bellboard 18>, <&cpuppr_vevif 15>;
		mbox-names = "tx0", "rx0";
	};
};

&cpuapp_bellboard {
	status = "okay";
};

&cpuppr_vevif {
	status = "okay";
};
