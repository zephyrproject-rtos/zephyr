/*
 * Copyright 2025 Nordic Semiconductor ASA
 * SPDX-License-Identifier: Apache-2.0
 */

/ {
	mbox-consumer {
		compatible = "zephyr,mbox-consumer";
		mboxes = <&cpuapp_vevif_tx 21>, <&cpuapp_vevif_rx 20>;
		mbox-names = "tx0", "rx0";
	};
};

&cpuapp_vevif_rx {
	status = "okay";
};

&cpuapp_vevif_tx {
	status = "okay";
};
