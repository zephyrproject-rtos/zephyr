/*
 * Copyright 2026 BayLibre, SAS
 *
 * SPDX-License-Identifier: Apache-2.0
 */

/ {
	mbox-consumer {
		compatible = "vnd,mbox-consumer";
		mboxes = <&mfis 0>, <&mfis 0>,
			 <&mfis 1>, <&mfis 1>,
			 <&mfis 2>, <&mfis 2>,
			 <&mfis 3>, <&mfis 3>;
		mbox-names = "tx0", "rx0",
			     "tx1", "rx1",
			     "tx2", "rx2",
			     "tx3", "rx3";
	};
};
