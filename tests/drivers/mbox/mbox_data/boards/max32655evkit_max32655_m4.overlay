/*
 * Copyright 2025 Analog Devices, Inc
 *
 * SPDX-License-Identifier: Apache-2.0
 */

&mbox {
	status = "okay";
	msg-payloads;
};

/ {
	mbox-consumer {
		compatible = "vnd,mbox-consumer";
		mboxes = <&mbox 0>, <&mbox 0>;
		mbox-names = "rx0", "tx0";
	};
};
