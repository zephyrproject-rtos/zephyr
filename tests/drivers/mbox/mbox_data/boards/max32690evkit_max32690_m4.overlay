/*
 * Copyright 2025 Analog Devices, Inc
 *
 * SPDX-License-Identifier: Apache-2.0
 */

&mbox {
	msg-payloads;
	status = "okay";
};

/ {
	mbox-consumer {
		compatible = "vnd,mbox-consumer";
		mboxes = <&mbox 0>, <&mbox 0>;
		mbox-names = "rx0", "tx0";
	};
};
