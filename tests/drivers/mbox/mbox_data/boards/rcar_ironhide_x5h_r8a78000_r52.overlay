/*
 * Copyright 2026 BayLibre, SAS
 *
 * SPDX-License-Identifier: Apache-2.0
 */

/ {
	mbox-consumer {
		compatible = "vnd,mbox-consumer";
		mboxes = <&mfis 64>, <&mfis 64>,
			 <&mfis 65>, <&mfis 65>,
			 <&mfis 66>, <&mfis 66>,
			 <&mfis 67>, <&mfis 67>;
		mbox-names = "tx0", "rx0",
			     "tx1", "rx1",
			     "tx2", "rx2",
			     "tx3", "rx3";
	};
};
