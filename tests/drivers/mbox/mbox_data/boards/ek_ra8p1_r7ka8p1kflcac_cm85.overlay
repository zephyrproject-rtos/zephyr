/*
 * Copyright (c) 2025 Renesas Electronics Corporation
 * SPDX-License-Identifier: Apache-2.0
 */

/ {
	mbox-consumer {
		compatible = "vnd,mbox-consumer";
		mboxes = <&mbox0 0>, <&mbox0 0>, <&mbox1 0>, <&mbox1 0>,
			<&mbox1 0>, <&mbox1 0>, <&mbox0 0>, <&mbox0 0>;
		mbox-names = "tx0", "rx0", "tx1", "rx1", "tx2", "rx2", "tx3",
			"rx3";
	};
};

&mbox0 {
	interrupts = <94 1>;
	status = "okay";
};

&mbox1 {
	interrupts = <95 1>;
	status = "okay";
};
