## CMakeLists.txt
```
# SPDX-License-Identifier: Apache-2.0

cmake_minimum_required(VERSION 3.28.0)
find_package(Zephyr REQUIRED HINTS $ENV{ZEPHYR_BASE})
project(entropy_api)

FILE(GLOB app_sources src/*.c)
target_sources(app PRIVATE ${app_sources})
```

## Kconfig
```
# Copyright NXP 2022
# SPDX-License-Identifier: Apache-2.0

mainmenu "Entropy API Test"

source "Kconfig.zephyr"
source "tests/drivers/entropy/api/Kconfig.mcux"

config RANDOM_BUFFER_NOCACHED
	bool "Put the buffer of randomly generated numbers in nocache region."
```

## Kconfig.mcux
```
# Copyright NXP 2022
# SPDX-License-Identifier: Apache-2.0

if ENTROPY_MCUX_CAAM

config RANDOM_BUFFER_NOCACHED
	default y if NOCACHE_MEMORY

endif
```

## prj.conf
```kconfig
CONFIG_ENTROPY_GENERATOR=y
CONFIG_ZTEST=y
```

## entropy_psa_crypto.conf
```kconfig
CONFIG_PSA_CRYPTO=y
CONFIG_TFM_CRYPTO_RNG_MODULE_ENABLED=y
CONFIG_HARDWARE_DEVICE_CS_GENERATOR=y
# Enable ISR test with a pool smaller (5 bytes) than the test buffer size
# (9 bytes) to check it's refilled.
CONFIG_ENTROPY_PSA_CRYPTO_RNG_ISR=y
CONFIG_ENTROPY_PSA_CRYPTO_RNG_ISR_BUFFER_SIZE=5
# Refilling entropy_psa_crypto ISR random sample pool with TF-M requires
# the driver ISR refill thread to preempt the Ztest thread.
# Use equal preemptive thread priorities to achieve that.
CONFIG_ENTROPY_PSA_CRYPTO_RNG_ISR_WQ_PRIO=1
CONFIG_ZTEST_THREAD_PRIORITY=1
```

## virtio.conf
```kconfig
# Copyright (c) 2025 TOKITA Hiroshi
# SPDX-License-Identifier: Apache-2.0

CONFIG_VIRTIO=y
```

## boards/gd32f450i_eval.conf
```kconfig
CONFIG_ENTROPY_GD32_TRNG=y
```

## boards/kit_pse84_eval_pse846gps2dbzc4a_m55.conf
```kconfig
# SPDX-FileCopyrightText: Copyright (c) 2026 Infineon Technologies AG,
# SPDX-FileCopyrightText: or an affiliate of Infineon Technologies AG. All rights reserved.
#
# SPDX-License-Identifier: Apache-2.0

# Enable MXCRYPTO TRNG entropy driver
CONFIG_ENTROPY_GENERATOR=y
CONFIG_ENTROPY_INFINEON_MXCRYPTO_TRNG=y

# Enable MXCRYPTO hardware crypto driver
CONFIG_CRYPTO=y
CONFIG_CRYPTO_INFINEON_MXCRYPTO=y
```

## boards/qemu_x86_64.conf
```kconfig
# Copyright (c) 2025 TOKITA Hiroshi
# SPDX-License-Identifier: Apache-2.0

CONFIG_PCIE=y
CONFIG_HEAP_MEM_POOL_SIZE=1024
```

## boards/qnxhv_vm.conf
```kconfig
# Copyright (c) 2026 TOKITA Hiroshi
# SPDX-License-Identifier: Apache-2.0

CONFIG_HEAP_MEM_POOL_SIZE=1024
```

## entropy_bt_hci.overlay
```dts
/*
 * Copyright (c) 2021, Commonwealth Scientific and Industrial Research
 * Organisation (CSIRO) ABN 41 687 119 230.
 *
 * SPDX-License-Identifier: Apache-2.0
 */

/ {
	chosen {
		zephyr,entropy = &rng_hci;
	};

	rng_hci: entropy_bt_hci {
		compatible = "zephyr,bt-hci-entropy";
		status = "okay";
	};
};
```

## stm32_rng.overlay
```dts
/*
 * Copyright (c) 2025 STMicroelectronics
 *
 * SPDX-License-Identifier: Apache-2.0
 */

/ {
	chosen {
		zephyr,entropy = &rng;
	};
};

&rng {
	status = "okay";
};
```

## boards/gd32f450i_eval.overlay
```dts
/*
 * Copyright (c) 2025 Aleksandr Senin <al@meshium.net>
 *
 * SPDX-License-Identifier: Apache-2.0
 */

/ {
	chosen {
		zephyr,entropy = &trng0;
	};
};

&rcu {
	gd,ck48m-source = "irc48m";
};

&trng0 {
	status = "okay";
};
```

## boards/kit_pse84_eval_pse846gps2dbzc4a_m55.overlay
```dts
/*
 * SPDX-FileCopyrightText: Copyright (c) 2026 Infineon Technologies AG,
 * SPDX-FileCopyrightText: or an affiliate of Infineon Technologies AG. All rights reserved.
 *
 * SPDX-License-Identifier: Apache-2.0
 */

/ {
    chosen {
        zephyr,entropy = &mxcrypto_trng;
        zephyr,crypto = &mxcrypto_crypto;
    };
};

&mxcrypto_trng {
	status = "okay";
};

&mxcrypto_crypto {
	status = "okay";
};
```

## boards/neorv32.overlay
```dts
/*
 * Copyright (c) 2021 Henrik Brix Andersen <henrik@brixandersen.dk>
 *
 * SPDX-License-Identifier: Apache-2.0
 */

&trng {
	status = "okay";
};
```

## boards/nucleo_wb05kz.overlay
```dts
/*
 * Copyright (c) 2024 STMicroelectronics
 *
 * SPDX-License-Identifier: Apache-2.0
 */

/ {
	chosen {
		zephyr,entropy = &rng;
	};
};

&rng {
	status = "okay";
};
```

## src/main.c
```c
/*
 * Copyright (c) 2017 Intel Corporation.
 *
 * SPDX-License-Identifier: Apache-2.0
 */
#include <inttypes.h>
#include <zephyr/bluetooth/bluetooth.h>
#include <zephyr/drivers/entropy.h>
#include <zephyr/ztest.h>

/*
 * @addtogroup t_entropy_api
 * @{
 * @defgroup t_entropy_get_entropy test_entropy_get_entropy
 * @brief TestPurpose: verify Get entropy works
 * @details
 * - Test Steps
 *   -# Read random numbers from Entropy driver.
 *   -# Verify whether buffer overflow occurred or not.
 *   -# Verify whether buffer completely filled or not.
 * - Expected Results
 *   -# Random number should be generated.
 * @}
 */

#define BUFFER_LENGTH           10
#define RECHECK_RANDOM_ENTROPY  0x10

#ifdef CONFIG_RANDOM_BUFFER_NOCACHED
__attribute__((__section__(".nocache")))
static uint8_t entropy_buffer[BUFFER_LENGTH] = {0};
#else
static uint8_t entropy_buffer[BUFFER_LENGTH] = {0};
#endif

static int random_entropy(const struct device *dev, uint8_t *buffer, char num, bool test_isr)
{
	int ret, i;
	int count = 0;

	(void)memset(buffer, num, BUFFER_LENGTH);

	/* The BUFFER_LENGTH-1 is used so the driver will not
	 * write the last byte of the buffer. If that last
	 * byte is not 0 on return it means the driver wrote
	 * outside the passed buffer, and that should never
	 * happen.
	 */
	if (test_isr) {
		/* 1 sec should be enough to get the samples */
		k_timepoint_t tp = sys_timepoint_calc(Z_TIMEOUT_MS(1000));
		int remaining = BUFFER_LENGTH - 1;

		/* Get the random bytes possibly in several calls */
		do {
			uint32_t offset = BUFFER_LENGTH - 1 - remaining;

			ret = entropy_get_entropy_isr(dev, buffer + offset, remaining, 0);
			if (ret < 0) {
				if (ret ==  -ENOSYS) {
					TC_PRINT("Skip ISR test: .get_entropy_isr not supported\n");
					return TC_PASS;
				}

				TC_PRINT("Error: entropy_get_entropy_isr failed: %d\n", ret);
				return TC_FAIL;
			}
			remaining -= ret;

			if (ret == 0 && sys_timepoint_expired(tp)) {
				TC_PRINT("Error: Timeout on entropy_get_entropy_isr\n");
				return TC_FAIL;
			}
		} while (remaining > 0);
	} else {
		ret = entropy_get_entropy(dev, buffer, BUFFER_LENGTH - 1);
		if (ret) {
			TC_PRINT("Error: entropy_get_entropy failed: %d\n", ret);
			return TC_FAIL;
		}
	}

	if (buffer[BUFFER_LENGTH - 1] != num) {
		TC_PRINT("Error: buffer overflow\n");
		return TC_FAIL;
	}

	for (i = 0; i < BUFFER_LENGTH - 1; i++) {
		TC_PRINT("  0x%02" PRIx8 "\n", buffer[i]);
		if (buffer[i] == num) {
			count++;
		}
	}

	if (count >= 2) {
		return RECHECK_RANDOM_ENTROPY;
	} else {
		return TC_PASS;
	}
}

/*
 * Function invokes the get_entropy callback in driver
 * to get the random data and fill to passed buffer
 */
static int get_entropy(bool test_isr)
{
	const struct device *const dev = entropy_get_default_device();
	int ret;

	if (!device_is_ready(dev)) {
		TC_PRINT("error: random device not ready\n");
		return TC_FAIL;
	}

	TC_PRINT("random device is %p, name is %s\n",
		 dev, dev->name);

	ret = random_entropy(dev, entropy_buffer, 0, test_isr);

	/* Check whether 20% or more of buffer still filled with default
	 * value(0), if yes then recheck again by filling nonzero value(0xa5)
	 * to buffer. Recheck random_entropy and verify whether 20% or more
	 * of buffer filled with value(0xa5) or not.
	 */
	if (ret == RECHECK_RANDOM_ENTROPY) {
		ret = random_entropy(dev, entropy_buffer, 0xa5, test_isr);
		if (ret == RECHECK_RANDOM_ENTROPY) {
			return TC_FAIL;
		} else {
			return ret;
		}
	}

	return ret;
}

ZTEST(entropy_api, test_entropy_get_entropy)
{
	zassert_true(get_entropy(false) == TC_PASS);
}

ZTEST(entropy_api, test_entropy_get_entropy_isr)
{
	zassert_true(get_entropy(true) == TC_PASS);
}

void *entropy_api_setup(void)
{
#ifdef CONFIG_BT
	bt_enable(NULL);
#endif /* CONFIG_BT */

	return NULL;
}

ZTEST_SUITE(entropy_api, NULL, entropy_api_setup, NULL, NULL, NULL);
```
