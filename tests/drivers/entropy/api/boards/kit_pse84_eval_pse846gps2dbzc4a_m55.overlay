/*
 * SPDX-FileCopyrightText: Copyright (c) 2026 Infineon Technologies AG,
 * SPDX-FileCopyrightText: or an affiliate of Infineon Technologies AG. All rights reserved.
 *
 * SPDX-License-Identifier: Apache-2.0
 */

/ {
    chosen {
        zephyr,entropy = &mxcrypto_trng;
        zephyr,crypto = &mxcrypto_crypto;
    };
};

&mxcrypto_trng {
	status = "okay";
};

&mxcrypto_crypto {
	status = "okay";
};