/*
 * Copyright (c) 2021, Commonwealth Scientific and Industrial Research
 * Organisation (CSIRO) ABN 41 687 119 230.
 *
 * SPDX-License-Identifier: Apache-2.0
 */

/ {
	chosen {
		zephyr,entropy = &rng_hci;
	};

	rng_hci: entropy_bt_hci {
		compatible = "zephyr,bt-hci-entropy";
		label = "bt_hci_entropy";
		status = "okay";
	};
};
