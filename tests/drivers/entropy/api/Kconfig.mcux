## tests/drivers/entropy/api/Kconfig.mcux
```kconfig
# Copyright NXP 2022
# SPDX-License-Identifier: Apache-2.0

if ENTROPY_MCUX_CAAM

config RANDOM_BUFFER_NOCACHED
	default y if NOCACHE_MEMORY

endif
```

## tests/drivers/entropy/api/boards/qemu_x86_64.conf
```kconfig
# Copyright (c) 2025 TOKITA Hiroshi
# SPDX-License-Identifier: Apache-2.0

CONFIG_PCIE=y
CONFIG_HEAP_MEM_POOL_SIZE=1024
```

## tests/drivers/entropy/api/boards/qnxhv_vm.conf
```kconfig
# Copyright (c) 2026 TOKITA Hiroshi
# SPDX-License-Identifier: Apache-2.0

CONFIG_HEAP_MEM_POOL_SIZE=1024
```

## tests/drivers/entropy/api/testcase.yaml
```yaml
tests:
  drivers.entropy:
    filter: CONFIG_ENTROPY_HAS_DRIVER
    tags:
      - drivers
      - entropy
  drivers.entropy.bt_hci:
    platform_allow:
      - nrf52_bsim
      - nrf5340bsim/nrf5340/cpunet
    extra_args:
      - DTC_OVERLAY_FILE=./entropy_bt_hci.overlay
      - EXTRA_CONF_FILE=./entropy_bt_hci.conf
    tags:
      - driver
      - entropy
      - bluetooth
  drivers.entropy.psa_crypto:
    filter: CONFIG_BUILD_WITH_TFM
    extra_args:
      - DTC_OVERLAY_FILE=./entropy_psa_crypto.overlay
      - EXTRA_CONF_FILE=./entropy_psa_crypto.conf
    tags:
      - driver
      - entropy
      - psa-crypto
  drivers.entropy.stm32:
    filter: CONFIG_SOC_FAMILY_STM32 and
            (dt_compat_enabled("st,stm32-rng") or dt_compat_enabled("st,stm32-rng-noirq"))
    extra_args: "DTC_OVERLAY_FILE=./stm32_rng.overlay"
    tags:
      - driver
      - entropy
```

## tests/drivers/espi/testcase.yaml
```yaml
# Copyright 2021 Google LLC
# SPDX-License-Identifier: Apache-2.0

tests:
  drivers.espi.acpi:
    tags:
      - drivers
      - espi
    filter: dt_compat_enabled("zephyr,espi-emul-controller")
    harness: ztest
    platform_allow:
      - native_sim
    integration_platforms:
      - native_sim
```

## tests/drivers/ethernet/eth_mac_config/testcase.yaml
```yaml
common:
  tags:
    - drivers
    - ethernet
  depends_on:
    - eth
tests:
  net.ethernet.mac_config:
    platform_allow:
      - native_sim
      - native_sim/native/64
    integration_platforms:
      - native_sim
```

## tests/drivers/ethernet/lan78xx/testcase.yaml
```yaml
common:
  build_only: true
  tags:
    - drivers
    - ethernet
    - usb

tests:
  drivers.ethernet.lan78xx.build:
    platform_allow:
      - nucleo_u5a5zj_q
    integration_platforms:
      - nucleo_u5a5zj_q
```

## tests/drivers/firmware/scmi/cpu_freq/basic/testcase.yaml
```yaml
common:
  tags:
    - drivers
    - firmware
    - scmi
    - cpu_freq

tests:
  # Static SCMI cpu_freq tests — timer disabled (interval=1000000 ms).
  # The test thread has exclusive control over frequency transitions.
  drivers.firmware.scmi.cpu_freq.basic:
    harness: ztest
    timeout: 60
    platform_allow:
      - imx95_evk/mimx9596/m7
      - imx943_evk/mimx94398/m33
      - imx943_evk/mimx94398/m7_0
      - imx943_evk/mimx94398/m7_1
    integration_platforms:
      - imx95_evk/mimx9596/m7
      - imx943_evk/mimx94398/m33
      - imx943_evk/mimx94398/m7_0
      - imx943_evk/mimx94398/m7_1
```

## tests/drivers/firmware/scmi/cpu_freq/dynamic/testcase.yaml
```yaml
common:
  tags:
    - drivers
    - firmware
    - scmi
    - cpu_freq

tests:
  # Dynamic (timer-driven) SCMI cpu_freq test.
  # Runs with CONFIG_CPU_FREQ_INTERVAL_MS=50 so the on_demand policy
  # fires ~20 times per second and reacts to load changes.
  drivers.firmware.scmi.cpu_freq.dynamic:
    harness: ztest
    timeout: 120
    platform_allow:
      - imx95_evk/mimx9596/m7
      - imx943_evk/mimx94398/m33
      - imx943_evk/mimx94398/m7_0
      - imx943_evk/mimx94398/m7_1
    integration_platforms:
      - imx95_evk/mimx9596/m7
      - imx943_evk/mimx94398/m33
      - imx943_evk/mimx94398/m7_0
      - imx943_evk/mimx94398/m7_1
```

## tests/drivers/fixed_partition/testcase.yaml
```yaml
tests:
  drivers.flash.fixed_partition:
    platform_allow: native_posix nrf52840dk_nrf52840
    tags: fixed_partition
```

## tests/drivers/fixed_partitions/testcase.yaml
```yaml
common:
  integration_platforms:
    - nrf52840dk_nrf52840

tests:
  drivers.flash.fixed_partitions:
    platform_allow: nrf52840dk_nrf52840
    tags: nrf52 soc_flash_nrf
    extra_args: OVERLAY_CONFIG=boards/nrf52840_flash_soc.conf
```

## tests/drivers/flash/api/page_layout/testcase.yaml
```yaml
common:
  tags:
    - drivers
    - flash
    - flash page layout
tests:
  drivers.flash.api.page_layout.flash_sim0:
    platform_allow:
      - qemu_x86
    integration_platforms:
      - qemu_x86
    extra_args:
      - DTC_OVERLAY_FILE=flash_sim0.overlay
  drivers.flash.api.page_layout.flash_sim0.userspace:
    platform_allow:
      - qemu_x86
    integration_platforms:
      - qemu_x86
    extra_configs:
      - CONFIG_USERSPACE=y
    extra_args:
      - DTC_OVERLAY_FILE=flash_sim0.overlay
  drivers.flash.api.page_layout.flash0:
    platform_allow:
      - native_sim
      - native_posix
      - nrf52dk_nrf52832
      - nucleo_f411re
    integration_platforms:
      - native_sim
    extra_args:
      - DTC_OVERLAY_FILE=flash0.overlay
  drivers.flash.api.page_layout.flash0.userspace:
    platform_allow:
      - native_sim
      - native_posix
      - nrf52dk_nrf52832
      - nucleo_f411re
    integration_platforms:
      - native_sim
    extra_configs:
      - CONFIG_USERSPACE=y
    extra_args:
      - DTC_OVERLAY_FILE=flash0.overlay
```

## tests/drivers/flash/boards/mr_canhubk3_s32k344.conf
```kconfig
# Copyright 2023 NXP
# SPDX-License-Identifier: Apache-2.0

CONFIG_MAIN_STACK_SIZE=1100
```

## tests/drivers/flash/boards/nrf52840_flash_soc.conf
```kconfig
# Minimal configuration for testing flash driver
# on nrf52840dk_nrf52840 board

CONFIG_MPU_ALLOW_FLASH_WRITE=y
```

## tests/drivers/flash/boards/nrf5340_flash_soc.conf
```kconfig
# Minimal configuration for testing flash driver
# on nrf5340dk_nrf5340 board

CONFIG_MPU_ALLOW_FLASH_WRITE=y
```

## tests/drivers/flash/common/Kconfig
```kconfig
# Copyright (c) 2024, Nordic Semiconductor ASA
# SPDX-License-Identifier: Apache-2.0

# Device/scenario dependent information that is not available in
# other ways.

DT_CHOSEN_Z_FLASH := zephyr,flash

config TEST_DRIVER_FLASH_SIZE
	int "Size of flash device under test"
	default $(dt_chosen_reg_size_int,$(DT_CHOSEN_Z_FLASH),0) \
		if (SOC_FAMILY_STM32 && !SOC_SERIES_STM32N6X)
	default -1
	help
	  Expected flash device size the test will validate against. If the flash driver does not
	  support the get_size() API, leave this set as -1 to skip the test.
	  For the STM32 devices, the flash size is directly given by the soc DTSI.

config TEST_FORCE_STORAGE_PARTITION
	bool "Force testing the storage partition area"
	default n
	help
	  This test prioritizes testing spi nor flash over
	  the storage area by default. Set this config to priorize
	  testing the storage partition instead.

source "Kconfig.zephyr"
```

## tests/drivers/flash/common/boards/apard32690_max32690_m4_spixf_nor_sfdp_runtime.conf
```kconfig
# Copyright (c) 2025 Analog Devices, Inc
# SPDX-License-Identifier: Apache-2.0

CONFIG_FLASH_ADI_MAX32_SPIXF_SFDP_RUNTIME=y
```
