/*
 * Copyright (c) 2023 Carl Zeiss Meditec AG
 * SPDX-License-Identifier: Apache-2.0
 */

/****************************************
 *  PLEASE KEEP ALPHABETICALLY SORTED   *
 **************************************
 */

adi_tmc2209: adi-tmc2209 {
	compatible = "adi,tmc2209";
	micro-step-res = <1>;
	m0-gpios = <&test_gpio 0 0>;
	m1-gpios = <&test_gpio 0 0>;
	en-gpios = <&test_gpio 0 0>;
	dual-edge-step;
	status = "okay";
};

allegro_a4979: allegro-a4979 {
	compatible = "allegro,a4979";
	micro-step-res = <1>;
	reset-gpios = <&test_gpio 0 0>;
	en-gpios = <&test_gpio 0 0>;
	m0-gpios = <&test_gpio 0 0>;
	m1-gpios = <&test_gpio 0 0>;
	status = "okay";
};

ti_drv84xx: ti-drv84xx {
	compatible = "ti,drv84xx";
	sleep-gpios = <&test_gpio 0 0>;
	en-gpios = <&test_gpio 0 0>;
	m0-gpios = <&test_gpio 0 0>;
	m1-gpios = <&test_gpio 0 0>;
	status = "okay";
};
