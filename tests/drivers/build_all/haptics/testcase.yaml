## tests/drivers/build_all/haptics/testcase.yaml
```yaml
# Copyright (c) 2024 Cirrus Logic, Inc.
# SPDX-License-Identifier: Apache-2.0

tests:
  drivers.haptics.build:
    tags:
      - drivers
      - haptics
    harness: build
    platform_allow:
      - native_sim
```

## tests/drivers/build_all/i2c/testcase.yaml
```yaml
common:
  build_only: true
  tags:
    - drivers
    - i2c
tests:
  drivers.i2c.build:
    # will cover drivers without in-tree boards
    platform_allow: qemu_cortex_m3
    extra_args: "CONFIG_I2C=y"
  drivers.i2c.build.bus_recovery:
    platform_allow: nucleo_f411re
    extra_args: "CONFIG_I2C=y CONFIG_I2C_BUS_RECOVERY=y"
```

## tests/drivers/build_all/i3c/boards/nucleo_c5a3zg.conf
```kconfig
# SPDX-FileCopyrightText: Copyright (c) 2026 STMicroelectronics
# SPDX-License-Identifier: Apache-2.0

# Disable Test userspace to prevent compilation error
CONFIG_TEST_USERSPACE=n
```

## tests/drivers/build_all/i3c/boards/nucleo_u385rg_q.conf
```kconfig
# SPDX-FileCopyrightText: Copyright The Zephyr Project Contributors
# SPDX-License-Identifier: Apache-2.0

# Disable Test userspace to prevent compilation error
CONFIG_TEST_USERSPACE=n
```

## tests/drivers/build_all/i3c/testcase.yaml
```yaml
common:
  build_only: true
  tags:
    - drivers
    - i3c
tests:
  drivers.i3c.build.dual_role:
    # will cover drivers without in-tree boards
    platform_allow: qemu_cortex_m3
    tags: i3c_cdns i3c_dw
    extra_args: "CONFIG_I3C_DUAL_ROLE=y CONFIG_I3C_RTIO=y"
  drivers.i3c.build.controller_role_only:
    # will cover drivers without in-tree boards
    platform_allow: qemu_cortex_m3
    tags: i3c_cdns i3c_dw
    extra_args: "CONFIG_I3C_CONTROLLER_ROLE_ONLY=y CONFIG_I3C_RTIO=y"
  drivers.i3c.build.target_role_only:
    # will cover drivers without in-tree boards
    platform_allow: qemu_cortex_m3
    tags: i3c_cdns i3c_dw
    extra_args: "CONFIG_I3C_TARGET_ROLE_ONLY=y"
```

## tests/drivers/build_all/ieee802154/testcase.yaml
```yaml
common:
  tags:
    - drivers
    - ieee802154
  build_only: true
tests:
  drivers.ieee802154.build.external:
    platform_allow:
      - native_posix/native
      - native_sim/native
  drivers.ieee802154.build.cc13xx_cc26xx:
    platform_allow: cc1352r_sensortag/cc1352r
  drivers.ieee802154.build.kw41z:
    platform_allow: frdm_kw41z/mkw41z4
  drivers.ieee802154.build.mcr20a:
    platform_allow: usb_kw24d512/mkw24d5
  drivers.ieee802154.build.nrf5:
    platform_allow: nrf52840dk/nrf52840
  drivers.ieee802154.build.telink_b91:
    platform_allow: tlsr9518adk80d/tlsr9518
  drivers.ieee802154.build.upipe:
    platform_allow: qemu_x86/atom
```

## tests/drivers/build_all/input/testcase.yaml
```yaml
common:
  tags:
    - drivers
    - input
  build_only: true
tests:
  drivers.input.default:
    platform_allow:
      - native_sim

  # Touchscreen drivers, non-default option
  drivers.input.touchscreen_interrupt:
    platform_allow:
      - native_sim
    extra_configs:
      - CONFIG_INPUT_CST816S_INTERRUPT=n
      - CONFIG_INPUT_FT5336_INTERRUPT=y
      - CONFIG_INPUT_GT911_INTERRUPT=y
      - CONFIG_INPUT_TMA525B_INTERRUPT=y

  drivers.input.kbd_16_bit:
    platform_allow:
      - native_sim
    extra_configs:
      - CONFIG_INPUT_KBD_MATRIX_16_BIT_ROW=y

  drivers.input.analog_axis:
    platform_allow:
      - native_sim
    extra_configs:
      - CONFIG_ADC=y
      - CONFIG_SETTINGS=y

  drivers.input.adc_keys:
    platform_allow:
      - native_sim
    extra_configs:
      - CONFIG_ADC=y

  drivers.input.bflb_irx:
    platform_allow:
      - ai_m62_12f_kit
      - ai_wb2_12f_kit
```

## tests/drivers/build_all/interrupt_controller/common/boards/imx8mp_evk_mimx8ml8_adsp.conf
```kconfig
# Copyright (c) 2024 Meta
# SPDX-License-Identifier: Apache-2.0

# Made-up config to build intc_nxp_irqsteer.c, refer to:
# https://github.com/zephyrproject-rtos/zephyr/pull/62776#issuecomment-1727846332

CONFIG_MULTI_LEVEL_INTERRUPTS=y
CONFIG_2ND_LEVEL_INTERRUPTS=y
CONFIG_2ND_LVL_ISR_TBL_OFFSET=32
CONFIG_MAX_IRQ_PER_AGGREGATOR=64
CONFIG_NUM_2ND_LEVEL_AGGREGATORS=3
CONFIG_2ND_LVL_INTR_00_OFFSET=19
CONFIG_2ND_LVL_INTR_01_OFFSET=20
CONFIG_2ND_LVL_INTR_02_OFFSET=21
```

## tests/drivers/build_all/interrupt_controller/intc_plic/Kconfig
```kconfig
# Copyright (c) 2023 Meta
# SPDX-License-Identifier: Apache-2.0

config NUM_IRQS
	int ""

source "Kconfig"
```

## tests/drivers/build_all/interrupt_controller/intc_plic/testcase.yaml
```yaml
common:
  build_only: true
  filter: CONFIG_PLIC
  platform_allow:
    - qemu_riscv32
    - qemu_riscv32/qemu_virt_riscv32/smp
    - qemu_riscv64
    - qemu_riscv64/qemu_virt_riscv64/smp
  integration_platforms:
    - qemu_riscv32
    - qemu_riscv64
  tags:
    - drivers
    - interrupt
    - plic
tests:
  drivers.interrupt_controller.intc_plic.build: {}
  drivers.interrupt_controller.intc_plic.plic_shell.build:
    tags:
      - shell
    extra_configs:
      - CONFIG_SHELL=y
      - CONFIG_PLIC_SHELL=y
  drivers.interrupt_controller.intc_plic.multi_instance.build:
    extra_args:
      DTC_OVERLAY_FILE="./app.multi_instance.overlay"
    extra_configs:
      - CONFIG_NUM_IRQS=116
      - CONFIG_MAX_IRQ_PER_AGGREGATOR=52
      - CONFIG_MULTI_LEVEL_INTERRUPTS=y
      - CONFIG_DYNAMIC_INTERRUPTS=y
      - CONFIG_NUM_2ND_LEVEL_AGGREGATORS=2
      - CONFIG_2ND_LVL_INTR_01_OFFSET=8
      - CONFIG_UART_INTERRUPT_DRIVEN=y
  drivers.interrupt_controller.intc_plic.irq_affinity.build:
    filter: CONFIG_SMP
    tags:
      - smp
    extra_configs:
      - CONFIG_MP_MAX_NUM_CPUS=4
      - CONFIG_PLIC_IRQ_AFFINITY=y
      - CONFIG_PLIC_IRQ_AFFINITY_MASK=0xf
```

## tests/drivers/build_all/interrupt_controller/testcase.yaml
```yaml
common:
  build_only: true
  tags:
    - drivers
    - interrupt
tests:
  drivers.interrupt_controller.intc_plic.build:
    platform_allow:
      - qemu_riscv32
      - qemu_riscv64
    tags: plic
  drivers.interrupt_controller.intc_plic.edge.build:
    platform_allow:
      - qemu_riscv32
      - qemu_riscv64
    extra_args:
      DTC_OVERLAY_FILE="./boards/qemu_riscv32_trig.overlay;./boards/qemu_riscv64_trig.overlay"
    extra_configs:
      - CONFIG_PLIC_SUPPORTS_EDGE_IRQ=y
    tags: plic
```

## tests/drivers/build_all/led/testcase.yaml
```yaml
tests:
  drivers.led.build:
    build_only: true
    min_ram: 32
    tags:
      - drivers
      - led
    integration_platforms:
      - native_sim
    platform_exclude:
      - pico_plus2/rp2350b/m33/w
```

## tests/drivers/build_all/led_strip/testcase.yaml
```yaml
common:
  build_only: true
  min_ram: 32
  tags:
    - drivers
    - led_strip
tests:
  drivers.led_strip.build:
    depends_on:
      - gpio
      - spi
  drivers.led_strip.build.uart:
    depends_on:
      - gpio
      - uart
    filter: not CONFIG_SERIAL_SUPPORT_ASYNC
    extra_args:
      - DTC_OVERLAY_FILE="uart.overlay"
  drivers.led_strip.build.rpi_pico_pio:
    platform_allow:
      - rpi_pico
```

## tests/drivers/build_all/lora/testcase.yaml
```yaml
tests:
  sample.driver.lora.rylr.send:
    extra_args: SHIELD=reyax_lora
    platform_allow: cy8ckit_062s4
  sample.driver.lora.build.uart:
    build_only: true
    extra_args: DTC_OVERLAY_FILE="uart_devices.overlay"
    extra_configs:
      - CONFIG_SERIAL=y
      - CONFIG_UART_INTERRUPT_DRIVEN=y
    platform_allow:
      - native_sim
      - native_sim/native/64
  sample.driver.lora.build.sx1262:
    build_only: true
    extra_args: DTC_OVERLAY_FILE="sx1262.overlay"
    extra_configs:
      - CONFIG_SPI=y
    platform_allow:
      - native_sim
      - native_sim/native/64
  sample.driver.lora.build.sx1272:
    build_only: true
    extra_args: DTC_OVERLAY_FILE="sx1272.overlay"
    extra_configs:
      - CONFIG_SPI=y
    platform_allow:
      - native_sim
      - native_sim/native/64
```

## tests/drivers/build_all/mbox/testcase.yaml
```yaml
common:
  build_only: true
  tags:
    - drivers
    - mbox
tests:
  drivers.mbox.build:
    platform_allow: rpi_pico2/rp2350a/m33
```

## tests/drivers/build_all/mdio/testcase.yaml
```yaml
common:
  harness: build
  tags:
    - drivers
    - mdio
tests:
  drivers.mdio.build:
    platform_allow: qemu_cortex_m0
```

## tests/drivers/build_all/memc/testcase.yaml
```yaml
# Copyright (c) 2025 CodeWrights GmbH
# SPDX-License-Identifier: Apache-2.0

common:
  tags:
    - drivers
    - memc
  build_only: true
tests:
  drivers.memc.stm32_xspi_psram.build:
    platform_allow:
      - stm32h7s78_dk
      - stm32h573i_dk
```

## tests/drivers/build_all/mfd/testcase.yaml
```yaml
common:
  build_only: true
  tags:
    - drivers
    - mfd
tests:
  drivers.mfd.build.sc18is606:
    platform_allow: native_sim
    tags: spi_nxp_sc18is606
    extra_args: "CONFIG_GPIO=y"

  drivers.mfd.build:
    platform_allow:
      - native_sim
```

## tests/drivers/build_all/modem/Kconfig
```kconfig
# Copyright (c) 2021 Linaro Limited
# SPDX-License-Identifier: Apache-2.0

source "Kconfig.zephyr"

# Modem Kconfig depends on SERIAL_SUPPORT_INTERRUPT so
# fake out Kconfig for testing purposes.

config TEST_UART
	bool "Test UART"
	select SERIAL_HAS_DRIVER
	select SERIAL_SUPPORT_INTERRUPT
```

## tests/drivers/build_all/modem/testcase.yaml
```yaml
common:
  build_only: true
  platform_allow:
    - native_sim
    - native_sim_64
    - qemu_x86
    - qemu_x86_64

tests:
  drivers.modem.modem_hl7800.interrupt_driven.build:
    extra_args: CONF_FILE=modem_hl7800.conf
    extra_configs:
      - CONFIG_UART_INTERRUPT_DRIVEN=y
  drivers.modem.modem_hl7800.async.build:
    extra_args: CONF_FILE=modem_hl7800.conf
    extra_configs:
      - CONFIG_UART_ASYNC_API=y
  drivers.modem.modem_ublox_sara.interrupt_driven.build:
    extra_args: CONF_FILE=modem_ublox_sara.conf
    extra_configs:
      - CONFIG_UART_INTERRUPT_DRIVEN=y
  drivers.modem.modem_ublox_sara.async.build:
    extra_args: CONF_FILE=modem_ublox_sara.conf
    extra_configs:
      - CONFIG_UART_ASYNC_API=y
  drivers.modem.modem_quectel_bg9x.interrupt_driven.build:
    extra_args: CONF_FILE=modem_quectel_bg9x.conf
    extra_configs:
      - CONFIG_UART_INTERRUPT_DRIVEN=y
  drivers.modem.modem_quectel_bg9x.async.build:
    extra_args: CONF_FILE=modem_quectel_bg9x.conf
    extra_configs:
      - CONFIG_UART_ASYNC_API=y
  drivers.modem.modem_gsm.interrupt_driven.build:
    extra_args: CONF_FILE=modem_gsm.conf
    extra_configs:
      - CONFIG_UART_INTERRUPT_DRIVEN=y
  drivers.modem.modem_gsm.async.build:
    extra_args: CONF_FILE=modem_gsm.conf
    extra_configs:
      - CONFIG_UART_ASYNC_API=y
  drivers.modem.modem_gsm_mux.interrupt_driven.build:
    extra_args: CONF_FILE=modem_gsm_mux.conf
    extra_configs:
      - CONFIG_UART_INTERRUPT_DRIVEN=y
  drivers.modem.modem_gsm_mux.async.build:
    extra_args: CONF_FILE=modem_gsm_mux.conf
    extra_configs:
      - CONFIG_UART_ASYNC_API=y
  drivers.modem.modem_esp_at.interrupt_driven.build:
    extra_args: CONF_FILE=modem_esp_at.conf
    extra_configs:
      - CONFIG_UART_INTERRUPT_DRIVEN=y
  drivers.modem.modem_esp_at.async.build:
    extra_args: CONF_FILE=modem_esp_at.conf
    extra_configs:
      - CONFIG_UART_ASYNC_API=y
  drivers.modem.modem_cellular.interrupt_driven.build:
    extra_args: CONF_FILE=modem_cellular.conf
    extra_configs:
      - CONFIG_UART_INTERRUPT_DRIVEN=y
  drivers.modem.modem_cellular.async.build:
    extra_args: CONF_FILE=modem_cellular.conf
    extra_configs:
      - CONFIG_UART_ASYNC_API=y
  drivers.modem.modem_simcom_sim7080.interrupt_driven.build:
    extra_args: CONF_FILE=modem_simcom_sim7080.conf
    extra_configs:
      - CONFIG_UART_INTERRUPT_DRIVEN=y
  drivers.modem.modem_simcom_sim7080.async.build:
    extra_args: CONF_FILE=modem_simcom_sim7080.conf
    extra_configs:
      - CONFIG_UART_ASYNC_API=y
```

## tests/drivers/build_all/opamp/testcase.yaml
```yaml
# Copyright 2025 NXP
# Copyright (c) 2025 Alexander Kozhinov <ak.alexander.kozhinov@gmail.com>
# SPDX-License-Identifier: Apache-2.0

common:
  tags:
    - drivers
    - opamp
  build_only: true
tests:
  drivers.opamp.build.nxp_opamp:
    platform_allow:
      - frdm_mcxa156
      - frdm_mcxn947/mcxn947/cpu0
      - lpcxpresso55s36
  drivers.opamp.build.nxp_opamp_fast:
    platform_allow:
      - frdm_mcxa366
      - frdm_mcxa346
  drivers.opamp.build.stm32_opamp:
    platform_allow:
      - nucleo_g474re
  drivers.opamp.build.infineon_ctb:
    platform_allow:
      - kit_pse84_eval/pse846gps2dbzc4a/m55
```

## tests/drivers/build_all/pwm/testcase.yaml
```yaml
common:
  build_only: true
  tags:
    - drivers
    - pwm
tests:
  drivers.pwm.cc13xx_cc26xx_timer.build:
    platform_allow: cc1352p1_launchxl/cc1352p
  drivers.pwm.gecko.build:
    platform_allow: efr32_radio/efr32fg1p133f256gm48
  drivers.pwm.imx.build:
    platform_allow: colibri_imx7d/mcimx7d/m4
  drivers.pwm.litex.build:
    platform_allow: litex_vexriscv/litex_vexriscv
  drivers.pwm.mcux.ftm.build:
    platform_allow: frdm_k22f/mk22f51212
  drivers.pwm.mcux.pwt.build:
    platform_allow: twr_ke18f/mke18f16
    extra_configs:
      - CONFIG_PWM_CAPTURE=y
  drivers.pwm.mcux.tpm.build:
    platform_allow: frdm_kw41z/mkw41z4
  drivers.pwm.mcux.build:
    platform_allow: mimxrt1064_evk/mimxrt1064
  drivers.pwm.mcux.sctimer.build:
    platform_allow: mimxrt685_evk/mimxrt685s
  drivers.pwm.rv32m1.tpm.build:
    platform_allow: rv32m1_vega/openisa_rv32m1/ri5cy
  drivers.pwm.sifive.build:
    platform_allow: hifive1@B/fe310
  drivers.pwm.npcx.build:
    platform_allow: npcx7m6fb_evb/npcx7m6fb
  drivers.pwm.nrf.sw.build:
    platform_allow: nrf51dk/nrf51822
  drivers.pwm.nrf.build:
    platform_allow: nrf52840dk/nrf52840
  drivers.pwm.pca9685.build:
    platform_allow: nrf52840dk/nrf52840
    extra_args: SHIELD=adafruit_pca9685
  drivers.pwm.sam0.tcc.build:
    platform_allow: same54_xpro/same54p20a
  drivers.pwm.build.sam:
    platform_allow:
      - sam_e70_xplained/same70q21
      - sam_v71_xult/samv71q21b
  drivers.pwm.stm32.build:
    platform_allow: disco_l475_iot1/stm32l475xx
  drivers.pwm.xec.build:
    platform_allow: mec15xxevb_assy6853/mec1501_hsz
  drivers.pwm.build.xlnx:
    platform_allow: arty_a7/designstart_fpga_cortex_m1
  drivers.pwm.build.test:
    platform_allow: qemu_cortex_m3/ti_lm3s6965
  drivers.pwm.max31790.build:
    platform_allow: nucleo_f429zi/stm32f429xx
    extra_args: DTC_OVERLAY_FILE=max31790.overlay
```

## tests/drivers/build_all/regulator/testcase.yaml
```yaml
# Copyright (c) 2023 Nordic Semiconductor ASA
# SPDX-License-Identifier: Apache-2.0

common:
  tags:
    - drivers
    - regulator
  build_only: true
tests:
  drivers.regulator.build:
    platform_allow:
      - native_sim
```

## tests/drivers/build_all/rtc/testcase.yaml
```yaml
common:
  build_only: true
  tags:
    - drivers
    - rtc
tests:
  drivers.rtc.build.pcf8523:
    depends_on:
      - arduino_spi
      - arduino_i2c
      - arduino_gpio
    extra_args: SHIELD=adafruit_data_logger
    platform_allow: frdm_k64f
  drivers.rtc.build.i2c:
    extra_args: DTC_OVERLAY_FILE="i2c_devices.overlay"
    extra_configs:
      - CONFIG_I2C=y
    platform_allow:
      - native_sim
      - native_sim/native/64
```
