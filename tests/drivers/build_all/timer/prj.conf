## prj.conf
```kconfig
CONFIG_TEST=y
CONFIG_TEST_USERSPACE=y
CONFIG_SYS_CLOCK_EXISTS=y
```

## boards/sr100_rdk_sr100.overlay
```dts
/*
 * Copyright (c) 2026 Antmicro <www.antmicro.com>
 * SPDX-License-Identifier: Apache-2.0
 */

/ {
	chosen {
		zephyr,system-timer = &test_timer0;
	};

	test {
		#address-cells = <1>;
		#size-cells = <1>;

		test_timer0: timer@deadbeef {
			compatible = "arm,cmsdk-timer";
			reg = <0x0 0xdeadbeef>;
			interrupts = <1 1>;
			interrupt-parent = <&nvic>;
		};
	};
};
```

## boards/sr100_rdk_sr100_m55.overlay
```dts
/*
 * Copyright (c) 2026 Antmicro <www.antmicro.com>
 * SPDX-License-Identifier: Apache-2.0
 */

/ {
	chosen {
		zephyr,system-timer = &test_timer0;
	};

	test {
		#address-cells = <1>;
		#size-cells = <1>;

		test_timer0: timer@5802f000 {
			compatible = "arm,cmsdk-timer";
			reg = <0x5802f000 0x1000>;
			interrupts = <2 0>;
			interrupt-parent = <&nvic>;
		};
	};
};
```

## src/main.c
```c
/*
 * Copyright (c) 2026 Antmicro <www.antmicro.com>
 *
 * SPDX-License-Identifier: Apache-2.0
 */

int main(void)
{
	return 0;
}
```
