/*
 * Copyright (c) 2026 Antmicro <www.antmicro.com>
 * SPDX-License-Identifier: Apache-2.0
 */

/ {
	chosen {
		zephyr,system-timer = &test_timer0;
	};

	test {
		#address-cells = <1>;
		#size-cells = <1>;

		test_timer0: timer@5802f000 {
			compatible = "arm,cmsdk-timer";
			reg = <0x5802f000 0x1000>;
			interrupts = <2 0>;
			interrupt-parent = <&nvic>;
		};
	};
};
