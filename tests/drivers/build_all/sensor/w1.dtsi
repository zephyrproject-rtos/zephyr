/*
 * Copyright (c) 2022, Thomas Stranger
 *
 * SPDX-License-Identifier: Apache-2.0
 *
 * Application overlay for w1 devices
 */

test_w1_ds18b20: ds18b20 {
	compatible = "maxim,ds18b20";
	family-code = <0x28>;
	resolution = <12>;
	status = "okay";
};

test_w1_ds18s20: ds18s20 {
	compatible = "maxim,ds18s20";
	family-code = <0x10>;
	status = "okay";
};
