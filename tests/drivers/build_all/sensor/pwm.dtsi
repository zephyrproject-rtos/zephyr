/*
 * Copyright (c) 2025 Prevas A/S
 *
 * SPDX-License-Identifier: Apache-2.0
 *
 * Application overlay for pwm devices
 */

test_pwm_tsic_xx6: tsic_xx6 {
	compatible = "ist,tsic-xx6";
	pwms = <&test_pwm 0 0 0>;
	data-bits = <14>;
	lower-temperature-limit = <(-100)>;
	higher-temperature-limit = <250>;
	status = "okay";
};
