## tests/drivers/build_all/sensor/testcase.yaml
```yaml
common:
  tags:
    - drivers
    - sensors
  platform_allow:
    - native_sim
  integration_platforms:
    - native_sim
  build_only: true
tests:
  drivers.sensor.sensorhub.build:
    extra_args: EXTRA_CONF_FILE=sensors_shub.conf;sensors_die_temp.conf
  drivers.sensor.trigger.own.build:
    extra_args: EXTRA_CONF_FILE=sensors_trigger_own.conf;sensors_die_temp.conf
  drivers.sensor.trigger.global.build:
    extra_args: EXTRA_CONF_FILE=sensors_trigger_global.conf;sensors_die_temp.conf
  drivers.sensor.trigger.none.build:
    extra_args: EXTRA_CONF_FILE=sensors_trigger_none.conf;sensors_die_temp.conf
  drivers.sensor.no_default.build:
    extra_args: EXTRA_CONF_FILE=sensors_no_default.conf
  drivers.sensor.build:
    tags: sensors
    extra_args: EXTRA_CONF_FILE=sensors_die_temp.conf
    extra_configs:
      - CONFIG_UART_INTERRUPT_DRIVEN=y
  drivers.sensor.pm.build:
    extra_configs:
      - CONFIG_PM=y
      - CONFIG_PM_DEVICE=y
      - CONFIG_UART_INTERRUPT_DRIVEN=y
  drivers.sensor.generic_test:
    build_only: false
    extra_configs:
      - CONFIG_GENERIC_SENSOR_TEST=y
      - CONFIG_ZTEST=y
      - CONFIG_ZTEST_THREAD_PRIORITY=1
      - CONFIG_EMUL=y
      - CONFIG_SENSOR_ASYNC_API=y
```

## tests/drivers/build_all/smbus/boards/nucleo_g071rb.conf
```kconfig
# SPDX-FileCopyrightText: Copyright The Zephyr Project Contributors
# SPDX-License-Identifier: Apache-2.0

CONFIG_I2C=y
```

## tests/drivers/build_all/smbus/testcase.yaml
```yaml
common:
  build_only: true
  tags:
    - drivers
    - i2c
    - smbus
tests:
  drivers.smbus.build.stm32:
    platform_allow:
      - nucleo_g071rb
```

## tests/drivers/build_all/spi/testcase.yaml
```yaml
common:
  build_only: true
  tags:
    - drivers
    - spi
tests:
  drivers.spi.build:
    # will cover drivers i2c based drivers
    platform_allow: native_sim
    tags: spi_nxp_sc18is606
    extra_args: "CONFIG_GPIO=y"
    # will cover drivers without in-tree boards
    platform_allow: qemu_cortex_m3
    tags: spi_cdns
    extra_args: "CONFIG_SPI=y"
```

## tests/drivers/build_all/stepper/testcase.yaml
```yaml
# SPDX-FileCopyrightText: Copyright (c) 2023 Carl Zeiss Meditec AG
# SPDX-License-Identifier: Apache-2.0

tests:
  drivers.stepper.build:
    tags:
      - drivers
      - stepper
    build_only: true
    platform_allow:
      - native_sim
```

## tests/drivers/build_all/testcase.yaml
```yaml
common:
  depends_on: gpio spi i2c
tests:
  drivers.led.build:
    build_only: true
    extra_args: CONF_FILE=led.conf
    min_ram: 32
    tags: drivers
  drivers.xlnx.build:
    build_only: true
    extra_args: CONF_FILE=xlnx.conf
    platform_allow: arty_a7_arm_designstart_m1
    tags: drivers
```

## tests/drivers/build_all/uart/testcase.yaml
```yaml
common:
  harness: build
  tags:
    - drivers
    - uart
tests:
  drivers.uart.build:
    # will cover drivers without in-tree boards
    platform_allow: qemu_cortex_m3
    extra_configs:
      - CONFIG_SERIAL=y
```

## tests/drivers/build_all/usb/testcase.yaml
```yaml
common:
  build_only: true
  tags:
    - drivers
    - usb
tests:
  drivers.usb.build.i2c:
    extra_args: DTC_OVERLAY_FILE="i2c_devices.overlay"
    extra_configs:
      - CONFIG_I2C=y
    platform_allow:
      - native_sim
      - native_sim/native/64

  drivers.usb.build.spi:
    extra_args: DTC_OVERLAY_FILE="spi_devices.overlay"
    extra_configs:
      - CONFIG_SPI=y
    platform_allow:
      - native_sim
      - native_sim/native/64
```

## tests/drivers/build_all/video/testcase.yaml
```yaml
common:
  build_only: true
  tags:
    - drivers
    - video
tests:
  drivers.video.build:
    platform_allow:
      - native_sim
    min_ram: 32
    depends_on:
      - gpio
      - i2c
  drivers.video.mcux_csi.build:
    platform_allow:
      - mimxrt1064_evk
      - mimxrt1170_evk/mimxrt1176/cm7
  drivers.video.mcux_mipi_csi2rx.build:
    platform_allow:
      - mimxrt1170_evk/mimxrt1176/cm7
      - mimxrt1170_evk@B/mimxrt1176/cm7
  drivers.video.mcux_smartdma.build:
    platform_allow:
      - frdm_mcxn947/mcxn947/cpu0
  drivers.video.stm32_dcmi.build:
    platform_allow:
      - stm32h7b3i_dk/stm32h7b3xx
      - arduino_nicla_vision/stm32h747xx/m7
    extra_args:
      - platform:stm32h7b3i_dk/stm32h7b3xx:SHIELD=st_b_cams_omv_mb1683
  drivers.video.esp32_dvp.build:
    platform_allow:
      - esp32s3_eye/esp32s3/procpu
  drivers.video.stm32_dcmipp.build:
    platform_allow:
      - stm32n6570_dk/stm32n657xx/sb
    extra_args:
      - platform:stm32n6570_dk/stm32n657xx/sb:SHIELD=st_b_cams_imx_mb1854
  drivers.video.renesas_ra_ceu.build:
    platform_allow:
      - ek_ra8d1/r7fa8d1bhecbd
    extra_args:
      - platform:ek_ra81/r7fa8d1bhecbd:SHIELD="dvp_20pin_ov7670"
```

## tests/drivers/build_all/virtio/testcase.yaml
```yaml
common:
  build_only: true
  tags:
    - drivers
    - virtio
tests:
  drivers.virtio_pci.build:
    extra_configs:
      - CONFIG_PCIE=y
    filter: CONFIG_DT_HAS_VIRTIO_PCI_ENABLED
    platform_allow: qemu_x86_64
  drivers.virtio_mmio.build:
    filter: CONFIG_DT_HAS_VIRTIO_MMIO_ENABLED
    platform_allow: qemu_cortex_a53
```

## tests/drivers/build_all/w1/testcase.yaml
```yaml
# Copyright (c) 2023 Hudson C. Dalpra
# SPDX-License-Identifier: Apache-2.0

tests:
  drivers.w1.build:
    harness: build
    tags:
      - drivers
      - w1
    depends_on:
      - gpio
    integration_platforms:
      - native_sim
```

## tests/drivers/build_all/watchdog/testcase.yaml
```yaml
common:
  build_only: true
  tags:
    - drivers
    - watchdog
tests:
  drivers.watchdog.build:
    # will cover drivers without in-tree boards
    platform_allow: qemu_cortex_m3/ti_lm3s6965
    extra_args: "CONFIG_WATCHDOG=y"
```

## tests/drivers/build_all/wifi/testcase.yaml
```yaml
common:
  build_only: true
  tags:
    - drivers
    - wifi
tests:
  drivers.wifi.build.spi:
    extra_args: DTC_OVERLAY_FILE="spi_devices.overlay"
    extra_configs:
      - CONFIG_SPI=y
    platform_allow:
      - native_sim
      - native_sim/native/64

  drivers.wifi.build.uart:
    extra_args: DTC_OVERLAY_FILE="uart_devices.overlay"
    extra_configs:
      - CONFIG_SERIAL=y
      - CONFIG_WIFI_ESWIFI_BUS_UART=y
    platform_allow:
      - native_sim
      - native_sim/native/64
```

## tests/drivers/can/api/Kconfig
```kconfig
# SPDX-License-Identifier: Apache-2.0

mainmenu "CAN Api test"

source "Kconfig.zephyr"

config CAN_TEST_MODE_LOOPBACK
    bool "Use Loopback mode for test"
    default y
    help
      Set the CAN controller into loopback mode to run the test

config CAN_TEST_MODE_LISTENONLY
   bool "Use Listenonly mode for test"
   default n
   help
     Set the CAN controller into listenonly mode to run the test
```

## tests/drivers/can/api/boards/nucleo_n657x0_q_stm32n657xx_sb.conf
```kconfig
# SPDX-FileCopyrightText: Copyright The Zephyr Project Contributors
# SPDX-License-Identifier: Apache-2.0

CONFIG_TEST_USERSPACE=n
```

## tests/drivers/can/api/boards/rtl87x2g_evb_a_rtl8762gku.conf
```kconfig
# Copyright (c) 2026, Realtek Semiconductor Corporation
# SPDX-License-Identifier: Apache-2.0

CONFIG_CAN_FD_MODE=n
```

## tests/drivers/can/api/testcase.yaml
```yaml
common:
  tags:
    - drivers
    - can
  depends_on: can
tests:
  drivers.can.api:
    filter: dt_chosen_enabled("zephyr,canbus") and not dt_compat_enabled("kvaser,pcican")
      and not dt_compat_enabled("infineon,xmc4xxx-can-node") and not dt_compat_enabled("xlnx,canfd-2.0")
  drivers.can.api.rtr:
    filter: dt_chosen_enabled("zephyr,canbus") and not dt_compat_enabled("kvaser,pcican")
      and not dt_compat_enabled("infineon,xmc4xxx-can-node") and not dt_compat_enabled("xlnx,canfd-2.0")
    extra_configs:
      - CONFIG_CAN_ACCEPT_RTR=y
  drivers.can.api.twai:
    extra_args: DTC_OVERLAY_FILE=twai-enable.overlay
    platform_allow:
      - esp32s3_devkitm/esp32s3/procpu
      - xiao_esp32s3/esp32s3/procpu
      - esp32h2_devkitm
    filter: dt_chosen_enabled("zephyr,canbus") and not dt_compat_enabled("xlnx,canfd-2.0")
  drivers.can.api.nxp_s32_canxl.non_rx_fifo:
    extra_configs:
      - CONFIG_CAN_NXP_S32_RX_FIFO=n
    filter: dt_compat_enabled("nxp,s32-canxl") and not dt_compat_enabled("xlnx,canfd-2.0")
```

## tests/drivers/can/canfd/testcase.yaml
```yaml
tests:
  drivers.can.canfd:
    tags: drivers can
    depends_on: canfd
    filter: dt_chosen_enabled("zephyr,canbus")
```

## tests/drivers/can/host/testcase.yaml
```yaml
common:
  tags:
    - drivers
    - can
  depends_on: can
tests:
  drivers.can.host:
    filter: dt_chosen_enabled("zephyr,canbus")
    harness: pytest
    harness_config:
      pytest_dut_scope: session
      fixture: can
    extra_configs:
      - arch:posix:CONFIG_NATIVE_UART_0_ON_STDINOUT=y
    integration_platforms:
      - native_sim
      - native_sim/native/64
```

## tests/drivers/can/host_socketcan/boards/native_sim.conf
```kconfig
# The companion on the host CAN bus runs at real (wall-clock) time, so slow the
# simulation down to match; otherwise the guest would exchange all its frames in
# simulated time before the companion has bound to the bus.
CONFIG_NATIVE_SIM_SLOWDOWN_TO_REAL_TIME=y
```

## tests/drivers/can/shell/Kconfig
```kconfig
# Copyright (c) 2022 Vestas Wind Systems A/S
# SPDX-License-Identifier: Apache-2.0

config TEST_FAKE_CAN
	bool
	default y
	depends on DT_HAS_TEST_FAKE_CAN_ENABLED
	select CAN_HAS_RX_TIMESTAMP
	select CAN_HAS_CANFD
	help
	  Enable support for the fake CAN driver.

source "Kconfig.zephyr"
```

## tests/drivers/can/shell/dts/bindings/test-fake-can.yaml
```yaml
# Copyright (c) 2022 Vestas Wind Systems A/S
# SPDX-License-Identifier: Apache-2.0

description: |
    This binding provides resources required to build and run the
    tests/drivers/can/shell test in Zephyr.

compatible: "test-fake-can"

include: can-fd-controller.yaml
```

## tests/drivers/can/shell/testcase.yaml
```yaml
tests:
  drivers.can.shell:
    integration_platforms:
      - native_sim
      - native_sim/native/64
    depends_on: can
    tags:
      - drivers
      - can
      - shell
```

## tests/drivers/can/stm32/testcase.yaml
```yaml
tests:
  drivers.can.stm32:
    tags: drivers can
    depends_on: can
    filter: dt_compat_enabled("st,stm32-can") and
            dt_chosen_enabled("zephyr,canbus")
```
