## tests/drivers/build_all/actuator/testcase.yaml
```yaml
common:
  build_only: true
  tags:
    - drivers
    - actuator
tests:
  drivers.build_all.actuator:
    platform_allow:
      - native_sim
      - native_sim/native/64
```

## tests/drivers/build_all/adc/testcase.yaml
```yaml
common:
  build_only: true
  tags:
    - drivers
    - adc
tests:
  drivers.adc.build:
    # will cover I2C, SPI, and emul based drivers
    platform_allow:
      - native_sim/native
      - native_sim/native/64
    extra_args: "CONFIG_GPIO=y"
  drivers.adc.cc32xx.build:
    platform_allow: cc3220sf_launchxl/cc3220sf
  drivers.adc.ite.it8xxx2.build:
    platform_allow: it8xxx2_evb/it81302bx
  drivers.adc.mcux.adc12.build:
    platform_allow: twr_ke18f/mke18f16
  drivers.adc.mcux.adc16.build:
    platform_allow: frdm_k22f/mk22f51212
  drivers.adc.mcux.lpadc.build:
    platform_allow: lpcxpresso55s28/lpc55s28
  drivers.adc.mcp320x.build:
    platform_allow: lpcxpresso55s16/lpc55s16
    extra_args: SHIELD=mikroe_adc_click
  drivers.adc.npcx.build:
    platform_allow: npcx7m6fb_evb/npcx7m6fb
  drivers.adc.nrf.build:
    platform_allow: nrf51dk/nrf51822
  drivers.adc.nrf.saadc.build:
    platform_allow: nrf21540dk/nrf52840
  drivers.adc.sam0.build:
    platform_allow: same54_xpro/same54p20a
  drivers.adc.sam.afec.build:
    platform_allow: sam_e70_xplained/same70q21
  drivers.adc.stm32.build:
    platform_allow: disco_l475_iot1/stm32l475xx
  drivers.adc.xec.build:
    platform_allow: mec15xxevb_assy6853/mec1501_hsz
  drivers.adc.test.build:
    platform_allow: qemu_cortex_m3/ti_lm3s6965
```

## tests/drivers/build_all/audio/testcase.yaml
```yaml
common:
  build_only: true
  tags:
    - drivers
    - audio
tests:
  drivers.audio.build.i2c:
    extra_args: DTC_OVERLAY_FILE="i2c_devices.overlay"
    extra_configs:
      - CONFIG_I2C=y
    platform_allow:
      - native_sim
      - native_sim/native/64

  drivers.audio.build.i2s:
    extra_args: DTC_OVERLAY_FILE="i2s_devices.overlay"
    extra_configs:
      - CONFIG_I2S=y
    platform_allow:
      - native_sim
      - native_sim/native/64
```

## tests/drivers/build_all/auxdisplay/testcase.yaml
```yaml
common:
  build_only: true
  tags:
    - drivers
    - rtc
tests:
  drivers.auxdisplay.build.i2c:
    extra_args: DTC_OVERLAY_FILE="i2c_devices.overlay"
    extra_configs:
      - CONFIG_I2C=y
    platform_allow:
      - native_sim
      - native_sim/native/64
  drivers.auxdisplay.build.spi:
    extra_args: DTC_OVERLAY_FILE="spi_devices.overlay"
    extra_configs:
      - CONFIG_SPI=y
    platform_allow:
      - native_sim
      - native_sim/native/64
  drivers.auxdisplay.build.uart:
    extra_args: DTC_OVERLAY_FILE="uart_devices.overlay"
    extra_configs:
      - CONFIG_SERIAL=y
    platform_allow:
      - native_sim
      - native_sim/native/64
```

## tests/drivers/build_all/bbram/testcase.yaml
```yaml
# Copyright (c) 2024 TOKITA hiroshi
# SPDX-License-Identifier: Apache-2.0

common:
  harness: build
  tags:
    - drivers
    - bbram

tests:
  drivers.bbram.build:
    platform_allow:
      - native_sim

  drivers.bbram.emul.build:
    platform_allow:
      - native_sim
    extra_configs:
      - CONFIG_EMUL=y
```

## tests/drivers/build_all/can/testcase.yaml
```yaml
common:
  build_only: true
  tags:
    - drivers
    - can
tests:
  drivers.can.build_all.mcp2515:
    depends_on:
      - arduino_spi
      - arduino_gpio
    extra_args: SHIELD=dfrobot_can_bus_v2_0
    platform_allow: frdm_k64f
  drivers.can.build_all.mcp2515.mikrobus:
    extra_args: SHIELD=mikroe_mcp25625_click
    platform_allow: lpcxpresso55s28
  drivers.can.build_all.mcp2515.pico:
    depends_on:
      - pico_spi
      - pico_gpio
    extra_args: SHIELD=waveshare_pico_can_b
    platform_allow:
      - pico_plus2/rp2350b/hazard3
      - pico_plus2/rp2350b/m33
      - rp2040_plus
      - rpi_pico
      - rpi_pico/rp2040/w
      - rpi_pico/rp2040/w/mcuboot
      - rpi_pico/rp2040/mcuboot
      - rpi_pico2/rp2350a/hazard3
      - rpi_pico2/rp2350a/m33
      - rpi_pico2/rp2350a/m33/w
      - rpi_pico2/rp2350a/m33/w/mcuboot
      - rpi_pico2/rp2350a/m33/mcuboot
      - w5500_evb_pico
      - w5500_evb_pico2/rp2350a/m33
  drivers.can.build_all.mcp2515.xiao:
    depends_on:
      - xiao_spi
      - xiao_gpio
    extra_args:
      - SHIELD=seeed_xiao_can
      # Avoiding hidden Kconfig warnings, as the Zephyr console on the XIAO
      # serial interface was disabled by the shield due to signal conflicts
      # on SPI CS (RX) and INT (TX).
      - CONFIG_SERIAL=n
      - CONFIG_CONSOLE=n
      - CONFIG_UART_CONSOLE=n
      - CONFIG_UART_INTERRUPT_DRIVEN=n
    platform_allow:
      - seeeduino_xiao
      - xiao_ble
      - xiao_rp2040
  drivers.can.build_all.tcan4x5x:
    depends_on:
      - arduino_spi
      - arduino_gpio
    extra_args: SHIELD=tcan4550evm
    platform_allow: frdm_k64f
  drivers.can.build_all.tcan4x5x.mikrobus:
    extra_args: SHIELD=mikroe_can_fd_6_click
    platform_allow: mikroe_stm32_m4_clicker
  drivers.can.build_all.mcp251xfd:
    extra_args: SHIELD=mikroe_mcp2518fd_click
    platform_allow: lpcxpresso55s28
  drivers.can.build_all.native_linux:
    platform_allow:
      - native_sim
      - native_sim/native/64
```

## tests/drivers/build_all/charger/testcase.yaml
```yaml
# Copyright (c) 2023 Cirrus Logic, Inc.
# SPDX-License-Identifier: Apache-2.0

tests:
  drivers.charger.build:
    tags:
      - drivers
      - charger
    build_only: true
    platform_allow:
      - native_posix
      - native_sim
```

## tests/drivers/build_all/comparator/testcase.yaml
```yaml
common:
  build_only: true
  tags:
    - drivers
    - comparator
tests:
  drivers.build_all.comparator.silabs_acmp.vsense_avdd:
    extra_args:
      - DTC_OVERLAY_FILE="silabs_acmp/vsense_avdd.overlay"
    platform_allow:
      - xg23_rb4210a
      - xg24_dk2601b
      - xg24_ek2703a
      - xg24_rb4187c
      - xg27_dk2602a
      - xg29_rb4412a
  drivers.build_all.comparator.nrf_comp.diff:
    extra_args:
      - DTC_OVERLAY_FILE="nrf_comp/diff.overlay"
    platform_allow:
      - nrf52dk/nrf52810
      - nrf52dk/nrf52832
      - nrf52833dk/nrf52820
      - nrf52833dk/nrf52833
      - nrf52840dk/nrf52811
      - nrf52840dk/nrf52840
      - nrf5340dk/nrf5340/cpuapp
      - nrf54h20dk/nrf54h20/cpuapp
      - nrf54l15dk/nrf54l15/cpuapp
      - ophelia4ev/nrf54l15/cpuapp
      - nrf9280pdk/nrf9280/cpuapp
    integration_platforms:
      - nrf52dk/nrf52810
      - nrf5340dk/nrf5340/cpuapp
  drivers.build_all.comparator.nrf_comp.se_aref:
    extra_args:
      - DTC_OVERLAY_FILE="nrf_comp/se_aref.overlay"
    platform_allow:
      - nrf52dk/nrf52810
      - nrf52dk/nrf52832
      - nrf52833dk/nrf52820
      - nrf52833dk/nrf52833
      - nrf52840dk/nrf52811
      - nrf52840dk/nrf52840
      - nrf5340dk/nrf5340/cpuapp
      - nrf54h20dk/nrf54h20/cpuapp
      - nrf54l15dk/nrf54l15/cpuapp
      - ophelia4ev/nrf54l15/cpuapp
      - nrf9280pdk/nrf9280/cpuapp
    integration_platforms:
      - nrf52dk/nrf52810
      - nrf5340dk/nrf5340/cpuapp
  drivers.build_all.comparator.nrf_comp.se:
    extra_args:
      - DTC_OVERLAY_FILE="nrf_comp/se.overlay"
    platform_allow:
      - nrf52dk/nrf52810
      - nrf52dk/nrf52832
      - nrf52833dk/nrf52820
      - nrf52833dk/nrf52833
      - nrf52840dk/nrf52811
      - nrf52840dk/nrf52840
      - nrf5340dk/nrf5340/cpuapp
      - nrf54h20dk/nrf54h20/cpuapp
      - nrf54l15dk/nrf54l15/cpuapp
      - ophelia4ev/nrf54l15/cpuapp
      - nrf9280pdk/nrf9280/cpuapp
    integration_platforms:
      - nrf52dk/nrf52810
      - nrf5340dk/nrf5340/cpuapp
  drivers.build_all.comparator.nrf_lpcomp.ext_ref:
    extra_args:
      - DTC_OVERLAY_FILE="nrf_lpcomp/ext_ref.overlay"
    platform_allow:
      - nrf51dk/nrf51822
      - nrf52dk/nrf52832
      - nrf5340dk/nrf5340/cpuapp
      - nrf54h20dk/nrf54h20/cpuapp
      - nrf54l15dk/nrf54l15/cpuapp
      - ophelia4ev/nrf54l15/cpuapp
      - nrf9280pdk/nrf9280/cpuapp
    integration_platforms:
      - nrf51dk/nrf51822
      - nrf54l15dk/nrf54l15/cpuapp
      - ophelia4ev/nrf54l15/cpuapp
  drivers.build_all.comparator.nrf_lpcomp.int_ref:
    extra_args:
      - DTC_OVERLAY_FILE="nrf_lpcomp/int_ref.overlay"
    platform_allow:
      - nrf51dk/nrf51822
      - nrf52dk/nrf52832
      - nrf5340dk/nrf5340/cpuapp
      - nrf54h20dk/nrf54h20/cpuapp
      - nrf54l15dk/nrf54l15/cpuapp
      - nrf9280pdk/nrf9280/cpuapp
      - ophelia4ev/nrf54l15/cpuapp
    integration_platforms:
      - nrf51dk/nrf51822
      - nrf54h20dk/nrf54h20/cpuapp
  drivers.build_all.comparator.mcux_acmp.mimxrt1176_mux_dac:
    extra_args:
      - DTC_OVERLAY_FILE="mcux_acmp/mimxrt1176_mux_dac.dts"
    platform_allow:
      - mimxrt1170_evk/mimxrt1176/cm4
      - mimxrt1170_evk/mimxrt1176/cm7
  drivers.build_all.comparator.mcux_acmp.mimxrt1176_mux_mux:
    extra_args:
      - DTC_OVERLAY_FILE="mcux_acmp/mimxrt1176_mux_mux.dts"
    platform_allow:
      - mimxrt1170_evk/mimxrt1176/cm4
      - mimxrt1170_evk/mimxrt1176/cm7
  drivers.build_all.comparator.mcux_acmp.mke15z7_mux_dac:
    extra_args:
      - DTC_OVERLAY_FILE="mcux_acmp/mke15z7_mux_dac.dts"
    platform_allow:
      - frdm_ke15z
  drivers.build_all.comparator.mcux_acmp.mke15z7_mux_mux:
    extra_args:
      - DTC_OVERLAY_FILE="mcux_acmp/mke15z7_mux_mux.dts"
    platform_allow:
      - frdm_ke15z
```

## tests/drivers/build_all/counter/testcase.yaml
```yaml
common:
  build_only: true
  tags:
    - drivers
    - counter
tests:
  drivers.counter.build.xlnx:
    platform_allow: arty_a7/designstart_fpga_cortex_m1
    extra_configs:
      - CONFIG_COUNTER_XLNX_AXI_TIMER=y
  drivers.counter.build.i2c:
    extra_args: DTC_OVERLAY_FILE="i2c_devices.overlay"
    extra_configs:
      - CONFIG_I2C=y
    platform_allow:
      - native_sim
      - native_sim/native/64
```

## tests/drivers/build_all/crypto/testcase.yaml
```yaml
# Copyright (c) 2024 TOKITA hiroshi
# SPDX-License-Identifier: Apache-2.0

tests:
  drivers.crypto.build:
    tags:
      - drivers
      - crypto
    harness: build
    platform_allow:
      - native_sim
```

## tests/drivers/build_all/dac/testcase.yaml
```yaml
common:
  build_only: true
  tags:
    - drivers
    - dac
tests:
  drivers.dac.build:
    # will cover I2C, SPI based drivers
    platform_allow:
      - native_sim
    extra_args: "CONFIG_GPIO=y"
  drivers.dac.mcux.build:
    platform_allow: frdm_k22f
  drivers.dac.mcux32.build:
    platform_allow: twr_ke18f
  drivers.dac.sam0.build:
    platform_allow: samd21_xpro
  drivers.dac.stm32.build:
    platform_allow: nucleo_f091rc
```

## tests/drivers/build_all/disk/testcase.yaml
```yaml
# Copyright (c) 2024 TOKITA hiroshi
# SPDX-License-Identifier: Apache-2.0

tests:
  drivers.disk.build:
    tags:
      - drivers
      - disk
    build_only: true
    platform_allow:
      - native_sim
      - native_sim/native/64
```

## tests/drivers/build_all/display/testcase.yaml
```yaml
common:
  build_only: true
  tags:
    - drivers
    - display

tests:
  drivers.display.build.default:
    integration_platforms:
      - native_sim
      - native_sim/native/64
    depends_on: display

  drivers.display.build.bflb_dbi:
    platform_allow:
      - ai_m62_12f_kit

  drivers.display.build.sf32lb_dbi:
    platform_allow:
      - sf32lb52_devkit_lcd
```

## tests/drivers/build_all/dsa/testcase.yaml
```yaml
common:
  build_only: true
  tags:
    - drivers
    - ethernet
    - dsa
tests:
  drivers.dsa.build.ksz8863:
    platform_allow:
      - native_sim
      - native_sim/native/64
```

## tests/drivers/build_all/eeprom/boards/xg23_rb4210a.conf
```kconfig
# Needs to be before CONFIG_SENSOR_INIT_PRIORITY
CONFIG_REGULATOR_FIXED_INIT_PRIORITY=55
```

## tests/drivers/build_all/eeprom/testcase.yaml
```yaml
common:
  build_only: true
  tags:
    - drivers
    - eeprom
tests:
  drivers.eeprom.build:
    min_ram: 32
    min_flash: 128
    platform_exclude: serpente
    depends_on:
      - gpio
      - i2c
      - spi

  drivers.eeprom.emul.build:
    min_ram: 64
    min_flash: 128
    platform_exclude: serpente
    depends_on:
      - gpio
      - i2c
      - spi
    extra_configs:
      - CONFIG_EMUL=y
      - CONFIG_EEPROM_AT2X_EMUL=y
```

## tests/drivers/build_all/ethernet/testcase.yaml
```yaml
common:
  build_only: true
  tags:
    - drivers
    - ethernet
  depends_on:
    - eth
tests:
  net.ethernet.build.default: {}

  net.ethernet.build.spi:
    extra_args: DTC_OVERLAY_FILE="spi_devices.overlay"
    extra_configs:
      - CONFIG_SPI=y
      - CONFIG_NET_L2_ETHERNET=y
    platform_allow:
      - native_sim
      - native_sim/native/64

  net.ethernet.build.stm32_ethernet:
    filter: dt_compat_enabled("st,stm32-ethernet")
    extra_configs:
      - CONFIG_ETH_STM32_MULTICAST_FILTER=y
    platform_allow:
      - stm32h573i_dk

  net.ethernet.build.stm32_dwmac:
    extra_args: DTC_OVERLAY_FILE="mdio_gpio.overlay"
    extra_configs:
      - CONFIG_ETH_STM32_HAL=n
      - CONFIG_MDIO_ST_STM32_HAL=n
      - CONFIG_ETH_DWMAC_STM32H7X=y
    platform_allow:
      - stm32h735g_disco
      - nucleo_h753zi
      - stm32h7s78_dk/stm32h7s7xx/ext_flash_app
      - stm32h573i_dk
```

## tests/drivers/build_all/flash/testcase.yaml
```yaml
# Copyright (c) 2024 TOKITA hiroshi
# SPDX-License-Identifier: Apache-2.0

common:
  build_only: true
  tags:
    - drivers
    - flash
tests:
  drivers.flash.build:
    platform_allow:
      - native_sim
  drivers.flash.emul.build:
    platform_allow:
      - native_sim
    extra_configs:
      - CONFIG_EMUL=y
  drivers.flash.stm32_fmc_mt29f4g08.build:
    platform_allow:
      - stm32h573i_dk
    extra_configs:
      - CONFIG_FLASH_EX_OP_ENABLED=y
      - CONFIG_FLASH_MT29F4G08_ECC=y
```

## tests/drivers/build_all/fpga/testcase.yaml
```yaml
common:
  tags:
    - drivers
    - sensors
  platform_allow:
    - native_sim
  build_only: true
tests:
  drivers.fpga.build:
    tags: fpga
```

## tests/drivers/build_all/fuel_gauge/testcase.yaml
```yaml
# Copyright (c) 2024 TOKITA hiroshi
# SPDX-License-Identifier: Apache-2.0

tests:
  drivers.fuel_gauge.build:
    tags:
      - drivers
      - fuel_gauge
    build_only: true
    platform_allow:
      - native_sim

  drivers.fuel_gauge.emul.build:
    tags:
      - drivers
      - fuel_gauge
    build_only: true
    platform_allow:
      - native_sim
    extra_configs:
      - CONFIG_EMUL=y
```

## tests/drivers/build_all/gnss/testcase.yaml
```yaml
common:
  tags:
    - drivers
    - gnss
  build_only: true
  platform_allow: native_sim
tests:
  drivers.gnss.default:
    extra_configs:
      - CONFIG_PM_DEVICE=y
```
