## tests/drivers/build_all/gpio/testcase.yaml
```yaml
common:
  build_only: true
  tags:
    - drivers
    - gpio
tests:
  drivers.gpio.build:
    min_ram: 32
    platform_exclude: serpente
    depends_on:
      - gpio
      - spi
      - i2c

  drivers.gpio.build.efinix_sapphire:
    min_ram: 32
    platform_allow: titanium_ti60_f225
    depends_on: gpio
    extra_args: DTC_OVERLAY_FILE="efinix_sapphire.overlay"

  drivers.gpio.build.altera_pio:
    min_ram: 32
    platform_allow:
      - niosv_m
      - niosv_g
    depends_on: gpio
    extra_args: DTC_OVERLAY_FILE="altera.overlay"

  drivers.gpio.build.adc_ads1x4s0x_gpio:
    min_ram: 32
    platform_allow:
      - m5stack_core2/esp32/procpu
      - nrf52840dk/nrf52840
      - native_sim
      - native_sim/native/64
    integration_platforms:
      - native_sim
    depends_on:
      - gpio
      - adc
      - spi
    extra_args:
      - DTC_OVERLAY_FILE="adc_ads1x4s0x_gpio.overlay"
    extra_configs:
      - CONFIG_ADC=y
      - CONFIG_ADC_INIT_PRIORITY=80
      - CONFIG_ADC_ADS1X4S0X_GPIO=y

  drivers.gpio.build.adc_lmp90xxx_gpio:
    min_ram: 32
    platform_allow:
      - native_sim
      - native_sim/native/64
    depends_on:
      - gpio
      - adc
      - spi
    extra_args:
      - DTC_OVERLAY_FILE="adc_lmp90xxx_gpio.overlay"
    extra_configs:
      - CONFIG_ADC=y
      - CONFIG_ADC_INIT_PRIORITY=80
      - CONFIG_ADC_LMP90XXX_GPIO=y

  drivers.gpio.build.iproc:
    platform_allow: qemu_cortex_m3
    depends_on: gpio
    extra_args: DTC_OVERLAY_FILE="iproc.overlay"
```
