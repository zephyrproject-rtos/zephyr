/*
 * Copyright (c) 2025 MASSDRIVER EI (massdriver.space)
 *
 * SPDX-License-Identifier: Apache-2.0
 */

&dbi0 {
	compatible = "bflb,dbi";

	dmas = <&dma0 0 0x14>;
	dma-names = "tx";
	status = "okay";
};
