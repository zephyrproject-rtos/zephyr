/*
 * SPDX-FileCopyrightText: Copyright The Zephyr Project Contributors
 *
 * SPDX-License-Identifier: Apache-2.0
 *
 * Application overlay for testing the VIRTIO GPIO driver build
 */

&virtio_mmio1 {
	status = "okay";

	test_gpio_virtio: virtio-gpio {
		compatible = "virtio,gpio";
		gpio-controller;
		#gpio-cells = <2>;
		status = "okay";
	};
};
