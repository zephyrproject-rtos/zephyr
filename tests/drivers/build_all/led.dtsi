/*
 * Copyright (c) 2021, Nordic Semiconductor ASA
 *
 * SPDX-License-Identifier: Apache-2.0
 *
 * Application overlay for led devices
 */

test_gpio_leds {
	compatible = "gpio-leds";
	test_gpio_led0: test_gpio_led_0 {
		gpios = <&test_gpio 0 0>;
		label = "Test GPIO LED";
	};
};
