/*
 * SPDX-FileCopyrightText: Copyright (c) 2026 Infineon Technologies AG,
 * SPDX-FileCopyrightText: or an affiliate of Infineon Technologies AG. All rights reserved.
 *
 * SPDX-License-Identifier: Apache-2.0
 */

&lpcomp0 {
	status = "okay";
};

&lpcomp0_1 {
	status = "okay";
	output-mode = "direct";
	power = "ulp";
	intr-type = "both";
	input-p = "gpio";
	input-n = "local_vref";
};
