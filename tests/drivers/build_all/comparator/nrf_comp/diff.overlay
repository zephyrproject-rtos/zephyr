/*
 * Copyright (c) 2024 Nordic Semiconductor
 *
 * SPDX-License-Identifier: Apache-2.0
 */

#include <zephyr/dt-bindings/comparator/nrf-comp.h>

&comp {
	main-mode = "DIFF";
	psel = <NRF_COMP_AIN0>;
	extrefsel = <NRF_COMP_AIN1>;
	sp-mode = "HIGH";
	isource = "DISABLED";
	status = "okay";
};
