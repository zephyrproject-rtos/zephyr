/*
 * Copyright (c) 2024 Nordic Semiconductor
 *
 * SPDX-License-Identifier: Apache-2.0
 */

#include <zephyr/dt-bindings/comparator/nrf-comp.h>

&comp {
	main-mode = "SE";
	psel = <NRF_COMP_AIN0>;
	refsel = "INT_1V2";
	sp-mode = "HIGH";
	th-up = <36>;
	th-down = <28>;
	isource = "DISABLED";
	status = "okay";
};
