/*
 * Copyright (c) 2025 Silicon Laboratories Inc.
 *
 * SPDX-License-Identifier: Apache-2.0
 */

#include <zephyr/dt-bindings/comparator/silabs-acmp.h>

&acmp0 {
	status = "okay";

	bias = <0>;
	hysteresis-mode = "disabled";
	accuracy-mode = "low";
	input-range = "full";
	input-positive = <ACMP_INPUT_VSENSE01DIV4>;
	input-negative = <ACMP_INPUT_VREFDIVAVDD>;
	vref-divider = <63>;
};
