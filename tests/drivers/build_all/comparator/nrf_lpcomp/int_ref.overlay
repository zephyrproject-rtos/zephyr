/*
 * Copyright (c) 2024 Nordic Semiconductor
 *
 * SPDX-License-Identifier: Apache-2.0
 */

#include <zephyr/dt-bindings/comparator/nrf-comp.h>

&comp {
	compatible = "nordic,nrf-lpcomp";
	psel = <NRF_COMP_AIN0>;
	refsel = "AREF";
	extrefsel = <NRF_COMP_AIN1>;
	status = "okay";
};
