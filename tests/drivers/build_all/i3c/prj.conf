## prj.conf
```kconfig
CONFIG_TEST=y
CONFIG_TEST_USERSPACE=y
CONFIG_I3C=y
CONFIG_SHELL=y
CONFIG_I3C_SHELL=y
CONFIG_CLOCK_CONTROL=y
CONFIG_CLOCK_CONTROL_FIXED_RATE_CLOCK=y
CONFIG_I3C_CALLBACK=y
```

## boards/nucleo_c5a3zg.conf
```kconfig
# SPDX-FileCopyrightText: Copyright (c) 2026 STMicroelectronics
# SPDX-License-Identifier: Apache-2.0

# Disable Test userspace to prevent compilation error
CONFIG_TEST_USERSPACE=n
```

## boards/nucleo_u385rg_q.conf
```kconfig
# SPDX-FileCopyrightText: Copyright The Zephyr Project Contributors
# SPDX-License-Identifier: Apache-2.0

# Disable Test userspace to prevent compilation error
CONFIG_TEST_USERSPACE=n
```

## boards/nucleo_c5a3zg.overlay
```dts
/*
 * SPDX-FileCopyrightText: Copyright (c) 2026 STMicroelectronics
 *
 * SPDX-License-Identifier: Apache-2.0
 */

&i2c1 {
	status = "disabled";
};

&i3c1 {
	status = "okay";
};
```

## boards/qemu_cortex_m3.overlay
```dts
/*
 * Copyright (c) 2022 Meta Platforms
 *
 * SPDX-License-Identifier: Apache-2.0
 */

/ {
	test_fixed_clk: test-fixed-clock {
		compatible = "fixed-clock";
		clock-frequency = <200000000>;
		#clock-cells = <0>;
	};

	i3c0: i3c@88888888 {
		compatible = "cdns,i3c";
		reg = <0x88888888 0x400>;
		#address-cells = <3>;
		#size-cells = <0>;
		interrupt-parent = <&nvic>;
		interrupts = <4 1>;
		input-clock-frequency = <200000000>;
		i3c-scl-hz = <12500000>;
		i2c-scl-hz = <400000>;
	};

	i3c1: i3c@cccccccc {
		compatible = "snps,designware-i3c";
		reg = <0xcccccccc 0x400>;
		#address-cells = <3>;
		#size-cells = <0>;
		interrupt-parent = <&nvic>;
		interrupts = <8 1>;
		clocks = <&test_fixed_clk>;
		i3c-scl-hz = <12500000>;
		i2c-scl-hz = <400000>;
	};
};
```

## src/main.c
```c
/*
 * Copyright (c) 2022 Meta Platforms
 *
 * SPDX-License-Identifier: Apache-2.0
 */

int main(void)
{
	return 0;
}
```
