## Kconfig
```
# Copyright (c) 2023 Meta
# SPDX-License-Identifier: Apache-2.0

config NUM_IRQS
	int ""

source "Kconfig"
```

## prj.conf
```kconfig
# SPDX-License-Identifier: Apache-2.0

CONFIG_TEST=y
```

## app.edge_interrupt.overlay
```dts
/*
 * Copyright (c) 2023 Meta
 *
 * SPDX-License-Identifier: Apache-2.0
 */

 /{
	soc {
		plic: interrupt-controller@c000000 {
			riscv,trigger-reg-offset = < 0x00001080 >;
		};
	};
};
```

## app.multi_instance.overlay
```dts
/*
 * Copyright (c) 2023 Meta
 *
 * SPDX-License-Identifier: Apache-2.0
 */

/ {
	soc {
		plic1: interrupt-controller@8000000 {
			compatible = "sifive,plic-1.0.0";
			reg = <0x08000000 0x04000000>;
			interrupts-extended = <&hlic0 0x08
					       &hlic1 0x08
					       &hlic2 0x08
					       &hlic3 0x08
					       &hlic4 0x08
					       &hlic5 0x08
					       &hlic6 0x08
					       &hlic7 0x08>;
			interrupt-controller;
			#address-cells = <0x00>;
			#interrupt-cells = <0x02>;
			riscv,max-priority = <7>;
			riscv,ndev = <0x35>;
		};
	};

	uart1: uart@10000100 {
		compatible = "ns16550";
		reg = <0x10000100 0x100>;
		interrupts = <0x0a 1>;
		interrupt-parent = <&plic1>;
		clock-frequency = <0x384000>;
		reg-shift = <0>;
	};
};
```

## src/main.c
```c
/*
 * Copyright (c) 2023 Meta
 *
 * SPDX-License-Identifier: Apache-2.0
 */

int main(void)
{
	return 0;
}
```
