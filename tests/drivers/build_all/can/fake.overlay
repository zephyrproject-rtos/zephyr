/*
 * SPDX-FileCopyrightText: Copyright (c) 2026 Vestas Wind Systems A/S
 *
 * SPDX-License-Identifier: Apache-2.0
 */

/ {
	chosen {
		zephyr,canbus = &fake_can;
	};

	fake_can: fake_can {
		compatible = "zephyr,fake-can";
	};
};
