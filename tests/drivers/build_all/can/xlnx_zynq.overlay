/*
 * SPDX-FileCopyrightText: Copyright The Zephyr Project Contributors
 *
 * SPDX-License-Identifier: Apache-2.0
 */

/ {
	chosen {
		zephyr,canbus = &can0;
	};
};

&can0 {
	status = "okay";
	clock-frequency = <100000000>;
};
