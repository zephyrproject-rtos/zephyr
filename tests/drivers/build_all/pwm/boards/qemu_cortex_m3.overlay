/*
 * Copyright (c) 2022, Commonwealth Scientific and Industrial Research
 * Organisation (CSIRO) ABN 41 687 119 230.
 *
 * SPDX-License-Identifier: Apache-2.0
 */

/ {
	test_pwm: pwm@11112222 {
		compatible = "vnd,pwm";
		reg = <0x11112222 0x1000>;
		#pwm-cells = <3>;
		status = "okay";
	};
};
