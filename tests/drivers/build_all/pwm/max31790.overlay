/*
 * Copyright (c) 2023 SILA Embedded Solutions GmbH
 * SPDX-License-Identifier: Apache-2.0
 */

&arduino_i2c {
	clock-frequency = <I2C_BITRATE_FAST>;
	status = "okay";

	max31790_max31790: max31790@20 {
		compatible = "maxim,max31790";
		reg = <0x20>;
		status = "okay";

		max31790_max31790_pwm: max31790_max31790_pwm {
			compatible = "maxim,max31790-pwm";
			pwm-controller;
			#pwm-cells = <2>;
			status = "okay";
		};
	};
};
