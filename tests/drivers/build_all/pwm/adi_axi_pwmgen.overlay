/*
 * Copyright (c) 2026 Analog Devices, Inc.
 * SPDX-License-Identifier: Apache-2.0
 */

/ {
	pwmgen0: pwmgen@99999999 {
		compatible = "adi,axi-pwmgen";
		reg = <0x99999999 0x10000>;
		adi,ref-clock-hz = <100000000>;
		#pwm-cells = <3>;
	};
};
