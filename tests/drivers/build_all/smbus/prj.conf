## prj.conf
```kconfig
CONFIG_TEST=y
CONFIG_TEST_USERSPACE=y
CONFIG_SMBUS=y
```

## boards/nucleo_g071rb.conf
```kconfig
# SPDX-FileCopyrightText: Copyright The Zephyr Project Contributors
# SPDX-License-Identifier: Apache-2.0

CONFIG_I2C=y
```

## boards/nucleo_g071rb.overlay
```dts
/*
 * SPDX-FileCopyrightText: Copyright The Zephyr Project Contributors
 * SPDX-License-Identifier: Apache-2.0
 */

&i2c1 {
	status = "okay";
};

&smbus1 {
	i2c = <&i2c1>;
	status = "okay";
};
```

## src/main.c
```c
/*
 * SPDX-FileCopyrightText: Copyright The Zephyr Project Contributors
 * SPDX-License-Identifier: Apache-2.0
 */

int main(void)
{
	return 0;
}
```
