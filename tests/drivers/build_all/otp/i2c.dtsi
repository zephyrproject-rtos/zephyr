/*
 * Copyright (c) 2026 Nordic Semiconductor ASA
 * SPDX-License-Identifier: Apache-2.0
 */

/****************************************
 * PLEASE KEEP REG ADDRESSES SEQUENTIAL *
 **************************************
 */

npm1012@0 {
	reg = <0x0>;

	otp {
		compatible = "nordic,npm10xx-uicr";
	};
};
