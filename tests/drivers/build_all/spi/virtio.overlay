/*
 * SPDX-FileCopyrightText: Copyright The Zephyr Project Contributors
 *
 * SPDX-License-Identifier: Apache-2.0
 *
 * Application overlay for testing the VIRTIO SPI driver build
 */

&virtio_mmio1 {
	status = "okay";

	test_spi_virtio: virtio-spi {
		compatible = "virtio,spi";
		#address-cells = <1>;
		#size-cells = <0>;
		status = "okay";
	};
};
