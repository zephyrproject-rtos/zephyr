/*
 * Copyright (c) 2025 tinyvision.ai
 *
 * SPDX-License-Identifier: Apache-2.0
 */

&i2c0 {
	status = "okay";

	sc18is606: sc18is606@28 {
		compatible = "nxp,sc18is606";
		reg = <0x28>;
		status = "okay";

		spi_ext: sc18is606_spi {
			compatible = "nxp,sc18is606-spi";
			#address-cells = <1>;
			#size-cells = <0>;
			frequency = <0>;
			status = "okay";
		};
	};
};
