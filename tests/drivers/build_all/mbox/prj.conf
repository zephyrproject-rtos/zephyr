## prj.conf
```kconfig
CONFIG_TEST=y
CONFIG_TEST_USERSPACE=y
CONFIG_MBOX=y
```

## boards/qemu_cortex_a53.overlay
```dts
/*
 * Copyright (c) 2026, Xsight Labs
 *
 * SPDX-License-Identifier: Apache-2.0
 */

/ {
	soc {
		mhu0: mbox@88880000 {
			compatible = "arm,mhuv2";
			reg = <0x0 0x88880000 0x0 0x1000>,
			      <0x0 0x88881000 0x0 0x1000>;
			reg-names = "send", "recv";
			interrupts = <GIC_SPI 88 IRQ_TYPE_LEVEL IRQ_DEFAULT_PRIORITY>;
			#mbox-cells = <1>;
		};
	};

	mbox-gic-sw {
		compatible = "zephyr,mbox-gic-sw";
		interrupt-parent = <&gic>;
		interrupts = <GIC_SPI 90 IRQ_TYPE_EDGE IRQ_DEFAULT_PRIORITY>,
			     <GIC_SPI 92 IRQ_TYPE_EDGE IRQ_DEFAULT_PRIORITY>;
		tx-spis = <91 93>;
		#mbox-cells = <1>;
	};
};
```

## boards/qemu_cortex_m3.overlay
```dts
/*
 * Copyright (c) 2026, Xsight Labs
 *
 * SPDX-License-Identifier: Apache-2.0
 */

/ {
	mhu0: mbox@88880000 {
		compatible = "arm,mhuv2";
		reg = <0x88880000 0x1000>, <0x88881000 0x1000>;
		reg-names = "send", "recv";
		interrupt-parent = <&nvic>;
		interrupts = <10 0>;
		#mbox-cells = <1>;
	};
};
```

## boards/rpi_pico2_rp2350a_m33.overlay
```dts
/*
 * Copyright (c) 2026 Igalia S.L.
 *
 * SPDX-License-Identifier: Apache-2.0
 */

&mbox {
	status = "okay";
};
```

## src/main.c
```c
/*
 * Copyright (c) 2026 Igalia S.L.
 *
 * SPDX-License-Identifier: Apache-2.0
 */

int main(void)
{
	return 0;
}
```
