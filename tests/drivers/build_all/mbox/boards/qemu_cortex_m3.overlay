/*
 * Copyright (c) 2026, Xsight Labs
 *
 * SPDX-License-Identifier: Apache-2.0
 */

/ {
	mhu0: mbox@88880000 {
		compatible = "arm,mhuv2";
		reg = <0x88880000 0x1000>, <0x88881000 0x1000>;
		reg-names = "send", "recv";
		interrupt-parent = <&nvic>;
		interrupts = <10 0>;
		#mbox-cells = <1>;
	};

	aspeed_mbox: mbox@88890000 {
		compatible = "aspeed,ast2700-mailbox";
		reg = <0x88890000 0x100>, <0x88890100 0x100>;
		reg-names = "tx", "rx";
		interrupt-parent = <&nvic>;
		interrupts = <11 0>;
		#mbox-cells = <1>;
	};
};
