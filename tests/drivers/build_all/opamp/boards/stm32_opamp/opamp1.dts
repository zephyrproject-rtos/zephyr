/*
 * Copyright (c) 2025 Alexander Kozhinov <ak.alexander.kozhinov@gmail.com>
 * SPDX-License-Identifier: Apache-2.0
 */

/*
 * IMPORTANT: D33 (PB0) shall be connected to D27 (PB2) by a jumper wire
 */

&opamp1 {
	pinctrl-0 = <&opamp1_vinm_pa7 &opamp1_vinp_pb0 &opamp2_vout_pe7>;
	pinctrl-names = "default";
	functional-mode = "non_inverting";
	status = "okay";
};

&opamp2 {
	functional-mode = "non_inverting";
	status = "okay";
};
