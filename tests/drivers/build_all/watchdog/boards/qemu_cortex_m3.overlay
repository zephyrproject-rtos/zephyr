/*
 * Copyright © 2023 Calian Ltd.  All rights reserved.
 *
 * SPDX-License-Identifier: Apache-2.0
 */

/ {
	watchdog: watchdog@88888888 {
		compatible = "xlnx,xps-timebase-wdt-1.00.a";
		reg = <0x88888888 0x10000>;
		clocks = <&sysclk>;
		xlnx,wdt-interval = <31>;
		xlnx,wdt-enable-once = <1>;
	};

	cdns_wdt: watchdog@99999000 {
		compatible = "cdns,wdt-r1p2";
		reg = <0x99999000 0x1000>;
		clock-frequency = <100000000>;
	};
};
