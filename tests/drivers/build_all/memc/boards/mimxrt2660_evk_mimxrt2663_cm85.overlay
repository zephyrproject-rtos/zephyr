/*
 * Copyright 2026 NXP
 *
 * SPDX-License-Identifier: Apache-2.0
 */

/*
 * Build-only coverage for the NXP AHB SRAM Controller driver.
 *
 * The MIMXRT2660-EVK carries no asynchronous parallel SRAM: its external
 * memories are the XSPI0 NOR and the XSPI1 PSRAM. J73 requires hardware rework
 * and shares PIO5 with the PSRAM. Do not run this configuration with the default
 * PSRAM memory layout.
 */

&sramc {
	port-size = <16>;
	address-mode = "admux";
	status = "okay";

	/*
	 * CS0's window and the timings of a nominal 128 KB (64K x 16) asynchronous
	 * SRAM with a 55 ns access time. No linker region is requested: the window is
	 * reached through the memc API.
	 */
	ext_sram0: sram@25000000 {
		compatible = "nxp,ahb-sramc-device";
		reg = <0x25000000 DT_SIZE_K(128)>;
		cs = <0>;

		ce-setup-time-ns = <0>;
		ce-hold-time-ns = <0>;
		address-setup-time-ns = <10>;
		address-hold-time-ns = <5>;
		turnaround-time-ns = <10>;
		write-enable-low-time-ns = <45>;
		write-enable-high-time-ns = <10>;
		read-enable-low-time-ns = <55>;
		read-enable-high-time-ns = <10>;
	};
};
