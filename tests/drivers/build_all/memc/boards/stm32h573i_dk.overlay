/*
 * Copyright (c) 2025 CodeWrights GmbH
 *
 * SPDX-License-Identifier: Apache-2.0
 */

/delete-node/ &ext_flash_ctrl;

&xspi1 {
	memc: aps256xxn_obr: memory@0 {
		compatible = "st,stm32-xspi-psram";
		reg = <0>;
		size = <DT_SIZE_M(256)>; /* 256 Mbits */
		max-frequency = <DT_FREQ_M(200)>;
		fixed-latency;
		read-latency = <4>;
		write-latency = <1>;
		burst-length = <0>;
		st,csbound = <11>;
		status = "okay";
	};
};
