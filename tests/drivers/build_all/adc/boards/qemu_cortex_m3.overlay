/*
 * Copyright (c) 2021, Commonwealth Scientific and Industrial Research
 * Organisation (CSIRO) ABN 41 687 119 230.
 *
 * SPDX-License-Identifier: Apache-2.0
 */

/ {
	test_adc: adc@11112222 {
		compatible = "vnd,adc";
		reg = <0x11112222 0x1000>;
		#io-channel-cells = <1>;
		status = "okay";
	};
};
