/*
 * SPDX-FileCopyrightText: Copyright 2026 NXP
 * SPDX-License-Identifier: Apache-2.0
 */

#include <zephyr/dt-bindings/wuc/wuc_nxp_rw_pmu.h>

/ {
	zephyr,user {
		wakeup-ctrls = <&wuc NXP_RW_PMU_RTC>,
			       <&wuc NXP_RW_PMU_OS_EVENT_TIMER>,
			       <&wuc NXP_RW_PMU_PIN1>;
	};
};
