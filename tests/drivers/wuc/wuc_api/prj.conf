## CMakeLists.txt
```
# Copyright 2026 NXP
# SPDX-License-Identifier: Apache-2.0

cmake_minimum_required(VERSION 3.28.0)

find_package(Zephyr REQUIRED HINTS $ENV{ZEPHYR_BASE})
project(wuc_api)

FILE(GLOB app_sources src/*.c)
target_sources(app PRIVATE ${app_sources})
```

## prj.conf
```kconfig
# Copyright 2026 NXP
# SPDX-License-Identifier: Apache-2.0

CONFIG_WUC=y
CONFIG_ZTEST=y
```

## boards/ek_ra8p1_r7ka8p1kflcac_cm85.overlay
```dts
/*
 * Copyright (c) 2026 Renesas Electronics Corporation
 *
 * SPDX-License-Identifier: Apache-2.0
 */

#include <zephyr/dt-bindings/wuc/wuc_renesas_ra_lpm.h>

/ {
	zephyr,user {
		wakeup-source;
		wakeup-ctrls = <&wuc RA_WUC_DPSS_IRQ13_FALLING>;
	};
};

&wuc {
	status = "okay";
};
```

## boards/frdm_mcxc242.overlay
```dts
/*
 * Copyright 2026 NXP
 *
 * SPDX-License-Identifier: Apache-2.0
 */

#include <zephyr/dt-bindings/wuc/wuc_nxp_llwu.h>

/ {
	zephyr,user {
		wakeup-source;
		wakeup-ctrls = <&llwu NXP_LLWU_PIN_0_RISING>,
			       <&llwu NXP_LLWU_MODULE_0>;
	};
};

&llwu {
	status = "okay";
};
```

## boards/frdm_mcxw72_mcxw727c.overlay
```dts
/*
 * Copyright 2026 NXP
 *
 * SPDX-License-Identifier: Apache-2.0
 */

#include <zephyr/dt-bindings/wuc/wuc_nxp_wuu.h>

/ {
	zephyr,user {
		wakeup-source;
		wakeup-ctrls = <&wuu NXP_WUU_PIN_0_RISING_INT>,
			       <&wuu NXP_WUU_MODULE_0_INT>;
	};
};
```

## boards/frdm_mcxw72_mcxw727c_cpu0.overlay
```dts
/*
 * Copyright 2026 NXP
 *
 * SPDX-License-Identifier: Apache-2.0
 */

#include <zephyr/drivers/wuc/wuc_nxp_wuu.h>

/ {
	zephyr,user {
		wakeup-source;
		wakeup-ctrls = <&wuu NXP_WUU_PIN_0_RISING_INT>,
			       <&wuu NXP_WUU_MODULE_0_INT>;
	};
};
```

## boards/frdm_rw612.overlay
```dts
/*
 * SPDX-FileCopyrightText: Copyright 2026 NXP
 * SPDX-License-Identifier: Apache-2.0
 */

/ {
	zephyr,user {
		wakeup-ctrls = <&wuc 32>, /* RTC */
			       <&wuc 41>; /* OS timer */
	};
};
```

## boards/mimxrt700_evk_mimxrt798s_cm33_cpu0.overlay
```dts
/*
 * SPDX-FileCopyrightText: Copyright 2026 NXP
 *
 * SPDX-License-Identifier: Apache-2.0
 */

/ {
	zephyr,user {
		wakeup-source;
		wakeup-ctrls = <&sleepcon0 26>,	/* RTC0 alarm  -> WAKEUPEN0 bit 26 */
			       <&sleepcon0 91>;	/* GPIO0       -> WAKEUPEN2 bit 27 */
	};
};

&sleepcon0 {
	status = "okay";
};
```

## src/main.c
```c
/*
 * Copyright 2026 NXP
 *
 * SPDX-License-Identifier: Apache-2.0
 */

#include <zephyr/ztest.h>
#include <zephyr/device.h>

#include <zephyr/drivers/wuc.h>

#define WUC_SPEC_INFO(node_id, prop, idx) WUC_DT_SPEC_GET_BY_IDX(node_id, idx),

#if DT_NODE_HAS_PROP(DT_PATH(zephyr_user), wakeup_ctrls)

static const struct wuc_dt_spec test_wuc_dt_specs[] = {
	DT_FOREACH_PROP_ELEM(DT_PATH(zephyr_user), wakeup_ctrls, WUC_SPEC_INFO)};
static const int test_wuc_dt_spec_count = ARRAY_SIZE(test_wuc_dt_specs);
#else
#error "Unsupported board"
#endif

static void *wuc_api_setup(void)
{
	zassert_true(device_is_ready(test_wuc_dt_specs[0].dev), "WUC device is not ready");

	return NULL;
}

/**
 * @brief Test wuc_enable_wakeup_source API
 */
ZTEST(wuc_api, test_wuc_enable_wakeup_source)
{
	int ret;
	int i;

	for (i = 0; i < test_wuc_dt_spec_count; i++) {
		ret = wuc_enable_wakeup_source_dt(&test_wuc_dt_specs[i]);
		zassert_ok(ret, "Fail to enable wakeup source");
	}
}

/**
 * @brief Test wuc_disable_wakeup_source API
 */
ZTEST(wuc_api, test_wuc_disable_wakeup_source)
{
	int ret;
	int i;

	for (i = 0; i < test_wuc_dt_spec_count; i++) {
		ret = wuc_disable_wakeup_source_dt(&test_wuc_dt_specs[i]);
		zassert_ok(ret, "Failed to disable wakeup source");
	}
}

ZTEST_SUITE(wuc_api, NULL, wuc_api_setup, NULL, NULL, NULL);
```
