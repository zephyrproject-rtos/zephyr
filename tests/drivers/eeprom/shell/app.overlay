/*
 * Copyright (c) 2022 Vestas Wind Systems A/S
 *
 * SPDX-License-Identifier: Apache-2.0
 */

#include <mem.h>

/ {
	fake_eeprom: fake_eeprom {
		compatible = "zephyr,fake-eeprom";
		status = "okay";
		size = <DT_SIZE_K(8)>;
	};
};
