## CMakeLists.txt
```
# SPDX-License-Identifier: Apache-2.0

cmake_minimum_required(VERSION 3.28.0)

find_package(Zephyr REQUIRED HINTS $ENV{ZEPHYR_BASE})
project(spi_controller_peripheral)

FILE(GLOB app_sources src/*.c)

target_sources(app PRIVATE ${app_sources})
```

## Kconfig
```
# Copyright (c) 2024 Nordic Semiconductor ASA
# SPDX-License-Identifier: Apache-2.0

config TESTED_SPI_MODE
	int "SPI mode"
	default 0
	help
	  SPI mode value (clock polarity and phase) used in the test.
	  0: CPOL 0 (Active high), CPHA 0 (leading)
	  1: CPOL 0 (Active high), CPHA 1 (trailing)
	  2: CPOL 1 (Active low), CPHA 0 (leading)
	  3: CPOL 1 (Active low), CPHA 1 (trailing)

config TEST_INCORRECT_SCK_STATE
	bool "Incorrect SCK state"
	select PM_DEVICE
	help
	  Setting this option will set SCK to the opposite state than CPOL just before transceive.

config PREALLOC_BUFFERS
	bool "Preallocate buffers"
	default y
	help
	  Preallocate buffers used for transaction
	  using `memory-region` property.

config SPI_CONTROLLER_PERIPHERAL_WORKQUEUE_STACK_SIZE
	int "Test workqueue stack size"
	default 1024
	help
	  Stack size for thread used to perform async API checks

config SPI_CONTROLLER_PERIPHERAL_WORKQUEUE_PRIORITY
	int "Test workqueue priority"
	default 10
	help
	  Priority for the work queue used for async testing

config TEST_SPI_NO_HOLD_ON_CS
	bool "No hold on CS"
	help
	  Setting this option will disable holding the CS line active between transactions.
	  This can be useful when the SPI instances is expecting a CS transition to start
	  a transaction.

source "Kconfig.zephyr"
```

## prj.conf
```kconfig
CONFIG_SPI=y
CONFIG_SPI_PERIPHERAL=y
CONFIG_GPIO=y
CONFIG_POLL=y
CONFIG_SPI_ASYNC=y
CONFIG_ZTEST=y
```

## boards/apard32690_max32690_m4.conf
```kconfig
#
# Copyright (c) 2023-2024 Analog Devices, Inc.
#
# SPDX-License-Identifier: Apache-2.0
#

CONFIG_SPI_MAX32_DMA=y
CONFIG_SPI_MAX32_INTERRUPT=y
```

## boards/ek_ra6m2.conf
```kconfig
# Copyright (c) 2025 Renesas Electronics Corporation
# SPDX-License-Identifier: Apache-2.0

CONFIG_SPI_INTERRUPT=y
CONFIG_SPI_RA_DTC=y
CONFIG_TESTED_SPI_MODE=1
```

## boards/ek_ra8d1_sci_b_spi.conf
```kconfig
# Copyright (c) 2025 Renesas Electronics Corporation
# SPDX-License-Identifier: Apache-2.0

CONFIG_SPI_ASYNC=y
CONFIG_SPI_RENESAS_RA_SCI_B_INTERRUPT=y
CONFIG_SPI_RENESAS_RA_SCI_B_DTC=y
```

## boards/ek_ra8m1.conf
```kconfig
# Copyright (c) 2024 Renesas Electronics Corporation
# SPDX-License-Identifier: Apache-2.0

CONFIG_SPI_B_INTERRUPT=y
CONFIG_SPI_B_RA_DTC=y
```

## boards/esp32_devkitc_procpu.conf
```kconfig
# Copyright (c) 2026 Espressif Systems (Shanghai) Co., Ltd.
# SPDX-License-Identifier: Apache-2.0

CONFIG_SPI_ESP32_INTERRUPT=y
CONFIG_ESP32_SPI_TARGET=y
CONFIG_SOC_ESP32_USE_UNSUPPORTED_REVISION=y
```

## boards/esp32p4_function_ev_board_hpcore.conf
```kconfig
# Copyright (c) 2026 Espressif Systems (Shanghai) Co., Ltd.
# SPDX-License-Identifier: Apache-2.0

CONFIG_SPI_ESP32_INTERRUPT=y
CONFIG_ESP32_SPI_TARGET=y
```

## 1m333333hz.overlay
```dts
/*
 * Copyright (c) 2025 Nordic Semiconductor
 *
 * SPDX-License-Identifier: Apache-2.0
 */

&dut_spi_dt {
	spi-max-frequency = <1333333>;
};
```

## 1mhz.overlay
```dts
/*
 * Copyright (c) 2024 Nordic Semiconductor
 *
 * SPDX-License-Identifier: Apache-2.0
 */

&dut_spi_dt {
	spi-max-frequency = <1000000>;
};
```

## 250khz.overlay
```dts
/*
 * Copyright (c) 2024 Nordic Semiconductor
 *
 * SPDX-License-Identifier: Apache-2.0
 */

&dut_spi_dt {
	spi-max-frequency = <100000>;
};
```

## 4mhz.overlay
```dts
/*
 * Copyright (c) 2024 Nordic Semiconductor
 *
 * SPDX-License-Identifier: Apache-2.0
 */

&dut_spi_dt {
	spi-max-frequency = <4000000>;
};
```

## 500khz.overlay
```dts
/*
 * Copyright (c) 2024 Nordic Semiconductor
 *
 * SPDX-License-Identifier: Apache-2.0
 */

&dut_spi_dt {
	spi-max-frequency = <500000>;
};
```

## 8mhz.overlay
```dts
/*
 * Copyright (c) 2024 Nordic Semiconductor
 *
 * SPDX-License-Identifier: Apache-2.0
 */

&dut_spi_dt {
	spi-max-frequency = <8000000>;
};
```

## src/main.c
```c
/*
 * Copyright (c) 2024 Nordic Semiconductor ASA
 *
 * SPDX-License-Identifier: Apache-2.0
 */

#include <errno.h>
#include <string.h>
#include <zephyr/kernel.h>
#include <zephyr/drivers/gpio.h>
#include <zephyr/drivers/spi.h>
#include <zephyr/linker/devicetree_regions.h>
#include <zephyr/ztest.h>

#if CONFIG_TESTED_SPI_MODE == 0
#define SPI_MODE (SPI_WORD_SET(8) | SPI_LINES_SINGLE | SPI_TRANSFER_LSB)
#elif CONFIG_TESTED_SPI_MODE == 1
#define SPI_MODE (SPI_WORD_SET(8) | SPI_LINES_SINGLE | SPI_TRANSFER_MSB | SPI_MODE_CPHA)
#elif CONFIG_TESTED_SPI_MODE == 2
#define SPI_MODE (SPI_WORD_SET(8) | SPI_LINES_SINGLE | SPI_TRANSFER_LSB | SPI_MODE_CPOL)
#elif CONFIG_TESTED_SPI_MODE == 3
#define SPI_MODE (SPI_WORD_SET(8) | SPI_LINES_SINGLE | SPI_TRANSFER_MSB | SPI_MODE_CPHA \
				| SPI_MODE_CPOL)
#endif

#define SPIM_OP	 (SPI_OP_MODE_CONTROLLER | SPI_MODE)
#define SPIS_OP	 (SPI_OP_MODE_PERIPHERAL | SPI_MODE)

#if CONFIG_TEST_INCORRECT_SCK_STATE && DT_NODE_HAS_PROP(DT_PATH(zephyr_user), sck_gpios)
static const struct gpio_dt_spec sck = GPIO_DT_SPEC_GET(DT_PATH(zephyr_user), sck_gpios);
#endif

static struct spi_dt_spec spim = SPI_DT_SPEC_GET(DT_NODELABEL(dut_spi_dt), SPIM_OP);
static const struct device *spis_dev = DEVICE_DT_GET(DT_NODELABEL(dut_spis));
static const struct spi_config spis_config = {
	.operation = SPIS_OP,
	.peripheral = DT_PROP_OR(DT_PATH(zephyr_user), peripheral_cs, 0),
	.frequency = DT_PROP(DT_NODELABEL(dut_spi_dt), spi_max_frequency),
};

#ifdef CONFIG_SPI_ASYNC
static struct k_poll_signal async_sig = K_POLL_SIGNAL_INITIALIZER(async_sig);
static struct k_poll_event async_evt =
	K_POLL_EVENT_INITIALIZER(K_POLL_TYPE_SIGNAL, K_POLL_MODE_NOTIFY_ONLY, &async_sig);

static struct k_poll_signal async_sig_spim = K_POLL_SIGNAL_INITIALIZER(async_sig_spim);
static struct k_poll_event async_evt_spim =
	K_POLL_EVENT_INITIALIZER(K_POLL_TYPE_SIGNAL, K_POLL_MODE_NOTIFY_ONLY, &async_sig_spim);
#endif /* CONFIG_SPI_ASYNC */

#define MEMORY_SECTION(node)                                                                       \
	COND_CODE_1(IS_ENABLED(CONFIG_PREALLOC_BUFFERS),                                           \
		    (COND_CODE_1(DT_NODE_HAS_PROP(node, memory_regions),                           \
				 (__attribute__((__section__(                                      \
				     LINKER_DT_NODE_REGION_NAME(DT_PHANDLE(node,                   \
									   memory_regions)))))),   \
				 ())),                                                             \
		    ())

static uint8_t spim_buffer[32] MEMORY_SECTION(DT_BUS(DT_NODELABEL(dut_spi_dt)));
static uint8_t spis_buffer[32] MEMORY_SECTION(DT_NODELABEL(dut_spis));

struct test_data {
	struct k_work_delayable test_work;
	struct k_sem sem;
	struct k_sem half_duplex_sem;
	int spim_alloc_idx;
	int spis_alloc_idx;
	struct spi_buf_set sets[4];
	struct spi_buf_set *mtx_set;
	struct spi_buf_set *mrx_set;
	struct spi_buf_set *stx_set;
	struct spi_buf_set *srx_set;
	struct spi_buf bufs[8];
	bool async;
};

static struct test_data tdata;

struct k_work_q spim_spis_work_q;

static K_KERNEL_STACK_DEFINE(spim_spis_work_q_stack,
			CONFIG_SPI_CONTROLLER_PERIPHERAL_WORKQUEUE_STACK_SIZE);

/* Allocate buffer from spim or spis space. */
static uint8_t *buf_alloc(size_t len, bool spim)
{
	int *idx = spim ? &tdata.spim_alloc_idx : &tdata.spis_alloc_idx;
	uint8_t *buf = spim ? spim_buffer : spis_buffer;
	size_t total = spim ? sizeof(spim_buffer) : sizeof(spis_buffer);
	uint8_t *rv;

	if (*idx + len > total) {
		zassert_false(true);

		return NULL;
	}

	rv = &buf[*idx];
	*idx += len;

	return rv;
}

static void work_handler(struct k_work *work)
{
	struct k_work_delayable *dwork = k_work_delayable_from_work(work);
	struct test_data *td = CONTAINER_OF(dwork, struct test_data, test_work);
	int rv;

#if CONFIG_TEST_INCORRECT_SCK_STATE && DT_NODE_HAS_PROP(DT_PATH(zephyr_user), sck_gpios)
	gpio_pin_set_dt(&sck, CONFIG_TESTED_SPI_MODE > 1 ? 0 : 1);
#endif

	if (spim.config.operation & SPI_HALF_DUPLEX) {
		if (!IS_ENABLED(CONFIG_TEST_SPI_NO_HOLD_ON_CS)) {
			spim.config.operation |= SPI_HOLD_ON_CS;
		}

		rv = spi_write_dt(&spim, td->mtx_set);
		spim.config.operation &= ~SPI_HOLD_ON_CS;
		zassert_equal(rv, 0);

		rv = k_sem_take(&td->half_duplex_sem, K_MSEC(1));
		if (rv) {
			return;
		}

		rv = spi_read_dt(&spim, td->mrx_set);

		if (rv == 0) {
			k_sem_give(&td->sem);
		}
	} else if (!td->async) {
		rv = spi_transceive_dt(&spim, td->mtx_set, td->mrx_set);
		if (rv == 0) {
			k_sem_give(&td->sem);
		}
	} else {
#ifdef CONFIG_SPI_ASYNC
		rv = spi_transceive_signal(spim.bus, &spim.config, td->mtx_set, td->mrx_set,
				&async_sig_spim);
		zassert_equal(rv, 0);

		rv = k_poll(&async_evt_spim, 1, K_MSEC(200));
		zassert_false(rv, "one or more events are not ready");

		rv = async_evt_spim.signal->result;
		zassert_equal(rv, 0);

		/* Reinitializing for next call */
		async_evt_spim.signal->signaled = 0U;
		async_evt_spim.state = K_POLL_STATE_NOT_READY;

		k_sem_give(&td->sem);
#endif /* CONFIG_SPI_ASYNC */
	}
}

/** Copies data from buffers in the set to a single buffer which makes it easier
 * to compare transmitted and received data.
 *
 * @param buf Output buffer.
 * @param len Buffer length.
 * @param set Set of buffers.
 *
 * @return Number of bytes copied.
 */
static int cpy_data(uint8_t *buf, size_t len, struct spi_buf_set *set)
{
	int idx = 0;

	for (size_t i = 0; i < set->count; i++) {
		size_t l = set->buffers[i].len;

		if (len - idx >= l) {
			memcpy(&buf[idx], set->buffers[i].buf, l);
			idx += l;
		} else {
			return -1;
		}
	}

	return idx;
}

/** Compare two sets.
 *
 * @param tx_set TX set.
 * @param rx_set RX set.
 * @param same_size True if it is expected to have the same amount of data in both sets.
 *
 * @return 0 if data is the same and other value indicate that check failed.
 */
static int check_buffers(struct spi_buf_set *tx_set, struct spi_buf_set *rx_set, bool same_size)
{
	static uint8_t tx_data[256];
	static uint8_t rx_data[256];
	int rx_len;
	int tx_len;

	if (!tx_set || !rx_set) {
		return 0;
	}

	rx_len = cpy_data(rx_data, sizeof(rx_data), rx_set);
	tx_len = cpy_data(tx_data, sizeof(tx_data), tx_set);
	if (same_size && (rx_len != tx_len)) {
		return -1;
	}

	return memcmp(tx_data, rx_data, rx_len);
}

/** Calculate expected number of received bytes by the SPI peripheral.
 *
 * It is used to check if SPI API call for peripheral SPI device returns correct value.
 * @param tx_set TX set.
 * @param rx_set RX set.
 *
 * @return Expected amount of received bytes.
 */
static int peripheral_rx_len(struct spi_buf_set *tx_set, struct spi_buf_set *rx_set)
{
	size_t tx_len = 0;
	size_t rx_len = 0;

	if (!tx_set || !rx_set) {
		return 0;
	}

	for (size_t i = 0; i < tx_set->count; i++) {
		tx_len += tx_set->buffers[i].len;
	}

	for (size_t i = 0; i < rx_set->count; i++) {
		rx_len += rx_set->buffers[i].len;
	}

	return MIN(rx_len, tx_len);
}

/** Generic function which runs the test with sets prepared in the test data structure. */
static void run_test(bool m_same_size, bool s_same_size, bool async)
{
	int rv;
	int periph_rv;
	int srx_len;

	if (spim.config.operation & SPI_HALF_DUPLEX) {
		ztest_test_skip();
		return;
	}

	tdata.async = async;
	rv = k_work_schedule_for_queue(&spim_spis_work_q, &tdata.test_work, K_MSEC(10));
	zassert_equal(rv, 1);

	if (!IS_ENABLED(CONFIG_SPI_ASYNC) || !async) {
		periph_rv = spi_transceive(spis_dev, &spis_config, tdata.stx_set, tdata.srx_set);
		if (periph_rv == -ENOTSUP) {
			/* DMA-enabled STM32 builds must accept these transfers. */
			if (IS_ENABLED(CONFIG_SPI_STM32_DMA)) {
				zassert_ok(periph_rv);
				return;
			}
			ztest_test_skip();
			return;
		}
	} else {
#ifdef CONFIG_SPI_ASYNC
		rv = spi_transceive_signal(spis_dev, &spis_config, tdata.stx_set, tdata.srx_set,
					   &async_sig);
		if (rv == -ENOTSUP) {
			if (IS_ENABLED(CONFIG_SPI_STM32_DMA)) {
				zassert_ok(rv);
				return;
			}
			ztest_test_skip();
			return;
		}
		zassert_equal(rv, 0);

		/* Transfer not finished yet */
		rv = k_sem_take(&tdata.sem, K_NO_WAIT);
		zassert_equal(rv, -EBUSY);

		rv = k_poll(&async_evt, 1, K_MSEC(200));
		zassert_false(rv, "one or more events are not ready");

		periph_rv = async_evt.signal->result;

		/* Reinitializing for next call */
		async_evt.signal->signaled = 0U;
		async_evt.state = K_POLL_STATE_NOT_READY;
#endif /* CONFIG_SPI_ASYNC */
	}

	rv = k_sem_take(&tdata.sem, K_MSEC(100));
	zassert_equal(rv, 0);

	srx_len = peripheral_rx_len(tdata.mtx_set, tdata.srx_set);

	zassert_equal(periph_rv, srx_len, "Got: %d but expected:%d", periph_rv, srx_len);

	rv = check_buffers(tdata.mtx_set, tdata.srx_set, m_same_size);
	zassert_equal(rv, 0);

	rv = check_buffers(tdata.stx_set, tdata.mrx_set, s_same_size);
	TC_PRINT("stx check same size? %d is %d\n", s_same_size, rv);
	zassert_equal(rv, 0);
}

/** Basic test where SPI controller and SPI peripheral have RX and TX sets which contains only one
 *  same size buffer.
 */
static void test_basic(bool async)
{
	size_t len = 16;

	for (int i = 0; i < 4; i++) {
		tdata.bufs[i].buf = buf_alloc(len, i < 2);
		tdata.bufs[i].len = len;
		tdata.sets[i].buffers = &tdata.bufs[i];
		tdata.sets[i].count = 1;
	}

	tdata.mtx_set = &tdata.sets[0];
	tdata.mrx_set = &tdata.sets[1];
	tdata.stx_set = &tdata.sets[2];
	tdata.srx_set = &tdata.sets[3];

	run_test(true, true, async);
}

ZTEST(spi_controller_peripheral, test_basic)
{
	test_basic(false);
}

#ifdef CONFIG_SPI_ASYNC
ZTEST(spi_controller_peripheral, test_basic_async)
{
	test_basic(true);
}
#endif /* CONFIG_SPI_ASYNC */

/** Basic test with zero length buffers.
 */
void test_basic_zero_len(bool async)
{
	size_t len = 8;

	/* SPIM */
	tdata.bufs[0].buf = buf_alloc(len, true);
	tdata.bufs[0].len = len;
	tdata.bufs[1].buf = buf_alloc(len, true);
	/* Intentionally len was set to 0 - second buffer "is empty". */
	tdata.bufs[1].len = 0;
	tdata.sets[0].buffers = &tdata.bufs[0];
	tdata.sets[0].count = 2;
	tdata.mtx_set = &tdata.sets[0];

	tdata.bufs[2].buf = buf_alloc(len, true);
	tdata.bufs[2].len = len;
	tdata.bufs[3].buf = buf_alloc(len, true);
	/* Intentionally len was set to 0 - second buffer "is empty". */
	tdata.bufs[3].len = 0;
	tdata.sets[1].buffers = &tdata.bufs[2];
	tdata.sets[1].count = 2;
	tdata.mrx_set = &tdata.sets[1];

	/* SPIS */
	tdata.bufs[4].buf = buf_alloc(len, false);
	tdata.bufs[4].len = len;
	tdata.sets[2].buffers = &tdata.bufs[4];
	tdata.sets[2].count = 1;
	tdata.stx_set = &tdata.sets[2];

	tdata.bufs[6].buf = buf_alloc(len, false);
	tdata.bufs[6].len = len;
	tdata.sets[3].buffers = &tdata.bufs[6];
	tdata.sets[3].count = 1;
	tdata.srx_set = &tdata.sets[3];

	run_test(true, true, async);
}

ZTEST(spi_controller_peripheral, test_basic_zero_len)
{
	test_basic_zero_len(false);
}

#ifdef CONFIG_SPI_ASYNC
ZTEST(spi_controller_peripheral, test_basic_zero_len_async)
{
	test_basic_zero_len(true);
}
#endif /* CONFIG_SPI_ASYNC */

/** Setup a transfer where RX buffer on SPI controller and SPI peripheral are
 *  shorter than TX buffers. RX buffers shall contain beginning of TX data
 *  and last TX bytes that did not fit in the RX buffers shall be lost.
 */
static void test_short_rx(bool async)
{
	size_t len = 16;

	tdata.bufs[0].buf = buf_alloc(len, true);
	tdata.bufs[0].len = len;
	tdata.bufs[1].buf = buf_alloc(len, true);
	tdata.bufs[1].len = len - 3; /* RX buffer */
	tdata.bufs[2].buf = buf_alloc(len, false);
	tdata.bufs[2].len = len;
	tdata.bufs[3].buf = buf_alloc(len, false);
	tdata.bufs[3].len = len - 4; /* RX buffer */

	for (int i = 0; i < 4; i++) {
		tdata.sets[i].buffers = &tdata.bufs[i];
		tdata.sets[i].count = 1;
	}

	tdata.mtx_set = &tdata.sets[0];
	tdata.mrx_set = &tdata.sets[1];
	tdata.stx_set = &tdata.sets[2];
	tdata.srx_set = &tdata.sets[3];

	run_test(false, false, async);
}

ZTEST(spi_controller_peripheral, test_short_rx)
{
	test_short_rx(false);
}

#ifdef CONFIG_SPI_ASYNC
ZTEST(spi_controller_peripheral, test_short_rx_async)
{
	test_short_rx(true);
}
#endif /* CONFIG_SPI_ASYNC */

/** Test where only controller transmits. */
static void test_only_tx(bool async)
{
	size_t len = 16;

	/* MTX buffer */
	tdata.bufs[0].buf = buf_alloc(len, true);
	tdata.bufs[0].len = len;
	tdata.sets[0].buffers = &tdata.bufs[0];
	tdata.sets[0].count = 1;
	tdata.mtx_set = &tdata.sets[0];
	tdata.mrx_set = NULL;

	/* STX buffer */
	tdata.bufs[1].buf = buf_alloc(len, false);
	tdata.bufs[1].len = len;
	tdata.sets[1].buffers = &tdata.bufs[1];
	tdata.sets[1].count = 1;
	tdata.srx_set = &tdata.sets[1];
	tdata.stx_set = NULL;

	run_test(true, true, async);
}

ZTEST(spi_controller_peripheral, test_only_tx)
{
	test_only_tx(false);
}

#ifdef CONFIG_SPI_ASYNC
ZTEST(spi_controller_peripheral, test_only_tx_async)
{
	test_only_tx(true);
}
#endif /* CONFIG_SPI_ASYNC */

/** Test where only SPI controller transmits and SPI peripheral receives in chunks. */
static void test_only_tx_in_chunks(bool async)
{
	size_t len1 = 7;
	size_t len2 = 8;

	/* MTX buffer */
	tdata.bufs[0].buf = buf_alloc(len1 + len2, true);
	tdata.bufs[0].len = len1 + len2;
	tdata.sets[0].buffers = &tdata.bufs[0];
	tdata.sets[0].count = 1;
	tdata.mtx_set = &tdata.sets[0];
	tdata.mrx_set = NULL;

	/* STX buffer */
	tdata.bufs[1].buf = buf_alloc(len1, false);
	tdata.bufs[1].len = len1;
	tdata.bufs[2].buf = buf_alloc(len2, false);
	tdata.bufs[2].len = len2;
	tdata.sets[1].buffers = &tdata.bufs[1];
	tdata.sets[1].count = 2;
	tdata.srx_set = &tdata.sets[1];
	tdata.stx_set = NULL;

	run_test(true, true, async);
}

ZTEST(spi_controller_peripheral, test_only_tx_in_chunks)
{
	test_only_tx_in_chunks(false);
}

#ifdef CONFIG_SPI_ASYNC
ZTEST(spi_controller_peripheral, test_only_tx_in_chunks_async)
{
	test_only_tx_in_chunks(true);
}
#endif /* CONFIG_SPI_ASYNC */

/** Test where only SPI peripheral transmits. */
static void test_only_rx(bool async)
{
	size_t len = 16;

	/* MTX buffer */
	tdata.bufs[0].buf = buf_alloc(len, true);
	tdata.bufs[0].len = len;
	tdata.sets[0].buffers = &tdata.bufs[0];
	tdata.sets[0].count = 1;
	tdata.mrx_set = &tdata.sets[0];
	tdata.mtx_set = NULL;

	/* STX buffer */
	tdata.bufs[1].buf = buf_alloc(len, false);
	tdata.bufs[1].len = len;
	tdata.sets[1].buffers = &tdata.bufs[1];
	tdata.sets[1].count = 1;
	tdata.stx_set = &tdata.sets[1];
	tdata.srx_set = NULL;

	run_test(true, true, async);
}

ZTEST(spi_controller_peripheral, test_only_rx)
{
	test_only_rx(false);
}

#ifdef CONFIG_SPI_ASYNC
ZTEST(spi_controller_peripheral, test_only_rx_async)
{
	test_only_rx(true);
}
#endif /* CONFIG_SPI_ASYNC */

/** Test where only SPI peripheral transmits in chunks. */
static void test_only_rx_in_chunks(bool async)
{
	size_t len1 = 7;
	size_t len2 = 9;

	/* MTX buffer */
	tdata.bufs[0].buf = buf_alloc(len1 + len2, true);
	tdata.bufs[0].len = len1 + len2;
	tdata.sets[0].buffers = &tdata.bufs[0];
	tdata.sets[0].count = 1;
	tdata.mrx_set = &tdata.sets[0];
	tdata.mtx_set = NULL;

	/* STX buffer */
	tdata.bufs[1].buf = buf_alloc(len1, false);
	tdata.bufs[1].len = len1;
	tdata.bufs[2].buf = buf_alloc(len2, false);
	tdata.bufs[2].len = len2;
	tdata.sets[1].buffers = &tdata.bufs[1];
	tdata.sets[1].count = 2;
	tdata.stx_set = &tdata.sets[1];
	tdata.srx_set = NULL;

	run_test(true, true, async);
}

ZTEST(spi_controller_peripheral, test_only_rx_in_chunks)
{
	test_only_rx_in_chunks(false);
}

#ifdef CONFIG_SPI_ASYNC
ZTEST(spi_controller_peripheral, test_only_rx_in_chunks_async)
{
	test_only_rx_in_chunks(true);
}
#endif /* CONFIG_SPI_ASYNC */

static void run_half_duplex_test(int len)
{
	int rv;
	int periph_rv;
	struct spi_config spis_half_duplex_config = spis_config;

	if (!(spim.config.operation & SPI_HALF_DUPLEX)) {
		ztest_test_skip();
		return;
	}

	spis_half_duplex_config.operation |= SPI_HALF_DUPLEX;

	if (!IS_ENABLED(CONFIG_TEST_SPI_NO_HOLD_ON_CS)) {
		spim.config.operation |= SPI_HOLD_ON_CS;
	}

	tdata.async = false;
	rv = k_work_schedule_for_queue(&spim_spis_work_q, &tdata.test_work, K_MSEC(10));
	zassert_equal(rv, 1);

	periph_rv = spi_read(spis_dev, &spis_half_duplex_config, tdata.srx_set);

	TC_PRINT("Read %d\n", periph_rv);

	if (periph_rv == -ENOTSUP) {
		ztest_test_skip();
		return;
	}

	zassert_equal(periph_rv, len);

	k_sem_give(&tdata.half_duplex_sem);

	TC_PRINT("WRITING!\n");

	periph_rv = spi_write(spis_dev, &spis_half_duplex_config, tdata.stx_set);

	TC_PRINT("Write %d\n", periph_rv);

	if (periph_rv == -ENOTSUP) {
		ztest_test_skip();
		return;
	}

	rv = k_sem_take(&tdata.sem, K_MSEC(100));
	zassert_equal(rv, 0);

	zassert_equal(periph_rv, 0);

	rv = check_buffers(tdata.mtx_set, tdata.srx_set, true);
	zassert_equal(rv, 0);

	rv = check_buffers(tdata.stx_set, tdata.mrx_set, true);
	zassert_equal(rv, 0);

}

ZTEST(spi_controller_peripheral, test_half_duplex)
{
	size_t len = 16;

	for (int i = 0; i < 4; i++) {
		tdata.bufs[i].buf = buf_alloc(len, i < 2);
		tdata.bufs[i].len = len;
		tdata.sets[i].buffers = &tdata.bufs[i];
		tdata.sets[i].count = 1;
	}

	tdata.mtx_set = &tdata.sets[0];
	tdata.mrx_set = &tdata.sets[1];
	tdata.stx_set = &tdata.sets[2];
	tdata.srx_set = &tdata.sets[3];

	run_half_duplex_test(len);
}

static void setup_split_buffer(uint8_t len)
{
	tdata.bufs[0].buf = buf_alloc(len / 2, true);
	tdata.bufs[0].len = len / 2;
	tdata.bufs[1].buf = buf_alloc(len / 2, true);
	tdata.bufs[1].len = len / 2;
	tdata.bufs[2].buf = buf_alloc(len, true);
	tdata.bufs[2].len = len;
	tdata.bufs[3].buf = buf_alloc(len, false);
	tdata.bufs[3].len = len;
	tdata.bufs[4].buf = buf_alloc(len, false);
	tdata.bufs[4].len = len;

	tdata.sets[0].buffers = &tdata.bufs[0];
	tdata.sets[0].count = 2;

	for (int i = 1; i < 4; i++) {
		tdata.sets[i].buffers = &tdata.bufs[i+1];
		tdata.sets[i].count = 1;
	}
}

ZTEST(spi_controller_peripheral, test_half_duplex_split_controller_tx_buffers)
{
	size_t len = 16;

	setup_split_buffer(len);

	tdata.mtx_set = &tdata.sets[0];
	tdata.mrx_set = &tdata.sets[1];
	tdata.stx_set = &tdata.sets[2];
	tdata.srx_set = &tdata.sets[3];

	run_half_duplex_test(len);
}

ZTEST(spi_controller_peripheral, test_half_duplex_split_controller_rx_buffers)
{
	size_t len = 16;

	setup_split_buffer(len);

	tdata.mtx_set = &tdata.sets[1];
	tdata.mrx_set = &tdata.sets[0];
	tdata.stx_set = &tdata.sets[2];
	tdata.srx_set = &tdata.sets[3];

	run_half_duplex_test(len);
}


ZTEST(spi_controller_peripheral, test_half_duplex_split_peripheral_tx_buffers)
{
	size_t len = 16;

	setup_split_buffer(len);

	tdata.mtx_set = &tdata.sets[1];
	tdata.mrx_set = &tdata.sets[2];
	tdata.stx_set = &tdata.sets[0];
	tdata.srx_set = &tdata.sets[3];

	run_half_duplex_test(len);
}

ZTEST(spi_controller_peripheral, test_half_duplex_split_peripheral_rx_buffers)
{
	size_t len = 16;

	setup_split_buffer(len);

	tdata.mtx_set = &tdata.sets[1];
	tdata.mrx_set = &tdata.sets[2];
	tdata.stx_set = &tdata.sets[3];
	tdata.srx_set = &tdata.sets[0];

	run_half_duplex_test(len);
}

static void before(void *not_used)
{
	ARG_UNUSED(not_used);

#if CONFIG_TEST_INCORRECT_SCK_STATE && !DT_NODE_HAS_PROP(DT_PATH(zephyr_user), sck_gpios)
	ztest_test_skip();
#endif

	memset(&tdata, 0, sizeof(tdata));
	for (size_t i = 0; i < sizeof(spim_buffer); i++) {
		spim_buffer[i] = (uint8_t)i;
	}
	for (size_t i = 0; i < sizeof(spis_buffer); i++) {
		spis_buffer[i] = (uint8_t)(i + 0x80);
	}

	k_work_init_delayable(&tdata.test_work, work_handler);
	k_sem_init(&tdata.sem, 0, 1);
	k_sem_init(&tdata.half_duplex_sem, 0, 1);
}

static void after(void *not_used)
{
	ARG_UNUSED(not_used);

	k_work_cancel_delayable(&tdata.test_work);
}

static void *suite_setup(void)
{
	struct k_work_queue_config cfg = {
		.name = "spim_spis_work",
		.no_yield = false,
	};

	k_work_queue_start(&spim_spis_work_q,
			   spim_spis_work_q_stack,
			   K_KERNEL_STACK_SIZEOF(spim_spis_work_q_stack),
			   CONFIG_SPI_CONTROLLER_PERIPHERAL_WORKQUEUE_PRIORITY, &cfg);

	return NULL;
}

ZTEST_SUITE(spi_controller_peripheral, NULL, suite_setup, before, after, NULL);
```

## src/extended_tests.c
```c
/*
 * Copyright (c) 2026 Conclusive Engineering Sp. z o.o.
 *
 * SPDX-License-Identifier: Apache-2.0
 */

#include <string.h>

#include <zephyr/drivers/spi.h>
#include <zephyr/kernel.h>
#include <zephyr/ztest.h>

#define SPI_MODE      (SPI_WORD_SET(8) | SPI_LINES_SINGLE | SPI_TRANSFER_LSB)
#define SPIM_OP       (SPI_OP_MODE_MASTER | SPI_MODE)
#define SPIS_OP       (SPI_OP_MODE_SLAVE | SPI_MODE)
#define TEST_BUF_SIZE 4096

static struct spi_dt_spec spim = SPI_DT_SPEC_GET(DT_NODELABEL(dut_spi_dt), SPIM_OP);
static const struct device *spis_dev = DEVICE_DT_GET(DT_NODELABEL(dut_spis));
static const struct spi_config spis_config = {
	.operation = SPIS_OP,
};

static struct k_poll_signal async_sig_ext = K_POLL_SIGNAL_INITIALIZER(async_sig_ext);
static struct k_poll_event async_evt_ext =
	K_POLL_EVENT_INITIALIZER(K_POLL_TYPE_SIGNAL, K_POLL_MODE_NOTIFY_ONLY, &async_sig_ext);

static struct k_poll_signal async_sig_spim = K_POLL_SIGNAL_INITIALIZER(async_sig_spim);
static struct k_poll_event async_evt_spim =
	K_POLL_EVENT_INITIALIZER(K_POLL_TYPE_SIGNAL, K_POLL_MODE_NOTIFY_ONLY, &async_sig_spim);

static uint8_t spim_buffer[TEST_BUF_SIZE];
static uint8_t spis_buffer[TEST_BUF_SIZE];

struct test_data {
	struct k_work_delayable test_work;
	struct k_sem sem;
	int spim_alloc_idx;
	int spis_alloc_idx;
	struct spi_buf_set sets[4];
	struct spi_buf_set *mtx_set;
	struct spi_buf_set *mrx_set;
	struct spi_buf_set *stx_set;
	struct spi_buf_set *srx_set;
	struct spi_buf bufs[8];
	bool async;
};

static struct test_data tdata;

static uint8_t *buf_alloc(size_t len, bool spim_space)
{
	int *idx = spim_space ? &tdata.spim_alloc_idx : &tdata.spis_alloc_idx;
	uint8_t *buf = spim_space ? spim_buffer : spis_buffer;

	zassert_true(*idx + len <= TEST_BUF_SIZE, "test buffer too small");

	uint8_t *rv = &buf[*idx];

	*idx += len;
	return rv;
}

static void work_handler(struct k_work *work)
{
	struct k_work_delayable *dwork = k_work_delayable_from_work(work);
	struct test_data *td = CONTAINER_OF(dwork, struct test_data, test_work);
	int rv;

	if (!td->async) {
		rv = spi_transceive_dt(&spim, td->mtx_set, td->mrx_set);
		zassert_equal(rv, 0);
		k_sem_give(&td->sem);
		return;
	}

	rv = spi_transceive_signal(spim.bus, &spim.config, td->mtx_set, td->mrx_set,
				   &async_sig_spim);
	zassert_equal(rv, 0);

	rv = k_poll(&async_evt_spim, 1, K_MSEC(500));
	zassert_equal(rv, 0);
	zassert_equal(async_evt_spim.signal->result, 0);

	async_evt_spim.signal->signaled = 0U;
	async_evt_spim.state = K_POLL_STATE_NOT_READY;
	k_sem_give(&td->sem);
}

static size_t copy_data(uint8_t *buf, size_t len, struct spi_buf_set *set)
{
	size_t idx = 0;

	for (size_t i = 0; i < set->count; i++) {
		size_t l = set->buffers[i].len;

		zassert_true(len - idx >= l, "copy buffer too small");
		memcpy(&buf[idx], set->buffers[i].buf, l);
		idx += l;
	}

	return idx;
}

static void check_buffers(struct spi_buf_set *tx_set, struct spi_buf_set *rx_set)
{
	static uint8_t tx_data[TEST_BUF_SIZE];
	static uint8_t rx_data[TEST_BUF_SIZE];
	size_t tx_len;
	size_t rx_len;

	tx_len = copy_data(tx_data, sizeof(tx_data), tx_set);
	rx_len = copy_data(rx_data, sizeof(rx_data), rx_set);

	zassert_mem_equal(tx_data, rx_data, MIN(tx_len, rx_len));
}

static size_t total_len(struct spi_buf_set *set)
{
	size_t len = 0;

	for (size_t i = 0; i < set->count; i++) {
		len += set->buffers[i].len;
	}

	return len;
}

static void run_test_ext(bool async)
{
	int rv;
	int periph_rv;
	size_t expected_periph_rv;

	async_evt_ext.signal->result = -1;
	async_evt_ext.signal->signaled = 0U;
	async_evt_ext.state = K_POLL_STATE_NOT_READY;

	tdata.async = async;
	rv = k_work_schedule(&tdata.test_work, K_MSEC(10));
	zassert_equal(rv, 1);

	if (!async) {
		periph_rv = spi_transceive(spis_dev, &spis_config, tdata.stx_set, tdata.srx_set);
	} else {
		rv = spi_transceive_signal(spis_dev, &spis_config, tdata.stx_set, tdata.srx_set,
					   &async_sig_ext);
		zassert_equal(rv, 0);

		rv = k_poll(&async_evt_ext, 1, K_MSEC(500));
		zassert_equal(rv, 0);
		periph_rv = async_evt_ext.signal->result;
	}

	rv = k_sem_take(&tdata.sem, K_MSEC(500));
	zassert_equal(rv, 0);

	expected_periph_rv = MIN(total_len(tdata.mtx_set), total_len(tdata.srx_set));
	zassert_equal(periph_rv, expected_periph_rv);

	check_buffers(tdata.mtx_set, tdata.srx_set);
	check_buffers(tdata.stx_set, tdata.mrx_set);
}

static void setup_slave_unequal_single_buffers(size_t master_len, size_t slave_tx_len,
					       size_t slave_rx_len)
{
	tdata.bufs[0].buf = buf_alloc(master_len, true);
	tdata.bufs[0].len = master_len;
	tdata.sets[0].buffers = &tdata.bufs[0];
	tdata.sets[0].count = 1;
	tdata.mtx_set = &tdata.sets[0];

	tdata.bufs[1].buf = buf_alloc(master_len, true);
	tdata.bufs[1].len = master_len;
	tdata.sets[1].buffers = &tdata.bufs[1];
	tdata.sets[1].count = 1;
	tdata.mrx_set = &tdata.sets[1];

	tdata.bufs[2].buf = buf_alloc(slave_tx_len, false);
	tdata.bufs[2].len = slave_tx_len;
	tdata.sets[2].buffers = &tdata.bufs[2];
	tdata.sets[2].count = 1;
	tdata.stx_set = &tdata.sets[2];

	tdata.bufs[3].buf = buf_alloc(slave_rx_len, false);
	tdata.bufs[3].len = slave_rx_len;
	tdata.sets[3].buffers = &tdata.bufs[3];
	tdata.sets[3].count = 1;
	tdata.srx_set = &tdata.sets[3];
}

static void setup_slave_tx_shorter_than_rx_chunked(void)
{
	setup_slave_unequal_single_buffers(16, 8, 16);

	tdata.bufs[2].buf = &spis_buffer[0];
	tdata.bufs[2].len = 5;
	tdata.bufs[3].buf = &spis_buffer[5];
	tdata.bufs[3].len = 3;
	tdata.sets[2].buffers = &tdata.bufs[2];
	tdata.sets[2].count = 2;

	tdata.bufs[4].buf = &spis_buffer[8];
	tdata.bufs[4].len = 16;
	tdata.sets[3].buffers = &tdata.bufs[4];
	tdata.sets[3].count = 1;
	tdata.srx_set = &tdata.sets[3];
}

static void setup_slave_tx_shorter_than_rx_asymmetric_chunks(void)
{
	setup_slave_unequal_single_buffers(16, 12, 16);

	tdata.bufs[2].buf = &spis_buffer[0];
	tdata.bufs[2].len = 5;
	tdata.bufs[3].buf = &spis_buffer[5];
	tdata.bufs[3].len = 7;
	tdata.sets[2].buffers = &tdata.bufs[2];
	tdata.sets[2].count = 2;

	tdata.bufs[4].buf = &spis_buffer[12];
	tdata.bufs[4].len = 9;
	tdata.bufs[5].buf = &spis_buffer[21];
	tdata.bufs[5].len = 7;
	tdata.sets[3].buffers = &tdata.bufs[4];
	tdata.sets[3].count = 2;
	tdata.srx_set = &tdata.sets[3];
}

static void prepare(void *not_used)
{
	ARG_UNUSED(not_used);

	memset(&tdata, 0, sizeof(tdata));
	for (size_t i = 0; i < sizeof(spim_buffer); i++) {
		spim_buffer[i] = (uint8_t)i;
	}
	for (size_t i = 0; i < sizeof(spis_buffer); i++) {
		spis_buffer[i] = (uint8_t)(i + 0x80);
	}

	k_work_init_delayable(&tdata.test_work, work_handler);
	k_sem_init(&tdata.sem, 0, 1);
}

static void test_slave_tx_shorter_than_rx(bool async)
{
	setup_slave_unequal_single_buffers(16, 8, 16);
	run_test_ext(async);
}

ZTEST(spi_controller_peripheral_ext, test_slave_tx_shorter_than_rx)
{
	test_slave_tx_shorter_than_rx(false);
}

ZTEST(spi_controller_peripheral_ext, test_slave_tx_shorter_than_rx_async)
{
	test_slave_tx_shorter_than_rx(true);
}

static void test_slave_rx_shorter_than_tx(bool async)
{
	setup_slave_unequal_single_buffers(16, 16, 8);
	run_test_ext(async);
}

ZTEST(spi_controller_peripheral_ext, test_slave_rx_shorter_than_tx)
{
	test_slave_rx_shorter_than_tx(false);
}

ZTEST(spi_controller_peripheral_ext, test_slave_rx_shorter_than_tx_async)
{
	test_slave_rx_shorter_than_tx(true);
}

static void test_slave_tx_shorter_than_rx_chunked(bool async)
{
	setup_slave_tx_shorter_than_rx_chunked();
	run_test_ext(async);
}

ZTEST(spi_controller_peripheral_ext, test_slave_tx_shorter_than_rx_chunked)
{
	test_slave_tx_shorter_than_rx_chunked(false);
}

ZTEST(spi_controller_peripheral_ext, test_slave_tx_shorter_than_rx_chunked_async)
{
	test_slave_tx_shorter_than_rx_chunked(true);
}

static void test_slave_tx_shorter_than_rx_asymmetric_chunks(bool async)
{
	setup_slave_tx_shorter_than_rx_asymmetric_chunks();
	run_test_ext(async);
}

ZTEST(spi_controller_peripheral_ext, test_slave_tx_shorter_than_rx_asymmetric_chunks)
{
	test_slave_tx_shorter_than_rx_asymmetric_chunks(false);
}

ZTEST(spi_controller_peripheral_ext, test_slave_tx_shorter_than_rx_asymmetric_chunks_async)
{
	test_slave_tx_shorter_than_rx_asymmetric_chunks(true);
}

ZTEST_SUITE(spi_controller_peripheral_ext, NULL, NULL, prepare, NULL, NULL);
```
