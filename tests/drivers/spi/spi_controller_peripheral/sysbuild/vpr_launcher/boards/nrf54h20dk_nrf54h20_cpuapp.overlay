/*
 * Copyright (c) 2024 Nordic Semiconductor ASA
 *
 * SPDX-License-Identifier: Apache-2.0
 */
#include "../../../boards/nrf54h20dk_nrf54h20_common.dtsi"

&spi130 {
	interrupt-parent = <&cpuppr_clic>;
	status = "reserved";
};

&dut_spis {
	interrupt-parent = <&cpuppr_clic>;
	status = "reserved";
};
