/*
 * Copyright (c) 2024 Nordic Semiconductor
 *
 * SPDX-License-Identifier: Apache-2.0
 */
#include "nrf54h20dk_nrf54h20_common.dtsi"

/* Increase dma region to fit dmm heap. */
&cpurad_dma_region {
	reg = <0x1e80 0x100>;
};

&spi130 {
	memory-regions = <&cpurad_dma_region>;
};

&dut_spis {
	memory-regions = <&cpurad_dma_region>;
};
