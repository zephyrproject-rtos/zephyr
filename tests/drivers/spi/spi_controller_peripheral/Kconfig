## tests/drivers/spi/spi_controller_peripheral/Kconfig
```kconfig
# Copyright (c) 2024 Nordic Semiconductor ASA
# SPDX-License-Identifier: Apache-2.0

config TESTED_SPI_MODE
	int "SPI mode"
	default 0
	help
		SPI mode value (clock polarity and phase) used in the test.
		0: CPOL 0 (Active high), CPHA 0 (leading)
		1: CPOL 0 (Active high), CPHA 1 (trailing)
		2: CPOL 1 (Active low), CPHA 0 (leading)
		3: CPOL 1 (Active low), CPHA 1 (trailing)

config PREALLOC_BUFFERS
	bool "Preallocate buffers"
	default y
	help
		Preallocate buffers used for transaction
		using `memory-region` property.

config SPI_CONTROLLER_PERIPHERAL_WORKQUEUE_STACK_SIZE
	int "Test workqueue stack size"
	default 1024
	help
	    Stack size for thread used to perform async API checks

config SPI_CONTROLLER_PERIPHERAL_WORKQUEUE_PRIORITY
	int "Test workqueue priority"
	default 10
	help
	    Priority for the work queue used for async testing

source "Kconfig.zephyr"
```

## tests/drivers/spi/spi_controller_peripheral/boards/ek_ra8d1_sci_b_spi.conf
```kconfig
# Copyright (c) 2025 Renesas Electronics Corporation
# SPDX-License-Identifier: Apache-2.0

CONFIG_SPI_ASYNC=y
CONFIG_SPI_RENESAS_RA_SCI_B_INTERRUPT=y
CONFIG_SPI_RENESAS_RA_SCI_B_DTC=y
```

## tests/drivers/spi/spi_controller_peripheral/boards/ek_ra8m1.conf
```kconfig
# Copyright (c) 2024 Renesas Electronics Corporation
# SPDX-License-Identifier: Apache-2.0

CONFIG_SPI_B_INTERRUPT=y
CONFIG_SPI_B_RA_DTC=y
```

## tests/drivers/spi/spi_controller_peripheral/boards/esp32s3_devkitc_procpu.conf
```kconfig
# Copyright (c) 2026 Espressif Systems (Shanghai) Co., Ltd.
# SPDX-License-Identifier: Apache-2.0

CONFIG_SPI_ESP32_INTERRUPT=y
CONFIG_ESP32_SPI_TARGET=y
CONFIG_PRINTK_SYNC=y
```

## tests/drivers/spi/spi_controller_peripheral/testcase.yaml
```yaml
common:
  depends_on: spi
  tags:
    - drivers
    - spi
  harness: ztest
  harness_config:
    fixture: gpio_spi_loopback
  platform_allow:
    - nrf52840dk/nrf52840
    - nrf54h20dk/nrf54h20/cpuapp
    - nrf54h20dk/nrf54h20/cpurad
    - nrf54h20dk/nrf54h20/cpuppr
    - nrf54l15dk/nrf54l15/cpuapp
    - nrf54lm20dk/nrf54lm20a/cpuapp
    - ophelia4ev/nrf54l15/cpuapp

tests:
  drivers.spi.spi_mode0:
    extra_configs:
      - CONFIG_TESTED_SPI_MODE=0
    extra_args: EXTRA_DTC_OVERLAY_FILE="boards/250khz.overlay"
    integration_platforms:
      - nrf52840dk/nrf52840

  drivers.spi.spi_mode1:
    extra_configs:
      - CONFIG_TESTED_SPI_MODE=1
    extra_args: EXTRA_DTC_OVERLAY_FILE="boards/500khz.overlay"
    integration_platforms:
      - nrf52840dk/nrf52840

  drivers.spi.spi_mode2:
    extra_configs:
      - CONFIG_TESTED_SPI_MODE=2
    extra_args: EXTRA_DTC_OVERLAY_FILE="boards/1mhz.overlay"
    integration_platforms:
      - nrf52840dk/nrf52840

  drivers.spi.spi_mode3:
    extra_configs:
      - CONFIG_TESTED_SPI_MODE=3
    extra_args: EXTRA_DTC_OVERLAY_FILE="boards/2mhz.overlay"
    integration_platforms:
      - nrf52840dk/nrf52840

  drivers.spi.spi_1M333333Hz:
    extra_configs:
      - CONFIG_TESTED_SPI_MODE=0
    extra_args: EXTRA_DTC_OVERLAY_FILE="boards/1m333333hz.overlay"
    integration_platforms:
      - nrf54l15dk/nrf54l15/cpuapp
      - nrf54h20dk/nrf54h20/cpuapp

  drivers.spi.spi_2M666666Hz:
    extra_configs:
      - CONFIG_TESTED_SPI_MODE=0
    extra_args: EXTRA_DTC_OVERLAY_FILE="boards/2m666666hz.overlay"
    integration_platforms:
      - nrf54l15dk/nrf54l15/cpuapp
      - nrf54h20dk/nrf54h20/cpuapp

  drivers.spi.spi_4MHz:
    extra_configs:
      - CONFIG_TESTED_SPI_MODE=2
    extra_args: EXTRA_DTC_OVERLAY_FILE="boards/4mhz.overlay"
    integration_platforms:
      - nrf52840dk/nrf52840

  drivers.spi.spi_8MHz:
    extra_configs:
      - CONFIG_TESTED_SPI_MODE=1
    extra_args: EXTRA_DTC_OVERLAY_FILE="boards/8mhz.overlay"
    integration_platforms:
      - nrf52840dk/nrf52840

  drivers.spi.spi_fast:
    extra_args: DTC_OVERLAY_FILE="boards/nrf54h20dk_nrf54h20_cpuapp_fast.overlay"
    platform_exclude:
      - nrf52840dk/nrf52840
      - nrf54h20dk/nrf54h20/cpurad
      - nrf54h20dk/nrf54h20/cpuppr
      - nrf54l15dk/nrf54l15/cpuapp
      - nrf54lm20dk/nrf54lm20a/cpuapp
      - ophelia4ev/nrf54l15/cpuapp

  drivers.spi.spis_fast:
    # SPIS120 instance occupies P6 which is not available on nRF54H20 DK pin headers
    # It is added only to check the compilation.
    build_only: true
    extra_args: DTC_OVERLAY_FILE="boards/nrf54h20dk_nrf54h20_cpuapp_fast_spis.overlay"
    platform_exclude:
      - nrf52840dk/nrf52840
      - nrf54h20dk/nrf54h20/cpurad
      - nrf54h20dk/nrf54h20/cpuppr
      - nrf54l15dk/nrf54l15/cpuapp
      - nrf54lm20dk/nrf54lm20a/cpuapp
      - ophelia4ev/nrf54l15/cpuapp

  drivers.spi.pm_runtime:
    extra_configs:
      - CONFIG_PM_DEVICE=y
      - CONFIG_PM_DEVICE_RUNTIME=y
    filter: CONFIG_SOC_FAMILY_NORDIC_NRF

  drivers.spi.spi_cross_domain:
    harness_config:
      fixture: spi_p1_p2_loopback
    extra_configs:
      - CONFIG_TESTED_SPI_MODE=0
      - CONFIG_NRF_SYS_EVENT=y
    extra_args: DTC_OVERLAY_FILE="boards/nrf54l15dk_nrf54l15_cpuapp_cross_domain.overlay"
    platform_exclude:
      - nrf52840dk/nrf52840
      - nrf54h20dk/nrf54h20/cpuapp
      - nrf54h20dk/nrf54h20/cpurad
      - nrf54h20dk/nrf54h20/cpuppr
      - ophelia4ev/nrf54l15/cpuapp

  drivers.spi.direct_xfer:
    extra_configs:
      - CONFIG_SPI_NRFX_RAM_BUFFER_SIZE=0
    filter: CONFIG_SOC_FAMILY_NORDIC_NRF

  drivers.spi.direct_xfer.no_prealloc:
    extra_configs:
      - CONFIG_SPI_NRFX_RAM_BUFFER_SIZE=0
      - CONFIG_PREALLOC_BUFFERS=n
    filter: CONFIG_SOC_FAMILY_NORDIC_NRF
```

## tests/drivers/spi/spi_error_cases/testcase.yaml
```yaml
common:
  depends_on: spi
  tags:
    - drivers
    - spi
  harness: ztest
  harness_config:
    fixture: gpio_spi_loopback
tests:
  drivers.spi.spi_error_cases:
    platform_allow:
      - nrf52840dk/nrf52840
      - nrf54l15dk/nrf54l15/cpuapp
      - nrf54h20dk/nrf54h20/cpuapp
      - nrf54l20pdk/nrf54l20/cpuapp
      - ophelia4ev/nrf54l15/cpuapp
    integration_platforms:
      - nrf52840dk/nrf52840
  drivers.spi.spi_error_cases.fast:
    extra_args: DTC_OVERLAY_FILE="boards/nrf54h20dk_nrf54h20_cpuapp_fast.overlay"
    platform_allow:
      - nrf54h20dk/nrf54h20/cpuapp
```

## tests/drivers/spi/spi_half_duplex/Kconfig
```kconfig
# Copyright (c) 2024 Nordic Semiconductor ASA
# Copyright (c) 2026 Bhavin Umatiya
# SPDX-License-Identifier: Apache-2.0

config TESTED_SPI_MODE
	bool "Tested SPI mode"
	default y
	help
	  This is used to identify that the SPI half-duplex is used in the test.

config PREALLOC_BUFFERS
	bool "Preallocate buffers"
	default y
	help
	  Preallocate buffers used for transceive. Hardware might require
	  buffers to be in a specific memory region (e.g. using
	  `memory-region` property).
```

## tests/drivers/spi/spi_half_duplex/testcase.yaml
```yaml
# SPDX-License-Identifier: Apache-2.0
# Copyright (c) 2026 Bhavin Umatiya

common:
  depends_on: spi
  tags:
    - drivers
    - spi
  harness: ztest
tests:
  drivers.spi.half_duplex:
    platform_allow:
      - nucleo_g474re
      - nucleo_h743zi
```

## tests/drivers/spi/spi_loopback/boards/96b_stm32_sensor_mez.conf
```kconfig
CONFIG_SPI_LOOPBACK_CS_GPIO=y
CONFIG_SPI_LOOPBACK_CS_CTRL_GPIO_DRV_NAME="GPIOE"
CONFIG_SPI_LOOPBACK_CS_CTRL_GPIO_PIN=11
CONFIG_SPI_LOOPBACK_DRV_NAME="SPI_4"
```

## tests/drivers/spi/spi_loopback/boards/am243x_evm_am2434_r5f0_0.conf
```kconfig
# Copyright (c) 2025 Texas Instruments
#
# SPDX-License-Identifier: Apache-2.0

CONFIG_SPI_LOOPBACK_MODE_LOOP=y
CONFIG_SPI_IDEAL_TRANSFER_DURATION_SCALING=25
```

## tests/drivers/spi/spi_loopback/boards/arty_a7_arm_designstart_m1.conf
```kconfig
#
# Copyright (c) 2020 Henrik Brix Andersen <henrik@brixandersen.dk>
#
# SPDX-License-Identifier: Apache-2.0
#

CONFIG_SPI_LOOPBACK_DRV_NAME="DAPLINK_SINGLE_SPI_0"
CONFIG_SPI_LOOPBACK_MODE_LOOP=y
```

## tests/drivers/spi/spi_loopback/boards/arty_a7_designstart_fpga_cortex_m1.conf
```kconfig
#
# Copyright (c) 2020 Henrik Brix Andersen <henrik@brixandersen.dk>
#
# SPDX-License-Identifier: Apache-2.0
#

CONFIG_SPI_LOOPBACK_MODE_LOOP=y
```
