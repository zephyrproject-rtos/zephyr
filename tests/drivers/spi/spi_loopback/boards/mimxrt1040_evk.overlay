/*
 * Copyright 2023 NXP
 *
 * SPDX-License-Identifier: Apache-2.0
 */

spi_loopback: &lpspi1 {
	transfer-delay = <100>;
	pcs-sck-delay = <100>;
	sck-pcs-delay = <100>;
};

#include "../spi-loopback.dtsi"
