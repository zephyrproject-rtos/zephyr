/*
 * Copyright 2024 NXP
 *
 * SPDX-License-Identifier: Apache-2.0
 */

/* To test this sample, connect
 * LPSPI0 MOSI(J6-6, P1_0/LPSPI0_SDO)     -->        LPSPI0 MISO(J6-5, P1_2/LPSPI0_SDI)
 */
spi_loopback: &lpspi0 {};

#include "../spi-loopback.dtsi"
