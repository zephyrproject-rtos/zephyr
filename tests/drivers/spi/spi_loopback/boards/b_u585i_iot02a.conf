## tests/drivers/spi/spi_loopback/boards/b_u585i_iot02a.conf
```kconfig
CONFIG_SPI_LOOPBACK_DRV_NAME="SPI_1"
CONFIG_SPI_ASYNC=y
CONFIG_SPI_LOOPBACK_MODE_LOOP=n
```

## tests/drivers/spi/spi_loopback/boards/cc1352r1_launchxl.conf
```kconfig
CONFIG_SPI_LOOPBACK_MODE_LOOP=y

#The driver does not yet have async support
CONFIG_SPI_ASYNC=n
```

## tests/drivers/spi/spi_loopback/boards/ek_ra8p1_r7ka8p1kflcac_cm85.conf
```kconfig
# Copyright (c) 2025 Renesas Electronics Corporation
# SPDX-License-Identifier: Apache-2.0

CONFIG_SPI_LOOPBACK_MODE_LOOP=y
CONFIG_SPI_B_INTERRUPT=y
CONFIG_SPI_B_RA_DTC=y
```

## tests/drivers/spi/spi_loopback/boards/fpb_ra4e1.conf
```kconfig
# Copyright (c) 2025 Renesas Electronics Corporation
# SPDX-License-Identifier: Apache-2.0

CONFIG_SPI_LOOPBACK_MODE_LOOP=y
CONFIG_SPI_INTERRUPT=y
CONFIG_SPI_RA_DTC=y
```

## tests/drivers/spi/spi_loopback/boards/frdm_k64f.conf
```kconfig
#
# Copyright (c) 2018, NXP
#
# SPDX-License-Identifier: Apache-2.0
#

CONFIG_SPI_LOOPBACK_DRV_NAME="SPI_0"
```

## tests/drivers/spi/spi_loopback/boards/frdm_kw41z.conf
```kconfig
#
# Copyright (c) 2018, NXP
#
# SPDX-License-Identifier: Apache-2.0
#

CONFIG_SPI_LOOPBACK_DRV_NAME="SPI_0"
CONFIG_SPI_LOOPBACK_SLOW_FREQ=5000
CONFIG_SPI_LOOPBACK_FAST_FREQ=160000
```

## tests/drivers/spi/spi_loopback/boards/frdm_mcxn236.conf
```kconfig
#
# Copyright 2024 NXP
#
# SPDX-License-Identifier: Apache-2.0
#
CONFIG_SPI_MCUX_LPSPI_DMA=n
CONFIG_SPI_ASYNC=n
```

## tests/drivers/spi/spi_loopback/boards/frdm_mcxn947_mcxn947_cpu0.conf
```kconfig
#
# Copyright 2024 NXP
#
# SPDX-License-Identifier: Apache-2.0
#
CONFIG_SPI_NXP_LPSPI_DMA=y
CONFIG_SPI_ASYNC=n
```

## tests/drivers/spi/spi_loopback/boards/gd32vf103c_starter.conf
```kconfig
# SPDX-License-Identifier: Apache-2.0
# Copyright (c) 2022 TOKITA Hiroshi <tokita.hiroshi@fujitsu.com>

CONFIG_GPIO=y
```

## tests/drivers/spi/spi_loopback/boards/imx8mp_evk_mimx8ml8_m7.conf
```kconfig
#
# Copyright (c) 2024 Basalte bv
#
# SPDX-License-Identifier: Apache-2.0

CONFIG_SPI_LOOPBACK_MODE_LOOP=y
```

## tests/drivers/spi/spi_loopback/boards/kit_pse84_ai_pse846gps2dbzc4a_m55.conf
```kconfig
# Copyright (c) 2026 Infineon Technologies AG,
# or an affiliate of Infineon Technologies AG.
#
# SPDX-License-Identifier: Apache-2.0

CONFIG_SPI_INFINEON_DMA=n
```

## tests/drivers/spi/spi_loopback/boards/kit_pse84_eval_pse846gps2dbzc4a_m33_ns.conf
```kconfig
# SPDX-FileCopyrightText: Copyright (c) 2026 Infineon Technologies AG,
# SPDX-FileCopyrightText: or an affiliate of Infineon Technologies AG. All rights reserved.
#
# SPDX-License-Identifier: Apache-2.0

CONFIG_SPI_INFINEON_DMA=y
```

## tests/drivers/spi/spi_loopback/boards/kit_pse84_eval_pse846gps2dbzc4a_m55.conf
```kconfig
# Copyright (c) 2025 Infineon Technologies AG,
# or an affiliate of Infineon Technologies AG.
#
# SPDX-License-Identifier: Apache-2.0

CONFIG_SPI_INFINEON_DMA=y
```

## tests/drivers/spi/spi_loopback/boards/lp_mspm0g3507.conf
```kconfig
# Copyright (c) 2026 Linumiz
# SPDX-License-Identifier: Apache-2.0

CONFIG_SPI_LOOPBACK_MODE_LOOP=y
CONFIG_SPI_ASYNC=n
CONFIG_GPIO=y
```

## tests/drivers/spi/spi_loopback/boards/lpcxpresso54114_m4.conf
```kconfig
#
# Copyright (c) 2019, NXP
#
# SPDX-License-Identifier: Apache-2.0
#

CONFIG_SPI_LOOPBACK_DRV_NAME="FLEXCOMM_5"
CONFIG_SPI_LOOPBACK_SLAVE_NUMBER=2
```

## tests/drivers/spi/spi_loopback/boards/lpcxpresso55s16.conf
```kconfig
#
# Copyright (c) 2020 Henrik Brix Andersen <henrik@brixandersen.dk>
#
# SPDX-License-Identifier: Apache-2.0
#

CONFIG_SPI_LOOPBACK_DRV_NAME="HS_LSPI"
CONFIG_SPI_LOOPBACK_SLAVE_NUMBER=1
CONFIG_SPI_LOOPBACK_SLOW_FREQ=5000
CONFIG_SPI_LOOPBACK_FAST_FREQ=160000
```

## tests/drivers/spi/spi_loopback/boards/lpcxpresso55s69_cpu0.conf
```kconfig
#
# Copyright (c) 2019, NXP
#
# SPDX-License-Identifier: Apache-2.0
#

CONFIG_SPI_LOOPBACK_DRV_NAME="HS_LSPI"
CONFIG_SPI_LOOPBACK_SLAVE_NUMBER=1
CONFIG_SPI_MCUX_FLEXCOMM_DMA=y
CONFIG_SPI_ASYNC=n
```

## tests/drivers/spi/spi_loopback/boards/max32675evkit.conf
```kconfig
#
# Copyright (c) 2024 Analog Devices, Inc.
#
# SPDX-License-Identifier: Apache-2.0
#
CONFIG_SPI_ASYNC=y
CONFIG_SPI_MAX32_INTERRUPT=y
```

## tests/drivers/spi/spi_loopback/boards/mcxw23_evk.conf
```kconfig
# Copyright 2025 NXP
# SPDX-License-Identifier: Apache-2.0

CONFIG_SPI_IDEAL_TRANSFER_DURATION_SCALING=9
```
