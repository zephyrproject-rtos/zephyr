/*
 * Copyright (c) 2022 Kumar Gala <galak@kernel.org>
 *
 * SPDX-License-Identifier: Apache-2.0
 */

spi_loopback: &sercom4 {
	cs-gpios = <&porta 3 GPIO_ACTIVE_LOW>;
};

#include "../spi-loopback.dtsi"
