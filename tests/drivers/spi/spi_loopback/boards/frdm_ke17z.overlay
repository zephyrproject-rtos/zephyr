/*
 * Copyright 2024 NXP
 *
 * SPDX-License-Identifier: Apache-2.0
 */

/* To test this sample, connect
 * LPSPI0 SIN(J2-10)  -->  LPSPI0 SOUT(J2-8)
 */

#define SPI_LOOPBACK_REG 1

spi_loopback: &lpspi0 {};

#include "../spi-loopback.dtsi"
