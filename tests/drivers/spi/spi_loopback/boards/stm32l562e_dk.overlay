/*
 * Copyright (c) 2021 STMicroelectronics
 *
 * SPDX-License-Identifier: Apache-2.0
 */

/* SPI bus pins are exposed in the Arduino Uno header.
 * SPI3 MISO  Arduino D12
 * SPI3 MOSI  Arduino D11
 * Short Pin PB4(D12) to PB5(D11) for the test to pass.
 */

spi_loopback: &spi3 {
	dmas = <&dmamux1 0 16 STM32_DMA_PERIPH_TX>,
	       <&dmamux1 7 15 STM32_DMA_PERIPH_RX>;
	dma-names = "tx", "rx";
};

&dma1 {
	status = "okay";
};

&dma2 {
	status = "okay";
};

&dmamux1 {
	status = "okay";
};

#include "../spi-loopback.dtsi"
