/*
 * Copyright (c) 2024 Analog Devices, Inc.
 *
 * SPDX-License-Identifier: Apache-2.0
 */

#define SPI_LOOPBACK_SLOW_HZ 128000
#define SPI_LOOPBACK_FAST_HZ 500000
#define SPI_LOOPBACK_REG 1

spi_loopback: &spi0 {};

#include "../spi-loopback.dtsi"
