## tests/drivers/spi/spi_loopback/boards/mimx8mm_phyboard_polis_mimx8mm6_m4.conf
```kconfig
#
# Copyright (C) 2024 PHYTEC Messtechnik GmbH
#
# SPDX-License-Identifier: Apache-2.0
#

CONFIG_SPI_LOOPBACK_MODE_LOOP=y
```

## tests/drivers/spi/spi_loopback/boards/mimxrt1015_evk.conf
```kconfig
#
# Copyright (c) 2021, NXP
#
# SPDX-License-Identifier: Apache-2.0
#

CONFIG_SPI_LOOPBACK_DRV_NAME="SPI_1"
```

## tests/drivers/spi/spi_loopback/boards/mimxrt1024_evk.conf
```kconfig
#
# Copyright (c) 2021, NXP
#
# SPDX-License-Identifier: Apache-2.0
#

CONFIG_SPI_LOOPBACK_DRV_NAME="SPI_1"
CONFIG_SPI_MCUX_LPSPI_DMA=y
CONFIG_SPI_ASYNC=n
```

## tests/drivers/spi/spi_loopback/boards/mimxrt1050_evk.conf
```kconfig
#
# Copyright (c) 2018, NXP
#
# SPDX-License-Identifier: Apache-2.0
#

CONFIG_SPI_LOOPBACK_DRV_NAME="SPI_1"
CONFIG_SPI_MCUX_LPSPI_DMA=y
CONFIG_SPI_ASYNC=n
```

## tests/drivers/spi/spi_loopback/boards/mimxrt1050_evk_mimxrt1052.conf
```kconfig
#
# Copyright (c) 2018, NXP
#
# SPDX-License-Identifier: Apache-2.0
#
CONFIG_SPI_MCUX_LPSPI_DMA=y
CONFIG_SPI_ASYNC=n
```

## tests/drivers/spi/spi_loopback/boards/mimxrt1170_evk_cm7.conf
```kconfig
#
# Copyright 2023 NXP
#
# SPDX-License-Identifier: Apache-2.0
#
CONFIG_SPI_MCUX_LPSPI_DMA=y
```

## tests/drivers/spi/spi_loopback/boards/mimxrt1180_evk_mimxrt1189_cm33.conf
```kconfig
#
# Copyright 2024 NXP
#
# SPDX-License-Identifier: Apache-2.0
#
CONFIG_SPI_MCUX_LPSPI_DMA=y
CONFIG_SPI_ASYNC=n
CONFIG_DMA_MCUX_USE_DTCM_FOR_DMA_DESCRIPTORS=n
```

## tests/drivers/spi/spi_loopback/boards/mimxrt595_evk_cm33.conf
```kconfig
#
# Copyright (c) 2020, NXP
#
# SPDX-License-Identifier: Apache-2.0
#

CONFIG_SPI_LOOPBACK_DRV_NAME="HS_LSPI_1"
CONFIG_SPI_MCUX_FLEXCOMM_DMA=y
CONFIG_SPI_ASYNC=n
```

## tests/drivers/spi/spi_loopback/boards/mimxrt595_evk_mimxrt595s_cm33.conf
```kconfig
#
# Copyright (c) 2020, NXP
#
# SPDX-License-Identifier: Apache-2.0
#
CONFIG_SPI_MCUX_FLEXCOMM_DMA=y
```

## tests/drivers/spi/spi_loopback/boards/mimxrt700_evk_mimxrt798s_cm33_cpu0.conf
```kconfig
#
# Copyright 2025 NXP
#
# SPDX-License-Identifier: Apache-2.0
#
CONFIG_NOCACHE_MEMORY=y
```

## tests/drivers/spi/spi_loopback/boards/nrf51_pca10028.conf
```kconfig
CONFIG_SPI_0=y
CONFIG_SPI_0_NRF_SPI=y

CONFIG_SPI_LOOPBACK_DRV_NAME="SPI_0"
CONFIG_SPI_LOOPBACK_CS_GPIO=y
CONFIG_SPI_LOOPBACK_CS_CTRL_GPIO_DRV_NAME="GPIO_0"
CONFIG_SPI_LOOPBACK_CS_CTRL_GPIO_PIN=28
```

## tests/drivers/spi/spi_loopback/boards/nrf52840_pca10056.conf
```kconfig
CONFIG_SPI_NRFX_RAM_BUFFER_SIZE=8
CONFIG_SPI_3=y
CONFIG_SPI_3_NRF_SPIM=y
CONFIG_SPI_3_NRF_RX_DELAY=1

CONFIG_SPI_LOOPBACK_DRV_NAME="SPI_3"
CONFIG_SPI_LOOPBACK_CS_GPIO=y
CONFIG_SPI_LOOPBACK_CS_CTRL_GPIO_DRV_NAME="GPIO_0"
CONFIG_SPI_LOOPBACK_CS_CTRL_GPIO_PIN=28
```

## tests/drivers/spi/spi_loopback/boards/nrf52_pca10040.conf
```kconfig
CONFIG_SPI_1=y
CONFIG_SPI_1_NRF_SPI=y

CONFIG_SPI_LOOPBACK_DRV_NAME="SPI_1"
CONFIG_SPI_LOOPBACK_CS_GPIO=y
CONFIG_SPI_LOOPBACK_CS_CTRL_GPIO_DRV_NAME="GPIO_0"
CONFIG_SPI_LOOPBACK_CS_CTRL_GPIO_PIN=28
```

## tests/drivers/spi/spi_loopback/boards/nrf54h20dk_nrf54h20_cpuflpr_xip.conf
```kconfig
# Copyright (c) 2026 Nordic Semiconductor ASA
#
# SPDX-License-Identifier: Apache-2.0
#

CONFIG_SPI_IDEAL_TRANSFER_DURATION_SCALING=15

# nRF54H20 FLPR has no GPIO interrupts available
CONFIG_GPIO_NRFX_INTERRUPT=n
CONFIG_NRFX_GPIOTE=y
```

## tests/drivers/spi/spi_loopback/boards/nrf9160dk_nrf9160.conf
```kconfig
CONFIG_SPI_LOOPBACK_DRV_NAME="SPI_3"
CONFIG_SPI_LOOPBACK_CS_GPIO=y
CONFIG_SPI_LOOPBACK_CS_CTRL_GPIO_DRV_NAME="GPIO_0"
CONFIG_SPI_LOOPBACK_CS_CTRL_GPIO_PIN=16
```

## tests/drivers/spi/spi_loopback/boards/nucleo_f091rc.conf
```kconfig
CONFIG_SPI_LOOPBACK_DRV_NAME="SPI_1"
CONFIG_SPI_LOOPBACK_SLOW_FREQ=550000
CONFIG_SPI_LOOPBACK_FAST_FREQ=2000000
```
