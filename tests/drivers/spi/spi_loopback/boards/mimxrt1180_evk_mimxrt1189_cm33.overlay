/*
 * Copyright 2024 NXP
 *
 * SPDX-License-Identifier: Apache-2.0
 */

/* To test this sample, connect J44.8 <-> J44.10 */

spi_loopback: &lpspi3 {
	transfer-delay = <100>;
	pcs-sck-delay = <100>;
	sck-pcs-delay = <100>;
};

#include "../spi-loopback.dtsi"
