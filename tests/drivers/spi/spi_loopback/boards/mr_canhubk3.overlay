/*
 * Copyright 2023 NXP
 *
 * SPDX-License-Identifier: Apache-2.0
 */

#define SPI_LOOPBACK_FAST_HZ 5000000

spi_loopback: &lpspi1 {
	status = "okay";
	/* DMA channels 10 and 12, muxed to LPSPI1 TX and RX */
	dmas = <&edma0 10 45>, <&edma0 12 46>;
	dma-names = "tx", "rx";
};

#include "../spi-loopback.dtsi"
