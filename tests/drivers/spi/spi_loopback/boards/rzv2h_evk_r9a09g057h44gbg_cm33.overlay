/*
 * Copyright (c) 2025 Renesas Electronics Corporation
 *
 * SPDX-License-Identifier: Apache-2.0
 */

#define SPI_LOOPBACK_FAST_HZ 2500000
#define SPI_LOOPBACK_REG 2

spi_loopback: &spi2 {
	dmas = <&dma0 6 RZ_DMA_PERIPH_TO_MEM>,
	       <&dma0 5 RZ_DMA_MEM_TO_PERIPH>;
	dma-names = "rx", "tx";

	pinctrl-0 = <&spi2_pins>;
	pinctrl-names = "default";
	status = "okay";
};

&dma0 {
	status = "okay";
	dma-buf-addr-alignment = <1>;
};

#include "../spi-loopback.dtsi"
