/*
 * Copyright (c) 2024 Analog Devices, Inc.
 *
 * SPDX-License-Identifier: Apache-2.0
 */

#define SPI_LOOPBACK_SLOW_HZ 125000
#define SPI_LOOPBACK_FAST_HZ 500000

spi_loopback: &spi1 {
	dmas = <&dma0 1 MAX32_DMA_SLOT_SPI1_TX>, <&dma0 2 MAX32_DMA_SLOT_SPI1_RX>;
	dma-names = "tx", "rx";
};

#include "../spi-loopback.dtsi"
