/*
 * Copyright (c) 2022 Kumar Gala <galak@kernel.org>
 *
 * SPDX-License-Identifier: Apache-2.0
 */

spi_loopback: &spi4 {
	cs-gpios = <&gpioe 11 GPIO_ACTIVE_LOW>;
};

#include "../spi-loopback.dtsi"
