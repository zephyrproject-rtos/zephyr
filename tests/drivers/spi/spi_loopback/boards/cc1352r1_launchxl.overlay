/*
 * Copyright (c) 2022 Kumar Gala <galak@kernel.org>
 *
 * SPDX-License-Identifier: Apache-2.0
 */

#define SPI_LOOPBACK_SLOW_HZ 2000000
#define SPI_LOOPBACK_FAST_HZ 3000000

spi_loopback: &spi0 {};

#include "../spi-loopback.dtsi"
