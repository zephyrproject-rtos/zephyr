/*
 * SPDX-FileCopyrightText: Copyright 2026 NXP
 *
 * SPDX-License-Identifier: Apache-2.0
 */

/* To run the loopback test, connect on the Arduino header:
 * SDO (J2-8, D11) <--> SDI (J2-10, D12).
 * This is the same jumper as the LPSPI0 loopback (frdm_mcxe31b.overlay).
 */

#define SPI_LOOPBACK_FAST_HZ 4000000

/* FlexIO reuses the Arduino SPI pads, so LPSPI0 must release them. */
&lpspi_0 {
	status = "disabled";
};

&flexio {
	spi_loopback: flexio_spi: flexio_spi {
		compatible = "nxp,flexio-spi";
		#address-cells = <1>;
		#size-cells = <0>;
		cs-gpios = <&gpioe_l 6 GPIO_ACTIVE_LOW>;
		sdo-pin = <13>;
		sdi-pin = <3>;
		sck-pin = <2>;
		pinctrl-0 = <&pinmux_flexio_spi>;
		pinctrl-names = "default";
		status = "okay";
	};
};

&gpioe_l {
	status = "okay";
};

#include "../spi-loopback.dtsi"
