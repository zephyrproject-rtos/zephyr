/*
 * Copyright (c) 2022 Microchip Technology Inc.
 *
 * SPDX-License-Identifier: Apache-2.0
 */

/ {
	aliases {
		spi0 = &qspi0;
	};
};

spi_loopback: &qspi0 {
	status = "okay";
	compatible = "microchip,xec-qmspi-ldma";
	clock-frequency = <12000000>;
};

#include "../spi-loopback.dtsi"
