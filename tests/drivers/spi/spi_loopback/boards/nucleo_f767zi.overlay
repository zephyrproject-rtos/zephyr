/*
 * Copyright (c) 2021 STMicroelectronics
 *
 * SPDX-License-Identifier: Apache-2.0
 */

/* Arduino Header pins: MOSI:D11, MISO:D12 */
spi_loopback: &spi1 {
	dmas = <&dma2 5 3 STM32_DMA_PERIPH_TX STM32_DMA_FIFO_FULL>,
	       <&dma2 2 3 STM32_DMA_PERIPH_RX STM32_DMA_FIFO_FULL>;
	dma-names = "tx", "rx";
};

&dma2 {
	status = "okay";
};

#include "../spi-loopback.dtsi"
