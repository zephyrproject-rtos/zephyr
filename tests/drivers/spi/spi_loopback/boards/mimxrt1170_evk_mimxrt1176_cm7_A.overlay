/*
 * Copyright 2023, 2025 NXP
 *
 * SPDX-License-Identifier: Apache-2.0
 */

/* Short J10-pin8 and J10-pin10. */
spi_loopback: &lpspi1 {
	dmas = <&edma0 0 36>, <&edma0 1 37>;
	dma-names = "rx", "tx";

	transfer-delay = <100>;
	pcs-sck-delay = <100>;
	sck-pcs-delay = <100>;
};

#include "../spi-loopback.dtsi"
