## tests/drivers/spi/spi_loopback/boards/nucleo_g071rb.conf
```kconfig
CONFIG_SPI_LOOPBACK_DRV_NAME="SPI_1"
CONFIG_SPI_STM32_INTERRUPT=y

CONFIG_SPI_ASYNC=n

CONFIG_SPI_LOOPBACK_MODE_LOOP=n
CONFIG_SPI_LOOPBACK_FAST_FREQ=16000000
```

## tests/drivers/spi/spi_loopback/boards/nucleo_g474re.conf
```kconfig
CONFIG_SPI_LOOPBACK_DRV_NAME="SPI_1"
CONFIG_SPI_STM32_INTERRUPT=y

# Reduce bus clock speed to be able to reach SPI_LOOPBACK_SLOW_FREQ = 500000
# with max prescaler 256
CONFIG_CLOCK_STM32_APB2_PRESCALER=2
```

## tests/drivers/spi/spi_loopback/boards/nucleo_h745zi_q_stm32h745xx_m7.conf
```kconfig
#
# Copyright (c) 2023 Graphcore Ltd, All rights reserved.
#
# SPDX-License-Identifier: Apache-2.0
#
CONFIG_NOCACHE_MEMORY=y
```

## tests/drivers/spi/spi_loopback/boards/nucleo_l152re.conf
```kconfig
CONFIG_SPI_LOOPBACK_DRV_NAME="SPI_1"

CONFIG_SPI_STM32_DMA=y
CONFIG_SPI_STM32_INTERRUPT=n

CONFIG_SPI_ASYNC=n

CONFIG_SPI_LOOPBACK_MODE_LOOP=n
```

## tests/drivers/spi/spi_loopback/boards/nucleo_wba55cg.conf
```kconfig
# SPDX-FileCopyrightText: Copyright The Zephyr Project Contributors
# SPDX-License-Identifier: Apache-2.0

CONFIG_SPI_IDEAL_TRANSFER_DURATION_SCALING=58
```

## tests/drivers/spi/spi_loopback/boards/olimex_esp32_evb.conf
```kconfig
# Loopback on UEXT connector
CONFIG_SPI_LOOPBACK_DRV_NAME="SPI_2"
CONFIG_SPI_ESP32_INTERRUPT=y
```

## tests/drivers/spi/spi_loopback/boards/qemu_cortex_m3.conf
```kconfig
#
# Copyright (c) 2018, Zilogic Systems
#
# SPDX-License-Identifier: Apache-2.0
#

CONFIG_SPI_LOOPBACK_DRV_NAME="SPI_0"
CONFIG_SPI_LOOPBACK_SLOW_FREQ=5000
CONFIG_SPI_LOOPBACK_FAST_FREQ=16500
```

## tests/drivers/spi/spi_loopback/boards/quark_se_c1000_devboard.conf
```kconfig
CONFIG_GPIO=y
CONFIG_SPI_DW=y
CONFIG_SPI_LOOPBACK_SLOW_FREQ=128000
CONFIG_SPI_LOOPBACK_SLAVE_NUMBER=1
```

## tests/drivers/spi/spi_loopback/boards/quick_feather.conf
```kconfig
CONFIG_SPI_LOOPBACK_DRV_NAME="SPI"
CONFIG_SPI_LOOPBACK_MODE_LOOP=y
CONFIG_SPI_LOOPBACK_FAST_FREQ=8000000
CONFIG_SPI_ASYNC=n
```

## tests/drivers/spi/spi_loopback/boards/rpi_pico.conf
```kconfig
#
# Copyright (c) 2022 TOKITA Hiroshi <tokita.hiroshi@fujitsu.com>
#
# SPDX-License-Identifier: Apache-2.0
#

CONFIG_SPI_ASYNC=y
CONFIG_SPI_PL022_INTERRUPT=y
```

## tests/drivers/spi/spi_loopback/boards/rtl87x2g_evb_a_rtl8762gku.conf
```kconfig
# Copyright (c) 2026, Realtek Semiconductor Corporation
# SPDX-License-Identifier: Apache-2.0

CONFIG_GPIO=y
CONFIG_SPI_BEE_DMA=y
CONFIG_SPI_BEE_DMA_BUF_SIZE=8192
CONFIG_SPI_BEE_DMA_BUF_COUNT=2
```

## tests/drivers/spi/spi_loopback/boards/rv32m1_vega_ri5cy.conf
```kconfig
#
# Copyright (c) 2018, NXP
#
# SPDX-License-Identifier: Apache-2.0
#

CONFIG_SPI_LOOPBACK_DRV_NAME="SPI_0"
CONFIG_SPI_LOOPBACK_SLAVE_NUMBER=2
```

## tests/drivers/spi/spi_loopback/boards/rzg3s_smarc_r9a08g045s33gbg_cm33.conf
```kconfig
CONFIG_SPI_ASYNC=y
CONFIG_SPI_RENESAS_RZ_RSPI_INTERRUPT=y
CONFIG_SPI_RENESAS_RZ_RSPI_DMAC=n
CONFIG_SPI_RTIO=n
CONFIG_SPI_LOOPBACK_MODE_LOOP=n
CONFIG_SPI_LARGE_BUFFER_SIZE=2048
CONFIG_SPI_IDEAL_TRANSFER_DURATION_SCALING=16
```

## tests/drivers/spi/spi_loopback/boards/stm32f3_disco.conf
```kconfig
# SPDX-FileCopyrightText: Copyright The Zephyr Project Contributors
# SPDX-License-Identifier: Apache-2.0

CONFIG_SPI_LOOPBACK_MODE_LOOP=y
CONFIG_SPI_IDEAL_TRANSFER_DURATION_SCALING=20
```
