/*
 * Copyright 2024 NXP
 *
 * SPDX-License-Identifier: Apache-2.0
 */

/*
 * This is a loopback setup for the frdm_mcxw72
 * To test this sample, connect J2.6 <-> J2.7
 */
spi_loopback: &lpspi1 {};

#include "../spi-loopback.dtsi"
