/*
 * Copyright 2025 NXP
 *
 * SPDX-License-Identifier: Apache-2.0
 */

/* To test this sample, connect
 * LPSPI1 MOSI(J2-8, LPSPI1_SOUT)     -->        LPSPI1 MISO(J2-10, LPSPI1_SIN)
 */
spi_loopback: &lpspi1 {};

#include "../spi-loopback.dtsi"
