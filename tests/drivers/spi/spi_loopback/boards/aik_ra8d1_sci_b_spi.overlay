/*
 * Copyright (c) 2026 Renesas Electronics Corporation
 *
 * SPDX-License-Identifier: Apache-2.0
 */

/**
 * To run this test on AIK-RA8D1 board on PMOD 1, set S4-1 to UART/SPI position.
 */

#define SPI_LOOPBACK_SLOW_HZ 2000000
#define SPI_LOOPBACK_FAST_HZ 3000000

spi_loopback: &pmod1_spi {
	status = "okay";
};

#include "../spi-loopback.dtsi"
