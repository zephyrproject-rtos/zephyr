/*
 * Copyright (c) 2025 Texas Instruments
 *
 * SPDX-License-Identifier: Apache-2.0
 */

#include <freq.h>

#define SPI_LOOPBACK_SLOW_HZ DT_FREQ_K(500)
#define SPI_LOOPBACK_FAST_HZ DT_FREQ_M(50)

spi_loopback: &main_mcspi0 {};

#include "../spi-loopback.dtsi"
