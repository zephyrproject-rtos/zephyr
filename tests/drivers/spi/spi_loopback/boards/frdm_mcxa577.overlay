/*
 * Copyright 2026 NXP
 *
 * SPDX-License-Identifier: Apache-2.0
 */

/* To test this sample, connect
 * LPSPI0 MOSI(J6-6, P4_4/LPSPI2_SDO)     -->        LPSPI0 MISO(J6-5, P4_5/LPSPI2_SDI)
 */
#define SPI_LOOPBACK_SLOW_HZ 6000000
#define SPI_LOOPBACK_FAST_HZ 12000000

spi_loopback: &lpspi2 {};

#include "../spi-loopback.dtsi"
