/*
 * Copyright 2026 NXP
 *
 * SPDX-License-Identifier: Apache-2.0
 */

/* To test this sample, connect J3-14 (LPSPI2_SOUT) <-> J3-16 (LPSPI2_SIN) */

spi_loopback: &lpspi2 {
	transfer-delay = <100>;
	pcs-sck-delay = <100>;
	sck-pcs-delay = <100>;
};

#include "../spi-loopback.dtsi"
