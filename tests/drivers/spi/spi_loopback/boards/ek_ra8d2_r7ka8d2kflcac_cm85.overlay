/*
 * Copyright (c) 2025 Renesas Electronics Corporation
 * SPDX-License-Identifier: Apache-2.0
 */

#define SPI_LOOPBACK_SLOW_HZ 2000000
#define SPI_LOOPBACK_FAST_HZ 3000000

spi_loopback: &spi1 {
	rx-dtc;
	tx-dtc;
	status = "okay";
};

#include "../spi-loopback.dtsi"
