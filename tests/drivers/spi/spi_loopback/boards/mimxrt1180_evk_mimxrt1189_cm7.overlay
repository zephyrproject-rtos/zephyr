/*
 * Copyright 2024 NXP
 *
 * SPDX-License-Identifier: Apache-2.0
 */

/* To test this sample, connect J44.8 <-> J44.10 */

#include <zephyr/dt-bindings/memory-attr/memory-attr-arm.h>

/ {
	chosen {
		zephyr,sram = &ocram1;
	};
};

&ocram1 {
	zephyr,memory-attr = <DT_MEM_ARM(ATTR_MPU_RAM_NOCACHE)>;
};

spi_loopback: &lpspi3 {
	transfer-delay = <100>;
	pcs-sck-delay = <100>;
	sck-pcs-delay = <100>;
};

#include "../spi-loopback.dtsi"
