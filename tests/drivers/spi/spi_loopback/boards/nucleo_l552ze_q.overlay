/*
 * Copyright (c) 2021 STMicroelectronics
 *
 * SPDX-License-Identifier: Apache-2.0
 */

spi_loopback: &spi1 {
	dmas = <&dmamux1 0 12 STM32_DMA_PERIPH_TX>,
	       <&dmamux1 7 11 STM32_DMA_PERIPH_RX>;
	dma-names = "tx", "rx";
};

&dma1 {
	status = "okay";
};

&dma2 {
	status = "okay";
};

&dmamux1 {
	status = "okay";
};

#include "../spi-loopback.dtsi"
