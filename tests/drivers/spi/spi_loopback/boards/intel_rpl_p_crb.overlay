/*
 * Copyright (c) 2023 Intel Corporation
 *
 * SPDX-License-Identifier: Apache-2.0
 */

/* External Loopback: Short MOSI & MISO  */

spi_loopback: &spi0 {
	pw,cs-mode = <0>;
	pw,cs-output = <0>;
	status = "okay";
};

#include "../spi-loopback.dtsi"
