/*
 * Copyright (c) 2025 Intel Corporation
 *
 * SPDX-License-Identifier: Apache-2.0
 */

/* External Loopback: Short MOSI (J7H4.3) & MISO (J7H4.5) */

&gpio_0_i {
	status = "okay";
};

spi_loopback: &spi0 {
	pw,cs-mode = <0>;
	pw,cs-output = <0>;
	status = "okay";
};

#include "../spi-loopback.dtsi"
