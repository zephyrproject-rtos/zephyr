/*
 * Copyright (c) 2020 Henrik Brix Andersen <henrik@brixandersen.dk>
 *
 * SPDX-License-Identifier: Apache-2.0
 */

spi_loopback: &daplink_single_spi0 {
	status = "okay";
};

#include "../spi-loopback.dtsi"
