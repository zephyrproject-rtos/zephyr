/*
 * Copyright (c) 2022 Nordic Semiconductor ASA
 *
 * SPDX-License-Identifier: Apache-2.0
 */

spi_loopback: &spi3 {
	overrun-character = <0x00>;
	cs-gpios = <&gpio0 16 GPIO_ACTIVE_LOW>;
	zephyr,pm-device-runtime-auto;
};

#include "../spi-loopback.dtsi"
