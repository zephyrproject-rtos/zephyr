/*
 * Copyright 2025 NXP
 *
 * SPDX-License-Identifier: Apache-2.0
 */

/* To test this sample, connect
 * LPSPI1 MOSI(J2-8, P3_8/LPSPI1_SDO)     -->        LPSPI0 MISO(J2-10, P3_9/LPSPI1_SDI)
 */
spi_loopback: &lpspi1 {};

#include "../spi-loopback.dtsi"
