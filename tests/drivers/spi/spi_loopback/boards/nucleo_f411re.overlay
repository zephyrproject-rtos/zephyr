/*
 * Copyright (c) 2020 Erwin Rol <erwin@erwinrol.com>
 *
 * SPDX-License-Identifier: Apache-2.0
 */

spi_loopback: &spi1 {
	dmas = <&dma2 5 3 0x28440 0x03>,
	       <&dma2 2 3 0x28480 0x03>;
	dma-names = "tx", "rx";
	status = "okay";
};

&dma2 {
	status = "okay";
};

#include "../spi-loopback.dtsi"
