/*
 * Copyright (c) 2025 Renesas Electronics Corporation
 * SPDX-License-Identifier: Apache-2.0
 */

#define SPI_LOOPBACK_SLOW_HZ 1000000
#define SPI_LOOPBACK_FAST_HZ 3000000

spi_loopback: &rspi0 {};

#include "../spi-loopback.dtsi"
