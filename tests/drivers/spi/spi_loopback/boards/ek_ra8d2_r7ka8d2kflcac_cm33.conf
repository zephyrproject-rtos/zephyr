## tests/drivers/spi/spi_loopback/boards/ek_ra8d2_r7ka8d2kflcac_cm33.conf
```kconfig
# Copyright (c) 2026 Renesas Electronics Corporation
# SPDX-License-Identifier: Apache-2.0

CONFIG_SPI_LOOPBACK_MODE_LOOP=y
```

## tests/drivers/spi/spi_loopback/boards/ek_ra8d2_r7ka8d2kflcac_cm85.conf
```kconfig
# Copyright (c) 2025 Renesas Electronics Corporation
# SPDX-License-Identifier: Apache-2.0

CONFIG_SPI_LOOPBACK_MODE_LOOP=y
```

## tests/drivers/spi/spi_loopback/boards/ek_ra8m2_r7ka8m2jflcac_cm85.conf
```kconfig
# Copyright (c) 2025 Renesas Electronics Corporation
# SPDX-License-Identifier: Apache-2.0

CONFIG_SPI_LOOPBACK_MODE_LOOP=y
CONFIG_SPI_INTERRUPT_DRIVEN=y
CONFIG_SPI_DMA=y
```

## tests/drivers/spi/spi_loopback/boards/frdm_kl25z.conf
```kconfig
# Copyright (c) 2026 Gabriel Ivo <gabriel.bozi@usp.br>
# SPDX-License-Identifier: Apache-2.0

CONFIG_SPI_ASYNC=n

CONFIG_SPI_LARGE_BUFFER_SIZE=512
CONFIG_SPI_IDEAL_TRANSFER_DURATION_SCALING=15
```

## tests/drivers/spi/spi_loopback/boards/frdm_mcxa287.conf
```kconfig
# SPDX-FileCopyrightText: Copyright 2026 NXP
# SPDX-License-Identifier: Apache-2.0

CONFIG_SPI_IDEAL_TRANSFER_DURATION_SCALING=12
```

## tests/drivers/spi/spi_loopback/boards/kit_psoc4_hvms_64k_lite.conf
```kconfig
CONFIG_SPI_ASYNC=n
CONFIG_SPI_LARGE_BUFFER_SIZE=4

CONFIG_ISR_STACK_SIZE=352
CONFIG_MAIN_STACK_SIZE=672

CONFIG_IDLE_STACK_SIZE=96

CONFIG_THREAD_MAX_NAME_LEN=12

CONFIG_SPI_LOG_LEVEL_OFF=y

CONFIG_ZTEST_STACK_SIZE=632

CONFIG_COMMON_LIBC_MALLOC_ARENA_SIZE=0
```

## tests/drivers/spi/spi_loopback/boards/kit_t2g_c2d6m_lite_cyt4dnjbzs_m7_0.conf
```kconfig
# SPDX-FileCopyrightText: Copyright (c) 2026 Linumiz
#
# SPDX-License-Identifier: Apache-2.0

CONFIG_SPI_INFINEON_DMA=y
CONFIG_MUX=y
```

## tests/drivers/spi/spi_loopback/boards/lp_mspm0g3519.conf
```kconfig
# Copyright (c) 2026 Texas Instruments
# SPDX-License-Identifier: Apache-2.0

CONFIG_SPI_LOOPBACK_MODE_LOOP=y
CONFIG_SPI_ASYNC=n
CONFIG_GPIO=y
```

## tests/drivers/spi/spi_loopback/boards/lp_mspm33c321a.conf
```kconfig
# Copyright (c) 2026 Texas Instruments Incorporated
# SPDX-License-Identifier: Apache-2.0

CONFIG_SPI_LOOPBACK_MODE_LOOP=y
CONFIG_SPI_ASYNC=n
CONFIG_GPIO=y
```

## tests/drivers/spi/spi_loopback/boards/lpcxpresso55s69_lpc55s69_cpu0.conf
```kconfig
#
# Copyright (c) 2019, NXP
#
# SPDX-License-Identifier: Apache-2.0
#
CONFIG_SPI_DMA=y
CONFIG_SPI_ASYNC=n
```

## tests/drivers/spi/spi_loopback/boards/max32651evkit.conf
```kconfig
#
# Copyright (c) 2026 Analog Devices, Inc.
#
# SPDX-License-Identifier: Apache-2.0
#
CONFIG_SPI_ASYNC=y
CONFIG_SPI_INTERRUPT_DRIVEN=y
```

## tests/drivers/spi/spi_loopback/boards/max32657evkit_max32657_ns.conf
```kconfig
#
# Copyright (c) 2024 Analog Devices, Inc.
#
# SPDX-License-Identifier: Apache-2.0
#
CONFIG_SPI_INTERRUPT_DRIVEN=y
```

## tests/drivers/spi/spi_loopback/boards/mimxrt685_evk_cm33.conf
```kconfig
#
# Copyright (c) 2020, NXP
#
# SPDX-License-Identifier: Apache-2.0
#
CONFIG_SPI_DMA=y
```

## tests/drivers/spi/spi_loopback/boards/rzt2m_rsk_r9a07g075m24gbg_cr520.conf
```kconfig
CONFIG_SPI_RTIO=n
CONFIG_SPI_LOOPBACK_MODE_LOOP=n
CONFIG_SPI_LARGE_BUFFER_SIZE=2048
```

## tests/drivers/spi/spim_rtio_loopback/Kconfig
```kconfig
# Copyright (c) 2026 Nordic Semiconductor ASA
# SPDX-License-Identifier: Apache-2.0

config TEST_SPI_MODE
	int "SPI mode"
	range 0 3
	default 0
	help
	  SPI mode (clock polarity and phase) used by both the SPIM and the SPIS.
	  0: CPOL 0, CPHA 0
	  1: CPOL 0, CPHA 1
	  2: CPOL 1, CPHA 0
	  3: CPOL 1, CPHA 1

source "Kconfig.zephyr"
```

## tests/drivers/timer/timer_core/Kconfig
```kconfig
# SPDX-FileCopyrightText: Copyright The Zephyr Project Contributors
# SPDX-License-Identifier: Apache-2.0

# The shape of hardware a scenario puts the core on. tests.yaml sets these;
# src/main.c turns them into the TIMER_CORE_* knobs a driver would state.

config TEST_COUNTER_WIDTH
	int "Width of the simulated counter, in bits"
	default 32

config TEST_ALARM_MAX_CYCLES
	hex "Furthest the simulated alarm reaches, or 0 for the counter's own span"
	default 0

config TEST_ALARM_MIN_CYCLES
	int "Nearest the simulated alarm can be armed, or 0 for no floor"
	default 0

choice TEST_BACKEND
	prompt "Backend under test"
	default TEST_BACKEND_COMPARE_ORDERED

config TEST_BACKEND_COMPARE_ORDERED
	bool "Comparator that fires on a value already passed"

config TEST_BACKEND_COMPARE_EXACT
	bool "Comparator that matches on equality only"

config TEST_BACKEND_RELOAD
	bool "One-shot relative reload"

endchoice

config TEST_COUNTER_NONATOMIC
	bool "Counter the driver synthesizes rather than reads in one go"

config TEST_COUNTER_NONMONOTONIC
	bool "Counter that can read behind a value already seen"

config TEST_RATE_FROM_DRIVER
	bool "Driver states a counter rate of its own"

source "Kconfig.zephyr"
```
