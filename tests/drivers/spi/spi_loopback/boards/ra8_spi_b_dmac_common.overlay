/*
 * Copyright (c) 2026 Renesas Electronics Corporation
 * SPDX-License-Identifier: Apache-2.0
 */

&dma0 {
	interrupts = <86 1>, <85 1>, <84 1>, <83 1>;
	interrupt-names = "ch0", "ch1", "ch2", "ch3";
	status = "okay";
};

&spi0 {
	/delete-property/ tx-dtc;
	/delete-property/ rx-dtc;
	dmas = <&dma0 0>, <&dma0 1>;
	dma-names = "tx", "rx";
};

&spi1 {
	/delete-property/ tx-dtc;
	/delete-property/ rx-dtc;
	dmas = <&dma0 2>, <&dma0 3>;
	dma-names = "tx", "rx";
};
