/*
 * Copyright 2024 NXP
 *
 * SPDX-License-Identifier: Apache-2.0
 */

/* To test this sample, connect
 * LPSPI3 MOSI(J2-8, P1_0/FC3_P0)     -->        LPSPI3 MISO(J2-10, P1_2/FC3_P2)
 */
spi_loopback: &flexcomm3_lpspi3 {};

#include "../spi-loopback.dtsi"
