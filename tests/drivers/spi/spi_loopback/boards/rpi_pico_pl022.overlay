/*
 * Copyright (c) 2023 TOKITA Hiroshi <tokita.hiroshi@fujitsu.com>
 *
 * SPDX-License-Identifier: Apache-2.0
 */

spi_loopback: &spi0 {
	cs-gpios = <&gpio0 17 GPIO_ACTIVE_LOW>;
};

#include "../spi-loopback.dtsi"
