/*
 * Copyright 2024-2025 NXP
 *
 * SPDX-License-Identifier: Apache-2.0
 */

/* Short MOSI and MISO externally using header J1 pins 2 and 4 */
spi_loopback: &flexcomm1 {};

#include "../spi-loopback.dtsi"
