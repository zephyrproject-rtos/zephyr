/*
 * Copyright (c) 2024 STMicroelectronics
 *
 * SPDX-License-Identifier: Apache-2.0
 */

spi_loopback: &spi5 {
	dmas = <&gpdma1 0 88 STM32_DMA_PERIPH_TX>,
	       <&gpdma1 1 87 STM32_DMA_PERIPH_RX>;
	dma-names = "tx", "rx";
};

&gpdma1 {
	status = "okay";
};

#include "../spi-loopback.dtsi"
