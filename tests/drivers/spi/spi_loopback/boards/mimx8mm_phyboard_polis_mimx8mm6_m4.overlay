/*
 * Copyright (c) 2024 PHYTEC Messtechnik GmbH
 *
 * SPDX-License-Identifier: Apache-2.0
 */

spi_loopback: &ecspi1 {
	status = "okay";
};

&gpio2 {
	status = "okay";
};

&gpio5 {
	status = "okay";
};

#include "../spi-loopback.dtsi"
