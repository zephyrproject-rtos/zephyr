/*
 * Copyright (c) 2021 Thomas Stranger
 *
 * SPDX-License-Identifier: Apache-2.0
 */

&spi1 {
	dmas = <&dmamux1 2 17 0x20440
		&dmamux1 1 16 0x20480>;
	dma-names = "tx", "rx";
};

&dma1 {
	status = "okay";
};

&dmamux1 {
	status = "okay";
};
