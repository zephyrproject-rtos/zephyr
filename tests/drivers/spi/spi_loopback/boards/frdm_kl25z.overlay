/*
 * Copyright (c) 2026 Gabriel Ivo <gabriel.bozi@usp.br>
 *
 * SPDX-License-Identifier: Apache-2.0
 */

/* To test this sample, connect:
 * spi0 MOSI (J1-11, PTC6) --> spi0 MISO (J1-1, PTC7)
 */

#define SPI_LOOPBACK_FAST_HZ 10000000

spi_loopback: &spi0 {};

#include "../spi-loopback.dtsi"
