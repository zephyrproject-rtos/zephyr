/*
 * Copyright 2023 NXP
 *
 * SPDX-License-Identifier: Apache-2.0
 */

/* Short P1.3 (SPI0/MISO) with P1.4 (SPI0/MOSI) */

#define SPI_LOOPBACK_FAST_HZ 9000000

spi_loopback: &lpspi0 {};

#include "../spi-loopback.dtsi"
