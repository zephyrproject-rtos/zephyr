## tests/drivers/spi/spi_loopback/boards/stm32mp157c_dk2.conf
```kconfig
#
# Copyright (c) 2019, STMicroelectronics
#
# SPDX-License-Identifier: Apache-2.0
#

CONFIG_SPI_4=y
CONFIG_SPI_LOOPBACK_DRV_NAME="SPI_4"
```

## tests/drivers/spi/spi_loopback/boards/tlsr9518adk80d.conf
```kconfig
#
# Copyright (c) 2021 Telink Semiconductor
#
# SPDX-License-Identifier: Apache-2.0
#

CONFIG_SPI_LOOPBACK_DRV_NAME="PSPI"
```

## tests/drivers/spi/spi_loopback/boards/twr_ke18f.conf
```kconfig
#
# Copyright (c) 2019 Vestas Wind Systems A/S
#
# SPDX-License-Identifier: Apache-2.0
#

CONFIG_SPI_LOOPBACK_DRV_NAME="SPI_0"
```

## tests/drivers/spi/spi_loopback/dts/bindings/test-spi-loopback-slow.yaml
```yaml
#
# Copyright (c) 2022 Kumar Gala <galak@kernel.org>
#
# SPDX-License-Identifier: Apache-2.0
#

description: |
    This binding provides resources required to build and run the
    tests/drivers/spi/spi_loopback test in Zephyr.

compatible: "test-spi-loopback-slow"

include: [spi-device.yaml]
```

## tests/drivers/spi/spi_loopback/dts/bindings/zephyr,loopback.yaml
```yaml
# Copyright (c) 2022, CSIRO.
# SPDX-License-Identifier: Apache-2.0

description: |
  SPI Loopback Device

compatible: "zephyr,spi-loopback"

include: spi-device.yaml
```

## tests/drivers/spi/spi_loopback/testcase.yaml
```yaml
common:
  depends_on: spi
  tags:
    - drivers
    - spi
    - dma
  filter: dt_compat_enabled("test-spi-loopback-slow") and
          dt_compat_enabled("test-spi-loopback-fast")
  harness: ztest
  harness_config:
    fixture: spi_loopback
tests:
  drivers.spi.loopback: {}
  drivers.spi.loopback.internal:
    filter: CONFIG_SPI_LOOPBACK_MODE_LOOP
  drivers.spi.loopback.lpspi.dma:
    filter: DT_HAS_NXP_LPSPI_ENABLED and DT_HAS_NXP_MCUX_EDMA_ENABLED
    extra_configs:
      - CONFIG_SPI_NXP_LPSPI_DMA=y
  drivers.spi.loopback.lpspi.async.unset:
    filter: DT_HAS_NXP_LPSPI_ENABLED and DT_HAS_NXP_MCUX_EDMA_ENABLED
    extra_configs:
      - CONFIG_SPI_NXP_LPSPI_DMA=n
      - CONFIG_SPI_ASYNC=n
  drivers.spi.loopback.lpspi.dma.async.unset:
    filter: DT_HAS_NXP_LPSPI_ENABLED and DT_HAS_NXP_MCUX_EDMA_ENABLED
    extra_configs:
      - CONFIG_SPI_NXP_LPSPI_DMA=y
      - CONFIG_SPI_ASYNC=n
  drivers.spi.loopback.rtio:
    extra_configs:
      - CONFIG_SPI_RTIO=y
      - CONFIG_SPI_RTIO_FALLBACK_MSGS=5
    platform_allow:
      - robokit1
      - mimxrt1170_evk/mimxrt1176/cm7
      - bg29_rb4420a
    integration_platforms:
      - robokit1
  drivers.spi.mcux_dspi_dma.loopback:
    extra_args:
      - EXTRA_CONF_FILE="overlay-mcux-dspi-dma.conf"
      - DTC_OVERLAY_FILE="overlay-mcux-dspi-dma.overlay"
    platform_allow: frdm_k64f
  drivers.spi.sam_spi_dma.loopback:
    extra_args:
      - EXTRA_CONF_FILE="overlay-sam-spi-dma.conf"
      - DTC_OVERLAY_FILE="overlay-sam-spi-dma.overlay"
    platform_allow:
      - sam_e70_xplained/same70q21
      - sam_v71_xult/samv71q21
      - robokit1
    integration_platforms:
      - sam_e70_xplained/same70q21
  drivers.spi.stm32_spi_dma.loopback:
    extra_args: EXTRA_CONF_FILE="overlay-stm32-spi-dma.conf"
    platform_allow:
      - b_u585i_iot02a
      - nucleo_c071rb
      - nucleo_g474re
      - nucleo_f207zg
      - nucleo_f429zi
      - nucleo_f746zg
      - nucleo_f767zi
      - nucleo_wba55cg
      - nucleo_wb55rg
      - nucleo_l152re
      - nucleo_wl55jc
      - nucleo_h743zi
      - nucleo_h753zi
      - nucleo_h745zi_q/stm32h745xx/m4
      - nucleo_h745zi_q/stm32h745xx/m7
      - nucleo_u385rg_q
      - stm32h573i_dk
      - stm32n6570_dk/stm32n657xx/sb
      - stm32u083c_dk
    integration_platforms:
      - nucleo_g474re
  drivers.spi.stm32_spi_dma_dt_nocache_mem.loopback:
    # this test case is for when nocache memory region is defined in DT
    # using `zephyr,memory-attr = < DT_MEM_ARM_MPU_RAM_NOCACHE)>`
    extra_args:
      - EXTRA_CONF_FILE="overlay-stm32-spi-dma-dt-nocache-mem.conf"
    filter: CONFIG_CPU_HAS_DCACHE
    platform_allow:
      - nucleo_h743zi
      - nucleo_h753zi
      - nucleo_h745zi_q/stm32h745xx/m4
      - nucleo_h745zi_q/stm32h745xx/m7
    integration_platforms:
      - nucleo_h743zi
  drivers.spi.stm32_spi_interrupt.loopback:
    extra_args: EXTRA_CONF_FILE="overlay-stm32-spi-interrupt.conf"
    platform_allow:
      - b_u585i_iot02a
      - nucleo_c071rb
      - nucleo_f207zg
      - nucleo_f429zi
      - nucleo_f746zg
      - nucleo_f767zi
      - nucleo_g474re
      - nucleo_h743zi
      - nucleo_h753zi
      - nucleo_h745zi_q/stm32h745xx/m4
      - nucleo_h745zi_q/stm32h745xx/m7
      - nucleo_l152re
      - nucleo_u385rg_q
      - nucleo_wba55cg
      - nucleo_wb55rg
      - nucleo_wl55jc
      - stm32f3_disco
      - stm32h573i_dk
      - stm32n6570_dk/stm32n657xx/sb
      - stm32u083c_dk
    integration_platforms:
      - stm32h573i_dk
  drivers.spi.gd32_spi_interrupt.loopback:
    extra_args: EXTRA_CONF_FILE="overlay-gd32-spi-interrupt.conf"
    platform_allow:
      - gd32f403z_eval
      - gd32f407v_start
      - gd32f450i_eval
      - gd32f450v_start
      - gd32f450z_eval
      - gd32f470i_eval
      - gd32vf103c_starter
      - gd32vf103v_eval
      - longan_nano
      - longan_nano/gd32vf103/lite
    integration_platforms:
      - gd32f403z_eval
  drivers.spi.gd32_spi_dma.loopback:
    extra_args: EXTRA_CONF_FILE="overlay-gd32-spi-dma.conf"
    platform_allow:
      - gd32f403z_eval
      - gd32f407v_start
      - gd32f450i_eval
      - gd32f450v_start
      - gd32f450z_eval
      - gd32f470i_eval
      - gd32vf103c_starter
      - gd32vf103v_eval
      - longan_nano
      - longan_nano/gd32vf103/lite
    integration_platforms:
      - gd32f403z_eval
  drivers.spi.pl022_spi_interrupt.loopback:
    extra_args: DTC_OVERLAY_FILE="boards/rpi_pico_pl022.overlay"
    extra_configs:
      - CONFIG_SPI_PL022_INTERRUPT=y
      - CONFIG_SPI_PL022_DMA=n
    platform_allow:
      - rpi_pico
      - pico_plus2/rp2350b/m33
  drivers.spi.pl022_spi_dma.loopback:
    extra_args: DTC_OVERLAY_FILE="boards/rpi_pico_pl022_dma.overlay"
    extra_configs:
      - CONFIG_SPI_PL022_INTERRUPT=n
      - CONFIG_SPI_PL022_DMA=y
      - CONFIG_DMA=y
    platform_allow:
      - rpi_pico
      - pico_plus2/rp2350b/m33
  drivers.spi.pl022_spi_dma_and_interrupt.loopback:
    extra_args: DTC_OVERLAY_FILE="boards/rpi_pico_pl022_dma.overlay"
    extra_configs:
      - CONFIG_SPI_PL022_INTERRUPT=y
      - CONFIG_SPI_PL022_DMA=y
      - CONFIG_DMA=y
    platform_allow:
      - rpi_pico
      - pico_plus2/rp2350b/m33
  drivers.spi.pl022_spi_dma_no_dma_props.loopback:
    extra_args: DTC_OVERLAY_FILE="boards/rpi_pico_pl022.overlay"
    extra_configs:
      - CONFIG_SPI_PL022_INTERRUPT=n
      - CONFIG_SPI_PL022_DMA=y
      - CONFIG_DMA=y
    platform_allow:
      - rpi_pico
      - pico_plus2/rp2350b/m33
  drivers.spi.pl022_spi_dma_and_interrupt_no_dma_props.loopback:
    extra_args: DTC_OVERLAY_FILE="boards/rpi_pico_pl022.overlay"
    extra_configs:
      - CONFIG_SPI_PL022_INTERRUPT=y
      - CONFIG_SPI_PL022_DMA=y
      - CONFIG_DMA=y
    platform_allow:
      - rpi_pico
      - pico_plus2/rp2350b/m33
  drivers.spi.pio_spi.loopback:
    extra_args:
      - DTC_OVERLAY_FILE="boards/rpi_pico_pio.overlay"
      - EXTRA_CONF_FILE="overlay-rpi-pico-pio.conf"
    platform_allow: rpi_pico
  drivers.spi.pio_spi_dma.loopback:
    extra_args:
      - DTC_OVERLAY_FILE="boards/rpi_pico_pio.overlay"
      - EXTRA_DTC_OVERLAY_FILE="boards/rpi_pico_pio_dma.overlay"
      - EXTRA_CONF_FILE="overlay-rpi-pico-pio.conf"
    extra_configs:
      - CONFIG_SPI_RPI_PICO_PIO_DMA=y
    platform_allow: rpi_pico
  drivers.spi.flexio_spi.loopback:
    extra_args:
      - platform:mimxrt1170_evk/mimxrt1176/cm7:DTC_OVERLAY_FILE="boards/mimxrt1170_evk_mimxrt1176_cm7_flexio_spi.overlay"
      - platform:mimxrt1180_evk/mimxrt1189/cm33:DTC_OVERLAY_FILE="boards/mimxrt1180_evk_flexio_spi.overlay"
      - platform:mimxrt1180_evk/mimxrt1189/cm7:DTC_OVERLAY_FILE="boards/mimxrt1180_evk_flexio_spi.overlay"
      - platform:mimxrt1064_evk:DTC_OVERLAY_FILE="overlay-mcux-flexio-spi.overlay"
      - platform:mimxrt1060_evk/mimxrt1062/qspi:DTC_OVERLAY_FILE="overlay-mcux-flexio-spi.overlay"
      - platform:mimxrt1040_evk:DTC_OVERLAY_FILE="boards/mimxrt1040_evk_flexio_spi.overlay"
    filter: CONFIG_DT_HAS_NXP_FLEXIO_ENABLED and
            CONFIG_DT_HAS_NXP_FLEXIO_SPI_ENABLED
    platform_allow:
      - mimxrt1170_evk/mimxrt1176/cm7
      - mimxrt1180_evk/mimxrt1189/cm33
      - mimxrt1180_evk/mimxrt1189/cm7
      - mimxrt1064_evk
      - mimxrt1060_evk/mimxrt1062/qspi
      - mimxrt1040_evk
  drivers.spi.nrf54h_fast_2mhz:
    extra_args:
      - DTC_OVERLAY_FILE="boards/nrf54h20dk_nrf54h20_cpuapp_fast.overlay"
      - EXTRA_DTC_OVERLAY_FILE="boards/nrf_at_2mhz.overlay"
    platform_allow:
      - nrf54h20dk/nrf54h20/cpuapp
    harness: console
    harness_config:
      fixture: spi_loopback
      type: one_line
      regex:
        - "Failed to initialize nrfx driver"
  drivers.spi.nrf54h_fast_8mhz:
    extra_args: DTC_OVERLAY_FILE="boards/nrf54h20dk_nrf54h20_cpuapp_fast.overlay"
    platform_allow:
      - nrf54h20dk/nrf54h20/cpuapp
  drivers.spi.nrf54h_fast_16mhz:
    extra_args:
      - DTC_OVERLAY_FILE="boards/nrf54h20dk_nrf54h20_cpuapp_fast.overlay"
      - EXTRA_DTC_OVERLAY_FILE="boards/nrf_at_16mhz.overlay"
    platform_allow:
      - nrf54h20dk/nrf54h20/cpuapp
  drivers.spi.nrf54h_fast_32mhz:
    extra_args:
      - DTC_OVERLAY_FILE="boards/nrf54h20dk_nrf54h20_cpuapp_fast.overlay"
      - EXTRA_DTC_OVERLAY_FILE="boards/nrf_at_32mhz.overlay"
    platform_allow:
      - nrf54h20dk/nrf54h20/cpuapp
  drivers.spi.nrf54h_fast_8mhz_port2:
    extra_args:
      - DTC_OVERLAY_FILE="boards/nrf54h20dk_nrf54h20_cpuapp_fast_p2.overlay"
      - CONFIG_NRF_REGTOOL_VERBOSITY=2
    platform_allow:
      - nrf54h20dk/nrf54h20/cpuapp
  drivers.spi.nrf54l_1mhz:
    extra_args: EXTRA_DTC_OVERLAY_FILE="boards/nrf_at_1mhz.overlay"
    platform_allow:
      - nrf54l15dk/nrf54l15/cpuapp
    harness: console
    harness_config:
      fixture: spi_loopback
      type: one_line
      regex:
        - "Failed to initialize nrfx driver"
  drivers.spi.nrf54l_8mhz:
    extra_args: EXTRA_DTC_OVERLAY_FILE="boards/nrf_at_8mhz.overlay"
    platform_allow:
      - nrf54l15dk/nrf54l15/cpuapp
      - nrf54lm20dk/nrf54lm20a/cpuapp
      - ophelia4ev/nrf54l15/cpuapp
  drivers.spi.nrf54l_16mhz:
    extra_args: EXTRA_DTC_OVERLAY_FILE="boards/nrf_at_16mhz.overlay"
    platform_allow:
      - nrf54l15dk/nrf54l15/cpuapp
      - ophelia4ev/nrf54l15/cpuapp
  drivers.spi.nrf54l_32mhz:
    extra_args: EXTRA_DTC_OVERLAY_FILE="boards/nrf_at_32mhz.overlay"
    platform_allow:
      - nrf54l15dk/nrf54l15/cpuapp
      - ophelia4ev/nrf54l15/cpuapp
  drivers.spi.nrf54lm20_16mhz_32mhz:
    harness: ztest
    harness_config:
      fixture: spi_fast_loopback
    extra_args:
      - DTC_OVERLAY_FILE="boards/nrf54lm20dk_nrf54lm20a_cpuapp_spi00.overlay"
    platform_allow:
      - nrf54lm20dk/nrf54lm20a/cpuapp
  drivers.spi.ke1xz_flexio_spi.loopback:
    extra_args: DTC_OVERLAY_FILE="boards/frdm_ke1xz_flexio_spi.overlay"
    filter: CONFIG_DT_HAS_NXP_FLEXIO_ENABLED and
            CONFIG_DT_HAS_NXP_FLEXIO_SPI_ENABLED
    platform_allow:
      - frdm_ke17z
      - frdm_ke17z512
  drivers.spi.max32_dma.loopback:
    extra_args: EXTRA_CONF_FILE="overlay-max32-spi-dma.conf"
    filter: CONFIG_SOC_FAMILY_MAX32
  drivers.spi.s32z_dspi.loopback:
    extra_args:
      - DTC_OVERLAY_FILE=boards/s32z2xxdc2_s32z270_dspi.overlay
    platform_allow:
      - s32z2xxdc2/s32z270/rtu0
      - s32z2xxdc2/s32z270/rtu1
  drivers.spi.max32_spi_rtio.loopback:
    extra_args:
      - EXTRA_CONF_FILE="overlay-max32-spi-rtio.conf"
    filter: CONFIG_SOC_FAMILY_MAX32
    platform_allow:
      - apard32690/max32690/m4
  drivers.spi.nrf_pm_runtime:
    extra_configs:
      - CONFIG_PM_DEVICE=y
      - CONFIG_PM_DEVICE_RUNTIME=y
    filter: CONFIG_SOC_FAMILY_NORDIC_NRF
  drivers.spi.silabs_s2.loopback.no_async:
    filter: CONFIG_SOC_FAMILY_SILABS_S2
    platform_allow:
      - xg24_rb4187c
      - xg29_rb4412a
      - bg29_rb4420a
    extra_configs:
      - CONFIG_SPI_SILABS_EUSART_DMA=n
      - CONFIG_SPI_ASYNC=n
  drivers.spi.silabs_s2.loopback.dma.no_async:
    filter: CONFIG_SOC_FAMILY_SILABS_S2
    platform_allow:
      - xg24_rb4187c
      - xg29_rb4412a
      - bg29_rb4420a
    extra_configs:
      - CONFIG_SPI_SILABS_EUSART_DMA=y
      - CONFIG_SPI_ASYNC=n
  drivers.spi.silabs_siwx91x.loopback:
    filter: CONFIG_SOC_FAMILY_SILABS_SIWX91X
    platform_allow:
      - siwx917_rb4338a
  drivers.spi.cc23x0.loopback.dma.no_async:
    filter: CONFIG_SOC_FAMILY_TI_SIMPLELINK
    platform_allow:
      - lp_em_cc2340r5
    extra_configs:
      - CONFIG_SPI_CC23X0_DMA_DRIVEN=y
      - CONFIG_SPI_ASYNC=n
  drivers.spi.cs_loopback.disable_lpspi_dma:
    extra_args: EXTRA_DTC_OVERLAY_FILE="overlay-cs-loopback-gpio.overlay"
    extra_configs:
      - CONFIG_SPI_NXP_LPSPI_DMA=n
    platform_allow:
      - frdm_mcxn947/mcxn947/cpu0
      - mimxrt1050_evk/mimxrt1052/hyperflash
```

## tests/drivers/spi/spi_ram/testcase.yaml
```yaml
common:
  depends_on: spi
  tags:
    - drivers
    - spi
  filter: dt_alias_exists("spi-ram")
  harness: ztest
  harness_config:
    fixture: spi_ram
tests:
  drivers.spi.ram:
    depends_on: spi
    tags:
      - drivers
      - spi
```

## tests/drivers/spi/spi_slave/testcase.yaml
```yaml
tests:
  drivers.spi_slave.api:
    depends_on: spi
    tags: drivers spi
    harness: ztest
    harness_config:
      fixture: gpio_spi_loopback
    platform_allow: |
      nrf52840dk/nrf52840 nrf54l15pdk/nrf54l15/cpuapp nrf54h20dk/nrf54h20/cpuapp
      nrf54h20dk/nrf54h20/cpurad
    integration_platforms:
      - nrf52840dk/nrf52840
```

## tests/drivers/spi/spi_slave_master_loopback/Kconfig
```kconfig
config TEST_MASTER_DRV_NAME
	string "Master SPI DRV name"
	default "SPI_LOOPBACK_MASTER"

config TEST_SLAVE_DRV_NAME
	string "Slave SPI DRV Name"
	default "SPI_LOOPBACK_SLAVE"

config TEST_SPI_SLAVE
	int "SPI Slave CS index"
	default 0

config TEST_MASTER_SLOW_FREQ
	int "Master SPI Slow Frequency"
	default 128000

config TEST_MASTER_FAST_FREQ
	int "Master SPI Fast Frequency"
	default 12000000

config TEST_SLAVE_FREQ
	int "Slave SPI Frequency"
	default 24000000

config TEST_SPI_MASTER_CS_GPIO_ENABLE
	bool "Enable SPI Master CS GPIO"
	default n

config TEST_MASTER_CS_GPIO_DRV_NAME
	string "Master SPI GPIO DRV Name"
	depends on TEST_SPI_MASTER_CS_GPIO_ENABLE
	default ""

config TEST_MASTER_CS_GPIO_PIN
	string "Master SPI GPIO Pin"
	depends on TEST_SPI_MASTER_CS_GPIO_ENABLE
	default ""

config TEST_SPI_SLAVE_CS_IGNORE
	bool "Ignore CS Line for SPI Slave"
	default y

source "$ZEPHYR_BASE/Kconfig.zephyr"
```

## tests/drivers/spi/spi_slave_master_loopback/boards/nucleo_f091rc.conf
```kconfig
CONFIG_SPI_STM32=y
CONFIG_SPI_STM32_INTERRUPT=y
CONFIG_SPI_1=y
CONFIG_SPI_1_IRQ_PRI=10
CONFIG_SPI_1_NAME="SPI_LOOPBACK_MASTER"
CONFIG_SPI_2=y
CONFIG_SPI_2_IRQ_PRI=9
CONFIG_SPI_2_NAME="SPI_LOOPBACK_SLAVE"
CONFIG_TEST_MASTER_SLOW_FREQ=500000
CONFIG_TEST_SPI_MASTER_CS_GPIO_ENABLE=n
CONFIG_TEST_SPI_SLAVE_CS_IGNORE=y
```

## tests/drivers/spi/spi_stm32/Kconfig
```kconfig
# Copyright (c) 2023 Graphcore Ltd.
#
# SPDX-License-Identifier: Apache-2.0

source "Kconfig"
```

## tests/drivers/spi/spi_stm32/testcase.yaml
```yaml
# Copyright (c) 2023 Graphcore Ltd.
#
# SPDX-License-Identifier: Apache-2.0

common:
  tags:
    - spi
    - spi_stm32
tests:
  drivers.spi.spi_stm32.test:
    type: unit
```

## tests/drivers/spi/spi_transceive/testcase.yaml
```yaml
common:
  tags:
    - drivers
    - spi
    - dma
  depends_on: spi
  harness: ztest
  harness_config:
    fixture: spi_loopback
  filter: dt_nodelabel_enabled("dut")
tests:
  drivers.spi.spi_transceive: {}
  drivers.spi.spi_transceive_int:
    extra_configs:
      - CONFIG_DMA=n
```
