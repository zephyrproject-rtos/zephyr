## tests/drivers/stepper/closed_loop/testcase.yaml
```yaml
# Copyright (c) 2026 Contributors to the Zephyr Project
# SPDX-License-Identifier: Apache-2.0

common:
  tags:
    - drivers
    - stepper
    - closed_loop
tests:
  drivers.stepper.closed_loop:
    extra_args:
      - platform:native_sim/native/64:DTC_OVERLAY_FILE="boards/native_sim.overlay"
    platform_allow:
      - native_sim/native/64
```

## tests/drivers/stepper/drv8424/api/Kconfig
```kconfig
# Copyright (c) 2024 Navimatix GmbH
# SPDX-License-Identifier: Apache-2.0

config ENTROPY_GENERATOR
	depends on ZTEST_SHUFFLE
	bool "Shuffle the order of tests and suites"
	default y

source "Kconfig.zephyr"
```

## tests/drivers/stepper/drv8424/api/testcase.yaml
```yaml
# Copyright (c) 2024 Navimatix GmbH
# SPDX-License-Identifier: Apache-2.0

tests:
  drivers.stepper.drv8424.api:
    tags:
      - drivers
      - stepper
      - api
      - drv8424
    platform_allow:
      - nucleo_f767zi
      - mimxrt1060_evk/mimxrt1062/qspi
      - native_sim
```

## tests/drivers/stepper/drv8424/emul/testcase.yaml
```yaml
# Copyright (c) 2024 Navimatix GmbH
# SPDX-License-Identifier: Apache-2.0

tests:
  drivers.stepper.drv8424.emul:
    tags:
      - drivers
      - stepper
      - drv8424
    platform_allow:
      - native_sim
```

## tests/drivers/stepper/drv84xx/api/Kconfig
```kconfig
# Copyright (c) 2024 Navimatix GmbH
# SPDX-License-Identifier: Apache-2.0

config ENTROPY_GENERATOR
	depends on ZTEST_SHUFFLE
	bool "Shuffle the order of tests and suites"
	default y

config STEPPER_IDX
	int "Stepper index"
	default 0
	help
	  Index of the stepper device to test.

source "Kconfig.zephyr"
```

## tests/drivers/stepper/drv84xx/api/testcase.yaml
```yaml
# Copyright (c) 2024 Navimatix GmbH
# SPDX-License-Identifier: Apache-2.0

tests:
  drivers.stepper.drv84xx.api:
    tags:
      - drivers
      - stepper
      - api
      - drv84xx
    platform_allow:
      - native_sim
```

## tests/drivers/stepper/drv84xx/emul/testcase.yaml
```yaml
# Copyright (c) 2024 Navimatix GmbH
# SPDX-License-Identifier: Apache-2.0

tests:
  drivers.stepper.drv84xx.emul:
    tags:
      - drivers
      - stepper
      - drv84xx
    platform_allow:
      - native_sim
```

## tests/drivers/stepper/drv84xx/testcase.yaml
```yaml
# Copyright (c) 2024 Navimatix GmbH
# SPDX-License-Identifier: Apache-2.0

common:
  tags:
    - drivers
    - stepper
    - drv84xx

tests:
  drivers.stepper.drv84xx.emul:
    platform_allow:
      - native_sim
      - native_sim/native/64
```

## tests/drivers/stepper/ramp/testcase.yaml
```yaml
# SPDX-FileCopyrightText: Copyright (c) 2025 Andre Stefanov
# SPDX-License-Identifier: Apache-2.0

common:
  tags:
    - drivers
    - stepper
    - ramp
tests:
  drivers.stepper.ramp:
    platform_allow:
      - qemu_x86_64/atom
      - native_sim/native/64
```

## tests/drivers/stepper/shell/testcase.yaml
```yaml
common:
  tags:
    - drivers
    - stepper
    - shell

tests:
  drivers.stepper.shell:
    platform_allow:
      - native_sim
      - native_sim/native/64
```
