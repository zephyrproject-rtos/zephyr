/*
 * Copyright (c) 2023, Synopsys, Inc. All rights reserved.
 *
 * SPDX-License-Identifier: Apache-2.0
 */

#define SPI_LOOPBACK_SLOW_HZ 128000
#define SPI_LOOPBACK_FAST_HZ 500000

spi_loopback: &spi1 {};

#include "../spi-loopback.dtsi"
