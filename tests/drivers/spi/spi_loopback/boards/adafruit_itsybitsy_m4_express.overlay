/*
 * Copyright (c) 2022 Kumar Gala <galak@kernel.org>
 *
 * SPDX-License-Identifier: Apache-2.0
 */

spi_loopback: &sercom1 {
	cs-gpios = <&porta 7 GPIO_ACTIVE_LOW>;
};

#include "../spi-loopback.dtsi"
