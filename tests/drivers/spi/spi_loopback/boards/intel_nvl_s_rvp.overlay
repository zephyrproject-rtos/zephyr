/*
 * Copyright (c) 2026 Intel Corporation
 *
 * SPDX-License-Identifier: Apache-2.0
 */

spi_loopback: &spi0 {
	pw,cs-mode = <0>;
	pw,cs-output = <0>;
	status = "okay";
};

&gpio_i {
	status = "okay";
};

#include "../spi-loopback.dtsi"
