/*
 * Copyright (c) 2025 Renesas Electronics Corporation
 *
 * SPDX-License-Identifier: Apache-2.0
 */

#define SPI_LOOPBACK_FAST_HZ 8333333
#define SPI_LOOPBACK_REG 2

spi_loopback: &spi0 {};

#include "../spi-loopback.dtsi"
