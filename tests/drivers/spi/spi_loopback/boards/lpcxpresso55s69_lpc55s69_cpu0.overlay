/*
 * Copyright (c) 2022 Kumar Gala <galak@kernel.org>
 *
 * SPDX-License-Identifier: Apache-2.0
 */

#define SPI_LOOPBACK_SLOW_HZ 5000
#define SPI_LOOPBACK_FAST_HZ 160000
#define SPI_LOOPBACK_REG 1

spi_loopback: &hs_lspi {
	/delete-property/ cs-gpios;
};

#include "../spi-loopback.dtsi"
