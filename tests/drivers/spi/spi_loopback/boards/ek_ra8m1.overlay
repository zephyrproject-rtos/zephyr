/*
 * Copyright (c) 2024 Renesas Electronics Corporation
 * SPDX-License-Identifier: Apache-2.0
 */

#include <zephyr/dt-bindings/clock/ra_clock.h>

&pinctrl {
	spi0_default: spi0_default {
		group1 {
			/* MISO MOSI RSPCK SSL*/
			psels = <RA_PSEL(RA_PSEL_SPI, 6, 9)>,
				<RA_PSEL(RA_PSEL_SPI, 6, 11)>,
				<RA_PSEL(RA_PSEL_SPI, 6, 10)>,
				<RA_PSEL(RA_PSEL_SPI, 6, 12)>;
		};
	};
};

#define SPI_LOOPBACK_SLOW_HZ 2000000
#define SPI_LOOPBACK_FAST_HZ 3000000

spi_loopback: &spi0 {
	rx-dtc;
	tx-dtc;
	pinctrl-0 = <&spi0_default>;
	pinctrl-names = "default";
	status = "okay";
};

#include "../spi-loopback.dtsi"
