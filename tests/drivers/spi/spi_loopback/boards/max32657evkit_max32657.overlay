/*
 * Copyright (c) 2024-2026 Analog Devices, Inc.
 *
 * SPDX-License-Identifier: Apache-2.0
 */

&dma1 {
	status = "okay";
};

#define SPI_LOOPBACK_SLOW_HZ 128000
#define SPI_LOOPBACK_FAST_HZ 500000
#define SPI_LOOPBACK_REG 1

spi_loopback: &spi0 {
	zephyr,pm-device-runtime-auto;
	dmas = <&dma1 1 MAX32_DMA_SLOT_SPI_TX>, <&dma1 2 MAX32_DMA_SLOT_SPI_RX>;
	dma-names = "tx", "rx";
};

/*
 * SRAM banks marked with the following property are retained in backup mode
 *
 * SRAM banks are listed in max32657_common.dtsi
 */
&sram0 {
	adi,ram-bank-retained;
};

#include "../spi-loopback.dtsi"
