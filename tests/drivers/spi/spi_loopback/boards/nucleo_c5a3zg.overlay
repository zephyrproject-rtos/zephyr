/*
 * Copyright (c) 2026 STMicroelectronics
 *
 * SPDX-License-Identifier: Apache-2.0
 */

spi_loopback: &spi1 {
	dmas = <&lpdma1 0 5 STM32_DMA_PERIPH_TX
		&lpdma1 1 4 STM32_DMA_PERIPH_RX>;
	dma-names = "tx", "rx";
	st,fifo-threshold = <8>;
};

#include "../spi-loopback.dtsi"
