/* SPDX-FileCopyrightText: Copyright The Zephyr Project Contributors */
/* SPDX-License-Identifier: Apache-2.0 */

#define SPI_LOOPBACK_FAST_HZ 15000000

spi_loopback: &spip0 {
	status = "okay";
	pinctrl-0 = <&spip_sclk_mosi_miso_gp95_gpa1_gpa3_gpa5_sl
		     &spip_sclk_mosi_miso_gp95_gpa1_gpa3_gpa5_no_spip_inv>;
	pinctrl-names = "default";

	cs-gpios = <&gpioa 5 GPIO_ACTIVE_LOW>;
};

#include "../spi-loopback.dtsi"
