/*
 * Copyright (c) 2024 Nordic Semiconductor ASA
 *
 * SPDX-License-Identifier: Apache-2.0
 */
#include "nrf54h20dk_nrf54h20_common.dtsi"

&spi130 {
	status = "okay";
	memory-regions = <&cpurad_dma_region>;
};
