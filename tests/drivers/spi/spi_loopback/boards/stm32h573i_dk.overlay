/*
 * Copyright (c) 2023 STMicroelectronics
 *
 * SPDX-License-Identifier: Apache-2.0
 */

&rcc {
	apb1-prescaler = <2>;
};

#define SPI_LOOPBACK_FAST_HZ 10000000

spi_loopback: &spi2 {
	dmas = <&gpdma1 0 9 STM32_DMA_PERIPH_TX>,
	       <&gpdma1 1 8 STM32_DMA_PERIPH_RX>;
	dma-names = "tx", "rx";
	st,fifo-threshold = <8>;
};

&gpdma1 {
	status = "okay";
};

&gpdma2 {
	status = "okay";
};

#include "../spi-loopback.dtsi"
