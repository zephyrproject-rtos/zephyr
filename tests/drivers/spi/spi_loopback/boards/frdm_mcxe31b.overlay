/*
 * SPDX-FileCopyrightText: Copyright 2026 NXP
 * SPDX-License-Identifier: Apache-2.0
 */

/* To test this sample, connect on the Arduino header:
 * LPSPI0 MOSI (J2-8, D11, PTE2 LPSPI0_SOUT)
 * --> LPSPI0 MISO (J2-10, D12, PTE0 LPSPI0_SIN)
 */

#define SPI_LOOPBACK_FAST_HZ 4000000
#define SPI_LOOPBACK_REG 2

spi_loopback: &lpspi_0 {
	/* Guarantee SOUT data setup before the first capture edge in CPHA=0 */
	pcs-sck-delay = <1000>;
};

#include "../spi-loopback.dtsi"
