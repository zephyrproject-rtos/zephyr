/*
 * Copyright (c) 2025 STMicroelectronics
 *
 * SPDX-License-Identifier: Apache-2.0
 */

spi_loopback: &spi1 {
	dmas = <&gpdma1 0 7 STM32_DMA_PERIPH_TX>,
	       <&gpdma1 1 6 STM32_DMA_PERIPH_RX>;
	dma-names = "tx", "rx";
	st,fifo-threshold = <8>;
};

&gpdma1 {
	status = "okay";
};

#include "../spi-loopback.dtsi"
