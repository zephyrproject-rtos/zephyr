/*
 * Copyright (c) 2025 Intel Corporation
 *
 * SPDX-License-Identifier: Apache-2.0
 */

spi_loopback: &spi0 {
	pw,cs-mode = <0>;
	pw,cs-output = <0>;
	status = "okay";
};

&gpio_e {
	status = "okay";
};

#include "../spi-loopback.dtsi"
