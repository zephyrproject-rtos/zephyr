## CMakeLists.txt
```
# Copyright 2022 NXP
# SPDX-License-Identifier: Apache-2.0

cmake_minimum_required(VERSION 3.28.0)

find_package(Zephyr REQUIRED HINTS $ENV{ZEPHYR_BASE})
project(wdt_basic_reset_none)

FILE(GLOB app_sources src/*.c)
target_sources(app PRIVATE ${app_sources})
```

## Kconfig
```
# Copyright 2025 NXP
# SPDX-License-Identifier: Apache-2.0

source "Kconfig.zephyr"

config TEST_WDT_MAX_WINDOW_TIME
	int "Watchdog Max Value"
	default 1000
	help
	  Set the watchdog max window time to feed the watchdog.
	  The units for this value will change based on the watchdog
	  driver being tested. Most drivers represent this as milliseconds
	  due to the max window reaching the millisecond feed window.

config TEST_WDT_SLEEP_TIME
	int "Watchdog Sleep Time"
	default 500
	help
	  Set the test sleep time between watchdog feeds.
	  The units for this value will change based on the watchdog
	  driver being tested. Most drivers represent this as milliseconds
	  due to the max window reaching the millisecond feed window.

config TEST_WDT_SETUP_FLAGS
	int "WDT setup flags for test, selectable options are: No flags (0x0U), WDT_OPT_PAUSE_IN_SLEEP (0x1U), WDT_OPT_PAUSE_HALTED_BY_DBG (0x2U)"
	default 2
	help
	  Set the watchdog setup flags for the test.

config TEST_WDT_TIMEOUT_UNIT_TICKS
	bool "Use watchdog timeout unit in ticks"
	help
	  Enable this option to configure the watchdog timeout unit in system ticks
```

## prj.conf
```kconfig
# Copyright 2022 NXP
# SPDX-License-Identifier: Apache-2.0

CONFIG_ZTEST=y
CONFIG_WATCHDOG=y
CONFIG_REBOOT=y
```

## app_ewm.conf
```kconfig
CONFIG_TEST_WDT_SETUP_FLAGS=0
CONFIG_TEST_WDT_TIMEOUT_UNIT_TICKS=y
```

## boards/frdm_mcxn236.conf
```kconfig
#
# Copyright 2025 NXP
#
# SPDX-License-Identifier Apache-2.0
#
CONFIG_TEST_WDT_MAX_WINDOW_TIME=254
CONFIG_TEST_WDT_SLEEP_TIME=68
```

## boards/frdm_mcxw23.conf
```kconfig
#
# Copyright 2025 NXP
#
# SPDX-License-Identifier Apache-2.0
#
CONFIG_WDT_MCUX_WWDT_WARNING_INTERRUPT_CFG=512
```

## boards/frdm_rw612.conf
```kconfig
#
# Copyright 2025 NXP
#
# SPDX-License-Identifier Apache-2.0
#
CONFIG_WDT_MCUX_WWDT_WARNING_INTERRUPT_CFG=512
CONFIG_PM=y
```

## boards/numaker_pfm_m487.conf
```kconfig
# Copyright (c) 2026 Nuvoton Technology Corporation.
# SPDX-License-Identifier: Apache-2.0

# M48x WDT clocked by 10 kHz LIRC has coarse granularity.
# tout=4 → 2^12 = 4096 ticks → 410 ms (rounded up).
# SLEEP_TIME of 200 ms keeps feeds well within the period.
# After last feed + 200 ms sleep, the WDT fires ~210 ms into the wait
# window of 410 ms → comfortably in range.
CONFIG_TEST_WDT_MAX_WINDOW_TIME=410
CONFIG_TEST_WDT_SLEEP_TIME=200
```

## boards/rsk_rx130_512kb.conf
```kconfig
CONFIG_TEST_WDT_SETUP_FLAGS=0
```

## boards/app_ewm.overlay
```dts
/*
 * Copyright 2025 NXP
 * SPDX-License-Identifier: Apache-2.0
 */

/ {
	aliases {
		watchdog0 = &ewm0;
	};
};

&ewm0 {
	status = "okay";
};
```

## boards/app_ewm_no_wdog.overlay
```dts
/*
 * Copyright 2025 NXP
 * SPDX-License-Identifier: Apache-2.0
 */

/ {
	aliases {
		watchdog0 = &ewm0;
	};
};

&ewm0 {
	clk-divider = <3>;
	status = "okay";
};

&wdog {
	status = "disabled";
};
```

## boards/frdm_rw612.overlay
```dts
/*
 * Copyright 2025 NXP
 *
 * SPDX-License-Identifier: Apache-2.0
 */

/* Enable standby low power mode */
&standby {
	status = "okay";
};
```

## boards/lp_mspm0l2228.overlay
```dts
/*
 * Copyright (c) 2026 Texas Instruments Inc.
 * SPDX-License-Identifier: Apache-2.0
 */

/ {
	aliases {
		watchdog0 = &wdt0;
	};
};

&wdt0 {
	status = "okay";
};
```

## boards/nxp_rt11xx.overlay
```dts
/*
 * Copyright 2025 NXP
 * SPDX-License-Identifier: Apache-2.0
 */

/ {
	aliases {
		watchdog0 = &ewm0;
	};
};

&ewm0 {
	clk-divider = <3>;
	status = "okay";
};
```

## boards/realtek_bee_core_wdt.overlay
```dts
/*
 * Copyright(c) 2026, Realtek Semiconductor Corporation.
 *
 * SPDX-License-Identifier: Apache-2.0
 */

/ {
	aliases {
		watchdog0 = &core_wdt;
	};
};

&core_wdt {
	status = "okay";
};
```

## src/main.c
```c
/*
 * Copyright 2022, 2025 NXP
 *
 * SPDX-License-Identifier: Apache-2.0
 */

#include <zephyr/ztest.h>
#include <zephyr/drivers/watchdog.h>


/*
 * To use this test, either the devicetree's /aliases must have a
 * 'watchdog0' property, or one of the following watchdog compatibles
 * must have an enabled node.
 */
#if DT_NODE_HAS_STATUS_OKAY(DT_ALIAS(watchdog0))
#define WDT_NODE DT_ALIAS(watchdog0)
#elif DT_HAS_COMPAT_STATUS_OKAY(nxp_s32_swt)
#define WDT_NODE DT_INST(0, nxp_s32_swt)
#endif

#define WDT_FEED_TRIES		2
#define WDT_TEST_CB_TEST_VALUE	0xCB
#define WDT_TIMEOUT_VALUE	CONFIG_TEST_WDT_MAX_WINDOW_TIME + 10
#define WDT_SETUP_FLAGS         CONFIG_TEST_WDT_SETUP_FLAGS

#if defined(CONFIG_TEST_WDT_TIMEOUT_UNIT_TICKS)
#define SLEEP_TIME  K_TICKS(CONFIG_TEST_WDT_SLEEP_TIME)
#else
#define SLEEP_TIME  K_MSEC(CONFIG_TEST_WDT_SLEEP_TIME)
#endif

/*
 * Wait for the callback in milliseconds in both cases. With ticks, the window
 * is in watchdog clock cycles, so a bound in ticks would depend on the system
 * tick rate.
 */
#define WDT_TIMEOUT K_MSEC(WDT_TIMEOUT_VALUE)

static struct wdt_timeout_cfg m_cfg_wdt0;
static volatile int wdt_interrupted_flag;
static volatile int wdt_feed_flag;


static void wdt_callback(const struct device *dev, int channel_id)
{
	wdt_interrupted_flag += WDT_TEST_CB_TEST_VALUE;
	zassert_equal(WDT_FEED_TRIES, wdt_feed_flag,
			"%d: Invalid number of feeding (expected: %d)",
			wdt_feed_flag, WDT_FEED_TRIES);
}

static int test_wdt_callback_reset_none(void)
{
	int err;
	const struct device *const wdt = DEVICE_DT_GET(WDT_NODE);

	if (!device_is_ready(wdt)) {
		TC_PRINT("WDT device is not ready\n");
		return TC_FAIL;
	}

	m_cfg_wdt0.window.min = 0U;
	m_cfg_wdt0.window.max = CONFIG_TEST_WDT_MAX_WINDOW_TIME;
	m_cfg_wdt0.flags = WDT_FLAG_RESET_NONE;
	m_cfg_wdt0.callback = wdt_callback;

	err = wdt_install_timeout(wdt, &m_cfg_wdt0);
	if (err == -ENOTSUP) {
		TC_PRINT("Some of the options are not supported, skip\n");
		return TC_SKIP;
	} else if (err != 0) {
		TC_PRINT("Watchdog install error\n");
		return TC_FAIL;
	}

	err = wdt_setup(wdt, WDT_SETUP_FLAGS);
	if (err != 0) {
		TC_PRINT("Watchdog setup error\n");
		return TC_FAIL;
	}

	TC_PRINT("Feeding watchdog %d times\n", WDT_FEED_TRIES);
	wdt_feed_flag = 0;
	wdt_interrupted_flag = 0;
	for (int i = 0; i < WDT_FEED_TRIES; ++i) {
		TC_PRINT("Feeding %d\n", i+1);
		wdt_feed(wdt, 0);
		wdt_feed_flag++;
		k_sleep(SLEEP_TIME);
	}

	k_timeout_t timeout = WDT_TIMEOUT;
	uint64_t start_time = k_uptime_ticks();

	while (wdt_interrupted_flag == 0) {
		if (k_uptime_ticks() - start_time >= timeout.ticks) {
			break;
		}
	}

	zassert_equal(wdt_interrupted_flag, WDT_TEST_CB_TEST_VALUE,
			"wdt callback failed");

	err = wdt_disable(wdt);
	if (err == -EPERM) {
		TC_PRINT("Some of the options are not permitted, skip\n");
		return TC_SKIP;
	} else if (err != 0) {
		TC_PRINT("Disable watchdog error\n");
		return TC_FAIL;
	}

	return TC_PASS;
}

static int test_wdt_bad_window_max(void)
{
	int err;
	const struct device *const wdt = DEVICE_DT_GET(WDT_NODE);

	if (!device_is_ready(wdt)) {
		TC_PRINT("WDT device is not ready\n");
		return TC_FAIL;
	}

	m_cfg_wdt0.callback = NULL;
	m_cfg_wdt0.flags = WDT_FLAG_RESET_NONE;
	m_cfg_wdt0.window.max = 0U;
	m_cfg_wdt0.window.min = 0U;
	err = wdt_install_timeout(wdt, &m_cfg_wdt0);
	if (err == -EINVAL) {
		return TC_PASS;
	}

	return TC_FAIL;
}


ZTEST(wdt_basic_reset_none, test_wdt_callback_reset_none)
{
	switch (test_wdt_callback_reset_none()) {
	case TC_SKIP:
		ztest_test_skip();
		break;
	case TC_PASS:
		ztest_test_pass();
		break;
	default:
		ztest_test_fail();
	}
}

ZTEST(wdt_basic_reset_none, test_wdt_bad_window_max)
{
	zassert_true(test_wdt_bad_window_max() == TC_PASS);
}

ZTEST_SUITE(wdt_basic_reset_none, NULL, NULL, NULL, NULL, NULL);
```
