/*
 * Copyright (c) 2025 Nordic Semiconductor ASA
 *
 * SPDX-License-Identifier: Apache-2.0
 */

&wdt131 {
	interrupt-parent = <&cpuppr_clic>;
	status = "reserved";
};

&wdt132 {
	interrupt-parent = <&cpuflpr_clic>;
	status = "reserved";
};
