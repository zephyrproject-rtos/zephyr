/*
 * Copyright (c) 2024 Nordic Semiconductor ASA
 *
 * SPDX-License-Identifier: Apache-2.0
 */

/ {
	resources {
		compatible = "test-wdt-error-cases";
		opt-pause-in-sleep;
		opt-pause-halted-by-dbg;
	};
};

&wdt31 {
	status = "okay";
};
