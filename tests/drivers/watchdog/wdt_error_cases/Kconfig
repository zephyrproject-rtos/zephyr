## tests/drivers/watchdog/wdt_error_cases/Kconfig
```kconfig
# Copyright (c) 2026 Nordic Semiconductor ASA
#
# SPDX-License-Identifier: Apache-2.0


config TEST_WDT_DISABLE_SUPPORTED
	bool "Watchdog can be disabled after it was started"
	default y
	help
	  This Kconfig is partially used to select test cases valid on a given platform.
	  However, at some point, test suite requires WDT to be disabled after test.
	  Therefore, this test suite currently can only be run on targets that
	  support watchdog disable.

config TEST_WDT_FLAG_RESET_NONE_SUPPORTED
	bool "Watchdog flag WDT_FLAG_RESET_NONE is supported"
	default y if SOC_FAMILY_SILABS_S2
	help
	  Set this Kconfig to 'y' if wdt_install_timeout() can be called with
	  cfg.flags=WDT_FLAG_RESET_NONE.

config TEST_WDT_FLAG_RESET_CPU_CORE_SUPPORTED
	bool "Watchdog flag WDT_FLAG_RESET_CPU_CORE is supported"
	default y if SOC_FAMILY_MICROCHIP_SAM_D5X_E5X || SOC_FAMILY_MICROCHIP_PIC32CX_SG
	help
	  Set this Kconfig to 'y' if wdt_install_timeout() can be called with
	  cfg.flags=WDT_FLAG_RESET_CPU_CORE.

config TEST_WDT_FLAG_RESET_SOC_SUPPORTED
	bool "Watchdog flag WDT_FLAG_RESET_SOC is supported"
	default y
	help
	  Set this Kconfig to 'y' if wdt_install_timeout() can be called with
	  cfg.flags=WDT_FLAG_RESET_SOC.

config TEST_MAX_INSTALLABLE_TIMEOUTS
	int "Maximal number of timeouts that can be set for single Watchdog instance"
	default 8 if NRFX_WDT
	default 1
	help
	  Maximal number of timeouts that can be set with wdt_install_timeout()
	  for the given Watchdog device.

config TEST_WDT_FLAG_ONLY_ONE_TIMEOUT_VALUE_SUPPORTED
	bool "Watchdog supports only one timeout value for all timeouts"
	default y
	help
	  Set this Kconfig to 'y' if all wdt_install_timeout() calls must set identical
	  cfg.window value.

config TEST_WDT_WINDOW_MIN_SUPPORTED
	bool "Watchdog supports lower limit of watchdog feed timeout"
	default y if SOC_FAMILY_SILABS_S2
	help
	  Set this Kconfig to 'y' if wdt_install_timeout() can be called with
	  cfg.window.min value higher than 0.

config TEST_WDT_WINDOW_MAX_ALLOWED
	hex "Maximal value of Watchdog timeout"
	default 0x07CFFFFF if NRFX_WDT
	default 0x40001 if SOC_FAMILY_SILABS_S2
	default 0x4000 if SOC_FAMILY_MICROCHIP_SAM_D5X_E5X || SOC_FAMILY_MICROCHIP_PIC32CX_SG
	default 0xFFFFFFFF if SOC_IT51XXX
	default 0xFFFFFFF
	help
	  Maximal value of the Watchdog timeout passed in the
	  wdt_install_timeout(dev, cfg.window.max) call.

config TEST_WDT_OPT_PAUSE_IN_SLEEP_SUPPORTED
	bool "Watchdog supports option that pause timer when core enters sleep"
	default y if NRFX_WDT || SOC_FAMILY_SILABS_S2
	help
	  Set this Kconfig to 'y' if wdt_setup() can be called with
	  options=WDT_OPT_PAUSE_IN_SLEEP.

config TEST_WDT_OPT_PAUSE_HALTED_BY_DBG_SUPPORTED
	bool "Watchdog supports option that pause timer when core is halted by the debugger"
	default y
	help
	  Set this Kconfig to 'y' if wdt_setup() can be called with
	  options=WDT_OPT_PAUSE_HALTED_BY_DBG.

config TEST_WDT_FEED_CAN_STALL
	bool "Watchdog may report that wdt_feed() can stall the caller"
	help
	  Set this Kconfig to 'y' if wdt_feed() may return -EAGAIN when completing
	  the feed operation would stall the caller, for example due to an in-progress
	  watchdog operation such as a previous wdt_feed() call.

source "Kconfig.zephyr"
```

## tests/drivers/watchdog/wdt_error_cases/dts/bindings/test-wdt-errors-case.yaml
```yaml
#
# Copyright (c) 2025 Nordic Semiconductor ASA
#
# SPDX-License-Identifier: Apache-2.0
#

description: |
    This binding provides resources required to build and run the
    tests/drivers/watchdog/wdt_error_cases test in Zephyr.

compatible: "test-wdt-error-cases"

properties:
  opt-pause-in-sleep:
    type: boolean
    description: |
      If true, the watchdog timer will be paused when the CPU is in sleep mode.
      This is useful to prevent the watchdog from triggering during low-power
      states.
  opt-pause-halted-by-dbg:
    type: boolean
    description: |
      If true, the watchdog timer will be paused when the CPU is halted by a
      debugger. This allows the watchdog to be used during debugging without
      triggering a reset.
  feed-can-stall:
    type: boolean
    description: |
      If true, feeding the watchdog can stall the CPU. This is useful for
      testing purposes to simulate a watchdog timeout.
  window-min:
    type: boolean
    description: |
      If true, the watchdog supports a minimum window value. This allows for
      more precise control over the watchdog timeout period.
  opt-pause-in-sleep-requires-pm:
    type: boolean
    description: |
      If true, the watchdog timer can only be paused in sleep mode if
      power management is enabled.
  flag-reset-cpu-core:
    type: boolean
    description: |
      If true, the watchdog supports resetting the CPU core. This allows for
      more flexible error recovery options.
  flag-reset-none:
    type: boolean
    description: |
      If true, the watchdog supports not resetting the CPU core. This allows for
      more flexible error recovery options.
```

## tests/drivers/watchdog/wdt_error_cases/testcase.yaml
```yaml
common:
  tags:
    - drivers
    - watchdog
  depends_on: watchdog
  harness: ztest

tests:
  drivers.watchdog.wdt_error_cases:
    platform_allow:
      - nrf5340dk/nrf5340/cpuapp
      - nrf54h20dk/nrf54h20/cpuapp
      - nrf54h20dk/nrf54h20/cpurad
      - nrf54l15dk/nrf54l15/cpuapp
      - nrf54lm20dk/nrf54lm20a/cpuapp
      - nrf9280pdk/nrf9280/cpuapp
      - nrf9280pdk/nrf9280/cpurad
      - ophelia4ev/nrf54l15/cpuapp
      - raytac_an54l15q_db/nrf54l15/cpuapp
      - xg24_rb4187c
      - xg27_dk2602a
    integration_platforms:
      - nrf54l15dk/nrf54l15/cpuapp
      - ophelia4ev/nrf54l15/cpuapp
      - raytac_an54l15q_db/nrf54l15/cpuapp
  drivers.watchdog.wdt_error_cases_pm:
    platform_allow:
      - xg24_rb4187c
      - xg27_dk2602a
    extra_configs:
      - CONFIG_PM=y
```

## tests/drivers/watchdog/wdt_variables/testcase.yaml
```yaml
common:
  timeout: 10
  tags:
    - drivers
    - watchdog
  harness: console
  harness_config:
    type: one_line
    regex:
      - "Test completed successfully"

tests:
  drivers.watchdog.wdt_variables.default:
    platform_allow:
      - nrf54h20dk/nrf54h20/cpuapp
      - nrf54h20dk/nrf54h20/cpuppr
      - nrf54l15dk/nrf54l15/cpuapp
      - nrf54lm20dk/nrf54lm20a/cpuapp
      - nrf54lm20dk/nrf54lm20a/cpuflpr
      - ophelia4ev/nrf54l15/cpuapp
    integration_platforms:
      - nrf54l15dk/nrf54l15/cpuapp
      - ophelia4ev/nrf54l15/cpuapp

  drivers.watchdog.wdt_variables.54h_flpr:
    platform_allow:
      - nrf54h20dk/nrf54h20/cpuflpr
    extra_args:
      - vpr_launcher_SNIPPET=nordic-log-stm
      - vpr_launcher_CONFIG_BOOT_BANNER=n
      - SNIPPET=nordic-log-stm
```

## tests/drivers/wifi/bflb/boards/bl604e_iot_dvk.conf
```kconfig
# SPDX-FileCopyrightText: Copyright The Zephyr Project Contributors
#
# SPDX-License-Identifier: Apache-2.0

# 184 KB usable RAM: drop IPv6/TCP and trim the PSA key-slot table.
CONFIG_NET_IPV6=n
CONFIG_NET_TCP=n
CONFIG_MBEDTLS_PSA_KEY_SLOT_COUNT=8
```

## tests/drivers/wifi/emul/testcase.yaml
```yaml
common:
  min_ram: 16
  tags:
    - drivers
    - wifi
    - net
  depends_on: netif
tests:
  drivers.wifi.emul:
    platform_allow:
      - native_sim
      - native_sim/native/64
      - qemu_x86
      - qemu_cortex_m3
    integration_platforms:
      - native_sim
```

## tests/drivers/wifi/nrf_wifi/Kconfig
```kconfig
#
# Copyright (c) 2025 Embeint Inc
#
# SPDX-License-Identifier: Apache-2.0
#

if !CONFIG_WIFI_USAGE_MODE_SCAN_ONLY

configdefault WIFI_NM_WPA_SUPPLICANT
	default y if NETWORKING
configdefault WIFI_NM_WPA_SUPPLICANT_AP
	default y

configdefault NET_SOCKETS
	default y
configdefault NET_LOG
	default y
configdefault NET_IPV6
	default y
configdefault NET_IPV4
	default y
configdefault NET_UDP
	default y
configdefault NET_TCP
	default y
configdefault NET_DHCPV4
	default y
configdefault DNS_RESOLVER
	default y

configdefault NET_STATISTICS
	default y
configdefault NET_STATISTICS_WIFI
	default y
configdefault NET_STATISTICS_USER_API
	default y

configdefault NET_PKT_RX_COUNT
	default 8
configdefault NET_PKT_TX_COUNT
	default 8

endif # !CONFIG_WIFI_USAGE_MODE_SCAN_ONLY

source "Kconfig.zephyr"
```

## tests/drivers/wifi/nrf_wifi/testcase.yaml
```yaml
common:
  build_only: true
  tags:
    - drivers
    - wifi
    - net
    - nrf_wifi
  platform_allow:
    - nrf7002dk/nrf5340/cpuapp
tests:
  drivers.net.wifi.build.sta:
    extra_configs: []
  drivers.net.wifi.build.radio_test:
    extra_configs:
      - CONFIG_NRF70_RADIO_TEST=y
      - CONFIG_NETWORKING=n
  drivers.net.wifi.build.scan_only:
    extra_configs:
      - CONFIG_WIFI_USAGE_MODE_SCAN_ONLY=y
  drivers.net.wifi.build.raw_scan_results:
    extra_configs:
      - CONFIG_WIFI_USAGE_MODE_SCAN_ONLY=y
      - CONFIG_WIFI_MGMT_RAW_SCAN_RESULTS=y
  drivers.net.wifi.build.raw_tx:
    extra_configs:
      - CONFIG_NRF70_RAW_DATA_TX=y
  drivers.net.wifi.build.raw_rx:
    extra_configs:
      - CONFIG_NRF70_RAW_DATA_RX=y
  drivers.net.wifi.build.promiscuous:
    extra_configs:
      - CONFIG_NRF70_PROMISC_DATA_RX=y
  drivers.net.wifi.build.offloaded_raw_tx:
    extra_configs:
      - CONFIG_NRF70_OFFLOADED_RAW_TX=y
      - CONFIG_NETWORKING=n
  drivers.net.wifi.build.softap:
    extra_configs:
      - CONFIG_WIFI_USAGE_MODE_STA_AP=y
  drivers.net.wifi.build.p2p:
    extra_configs:
      - CONFIG_NRF70_P2P_MODE=y
  drivers.net.wifi.build.tx_align:
    extra_configs:
      - CONFIG_NET_PKT_BUF_TX_DATA_ALLOC_ALIGN_LEN=4
      - CONFIG_NET_BUF_VARIABLE_DATA_SIZE=y
  drivers.net.wifi.build.ethernet_stats:
    extra_configs:
      - CONFIG_NET_STATISTICS_ETHERNET=y
      - CONFIG_NET_STATISTICS_ETHERNET_VENDOR=y
  drivers.net.wifi.build.sr_coex:
    extra_configs:
      - CONFIG_NRF70_SR_COEX=y
    extra_args: SHIELD=nrf7002ek
    platform_allow:
      - nrf5340dk/nrf5340/cpuapp
    platform_exclude:
      - nrf7002dk/nrf5340/cpuapp
```

## tests/drivers/wuc/wkpu/testcase.yaml
```yaml
# Copyright 2026 NXP
# SPDX-License-Identifier: Apache-2.0

common:
  tags:
    - drivers
    - wuc
    - wkpu
  harness: ztest
tests:
  drivers.wuc.nxp_wkpu:
    # Exercises the WKPU WUC driver through the RTC-timeout internal wakeup
    # source (no external pin stimulus required).
    platform_allow:
      - frdm_mcxe31b
    integration_platforms:
      - frdm_mcxe31b
```

## tests/drivers/wuc/wuc_api/testcase.yaml
```yaml
# Copyright 2026 NXP
# SPDX-License-Identifier: Apache-2.0

common:
  tags:
    - drivers
    - wuc
tests:
  drivers.wuc.api:
    depends_on: wuc
    filter: dt_node_has_prop("/zephyr,user", "wakeup-ctrls")
```

## tests/drivers/zsai/zsai_simulator/boards/nrf52840dk_nrf52840.conf
```kconfig
#
# Copyright (c) 2023 Nordic Semiconductor ASA
#
# SPDX-License-Identifier: Apache-2.0
#

CONFIG_SOC_FLASH_NRF_ZSAI=y
```

## tests/drivers/zsai/zsai_simulator/testcase.yaml
```yaml
common:
  tags:
    - drivers
    - zsai
tests:
  drivers.zasi.zsai_simulator.without_erase:
    extra_args: DTC_OVERLAY_FILE=zsai_without_erase.overlay
    platform_allow: qemu_x86 native_posix native_sim
    integration_platforms:
      - native_posix
  drivers.zsai.zsai_simulator.with_erase:
    extra_args: DTC_OVERLAY_FILE=zsai_with_erase.overlay
    platform_allow: qemu_x86 native_posix native_sim
    integration_platforms:
      - native_posix
  drivers.zsai.zsai_simulator.both:
    extra_args: DTC_OVERLAY_FILE=zsai_with_erase.overlay:zsai_without_erase.overlay
    platform_allow: qemu_x86 native_posix
    integration_platforms:
      - native_posix
```

## tests/include/zephyr/zerror/testcase.yaml
```yaml
tests:
  include.zephyr.zerror:
    integration_platforms:
      - qemu_cortex_m3
      - native_sim
    harness: ztest
    tags: zerror
```

## tests/kconfig/configdefault/Kconfig
```kconfig
# SPDX-License-Identifier: Apache-2.0
# Copyright (c) 2022 CSIRO

config DEP_Y
	bool "Dependency that evaluates to enabled"
	default y

config DEP_N
	bool "Dependency that evaluates to disabled"
	default n

# configdefault after main def
config SYM_Y_1
	bool "SYM Y 1"

configdefault SYM_Y_1
	default y if DEP_Y

config SYM_N_1
	bool "SYM N 1"

configdefault SYM_N_1
	default y if DEP_N

# configdefault before main def
configdefault SYM_Y_2
	default y if DEP_Y

config SYM_Y_2
	bool "SYM Y 2"

configdefault SYM_N_2
	default y if DEP_N

config SYM_N_2
	bool "SYM N 2"

# configdefaults with multiple defaults
configdefault SYM_Y_3
	default y if DEP_Y
	default y if DEP_N

config SYM_Y_3
	bool "SYM Y 3"

configdefault SYM_N_3
	default y if DEP_N
	default y if DEP_N

config SYM_N_3
	bool "SYM N 3"

# multiple configdefaults
configdefault SYM_Y_4
	default y if DEP_Y
configdefault SYM_Y_4
	default y if DEP_N

config SYM_Y_4
	bool "SYM Y 4"

configdefault SYM_N_4
	default y if DEP_N
configdefault SYM_N_4
	default y if DEP_N

config SYM_N_4
	bool "SYM N 4"

# if surrounding configdefault
config SYM_Y_5
	bool "SYM Y 5"
if DEP_Y
configdefault SYM_Y_5
	default y
endif

config SYM_N_5
	bool "SYM N 5"
if DEP_N
configdefault SYM_N_5
	default y
endif

# if surrounding definition
if DEP_Y
config SYM_Y_6
	bool "SYM Y 6"
endif

configdefault SYM_Y_6
	default y

if DEP_N
config SYM_N_6
	bool "SYM N 6"
endif

configdefault SYM_N_6
	default y

# if surrounding complete
if DEP_Y
config SYM_Y_7
	bool "SYM Y 7"
configdefault SYM_Y_7
	default y
endif

if DEP_N
config SYM_N_7
	bool "SYM N 7"
configdefault SYM_N_7
	default y
endif

# configdefault default symbol
config SYM_Y_8
	bool "SYM Y 8"

configdefault SYM_Y_8
	default DEP_Y

config SYM_N_8
	bool "SYM N 8"

configdefault SYM_N_8
	default DEP_N

# configdefault with "prompt if <conditional==true>"
configdefault SYM_Y_9
	default y

config SYM_Y_9
	bool "SYM Y 9" if DEP_Y
	default y if DEP_N

configdefault SYM_N_9
	default n if DEP_Y

config SYM_N_9
	bool "SYM N 9" if DEP_Y
	default y

# configdefault with "prompt if <conditional==false>"
configdefault SYM_Y_10
	default y if DEP_Y

config SYM_Y_10
	bool "SYM Y 10" if DEP_N

configdefault SYM_N_10
	default n if DEP_Y

config SYM_N_10
	bool "SYM N 10" if DEP_N
	default y

# configdefault with "prompt if <conditional==true>" and surrounding 'if'
configdefault SYM_Y_11
	default y

if DEP_Y
config SYM_Y_11
	bool "SYM Y 11" if DEP_Y
	default y if DEP_N
endif

configdefault SYM_N_11
	default y

if DEP_N
config SYM_N_11
	bool "SYM N 11" if DEP_Y
	default n if DEP_N
endif

# Multiple symbols, no configdefault effect
configdefault SYM_Y_12
	default y if DEP_N

config SYM_Y_12
	bool "SYM Y 12"
	default y if DEP_N
	depends on DEP_N

config SYM_Y_12
	default y

configdefault SYM_N_12
	default y if DEP_N

config SYM_N_12
	bool "SYM N 12"
	default y if DEP_N

config SYM_N_12
	default n

# configdefault does not define integer
config SYM_INT_UNDEF
	int "Undefined integer"
	default 0
	depends on DEP_N

configdefault SYM_INT_UNDEF
	default 1

# Integer default
config SYM_INT_1
	int "Int 1"
	depends on DEP_Y

configdefault SYM_INT_1
	default 1

# configdefault doesn't overwrite ordering
config SYM_INT_2
	int "Int 2"
	default 2

configdefault SYM_INT_2
	default 3

configdefault SYM_INT_3
	default 3

configdefault SYM_INT_3
	default 4

config SYM_INT_3
	int "Int 3"
	default 2

configdefault SYM_INT_4
	default 3 if DEP_N

configdefault SYM_INT_4
	default 4

config SYM_INT_4
	int "Int 4"
	default 2

# Hex value
configdefault SYM_HEX_20
	default 0x20

config SYM_HEX_20
	hex "Hex 0x20"

# String value
configdefault SYM_STRING
	default "TEST"

config SYM_STRING
	string "Hex 0x20"

source "Kconfig.zephyr"
```
