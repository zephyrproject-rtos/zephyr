/*
 * Copyright (c) 2022 STMicroelectronics
 *
 * SPDX-License-Identifier: Apache-2.0
 */

/ {
	aliases {
		watchdog0 = &wwdg;
	};
};

/* stm32h7 has no apb1 prescaler */

&wwdg {
	status = "okay";
};

&iwdg {
	status = "disabled";
};
