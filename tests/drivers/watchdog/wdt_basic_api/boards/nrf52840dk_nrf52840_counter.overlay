/*
 * Copyright (c) 2021 Nordic Semiconductor ASA
 *
 * SPDX-License-Identifier: Apache-2.0
 */

&timer0 {
	interrupts = <8 0>;
	zli;
	status = "okay";
};

&wdt0 {
	status = "disabled";
};

/ {
	wdt_counter: wdt-counter {
		compatible = "zephyr,counter-watchdog";
		counter = <&timer0>;
		status = "okay";
	};
};
