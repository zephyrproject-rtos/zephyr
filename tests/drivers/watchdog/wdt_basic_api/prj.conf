## CMakeLists.txt
```
# SPDX-License-Identifier: Apache-2.0

cmake_minimum_required(VERSION 3.28.0)
find_package(Zephyr REQUIRED HINTS $ENV{ZEPHYR_BASE})
project(wdt_basic_api)

FILE(GLOB app_sources src/*.c)
target_sources(app PRIVATE ${app_sources})
```

## Kconfig
```
# SPDX-FileCopyrightText: Copyright (c) 2026 Infineon Technologies AG,
# SPDX-FileCopyrightText: or an affiliate of Infineon Technologies AG. All rights reserved.
#
# SPDX-License-Identifier: Apache-2.0

source "Kconfig.zephyr"

config TEST_WDT_NOINIT_SECTION
	string "Watchdog test's NOINIT section"
	default ".dtcm_noinit.test_wdt" if $(dt_chosen_enabled,$(DT_CHOSEN_Z_DTCM)) \
		  && !SOC_FAMILY_STM32
	default ".noinit.test_wdt"
	help
	  Set the memory region used as NOINIT for the
	  wdt_basic_api test.
```

## prj.conf
```kconfig
CONFIG_WATCHDOG=y
CONFIG_WDT_DISABLE_AT_BOOT=n
CONFIG_ZTEST=y
CONFIG_BOOT_BANNER=n
```

## nucleo_l496zg.conf
```kconfig
# 2MHz system clock
CONFIG_SYS_CLOCK_HW_CYCLES_PER_SEC=2000000

# SYSCLK selection
CONFIG_CLOCK_STM32_SYSCLK_SRC_MSI=y
# produce 2MHz clock at MSI RC output
CONFIG_CLOCK_STM32_MSI_RANGE=5
# select buses prescalers
CONFIG_CLOCK_STM32_AHB_PRESCALER=1
CONFIG_CLOCK_STM32_APB1_PRESCALER=1
CONFIG_CLOCK_STM32_APB2_PRESCALER=1
```

## boards/frdm_imxrt700_mimxrt798s_cm33_cpu0.conf
```kconfig
# SPDX-FileCopyrightText: Copyright 2026 NXP
# SPDX-License-Identifier: Apache-2.0

CONFIG_ARM_MPU_SRAM_WRITE_THROUGH=y
CONFIG_WDT_MCUX_WWDT_WARNING_INTERRUPT_CFG=10
```

## boards/frdm_mcxa156.conf
```kconfig
# SPDX-FileCopyrightText: Copyright 2026 NXP
# SPDX-License-Identifier: Apache-2.0

# Run the callback before the watchdog resets the SoC.
CONFIG_WDT_MCUX_WWDT_WARNING_INTERRUPT_CFG=10
```

## boards/frdm_mcxa287.conf
```kconfig
# SPDX-FileCopyrightText: Copyright 2026 NXP
# SPDX-License-Identifier: Apache-2.0

CONFIG_PM=y
```

## boards/frdm_mcxc444.conf
```kconfig
# Copyright 2025 NXP
# SPDX-License-Identifier: Apache-2.0

CONFIG_WDT_DISABLE_AT_BOOT=y
```

## boards/frdm_mcxe31b.conf
```kconfig
# Copyright 2025 NXP
# SPDX-License-Identifier: Apache-2.0

CONFIG_CLEAR_DESTRUCTIVE_RESET_FLAG=0x1
```

## zephyr_sram3.overlay
```dts
/*
 * Copyright (c) 2026 Analog Devices, Inc.
 *
 * SPDX-License-Identifier: Apache-2.0
 */

/ {
	chosen {
		zephyr,sram = &sram3;
	};
};
```

## boards/adp_xc7k_ae350_clic.overlay
```dts
/*
 * Copyright (c) 2026 Andes Technology Corporation.
 *
 * SPDX-License-Identifier: Apache-2.0
 */

/ {
	aliases {
		watchdog0 = &wdt;
	};
};
```

## boards/bl54l15_dvk_nrf54l10_cpuapp.overlay
```dts
/*
 * Copyright (c) 2024 Nordic Semiconductor ASA
 * Copyright (c) 2025 Ezurio LLC
 *
 * SPDX-License-Identifier: Apache-2.0
 */

&wdt31 {
	status = "okay";
};
```

## boards/bl54l15u_dvk_nrf54l15_cpuflpr.overlay
```dts
/*
 * Copyright 2024 Nordic Semiconductor ASA
 * Copyright (c) 2025 Ezurio LLC
 * SPDX-License-Identifier: Apache-2.0
 */

&wdt31 {
	status = "okay";
};
```

## boards/bl54l15u_dvk_nrf54l15_cpuflpr_xip.overlay
```dts
/*
 * Copyright 2024 Nordic Semiconductor ASA
 * Copyright (c) 2025 Ezurio LLC
 *
 * SPDX-License-Identifier: Apache-2.0
 */

&wdt31 {
	status = "okay";
};
```

## boards/cc3220sf_launchxl_cc3220sf.overlay
```dts
&wdt0 {
	status = "okay";
};
```

## src/main.c
```c
/*
 * Copyright (c) 2016 Intel Corporation
 * Copyright (c) 2018 Nordic Semiconductor
 *
 * SPDX-License-Identifier: Apache-2.0
 */

/**
 * @addtogroup t_driver_wdt
 * @{
 * @defgroup t_wdt_basic test_wdt_basic_operations
 * @}
 */

#include <zephyr/kernel.h>
#include <zephyr/ztest.h>

ZTEST_SUITE(wdt_basic_test_suite, NULL, NULL, NULL, NULL, NULL);
```

## src/test_wdt.c
```c
/*
 * Copyright (c) 2018 Nordic Semiconductor.
 * Copyright 2025 NXP
 *
 * SPDX-License-Identifier: Apache-2.0
 */

/*
 * @addtogroup t_wdt_basic
 * @{
 * @defgroup t_wdt_timeout test_wdt_timeout_capabilities
 * @brief TestPurpose: verify Watchdog Timer install/setup/feed can work,
 *        and reset can be triggered when timeout
 * @details
 * There are multiple tests, conditional on Kconfig and devicetree.
 * Each test provides watchdog installation, setup and wait for reset.
 * Four variables are placed in noinit section to prevent
 * clearing them during board reset.These variables save number of the current
 * test case, current test state, callback value, and a magic number to detect
 * uninitialized noinit section on first boot.
 *
 * - Test Steps - test_wdt_no_callback
 *   -# Get device.
 *   -# Check if the state was changed and test should be finished.
 *   -# Set callback to NULL value.
 *   -# Install watchdog with current configuration.
 *   -# Setup watchdog with no additions options.
 *   -# Wait for reset.
 * - Expected Results
 *   -# If reset comes, the same testcase should be executed but state should
 *      be set to finish value and test should return with success.
 *
 * - Test Steps - test_wdt_callback_1
 *   -# Get device.
 *   -# Check if the state was changed. If so check testvalue if interrupt
 *      occurred.
 *   -# Set callback as pointer to wdt_int_cb0.
 *   -# Install watchdog with current configuration.
 *   -# Setup watchdog with no additions options.
 *   -# Wait for reset.
 * - Expected Results
 *   -# If reset comes, the same testcase should be executed but state should be
 *      set to finish value and test checks if m_testvalue was set in interrupt
 *      right before reset.
 *
 * - Test Steps - test_wdt_callback_2
 *   -# Get device.
 *   -# Check if the state was changed. If so check testvalue if interrupt
 *      occurred.
 *   -# Install two watchdogs: set pointer to wdt_int_cb0 as callback for first
 *      watchdog and wdt_int_cb1 for second one.
 *   -# Install watchdog with current configuration.
 *   -# Setup watchdog with no additions options.
 *   -# Wait for reset and feed first watchdog.
 * - Expected Results
 *   -# If reset comes, the same testcase should be executed but state should be
 *      set to finish value and test checks if m_testvalue was set in callback
 *      of second watchdog right before reset.
 *
 * @}
 */

#include <zephyr/cache.h>
#include <zephyr/drivers/watchdog.h>
#include <zephyr/kernel.h>
#include <zephyr/ztest.h>

/*
 * To use this test, either the devicetree's /aliases must have a
 * 'watchdog0' property, or one of the following watchdog compatibles
 * must have an enabled node.
 */
#if DT_NODE_HAS_STATUS_OKAY(DT_ALIAS(watchdog0))
#define WDT_NODE DT_ALIAS(watchdog0)
#elif DT_HAS_COMPAT_STATUS_OKAY(nordic_nrf_wdt)
#define WDT_NODE DT_INST(0, nordic_nrf_wdt)
#define TIMEOUTS 2
#elif DT_HAS_COMPAT_STATUS_OKAY(espressif_esp32_watchdog)
#define WDT_NODE DT_INST(0, espressif_esp32_watchdog)
#elif DT_HAS_COMPAT_STATUS_OKAY(silabs_gecko_wdog)
#define WDT_NODE DT_INST(0, silabs_gecko_wdog)
#elif DT_HAS_COMPAT_STATUS_OKAY(nxp_wdog32)
#define WDT_NODE DT_INST(0, nxp_wdog32)
#elif DT_HAS_COMPAT_STATUS_OKAY(microchip_xec_watchdog)
#define WDT_NODE DT_INST(0, microchip_xec_watchdog)
#elif DT_HAS_COMPAT_STATUS_OKAY(nuvoton_npcx_watchdog)
#define WDT_NODE DT_INST(0, nuvoton_npcx_watchdog)
#elif DT_HAS_COMPAT_STATUS_OKAY(ti_cc32xx_watchdog)
#define WDT_NODE DT_INST(0, ti_cc32xx_watchdog)
#elif DT_HAS_COMPAT_STATUS_OKAY(nxp_imx_wdog)
#define WDT_NODE DT_INST(0, nxp_imx_wdog)
#elif DT_HAS_COMPAT_STATUS_OKAY(gd_gd32_wwdgt)
#define WDT_NODE DT_INST(0, gd_gd32_wwdgt)
#elif DT_HAS_COMPAT_STATUS_OKAY(gd_gd32_fwdgt)
#define WDT_NODE DT_INST(0, gd_gd32_fwdgt)
#elif DT_HAS_COMPAT_STATUS_OKAY(realtek_bee_core_wdt)
#define WDT_NODE DT_INST(0, realtek_bee_core_wdt)
#define TIMEOUTS 0
#define WDT_TEST_MAX_WINDOW 5000U
#elif DT_HAS_COMPAT_STATUS_OKAY(zephyr_counter_watchdog)
#define WDT_NODE DT_COMPAT_GET_ANY_STATUS_OKAY(zephyr_counter_watchdog)
#elif DT_HAS_COMPAT_STATUS_OKAY(silabs_siwx91x_wdt)
#define WDT_NODE DT_INST(0, silabs_siwx91x_wdt)
#elif DT_HAS_COMPAT_STATUS_OKAY(nuvoton_numaker_wwdt)
#define WDT_NODE DT_INST(0, nuvoton_numaker_wwdt)
#define TIMEOUTS 1
#elif DT_HAS_COMPAT_STATUS_OKAY(nuvoton_numaker_wdt)
#define WDT_NODE DT_INST(0, nuvoton_numaker_wdt)
#define TIMEOUTS 1
#endif
#if DT_HAS_COMPAT_STATUS_OKAY(raspberrypi_pico_watchdog)
#define WDT_TEST_MAX_WINDOW 8000U
#define TIMEOUTS            0
#endif
#if DT_HAS_COMPAT_STATUS_OKAY(intel_tco_wdt)
#define TIMEOUTS            0
#define WDT_TEST_MAX_WINDOW 3000U
#endif
#if DT_HAS_COMPAT_STATUS_OKAY(nxp_wdog32)
#define WDT_TEST_MAX_WINDOW 1000U
#endif
#if DT_HAS_COMPAT_STATUS_OKAY(nxp_cop)
#define WDT_TEST_BAD_MAX_WINDOW 0
#define WDT_TEST_FINAL_DISABLE  1
#endif
#if DT_HAS_COMPAT_STATUS_OKAY(bflb_wdt)
#define WDT_TEST_MAX_WINDOW 1999U
#endif
#if DT_HAS_COMPAT_STATUS_OKAY(andestech_atcwdt200)
#define TIMEOUTS            0
#define WDT_TEST_MAX_WINDOW 200U
#endif
#if DT_HAS_COMPAT_STATUS_OKAY(st_stm32_window_watchdog)
#define TIMEOUTS            0
#if defined(CONFIG_SOC_SERIES_STM32F7X)
#define WDT_TEST_MAX_WINDOW 170
#else
#define WDT_TEST_MAX_WINDOW 200
#endif
#endif
#if DT_HAS_COMPAT_STATUS_OKAY(nordic_nrf_gswdt) && !defined(CONFIG_NRFS_GSWDT_SERVICE_ENABLED)
#define WDT_TEST_MAX_WINDOW 6000U
#endif
#if DT_HAS_COMPAT_STATUS_OKAY(xen_watchdog)
#define TIMEOUTS DT_PROP(WDT_NODE, num_channels)
#define WDT_TEST_MAX_WINDOW 3000U
#define WDT_OPT_PAUSE_IN_SLEEP_SUPPORTED 0
#endif

#define WDT_TEST_STATE_IDLE        0
#define WDT_TEST_STATE_CHECK_RESET 1

#define WDT_TEST_CB0_TEST_VALUE 0x0CB0
#define WDT_TEST_CB1_TEST_VALUE 0x0CB1

/* Magic number to detect first boot vs reset */
#define WDT_TEST_MAGIC_NUMBER ((DATATYPE)0xDEADBEEF)

#ifndef WDT_TEST_MAX_WINDOW
#define WDT_TEST_MAX_WINDOW 2000U
#endif

#ifndef TIMEOUTS
#define TIMEOUTS 1
#endif

#if !(defined(CONFIG_HAS_WDT_NO_CALLBACKS) && CONFIG_HAS_WDT_NO_CALLBACKS)
#define TEST_WDT_CALLBACK_1 (TIMEOUTS > 0)
#define TEST_WDT_CALLBACK_2 (TIMEOUTS > 1)
#define TEST_WDT_NO_CALLBACK_2 0
#else
#define TEST_WDT_CALLBACK_1 0
#define TEST_WDT_CALLBACK_2 0
#define TEST_WDT_NO_CALLBACK_2 (TIMEOUTS > 1)
#endif

#ifndef WDT_OPT_PAUSE_IN_SLEEP_SUPPORTED
#define WDT_OPT_PAUSE_IN_SLEEP_SUPPORTED 1
#endif

#if CONFIG_PM && WDT_OPT_PAUSE_IN_SLEEP_SUPPORTED
#define TEST_WDT_WAIT_MODE 1
#endif

#ifndef WDT_TEST_BAD_MAX_WINDOW
#define WDT_TEST_BAD_MAX_WINDOW 1
#endif

static struct wdt_timeout_cfg m_cfg_wdt0;
#if TEST_WDT_CALLBACK_2 || TEST_WDT_NO_CALLBACK_2
static struct wdt_timeout_cfg m_cfg_wdt1;
#endif

#if defined(CONFIG_SOC_SERIES_STM32F7X) || defined(CONFIG_SOC_SERIES_STM32H7X)
/* STM32H7 and STM32F7 guarantee last write RAM retention over reset,
 * only for 64bits
 * See details in Application Note AN5342
 */
#define DATATYPE uint64_t
#else
#define DATATYPE uint32_t
#endif

/* Set NOINIT_SECTION based on Kconfig settings.
 * Defaults are '.noinit.test_wdt' and '.dtcm_noinit.test_wdt', based on
 * configuration.
 */
#define NOINIT_SECTION CONFIG_TEST_WDT_NOINIT_SECTION

/* m_state indicates state of particular test. Used to check whether testcase
 * should go to reset state or check other values after reset.
 */
volatile DATATYPE m_state __attribute__((section(NOINIT_SECTION)));

/* m_testcase_index is incremented after each test to make test possible
 * switch to next testcase.
 */
volatile DATATYPE m_testcase_index __attribute__((section(NOINIT_SECTION)));

/* m_testvalue contains value set in interrupt callback to point whether
 * first or second interrupt was fired.
 */
volatile DATATYPE m_testvalue __attribute__((section(NOINIT_SECTION)));

/* m_magic is used to detect first boot (random value) vs reset (magic retained) */
volatile DATATYPE m_magic __attribute__((section(NOINIT_SECTION)));

/* Commit the noinit state to memory: a watchdog reset discards dirty
 * write-back cache lines
 */
static void commit_noinit_state(void)
{
	sys_cache_data_flush_range((void *)(uintptr_t)&m_state, sizeof(m_state));
	sys_cache_data_flush_range((void *)(uintptr_t)&m_testcase_index, sizeof(m_testcase_index));
	sys_cache_data_flush_range((void *)(uintptr_t)&m_testvalue, sizeof(m_testvalue));
	sys_cache_data_flush_range((void *)(uintptr_t)&m_magic, sizeof(m_magic));
}

#if TEST_WDT_CALLBACK_1
static void wdt_int_cb0(const struct device *wdt_dev, int channel_id)
{
	ARG_UNUSED(wdt_dev);
	ARG_UNUSED(channel_id);
	m_testvalue += WDT_TEST_CB0_TEST_VALUE;
	commit_noinit_state();
}
#endif

#if TEST_WDT_CALLBACK_2
static void wdt_int_cb1(const struct device *wdt_dev, int channel_id)
{
	ARG_UNUSED(wdt_dev);
	ARG_UNUSED(channel_id);
	m_testvalue += WDT_TEST_CB1_TEST_VALUE;
	commit_noinit_state();
}
#endif

static int test_wdt_no_callback(void)
{
	int err;
	const struct device *const wdt = DEVICE_DT_GET(WDT_NODE);

	TC_PRINT("Testcase: %s\n", __func__);

	if (!device_is_ready(wdt)) {
		TC_PRINT("WDT device is not ready\n");
		return TC_FAIL;
	}

	if (m_state == WDT_TEST_STATE_CHECK_RESET) {
		m_state = WDT_TEST_STATE_IDLE;
		m_testcase_index = 1U;
		TC_PRINT("Testcase passed\n");
		return TC_PASS;
	}

	m_cfg_wdt0.callback = NULL;
	m_cfg_wdt0.flags = WDT_FLAG_RESET_SOC;
	m_cfg_wdt0.window.max = WDT_TEST_MAX_WINDOW;
	err = wdt_install_timeout(wdt, &m_cfg_wdt0);
	if (err < 0) {
		TC_PRINT("Watchdog install error\n");
		return TC_FAIL;
	}

	err = wdt_setup(wdt, WDT_OPT_PAUSE_HALTED_BY_DBG);
	if (err == -ENOTSUP) {
		TC_PRINT("- pausing watchdog by debugger is not supported\n");
		err = wdt_setup(wdt, 0);
	}
	if (err < 0) {
		TC_PRINT("Watchdog setup error\n");
		return TC_FAIL;
	}

	TC_PRINT("Waiting to restart MCU\n");
	m_testvalue = 0U;
	m_state = WDT_TEST_STATE_CHECK_RESET;
	commit_noinit_state();
	while (1) {
		k_yield();
	}
}

#if TEST_WDT_CALLBACK_1
static int test_wdt_callback_1(void)
{
	int err;
	const struct device *const wdt = DEVICE_DT_GET(WDT_NODE);

	TC_PRINT("Testcase: %s\n", __func__);

	if (!device_is_ready(wdt)) {
		TC_PRINT("WDT device is not ready\n");
		return TC_FAIL;
	}

	if (m_state == WDT_TEST_STATE_CHECK_RESET) {
		m_state = WDT_TEST_STATE_IDLE;
		m_testcase_index++;
		if (m_testvalue == WDT_TEST_CB0_TEST_VALUE) {
			TC_PRINT("Testcase passed\n");
			return TC_PASS;
		} else {
			return TC_FAIL;
		}
	}

	err = wdt_disable(wdt);
	if (err < 0 && err != -EPERM && err != -EFAULT) {
		TC_PRINT("Watchdog disable error\n");
		return TC_FAIL;
	}

	m_testvalue = 0U;
	m_cfg_wdt0.flags = WDT_FLAG_RESET_SOC;
	m_cfg_wdt0.callback = wdt_int_cb0;
	m_cfg_wdt0.window.max = WDT_TEST_MAX_WINDOW;
	err = wdt_install_timeout(wdt, &m_cfg_wdt0);
	if (err < 0) {
		if (err == -ENOTSUP) {
			TC_PRINT("CB1 not supported on platform\n");
			m_testcase_index++;
			return TC_PASS;
		}
		TC_PRINT("Watchdog install error\n");
		return TC_FAIL;
	}

	err = wdt_setup(wdt, WDT_OPT_PAUSE_HALTED_BY_DBG);
	if (err == -ENOTSUP) {
		TC_PRINT("- pausing watchdog by debugger is not supported\n");
		err = wdt_setup(wdt, 0);
	}
	if (err < 0) {
		TC_PRINT("Watchdog setup error\n");
		return TC_FAIL;
	}

	TC_PRINT("Waiting to restart MCU\n");
	m_testvalue = 0U;
	m_state = WDT_TEST_STATE_CHECK_RESET;
	commit_noinit_state();
	while (1) {
		k_yield();
	}
}
#endif

#if TEST_WDT_CALLBACK_2
static int test_wdt_callback_2(void)
{
	int err;
	const struct device *const wdt = DEVICE_DT_GET(WDT_NODE);

	TC_PRINT("Testcase: %s\n", __func__);

	if (!device_is_ready(wdt)) {
		TC_PRINT("WDT device is not ready\n");
		return TC_FAIL;
	}

	if (m_state == WDT_TEST_STATE_CHECK_RESET) {
		m_state = WDT_TEST_STATE_IDLE;
		m_testcase_index++;
		if (m_testvalue == WDT_TEST_CB1_TEST_VALUE) {
			TC_PRINT("Testcase passed\n");
			return TC_PASS;
		} else {
			return TC_FAIL;
		}
	}

	err = wdt_disable(wdt);
	if (err < 0 && err != -EPERM && err != -EFAULT) {
		TC_PRINT("Watchdog disable error\n");
		return TC_FAIL;
	}

	m_testvalue = 0U;
	m_cfg_wdt0.callback = wdt_int_cb0;
	m_cfg_wdt0.flags = WDT_FLAG_RESET_SOC;
	m_cfg_wdt0.window.max = WDT_TEST_MAX_WINDOW;
	err = wdt_install_timeout(wdt, &m_cfg_wdt0);

	if (err < 0) {
		TC_PRINT("Watchdog install error\n");
		return TC_FAIL;
	}

	m_cfg_wdt1.callback = wdt_int_cb1;
	m_cfg_wdt1.flags = WDT_FLAG_RESET_SOC;
	m_cfg_wdt1.window.max = WDT_TEST_MAX_WINDOW;
	err = wdt_install_timeout(wdt, &m_cfg_wdt1);
	if (err < 0) {
		TC_PRINT("Watchdog install error\n");
		return TC_FAIL;
	}

	err = wdt_setup(wdt, WDT_OPT_PAUSE_HALTED_BY_DBG);
	if (err == -ENOTSUP) {
		TC_PRINT("- pausing watchdog by debugger is not supported\n");
		err = wdt_setup(wdt, 0);
	}
	if (err < 0) {
		TC_PRINT("Watchdog setup error\n");
		return TC_FAIL;
	}

	TC_PRINT("Waiting to restart MCU\n");
	m_testvalue = 0U;
	m_state = WDT_TEST_STATE_CHECK_RESET;
	commit_noinit_state();

	while (1) {
		wdt_feed(wdt, 0);
		k_sleep(K_MSEC(100));
	}
}
#endif

#if TEST_WDT_NO_CALLBACK_2
static int test_wdt_no_callback_2(void)
{
	int err;
	int channel_id;
	const struct device *const wdt = DEVICE_DT_GET(WDT_NODE);

	TC_PRINT("Testcase: %s\n", __func__);

	if (!device_is_ready(wdt)) {
		TC_PRINT("WDT device is not ready\n");
		return TC_FAIL;
	}

	if (m_state == WDT_TEST_STATE_CHECK_RESET) {
		m_state = WDT_TEST_STATE_IDLE;
		m_testcase_index++;
		TC_PRINT("Testcase passed\n");
		return TC_PASS;
	}

	err = wdt_disable(wdt);
	if (err < 0 && err != -EPERM && err != -EFAULT) {
		TC_PRINT("Watchdog disable error\n");
		return TC_FAIL;
	}

	m_cfg_wdt0.callback = NULL;
	m_cfg_wdt0.flags = WDT_FLAG_RESET_SOC;
	m_cfg_wdt0.window.max = WDT_TEST_MAX_WINDOW;
	channel_id = wdt_install_timeout(wdt, &m_cfg_wdt0);
	if (channel_id < 0) {
		TC_PRINT("Watchdog install error\n");
		return TC_FAIL;
	}

	m_cfg_wdt1.callback = NULL;
	m_cfg_wdt1.flags = WDT_FLAG_RESET_SOC;
	m_cfg_wdt1.window.max = WDT_TEST_MAX_WINDOW;
	err = wdt_install_timeout(wdt, &m_cfg_wdt1);
	if (err < 0) {
		TC_PRINT("Watchdog install error\n");
		return TC_FAIL;
	}

	err = wdt_setup(wdt, WDT_OPT_PAUSE_HALTED_BY_DBG);
	if (err == -ENOTSUP) {
		TC_PRINT("- pausing watchdog by debugger is not supported\n");
		err = wdt_setup(wdt, 0);
	}
	if (err < 0) {
		TC_PRINT("Watchdog setup error\n");
		return TC_FAIL;
	}

	TC_PRINT("Waiting to restart MCU\n");
	m_testvalue = 0U;
	m_state = WDT_TEST_STATE_CHECK_RESET;
	commit_noinit_state();

	while (1) {
		wdt_feed(wdt, channel_id);
		k_sleep(K_MSEC(100));
	}
}
#endif

#if WDT_TEST_BAD_MAX_WINDOW
static int test_wdt_bad_window_max(void)
{
	int err;
	const struct device *const wdt = DEVICE_DT_GET(WDT_NODE);

	TC_PRINT("Testcase: %s\n", __func__);

	if (!device_is_ready(wdt)) {
		TC_PRINT("WDT device is not ready\n");
		return TC_FAIL;
	}

	err = wdt_disable(wdt);
	if (err < 0 && err != -EPERM && err != -EFAULT) {
		TC_PRINT("Watchdog disable error\n");
		return TC_FAIL;
	}

	m_cfg_wdt0.callback = NULL;
	m_cfg_wdt0.flags = WDT_FLAG_RESET_SOC;
	m_cfg_wdt0.window.max = 0U;
	err = wdt_install_timeout(wdt, &m_cfg_wdt0);
	if (err == -EINVAL) {
		return TC_PASS;
	}

	return TC_FAIL;
}
#endif

#if TEST_WDT_WAIT_MODE
static int test_wdt_enable_wait_mode(void)
{
	int err;
	int wdt_channel_id;
	const struct device *const wdt = DEVICE_DT_GET(WDT_NODE);

	TC_PRINT("Testcase: %s\n", __func__);

	if (!device_is_ready(wdt)) {
		TC_PRINT("WDT device is not ready\n");
		return TC_FAIL;
	}

	if (m_state == WDT_TEST_STATE_CHECK_RESET) {
		m_state = WDT_TEST_STATE_IDLE;
		m_testcase_index++;
		TC_PRINT("Testcase passed\n");
		return TC_PASS;
	}

	struct wdt_timeout_cfg wdt_config = {
		/* Reset SoC when watchdog timer expires. */
		.flags = WDT_FLAG_RESET_SOC,

		/* Expire watchdog after max window */
		.window.min = 0U,
		.window.max = 1000U,
	};

	wdt_channel_id = wdt_install_timeout(wdt, &wdt_config);
	if (wdt_channel_id < 0) {
		printk("Watchdog install error\n");
		return TC_FAIL;
	}

	err = wdt_setup(wdt, (WDT_OPT_PAUSE_HALTED_BY_DBG | WDT_OPT_PAUSE_IN_SLEEP));
	if (err == -ENOTSUP) {
		TC_PRINT("- pausing watchdog by debugger is not supported\n");
		err = wdt_setup(wdt, WDT_OPT_PAUSE_IN_SLEEP);
	}
	if (err == -ENOTSUP) {
		TC_PRINT("- pausing watchdog in sleep mode is not supported\n");
		err = wdt_setup(wdt, 0);
	}
	if (err < 0) {
		printk("Watchdog setup error\n");
		return TC_FAIL;
	}

	for (int i = 0; i < 20; ++i) {
		printk("Feeding watchdog... %d\n", i);
		wdt_feed(wdt, 0);
		k_sleep(K_MSEC(2000));
	}

	TC_PRINT("Waiting to restart MCU\n");
	m_testvalue = 0U;
	m_state = WDT_TEST_STATE_CHECK_RESET;
	commit_noinit_state();
	while (1) {
		k_yield();
	}

	return TC_PASS;
}
#endif

ZTEST(wdt_basic_test_suite, test_wdt)
{
	/* Initialize noinit variables on first boot (cold reset) */
	if (m_magic != WDT_TEST_MAGIC_NUMBER) {
		m_state = WDT_TEST_STATE_IDLE;
		m_testcase_index = 0;
		m_testvalue = 0;
		m_magic = WDT_TEST_MAGIC_NUMBER;
	}
	if (m_testcase_index == 0U) {
		zassert_true(test_wdt_no_callback() == TC_PASS);
	}
	if (m_testcase_index == 1U) {
#if TEST_WDT_CALLBACK_1
		zassert_true(test_wdt_callback_1() == TC_PASS);
#else
		m_testcase_index++;
#endif
	}
	if (m_testcase_index == 2U) {
#if TEST_WDT_CALLBACK_2
		zassert_true(test_wdt_callback_2() == TC_PASS);
#else
		m_testcase_index++;
#endif
	}
	if (m_testcase_index == 3U) {
#if TEST_WDT_NO_CALLBACK_2
		zassert_true(test_wdt_no_callback_2() == TC_PASS);
#else
		m_testcase_index++;
#endif
	}
	if (m_testcase_index == 4U) {
#if TEST_WDT_WAIT_MODE
		zassert_true(test_wdt_enable_wait_mode() == TC_PASS);
#else
		m_testcase_index++;
#endif
	}
	if (m_testcase_index == 5U) {
#if WDT_TEST_BAD_MAX_WINDOW
		zassert_true(test_wdt_bad_window_max() == TC_PASS);
#endif
		m_testcase_index++;
	}
	if (m_testcase_index > 5) {
		m_state = WDT_TEST_STATE_IDLE;
		m_magic = 0;
		m_testcase_index = 0;
		m_testvalue = 0;
#if WDT_TEST_FINAL_DISABLE
		const struct device *const wdt = DEVICE_DT_GET(WDT_NODE);

		wdt_disable(wdt);
#endif
	}
}
```

## src/test_wdt.h
```c
/*
 * Copyright (c) 2018 Nordic Semiconductor.
 *
 * SPDX-License-Identifier: Apache-2.0
 */

/**
 * @file
 * @brief WDT cases header file
 *
 * Header file for WDT cases
 */

#ifndef __TEST_WDT_H__
#define __TEST_WDT_H__

void test_wdt(void);

#endif /* __TEST_WDT_H__ */
```

## src/test_wdt_timeout.c
```c
/*
 * Copyright (c) 2016 Intel Corporation.
 *
 * SPDX-License-Identifier: Apache-2.0
 */

/*
 * @addtogroup t_wdt_basic
 * @{
 * @defgroup t_wdt_timeout test_wdt_timeout_capabilities
 * @brief TestPurpose: verify Watchdog Timer enable/disable/set/get can work,
 *			and Warm Reset can be triggered when timeout
 * @details
 * - Test Steps
 *   -# Enable Watchdog Timer
 *   -# Configure timeout, mode and interrupt_fn for Watchdog Timer
 *   -# Fetch Watchdog Timer configurations and compare the settings
 *   -# Disable Watchdog Timer to disable the Warm Reset
 *   -# Enable Watchdog Timer again and wait fortimeout and Warm Reset
 *   -# Use General Purpose Sticky Scratchpad 2 (GPS2) as a flag to
 *      indicate whether a Warm Reset happened, because Warm Reset won't
 *      clear it
 * - Expected Results
 *   -# If response mode is configured as Interrupt Reset, the interrupt
 *      callback function will be called first when the first timeout comes.
 *      The second timeout will trigger a Warm Reset and GPS2 will be two.
 *   -# If response mode is configured as Reset, a Warm Reset will be
 *      triggered when timeout and GPS2 will be one.
 * @}
 */

#ifdef CONFIG_BOARD_ESP32
#include <soc/rtc_cntl_reg.h>
#else
#include <qm_soc_regs.h>
#endif
#include <watchdog.h>
#include <zephyr.h>
#include <ztest.h>

#ifdef CONFIG_BOARD_ESP32
#define WDT_DEV_NAME CONFIG_WDT_ESP32_DEVICE_NAME
#define MWDT1_GLOBAL_RST	0x08
#define RWDT_SYSTEM_RST		0x10
#else
#define WDT_DEV_NAME CONFIG_WDT_0_NAME
#endif

#ifdef CONFIG_BOARD_ESP32
static volatile u32_t *gp_retention_reg0 = (u32_t *)(RTC_CNTL_STORE0_REG);
static volatile u32_t *gp_retention_reg1 = (u32_t *)(RTC_CNTL_STORE1_REG);

static int wdt_reset_reason(void)
{
	/*Reading reset cause of PRO CPU*/
	volatile u32_t *wdt_rtc_rst_procpu =
		(u32_t *)(RTC_CNTL_RESET_STATE_REG);
	/* RTC_CNTL_RESET_CAUSE_PROCPU :bitpos:[5:0] */
	return *wdt_rtc_rst_procpu & 0x1F;
}
#endif

static void wdt_int_cb(struct device *wdt_dev)
{
	static u32_t wdt_int_cnt;

	TC_PRINT("%s: Invoked (%u)\n", __func__, ++wdt_int_cnt);
#ifdef CONFIG_BOARD_ESP32
	(*gp_retention_reg1)++;
#else
	QM_SCSS_GP->gps2++;
#endif
#ifdef INT_RESET
	/* Don't come out from the loopback to avoid have the interrupt
	 * cleared and the system will reset in interrupt reset mode
	 */
	while (1)
	;
#endif
}

static int test_wdt(u32_t timeout, enum wdt_mode r_mode)
{
	struct wdt_config config;
	struct device *wdt = device_get_binding(WDT_DEV_NAME);

#ifdef CONFIG_BOARD_ESP32
	/*Initialize retention registers to 0 on first boot*/
	if (wdt_reset_reason() == RWDT_SYSTEM_RST) {
		*gp_retention_reg0 = 0;
		*gp_retention_reg1 = 0;
	}
#endif
	if (!wdt) {
		TC_PRINT("Cannot get WDT device\n");
		return TC_FAIL;
	}

	config.timeout = timeout;
	config.mode = r_mode;
	if (r_mode == WDT_MODE_INTERRUPT_RESET) {
		config.interrupt_fn = wdt_int_cb;
	} else {
		config.interrupt_fn = NULL;
	}

	/* 1. Verify wdt_enable() */
	wdt_enable(wdt);

	/* 2. Verify wdt_set_config() */
	if (wdt_set_config(wdt, &config)) {
		TC_PRINT("Fail to configure WDT device\n");
		wdt_disable(wdt);
		return TC_FAIL;
	}

	/* 3. Verify wdt_get_config() */
	wdt_get_config(wdt, &config);

	if (timeout != config.timeout || r_mode != config.mode) {
		TC_PRINT("Fetch config doesn't match with set config\n");
		TC_PRINT("timeout = %d, config.timeout = %d", timeout,
			 config.timeout);
		TC_PRINT("r_mode = %d, config.mode = %d", r_mode, config.mode);
		wdt_disable(wdt);
		return TC_FAIL;
	}

	/* 4. Verify wdt_disable(), and Warm Reset won't happen */
	wdt_disable(wdt);

#ifdef CONFIG_BOARD_ESP32
	if (*gp_retention_reg0) {
		TC_PRINT("A Warm Reset shouldn't happen when Timer disabled\n");
		return TC_FAIL;
	}
	*gp_retention_reg0 = 1;
#else
	if (QM_SCSS_GP->gps3) {
		TC_PRINT("A Warm Reset shouldn't happen when Timer disabled\n");
		return TC_FAIL;
	}

	QM_SCSS_GP->gps3 = 1;
#endif
	/*
	 * Wait to check whether a Warm Reset will happen.
	 * The sleep time should be longer than Watchdog Timer
	 * timeout value. If a Warm Reset happens, gps3 won't be
	 * cleared and then when the program comes here again,
	 * it will notice this and return a failure.
	 */
	k_sleep(5000);

#ifdef CONFIG_BOARD_ESP32
	*gp_retention_reg0 = 0;
#else
	QM_SCSS_GP->gps3 = 0;
#endif

	/* 5. Verify watchdog trigger a Warm Reset */
	wdt_enable(wdt);

#ifdef CONFIG_BOARD_ESP32
	if (!*gp_retention_reg1 && (wdt_reset_reason() == RWDT_SYSTEM_RST)) {
		TC_PRINT("Waiting for WDT reset\n");
		*gp_retention_reg1 = 1;
		while (1)
			;
	} else {
		if (r_mode == WDT_MODE_INTERRUPT_RESET) {
			if ((*gp_retention_reg1 == 2) &&
				(wdt_reset_reason() == MWDT1_GLOBAL_RST)) {
				wdt_disable(wdt);
				return TC_PASS;
			}
		} else {
			if (*gp_retention_reg1 &&
				(wdt_reset_reason() == MWDT1_GLOBAL_RST)) {
				wdt_disable(wdt);
				return TC_PASS;
			}
		}
		TC_PRINT("gp_retention_reg1 = %d\n", *gp_retention_reg1);
		wdt_disable(wdt);
		return TC_FAIL;
	}

#else
	if (!QM_SCSS_GP->gps2) {
		TC_PRINT("Waiting for WDT reset\n");
		QM_SCSS_GP->gps2 = 1;
		while (1)
			;
	} else {
		if (r_mode == WDT_MODE_INTERRUPT_RESET) {
			if (QM_SCSS_GP->gps2 == 2) {
				wdt_disable(wdt);
				return TC_PASS;
			}
		} else {
			if (QM_SCSS_GP->gps2) {
				wdt_disable(wdt);
				return TC_PASS;
			}
		}
		TC_PRINT("QM_SCSS_GP->gps2 = %d\n", QM_SCSS_GP->gps2);
		wdt_disable(wdt);
		return TC_FAIL;
	}
#endif
}

/*
 * Choose WDT_2_26_CYCLES as watchdog timeout cycle, which will
 * timeout in 2.097s. Other timeout cycles are the same.
 */
void test_wdt_int_reset_26(void)
{
	zassert_true(test_wdt(WDT_2_26_CYCLES,
			     WDT_MODE_INTERRUPT_RESET) == TC_PASS, NULL);
#ifdef CONFIG_BOARD_ESP32
	*gp_retention_reg1 = 0;
	*gp_retention_reg0 = 0;
#else
	QM_SCSS_GP->gps2 = 0;
#endif
}

void test_wdt_reset_26(void)
{
	zassert_true(test_wdt(WDT_2_26_CYCLES,
			     WDT_MODE_RESET) == TC_PASS, NULL);
#ifdef CONFIG_BOARD_ESP32
	*gp_retention_reg1 = 0;
	*gp_retention_reg0 = 0;
#else
	QM_SCSS_GP->gps2 = 0;
#endif
}
```
