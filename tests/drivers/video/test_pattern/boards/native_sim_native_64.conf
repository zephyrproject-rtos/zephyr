## tests/drivers/video/test_pattern/boards/native_sim_native_64.conf
```kconfig
CONFIG_VIDEO_BUFFER_POOL_SZ_MAX=33000
CONFIG_VIDEO_BUFFER_POOL_NUM_MAX=1
CONFIG_VIDEO_FRAME_HEIGHT=64
CONFIG_VIDEO_FRAME_WIDTH=256
CONFIG_VIDEO_PIXEL_FORMAT="RGBP"
CONFIG_LAB_THRESHOLD=30
```

## tests/drivers/video/test_pattern/testcase.yaml
```yaml
# Copyright The Zephyr Project Contributors
# SPDX-License-Identifier: Apache-2.0

common:
  tags:
    - drivers
    - video

tests:

  drivers.video.test_pattern.sw_generator:
    platform_allow:
      - native_sim/native/64
    integration_platforms:
      - native_sim/native/64
    extra_args:
      - SNIPPET="video-sw-generator"

  drivers.video.test_pattern.mimxrt1170_evk:
    platform_allow:
      - mimxrt1170_evk/mimxrt1176/cm7
    extra_args:
      - SHIELD="nxp_btb44_ov5640;rk055hdmipi4ma0"
```

## tests/drivers/virtualization/ivshmem/plain/boards/qemu_kvm_arm64.conf
```kconfig
CONFIG_PCIE_CONTROLLER=y
CONFIG_PCIE_ECAM=y

# Hungry PCI requires at least 256M of virtual space
CONFIG_KERNEL_VM_SIZE=0x80000000

# Hungry PCI requires phys addresses with more than 32 bits
CONFIG_ARM64_VA_BITS_40=y
CONFIG_ARM64_PA_BITS_40=y
```

## tests/drivers/virtualization/ivshmem/plain/testcase.yaml
```yaml
tests:
  virtualization.ivshmem:
    arch_allow: x86 arm64
    platform_allow: qemu_x86_64 qemu_cortex_a53 qemu_kvm_arm64
```

## tests/drivers/virtualization/ivshmem/testcase.yaml
```yaml
tests:
  virtualization.ivshmem:
    arch_allow: x86
    platform_allow: qemu_x86_64
```

## tests/drivers/w1/w1_api/dts/bindings/test,w1-dummy-slave.yaml
```yaml
# Copyright (c) 2022, Thomas Stranger
# SPDX-License-Identifier: Apache-2.0

description: 1-Wire dummy slave

compatible: "test-w1-dummy-slave"

include: w1-slave.yaml
```

## tests/drivers/w1/w1_api/dts/bindings/vnd,w1-device.yaml
```yaml
# Copyright (c) 2022, Thomas Stranger
# SPDX-License-Identifier: Apache-2.0

description: 1-Wire dummy slave

compatible: "vnd,w1-device"

include: w1-slave.yaml
```

## tests/drivers/w1/w1_api/testcase.yaml
```yaml
common:
  tags:
    - drivers
    - w1
    - userspace
  harness: ztest

tests:
  drivers.w1.w1-serial:
    depends_on: arduino_serial
    extra_args: DTC_OVERLAY_FILE=w1_serial.overlay
    harness_config:
      fixture: w1_serial_idle
    platform_allow:
      - nucleo_g0b1re
      - nrf52840dk/nrf52840
    integration_platforms:
      - nrf52840dk/nrf52840
  drivers.w1.ds2482-800:
    depends_on: arduino_i2c
    extra_args: DTC_OVERLAY_FILE=ds2482-800.overlay
    harness_config:
      fixture: w1_ds2482_800_idle
    integration_platforms:
      - nrf52840dk/nrf52840
  drivers.w1.ds2484:
    depends_on: arduino_i2c
    extra_args: DTC_OVERLAY_FILE=ds2484.overlay
    harness_config:
      fixture: w1_ds2484_idle
    integration_platforms:
      - nrf52840dk/nrf52840
  drivers.w1.ds2485:
    depends_on: arduino_i2c
    extra_args: DTC_OVERLAY_FILE=ds2485.overlay
    harness_config:
      fixture: w1_ds2485_idle
    integration_platforms:
      - nrf52840dk/nrf52840
  drivers.w1.max32:
    filter: dt_compat_enabled("adi,max32-w1")
    platform_allow:
      - apard32690/max32690/m4
      - max32655evkit/max32655/m4
      - max32666fthr/max32666/cpu0
      - max32666evkit/max32666/cpu0
      - max32680evkit/max32680/m4
      - max32690evkit/max32690/m4
      - max78002evkit/max78002/m4
```

## tests/drivers/watchdog/wdt_basic_api/Kconfig
```kconfig
# Copyright (c) 2026 Infineon Technologies AG,
# or an affiliate of Infineon Technologies AG.
#
# SPDX-License-Identifier: Apache-2.0

source "Kconfig.zephyr"

config TEST_WDT_NOINIT_SECTION
	string "Watchdog test's NOINIT section"
	default ".dtcm_noinit.test_wdt" if $(dt_chosen_enabled,$(DT_CHOSEN_Z_DTCM)) \
		  && !SOC_FAMILY_STM32
	default ".noinit.test_wdt"
	help
	  Set the memory region used as NOINIT for the
	  wdt_basic_api test.
```

## tests/drivers/watchdog/wdt_basic_api/boards/frdm_mcxc444.conf
```kconfig
# Copyright 2025 NXP
# SPDX-License-Identifier: Apache-2.0

CONFIG_WDT_DISABLE_AT_BOOT=y
```

## tests/drivers/watchdog/wdt_basic_api/boards/frdm_mcxe31b.conf
```kconfig
# Copyright 2025 NXP
# SPDX-License-Identifier: Apache-2.0

CONFIG_CLEAR_DESTRUCTIVE_RESET_FLAG=0x1
```

## tests/drivers/watchdog/wdt_basic_api/boards/kit_pse84_eval_pse846gps2dbzc4a_m55.conf
```kconfig
# Copyright (c) 2026 Infineon Technologies AG,
# or an affiliate of Infineon Technologies AG.
#
# SPDX-License-Identifier: Apache-2.0

CONFIG_TEST_WDT_NOINIT_SECTION=".cy_sharedmem"
```

## tests/drivers/watchdog/wdt_basic_api/boards/lpcxpresso55s06.conf
```kconfig
# Copyright 2026 NXP
# SPDX-License-Identifier: Apache-2.0

# lpcxpresso55s06 runs in TrustZone NS mode. The Secure Boot ROM clears
# NS SRAM (0x20000000) on every reset, including WWDT warm resets.
# SRAMX (0x04000000) is a separate NOLOAD region not cleared by the Boot ROM,
# so place the noinit test variables there to survive WWDT resets.
CONFIG_TEST_WDT_NOINIT_SECTION="SRAMX"
CONFIG_WDT_MCUX_WWDT_WARNING_INTERRUPT_CFG=10
```

## tests/drivers/watchdog/wdt_basic_api/boards/lpcxpresso55s36.conf
```kconfig
# Copyright 2026 NXP
# SPDX-License-Identifier: Apache-2.0

# Enable WWDT warning interrupt to support test_wdt_callback_1.
CONFIG_WDT_MCUX_WWDT_WARNING_INTERRUPT_CFG=10
```

## tests/drivers/watchdog/wdt_basic_api/boards/mimxrt700_evk_mimxrt798s_cm33_cpu0.conf
```kconfig
# Copyright 2025 NXP
# SPDX-License-Identifier: Apache-2.0

CONFIG_ARM_MPU_SRAM_WRITE_THROUGH=y
CONFIG_WDT_MCUX_WWDT_WARNING_INTERRUPT_CFG=10
```

## tests/drivers/watchdog/wdt_basic_api/testcase.yaml
```yaml
common:
  depends_on: watchdog
  expect_reboot: true
  tags:
    - drivers
    - watchdog
tests:
  drivers.watchdog:
    filter: >
      not (CONFIG_WDT_SAM or CONFIG_WDT_SAM4L
       or dt_compat_enabled("st,stm32-window-watchdog")
       or dt_compat_enabled("st,stm32-watchdog") or CONFIG_SOC_FAMILY_LPC or
       CONFIG_SOC_SERIES_IMXRT6XX or CONFIG_SOC_SERIES_IMXRT5XX or
       CONFIG_SOC_FAMILY_GD_GD32 or SOC_SERIES_GD32VF103)
    platform_exclude:
      - mec15xxevb_assy6853
      - s32z2xxdc2/s32z270/rtu0
      - s32z2xxdc2/s32z270/rtu1
      - s32z2xxdc2@D/s32z270/rtu0
      - s32z2xxdc2@D/s32z270/rtu1
      - mps2/an383
      - mps2/an386
      - mps2/an500
      - panb511evb/nrf54l15/cpuapp
      - panb511evb/nrf54l15/cpuflpr
      - panb511evb/nrf54l15/cpuflpr/xip
      - mimxrt700_evk/mimxrt798s/cm33_cpu1
      - nrf54l15dk/nrf54l15/cpuapp/ns
      - nrf54l15dk/nrf54l10/cpuapp/ns
      - bl54l15_dvk/nrf54l10/cpuapp/ns
      - bl54l15_dvk/nrf54l15/cpuapp/ns
      - bl54l15u_dvk/nrf54l15/cpuapp/ns
  drivers.watchdog.stm32wwdg:
    filter: dt_compat_enabled("st,stm32-window-watchdog") or dt_compat_enabled("st,stm32-watchdog")
    extra_args: DTC_OVERLAY_FILE="boards/stm32_wwdg.overlay"
    platform_allow:
      - nucleo_f091rc
      - nucleo_f103rb
      - nucleo_f207zg
      - stm32f3_disco
      - nucleo_f429zi
      - nucleo_f746zg
      - nucleo_g071rb
      - nucleo_g474re
      - nucleo_l073rz
      - nucleo_l152re
      - nucleo_l4r5zi
      - stm32l562e_dk
      - nucleo_wb55rg
      - nucleo_wl55jc
      - b_u585i_iot02a
      - nucleo_u575zi_q
      - nucleo_c031c6
      - stm32h573i_dk
      - nucleo_wba55cg
    integration_platforms:
      - nucleo_f091rc
  drivers.watchdog.stm32wwdg_h7:
    filter: dt_compat_enabled("st,stm32-window-watchdog") or dt_compat_enabled("st,stm32-watchdog")
    extra_args: DTC_OVERLAY_FILE="boards/stm32_wwdg_h7.overlay"
    platform_allow:
      - nucleo_h7s3l8
      - stm32h7s78_dk
      - nucleo_h753zi
      - nucleo_h743zi
  drivers.watchdog.stm32iwdg:
    filter: dt_compat_enabled("st,stm32-window-watchdog") or dt_compat_enabled("st,stm32-watchdog")
    extra_args: DTC_OVERLAY_FILE="boards/stm32_iwdg.overlay"
    platform_allow:
      - nucleo_f091rc
      - nucleo_f103rb
      - nucleo_f207zg
      - stm32f3_disco
      - nucleo_f429zi
      - nucleo_f746zg
      - nucleo_g071rb
      - nucleo_g474re
      - nucleo_l073rz
      - nucleo_l152re
      - nucleo_l4r5zi
      - stm32l562e_dk
      - nucleo_wb55rg
      - nucleo_wl55jc
      - b_u585i_iot02a
      - nucleo_u575zi_q
      - nucleo_h753zi
      - nucleo_h743zi
      - nucleo_c031c6
      - nucleo_h753zi
      - nucleo_h7s3l8
      - stm32h7s78_dk
      - nucleo_wba55cg
    integration_platforms:
      - nucleo_f091rc
  drivers.watchdog.mec15xxevb_assy6853:
    build_only: true
    platform_allow: mec15xxevb_assy6853
  drivers.watchdog.counter_watchdog:
    platform_allow: nrf52840dk/nrf52840
    extra_args:
      - EXTRA_CONF_FILE="boards/nrf52840dk_nrf52840_counter.conf"
      - DTC_OVERLAY_FILE="boards/nrf52840dk_nrf52840_counter.overlay"
  drivers.watchdog.gd32fwdgt:
    filter: dt_compat_enabled("gd,gd32-fwdgt")
    extra_args: DTC_OVERLAY_FILE="boards/gd32_fwdgt.overlay"
    platform_allow:
      - gd32e103v_eval
      - gd32e507v_start
      - gd32f350r_eval
      - gd32f403z_eval
      - gd32f450i_eval
      - gd32f450z_eval
      - gd32f470i_eval
      - gd32vf103c_starter
      - gd32vf103v_eval
      - longan_nano
    integration_platforms:
      - gd32e103v_eval
  drivers.watchdog.gd32wwdgt:
    filter: dt_compat_enabled("gd,gd32-wwdgt")
    extra_args: DTC_OVERLAY_FILE="boards/gd32_wwdgt.overlay"
    platform_allow:
      - gd32e103v_eval
      - gd32e507v_start
      - gd32f350r_eval
      - gd32f403z_eval
      - gd32f450i_eval
      - gd32f450z_eval
      - gd32f470i_eval
      - gd32vf103c_starter
      - gd32vf103v_eval
      - longan_nano
    integration_platforms:
      - gd32e103v_eval
  drivers.watchdog.nxp_s32:
    build_only: true
    platform_allow:
      - s32z2xxdc2/s32z270/rtu0
      - s32z2xxdc2/s32z270/rtu1
      - s32z2xxdc2@D/s32z270/rtu0
      - s32z2xxdc2@D/s32z270/rtu1
      - mr_canhubk3
    integration_platforms:
      - s32z2xxdc2/s32z270/rtu0
  drivers.watchdog.mimxrt1050_evk_ti_tps382x:
    filter: dt_compat_enabled("ti,tps382x")
    platform_allow: mimxrt1050_evk/mimxrt1052/hyperflash
    extra_args: DTC_OVERLAY_FILE="boards/mimxrt1050_evk_ti_tps382x.overlay"
```

## tests/drivers/watchdog/wdt_basic_reset_none/Kconfig
```kconfig
# Copyright 2025 NXP
# SPDX-License-Identifier: Apache-2.0

source "Kconfig.zephyr"

config TEST_WDT_MAX_WINDOW_TIME
	int "Watchdog Max Value"
	default 1000
	help
	  Set the watchdog max window time to feed the watchdog.
	  The units for this value will change based on the watchdog
	  driver being tested. Most drivers represent this as milliseconds
	  due to the max window reaching the millisecond feed window.

config TEST_WDT_SLEEP_TIME
	int "Watchdog Sleep Time"
	default 500
	help
	  Set the test sleep time between watchdog feeds.
	  The units for this value will change based on the watchdog
	  driver being tested. Most drivers represent this as milliseconds
	  due to the max window reaching the millisecond feed window.

config TEST_WDT_SETUP_FLAGS
	int "WDT setup flags for test, selectable options are: No flags (0x0U), WDT_OPT_PAUSE_IN_SLEEP (0x1U), WDT_OPT_PAUSE_HALTED_BY_DBG (0x2U)"
	default 2
	help
	  Set the watchdog setup flags for the test.

config TEST_WDT_TIMEOUT_UNIT_TICKS
	bool "Use watchdog timeout unit in ticks"
	default n
	help
	  Enable this option to configure the watchdog timeout unit in system ticks
```

## tests/drivers/watchdog/wdt_basic_reset_none/boards/frdm_mcxn236.conf
```kconfig
#
# Copyright 2025 NXP
#
# SPDX-License-Identifier Apache-2.0
#
CONFIG_TEST_WDT_MAX_WINDOW_TIME=254
CONFIG_TEST_WDT_SLEEP_TIME=68
```

## tests/drivers/watchdog/wdt_basic_reset_none/boards/frdm_mcxw23.conf
```kconfig
#
# Copyright 2025 NXP
#
# SPDX-License-Identifier Apache-2.0
#
CONFIG_WDT_MCUX_WWDT_WARNING_INTERRUPT_CFG=512
```

## tests/drivers/watchdog/wdt_basic_reset_none/boards/frdm_rw612.conf
```kconfig
#
# Copyright 2025 NXP
#
# SPDX-License-Identifier Apache-2.0
#
CONFIG_WDT_MCUX_WWDT_WARNING_INTERRUPT_CFG=512
CONFIG_PM=y
```

## tests/drivers/watchdog/wdt_basic_reset_none/boards/numaker_pfm_m487.conf
```kconfig
# Copyright (c) 2026 Nuvoton Technology Corporation.
# SPDX-License-Identifier: Apache-2.0

# M48x WDT clocked by 10 kHz LIRC has coarse granularity.
# tout=4 → 2^12 = 4096 ticks → 410 ms (rounded up).
# SLEEP_TIME of 200 ms keeps feeds well within the period.
# After last feed + 200 ms sleep, the WDT fires ~210 ms into the wait
# window of 410 ms → comfortably in range.
CONFIG_TEST_WDT_MAX_WINDOW_TIME=410
CONFIG_TEST_WDT_SLEEP_TIME=200
```

## tests/drivers/watchdog/wdt_basic_reset_none/testcase.yaml
```yaml
# Copyright 2022 NXP
# SPDX-License-Identifier: Apache-2.0

tests:
  drivers.watchdog.reset_none:
    filter: |
      dt_compat_enabled("nxp,s32-swt")
      or dt_compat_enabled("renesas,ra-wdt")
      or dt_compat_enabled("silabs,gecko-wdog")
    integration_platforms:
      - s32z2xxdc2/s32z270/rtu0
    tags:
      - drivers
      - watchdog
    depends_on: watchdog
  drivers.watchdog.reset_none_ewm:
    filter: dt_compat_enabled("nxp,ewm")
    platform_allow:
      - frdm_mcxw71
      - frdm_mcxw72/mcxw727c/cpu0
      - mimxrt1180_evk/mimxrt1189/cm33
      - mimxrt1180_evk/mimxrt1189/cm7
      - frdm_mcxn947/mcxn947/cpu0
      - frdm_mcxn947/mcxn947/cpu1
    integration_platforms:
      - frdm_mcxw71
      - frdm_mcxw72/mcxw727c/cpu0
      - mimxrt1180_evk/mimxrt1189/cm33
      - mimxrt1180_evk/mimxrt1189/cm7
    extra_args:
      - EXTRA_CONF_FILE="app_ewm.conf"
      - EXTRA_DTC_OVERLAY_FILE="boards/app_ewm.overlay"
    extra_configs:
      - CONFIG_TEST_WDT_MAX_WINDOW_TIME=254
      - CONFIG_TEST_WDT_SLEEP_TIME=68
  drivers.watchdog.reset_none_ewm_no_wdog:
    filter: dt_compat_enabled("nxp,ewm")
    platform_allow:
      - frdm_ke15z
      - frdm_ke17z
      - frdm_mcxe247
    integration_platforms:
      - frdm_ke17z
      - frdm_mcxe247
    extra_args:
      - EXTRA_CONF_FILE="app_ewm.conf"
      - DTC_OVERLAY_FILE="boards/app_ewm_no_wdog.overlay"
    extra_configs:
      - CONFIG_TEST_WDT_MAX_WINDOW_TIME=254
      - CONFIG_TEST_WDT_SLEEP_TIME=68
  drivers.watchdog.reset_none_ewm_11xx:
    filter: dt_compat_enabled("nxp,ewm")
    platform_allow:
      - mimxrt1170_evk@A/mimxrt1176/cm7
      - mimxrt1170_evk@B/mimxrt1176/cm7
    integration_platforms:
      - mimxrt1170_evk@A/mimxrt1176/cm7
    extra_args:
      - EXTRA_CONF_FILE="app_ewm.conf"
      - DTC_OVERLAY_FILE="boards/nxp_rt11xx.overlay"
    extra_configs:
      - CONFIG_TEST_WDT_MAX_WINDOW_TIME=254
      - CONFIG_TEST_WDT_SLEEP_TIME=68
```
