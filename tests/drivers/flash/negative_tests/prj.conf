## CMakeLists.txt
```
# SPDX-License-Identifier: Apache-2.0

cmake_minimum_required(VERSION 3.28.0)
find_package(Zephyr REQUIRED HINTS $ENV{ZEPHYR_BASE})
project(flash_negative_tests)

FILE(GLOB app_sources src/*.c)
target_sources(app PRIVATE ${app_sources})
```

## Kconfig
```
# SPDX-FileCopyrightText: <text>Copyright (c) 2026 Infineon Technologies AG,
# or an affiliate of Infineon Technologies AG. All rights reserved.</text>
#
# SPDX-License-Identifier: Apache-2.0

config TEST_FLASH_SUPPORTS_UNALIGNED_OP
	bool "Flash device under test supports unaligned operations"
	default y if FLASH_INFINEON_RRAM
	help
	  Set this if the flash device under test supports unaligned
	  read/write/erase/flatten operations (i.e. offset and size are not
	  required to be page-aligned).

source "Kconfig.zephyr"
```

## sysbuild.conf
```
SB_CONFIG_PARTITION_MANAGER=n
```

## prj.conf
```kconfig
CONFIG_TEST=y
CONFIG_ZTEST=y
CONFIG_FLASH=y
CONFIG_FLASH_PAGE_LAYOUT=y
CONFIG_MAIN_STACK_SIZE=2048
CONFIG_SPI_NOR=n
```

## boards/cy8cproto_062s3_4343w.conf
```kconfig
# SPDX-FileCopyrightText: Copyright (c) 2026 Infineon Technologies AG,
# SPDX-FileCopyrightText: or an affiliate of Infineon Technologies AG. All rights reserved.
#
# SPDX-License-Identifier: Apache-2.0

# flash_fill() rejects a buffer smaller than the 512 byte write-block size.
CONFIG_FLASH_FILL_BUFFER_SIZE=512
```

## boards/kit_psc3m5_evk.conf
```kconfig
# SPDX-FileCopyrightText: Copyright (c) 2026 Infineon Technologies AG,
# SPDX-FileCopyrightText: or an affiliate of Infineon Technologies AG. All rights reserved.
#
# SPDX-License-Identifier: Apache-2.0

CONFIG_FLASH_FILL_BUFFER_SIZE=512
```

## boards/stm32h573i_dk.conf
```kconfig
# Copyright (c) 2026 EXALT Technologies
# SPDX-License-Identifier: Apache-2.0

CONFIG_MSPI=y
CONFIG_LOG=y
CONFIG_MSPI_LOG_LEVEL_INF=y
CONFIG_HEAP_MEM_POOL_SIZE=8192
```

## boards/cy8ckit_041s_max.overlay
```dts
/*
 * SPDX-FileCopyrightText: Copyright (c) 2026 Infineon Technologies AG,
 * SPDX-FileCopyrightText: or an affiliate of Infineon Technologies AG. All rights reserved.
 *
 * SPDX-License-Identifier: Apache-2.0
 */

&flash0 {
	status = "okay";

	partitions {
		compatible = "fixed-partitions";
		#address-cells = <1>;
		#size-cells = <1>;

		/* Test partition for flash driver negative tests */
		storage_partition: partition@10000 {
			reg = <0x10000 DT_SIZE_K(32)>;
			label = "storage";
		};
	};
};
```

## boards/cy8cproto_041tp.overlay
```dts
/*
 * SPDX-FileCopyrightText: Copyright (c) 2026 Infineon Technologies AG,
 * SPDX-FileCopyrightText: or an affiliate of Infineon Technologies AG. All rights reserved.
 *
 * SPDX-License-Identifier: Apache-2.0
 */

&flash0 {
	status = "okay";

	partitions {
		#address-cells = <1>;
		#size-cells = <1>;
		compatible = "fixed-partitions";

		/* Test partition for flash driver negative tests */
		storage_partition: partition@10000 {
			label = "storage";
			reg = <0x10000 DT_SIZE_K(32)>;
		};
	};
};
```

## boards/cy8cproto_062_4343w.overlay
```dts
/*
 * SPDX-FileCopyrightText: Copyright (c) 2026 Infineon Technologies AG,
 * SPDX-FileCopyrightText: or an affiliate of Infineon Technologies AG. All rights reserved.
 *
 * SPDX-License-Identifier: Apache-2.0
 */

&flash0 {
	partitions {
		compatible = "fixed-partitions";
		#address-cells = <1>;
		#size-cells = <1>;

		/* At the end of flash 0, so writes past the partition also run past
		 * the end of the device.
		 */
		storage_partition: partition@1ff400 {
			reg = <0x001ff400 DT_SIZE_K(3)>;
			label = "storage";
		};
	};
};
```

## boards/cy8cproto_062s3_4343w.overlay
```dts
/*
 * SPDX-FileCopyrightText: Copyright (c) 2026 Infineon Technologies AG,
 * SPDX-FileCopyrightText: or an affiliate of Infineon Technologies AG. All rights reserved.
 *
 * SPDX-License-Identifier: Apache-2.0
 */

&flash0 {
	partitions {
		compatible = "fixed-partitions";
		#address-cells = <1>;
		#size-cells = <1>;

		/* At the end of flash 0, so writes past the partition also run past
		 * the end of the device.
		 */
		storage_partition: partition@7f400 {
			reg = <0x0007f400 DT_SIZE_K(3)>;
			label = "storage";
		};
	};
};
```

## boards/it51xxx_evb_it51526aw.overlay
```dts
/*
 * Copyright (c) 2026 ITE Corporation. All Rights Reserved.
 *
 * SPDX-License-Identifier: Apache-2.0
 */

&flash0 {
	partitions {
		compatible = "fixed-partitions";
		#address-cells = <1>;
		#size-cells = <1>;

		storage_partition: partition@40000 {
			reg = <0x00040000 DT_SIZE_K(256)>;
			label = "storage";
		};
	};
};
```

## boards/kit_psc3m5_evk.overlay
```dts
/*
 * SPDX-FileCopyrightText: Copyright (c) 2026 Infineon Technologies AG,
 * SPDX-FileCopyrightText: or an affiliate of Infineon Technologies AG. All rights reserved.
 *
 * SPDX-License-Identifier: Apache-2.0
 */

&slot0_ns_partition {
	reg = <0x20000 DT_SIZE_K(96)>;
};

&flash0 {
	status = "okay";

	partitions {
		ranges;
		#address-cells = <1>;
		#size-cells = <1>;

		storage_partition: partition@38000 {
			compatible = "zephyr,mapped-partition";
			label = "storage";
			reg = <0x38000 DT_SIZE_K(32)>;
		};
	};
};
```

## src/main.c
```c
/*
 * Copyright (c) 2020-2024 Nordic Semiconductor ASA
 *
 * SPDX-License-Identifier: Apache-2.0
 */

#include <zephyr/kernel.h>
#include <zephyr/ztest.h>
#include <zephyr/drivers/flash.h>
#include <zephyr/devicetree.h>
#include <zephyr/storage/flash_map.h>

#if defined(CONFIG_NORDIC_QSPI_NOR)
#define TEST_AREA_DEV_NODE DT_INST(0, nordic_qspi_nor)
#elif defined(CONFIG_SPI_NOR)
#define TEST_AREA_DEV_NODE DT_INST(0, jedec_spi_nor)
#elif defined(CONFIG_FLASH_INFINEON_RRAM)
#define TEST_AREA storage_partition_rram
#else
#define TEST_AREA storage_partition
#endif

/* TEST_AREA is only defined for configurations that rely on
 * fixed-partition nodes.
 */
#if defined(TEST_AREA)
#define TEST_AREA_OFFSET PARTITION_OFFSET(TEST_AREA)
#define TEST_AREA_SIZE   PARTITION_SIZE(TEST_AREA)
#define TEST_AREA_DEVICE PARTITION_DEVICE(TEST_AREA)

#if defined(CONFIG_SOC_SERIES_NRF54L) || defined(CONFIG_SOC_FAMILY_MICROCHIP_SAM_D5X_E5X) ||       \
	defined(CONFIG_FLASH_MCHP_NVMCTRL_G2) || defined(CONFIG_FLASH_MCHP_NVMCTRL_G3)
#define TEST_FLASH_START (DT_REG_ADDR(DT_MEM_FROM_PARTITION(DT_NODELABEL(TEST_AREA))))
#define TEST_FLASH_SIZE  (DT_REG_SIZE(DT_MEM_FROM_PARTITION(DT_NODELABEL(TEST_AREA))))
#elif defined(CONFIG_SOC_NRF54H20) || defined(CONFIG_SOC_SERIES_NRF92)
#define TEST_FLASH_START (DT_REG_ADDR(DT_PARENT(DT_PARENT(DT_NODELABEL(TEST_AREA)))))
#define TEST_FLASH_SIZE  (DT_REG_SIZE(DT_PARENT(DT_PARENT(DT_NODELABEL(TEST_AREA)))))
#elif defined(CONFIG_SOC_NRF7120)
#undef TEST_AREA_DEVICE
#define DEVICE_NODE        DT_PARENT(DT_PARENT(DT_PARENT(DT_NODELABEL(TEST_AREA))))
#define TEST_AREA_DEVICE   (DEVICE_DT_GET(DEVICE_NODE))
#define TEST_FLASH_START   (DT_REG_ADDR(DT_MEM_FROM_PARTITION(DT_NODELABEL(TEST_AREA))))
#define TEST_FLASH_SIZE    (DT_REG_SIZE(DT_MEM_FROM_PARTITION(DT_NODELABEL(TEST_AREA))))
#elif defined(CONFIG_SOC_FAMILY_INFINEON_PSOC4) || defined(CONFIG_SOC_FAMILY_PSOC6)
/* storage_partition is a child of partitions, which is a child of flash0.
 * Go up two levels: storage_partition -> partitions -> flash0.
 */
#define TEST_FLASH_START (DT_REG_ADDR(DT_PARENT(DT_PARENT(DT_NODELABEL(TEST_AREA)))))
#define TEST_FLASH_SIZE  (DT_REG_SIZE(DT_PARENT(DT_PARENT(DT_NODELABEL(TEST_AREA)))))
#elif defined(CONFIG_SOC_FAMILY_INFINEON_EDGE) || defined(CONFIG_SOC_SERIES_PSC3)
#define TEST_FLASH_START (DT_REG_ADDR(DT_MEM_FROM_PARTITION(DT_NODELABEL(TEST_AREA))))
#define TEST_FLASH_SIZE  (DT_REG_SIZE(DT_MEM_FROM_PARTITION(DT_NODELABEL(TEST_AREA))))
#elif defined(CONFIG_SOC_SERIES_LPC84X)
#define TEST_FLASH_START (DT_REG_ADDR(DT_PARENT(DT_PARENT(DT_NODELABEL(TEST_AREA)))))
#define TEST_FLASH_SIZE  (DT_REG_SIZE(DT_PARENT(DT_PARENT(DT_NODELABEL(TEST_AREA)))))
#elif defined(CONFIG_SOC_SERIES_IMXRT118X)
/* For i.MX RT118x, storage_partition -> partitions -> external FlexSPI NOR.
 * Prefer /chosen zephyr,flash-controller for flash geometry.
 * Flash operations use offsets from 0, not physical addresses.
 */
#define TEST_FLASH_START 0
#define TEST_FLASH_SIZE  DT_PROP(DT_CHOSEN(zephyr_flash_controller), size)
#elif defined(CONFIG_SOC_FAMILY_REALTEK_BEE)
#define TEST_FLASH_START (DT_REG_ADDR(DT_MEM_FROM_PARTITION(DT_NODELABEL(TEST_AREA))))
#define TEST_FLASH_SIZE (DT_REG_SIZE(DT_MEM_FROM_PARTITION(DT_NODELABEL(TEST_AREA))))
#elif defined(CONFIG_SOC_SERIES_IT51XXX)
#define TEST_FLASH_START (DT_REG_ADDR(DT_MEM_FROM_PARTITION(DT_NODELABEL(TEST_AREA))))
#define TEST_FLASH_SIZE  (DT_REG_SIZE(DT_MEM_FROM_PARTITION(DT_NODELABEL(TEST_AREA))))
#else
#error "Missing definition of TEST_FLASH_START and TEST_FLASH_SIZE for this target"
#endif

#else
#error "Unsupported configuration"
#endif

#define EXPECTED_SIZE 512

#if !defined(CONFIG_FLASH_HAS_EXPLICIT_ERASE) && !defined(CONFIG_FLASH_HAS_NO_EXPLICIT_ERASE)
#error There is no flash device enabled or it is missing Kconfig options
#endif

static const struct device *const flash_dev = TEST_AREA_DEVICE;
static struct flash_pages_info page_info;
static uint8_t __aligned(4) expected[EXPECTED_SIZE];

static void *flash_driver_setup(void)
{
	int rc;

	zassert_true(device_is_ready(flash_dev));

	TC_PRINT("Test will run on device %s\n", flash_dev->name);
	TC_PRINT("TEST_AREA_OFFSET = 0x%lx\n", (unsigned long)TEST_AREA_OFFSET);
	TC_PRINT("TEST_AREA_SIZE   = 0x%lx\n", (unsigned long)TEST_AREA_SIZE);
	TC_PRINT("TEST_FLASH_START = 0x%lx\n", (unsigned long)TEST_FLASH_START);
	TC_PRINT("TEST_FLASH_SIZE  = 0x%lx\n", (unsigned long)TEST_FLASH_SIZE);

	rc = flash_get_page_info_by_offs(flash_dev, TEST_AREA_OFFSET, &page_info);
	zassert_true(rc == 0, "flash_get_page_info_by_offs returned %d", rc);
	TC_PRINT("Test Page Info:\n");
	TC_PRINT("start_offset = 0x%lx\n", (unsigned long)page_info.start_offset);
	TC_PRINT("size         = 0x%lx\n", (unsigned long)page_info.size);
	TC_PRINT("index        = %d\n", page_info.index);
	TC_PRINT("===================================================================\n");

	return NULL;
}

/*  Acceptable values of erase size and offset are subject to
 *  hardware-specific multiples of page size and offset.
 */
ZTEST(flash_driver_negative, test_negative_flash_erase_zero_length)
{
	int rc;

#if !defined(TEST_AREA)
	/* Flash memory boundaries are correctly calculated
	 * only for storage_partition.
	 */
	ztest_test_skip();
#endif

	/* Erasing 0 bytes shall succeed */
	rc = flash_erase(flash_dev, TEST_AREA_OFFSET, 0);
	zassert_true(rc == 0, "flash_erase 0 bytes returned %d", rc);
}

ZTEST(flash_driver_negative, test_negative_flash_erase_oversized_length)
{
	int rc;

#if !defined(TEST_AREA)
	/* Flash memory boundaries are correctly calculated
	 * only for storage_partition.
	 */
	ztest_test_skip();
#endif

	/* Check error returned when erasing too large chunk of memory */
	rc = flash_erase(flash_dev, TEST_AREA_OFFSET, (TEST_FLASH_SIZE + 1));
	zassert_true(rc < 0,
		     "Invalid use of flash_erase (erasing too large chunk of memory) returned %d",
		     rc);
}

ZTEST(flash_driver_negative, test_negative_flash_erase_wrong_address)
{
	int rc;

#if !defined(TEST_AREA)
	/* Flash memory boundaries are correctly calculated
	 * only for storage_partition.
	 */
	ztest_test_skip();
#endif

	/* Check error returned when erasing memory at wrong address (too low) */
	rc = flash_erase(flash_dev, (TEST_FLASH_START - page_info.size), page_info.size);
	zassert_true(rc < 0,
		     "Invalid use of flash_erase (erasing memory at wrong address (too low)) "
		     "returned %d",
		     rc);

	/* Check error returned when erasing memory at wrong address (too high) */
	rc = flash_erase(flash_dev, (TEST_FLASH_START + TEST_FLASH_SIZE), page_info.size);
	zassert_true(rc < 0,
		     "Invalid use of flash_erase (erasing memory at wrong address (too high)) "
		     "returned %d",
		     rc);
}

ZTEST(flash_driver_negative, test_negative_flash_erase_unaligned)
{
	int rc;

#if !defined(TEST_AREA)
	/* Flash memory boundaries are correctly calculated
	 * only for storage_partition.
	 */
	ztest_test_skip();
#endif

	/* Check error returned when erasing unaligned memory */
	rc = flash_erase(flash_dev, (TEST_AREA_OFFSET + 1), page_info.size);
	zassert_true(rc < 0, "Invalid use of flash_erase (unaligned erase size) returned %d", rc);
	/* Check error returned when erasing unaligned size */
	rc = flash_erase(flash_dev, TEST_AREA_OFFSET, page_info.size + 1);
	zassert_true(rc < 0, "Invalid use of flash_erase (unaligned size) returned %d", rc);
}

/*  Erase page offset and size are constrains of paged, explicit erase devices,
 *  but can be relaxed with devices without such requirement.
 */
ZTEST(flash_driver_negative, test_negative_flash_fill_zero_length)
{
	int rc;
	uint8_t fill_val = 0xA; /* Dummy value */

#if !defined(TEST_AREA)
	/* Flash memory boundaries are correctly calculated
	 * only for storage_partition.
	 */
	ztest_test_skip();
#endif

	/* Filling 0 bytes shall succeed */
	rc = flash_fill(flash_dev, fill_val, TEST_AREA_OFFSET, 0);
	zassert_true(rc == 0, "flash_fill 0 bytes returned %d", rc);
}

ZTEST(flash_driver_negative, test_negative_flash_fill_wrong_address)
{
	int rc;
	uint8_t fill_val = 0xA; /* Dummy value */

#if !defined(TEST_AREA)
	/* Flash memory boundaries are correctly calculated
	 * only for storage_partition.
	 */
	ztest_test_skip();
#endif

	/* Check error returned when filling memory at wrong address (too low) */
	rc = flash_fill(flash_dev, fill_val, (TEST_FLASH_START - page_info.size), page_info.size);
	zassert_true(
		rc < 0,
		"Invalid use of flash_fill (filling memory at wrong address (too low)) returned %d",
		rc);

	/* Check error returned when filling memory at wrong address (too high) */
	rc = flash_fill(flash_dev, fill_val, (TEST_FLASH_START + TEST_FLASH_SIZE), page_info.size);
	zassert_true(rc < 0,
		     "Invalid use of flash_fill (filling memory at wrong address (too high)) "
		     "returned %d",
		     rc);
}

ZTEST(flash_driver_negative, test_negative_flash_fill_unaligned)
{
	int rc;
	uint8_t fill_val = 0xA; /* Dummy value */
	size_t write_block_size;

#if !defined(TEST_AREA)
	/* Flash memory boundaries are correctly calculated
	 * only for storage_partition.
	 */
	ztest_test_skip();
#endif

	write_block_size = flash_get_write_block_size(flash_dev);

	if (write_block_size <= 1) {
		ztest_test_skip();
	}
	/* Check error returned when filling unaligned memory */
	rc = flash_fill(flash_dev, fill_val, TEST_AREA_OFFSET + 1, page_info.size);
	zassert_true(rc < 0, "Invalid use of flash_fill returned %d", rc);

	/* Check error returned when filling unaligned size */
	rc = flash_fill(flash_dev, fill_val, TEST_AREA_OFFSET, page_info.size + 1);
	zassert_true(rc < 0, "Invalid use of flash_fill returned %d", rc);
}

/*  Erase page offset and size are constrains of paged, explicit erase devices,
 *  but can be relaxed with devices without such requirement.
 */
ZTEST(flash_driver_negative, test_negative_flash_flatten_zero_length)
{
	int rc;

#if !defined(TEST_AREA)
	/* Flash memory boundaries are correctly calculated
	 * only for storage_partition.
	 */
	ztest_test_skip();
#endif

	/* Flatten 0 bytes shall succeed */
	rc = flash_flatten(flash_dev, TEST_AREA_OFFSET, 0);
	zassert_true(rc == 0, "flash_flatten 0 bytes returned %d", rc);
}

ZTEST(flash_driver_negative, test_negative_flash_flatten_wrong_address)
{
	int rc;

#if !defined(TEST_AREA)
	/* Flash memory boundaries are correctly calculated
	 * only for storage_partition.
	 */
	ztest_test_skip();
#endif

	/* Check error returned when flatten memory at wrong address (too low) */
	rc = flash_flatten(flash_dev, (TEST_FLASH_START - page_info.size), page_info.size);
	zassert_true(rc < 0,
		     "Invalid use of flash_flatten (flatten memory at wrong address (too low)) "
		     "returned %d",
		     rc);

	/* Check error returned when flatten memory at wrong address (too high) */
	rc = flash_flatten(flash_dev, (TEST_FLASH_START + TEST_FLASH_SIZE), page_info.size);
	zassert_true(rc < 0,
		     "Invalid use of flash_flatten (flatten memory at wrong address (too high)) "
		     "returned %d",
		     rc);
}

ZTEST(flash_driver_negative, test_negative_flash_flatten_unaligned)
{
	int rc;

#if !defined(TEST_AREA)
	/* Flash memory boundaries are correctly calculated
	 * only for storage_partition.
	 */
	ztest_test_skip();
#endif

	/* Check error returned when flatten unaligned memory */
	rc = flash_flatten(flash_dev, (TEST_AREA_OFFSET + 1), page_info.size);
	zassert_true(rc < 0, "Invalid use of flash_flatten (unaligned flatten size) returned %d",
		     rc);

	rc = flash_flatten(flash_dev, TEST_AREA_OFFSET, (page_info.size + 1));
	zassert_true(rc < 0, "Invalid use of flash_flatten (unaligned size) returned %d", rc);
}

/*  All flash drivers support reads without alignment restrictions on
 *  the read offset, the read size, or the destination address.
 */
ZTEST(flash_driver_negative, test_negative_flash_read_zero_length)
{
	int rc;
	uint8_t read_buf[EXPECTED_SIZE];

#if !defined(TEST_AREA)
	/* Flash memory boundaries are correctly calculated
	 * only for storage_partition.
	 */
	ztest_test_skip();
#endif

	/* Reading 0 bytes shall succeed */
	rc = flash_read(flash_dev, TEST_AREA_OFFSET, read_buf, 0);
	zassert_true(rc == 0, "flash_read 0 bytes returned %d", rc);
}

ZTEST(flash_driver_negative, test_negative_flash_read_oversized_length)
{
	int rc;
	uint8_t read_buf[EXPECTED_SIZE];

#if !defined(TEST_AREA)
	/* Flash memory boundaries are correctly calculated
	 * only for storage_partition.
	 */
	ztest_test_skip();
#endif

	/* Check error returned when reading too many data */
	rc = flash_read(flash_dev, TEST_AREA_OFFSET, read_buf, (TEST_FLASH_SIZE + page_info.size));
	zassert_true(rc < 0, "Invalid use of flash_read (reading too many data) returned %d", rc);
}

ZTEST(flash_driver_negative, test_negative_flash_read_wrong_address)
{
	int rc;
	uint8_t read_buf[EXPECTED_SIZE];

#if !defined(TEST_AREA)
	/* Flash memory boundaries are correctly calculated
	 * only for storage_partition.
	 */
	ztest_test_skip();
#endif

	/* Check error returned when reading from a wrong address (too low) */
	rc = flash_read(flash_dev, (TEST_FLASH_START - page_info.size), read_buf, EXPECTED_SIZE);
	zassert_true(
		rc < 0,
		"Invalid use of flash_read (reading from a wrong address (too low)) returned %d",
		rc);

	/* Check error returned when reading from a wrong address (too high) */
	rc = flash_read(flash_dev, (TEST_FLASH_START + TEST_FLASH_SIZE), read_buf, EXPECTED_SIZE);
	zassert_true(
		rc < 0,
		"Invalid use of flash_read (reading from a wrong address (too high)) returned %d",
		rc);
}

ZTEST(flash_driver_negative, test_negative_flash_write_zero_length)
{
	int rc;

#if !defined(TEST_AREA)
	/* Flash memory boundaries are correctly calculated
	 * only for storage_partition.
	 */
	ztest_test_skip();
#endif

	/*  Write size and offset must be multiples of the minimum write block size
	 *  supported by the driver.
	 */

	/* Writing 0 bytes shall succeed */
	rc = flash_write(flash_dev, TEST_AREA_OFFSET, expected, 0);
	zassert_true(rc == 0, "flash_write 0 bytes returned %d", rc);
}

ZTEST(flash_driver_negative, test_negative_flash_write_oversized_length)
{
	int rc;

#if !defined(TEST_AREA)
	/* Flash memory boundaries are correctly calculated
	 * only for storage_partition.
	 */
	ztest_test_skip();
#endif

	/* Check error returned when writing too large chunk of memory */
	rc = flash_write(flash_dev, TEST_AREA_OFFSET, expected, (TEST_FLASH_SIZE + 1));
	zassert_true(rc < 0,
		     "Invalid use of flash_write (writing too large chunk of memory) returned %d",
		     rc);
}

ZTEST(flash_driver_negative, test_negative_flash_write_wrong_address)
{
	int rc;

#if !defined(TEST_AREA)
	/* Flash memory boundaries are correctly calculated
	 * only for storage_partition.
	 */
	ztest_test_skip();
#endif

	/* Check error returned when writing to a wrong address (too low) */
	rc = flash_write(flash_dev, (TEST_FLASH_START - page_info.size), expected, page_info.size);
	zassert_true(
		rc < 0,
		"Invalid use of flash_write (writing to a wrong address (too low)) returned %d",
		rc);

	/* Check error returned when writing to a wrong address (too high) */
	rc = flash_write(flash_dev, (TEST_FLASH_START + TEST_FLASH_SIZE), expected, page_info.size);
	zassert_true(
		rc < 0,
		"Invalid use of flash_write (writing to a wrong address (too high)) returned %d",
		rc);
}

ZTEST(flash_driver_negative, test_negative_flash_write_unaligned)
{
	int rc;
	size_t write_block_size;

#if !defined(TEST_AREA)
	/* Flash memory boundaries are correctly calculated
	 * only for storage_partition.
	 */
	ztest_test_skip();
#endif

	/*  Write size and offset must be multiples of the minimum write block size
	 *  supported by the driver.
	 */

	write_block_size = flash_get_write_block_size(flash_dev);

	if (write_block_size <= 1) {
		ztest_test_skip();
	}
	/* Check error returned when writing at unaligned memory */
	rc = flash_write(flash_dev, (TEST_AREA_OFFSET + 1), expected, page_info.size);
	zassert_true(rc < 0, "Invalid use of flash_write (unaligned write size) returned %d", rc);

	/* Check error returned when writing unaligned size */
	rc = flash_write(flash_dev, TEST_AREA_OFFSET, expected, page_info.size + 1);
	zassert_true(rc < 0, "Invalid use of flash_write (unaligned size) returned %d", rc);
}

ZTEST_SUITE(flash_driver_negative, NULL, flash_driver_setup, NULL, NULL, NULL);
```
