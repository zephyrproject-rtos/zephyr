/*
 * Copyright (c) 2025 Infineon Technologies AG,
 * or an affiliate of Infineon Technologies AG.
 *
 * SPDX-License-Identifier: Apache-2.0
 */

&flash0 {
	status = "okay";

	partitions {
		#address-cells = <1>;
		#size-cells = <1>;
		compatible = "fixed-partitions";

		/* Test partition for flash driver negative tests */
		storage_partition: partition@10000 {
			label = "storage";
			reg = <0x10000 DT_SIZE_K(32)>;
		};
	};
};
