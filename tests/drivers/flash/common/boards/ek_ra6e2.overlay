/*
 * Copyright (c) 2024-2026 Renesas Electronics Corporation
 * SPDX-License-Identifier: Apache-2.0
 */

/delete-node/ &storage_partition;

&code_flash {
	partitions {
		ranges;
		#address-cells = <1>;
		#size-cells = <1>;

		/* Set 2 last blocks of the code flash as storage partition */
		storage_partition: partition@30000 {
			compatible = "zephyr,mapped-partition";
			reg = <0x30000 DT_SIZE_K(64)>;
			label = "storage";
		};
	};
};

&at25sf128a {
	status = "disabled";
};
