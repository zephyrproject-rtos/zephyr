## tests/drivers/flash/common/boards/fpb_ra8e1.conf
```kconfig
# Copyright (c) 2026 Renesas Electronics Corporation
# SPDX-License-Identifier: Apache-2.0

CONFIG_TEST_DRIVER_FLASH_SIZE=1048576
```

## tests/drivers/flash/common/boards/mec172xevb_assy6906.conf
```kconfig
CONFIG_SPI=y
CONFIG_SPI_NOR=y
# flash_get_size() returns size in bytes
CONFIG_TEST_DRIVER_FLASH_SIZE=2097152
```

## tests/drivers/flash/common/boards/mikroe_flash_5_click.conf
```kconfig
# Copyright (c) 2026 CodeWrights GmbH
# SPDX-License-Identifier: Apache-2.0

CONFIG_ZTEST_STACK_SIZE=6144
CONFIG_FLASH_FILL_BUFFER_SIZE=2048
CONFIG_TEST_DRIVER_FLASH_SIZE=134217728
```

## tests/drivers/flash/common/boards/mimxrt1060_evk.conf
```kconfig
#
# Copyright (c) 2021 NXP.
# SPDX-License-Identifier: Apache-2.0
#

CONFIG_FLASH_MCUX_FLEXSPI_XIP_MEM_SRAM=y
```

## tests/drivers/flash/common/boards/mimxrt685_evk_cm33.conf
```kconfig
#
# Copyright (c) 2022 NXP.
# SPDX-License-Identifier: Apache-2.0
#

CONFIG_FLASH_MCUX_FLEXSPI_NOR_WRITE_BUFFER=y
```

## tests/drivers/flash/common/boards/nrf52840_flash_qspi.conf
```kconfig
# Minimal configuration for testing flash driver
# on nrf52840dk_nrf52840 board

CONFIG_NORDIC_QSPI_NOR=y
```

## tests/drivers/flash/common/boards/nrf52840_flash_soc.conf
```kconfig
# Minimal configuration for testing flash driver
# on nrf52840dk/nrf52840 board

CONFIG_MPU_ALLOW_FLASH_WRITE=y
```

## tests/drivers/flash/common/boards/nrf52840dk_flash_spi.conf
```kconfig
CONFIG_SPI=y
CONFIG_SPI_NOR=y
CONFIG_SOC_FLASH_NRF=n
CONFIG_TEST_DRIVER_FLASH_SIZE=2097152
```

## tests/drivers/flash/common/boards/nrf52840dk_nrf52840_qspi_nor.conf
```kconfig
# Minimal configuration for testing flash driver
# on nrf52840dk/nrf52840 board

CONFIG_NORDIC_QSPI_NOR=y
CONFIG_NORDIC_QSPI_NOR_FLASH_LAYOUT_PAGE_SIZE=4096
```

## tests/drivers/flash/common/boards/nrf54h20dk_nrf54h20_spi_nor.conf
```kconfig
# Minimal configuration for testing flash driver
# on nrf52840dk/nrf52840 board

CONFIG_SPI=y
CONFIG_SPI_NOR=y
```

## tests/drivers/flash/common/boards/nucleo_wb55rg.conf
```kconfig
# SPDX-FileCopyrightText: Copyright The Zephyr Project Contributors
# SPDX-License-Identifier: Apache-2.0

CONFIG_TEST_DRIVER_FLASH_SIZE=1048576
```

## tests/drivers/flash/common/boards/pic32cm_jh01_cpro.conf
```kconfig
# Copyright (c) 2026 Microchip Technology Inc.
# SPDX-License-Identifier: Apache-2.0

CONFIG_FLASH_PAGE_LAYOUT=y
CONFIG_FLASH_FILL_BUFFER_SIZE=64
```

## tests/drivers/flash/common/boards/qemu_riscv64.conf
```kconfig
# Copyright (c) 2026 Analog Devices, Inc
# SPDX-License-Identifier: Apache-2.0
#
# Configuration for Intel CFI01 pflash driver test on qemu_x86

CONFIG_FLASH_INTEL_PFLASH_CFI01=y
CONFIG_FLASH_SIMULATOR=n
```

## tests/drivers/flash/common/boards/rza3ul_smarc.conf
```kconfig
# Copyright (c) 2025 Renesas Electronics Corporation
# SPDX-License-Identifier: Apache-2.0

CONFIG_TEST_DRIVER_FLASH_SIZE=16777216
```

## tests/drivers/flash/common/boards/stm32h7s78_dk.conf
```kconfig
# SPDX-FileCopyrightText: Copyright The Zephyr Project Contributors
# SPDX-License-Identifier: Apache-2.0

CONFIG_TEST_DRIVER_FLASH_SIZE=134217728
CONFIG_FLASH_STM32_NOR_MEMMAP=y
```

## tests/drivers/flash/common/testcase.yaml
```yaml
common:
  tags:
    - drivers
    - flash
tests:
  drivers.flash.common.nrf_qspi_nor:
    platform_allow: nrf52840dk/nrf52840
    extra_args: EXTRA_CONF_FILE=boards/nrf52840dk_nrf52840_qspi_nor.conf
    integration_platforms:
      - nrf52840dk/nrf52840
  drivers.flash.common.max32_spixf_nor:
    platform_allow: apard32690/max32690/m4
    extra_args: DTC_OVERLAY_FILE=boards/apard32690_max32690_m4_spixf_nor.overlay
    integration_platforms:
      - apard32690/max32690/m4
  drivers.flash.common.max32_spixf_nor_sfdp_runtime:
    platform_allow: apard32690/max32690/m4
    extra_args:
      - EXTRA_CONF_FILE=boards/apard32690_max32690_m4_spixf_nor_sfdp_runtime.conf
      - DTC_OVERLAY_FILE=boards/apard32690_max32690_m4_spixf_nor.overlay
    integration_platforms:
      - apard32690/max32690/m4
  drivers.flash.common.nrf_qspi_nor.size_in_bytes:
    platform_allow: nrf52840dk/nrf52840
    extra_args:
      - EXTRA_CONF_FILE=boards/nrf52840dk_nrf52840_qspi_nor.conf
      - DTC_OVERLAY_FILE=boards/nrf52840_size_in_bytes.overlay
    extra_configs:
      - CONFIG_TEST_DRIVER_FLASH_SIZE=8388608
    integration_platforms:
      - nrf52840dk/nrf52840
  drivers.flash.common.nrf_qspi_nor_4B_addr:
    platform_allow: nrf52840dk/nrf52840
    extra_configs:
      - CONFIG_TEST_DRIVER_FLASH_SIZE=67108864
    extra_args:
      - EXTRA_CONF_FILE=boards/nrf52840dk_nrf52840_qspi_nor.conf
      - DTC_OVERLAY_FILE=boards/nrf52840dk_mx25l51245g.overlay
    harness_config:
      fixture: external_flash_mx25l51245g
    integration_platforms:
      - nrf52840dk/nrf52840
  drivers.flash.common.soc_flash_nrf:
    platform_allow: nrf52840dk/nrf52840
    extra_args: EXTRA_CONF_FILE=boards/nrf52840dk_nrf52840_soc.conf
    integration_platforms:
      - nrf52840dk/nrf52840
  drivers.flash.common.default:
    filter: ((CONFIG_FLASH_HAS_DRIVER_ENABLED and not CONFIG_TRUSTED_EXECUTION_NONSECURE)
      and (dt_label_with_parent_compat_enabled("storage_partition", "fixed-partitions")
      or dt_label_with_parent_compat_enabled("storage_partition", "nordic,owned-partitions")))
    platform_exclude:
      - nrf54lm20dk/nrf54lm20a/cpuapp
    integration_platforms:
      - qemu_x86
      - mimxrt1060_evk/mimxrt1062/qspi
  drivers.flash.common.no_explicit_erase:
    platform_allow:
      - nrf54l15dk/nrf54l05/cpuapp
      - nrf54l15dk/nrf54l10/cpuapp
      - nrf54l15dk/nrf54l15/cpuapp
      - nrf54h20dk/nrf54h20/cpuapp
      - ophelia4ev/nrf54l15/cpuapp
  drivers.flash.common.nrf54lm20a:
    platform_allow:
      - nrf54lm20dk/nrf54lm20a/cpuapp
    harness_config:
      fixture: external_flash
  drivers.flash.common.tfm_ns:
    build_only: true
    filter: (CONFIG_FLASH_HAS_DRIVER_ENABLED and CONFIG_TRUSTED_EXECUTION_NONSECURE
      and dt_label_with_parent_compat_enabled("storage_partition", "fixed-partitions"))
    integration_platforms:
      - nrf9161dk/nrf9161/ns
  drivers.flash.common.mx25r_high_perf:
    platform_allow: nrf52840dk/nrf52840
    extra_configs:
      - CONFIG_TEST_DRIVER_FLASH_SIZE=8388608
    extra_args:
      - EXTRA_CONF_FILE=boards/nrf52840dk_flash_spi.conf
      - DTC_OVERLAY_FILE=boards/nrf52840dk_mx25r_high_perf.overlay
    integration_platforms:
      - nrf52840dk/nrf52840
  drivers.flash.common.mr_canhubk3_sfdp_runtime:
    platform_allow: mr_canhubk3
    extra_configs:
      - CONFIG_FLASH_NXP_S32_QSPI_SFDP_RUNTIME=y
  drivers.flash.common.spi_nor:
    platform_allow: nrf52840dk/nrf52840
    extra_configs:
      - CONFIG_TEST_DRIVER_FLASH_SIZE=2097152
    extra_args:
      - EXTRA_CONF_FILE=boards/nrf52840dk_flash_spi.conf
      - DTC_OVERLAY_FILE=boards/nrf52840dk_spi_nor.overlay
    harness_config:
      fixture: external_flash_mx25v1635f
  drivers.flash.common.spi_nor_wp_hold:
    platform_allow: nrf52840dk/nrf52840
    extra_configs:
      - CONFIG_TEST_DRIVER_FLASH_SIZE=2097152
    extra_args:
      - EXTRA_CONF_FILE=boards/nrf52840dk_flash_spi.conf
      - DTC_OVERLAY_FILE=boards/nrf52840dk_spi_nor_wp_hold.overlay
    harness_config:
      fixture: external_flash_mx25v1635f
  drivers.flash.common.sam0:
    platform_allow:
      - samd20_xpro
      - samr21_xpro
      - same54_xpro
  drivers.flash.common.gd32:
    platform_allow:
      - gd32vf103v_eval
      - gd32a503v_eval
      - gd32f470i_eval
  drivers.flash.common.silabs.dma:
    platform_allow:
      - xg24_rb4187c
      - xg29_rb4412a
      - bg29_rb4420a
    extra_configs:
      - CONFIG_DMA=y
  drivers.flash.common.silabs.dma.lpwrite:
    platform_allow:
      - xg24_rb4187c
      - xg29_rb4412a
      - bg29_rb4420a
    extra_configs:
      - CONFIG_DMA=y
    extra_args:
      - EXTRA_DTC_OVERLAY_FILE=boards/silabs_s2_lpwrite.overlay
  drivers.flash.common.silabs.dma_read:
    platform_allow:
      - xg24_rb4187c
      - xg29_rb4412a
      - bg29_rb4420a
    extra_configs:
      - CONFIG_DMA=y
      - CONFIG_SOC_FLASH_SILABS_S2_DMA_READ=y
  drivers.flash.common.stm32:
    filter: ((CONFIG_FLASH_HAS_DRIVER_ENABLED and not CONFIG_TRUSTED_EXECUTION_NONSECURE)
      and CONFIG_SOC_FAMILY_STM32
      and dt_label_with_parent_compat_enabled("storage_partition", "fixed-partitions"))
    integration_platforms:
      - nucleo_g474re
    platform_exclude:
      - nucleo_wb55rg
  drivers.flash.common.non_quad_mode:
    extra_args:
      - EXTRA_DTC_OVERLAY_FILE=boards/mx25r64_non_quad.overlay
    integration_platforms:
      - nrf52840dk/nrf52840
      - nrf5340dk/nrf5340/cpuapp
    platform_allow:
      - nrf52840dk/nrf52840
      - nrf5340dk/nrf5340/cpuapp
  drivers.flash.common.disable_spi_nor:
    filter: dt_compat_enabled("soc-nv-flash") and dt_compat_enabled("jedec,spi-nor")
    platform_exclude:
      - beagleconnect_freedom/cc1352p7
    extra_args:
      - CONFIG_SPI_NOR=n
  drivers.flash.common.ra_ospi_b_nor:
    platform_allow:
      - ek_ra8m1
      - ek_ra8d1
    extra_args:
      - DTC_OVERLAY_FILE="./boards/${BOARD}_ospi_b_nor.overlay"
      - CONF_FILE="./prj.conf ./boards/${BOARD}_ospi_b_nor.conf"
  drivers.flash.common.mspi_single_io:
    platform_allow:
      - nrf54h20dk/nrf54h20/cpuapp
    extra_args:
      - EXTRA_DTC_OVERLAY_FILE=boards/mx25uw63_single_io.overlay
  drivers.flash.common.ra_qspi_nor:
    filter: CONFIG_FLASH_RENESAS_RA_QSPI and dt_compat_enabled("renesas,ra-qspi-nor")
    platform_allow:
      - ek_ra6m5
      - ek_ra6m4
      - ek_ra6m3
      - ek_ra6e2
    extra_args:
      - DTC_OVERLAY_FILE="./boards/${BOARD}_qspi_nor.overlay"
      - CONF_FILE="./prj.conf ./boards/${BOARD}_qspi_nor.conf"
```
