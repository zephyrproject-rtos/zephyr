/*
 * Copyright (c) 2026 Texas Instruments Incorporated
 *
 * SPDX-License-Identifier: Apache-2.0
 */

/* Disable external SPI NOR flash to avoid conflicts when SPI0 and SPI1
 * are looped together for SPI driver testing. The flash/common test only
 * validates the internal SOC flash via storage_partition.
 */
&mx25r80 {
	status = "disabled";
};
