/*
 * Copyright (c) 2024 Silicon Laboratories Inc.
 *
 * SPDX-License-Identifier: Apache-2.0
 */

&flash0 {
	partitions {
		compatible = "fixed-partitions";
		#address-cells = <1>;
		#size-cells = <1>;

		code_partition: partition@0 {
			label = "code_partition";
			reg = <0x0000000 DT_SIZE_K(2048-8-16)>;
		};

		storage_partition: partition@1FA000 {
			label = "storage";
			reg = <0x01FA000 DT_SIZE_K(16)>;
		};
	};
};
