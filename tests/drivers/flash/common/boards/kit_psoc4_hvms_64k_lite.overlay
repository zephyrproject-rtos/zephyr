/*
 * SPDX-FileCopyrightText: Copyright (c) 2026 Infineon Technologies AG,
 * SPDX-FileCopyrightText: or an affiliate of Infineon Technologies AG. All rights reserved.
 *
 * SPDX-License-Identifier: Apache-2.0
 */

&flash0 {
	status = "okay";

	partitions {
		#address-cells = <1>;
		#size-cells = <1>;
		compatible = "fixed-partitions";

		/* Test partition for flash driver common tests */
		storage_partition: partition@c000 {
			label = "storage";
			reg = <0x0000c000 DT_SIZE_K(16)>;
		};
	};
};
