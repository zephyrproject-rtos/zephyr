/*
 * SPDX-FileCopyrightText: Copyright (c) 2026 Infineon Technologies AG,
 * SPDX-FileCopyrightText: or an affiliate of Infineon Technologies AG. All rights reserved.
 *
 * SPDX-License-Identifier: Apache-2.0
 */

&flash0 {
	partitions {
		ranges;
		#address-cells = <1>;
		#size-cells = <1>;

		/* Last 32 KB of the 128 KB code flash */
		storage_partition: partition@18000 {
			compatible = "zephyr,mapped-partition";
			reg = <0x18000 DT_SIZE_K(32)>;
			label = "storage";
		};
	};
};
