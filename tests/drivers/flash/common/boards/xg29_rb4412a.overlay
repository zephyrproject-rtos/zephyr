/*
 * Copyright (c) 2025 Silicon Laboratories Inc.
 *
 * SPDX-License-Identifier: Apache-2.0
 */

&dma0 {
	status = "okay";
};

&msc {
	dmas = <&dma0 DMA_REQSEL_MSCWDATA>;
};

/* Disable jedec spi nor flash to test internal flash */

/ {

	aliases {
		/delete-property/ spi-flash0;
	};
};

/delete-node/ &mx25r80;
