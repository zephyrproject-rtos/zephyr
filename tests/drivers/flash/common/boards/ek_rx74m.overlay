/*
 * Copyright (c) 2026 Renesas Electronics Corporation
 * SPDX-License-Identifier: Apache-2.0
 */

&code_mram {
	partitions {
		ranges;
		#address-cells = <1>;
		#size-cells = <1>;

		storage_partition: partition@e0000 {
			compatible = "zephyr,mapped-partition";
			reg = <0xe0000 DT_SIZE_K(64)>;
			label = "storage";
		};
	};
};
