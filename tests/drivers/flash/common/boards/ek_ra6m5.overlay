/*
 * Copyright (c) 2024-2026 Renesas Electronics Corporation
 * SPDX-License-Identifier: Apache-2.0
 */

/delete-node/ &storage_partition;

&code_flash {
	partitions {
		ranges;
		#address-cells = <1>;
		#size-cells = <1>;

		/* Set 2 last blocks of the code flash as storage partition */
		storage_partition: partition@1f0000 {
			compatible = "zephyr,mapped-partition";
			reg = <0x1f0000 DT_SIZE_K(64)>;
			label = "storage";
		};
	};
};

&mx25l25645g {
	status = "disabled";
};
