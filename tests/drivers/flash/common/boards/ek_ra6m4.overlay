/*
 * Copyright (c) 2024 Renesas Electronics Corporation
 * SPDX-License-Identifier: Apache-2.0
 */

/delete-node/ &storage_partition;

&flash0 {
	partitions {
		compatible = "fixed-partitions";
		#address-cells = <1>;
		#size-cells = <1>;

		/* Set 2 last blocks of the code flash as storage partition */
		storage_partition: partition@F0000 {
			label = "storage";
			reg = <0xF0000 DT_SIZE_K(64)>;
		};
	};
};

&mx25l25645g {
	status = "disabled";
};
