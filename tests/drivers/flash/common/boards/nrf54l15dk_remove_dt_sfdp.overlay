/*
 * Copyright (c) 2025 Nordic Semiconductor ASA
 *
 * SPDX-License-Identifier: Apache-2.0
 */

&mx25r64 {
/delete-property/ jedec-id;
/delete-property/ sfdp-bfp;
/delete-property/ has-dpd;
/delete-property/ t-enter-dpd;
/delete-property/ t-exit-dpd;
};
