/*
 * Copyright (c) 2025 STMicroelectronics
 * SPDX-License-Identifier: Apache-2.0
 */

/delete-node/ &storage_partition;

&flash0 {
	partitions {
		compatible = "fixed-partitions";
		#address-cells = <1>;
		#size-cells = <1>;

		/*
		 * Reserve the final 16 KiB for file system partition
		 */
		storage_partition: partition@1c276 {
			label = "storage";
			reg = <0x0001c276 DT_SIZE_K(16)>;
		};
	};
};
