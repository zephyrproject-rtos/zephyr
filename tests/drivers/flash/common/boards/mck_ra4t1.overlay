/*
 * Copyright (c) 2025 Renesas Electronics Corporation
 * SPDX-License-Identifier: Apache-2.0
 */

&flash0 {
	partitions {
		compatible = "fixed-partitions";
		#address-cells = <1>;
		#size-cells = <1>;

		/* Set 2 last blocks of the code flash as storage partition */
		storage_partition: partition@30000 {
			label = "storage";
			reg = <0x30000 DT_SIZE_K(64)>;
		};
	};
};
