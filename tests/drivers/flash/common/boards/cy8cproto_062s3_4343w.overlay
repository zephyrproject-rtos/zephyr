/*
 * SPDX-FileCopyrightText: Copyright (c) 2026 Infineon Technologies AG,
 * SPDX-FileCopyrightText: or an affiliate of Infineon Technologies AG. All rights reserved.
 *
 * SPDX-License-Identifier: Apache-2.0
 */

&flash0 {
	partitions {
		compatible = "fixed-partitions";
		#address-cells = <1>;
		#size-cells = <1>;

		/* 3 KB of storage at the end of the 512 KB flash 0 */
		storage_partition: partition@7f400 {
			reg = <0x0007f400 DT_SIZE_K(3)>;
			label = "storage";
		};
	};
};
