/*
 * Copyright (c) 2024 Analog Devices, Inc.
 *
 * SPDX-License-Identifier: Apache-2.0
 */

&flash0 {
	partitions {
		compatible = "fixed-partitions";
		#address-cells = <1>;
		#size-cells = <1>;

		code_partition: partition@0 {
			reg = <0x0 DT_SIZE_K(256)>;
			read-only;
		};

		storage_partition: partition@20000 {
			label = "storage";
			reg = <0x20000 DT_SIZE_K(128)>;
		};
	};
};
