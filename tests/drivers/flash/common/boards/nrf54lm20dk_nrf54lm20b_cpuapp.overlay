/*
 * Copyright (c) 2026 Nordic Semiconductor ASA
 *
 * SPDX-License-Identifier: Apache-2.0
 */

/ {
	zephyr,user {
		test-gpios = <&gpio1 4 GPIO_ACTIVE_HIGH>;
	};
};

&mx25r64 {
	status = "okay";
	supply-gpios = <&gpio1 3 GPIO_ACTIVE_HIGH>;
	t-reset-recovery = <10000>;
};
