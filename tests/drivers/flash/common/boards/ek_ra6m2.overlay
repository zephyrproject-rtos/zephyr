/*
 * Copyright (c) 2024-2026 Renesas Electronics Corporation
 * SPDX-License-Identifier: Apache-2.0
 */

/delete-node/ &storage_partition;

&code_flash {
	partitions {
		#address-cells = <1>;
		#size-cells = <1>;
		ranges;

		/* Set 2 last blocks of the code flash as storage partition */
		storage_partition: partition@f0000 {
			compatible = "zephyr,mapped-partition";
			label = "storage";
			reg = <0xf0000 DT_SIZE_K(64)>;
		};
	};
};
