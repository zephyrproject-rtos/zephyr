/*
 * Copyright (c) 2024-2026 Renesas Electronics Corporation
 * SPDX-License-Identifier: Apache-2.0
 */

/delete-node/ &storage_partition;

&code_flash {
	partitions {
		ranges;
		#address-cells = <1>;
		#size-cells = <1>;

		/* Set the 2 last block of storage. */
		storage_partition: partition@1e8000 {
			compatible = "zephyr,mapped-partition";
			reg = <0x1e8000 DT_SIZE_K(64)>;
			label = "storage";
		};
	};
};

&s28hl512t {
	status = "disabled";
};
