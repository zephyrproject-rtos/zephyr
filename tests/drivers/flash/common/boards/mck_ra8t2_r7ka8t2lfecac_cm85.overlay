/*
 * Copyright (c) 2025 Renesas Electronics Corporation
 * SPDX-License-Identifier: Apache-2.0
 */

&code_mram_cm85 {
	partitions {
		compatible = "fixed-partitions";
		#address-cells = <1>;
		#size-cells = <1>;

		storage_partition: partition@98000 {
			label = "storage";
			reg = <0x98000 DT_SIZE_K(32)>;
		};
	};
};
