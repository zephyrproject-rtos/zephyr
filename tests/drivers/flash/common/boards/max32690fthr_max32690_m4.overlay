/*
 * Copyright (c) 2024 Analog Devices, Inc.
 *
 * SPDX-License-Identifier: Apache-2.0
 */

&flash0 {
	partitions {
		compatible = "fixed-partitions";
		#address-cells = <1>;
		#size-cells = <1>;

		code_partition: partition@0 {
			reg = <0x0 DT_SIZE_M(2)>;
			read-only;
		};

		storage_partition: partition@200000 {
			label = "storage";
			reg = <0x200000 DT_SIZE_K(1)>;
		};
	};
};
