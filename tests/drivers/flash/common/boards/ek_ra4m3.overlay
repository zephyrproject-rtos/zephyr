/*
 * Copyright (c) 2024 Renesas Electronics Corporation
 * SPDX-License-Identifier: Apache-2.0
 */

/delete-node/ &storage_partition;

&flash0 {
	partitions {
		compatible = "fixed-partitions";
		#address-cells = <1>;
		#size-cells = <1>;

		/* Set the 2 last block of storage. */
		storage_partition: partition@f0000 {
			label = "storage";
			reg = <0xf0000 DT_SIZE_K(64)>;
		};
	};
};
