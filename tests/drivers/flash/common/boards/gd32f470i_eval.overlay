/*
 * Copyright (c) 2023, BrainCo Inc.
 *
 * SPDX-License-Identifier: Apache-2.0
 */

&flash0 {
	partitions {
		compatible = "fixed-partitions";
		#address-cells = <1>;
		#size-cells = <1>;

		/* Set 512KB of storage at the end of 3072KB flash */
		storage_partition: partition@280000 {
			label = "storage";
			reg = <0x00280000 DT_SIZE_K(512)>;
		};
	};
};

/* To avoid test on nor_flash, disable it. */
&nor_flash {
	status = "disabled";
};
