/*
 * SPDX-FileCopyrightText: Copyright (c) 2026 CodeWrights GmbH
 * SPDX-License-Identifier: Apache-2.0
 */

/delete-node/ &storage_partition;

&spi_nand_mikroe_flash_5_click {
	partitions {
		compatible = "fixed-partitions";
		#address-cells = <1>;
		#size-cells = <1>;

		storage_partition: partition@0 {
			label = "storage";
			reg = <0x0 DT_SIZE_K(256)>;
		};
	};
};
