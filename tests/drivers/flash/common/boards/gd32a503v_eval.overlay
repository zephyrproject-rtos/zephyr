/*
 * Copyright (c) 2023, BrainCo Inc.
 *
 * SPDX-License-Identifier: Apache-2.0
 */

&flash0 {
	partitions {
		compatible = "fixed-partitions";
		#address-cells = <1>;
		#size-cells = <1>;

		/* Set 4KB of storage at the border of bank0(256KB) and bank1(128KB). */
		storage_partition: partition@3f800 {
			label = "storage";
			reg = <0x0003f800 DT_SIZE_K(4)>;
		};
	};
};

/* To avoid test on nor_flash, disable it. */
&nor_flash {
	status = "disabled";
};
