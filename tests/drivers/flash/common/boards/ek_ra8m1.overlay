/*
 * Copyright (c) 2024 Renesas Electronics Corporation
 * SPDX-License-Identifier: Apache-2.0
 */

/delete-node/ &storage_partition;

&flash0 {
	partitions {
		compatible = "fixed-partitions";
		#address-cells = <1>;
		#size-cells = <1>;

		/* Set the 2 last block of storage. */
		storage_partition: partition@1E8000 {
			label = "storage";
			reg = <0x1E8000 DT_SIZE_K(64)>;
		};
	};
};
