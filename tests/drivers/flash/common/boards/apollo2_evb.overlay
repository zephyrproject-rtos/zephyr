/*
 * SPDX-FileCopyrightText: Copyright The Zephyr Project Contributors
 * SPDX-License-Identifier: Apache-2.0
 */

/delete-node/ &storage_partition;

&flash0 {
	partitions {
		ranges;

		storage_partition: partition@fc000 {
			compatible = "zephyr,mapped-partition";
			label = "storage";
			reg = <0xfc000 DT_SIZE_K(16)>;
		};
	};
};
