/*
 * Copyright (c) 2026 Nordic Semiconductor ASA
 *
 * SPDX-License-Identifier: Apache-2.0
 */

&mspi00 {
	status = "okay";
};

/delete-node/ &slot1_partition;

&mx25u25645g {
	status = "okay";

	partitions {
		compatible = "fixed-partitions";
		#address-cells = <1>;
		#size-cells = <1>;

		slot1_partition: partition@0 {
			label = "image-1";
			reg = <0x0 DT_SIZE_K(680)>;
		};
	};
};
