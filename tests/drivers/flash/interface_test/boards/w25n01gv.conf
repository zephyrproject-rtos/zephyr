## tests/drivers/flash/negative_tests/testcase.yaml
```yaml
common:
  tags:
    - drivers
    - flash
tests:
  drivers.flash.negative_tests:
    platform_allow:
      - nrf54h20dk/nrf54h20/cpuapp
      - nrf54l15dk/nrf54l15/cpuapp
      - nrf54lm20dk/nrf54lm20a/cpuapp
      - nrf54lm20dk/nrf54lm20b/cpuapp
      - ophelia4ev/nrf54l15/cpuapp
      - sam_e54_xpro
      - lp_em_cc35x1/cc3551e
      - lp_em_cc2340r5
      - lp_em_cc2340r5moda
      - lp_em_cc2340r53
      - lp_em_cc2340r53_wcsp
      - lp_em_cc2745r10_q1/cc2745r10_q1
      - lp_em_cc2745r10_q1/cc2755r10
      - lp_em_cc2755p10
```

## tests/drivers/fuel_gauge/bq35100/boards/native_sim.conf
```kconfig
# Copyright (c) 2025 Orgatex GmbH
#
# SPDX-License-Identifier: Apache-2.0

CONFIG_EMUL=y
CONFIG_GPIO=y
CONFIG_PM_DEVICE=y
```

## tests/drivers/fuel_gauge/ltc3337/boards/native_sim.conf
```kconfig
# SPDX-FileCopyrightText: Copyright (c) 2026 Federico Borgo
# SPDX-License-Identifier: Apache-2.0

CONFIG_EMUL=y
```

## tests/drivers/gpio/gpio_ite_it8xxx2_v2/Kconfig
```kconfig
# Copyright 2023 The ChromiumOS Authors
#
# SPDX-License-Identifier: Apache-2.0

config SOC_IT8XXX2_GPIO_GROUP_K_L_DEFAULT_PULL_DOWN
	bool

config HAS_ITE_INTC
	bool
	default y

source "Kconfig.zephyr"
```

## tests/drivers/i2c/i2c_async/Kconfig
```kconfig
/*
 * SPDX-FileCopyrightText: Copyright (c) 2026 Microchip Technology Inc.
 * SPDX-License-Identifier: Apache-2.0
 */

source "Kconfig.zephyr"

config I2C_ASYNC_TEST_EEPROM_OFFSET
	int "EEPROM internal offset used by the async I2C test"
	default 1
	help
	  Internal memory offset in the EEPROM that the test writes to and
	  reads back. Encoded into address bytes according to the device's
	  address-width property.

config I2C_ASYNC_TEST_DATA_LEN
	int "Payload length for the async I2C test"
	default 8
	range 1 256
	help
	  Number of data bytes written to and read back from the EEPROM.
```

## tests/drivers/i2c/i2c_fault_injection/Kconfig
```kconfig
# SPDX-FileCopyrightText: Copyright (c) 2026 Infineon Technologies AG,
# SPDX-FileCopyrightText: or an affiliate of Infineon Technologies AG. All rights reserved.
#
# SPDX-License-Identifier: Apache-2.0

mainmenu "I2C fault injection test"

config I2C_FAULT_TEST_ABSENT_ADDR
	hex "7-bit address that nothing on the bus answers"
	default 0x01
	range 0x01 0x77
	help
	  Address that the address-phase tests send to.  The default, 0x01,
	  is the CBUS address.  The I2C-bus specification does not allow
	  I2C-bus compatible devices to respond to it, though a system may
	  assign it to a target when CBUS is not used (UM10204 Rev. 7.0,
	  Table 4 and section 3.1.12).

	  The suite checks with one zero-length write that the address does
	  not answer before using it.  If it answers, every test skips and
	  the log names the address.  Set another address where a device on
	  the bus uses 0x01.

	  This is not a devicetree property, because devicetree describes
	  what is present on a bus and this is an address where nothing is.

config I2C_FAULT_TEST_PRESENT_ADDR
	hex "7-bit address used for the known-good transfers"
	default 0x00
	range 0x00 0x77
	help
	  Address that the suite sends to when it needs to show that the bus
	  still works.  The default, 0x00, means the first enabled devicetree
	  child of the controller under test that answers a zero-length
	  write.  Set a value where the device that answers is not in
	  devicetree.

	  Only the zero-length write is sent to this address, so the device
	  there is not written to.  If nothing answers, the tests that need a
	  known-good address skip.

config I2C_FAULT_TEST_ABSENT_ADDR_10BIT
	hex "10-bit address that nothing on the bus answers"
	default 0x2AA
	range 0x000 0x3FF
	help
	  10-bit address used by the 10-bit addressing test.  The test checks
	  with one zero-length 10-bit write that the address does not answer
	  before sending data, and skips if it does.  Set another address
	  where a device on the bus uses it.

config I2C_FAULT_TEST_BUS_FAULT_WIRED
	bool "The line-forcing GPIOs are wired to the bus"
	help
	  Declares that the GPIOs named by sda-gpios and scl-gpios under the
	  zephyr,user node are wired to the SDA and SCL nets of the controller
	  under test.  The twister scenario with the i2c_bus_fault fixture
	  sets it.

	  Devicetree names the pins but cannot say that a jumper is fitted.
	  Holding lines through pins that are not wired produces failures
	  that look like driver defects, so without this option the tests
	  that hold a line skip.  With it, the build fails unless both
	  properties are present, and setup fails unless both GPIOs are
	  ready.

config I2C_FAULT_TEST_RELAXED_ERRNO
	bool "Accept any negative errno from a failed transfer or recovery"
	help
	  The I2C API documents -EIO for a failed transfer and -ETIMEDOUT for
	  one that reached the transfer timeout, and -EBUSY for a bus that is
	  not clear after a recovery attempt, so by default this suite
	  accepts only those.  Enable this to accept any negative value
	  instead, which is useful when bringing up a driver that is not yet
	  conformant.  In both modes each test logs the value the driver
	  returned.

config I2C_FAULT_TEST_UNSAFE_API_MISUSE
	bool "Run the NULL-buffer condition without userspace"
	help
	  Runs test_misuse_null_buffer, which passes a NULL buffer with a
	  non-zero length, in a build without CONFIG_USERSPACE.  Without
	  userspace, nothing validates the buffer before the driver receives
	  it.  The driver may dereference the NULL pointer or pass it to a DMA
	  engine, and either can fault the CPU and end the run.  Off by
	  default for that reason.

config I2C_FAULT_TEST_TIMEOUT_MS
	int "Time in milliseconds the test waits for a faulted transfer"
	default 2000
	range 100 30000
	help
	  The test wait limit: how long the test thread waits for a faulted
	  transfer, which runs on a worker thread.  A transfer still running
	  at the limit fails the condition where the driver has a transfer
	  timeout shorter than this limit, and skips it elsewhere.  Without
	  the limit, a driver that never returns would show up only as a
	  twister timeout, which looks the same as a build or flash problem.

config I2C_FAULT_TEST_WORKER_STACK_SIZE
	int "Stack size in bytes for the faulted-transfer worker thread"
	default 2048
	range 512 8192
	help
	  Stack for the thread that faulted transfers run on.  It calls
	  nothing deeper than the I2C driver.

config I2C_FAULT_TEST_PAYLOAD_LEN
	int "Bytes transferred by the multi-byte conditions"
	default 8
	range 4 64
	help
	  Length of the data in the multi-byte transfers: the write, read and
	  write-read to the absent address, the read in the alternating-NACK
	  test, and the NULL-buffer write.  A refused transfer then leaves the
	  driver more than one queued byte to discard.

config I2C_FAULT_TEST_REPEAT_COUNT
	int "Attempts made by the repeated-fault conditions"
	default 5
	range 2 100
	help
	  Number of times a fault is repeated when checking that a driver
	  does not latch state from the first failure, and the number of
	  consecutive recovery calls in the repeated-recovery test.

config I2C_FAULT_TEST_HOLD_MS
	int "Milliseconds a line is held low before a recovery"
	default 20
	range 1 1000
	help
	  How long the recovery-after-release test holds SDA low through a
	  forcing GPIO before releasing it and calling i2c_recover_bus().
	  The bus is open drain, so the hold needs no timing precision.

source "Kconfig.zephyr"
```

## tests/drivers/i2c/i2c_target_api/boards/frdm_mcxa287.conf
```kconfig
# SPDX-FileCopyrightText: Copyright 2026 NXP
# SPDX-License-Identifier: Apache-2.0

CONFIG_I2C_MCUX_LPI2C_BUS_RECOVERY=y
```

## tests/drivers/i2c/i2c_target_api/boards/kit_t2g_c2d6m_lite_cyt4dnjbzs_m7_0.conf
```kconfig
# SPDX-FileCopyrightText: Copyright (c) 2026 Linumiz
#
# SPDX-License-Identifier: Apache-2.0

CONFIG_I2C_VIRTUAL=n
```

## tests/drivers/i2c/i2c_target_api/boards/lp_mspm0g3507.conf
```kconfig
# Copyright (c) 2026 Texas Instruments Incorporated
# SPDX-License-Identifier: Apache-2.0

CONFIG_I2C_VIRTUAL=n
CONFIG_BOOT_BANNER=n
```

## tests/drivers/i2c/i2c_target_api/boards/nrf54lv10dk_nrf54lv10a_cpuapp_ns.conf
```kconfig
CONFIG_I2C_TARGET_BUFFER_MODE=y
CONFIG_I2C_NRFX_TWIS_BUF_SIZE=256
CONFIG_TFM_LOG_LEVEL_SILENCE=y
```

## tests/drivers/i2c/regset_target_lib/Kconfig
```kconfig
# SPDX-FileCopyrightText: Copyright The Zephyr Project Contributors
# SPDX-License-Identifier: Apache-2.0

config I2C_TARGET_REGSET_LIB
	default y

source "Kconfig.zephyr"
```

## tests/drivers/i2s/i2s_api/boards/rpi_pico2_rp2350a_m33.conf
```kconfig
CONFIG_DMA=y
CONFIG_LOG_MODE_DEFERRED=y
CONFIG_I2S_LOG_LEVEL_DBG=y
CONFIG_I2S_TEST_ALLOWED_DATA_OFFSET=16
CONFIG_I2S_TEST_ALLOW_VARIABLE_OFFSET=y
CONFIG_I2S_TEST_USE_GPIO_LOOPBACK=y
```

## tests/drivers/i2s/i2s_api/boards/rtl8721f_evb.conf
```kconfig
#
# Copyright (c) 2026 Realtek Semiconductor Corp.
#
# SPDX-License-Identifier: Apache-2.0
#

CONFIG_I2S_TEST_ALLOWED_DATA_OFFSET=2
```

## tests/drivers/i2s/i2s_speed/boards/rpi_pico2_rp2350a_m33.conf
```kconfig
CONFIG_DMA=y

CONFIG_I2S_TEST_USE_GPIO_LOOPBACK=y

CONFIG_I2S_TEST_ALLOWED_DATA_OFFSET=16
CONFIG_I2S_TEST_ALLOW_VARIABLE_OFFSET=y
CONFIG_I2S_TEST_SKIP_SAMPLERATE_88200=y
CONFIG_I2S_TEST_SKIP_SAMPLERATE_96000=y

CONFIG_I2S_LOG_LEVEL_OFF=y
CONFIG_DMA_LOG_LEVEL_OFF=y
CONFIG_LOG_MODE_DEFERRED=y
```

## tests/drivers/i3c/dual_board_loopback/controller_driven/i3c_controller/Kconfig
```kconfig
# SPDX-FileCopyrightText: Copyright (c) 2026 Infineon Technologies AG,
# SPDX-FileCopyrightText: or an affiliate of Infineon Technologies AG. All rights reserved.
#
# SPDX-License-Identifier: Apache-2.0

mainmenu "I3C loopback test (controller)"

source "Kconfig.zephyr"

menu "I3C loopback bench options"

config I3C_DUAL_BOARD_LOOPBACK_META_TESTS
	bool "Build the meta tests that exercise the loopback fixture"
	help
	  Build the ``meta_*`` ZTESTs in test_harness.c.  These test the
	  fixture in main.c rather than the I3C driver: they deliberately
	  corrupt the target descriptor to prove the recovery path in
	  dual_board_loopback_heal_target() puts it back.  Because they run before
	  the driver tests and mutate shared bus state, a regression in the
	  fixture makes them cascade into every later test, so keep them off
	  for routine runs and enable them when changing the harness.

endmenu
```
