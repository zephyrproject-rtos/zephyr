/*
 * Copyright (c) 2022 STMicroelectronics
 *
 * SPDX-License-Identifier: Apache-2.0
 */

&flash0 {
	partitions {
		compatible = "fixed-partitions";
		#address-cells = <1>;
		#size-cells = <1>;

		/* Set 8KB of storage at the end of 2MB flash */
		storage_partition: partition@1fe000 {
			label = "storage";
			reg = <0x01fe000 0x00002000>;
		};
	};
};
