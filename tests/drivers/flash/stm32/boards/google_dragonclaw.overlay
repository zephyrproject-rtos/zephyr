/*
 * Copyright (c) 2023 Google Inc
 *
 * SPDX-License-Identifier: Apache-2.0
 */

&flash0 {
	partitions {
		compatible = "fixed-partitions";
		#address-cells = <1>;
		#size-cells = <1>;

		/* Reserve last 4KiB of flash for storage_partition. */
		storage_partition: partition@ff000 {
			label = "storage";
			reg = <0x000ff000 DT_SIZE_K(4)>;
		};
	};
};
