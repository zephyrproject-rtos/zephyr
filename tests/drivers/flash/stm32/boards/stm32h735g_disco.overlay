/*
 * Copyright (c) 2024 STMicroelectronics
 *
 * SPDX-License-Identifier: Apache-2.0
 */

&flash0 {
	partitions {
		ranges;
		#address-cells = <1>;
		#size-cells = <1>;

		/* Reserve 4KiB of flash for storage_partition. */
		storage_partition: partition@f0000 {
			compatible = "zephyr,mapped-partition";
			reg = <0x000f0000 DT_SIZE_K(4)>;
			label = "storage";
		};
	};
};
