/*
 * Copyright (c) 2023 STMicroelectronics
 *
 * SPDX-License-Identifier: Apache-2.0
 */

/* Do not use the storage-partition of the external qspi-NOR flash */
/delete-node/ &storage_partition;

&flash0 {
	partitions {
		/* Reserve 4KiB of flash for storage_partition. */
		storage_partition: partition@f0000 {
			compatible = "zephyr,mapped-partition";
			label = "storage";
			reg = <0x000f0000 DT_SIZE_K(4)>;
		};
	};
};
