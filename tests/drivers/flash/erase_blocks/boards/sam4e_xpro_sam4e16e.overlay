/*
 * Copyright (c) 2025 Nordic Semiconductor ASA
 *
 * SPDX-License-Identifier: Apache-2.0
 */

&flash0 {
	partitions {
		/delete-node/ storage_partition;

		slot1_partition: partition@84000 {
			label = "image-1";
			reg = <0x00084000 0x7C000>;
		};
	};
};
