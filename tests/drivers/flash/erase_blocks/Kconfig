## tests/drivers/flash/erase_blocks/Kconfig
```kconfig
# SPDX-FileCopyrightText: <text>Copyright (c) 2026 Infineon Technologies AG,
# or an affiliate of Infineon Technologies AG. All rights reserved.</text>
#
# SPDX-License-Identifier: Apache-2.0

config TEST_FLASH_ERASE_BLOCKS_BUFFER_SIZE
	int "Flash erase-blocks test buffer size"
	default 512

source "Kconfig.zephyr"
```

## tests/drivers/flash/erase_blocks/testcase.yaml
```yaml
# Copyright (c) 2023 Bjarki Arge Andreasen
# SPDX-License-Identifier: Apache-2.0

common:
  sysbuild: true
  tags:
    - drivers
    - flash
tests:
  flash.erase_blocks.build_only:
    harness: ztest
    build_only: true
    platform_allow:
      - sam_v71_xult/samv71q21
      - b_u585i_iot02a
      - nrf9160dk/nrf9160
      - nrf5340dk/nrf5340/cpuapp
    integration_platforms:
      - nrf9160dk/nrf9160
```

## tests/drivers/flash/interface_test/Kconfig
```kconfig
#
# Copyright 2025 NXP
# SPDX-FileCopyrightText: <text>Copyright (c) 2026 Infineon Technologies AG,
# or an affiliate of Infineon Technologies AG. All rights reserved.</text>
#
# SPDX-License-Identifier: Apache-2.0
#

config TEST_FLASH_PATTERN_SIZE
	int "Flash interface test pattern size"
	default 256

config TEST_SEQUENTIAL_READ_PATTERN_AMOUNT
	int "Perform amount of sequential-read-pattern tests"
	default 1000000

config TEST_SEQUENTIAL_ALTERNATING_READ_PATTERN_AMOUNT
	int "Perform amount of sequential-alternating-read-pattern tests"
	default 1000000

source "Kconfig.zephyr"
```

## tests/drivers/flash/interface_test/testcase.yaml
```yaml
#
# Copyright 2025 NXP
#
# SPDX-License-Identifier: Apache-2.0
#

common:
  tags:
    - drivers
    - flash
    - memc
tests:
  flash.interface_test.build_only:
    harness: ztest
    build_only: true
    filter: CONFIG_FLASH_HAS_DRIVER_ENABLED and
      dt_label_with_parent_compat_enabled("slot1_partition", "fixed-partitions")
    integration_platforms:
      - imx95_evk/mimx9596/m7
```

## tests/drivers/flash/negative_tests/Kconfig
```kconfig
# SPDX-FileCopyrightText: <text>Copyright (c) 2026 Infineon Technologies AG,
# or an affiliate of Infineon Technologies AG. All rights reserved.</text>
#
# SPDX-License-Identifier: Apache-2.0

config TEST_FLASH_SUPPORTS_UNALIGNED_OP
	bool "Flash device under test supports unaligned operations"
	default y if FLASH_INFINEON_RRAM
	help
	  Set this if the flash device under test supports unaligned
	  read/write/erase/flatten operations (i.e. offset and size are not
	  required to be page-aligned).

source "Kconfig.zephyr"
```

## tests/drivers/flash/negative_tests/boards/kit_psc3m5_evk.conf
```kconfig
# SPDX-FileCopyrightText: Copyright (c) 2026 Infineon Technologies AG,
# SPDX-FileCopyrightText: or an affiliate of Infineon Technologies AG. All rights reserved.
#
# SPDX-License-Identifier: Apache-2.0

CONFIG_FLASH_FILL_BUFFER_SIZE=512
```

## tests/drivers/flash/npcx/testcase.yaml
```yaml
common:
  tags:
    - drivers
    - flash
tests:
  drivers.flash.npcx:
    platform_allow:
      - google_quincy
    extra_configs:
      - CONFIG_FLASH_NPCX_FIU_QSPI=y
      - CONFIG_FLASH_NPCX_FIU_NOR=y
      - CONFIG_FLASH_NPCX_FIU_NOR_INIT=y
```

## tests/drivers/flash/nrf_qpsi_flash/testcase.yaml
```yaml
common:
  sysbuild: true
  depends_on: spi

tests:
  tests.drivers.nrf_qspi_flash.qspi_multi_line_mode:
    tags:
      - drivers
      - flash
      - spi
    platform_allow:
      - nrf52840dk/nrf52840
      - nrf5340dk/nrf5340/cpuapp
    integration_platforms:
      - nrf52840dk/nrf52840
      - nrf5340dk/nrf5340/cpuapp
    harness: console
    harness_config:
      type: multi_line
      ordered: true
      regex:
        - ".*Flash erase succeeded.*"
        - ".*Data read matches data written. Good.*"

  tests.drivers.nrf_qspi_flash.qspi_single_line_mode:
    tags:
      - drivers
      - flash
      - spi
    platform_allow:
      - nrf52840dk/nrf52840
      - nrf5340dk/nrf5340/cpuapp
    integration_platforms:
      - nrf52840dk/nrf52840
      - nrf5340dk/nrf5340/cpuapp
    extra_args:
      - EXTRA_DTC_OVERLAY_FILE="flash_cfg/mx25r64_single_line.overlay"
    harness: console
    harness_config:
      type: multi_line
      ordered: true
      regex:
        - ".*Flash erase succeeded.*"
        - ".*Data read matches data written. Good.*"
```

## tests/drivers/flash/preload_data/boards/qemu_riscv64.conf
```kconfig
# SPDX-License-Identifier: Apache-2.0
# Copyright (c) 2026 Analog Devices, Inc.

CONFIG_FLASH=y
CONFIG_FLASH_PAGE_LAYOUT=y
CONFIG_SEMIHOST=y
```

## tests/drivers/flash/stm32/boards/stm32h750b_dk.conf
```kconfig
# SPDX-FileCopyrightText: Copyright The Zephyr Project Contributors
# SPDX-License-Identifier: Apache-2.0

CONFIG_FLASH_STM32_QSPI=n
```

## tests/drivers/flash/stm32/testcase.yaml
```yaml
common:
  tags:
    - drivers
    - flash
tests:
  drivers.flash.stm32.f4:
    platform_allow:
      - nucleo_f429zi
      - google_dragonclaw
    extra_configs:
      - CONFIG_FLASH_STM32_WRITE_PROTECT=y
      - CONFIG_FLASH_STM32_READOUT_PROTECTION=y
    filter: dt_compat_enabled("st,stm32f4-flash-controller") and
            dt_label_with_parent_compat_enabled("storage_partition", "fixed-partitions")
  drivers.flash.stm32.f4.block_registers:
    platform_allow:
      - nucleo_f429zi
      - google_dragonclaw
    extra_configs:
      - CONFIG_FLASH_STM32_BLOCK_REGISTERS=y
    filter: dt_compat_enabled("st,stm32f4-flash-controller") and
            dt_label_with_parent_compat_enabled("storage_partition", "fixed-partitions")
  drivers.flash.stm32.l4:
    platform_allow:
      - nucleo_l452re/stm32l452xx/p
      - disco_l475_iot1
    extra_configs:
      - CONFIG_FLASH_STM32_READOUT_PROTECTION=y
    filter: dt_compat_enabled("st,stm32l4-flash-controller") and
            dt_label_with_parent_compat_enabled("storage_partition", "fixed-partitions")
  drivers.flash.stm32.g4:
    platform_allow:
      - nucleo_g474re
    extra_configs:
      - CONFIG_FLASH_STM32_READOUT_PROTECTION=y
    filter: dt_compat_enabled("st,stm32g4-flash-controller") and
      dt_label_with_parent_compat_enabled("storage_partition", "fixed-partitions")
  drivers.flash.stm32.f7:
    platform_allow:
      - nucleo_f746zg
    extra_configs:
      - CONFIG_FLASH_STM32_READOUT_PROTECTION=y
    filter: dt_compat_enabled("st,stm32f7-flash-controller") and
      dt_label_with_parent_compat_enabled("storage_partition", "fixed-partitions")
  drivers.flash.stm32.h7:
    platform_allow:
      - stm32h735g_disco
      - stm32h750b_dk
      - stm32h745i_disco/stm32h745xx/m7
      - nucleo_h743zi
      - google_icetower
    extra_configs:
      - CONFIG_FLASH_STM32_READOUT_PROTECTION=y
      - CONFIG_FLASH_STM32_WRITE_PROTECT=y
    filter: dt_compat_enabled("st,stm32h7-flash-controller") and
      dt_label_with_parent_compat_enabled("storage_partition", "fixed-partitions")
  drivers.flash.stm32.h7.block_registers:
    platform_allow:
      - nucleo_h743zi
      - google_icetower
    extra_configs:
      - CONFIG_FLASH_STM32_BLOCK_REGISTERS=y
    filter: dt_compat_enabled("st,stm32h7-flash-controller") and
            dt_label_with_parent_compat_enabled("storage_partition", "fixed-partitions") and
            CONFIG_SOC_SERIES_STM32H7X
```

## tests/drivers/flash/suspend_resume/testcase.yaml
```yaml
common:
  tags:
    - drivers
    - flash
tests:
  drivers.flash.suspend_resume.nrf_spi_nor:
    platform_allow: nrf52840dk/nrf52840
    extra_args:
      - OVERLAY_CONFIG=boards/nrf52840dk_spi_nor.conf
      - DTC_OVERLAY_FILE=boards/nrf52840dk_spi_nor.overlay
      - CONFIG_SPI_NOR_SFDP_RUNTIME=y
    integration_platforms:
      - nrf52840dk/nrf52840
    harness_config:
      fixture: external_flash_mx25v1635f
  drivers.flash.suspend_resume.spi_nor:
    filter: dt_compat_enabled("jedec,spi-nor")
```

## tests/drivers/flash/testcase.yaml
```yaml
common:
  tags: drivers flash
tests:
  drivers.flash.nrf_qspi_nor:
    platform_allow: nrf52840dk_nrf52840
    extra_args: OVERLAY_CONFIG=boards/nrf52840_flash_qspi.conf
    integration_platforms:
      - nrf52840dk_nrf52840
  drivers.flash.nrf_qspi_nor.size_in_bytes:
    platform_allow: nrf52840dk_nrf52840
    extra_args:
      OVERLAY_CONFIG=boards/nrf52840_flash_qspi.conf
      DTC_OVERLAY_FILE=boards/nrf52840_size_in_bytes.overlay
    integration_platforms:
      - nrf52840dk_nrf52840
  drivers.flash.nrf_qspi_nor_4B_addr:
    platform_allow: nrf52840dk_nrf52840
    extra_args: OVERLAY_CONFIG=boards/nrf52840_flash_qspi.conf
                DTC_OVERLAY_FILE=boards/nrf52840dk_mx25l51245g.overlay
    harness_config:
      fixture: external_flash
    integration_platforms:
      - nrf52840dk_nrf52840
  drivers.flash.soc_flash_nrf:
    platform_allow: nrf52840dk_nrf52840
    extra_args: OVERLAY_CONFIG=boards/nrf52840_flash_soc.conf
    integration_platforms:
      - nrf52840dk_nrf52840
  drivers.flash.default:
    filter: ((CONFIG_FLASH_HAS_DRIVER_ENABLED and
        not CONFIG_TRUSTED_EXECUTION_NONSECURE) and
        dt_label_with_parent_compat_enabled("storage_partition", "fixed-partitions"))
  drivers.flash.tfm_ns:
    build_only: true
    filter: (CONFIG_FLASH_HAS_DRIVER_ENABLED and CONFIG_TRUSTED_EXECUTION_NONSECURE and
        dt_label_with_parent_compat_enabled("slot1_ns_partition", "fixed-partitions"))
  drivers.flash.mcux:
    platform_allow: mimxrt1060_evk it8xxx2_evb mimxrt685_evk_cm33 mimxrt595_evk_cm33
    integration_platforms:
      - mimxrt1060_evk
  drivers.flash.stm32:
    platform_allow: nucleo_f103rb nucleo_f207zg stm32f3_disco nucleo_f429zi stm32f746g_disco
      nucleo_g0b1re nucleo_g474re nucleo_h743zi nucleo_l152re disco_l475_iot1 nucleo_wb55rg
      nucleo_wl55jc stm32l562e_dk stm32l562e_dk_ns
    integration_platforms:
      - nucleo_f103rb
    filter: (dt_compat_enabled("st,stm32-flash-controller") or
             dt_compat_enabled("st,stm32h7-flash-controller")) and
       dt_label_with_parent_compat_enabled("storage_partition", "fixed-partitions")
  drivers.flash.mx25r_high_perf:
    platform_allow: nrf52840dk_nrf52840
    extra_args:
      OVERLAY_CONFIG=boards/nrf52840dk_flash_spi.conf
      DTC_OVERLAY_FILE=boards/nrf52840dk_mx25r_high_perf.overlay
    integration_platforms:
      - nrf52840dk_nrf52840
```

## tests/drivers/flash_api/testcase.yaml
```yaml
#
# Copyright (c) 2021 Nordic Semiconductor ASA
#
# SPDX-License-Identifier: Apache-2.0
#
tests:
  drivers.flash.api:
    tags: driver flash_api
    platform_allow:
      - native_sim/native/64
      - native_sim
  drivers.flash.api.userspace:
    tags: driver flash_api userspace
    platform_allow:
      - native_sim/native/64
      - native_sim
    extra_configs:
      - CONFIG_USERSPACE=y
```

## tests/drivers/flash_partition/boards/flash_simulator.conf
```kconfig
#
# Copyright (c) 2021 Nordic Semiconductor ASA
#
# SPDX-License-Identifier: Apache-2.0
#
CONFIG_FLASH_SIMULATOR=y
CONFIG_FLASH_SIMULATOR_DOUBLE_WRITES=n
CONFIG_FLASH_SIMULATOR_UNALIGNED_READ=n
```

## tests/drivers/flash_partition/testcase.yaml
```yaml
#
# Copyright (c) 2021 Nordic Semiconductor ASA
#
# SPDX-License-Identifier: Apache-2.0
#
tests:
  drivers.flash.flash_partition:
    platform_allow: qemu_x86 native_posix native_posix_64
                    OVERLAY_CONFIG=boards/flash_simulator.conf
    tags: driver
  drivers.flash.flash_parititon.qemu_erase_value_0x00:
    extra_args: DTC_OVERLAY_FILE=boards/qemu_x86_ev_0x00.overlay
                OVERLAY_CONFIG=boards/flash_simulator.conf
    platform_allow: qemu_x86
    tags: driver
  drivers.flash.flash_partition.posix_erase_value_0x00:
    extra_args: DTC_OVERLAY_FILE=boards/native_posix_ev_0x00.overlay
                OVERLAY_CONFIG=boards/flash_simulator.conf
    platform_allow: native_posix
    tags: driver
  drivers.flash.fash_partition.posix_64_erase_value_0x00:
    extra_args: DTC_OVERLAY_FILE=boards/native_posix_64_ev_0x00.overlay
                OVERLAY_CONFIG=boards/flash_simulator.conf
    platform_allow: native_posix_64
    tags: driver
```

## tests/drivers/flash_simulator/flash_sim_impl/testcase.yaml
```yaml
common:
  tags:
    - drivers
    - flash
tests:
  drivers.flash.flash_simulator:
    platform_allow:
      - qemu_x86
      - native_sim
      - native_sim/native/64
      - nucleo_f411re
    integration_platforms:
      - qemu_x86
  drivers.flash.flash_simulator.ramlike:
    extra_args: CONFIG_FLASH_SIMULATOR_EXPLICIT_ERASE=n
    platform_allow:
      - qemu_x86
      - native_sim
      - native_sim/native/64
      - nucleo_f411re
    integration_platforms:
      - qemu_x86
  drivers.flash.flash_simulator.qemu_erase_value_0x00:
    extra_args: DTC_OVERLAY_FILE=boards/qemu_x86_ev_0x00.overlay
    platform_allow: qemu_x86
    integration_platforms:
      - qemu_x86
  drivers.flash.flash_simulator.native_erase_value_0x00:
    extra_args: DTC_OVERLAY_FILE=boards/native_ev_0x00.overlay
    platform_allow:
      - native_sim
    integration_platforms:
      - native_sim
  drivers.flash.flash_simulator.native_64_erase_value_0x00:
    extra_args: DTC_OVERLAY_FILE=boards/native_64_ev_0x00.overlay
    platform_allow:
      - native_sim/native/64
    integration_platforms:
      - native_sim/native/64
```

## tests/drivers/flash_simulator/flash_sim_reboot/testcase.yaml
```yaml
common:
  tags:
    - drivers
    - flash
tests:
  drivers.flash.flash_simulator.boot_no_erase:
    timeout: 5
    platform_allow: mps2/an385
    integration_platforms:
      - mps2/an385
```

## tests/drivers/flash_simulator/testcase.yaml
```yaml
tests:
  drivers.flash.flash_simulator:
    platform_allow: qemu_x86 native_posix native_posix_64
    tags: drivers
  drivers.flash.flash_simulator.qemu_erase_value_0x00:
    extra_args: DTC_OVERLAY_FILE=boards/qemu_x86_ev_0x00.overlay
    platform_allow: qemu_x86
    tags: drivers
  drivers.flash.flash_simulator.posix_erase_value_0x00:
    extra_args: DTC_OVERLAY_FILE=boards/native_posix_ev_0x00.overlay
    platform_allow: native_posix
    tags: drivers
  drivers.flash.flash_simulator.posix_64_erase_value_0x00:
    extra_args: DTC_OVERLAY_FILE=boards/native_posix_64_ev_0x00.overlay
    platform_allow: native_posix_64
    tags: drivers
```

## tests/drivers/flash_simulator_noalloc/testcase.yaml
```yaml
#
# Copyright (c) 2021 Nordic Semiconductor ASA
#
# SPDX-License-Identifier: Apache-2.0
#
tests:
  drivers.flash.flash_simulator:
    platform_allow: qemu_x86
    tags: driver
  drivers.flash.flash_simulator.qemu_erase_value_0x00:
    extra_args: DTC_OVERLAY_FILE=boards/qemu_x86_ev_0x00.overlay
    platform_allow: qemu_x86
    tags: driver
```

## tests/drivers/ftl_dhara/testcase.yaml
```yaml
# Copyright (c) 2025 Endress+Hauser GmbH+Co. KG
# SPDX-License-Identifier: Apache-2.0

common:
  tags:
    - disk
    - drivers
tests:
  drivers.disk.ftl_dhara:
    platform_allow:
      - native_sim
```

## tests/drivers/fuel_gauge/bq27z746/testcase.yaml
```yaml
tests:
  # section.subsection
  drivers.bq27z746:
    filter: dt_compat_enabled("ti,bq27z746")
    platform_allow: native_posix
```
