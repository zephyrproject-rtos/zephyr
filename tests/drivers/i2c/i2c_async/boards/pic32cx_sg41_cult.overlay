/*
 * Copyright (c) 2025 Microchip Technology Inc.
 *
 * SPDX-License-Identifier: Apache-2.0
 */

&sercom6 {
	eeprom0: eeprom@56 {
		compatible = "zephyr,i2c-target-eeprom";
		reg = <0x56>;
		size = <256>;
	};
};
