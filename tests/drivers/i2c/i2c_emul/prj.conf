## CMakeLists.txt
```
# Copyright (c) 2024 Google LLC
# SPDX-License-Identifier: Apache-2.0

cmake_minimum_required(VERSION 3.28.0)
find_package(Zephyr REQUIRED HINTS $ENV{ZEPHYR_BASE})
project(i2c_emul)

target_sources(app PRIVATE
    src/emulated_target.cpp
    src/test_fowarding_common.cpp
)
if(CONFIG_I2C_TARGET_BUFFER_MODE)
    target_sources(app PRIVATE src/test_forwarding_buf.cpp)
else()
    target_sources(app PRIVATE src/test_forwarding_pio.cpp)
endif()
target_include_directories(app PRIVATE include)
```

## prj.conf
```kconfig
# Copyright 2024 Google LLC
# SPDX-License-Identifier: Apache-2.0

CONFIG_ZTEST=y
CONFIG_I2C=y
CONFIG_I2C_TARGET=y
CONFIG_EMUL=y

CONFIG_CPP=y
CONFIG_STD_CPP17=y
CONFIG_REQUIRES_FULL_LIBCPP=y
```

## boards/native_sim.buf.overlay
```dts
/*
 * Copyright 2024 Google LLC
 * SPDX-License-Identifier: Apache-2.0
 */

&i2c1 {
	target-buffered-mode;
};
```

## boards/native_sim.overlay
```dts
/*
 * Copyright 2024 Google LLC
 * SPDX-License-Identifier: Apache-2.0
 */

/ {
	i2c1: i2c@400 {
		compatible = "zephyr,i2c-emul-controller";
		reg = <0x400 4>;
		clock-frequency = <I2C_BITRATE_STANDARD>;
		#address-cells = <1>;
		#size-cells = <0>;
		#forward-cells = <1>;
		status = "okay";
	};

	i2c2: i2c@500 {
		compatible = "zephyr,i2c-emul-controller";
		reg = <0x500 4>;
		clock-frequency = <I2C_BITRATE_STANDARD>;
		#address-cells = <1>;
		#size-cells = <0>;
		#forward-cells = <1>;
		status = "okay";
	};
};

&i2c0 {
	forwards = <&i2c1 0x20>, <&i2c2 0x24>;
};
```

## include/emulated_target.hpp
```c
/*
 * Copyright 2024 Google LLC
 * SPDX-License-Identifier: Apache-2.0
 */

#ifndef _TESTS_DRIVERS_I2C_I2C_EMUL_INCLUDE_EMULATED_TARGET_H
#define _TESTS_DRIVERS_I2C_I2C_EMUL_INCLUDE_EMULATED_TARGET_H

#include <functional>

#define CUSTOM_FFF_FUNCTION_TEMPLATE(RETURN, FUNCNAME, ...)                                        \
	std::function<RETURN(__VA_ARGS__)> FUNCNAME

#include <zephyr/devicetree.h>
#include <zephyr/drivers/i2c.h>
#include <zephyr/fff.h>

#define CONTROLLER_LABEL DT_NODELABEL(i2c0)
#define TARGET_LABEL(n)  DT_NODELABEL(DT_CAT(i2c, n))
#define FORWARD_COUNT    DT_PROP_LEN(CONTROLLER_LABEL, forwards)

extern struct i2c_target_callbacks emulated_callbacks[FORWARD_COUNT];
extern struct i2c_target_config emulated_target_config[FORWARD_COUNT];

/* Declare all the fake functions needed */
#define DECLARE_FAKE_TARGET_FUNCTIONS(node_id, prop, n)                                            \
	DECLARE_FAKE_VALUE_FUNC(int, target_read_requested_##n, struct i2c_target_config *,        \
				uint8_t *);                                                        \
	DECLARE_FAKE_VALUE_FUNC(int, target_read_processed_##n, struct i2c_target_config *,        \
				uint8_t *);                                                        \
	DECLARE_FAKE_VALUE_FUNC(int, target_write_requested_##n, struct i2c_target_config *);      \
	DECLARE_FAKE_VALUE_FUNC(int, target_write_received_##n, struct i2c_target_config *,        \
				uint8_t);                                                          \
	DECLARE_FAKE_VALUE_FUNC(int, target_stop_##n, struct i2c_target_config *);                 \
	DECLARE_FAKE_VALUE_FUNC(int, target_buf_read_requested_##n, struct i2c_target_config *,    \
				uint8_t **, uint32_t *)                                            \
	DECLARE_FAKE_VOID_FUNC(target_buf_write_received_##n, struct i2c_target_config *,          \
			       uint8_t *, uint32_t)

DT_FOREACH_PROP_ELEM(CONTROLLER_LABEL, forwards, DECLARE_FAKE_TARGET_FUNCTIONS)

#define FFF_FAKE_ACTION(node_id, prop, n, fn)                                                      \
	do {                                                                                       \
		fn(target_read_requested_##n);                                                     \
		fn(target_read_processed_##n);                                                     \
		fn(target_write_requested_##n);                                                    \
		fn(target_write_received_##n);                                                     \
		fn(target_stop_##n);                                                               \
		fn(target_buf_read_requested_##n);                                                 \
		fn(target_buf_write_received_##n);                                                 \
	} while (0);

#define FFF_FAKES_LIST_FOREACH(fn)                                                                 \
	DT_FOREACH_PROP_ELEM_VARGS(CONTROLLER_LABEL, forwards, FFF_FAKE_ACTION, fn)

#endif /* _TESTS_DRIVERS_I2C_I2C_EMUL_INCLUDE_EMULATED_TARGET_H */
```

## src/emulated_target.cpp
```c
/*
 * Copyright 2024 Google LLC
 * SPDX-License-Identifier: Apache-2.0
 */

#include <emulated_target.hpp>

DEFINE_FFF_GLOBALS;

#define DEFINE_FAKE_TARGET_FUNCTION(node_id, prop, n)                                              \
	DEFINE_FAKE_VALUE_FUNC(int, target_read_requested_##n, struct i2c_target_config *,         \
			       uint8_t *);                                                         \
	DEFINE_FAKE_VALUE_FUNC(int, target_read_processed_##n, struct i2c_target_config *,         \
			       uint8_t *);                                                         \
	DEFINE_FAKE_VALUE_FUNC(int, target_write_requested_##n, struct i2c_target_config *);       \
	DEFINE_FAKE_VALUE_FUNC(int, target_write_received_##n, struct i2c_target_config *,         \
			       uint8_t);                                                           \
	DEFINE_FAKE_VALUE_FUNC(int, target_stop_##n, struct i2c_target_config *);                  \
	DEFINE_FAKE_VALUE_FUNC(int, target_buf_read_requested_##n, struct i2c_target_config *,     \
				uint8_t **, uint32_t *)                                            \
	DEFINE_FAKE_VOID_FUNC(target_buf_write_received_##n, struct i2c_target_config *,           \
			       uint8_t *, uint32_t)

DT_FOREACH_PROP_ELEM(CONTROLLER_LABEL, forwards, DEFINE_FAKE_TARGET_FUNCTION);

/* clang-format off */
#define DEFINE_EMULATED_CALLBACK(node_id, prop, n)                                                 \
	{                                                                                          \
		.write_requested = target_write_requested_##n,                                     \
		.read_requested = target_read_requested_##n,                                       \
		.write_received = target_write_received_##n,                                       \
		.read_processed = target_read_processed_##n,                                       \
		COND_CODE_1(CONFIG_I2C_TARGET_BUFFER_MODE,                                         \
			    (.buf_write_received = target_buf_write_received_##n, ), ())           \
		COND_CODE_1(CONFIG_I2C_TARGET_BUFFER_MODE,                                         \
				(.buf_read_requested = target_buf_read_requested_##n, ), ())       \
		.stop = target_stop_##n,                                                           \
	},
/* clang-format on */

struct i2c_target_callbacks emulated_callbacks[FORWARD_COUNT] = {
	DT_FOREACH_PROP_ELEM(CONTROLLER_LABEL, forwards, DEFINE_EMULATED_CALLBACK)};

#define DEFINE_EMULATED_TARGET_CONFIG(node_id, prop, n)                                            \
	{                                                                                          \
		.flags = 0,                                                                        \
		.address = DT_PHA_BY_IDX(node_id, prop, n, addr),                                  \
		.callbacks = &emulated_callbacks[n],                                               \
	},

struct i2c_target_config emulated_target_config[FORWARD_COUNT] = {
	DT_FOREACH_PROP_ELEM(CONTROLLER_LABEL, forwards, DEFINE_EMULATED_TARGET_CONFIG)};
```

## src/test_forwarding.cpp
```c
/*
 * Copyright 2024 Google LLC
 * SPDX-License-Identifier: Apache-2.0
 */
#include "emulated_target.hpp"

#include <zephyr/devicetree.h>
#include <zephyr/drivers/i2c.h>
#include <zephyr/fff.h>
#include <zephyr/ztest.h>

namespace
{

#define GET_TARGET_DEVICE(node_id, prop, n) DEVICE_DT_GET(DT_PHANDLE_BY_IDX(node_id, prop, n)),

/* Get the devicetree constants */
constexpr const struct device *controller = DEVICE_DT_GET(CONTROLLER_LABEL);
constexpr const struct device *targets[FORWARD_COUNT] = {
	DT_FOREACH_PROP_ELEM(CONTROLLER_LABEL, forwards, GET_TARGET_DEVICE)};

static void *i2c_emul_forwarding_setup(void)
{
	// Register the target
	for (int i = 0; i < FORWARD_COUNT; ++i) {
		zassert_ok(i2c_target_register(targets[i], &emulated_target_config[i]));
	}

	return NULL;
}

static void i2c_emul_forwarding_before(void *fixture)
{
	ARG_UNUSED(fixture);

	// Reset all fakes
	FFF_FAKES_LIST_FOREACH(RESET_FAKE);
	FFF_RESET_HISTORY();
}

static void i2c_emul_forwarding_teardown(void *fixture)
{
	ARG_UNUSED(fixture);

	// Unregister the I2C target callbacks
	for (int i = 0; i < FORWARD_COUNT; ++i) {
		zassert_ok(i2c_target_unregister(targets[i], &emulated_target_config[i]));
	}
}

ZTEST_SUITE(i2c_emul_forwarding, NULL, i2c_emul_forwarding_setup, i2c_emul_forwarding_before, NULL,
	    i2c_emul_forwarding_teardown);

ZTEST(i2c_emul_forwarding, test_write_is_forwarded)
{
	// Try writing some values
	for (uint8_t data = 0; data < 10; ++data) {
		const int expected_call_count = 1 + data;

		zassert_ok(i2c_write(controller, &data, sizeof(data),
				     emulated_target_config[0].address));

		// Expected no reads to be made
		zexpect_equal(0, target_read_requested_0_fake.call_count);
		zexpect_equal(0, target_read_processed_0_fake.call_count);

		// Expected N write requests to be made
		zexpect_equal(expected_call_count, target_write_requested_0_fake.call_count,
			      "Expected to be called %d times, got %d", expected_call_count,
			      target_write_requested_0_fake.call_count);
		zexpect_equal(expected_call_count, target_write_received_0_fake.call_count,
			      "Expected to be called %d times, got %d", expected_call_count,
			      target_write_received_0_fake.call_count);

		// Check that the data written was correct
		zexpect_equal(data, target_write_received_0_fake.arg1_val,
			      "Expected data value %u. got %u", data,
			      target_write_received_0_fake.arg1_val);

		// Expect 1 stop call per write request
		zexpect_equal(expected_call_count, target_stop_0_fake.call_count,
			      "Expected to be called %d times, got %d", expected_call_count,
			      target_stop_0_fake.call_count);
	}
}

ZTEST(i2c_emul_forwarding, test_read_is_forwarded)
{
	// Try reading some values
	for (uint8_t i = 0; i < 10; ++i) {
		const uint8_t expected_data[2] = {
			static_cast<uint8_t>(0x1 * i),
			static_cast<uint8_t>(0x2 * i),
		};
		const unsigned int expected_call_count = 1 + i;
		uint8_t data[2];

		// Setup some lambdas to do the actual reads using 'expected_data'
		target_read_requested_0_fake.custom_fake =
			[expected_data](struct i2c_target_config *, uint8_t *out) -> int {
			*out = expected_data[0];
			return 0;
		};
		target_read_processed_0_fake.custom_fake =
			[expected_data](struct i2c_target_config *, uint8_t *out) -> int {
			*out = expected_data[1];
			return 0;
		};
		zassert_ok(i2c_read(controller, data, sizeof(data),
				    emulated_target_config[0].address));

		// Expect the read functions to be called N times
		zexpect_equal(expected_call_count, target_read_requested_0_fake.call_count,
			      "Expected to be called %d times, got %d", expected_call_count,
			      target_read_requested_0_fake.call_count);
		zexpect_equal(expected_call_count, target_read_processed_0_fake.call_count,
			      "Expected to be called %d times, got %d", expected_call_count,
			      target_read_processed_0_fake.call_count);

		// Expect the data read to match
		zexpect_equal(expected_data[0], data[0], "Expected 0x%02x, got 0x%02x",
			      expected_data[0], data[0]);
		zexpect_equal(expected_data[1], data[1], "Expected 0x%02x, got 0x%02x",
			      expected_data[1], data[1]);

		// Expect 0 write calls
		zexpect_equal(0, target_write_requested_0_fake.call_count);
		zexpect_equal(0, target_write_received_0_fake.call_count);

		// Expect 1 stop call per read
		zexpect_equal(expected_call_count, target_stop_0_fake.call_count,
			      "Expected to be called %d times, got %d", expected_call_count,
			      target_stop_0_fake.call_count);
	}
}

ZTEST(i2c_emul_forwarding, test_recover_failed_write)
{
	uint8_t write_data[2];

	// Fail on the write request (should never call the write_received function)
	target_write_requested_0_fake.return_val = -EINVAL;
	zassert_equal(-EINVAL, i2c_write(controller, write_data, sizeof(write_data),
					 emulated_target_config[0].address));
	zexpect_equal(1, target_write_requested_0_fake.call_count, "Was called %d times",
		      target_write_requested_0_fake.call_count);
	zexpect_equal(0, target_write_received_0_fake.call_count, "Was called %d times",
		      target_write_requested_0_fake.call_count);

	// Next instruction should succeed
	target_write_requested_0_fake.return_val = 0;
	zassert_ok(i2c_write(controller, write_data, sizeof(write_data),
			     emulated_target_config[0].address));
	zexpect_equal(2, target_write_requested_0_fake.call_count, "Was called %d times",
		      target_write_requested_0_fake.call_count);
	zexpect_equal(2, target_write_received_0_fake.call_count, "Was called %d times",
		      target_write_requested_0_fake.call_count);
}

ZTEST(i2c_emul_forwarding, test_recover_failed_read)
{
	uint8_t read_data[2];

	// Fail the read_requested (should never call the read_processed function)
	target_read_requested_0_fake.return_val = -EINVAL;
	zassert_equal(-EINVAL, i2c_read(controller, read_data, sizeof(read_data),
					emulated_target_config[0].address));
	zexpect_equal(1, target_read_requested_0_fake.call_count, "Was called %d times",
		      target_read_requested_0_fake.call_count);
	zexpect_equal(0, target_read_processed_0_fake.call_count, "Was called %d times",
		      target_read_processed_0_fake.call_count);

	// Next instruction should pass
	target_read_requested_0_fake.return_val = 0;
	zassert_ok(i2c_read(controller, read_data, sizeof(read_data),
			    emulated_target_config[0].address));
	zexpect_equal(2, target_read_requested_0_fake.call_count, "Was called %d times",
		      target_read_requested_0_fake.call_count);
	zexpect_equal(1, target_read_processed_0_fake.call_count, "Was called %d times",
		      target_read_processed_0_fake.call_count);
}

ZTEST(i2c_emul_forwarding, test_transfer_is_forwarded)
{
	uint8_t write_data[1] = {};
	uint8_t read_data[2] = {};

	struct i2c_msg msgs[] = {
		{
			.buf = write_data,
			.len = sizeof(write_data),
			.flags = I2C_MSG_WRITE,
		},
		{
			.buf = read_data,
			.len = sizeof(read_data),
			.flags = I2C_MSG_READ | I2C_MSG_STOP,
		},
	};

	int phase = 0;
	target_write_requested_0_fake.custom_fake = [&phase](struct i2c_target_config *) -> int {
		zassert_equal(0, phase, "Expected a call to write_requested before anything else");
		phase++;
		return 0;
	};
	target_write_received_0_fake.custom_fake = [&phase](struct i2c_target_config *,
							    uint8_t) -> int {
		zassert_equal(1, phase, "Expected a call to write_received as the second step");
		phase++;
		return 0;
	};
	target_read_requested_0_fake.custom_fake = [&phase](struct i2c_target_config *,
							    uint8_t *) -> int {
		zassert_equal(2, phase, "Expected a call to read_requested as the 3rd step");
		phase++;
		return 0;
	};
	target_read_processed_0_fake.custom_fake = [&phase](struct i2c_target_config *,
							    uint8_t *) -> int {
		zassert_equal(3, phase, "Expected a call to read_processed as the 4th step");
		phase++;
		return 0;
	};
	target_stop_0_fake.custom_fake = [&phase](struct i2c_target_config *) -> int {
		zassert_equal(4, phase, "Expected a call to stop as the 5th step");
		phase++;
		return 0;
	};
	zassert_ok(i2c_transfer(controller, msgs, ARRAY_SIZE(msgs),
				emulated_target_config[0].address));
	zexpect_equal(1, target_write_requested_0_fake.call_count,
		      "Expected target_write_requested to be called once, but got %d",
		      target_write_requested_0_fake.call_count);
	zexpect_equal(1, target_write_received_0_fake.call_count,
		      "Expected target_write_received to be called once, but got %d",
		      target_write_received_0_fake.call_count);
	zexpect_equal(1, target_read_requested_0_fake.call_count,
		      "Expected target_read_requested to be called once, but got %d",
		      target_read_requested_0_fake.call_count);
	zexpect_equal(1, target_read_processed_0_fake.call_count,
		      "Expected target_read_processed to be called once, but got %d",
		      target_read_processed_0_fake.call_count);
	zexpect_equal(1, target_stop_0_fake.call_count,
		      "Expected target_stop to be called once, but got %d",
		      target_stop_0_fake.call_count);
	zexpect_equal(5, phase, "Expected a total of 5 phases, but got %d", phase);
}

ZTEST(i2c_emul_forwarding, test_forward_two_targets)
{
	uint8_t read_data[2];

	// Read the second forward and ensure that we only forwarded to the correct one
	zassert_ok(i2c_read(controller, read_data, sizeof(read_data),
			    emulated_target_config[1].address));

	// Check that we got the forward
	zexpect_equal(1, target_read_requested_1_fake.call_count,
		      "Expected to be called 1 time, got %d",
		      target_read_requested_1_fake.call_count);
	zexpect_equal(1, target_read_processed_1_fake.call_count,
		      "Expected to be called 1 time, got %d",
		      target_read_processed_1_fake.call_count);

	// Check that we didn't forward to the first target
	zexpect_equal(0, target_read_requested_0_fake.call_count,
		      "Expected to be called 0 times, got %d",
		      target_read_requested_0_fake.call_count);
	zexpect_equal(0, target_read_processed_0_fake.call_count,
		      "Expected to be called 0 times, got %d",
		      target_read_processed_0_fake.call_count);
}
} // namespace
```

## src/test_forwarding_buf.cpp
```c
/*
 * Copyright 2024 Google LLC
 * SPDX-License-Identifier: Apache-2.0
 */
#include <emulated_target.hpp>
#include <cstdint>

#include <zephyr/devicetree.h>
#include <zephyr/drivers/i2c.h>
#include <zephyr/fff.h>
#include <zephyr/ztest.h>

namespace
{

/* Get the devicetree constants */
constexpr const struct device *controller = DEVICE_DT_GET(CONTROLLER_LABEL);

ZTEST(i2c_emul_forwarding, test_write_is_forwarded)
{
	uint8_t data[] = {0x00, 0x01, 0x02};

	target_buf_write_received_0_fake.custom_fake = [&data](struct i2c_target_config *,
							       uint8_t *buf, uint32_t len) {
		zassert_equal(ARRAY_SIZE(data), len);
		zexpect_mem_equal(data, buf, len);
	};

	zassert_ok(
		i2c_write(controller, data, ARRAY_SIZE(data), emulated_target_config[0].address));

	// Expect 0 reads and 1 write/stop to be made
	zexpect_equal(0, target_buf_read_requested_0_fake.call_count);
	zexpect_equal(1, target_buf_write_received_0_fake.call_count);
	zexpect_equal(1, target_stop_0_fake.call_count);
}

ZTEST(i2c_emul_forwarding, test_read_is_forwarded)
{
	uint8_t expected[] = {0x01, 0x02, 0x03};
	uint8_t data[ARRAY_SIZE(expected)] = {};

	/* Set the custom fake function to a lambda which captures the expected value as a reference.
	 * This means that when the function is executed, we can access 'expected' as though it were
	 * within the lambda's scope.
	 */
	target_buf_read_requested_0_fake.custom_fake = [&expected](struct i2c_target_config *,
								   uint8_t **ptr, uint32_t *len) {
		*ptr = expected;
		*len = ARRAY_SIZE(expected);
		return 0;
	};

	zassert_ok(i2c_read(controller, data, ARRAY_SIZE(expected),
			    emulated_target_config[0].address));

	// Expect 1 read/stop and 0 write to be made
	zexpect_equal(1, target_buf_read_requested_0_fake.call_count);
	zexpect_equal(0, target_buf_write_received_0_fake.call_count);
	zexpect_equal(1, target_stop_0_fake.call_count);
	zexpect_mem_equal(expected, data, ARRAY_SIZE(expected));
}

ZTEST(i2c_emul_forwarding, test_failed_read_request)
{
	uint8_t data;
	target_buf_read_requested_0_fake.return_val = -EINTR;

	zassert_equal(-EINTR, i2c_read(controller, &data, 1, emulated_target_config[0].address));
	zexpect_equal(1, target_buf_read_requested_0_fake.call_count);
	zexpect_equal(0, target_buf_write_received_0_fake.call_count);
	zexpect_equal(0, target_stop_0_fake.call_count);
}

ZTEST(i2c_emul_forwarding, test_read_request_overflow)
{
	uint8_t data;

	/* Set the custom_fake to a local lambda with no capture values. */
	target_buf_read_requested_0_fake.custom_fake = [](struct i2c_target_config *, uint8_t **_,
							  uint32_t *len) {
		*len = UINT32_MAX;
		return 0;
	};

	zassert_equal(-ENOMEM, i2c_read(controller, &data, 1, emulated_target_config[0].address));
	zexpect_equal(1, target_buf_read_requested_0_fake.call_count);
	zexpect_equal(0, target_buf_write_received_0_fake.call_count);
	zexpect_equal(0, target_stop_0_fake.call_count);
}

ZTEST(i2c_emul_forwarding, test_transfer_is_forwarded)
{
	uint8_t write_data[1] = {};
	uint8_t read_data[2] = {};

	struct i2c_msg msgs[] = {
		{
			.buf = write_data,
			.len = sizeof(write_data),
			.flags = I2C_MSG_WRITE,
		},
		{
			.buf = read_data,
			.len = sizeof(read_data),
			.flags = I2C_MSG_READ | I2C_MSG_STOP,
		},
	};

	int phase = 0;
	target_buf_write_received_0_fake.custom_fake = [&phase](struct i2c_target_config *,
								uint8_t *, uint32_t) {
		zassert_equal(0, phase,
			      "Expected a call to buf_write_received before anything else");
		phase++;
	};
	target_buf_read_requested_0_fake.custom_fake = [&phase](struct i2c_target_config *,
								uint8_t **ptr, uint32_t *len) {
		zassert_equal(1, phase, "Expected a call to buf_Read_requested as the second step");
		phase++;

		// Write a random byte. It doesn't make a difference.
		*ptr = (uint8_t *)&phase;
		*len = 1;
		return 0;
	};
	target_stop_0_fake.custom_fake = [&phase](struct i2c_target_config *) -> int {
		zassert_equal(2, phase, "Expected a call to stop as the 3rd step");
		phase++;
		return 0;
	};

	zassert_ok(i2c_transfer(controller, msgs, ARRAY_SIZE(msgs),
				emulated_target_config[0].address));
	zexpect_equal(1, target_buf_write_received_0_fake.call_count);
	zexpect_equal(1, target_buf_read_requested_0_fake.call_count);
	zexpect_equal(1, target_stop_0_fake.call_count);
	zexpect_equal(3, phase, "Expected a total of 3 phases, but got %d", phase);
}

ZTEST(i2c_emul_forwarding, test_call_pio_forwarded_bus_when_buffering_enabled)
{
	uint8_t data[2];

	zassert_ok(i2c_read(controller, data, ARRAY_SIZE(data), emulated_target_config[1].address));
	zexpect_equal(1, target_read_requested_1_fake.call_count);
	zexpect_equal(1, target_read_processed_1_fake.call_count);
	zexpect_equal(1, target_stop_1_fake.call_count);
}

} // namespace
```

## src/test_forwarding_pio.cpp
```c
/*
 * Copyright 2024 Google LLC
 * SPDX-License-Identifier: Apache-2.0
 */
#include "emulated_target.hpp"

#include <zephyr/devicetree.h>
#include <zephyr/drivers/i2c.h>
#include <zephyr/fff.h>
#include <zephyr/ztest.h>

namespace
{

/* Get the devicetree constants */
constexpr const struct device *controller = DEVICE_DT_GET(CONTROLLER_LABEL);

ZTEST(i2c_emul_forwarding, test_write_is_forwarded)
{
	// Try writing some values
	for (uint8_t data = 0; data < 10; ++data) {
		const unsigned int expected_call_count = 1 + data;

		zassert_ok(i2c_write(controller, &data, sizeof(data),
				     emulated_target_config[0].address));

		// Expected no reads to be made
		zexpect_equal(0, target_read_requested_0_fake.call_count);
		zexpect_equal(0, target_read_processed_0_fake.call_count);

		// Expected N write requests to be made
		zexpect_equal(expected_call_count, target_write_requested_0_fake.call_count,
			      "Expected to be called %d times, got %d", expected_call_count,
			      target_write_requested_0_fake.call_count);
		zexpect_equal(expected_call_count, target_write_received_0_fake.call_count,
			      "Expected to be called %d times, got %d", expected_call_count,
			      target_write_received_0_fake.call_count);

		// Check that the data written was correct
		zexpect_equal(data, target_write_received_0_fake.arg1_val,
			      "Expected data value %u. got %u", data,
			      target_write_received_0_fake.arg1_val);

		// Expect 1 stop call per write request
		zexpect_equal(expected_call_count, target_stop_0_fake.call_count,
			      "Expected to be called %d times, got %d", expected_call_count,
			      target_stop_0_fake.call_count);
	}
}

ZTEST(i2c_emul_forwarding, test_read_is_forwarded)
{
	// Try reading some values
	for (uint8_t i = 0; i < 10; ++i) {
		const uint8_t expected_data[2] = {
			static_cast<uint8_t>(0x1 * i),
			static_cast<uint8_t>(0x2 * i),
		};
		const unsigned int expected_call_count = 1 + i;
		uint8_t data[2];

		// Setup some lambdas to do the actual reads using 'expected_data'
		target_read_requested_0_fake.custom_fake =
			[expected_data](struct i2c_target_config *, uint8_t *out) -> int {
			*out = expected_data[0];
			return 0;
		};
		target_read_processed_0_fake.custom_fake =
			[expected_data](struct i2c_target_config *, uint8_t *out) -> int {
			*out = expected_data[1];
			return 0;
		};
		zassert_ok(i2c_read(controller, data, sizeof(data),
				    emulated_target_config[0].address));

		// Expect the read functions to be called N times
		zexpect_equal(expected_call_count, target_read_requested_0_fake.call_count,
			      "Expected to be called %d times, got %d", expected_call_count,
			      target_read_requested_0_fake.call_count);
		zexpect_equal(expected_call_count, target_read_processed_0_fake.call_count,
			      "Expected to be called %d times, got %d", expected_call_count,
			      target_read_processed_0_fake.call_count);

		// Expect the data read to match
		zexpect_equal(expected_data[0], data[0], "Expected 0x%02x, got 0x%02x",
			      expected_data[0], data[0]);
		zexpect_equal(expected_data[1], data[1], "Expected 0x%02x, got 0x%02x",
			      expected_data[1], data[1]);

		// Expect 0 write calls
		zexpect_equal(0, target_write_requested_0_fake.call_count);
		zexpect_equal(0, target_write_received_0_fake.call_count);

		// Expect 1 stop call per read
		zexpect_equal(expected_call_count, target_stop_0_fake.call_count,
			      "Expected to be called %d times, got %d", expected_call_count,
			      target_stop_0_fake.call_count);
	}
}

ZTEST(i2c_emul_forwarding, test_recover_failed_write)
{
	uint8_t write_data[2] = {};

	// Fail on the write request (should never call the write_received function)
	target_write_requested_0_fake.return_val = -EINVAL;
	zassert_equal(-EINVAL, i2c_write(controller, write_data, sizeof(write_data),
					 emulated_target_config[0].address));
	zexpect_equal(1, target_write_requested_0_fake.call_count, "Was called %d times",
		      target_write_requested_0_fake.call_count);
	zexpect_equal(0, target_write_received_0_fake.call_count, "Was called %d times",
		      target_write_requested_0_fake.call_count);

	// Next instruction should succeed
	target_write_requested_0_fake.return_val = 0;
	zassert_ok(i2c_write(controller, write_data, sizeof(write_data),
			     emulated_target_config[0].address));
	zexpect_equal(2, target_write_requested_0_fake.call_count, "Was called %d times",
		      target_write_requested_0_fake.call_count);
	zexpect_equal(2, target_write_received_0_fake.call_count, "Was called %d times",
		      target_write_requested_0_fake.call_count);
}

ZTEST(i2c_emul_forwarding, test_recover_failed_read)
{
	uint8_t read_data[2];

	// Fail the read_requested (should never call the read_processed function)
	target_read_requested_0_fake.return_val = -EINVAL;
	zassert_equal(-EINVAL, i2c_read(controller, read_data, sizeof(read_data),
					emulated_target_config[0].address));
	zexpect_equal(1, target_read_requested_0_fake.call_count, "Was called %d times",
		      target_read_requested_0_fake.call_count);
	zexpect_equal(0, target_read_processed_0_fake.call_count, "Was called %d times",
		      target_read_processed_0_fake.call_count);

	// Next instruction should pass
	target_read_requested_0_fake.return_val = 0;
	zassert_ok(i2c_read(controller, read_data, sizeof(read_data),
			    emulated_target_config[0].address));
	zexpect_equal(2, target_read_requested_0_fake.call_count, "Was called %d times",
		      target_read_requested_0_fake.call_count);
	zexpect_equal(1, target_read_processed_0_fake.call_count, "Was called %d times",
		      target_read_processed_0_fake.call_count);
}

ZTEST(i2c_emul_forwarding, test_transfer_is_forwarded)
{
	uint8_t write_data[1] = {};
	uint8_t read_data[2] = {};

	struct i2c_msg msgs[] = {
		{
			.buf = write_data,
			.len = sizeof(write_data),
			.flags = I2C_MSG_WRITE,
		},
		{
			.buf = read_data,
			.len = sizeof(read_data),
			.flags = I2C_MSG_READ | I2C_MSG_STOP,
		},
	};

	int phase = 0;
	target_write_requested_0_fake.custom_fake = [&phase](struct i2c_target_config *) -> int {
		zassert_equal(0, phase, "Expected a call to write_requested before anything else");
		phase++;
		return 0;
	};
	target_write_received_0_fake.custom_fake = [&phase](struct i2c_target_config *,
							    uint8_t) -> int {
		zassert_equal(1, phase, "Expected a call to write_received as the second step");
		phase++;
		return 0;
	};
	target_read_requested_0_fake.custom_fake = [&phase](struct i2c_target_config *,
							    uint8_t *) -> int {
		zassert_equal(2, phase, "Expected a call to read_requested as the 3rd step");
		phase++;
		return 0;
	};
	target_read_processed_0_fake.custom_fake = [&phase](struct i2c_target_config *,
							    uint8_t *) -> int {
		zassert_equal(3, phase, "Expected a call to read_processed as the 4th step");
		phase++;
		return 0;
	};
	target_stop_0_fake.custom_fake = [&phase](struct i2c_target_config *) -> int {
		zassert_equal(4, phase, "Expected a call to stop as the 5th step");
		phase++;
		return 0;
	};
	zassert_ok(i2c_transfer(controller, msgs, ARRAY_SIZE(msgs),
				emulated_target_config[0].address));
	zexpect_equal(1, target_write_requested_0_fake.call_count,
		      "Expected target_write_requested to be called once, but got %d",
		      target_write_requested_0_fake.call_count);
	zexpect_equal(1, target_write_received_0_fake.call_count,
		      "Expected target_write_received to be called once, but got %d",
		      target_write_received_0_fake.call_count);
	zexpect_equal(1, target_read_requested_0_fake.call_count,
		      "Expected target_read_requested to be called once, but got %d",
		      target_read_requested_0_fake.call_count);
	zexpect_equal(1, target_read_processed_0_fake.call_count,
		      "Expected target_read_processed to be called once, but got %d",
		      target_read_processed_0_fake.call_count);
	zexpect_equal(1, target_stop_0_fake.call_count,
		      "Expected target_stop to be called once, but got %d",
		      target_stop_0_fake.call_count);
	zexpect_equal(5, phase, "Expected a total of 5 phases, but got %d", phase);
}

ZTEST(i2c_emul_forwarding, test_forward_two_targets)
{
	uint8_t read_data[2];

	// Read the second forward and ensure that we only forwarded to the correct one
	zassert_ok(i2c_read(controller, read_data, sizeof(read_data),
			    emulated_target_config[1].address));

	// Check that we got the forward
	zexpect_equal(1, target_read_requested_1_fake.call_count,
		      "Expected to be called 1 time, got %d",
		      target_read_requested_1_fake.call_count);
	zexpect_equal(1, target_read_processed_1_fake.call_count,
		      "Expected to be called 1 time, got %d",
		      target_read_processed_1_fake.call_count);

	// Check that we didn't forward to the first target
	zexpect_equal(0, target_read_requested_0_fake.call_count,
		      "Expected to be called 0 times, got %d",
		      target_read_requested_0_fake.call_count);
	zexpect_equal(0, target_read_processed_0_fake.call_count,
		      "Expected to be called 0 times, got %d",
		      target_read_processed_0_fake.call_count);
}

ZTEST(i2c_emul_forwarding, test_error_in_write_received)
{
	uint8_t data = 0;

	target_write_received_0_fake.return_val = -EINTR;
	zassert_equal(-EINTR, i2c_write(controller, &data, 1, emulated_target_config[0].address));
	zexpect_equal(1, target_write_requested_0_fake.call_count);
	zexpect_equal(1, target_write_received_0_fake.call_count);
	zexpect_equal(0, target_stop_0_fake.call_count);
}

} // namespace
```

## src/test_fowarding_common.cpp
```c
/*
 * Copyright 2024 Google LLC
 * SPDX-License-Identifier: Apache-2.0
 */
#include "emulated_target.hpp"

#include <zephyr/devicetree.h>
#include <zephyr/drivers/i2c.h>
#include <zephyr/fff.h>
#include <zephyr/ztest.h>

namespace
{

/* Get the devicetree constants */
constexpr const struct device *controller = DEVICE_DT_GET(CONTROLLER_LABEL);
constexpr const struct device *targets[FORWARD_COUNT] = {
	DT_FOREACH_PROP_ELEM_SEP(CONTROLLER_LABEL, forwards, DEVICE_DT_GET_BY_IDX, (,))};

static void *i2c_emul_forwarding_setup(void)
{
	// Register the target
	for (int i = 0; i < FORWARD_COUNT; ++i) {
		zassert_ok(i2c_target_register(targets[i], &emulated_target_config[i]));
	}

	return NULL;
}

static void i2c_emul_forwarding_before(void *fixture)
{
	ARG_UNUSED(fixture);

	// Reset all fakes
	FFF_FAKES_LIST_FOREACH(RESET_FAKE);
	FFF_RESET_HISTORY();
}

static void i2c_emul_forwarding_teardown(void *fixture)
{
	ARG_UNUSED(fixture);

	// Unregister the I2C target callbacks
	for (int i = 0; i < FORWARD_COUNT; ++i) {
		zassert_ok(i2c_target_unregister(targets[i], &emulated_target_config[i]));
	}
}

ZTEST_SUITE(i2c_emul_forwarding, NULL, i2c_emul_forwarding_setup, i2c_emul_forwarding_before, NULL,
	    i2c_emul_forwarding_teardown);

/* Common tests */

ZTEST(i2c_emul_forwarding, test_invalid_address_for_target)
{
	uint8_t data = 0;
	int rc = i2c_write(targets[0], &data, 1, emulated_target_config[0].address + 1);
	zassert_equal(-EINVAL, rc, "Expected %d (-EINVAL), but got %d", -EINVAL, rc);
	zexpect_equal(0, target_read_requested_0_fake.call_count);
	zexpect_equal(0, target_read_processed_0_fake.call_count);
	zexpect_equal(0, target_write_requested_0_fake.call_count);
	zexpect_equal(0, target_write_received_0_fake.call_count);
	zexpect_equal(0, target_buf_write_received_0_fake.call_count);
	zexpect_equal(0, target_buf_read_requested_0_fake.call_count);
	zexpect_equal(0, target_stop_0_fake.call_count);
}

ZTEST(i2c_emul_forwarding, test_error_in_stop)
{
	uint8_t data = 0;

	target_stop_0_fake.return_val = -EINTR;
	zassert_equal(-EINTR, i2c_write(controller, &data, 1, emulated_target_config[0].address));
	zexpect_equal(1, target_stop_0_fake.call_count);
}

} // namespace
```
