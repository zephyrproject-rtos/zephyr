## CMakeLists.txt
```
# SPDX-FileCopyrightText: 2026 Muhammad Waleed Badar
# SPDX-License-Identifier: Apache-2.0

cmake_minimum_required(VERSION 3.28.0)
find_package(Zephyr REQUIRED HINTS $ENV{ZEPHYR_BASE})
project(i2c_native_linux)

target_sources(app PRIVATE src/main.c)

# Fake host i2c-dev adapters behind the host call hooks of the driver bottom
target_compile_options(native_simulator INTERFACE -DI2C_NATIVE_LINUX_TEST_HOOKS)
target_sources(native_simulator INTERFACE src/fake_i2c_dev_bottom.c)
```

## prj.conf
```kconfig
CONFIG_ZTEST=y
CONFIG_I2C=y
CONFIG_I2C_NATIVE_LINUX_BOUNCE_SIZE=64
```

## app.overlay
```dts
/*
 * SPDX-FileCopyrightText: 2026 Muhammad Waleed Badar
 *
 * SPDX-License-Identifier: Apache-2.0
 */

/ {
	fake_i2c: fake_i2c {
		compatible = "zephyr,native-linux-i2c";
		path = "/dev/i2c-fake";
		clock-frequency = <I2C_BITRATE_FAST>;
		#address-cells = <1>;
		#size-cells = <0>;
	};

	smbus_i2c: smbus_i2c {
		compatible = "zephyr,native-linux-i2c";
		path = "/dev/i2c-fake-smbus";
		#address-cells = <1>;
		#size-cells = <0>;
	};

	missing_i2c: missing_i2c {
		compatible = "zephyr,native-linux-i2c";
		path = "/dev/i2c-fake-missing";
		#address-cells = <1>;
		#size-cells = <0>;
	};
};
```

## src/main.c
```c
/*
 * SPDX-FileCopyrightText: 2026 Muhammad Waleed Badar
 *
 * SPDX-License-Identifier: Apache-2.0
 */

#include <string.h>

#include <zephyr/device.h>
#include <zephyr/drivers/i2c.h>
#include <zephyr/ztest.h>

#include "fake_i2c_dev_bottom.h"

/* The fake adapters are provided by fake_i2c_dev_bottom.c */
static const struct device *const i2c = DEVICE_DT_GET(DT_NODELABEL(fake_i2c));
static const struct device *const smbus = DEVICE_DT_GET(DT_NODELABEL(smbus_i2c));
static const struct device *const missing = DEVICE_DT_GET(DT_NODELABEL(missing_i2c));

#define ADDR FAKE_I2C_DEV_ADDR

static void *i2c_native_linux_setup(void)
{
	zassert_true(device_is_ready(i2c), "I2C controller not ready");

	return NULL;
}

static void i2c_native_linux_before(void *fixture)
{
	ARG_UNUSED(fixture);

	fake_i2c_dev_reset();
}

static void assert_msg(int transfer, int msg, bool read, int len)
{
	zassert_equal(fake_i2c_dev_msg_read(transfer, msg), read ? 1 : 0,
		      "transfer %d message %d direction", transfer, msg);
	zassert_equal(fake_i2c_dev_msg_len(transfer, msg), len, "transfer %d message %d length",
		      transfer, msg);
}

ZTEST(i2c_native_linux, test_init_errors)
{
	zassert_false(device_is_ready(smbus), "SMBus only adapter accepted");
	zassert_false(device_is_ready(missing), "missing i2c-dev node accepted");
}

ZTEST(i2c_native_linux, test_config)
{
	uint32_t config;

	zassert_ok(i2c_get_config(i2c, &config));
	zassert_equal(config, I2C_MODE_CONTROLLER | I2C_SPEED_SET(I2C_SPEED_FAST));

	zassert_ok(i2c_configure(i2c, I2C_MODE_CONTROLLER | I2C_SPEED_SET(I2C_SPEED_STANDARD)));
	zassert_ok(i2c_get_config(i2c, &config));
	zassert_equal(config, I2C_MODE_CONTROLLER | I2C_SPEED_SET(I2C_SPEED_STANDARD));

	zassert_equal(i2c_configure(i2c, I2C_SPEED_SET(I2C_SPEED_STANDARD)), -ENOTSUP);
}

ZTEST(i2c_native_linux, test_burst_write_read)
{
	const uint8_t data[] = {0x11, 0x22, 0x33, 0x44};
	uint8_t buf[sizeof(data)] = {0};

	zassert_ok(i2c_burst_write(i2c, ADDR, 0x10, data, sizeof(data)));
	zassert_ok(i2c_burst_read(i2c, ADDR, 0x10, buf, sizeof(buf)));
	zassert_mem_equal(buf, data, sizeof(data));

	zassert_equal(fake_i2c_dev_transfers(), 2);

	/* The register address and the data are joined in one message */
	zassert_equal(fake_i2c_dev_msgs(0), 1);
	assert_msg(0, 0, false, 1 + sizeof(data));

	zassert_equal(fake_i2c_dev_msgs(1), 2);
	assert_msg(1, 0, false, 1);
	assert_msg(1, 1, true, sizeof(data));
}

ZTEST(i2c_native_linux, test_continued_read)
{
	const uint8_t data[] = {0xa1, 0xa2, 0xa3, 0xa4, 0xa5};
	uint8_t reg = 0x40;
	uint8_t head[2] = {0};
	uint8_t tail[3] = {0};
	struct i2c_msg msgs[] = {
		{.buf = &reg, .len = 1, .flags = I2C_MSG_WRITE},
		{.buf = head, .len = sizeof(head), .flags = I2C_MSG_READ | I2C_MSG_RESTART},
		{.buf = tail, .len = sizeof(tail), .flags = I2C_MSG_READ | I2C_MSG_STOP},
	};

	zassert_ok(i2c_burst_write(i2c, ADDR, reg, data, sizeof(data)));
	fake_i2c_dev_reset();

	zassert_ok(i2c_transfer(i2c, msgs, ARRAY_SIZE(msgs), ADDR));
	zassert_mem_equal(head, &data[0], sizeof(head));
	zassert_mem_equal(tail, &data[sizeof(head)], sizeof(tail));

	/* Both reads are received as one message */
	zassert_equal(fake_i2c_dev_transfers(), 1);
	zassert_equal(fake_i2c_dev_msgs(0), 2);
	assert_msg(0, 0, false, 1);
	assert_msg(0, 1, true, sizeof(head) + sizeof(tail));
}

ZTEST(i2c_native_linux, test_stop_splits_transfer)
{
	uint8_t wr[] = {0x20, 0x5a};
	uint8_t reg = 0x20;
	uint8_t rd = 0;
	struct i2c_msg msgs[] = {
		{.buf = wr, .len = sizeof(wr), .flags = I2C_MSG_WRITE | I2C_MSG_STOP},
		{.buf = &reg, .len = 1, .flags = I2C_MSG_WRITE},
		{.buf = &rd, .len = 1, .flags = I2C_MSG_READ | I2C_MSG_RESTART | I2C_MSG_STOP},
	};

	zassert_ok(i2c_transfer(i2c, msgs, ARRAY_SIZE(msgs), ADDR));
	zassert_equal(rd, 0x5a);

	zassert_equal(fake_i2c_dev_transfers(), 2);
	zassert_equal(fake_i2c_dev_msgs(0), 1);
	assert_msg(0, 0, false, sizeof(wr));
	zassert_equal(fake_i2c_dev_msgs(1), 2);
	assert_msg(1, 0, false, 1);
	assert_msg(1, 1, true, 1);
}

ZTEST(i2c_native_linux, test_ten_bit_address)
{
	uint8_t wr[] = {0x00, 0x01};
	struct i2c_msg msg = {
		.buf = wr,
		.len = sizeof(wr),
		.flags = I2C_MSG_WRITE | I2C_MSG_STOP | I2C_MSG_ADDR_10_BITS,
	};

	zassert_ok(i2c_transfer(i2c, &msg, 1, ADDR));
	zassert_equal(fake_i2c_dev_msg_ten(0, 0), 1);
}

ZTEST(i2c_native_linux, test_nack)
{
	uint8_t byte = 0;

	zassert_equal(i2c_write(i2c, &byte, 1, ADDR + 1), -EIO);
	zassert_equal(i2c_read(i2c, &byte, 1, ADDR + 1), -EIO);
}

ZTEST(i2c_native_linux, test_bounce_overflow)
{
	static uint8_t data[CONFIG_I2C_NATIVE_LINUX_BOUNCE_SIZE];

	/* The register address does not fit next to a full buffer of data */
	zassert_equal(i2c_burst_write(i2c, ADDR, 0x00, data, sizeof(data)), -ENOMEM);
	zassert_equal(fake_i2c_dev_transfers(), 0);

	/* A single message is passed without copying, whatever its length */
	zassert_ok(i2c_write(i2c, data, sizeof(data), ADDR));
}

ZTEST_SUITE(i2c_native_linux, NULL, i2c_native_linux_setup, i2c_native_linux_before, NULL, NULL);
```

## src/fake_i2c_dev_bottom.c
```c
/*
 * SPDX-FileCopyrightText: 2026 Muhammad Waleed Badar
 *
 * SPDX-License-Identifier: Apache-2.0
 */

/*
 * Fake i2c-dev adapters behind the host call hooks of the driver bottom
 * (I2C_NATIVE_LINUX_TEST_HOOKS). FAKE_I2C_DEV_PATH is a plain I2C adapter
 * with a register file at FAKE_I2C_DEV_ADDR (the first written byte sets the
 * auto-incrementing pointer), FAKE_I2C_DEV_SMBUS_PATH is SMBus only.
 */

#include <errno.h>
#include <stdbool.h>
#include <stdint.h>
#include <string.h>
#include <linux/i2c.h>
#include <linux/i2c-dev.h>

#include "fake_i2c_dev_bottom.h"

#define MAX_TRANSFERS 8

/* File descriptors returned for the fake adapters */
#define FAKE_FD  100
#define SMBUS_FD 101

struct recorded_transfer {
	int nmsgs;
	struct i2c_msg msgs[I2C_RDWR_IOCTL_MAX_MSGS];
};

static uint8_t regs[256];
static uint8_t reg_ptr;
static struct recorded_transfer transfers[MAX_TRANSFERS];
static int ntransfers;

int i2c_native_linux_host_open(const char *path)
{
	if (strcmp(path, FAKE_I2C_DEV_PATH) == 0) {
		return FAKE_FD;
	}

	if (strcmp(path, FAKE_I2C_DEV_SMBUS_PATH) == 0) {
		return SMBUS_FD;
	}

	errno = ENOENT;
	return -1;
}

int i2c_native_linux_host_close(int fd)
{
	return 0;
}

static int fake_funcs(int fd, unsigned long *funcs)
{
	*funcs = I2C_FUNC_SMBUS_BYTE_DATA | I2C_FUNC_SMBUS_WORD_DATA;

	if (fd == FAKE_FD) {
		*funcs |= I2C_FUNC_I2C | I2C_FUNC_10BIT_ADDR;
	}

	return 0;
}

static int fake_rdwr(int fd, struct i2c_rdwr_ioctl_data *rdwr)
{
	struct i2c_msg *msg;
	bool read;
	uint32_t i;
	uint16_t b;

	if (fd != FAKE_FD) {
		errno = EOPNOTSUPP;
		return -1;
	}

	if (rdwr->nmsgs == 0U || rdwr->nmsgs > I2C_RDWR_IOCTL_MAX_MSGS) {
		errno = EINVAL;
		return -1;
	}

	if (ntransfers < MAX_TRANSFERS) {
		transfers[ntransfers].nmsgs = (int)rdwr->nmsgs;
		memcpy(transfers[ntransfers].msgs, rdwr->msgs, rdwr->nmsgs * sizeof(rdwr->msgs[0]));
		ntransfers++;
	}

	for (i = 0U; i < rdwr->nmsgs; i++) {
		if (rdwr->msgs[i].addr != FAKE_I2C_DEV_ADDR) {
			errno = ENXIO;
			return -1;
		}
	}

	for (i = 0U; i < rdwr->nmsgs; i++) {
		msg = &rdwr->msgs[i];
		read = (msg->flags & I2C_M_RD) != 0U;

		for (b = 0U; b < msg->len; b++) {
			if (read) {
				msg->buf[b] = regs[reg_ptr++];
			} else if (b == 0U) {
				reg_ptr = msg->buf[0];
			} else {
				regs[reg_ptr++] = msg->buf[b];
			}
		}
	}

	return (int)rdwr->nmsgs;
}

int i2c_native_linux_host_ioctl(int fd, unsigned long request, void *arg)
{
	if (fd != FAKE_FD && fd != SMBUS_FD) {
		errno = EBADF;
		return -1;
	}

	switch (request) {
	case I2C_FUNCS:
		return fake_funcs(fd, arg);
	case I2C_RDWR:
		return fake_rdwr(fd, arg);
	default:
		errno = EINVAL;
		return -1;
	}
}

void fake_i2c_dev_reset(void)
{
	ntransfers = 0;
}

int fake_i2c_dev_transfers(void)
{
	return ntransfers;
}

int fake_i2c_dev_msgs(int transfer)
{
	return transfers[transfer].nmsgs;
}

int fake_i2c_dev_msg_len(int transfer, int msg)
{
	return transfers[transfer].msgs[msg].len;
}

int fake_i2c_dev_msg_read(int transfer, int msg)
{
	return (transfers[transfer].msgs[msg].flags & I2C_M_RD) != 0U;
}

int fake_i2c_dev_msg_ten(int transfer, int msg)
{
	return (transfers[transfer].msgs[msg].flags & I2C_M_TEN) != 0U;
}
```

## src/fake_i2c_dev_bottom.h
```c
/*
 * SPDX-FileCopyrightText: 2026 Muhammad Waleed Badar
 *
 * SPDX-License-Identifier: Apache-2.0
 */

#ifndef FAKE_I2C_DEV_BOTTOM_H
#define FAKE_I2C_DEV_BOTTOM_H

/* Paths of the fake adapters, as in app.overlay; any other path does not exist */
#define FAKE_I2C_DEV_PATH       "/dev/i2c-fake"
#define FAKE_I2C_DEV_SMBUS_PATH "/dev/i2c-fake-smbus"

/* Address of the register file of the fake adapter, any other address NACKs */
#define FAKE_I2C_DEV_ADDR 0x50

/* Forget the transfers recorded so far */
void fake_i2c_dev_reset(void);

/* Number of I2C_RDWR transfers since the last reset */
int fake_i2c_dev_transfers(void);

/* Number of messages of a recorded transfer */
int fake_i2c_dev_msgs(int transfer);

/* Length of a message of a recorded transfer */
int fake_i2c_dev_msg_len(int transfer, int msg);

/* 1 when a message of a recorded transfer is a read, 0 otherwise */
int fake_i2c_dev_msg_read(int transfer, int msg);

/* 1 when a message of a recorded transfer uses a 10-bit address, 0 otherwise */
int fake_i2c_dev_msg_ten(int transfer, int msg);

#endif /* FAKE_I2C_DEV_BOTTOM_H */
```
