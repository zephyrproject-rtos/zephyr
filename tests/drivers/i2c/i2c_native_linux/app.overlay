/*
 * SPDX-FileCopyrightText: 2026 Muhammad Waleed Badar
 *
 * SPDX-License-Identifier: Apache-2.0
 */

/ {
	fake_i2c: fake_i2c {
		compatible = "zephyr,native-linux-i2c";
		path = "/dev/i2c-fake";
		clock-frequency = <I2C_BITRATE_FAST>;
		#address-cells = <1>;
		#size-cells = <0>;
	};

	smbus_i2c: smbus_i2c {
		compatible = "zephyr,native-linux-i2c";
		path = "/dev/i2c-fake-smbus";
		#address-cells = <1>;
		#size-cells = <0>;
	};

	missing_i2c: missing_i2c {
		compatible = "zephyr,native-linux-i2c";
		path = "/dev/i2c-fake-missing";
		#address-cells = <1>;
		#size-cells = <0>;
	};
};
