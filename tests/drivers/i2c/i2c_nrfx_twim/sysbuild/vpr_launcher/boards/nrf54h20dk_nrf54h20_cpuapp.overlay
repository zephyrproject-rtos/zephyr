/*
 * Copyright (c) 2025 Nordic Semiconductor ASA
 *
 * SPDX-License-Identifier: Apache-2.0
 */

&i2c130 {
	status = "reserved";
	interrupt-parent = <&cpuppr_clic>;
};

&i2c131 {
	status = "reserved";
	interrupt-parent = <&cpuppr_clic>;
};
