/*
 * Copyright 2023 Google LLC
 *
 * SPDX-License-Identifier: Apache-2.0
 */

#include <zephyr/dt-bindings/i2c/i2c.h>

/ {
	i2c_bus: i2c@100 {
		compatible = "zephyr,i2c-emul-controller";
		clock-frequency = <I2C_BITRATE_STANDARD>;
		status = "okay";

		#address-cells = <1>;
		#size-cells = <0>;
		reg = <0x100 4>;
	};
};

&i2c_bus {
	compatible = "zephyr,i2c-emul-controller";

	i2c_pec_test: i2c_pec_test@b {
		compatible = "zephyr,i2c-pec-test";
		reg = <0x0b>;
		status = "okay";
	};
};
