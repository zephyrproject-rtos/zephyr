## tests/drivers/i2c/i2c_target_api/boards/nucleo_h7p5ii.conf
```kconfig
# SPDX-FileCopyrightText: Copyright (c) 2026 STMicroelectronics
# SPDX-License-Identifier: Apache-2.0

CONFIG_GPIO=y
CONFIG_I2C_STM32_INTERRUPT=y
CONFIG_I2C_VIRTUAL=n
```

## tests/drivers/i2s/i2s_pm/boards/espressif.conf
```kconfig
# Copyright (c) 2026 Espressif Systems (Shanghai) Co., Ltd.
# SPDX-License-Identifier: Apache-2.0

CONFIG_I2S_TEST_USE_I2S_DIR_BOTH=y
CONFIG_I2S_TEST_USE_GPIO_LOOPBACK=y
CONFIG_I2S_TEST_ALLOWED_DATA_OFFSET=1
CONFIG_LOG=y
CONFIG_SOC_LOG_LEVEL_DBG=y
CONFIG_SOC_FAMILY_ESPRESSIF_PM_SLEEP_STATS=y
```

## tests/drivers/i2s/i2s_speed/boards/ek_ra8p1_r7ka8p1kflcac_cm85.conf
```kconfig
# Copyright (c) 2026 Renesas Electronics Corporation
# SPDX-License-Identifier: Apache-2.0

CONFIG_I2S_INIT_PRIORITY=52
CONFIG_I2S_TEST_USE_GPIO_LOOPBACK=y
CONFIG_I2S_TEST_SEPARATE_DEVICES=y
CONFIG_I2S_TEST_FORMAT_PCM_SHORT=y
CONFIG_I2S_TEST_FORMAT_PCM_LONG=y
CONFIG_I2S_TEST_SKIP_SAMPLERATE_8000=y
CONFIG_I2S_TEST_SKIP_SAMPLERATE_16000=y
CONFIG_I2S_TEST_SKIP_SAMPLERATE_32000=y
CONFIG_I2S_TEST_SKIP_SAMPLERATE_48000=y
CONFIG_I2S_TEST_SKIP_SAMPLERATE_96000=y
```

## tests/drivers/i2s/i2s_speed/boards/nucleo_u3c5zi_q.conf
```kconfig
# SPDX-FileCopyrightText: Copyright The Zephyr Project Contributors
# SPDX-License-Identifier: Apache-2.0

CONFIG_HEAP_MEM_POOL_SIZE=128
CONFIG_I2S_TEST_SEPARATE_DEVICES=y
CONFIG_I2S_TEST_USE_GPIO_LOOPBACK=y
CONFIG_I2S_TEST_USE_I2S_DIR_BOTH=n
CONFIG_I2S_TEST_ALLOWED_DATA_OFFSET=2
CONFIG_I2S_TEST_ALLOW_VARIABLE_OFFSET=y

# Not reachable from MSIK with these dividers
CONFIG_I2S_TEST_SKIP_SAMPLERATE_88200=y
CONFIG_I2S_TEST_SKIP_SAMPLERATE_96000=y
```

## tests/drivers/i2s/tdm_channel_masking/Kconfig
```kconfig
# Copyright The Zephyr Project Contributors
# SPDX-License-Identifier: Apache-2.0

mainmenu "TDM channel masking test"

config TDM_MASKING_TEST_WORD_SIZE
	int "Sample word size in bits"
	range 16 32
	default 16
	help
	  Size of each TDM slot sample, 16 or 32 bits.

source "Kconfig.zephyr"
```

## tests/drivers/i3c/i3c_dw_secondary_boot/boards/qemu_cortex_m3.conf
```kconfig
# Copyright (c) 2026 Mark Tamas
# SPDX-License-Identifier: Apache-2.0

CONFIG_CLOCK_CONTROL_FIXED_RATE_CLOCK=y
```

## tests/drivers/interrupt_controller/intc_ite_it8xxx2/Kconfig
```kconfig
# Copyright 2026 Google LLC
# SPDX-License-Identifier: Apache-2.0

source "Kconfig.zephyr"

config NUM_IRQS
	int
	default 186

config HAS_ITE_INTC
	bool
	default y

config TEST_IT8XXX2_INTC_V1
	bool "Test IT8XXX2 V1 interrupt controller"
	help
	  Select the IT8XXX2 V1 interrupt controller driver for unit testing.

config TEST_IT8XXX2_INTC_V2
	bool "Test IT8XXX2 V2 interrupt controller"
	help
	  Select the IT8XXX2 V2 interrupt controller driver for unit testing.
```

## tests/drivers/interrupt_controller/intc_ite_it8xxx2/testcase.yaml
```yaml
# Copyright 2026 Google LLC
# SPDX-License-Identifier: Apache-2.0

common:
  tags:
    - drivers
    - interrupt
  platform_allow:
    - native_sim

tests:
  drivers.interrupt_controller.intc_ite_it8xxx2.v1:
    extra_configs:
      - CONFIG_TEST_IT8XXX2_INTC_V1=y
  drivers.interrupt_controller.intc_ite_it8xxx2.v2:
    extra_configs:
      - CONFIG_TEST_IT8XXX2_INTC_V2=y
```

## tests/drivers/interrupt_controller/multi_level_backend/dts/bindings/vnd,l2-placement-intc.yaml
```yaml
# Copyright (c) 2026 Espressif Systems (Shanghai) Co., Ltd.
# SPDX-License-Identifier: Apache-2.0

description: |
  Level 2 aggregator placeholder for the ISR table placement test. No
  driver binds to it; the test only reads its devicetree instance number
  and interrupt level.

compatible: "vnd,l2-placement-intc"

include: [interrupt-controller.yaml, base.yaml]

properties:
  "#interrupt-cells":
    const: 1

interrupt-cells:
  - irq
```

## tests/drivers/interrupt_controller/rp1/Kconfig
```kconfig
# Copyright (c) 2026 Process Mission
# SPDX-License-Identifier: Apache-2.0

config TEST_RP1_MSI_PROXY
	bool
	default y if !PCIE_MSI
	select MSI_PROXY

source "Kconfig.zephyr"
```

## tests/drivers/modem/cellular_sim_slots/dts/bindings/vnd,sim-mux.yaml
```yaml
# Copyright (c) 2026 Pedro Ramos
# SPDX-License-Identifier: Apache-2.0

description: |
  MUX controller of the SIM slot selection test, which can be made to fail
  the next state changes.

compatible: "vnd,sim-mux"

include: [base.yaml, mux-controller.yaml]

mux-state-cells:
  - state
```

## tests/drivers/pcie/endpoint/dts/bindings/vnd,pcie-endpoint.yaml
```yaml
# SPDX-FileCopyrightText: Copyright (c) 2026 Process Mission
# SPDX-License-Identifier: Apache-2.0

description: Fake PCIe endpoint for controller isolation testing

compatible: "vnd,pcie-endpoint"

include: pcie-device.yaml
```

## tests/drivers/pcie/endpoint/dts/bindings/vnd,pcie-fake-ctrl.yaml
```yaml
# SPDX-FileCopyrightText: Copyright (c) 2026 Process Mission
# SPDX-License-Identifier: Apache-2.0

description: Fake PCIe controller for endpoint isolation testing

compatible: "vnd,pcie-fake-ctrl"

include: pcie-controller.yaml
```

## tests/drivers/pinctrl/microchip/boards/pic32cz_ca80_cult.conf
```kconfig
# SPDX-FileCopyrightText: Copyright (c) 2026 Microchip Technology Inc.
# SPDX-License-Identifier: Apache-2.0

CONFIG_PIN_DRIVE_STRENGTH=n
```

## tests/drivers/pinctrl/rockchip/dts/bindings/test/vnd,rockchip-rk3588-pinctrl-test.yaml
```yaml
# SPDX-FileCopyrightText: Copyright (c) 2026 Process Mission
# SPDX-License-Identifier: Apache-2.0

description: RK3588 pinctrl state expansion test consumer

compatible: "vnd,rockchip-rk3588-pinctrl-test"

include: pinctrl-device.yaml
```

## tests/drivers/pwm/pwm_pm/Kconfig
```kconfig
# Copyright (c) 2026 Espressif Systems (Shanghai) Co., Ltd.
#
# SPDX-License-Identifier: Apache-2.0

mainmenu "PWM PM test"

config TEST_PWM_PM_LOW_POWER
	bool "Enter each low power state and check the captured waveform"
	depends on PM

source "Kconfig.zephyr"
```

## tests/drivers/regulator/tps6521x/Kconfig
```kconfig
# SPDX-FileCopyrightText: Copyright The Zephyr Project Contributors
# SPDX-License-Identifier: Apache-2.0

mainmenu "TPS6521x regulator test"

config TPS6521X_TEST_ID_MISMATCH
	bool "Emulate the device ID of the other variant"
	help
	  The emulated PMIC reports the TI_DEV_ID of the variant the devicetree
	  compatible does not name, so the MFD driver must refuse it.

source "Kconfig.zephyr"
```

## tests/drivers/spi/spi_loopback/boards/ensemble_e8_dk_ae822fa0e5597ls0_rtss_hp.conf
```kconfig
# SPDX-FileCopyrightText: Copyright (c) 2026 Alif Semiconductor
# SPDX-License-Identifier: Apache-2.0

CONFIG_DMA=n
CONFIG_SPI_ASYNC=n
CONFIG_SPI_LOOPBACK_MODE_LOOP=n
CONFIG_SPI_LARGE_BUFFER_SIZE=200
CONFIG_COMMON_LIBC_MALLOC_ARENA_SIZE=0
```

## tests/drivers/spi/spi_loopback/boards/lp_am13e230.conf
```kconfig
# Copyright (c) 2026 Texas Instruments Incorporated
# SPDX-License-Identifier: Apache-2.0

CONFIG_SPI_LOOPBACK_MODE_LOOP=y
CONFIG_SPI_TI_UNICOMM_DMA=y
```

## tests/drivers/uart/uart_async_api/boards/skystar_gd32f407vet6.conf
```kconfig
# SPDX-FileCopyrightText: Copyright The Zephyr Project Contributors
# SPDX-License-Identifier: Apache-2.0

CONFIG_GD32_HXTAL_8MHZ=y
```

## tests/drivers/uart/uart_elementary/Kconfig
```kconfig
# UART test configuration options
# Copyright (c) 2024 Nordic Semiconductor ASA
# SPDX-License-Identifier: Apache-2.0

config DUAL_UART_TEST
	bool "Enable dual UART test"

config SETUP_MISMATCH_TEST
	bool "Enable mismatched configuration in dual UART test"

config UART_BAUDRATE_MISMATCH
	int "UART baudrate for DUT_AUX to test mismatch case"
	depends on SETUP_MISMATCH_TEST
	default 9600
	help
	  UART baudrate for DUT_AUX that is intentionally different from DUT
	  to test error detection.

config UART_ELEMENTARY_NO_FLOW_CTRL
	bool "Skip hardware flow control in elementary UART tests"
	help
	  Use UART_CFG_FLOW_CTRL_NONE instead of UART_CFG_FLOW_CTRL_RTS_CTS
	  for boards whose UART driver does not support hardware flow control.

config UART_INT_STRESS_TEST_TIMEOUT
	int "Single test case length (in milliseconds)"
	depends on DUAL_UART_TEST
	default 3000
	help
	  For how long the stress test is running. The higher this number the longer the
	  test and therefore the higher likelihood an unlikely race/event will be triggered.

source "Kconfig.zephyr"
```

## tests/kernel/fatal/park_hook/Kconfig
```kconfig
# Copyright (c) Qualcomm Technologies, Inc. and/or its subsidiaries.
# SPDX-License-Identifier: Apache-2.0

source "Kconfig.zephyr"

config TEST_SOC_FATAL_CPU_PARK_HOOK
	bool "Provide a soc_fatal_cpu_park_hook() implementation"
	default y
	depends on SMP
	select SOC_FATAL_CPU_PARK_HOOK
	help
	  Enable the park hook and build the test implementation of it.
```
