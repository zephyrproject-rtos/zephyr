## tests/drivers/i2c/i2c_target_api/boards/mec172xevb_assy6906.conf
```kconfig
# Copyright (c) 2026 Microchip Technology Inc.
# Disable driver hardware port multiplexer support.
CONFIG_I2C_XEC_PORT_MUX=n
```

## tests/drivers/i2c/i2c_target_api/boards/nrf5340dk_nrf5340_cpuapp.conf
```kconfig
# Copyright (c) 2024 Nordic Semiconductor ASA
# SPDX-License-Identifier: Apache-2.0

CONFIG_I2C_VIRTUAL=n
CONFIG_BOOT_BANNER=n
CONFIG_I2C_TARGET_BUFFER_MODE=y
CONFIG_I2C_NRFX_TWIS_BUF_SIZE=256
```

## tests/drivers/i2c/i2c_target_api/boards/nrf54h20dk_nrf54h20_cpuppr.conf
```kconfig
# Copyright (c) 2025 Nordic Semiconductor ASA
# SPDX-License-Identifier: Apache-2.0

CONFIG_I2C_TARGET_BUFFER_MODE=y
CONFIG_I2C_NRFX_TWIS_BUF_SIZE=256
CONFIG_GPIO=y
```

## tests/drivers/i2c/i2c_target_api/boards/nucleo_g071rb.conf
```kconfig
# SPDX-License-Identifier: Apache-2.0

CONFIG_I2C_STM32_INTERRUPT=y
CONFIG_I2C_VIRTUAL=n
```

## tests/drivers/i2c/i2c_target_api/boards/nucleo_h503rb.conf
```kconfig
# SPDX-FileCopyrightText: Copyright The Zephyr Project Contributors
# SPDX-License-Identifier: Apache-2.0

CONFIG_I2C_STM32_INTERRUPT=y
CONFIG_I2C_TEST_DATA_MAX_SIZE=300
CONFIG_I2C_VIRTUAL=n
```

## tests/drivers/i2c/i2c_target_api/boards/numaker_m3334ki.conf
```kconfig
# SPDX-FileCopyrightText: Copyright (c) 2025 Nuvoton Technology Corporation
# SPDX-License-Identifier: Apache-2.0

CONFIG_I2C=y
CONFIG_I2C_TARGET=y
```

## tests/drivers/i2c/i2c_target_api/boards/ophelia4ev_nrf54l15_cpuapp.conf
```kconfig
# Copyright (c) 2025 Würth Elektronik eiSos GmbH & Co. KG
# SPDX-License-Identifier: Apache-2.0

CONFIG_I2C_TARGET_BUFFER_MODE=y
CONFIG_I2C_NRFX_TWIS_BUF_SIZE=256
```

## tests/drivers/i2c/i2c_target_api/common/Kconfig
```kconfig
# I2C target tests common configuration options

# Copyright (c) 2017 BayLibre, SAS
# SPDX-License-Identifier: Apache-2.0

config I2C_VIRTUAL
	bool "Virtual I2C Driver for Target development"
	depends on I2C
	help
	  This driver exposes a virtual I2C driver used to debug virtual
	  I2C target drivers.

config I2C_VIRTUAL_NAME
	string "Virtual Port device name"
	default "I2C_VIRTUAL"
	depends on I2C_VIRTUAL

config APP_DUAL_ROLE_I2C
	bool "Test with combined controller/target behavior"
```

## tests/drivers/i2c/i2c_target_api/testcase.yaml
```yaml
common:
  depends_on: i2c
  tags:
    - drivers
    - i2c
  harness: ztest
  harness_config:
    fixture: i2c_bus_short

tests:
  drivers.i2c.target_api.dual_role:
    platform_allow:
      - b_u585i_iot02a
      - nucleo_f746zg
      - nucleo_g474re
      - nucleo_f091rc
      - stm32f072b_disco
      - stm32f3_disco
      - stm32h573i_dk
      - stm32u083c_dk
      - nucleo_c071rb
      - nucleo_g071rb
      - nucleo_f207zg
      - nucleo_f401re
      - nucleo_f429zi
      - nucleo_wl55jc
      - nucleo_l073rz
      - nucleo_l152re
      - nucleo_u083rc
      - nucleo_wb55rg
      - rpi_pico
      - sltb010a@0
      - mr_canhubk3
    integration_platforms:
      - nucleo_f091rc
    extra_configs:
      - CONFIG_APP_DUAL_ROLE_I2C=y
  drivers.i2c.target_api.single_role:
    platform_allow:
      - frdm_mcxn947/mcxn947/cpu0
      - mcxw72_evk/mcxw727c/cpu0
      - mimxrt1170_evk@B/mimxrt1176/cm7
      - mimxrt1170_evk/mimxrt1176/cm7
      - mimxrt1180_evk/mimxrt1189/cm33
      - mimxrt1180_evk/mimxrt1189/cm7
      - mimxrt1040_evk
      - mimxrt1060_evk/mimxrt1062/qspi
      - frdm_ke17z512
      - frdm_mcxn236
      - frdm_mcxa156
      - max32655evkit/max32655/m4
      - max32662evkit
      - max32666evkit/max32666/cpu0
      - max32670evkit
      - max32672evkit
      - max32675evkit
      - max32680evkit/max32680/m4
      - max32690evkit/max32690/m4
    integration_platforms:
      - max32690evkit/max32690/m4
```

## tests/drivers/i2c/i2c_target_api2/testcase.yaml
```yaml
common: 
    depends_on: i2c
    tags:
      - drivers
      - i2c
    harness: ztest

tests:
  drivers.i2c.target_api:
    platform_allow: 
      - lp_mspm0g3507
```

## tests/drivers/i2c/i2c_target_mode/testcase.yaml
```yaml
common:
  depends_on: i2c
  tags:
    - drivers
    - i2c
  harness: ztest
  harness_config:
    fixture: i2c_connection
tests:
  drivers.i2c.i2c_target_mode_int:
    platform_allow:
      - sam_e54_xpro
    extra_configs:
      - CONFIG_I2C_MCHP_INTERRUPT_DRIVEN=y
  drivers.i2c.i2c_target_mode_poll:
    platform_allow:
      - sam_e54_xpro
    extra_configs:
      - CONFIG_I2C_MCHP_INTERRUPT_DRIVEN=n
```

## tests/drivers/i2c/i2c_tca9546a/testcase.yaml
```yaml
tests:
  drivers.i2c:
    build_only: true
    tags: testing drivers
    depends_on: i2c
    filter: dt_compat_enabled("ti,tca9546a")
    platform_allow: nrf52840dk_nrf52840
```

## tests/drivers/i2c/i2c_tca954x/testcase.yaml
```yaml
tests:
  drivers.i2c.tca954x:
    build_only: true
    tags:
      - testing
      - drivers
      - i2c
    depends_on: i2c
    filter: dt_compat_enabled("ti,tca9546a")
    platform_allow: nrf52840dk/nrf52840
```

## tests/drivers/i2c/shell/boards/native_posix.conf
```kconfig
# Copyright (c) 2022 Google LLC
# SPDX-License-Identifier: Apache-2.0

CONFIG_EMUL=y
CONFIG_I2C=y
CONFIG_EEPROM=y
CONFIG_EEPROM_INIT_PRIORITY=75
CONFIG_EMUL_EEPROM_AT2X=y
```

## tests/drivers/i2c/shell/testcase.yaml
```yaml
tests:
  drivers.i2c.shell:
    platform_allow: native_posix qemu_cortex_a9
    tags: drivers i2c shell
```

## tests/drivers/i2s/i2s_additional/Kconfig
```kconfig
#
# Copyright (c) 2025 Nordic Semiconductor ASA
#
# SPDX-License-Identifier: Apache-2.0
#

mainmenu "I2S Additional Test"

source "Kconfig.zephyr"

config I2S_TEST_USE_GPIO_LOOPBACK
	bool "Use GPIO loopback"
	default y if DT_HAS_NORDIC_NRF_I2S_ENABLED || DT_HAS_NORDIC_NRF_TDM_ENABLED
	help
	  Use wiring between the data-out and data-in pins for looping back
	  data. This option is intended to be used for devices that do not
	  provide the internal loopback functionality.

config I2S_TEST_ALLOWED_DATA_OFFSET
	int "Allowed offset in received data"
	default 2 if DT_HAS_NORDIC_NRF_I2S_ENABLED || DT_HAS_NORDIC_NRF_TDM_ENABLED
	default 0
	help
	  Maximum allowed offset between sent and received samples. Non-zero
	  value of this option may be needed when GPIO loopback is used.

config I2S_TEST_WORD_SIZE_8_BIT_UNSUPPORTED
	bool "8 bit word size is not supported by the driver"
	help
	  When set to 'y', test will check that i2s_configure() returns -EINVAL.
	  When set to 'n', test will do the transmission.

config I2S_TEST_WORD_SIZE_16_BIT_UNSUPPORTED
	bool "16 bit word size is not supported by the driver"
	help
	  When set to 'y', test will check that i2s_configure() returns -EINVAL.
	  When set to 'n', test will do the transmission.

config I2S_TEST_WORD_SIZE_24_BIT_UNSUPPORTED
	bool "24 bit word size is not supported by the driver"
	help
	  When set to 'y', test will check that i2s_configure() returns -EINVAL.
	  When set to 'n', test will do the transmission.

config I2S_TEST_WORD_SIZE_32_BIT_UNSUPPORTED
	bool "32 bit word size is not supported by the driver"
	help
	  When set to 'y', test will check that i2s_configure() returns -EINVAL.
	  When set to 'n', test will do the transmission.

config I2S_TEST_WORD_SIZE_48_BIT_UNSUPPORTED
	bool "48 bit word size is not supported by the driver"
	default y if DT_HAS_NORDIC_NRF_I2S_ENABLED || DT_HAS_NORDIC_NRF_TDM_ENABLED
	help
	  When set to 'y', test will check that i2s_configure() returns -EINVAL.
	  When set to 'n', test will do the transmission.

config I2S_TEST_ONE_CHANNEL_UNSUPPORTED
	bool "Single audio channel is not supported by the driver"
	help
	  When set to 'y', test will check that i2s_configure() returns -EINVAL.
	  When set to 'n', test will do the transmission.

config I2S_TEST_FOUR_CHANNELS_UNSUPPORTED
	bool "Four audio channels are not supported by the driver"
	default y if DT_HAS_NORDIC_NRF_I2S_ENABLED
	help
	  When set to 'y', test will check that i2s_configure() returns -EINVAL.
	  When set to 'n', test will do the transmission.

config I2S_TEST_EIGHT_CHANNELS_UNSUPPORTED
	bool "Eight audio channels are not supported by the driver"
	default y if DT_HAS_NORDIC_NRF_I2S_ENABLED
	help
	  When set to 'y', test will check that i2s_configure() returns -EINVAL.
	  When set to 'n', test will do the transmission.

config I2S_TEST_EIGHT_CHANNELS_32B_48K_UNSUPPORTED
	bool "Skip test with 8 channels, 32 bit word size and 48k sample rate"
	depends on !I2S_TEST_EIGHT_CHANNELS_UNSUPPORTED
	help
	  Skip test that is challenging due to high data throughput.
	  When set to 'y', test will be skipped.
	  When set to 'n', test will do the transmission.

config I2S_TEST_DATA_FORMAT_I2S_UNSUPPORTED
	bool "I2S_FMT_DATA_FORMAT_I2S is not supported by the driver"
	help
	  When set to 'y', test will check that i2s_configure() returns -EINVAL.
	  When set to 'n', test will do the transmission.

config I2S_TEST_DATA_FORMAT_LEFT_JUSTIFIED_UNSUPPORTED
	bool "I2S_FMT_DATA_FORMAT_LEFT_JUSTIFIED is not supported by the driver"
	help
	  When set to 'y', test will check that i2s_configure() returns -EINVAL.
	  When set to 'n', test will do the transmission.

config I2S_TEST_DATA_FORMAT_RIGHT_JUSTIFIED_UNSUPPORTED
	bool "I2S_FMT_DATA_FORMAT_RIGHT_JUSTIFIED is not supported by the driver"
	help
	  When set to 'y', test will check that i2s_configure() returns -EINVAL.
	  When set to 'n', test will do the transmission.

config I2S_TEST_DATA_FORMAT_PCM_LONG_UNSUPPORTED
	bool "I2S_FMT_DATA_FORMAT_PCM_LONG is not supported by the driver"
	default y if DT_HAS_NORDIC_NRF_I2S_ENABLED
	help
	  When set to 'y', test will check that i2s_configure() returns -EINVAL.
	  When set to 'n', test will do the transmission.

config I2S_TEST_DATA_FORMAT_PCM_SHORT_UNSUPPORTED
	bool "I2S_FMT_DATA_FORMAT_PCM_SHORT is not supported by the driver"
	default y if DT_HAS_NORDIC_NRF_I2S_ENABLED
	help
	  When set to 'y', test will check that i2s_configure() returns -EINVAL.
	  When set to 'n', test will do the transmission.

config I2S_TEST_DATA_ORDER_MSB_UNSUPPORTED
	bool "I2S_FMT_DATA_ORDER_MSB is not supported by the driver"
	help
	  When set to 'y', test will check that i2s_configure() returns -EINVAL.
	  When set to 'n', test will do the transmission.

config I2S_TEST_DATA_ORDER_LSB_UNSUPPORTED
	bool "I2S_FMT_DATA_ORDER_LSB is not supported by the driver"
	default y if DT_HAS_NORDIC_NRF_I2S_ENABLED || DT_HAS_NORDIC_NRF_TDM_ENABLED
	help
	  When set to 'y', test will check that i2s_configure() returns -EINVAL.
	  When set to 'n', test will do the transmission.

config I2S_TEST_BIT_CLK_INV_UNSUPPORTED
	bool "I2S_FMT_BIT_CLK_INV is not supported by the driver"
	default y if DT_HAS_NORDIC_NRF_I2S_ENABLED || DT_HAS_NORDIC_NRF_TDM_ENABLED
	help
	  When set to 'y', test will check that i2s_configure() returns -EINVAL.
	  When set to 'n', test will do the transmission.

config I2S_TEST_FRAME_CLK_INV_UNSUPPORTED
	bool "I2S_FMT_FRAME_CLK_INV is not supported by the driver"
	default y if DT_HAS_NORDIC_NRF_I2S_ENABLED || DT_HAS_NORDIC_NRF_TDM_ENABLED
	help
	  When set to 'y', test will check that i2s_configure() returns -EINVAL.
	  When set to 'n', test will do the transmission.

config I2S_TEST_BLOCK_SIZE_6_UNSUPPORTED
	bool "Block_size of 6 is not supported by the driver"
	default y if DT_HAS_NORDIC_NRF_I2S_ENABLED || DT_HAS_NORDIC_NRF_TDM_ENABLED
	help
	  When set to 'y', test will check that i2s_configure() returns -EINVAL.
	  When set to 'n', test will do the transmission.

config I2S_TEST_OPTIONS_BIT_CLK_CONT_UNSUPPORTED
	bool "I2S_OPT_BIT_CLK_CONT is not supported by the driver"
	help
	  When set to 'y', test will check that i2s_configure() returns -EINVAL.
	  When set to 'n', test will do the transmission.

config I2S_TEST_OPTIONS_BIT_CLK_GATED_UNSUPPORTED
	bool "I2S_OPT_BIT_CLK_GATED is not supported by the driver"
	help
	  When set to 'y', test will check that i2s_configure() returns -EINVAL.
	  When set to 'n', test will do the transmission.

config I2S_TEST_OPTIONS_LOOPBACK_UNSUPPORTED
	bool "I2S_OPT_LOOPBACK is not supported by the driver"
	default y if DT_HAS_NORDIC_NRF_I2S_ENABLED || DT_HAS_NORDIC_NRF_TDM_ENABLED
	help
	  When set to 'y', test will check that i2s_configure() returns -EINVAL.
	  When set to 'n', test will do the transmission.

config I2S_TEST_OPTIONS_PINGPONG_UNSUPPORTED
	bool "I2S_OPT_PINGPONG is not supported by the driver"
	default y if DT_HAS_NORDIC_NRF_I2S_ENABLED || DT_HAS_NORDIC_NRF_TDM_ENABLED
	help
	  When set to 'y', test will check that i2s_configure() returns -EINVAL.
	  When set to 'n', test will do the transmission.
```

## tests/drivers/i2s/i2s_additional/testcase.yaml
```yaml
common:
  tags:
    - drivers
    - i2s
  depends_on:
    - i2s
    - gpio
  filter: CONFIG_I2S_TEST_USE_GPIO_LOOPBACK
  harness: ztest

tests:
  drivers.i2s.additional.gpio_loopback:
    harness_config:
      fixture: gpio_loopback
    platform_allow:
      - nrf52840dk/nrf52840
      - nrf5340dk/nrf5340/cpuapp
      - nrf54l15dk/nrf54l15/cpuapp
      - nrf54lm20dk/nrf54lm20a/cpuapp
    integration_platforms:
      - nrf52840dk/nrf52840
      - nrf5340dk/nrf5340/cpuapp
      - nrf54l15dk/nrf54l15/cpuapp
      - nrf54lm20dk/nrf54lm20a/cpuapp

  drivers.i2s.additional.gpio_loopback.54h:
    harness_config:
      fixture: i2s_loopback
    extra_configs:
      - CONFIG_I2S_TEST_EIGHT_CHANNELS_32B_48K_UNSUPPORTED=y
    platform_allow:
      - nrf54h20dk/nrf54h20/cpuapp
    integration_platforms:
      - nrf54h20dk/nrf54h20/cpuapp

  drivers.i2s.additional.gpio_loopback.54h.aclk:
    harness_config:
      fixture: i2s_loopback
    extra_args: EXTRA_DTC_OVERLAY_FILE="boards/nrf54h20dk_nrf54h20_cpuapp_aclk.overlay"
    platform_allow:
      - nrf54h20dk/nrf54h20/cpuapp
    integration_platforms:
      - nrf54h20dk/nrf54h20/cpuapp

  drivers.i2s.additional.gpio_loopback.aclk:
    harness_config:
      fixture: gpio_loopback
    extra_args: EXTRA_DTC_OVERLAY_FILE="boards/nrf5340dk_nrf5340_cpuapp_aclk.overlay"
    platform_allow:
      - nrf5340dk/nrf5340/cpuapp
    integration_platforms:
      - nrf5340dk/nrf5340/cpuapp
```

## tests/drivers/i2s/i2s_api/boards/ek_ra8d1.conf
```kconfig
# Copyright (c) 2025 Renesas Electronics Corporation
# SPDX-License-Identifier: Apache-2.0

CONFIG_I2S_INIT_PRIORITY=52
CONFIG_I2S_TEST_USE_GPIO_LOOPBACK=y
CONFIG_I2S_TEST_SEPARATE_DEVICES=y
```

## tests/drivers/i2s/i2s_api/boards/ek_ra8m1.conf
```kconfig
#
# Copyright (c) 2025 Renesas Electronics Corporation
#
# SPDX-License-Identifier: Apache-2.0
#

CONFIG_PWM=y
CONFIG_CLOCK_CONTROL=y
CONFIG_I2S_INIT_PRIORITY=52
CONFIG_I2S_TEST_USE_GPIO_LOOPBACK=y
CONFIG_I2S_TEST_SEPARATE_DEVICES=y
CONFIG_CLOCK_CONTROL_FIXED_RATE_CLOCK=y
```

## tests/drivers/i2s/i2s_api/boards/kit_pse84_eval_pse846gps2dbzc4a_m55.conf
```kconfig
# Copyright (c) 2025 Infineon Technologies AG,
# or an affiliate of Infineon Technologies AG.
#
# SPDX-License-Identifier: Apache-2.0

CONFIG_DMA=y
CONFIG_I2S_TEST_ALLOWED_DATA_OFFSET=2
CONFIG_I2S_TEST_ALLOW_VARIABLE_OFFSET=y
CONFIG_I2S_INFINEON_RX_QUEUE_SIZE=4
CONFIG_I2S_INFINEON_TX_QUEUE_SIZE=4
```
