/*
 * Copyright (c) 2024 Intel Corporation
 * SPDX-License-Identifier: Apache-2.0
 */

/ {
	aliases {
		i2c-ram = &i2c2;
	};
};

&i2c2 {
	status = "okay";
	pinctrl-0 = <&i2c2_scl_pf1 &i2c2_sda_pf0>;
	pinctrl-names = "default";
	clock-frequency = <I2C_BITRATE_FAST>;
};
