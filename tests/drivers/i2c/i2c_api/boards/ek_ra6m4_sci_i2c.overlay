/*
 * Copyright (c) 2025 Renesas Electronics Corporation
 * SPDX-License-Identifier: Apache-2.0
 */

/ {
	aliases {
		i2c-0 = &i2c2;
		gy271 = &i2c2;
	};
};

&sci2 {
	status = "okay";

	i2c2: i2c {
		status = "okay";
	};
};
