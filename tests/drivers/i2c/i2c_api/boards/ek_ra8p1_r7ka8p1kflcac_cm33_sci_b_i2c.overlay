/*
 * Copyright (c) 2025 Renesas Electronics Corporation
 * SPDX-License-Identifier: Apache-2.0
 */

/ {
	aliases {
		i2c-0 = &i2c1;
		gy271 = &i2c1;
	};
};

&sci1 {
	status = "okay";

	i2c1: i2c {
		status = "okay";
	};
};
