## tests/drivers/i2c/i2c_api/testcase.yaml
```yaml
tests:
  drivers.i2c.api:
    depends_on: i2c
    tags:
      - drivers
      - i2c
    filter: dt_alias_exists("gy271")
  drivers.i2c.renesas_sci_b_i2c.api:
    depends_on: i2c
    tags:
      - drivers
      - i2c
    filter: dt_alias_exists("gy271") and CONFIG_I2C_RENESAS_RA_SCI_B
    platform_allow:
      - ek_ra8m1
      - ek_ra8d1
      - mck_ra8t1
    extra_args:
      - DTC_OVERLAY_FILE="./boards/${BOARD}_sci_b_i2c.overlay"
      - CONF_FILE="./prj.conf ./boards/${BOARD}_sci_b_i2c.conf"
  drivers.i2c.renesas_sci_b_i2c_ra8x2.api:
    depends_on: i2c
    tags:
      - drivers
      - i2c
    filter: dt_alias_exists("gy271") and CONFIG_I2C_RENESAS_RA_SCI_B
    platform_allow:
      - ek_ra8p1/r7ka8p1kflcac/cm85
      - ek_ra8p1/r7ka8p1kflcac/cm33
    extra_args:
      - DTC_OVERLAY_FILE="./boards/${BOARD}${NORMALIZED_BOARD_QUALIFIERS}_sci_b_i2c.overlay"
      - CONF_FILE="./prj.conf ./boards/${BOARD}${NORMALIZED_BOARD_QUALIFIERS}_sci_b_i2c.conf"
  drivers.i2c.stm32.interrupt_disabled:
    depends_on:
      - i2c
      - arduino_i2c
    filter: dt_nodelabel_enabled("arduino_i2c") and CONFIG_SOC_FAMILY_STM32
    build_only: true
    extra_args: "DTC_OVERLAY_FILE=boards/stm32_arduino.overlay"
    extra_configs:
      - CONFIG_I2C_STM32_INTERRUPT=n
```

## tests/drivers/i2c/i2c_async/testcase.yaml
```yaml
common:
  tags:
    - drivers
    - i2c
  depends_on: i2c
tests:
  drivers.i2c.i2c_async:
    platform_allow:
      - sam_e54_xpro
      - pic32cx_sg41_cult
  drivers.i2c.i2c_eeprom_int:
    platform_allow:
      - sam_e54_xpro
    extra_configs:
      - CONFIG_I2C_MCHP_INTERRUPT_DRIVEN=y
      - CONFIG_DMA=n
      - CONFIG_I2C_CALLBACK=n
  drivers.i2c.i2c_eeprom_poll:
    platform_allow:
      - sam_e54_xpro
    extra_configs:
      - CONFIG_I2C_MCHP_INTERRUPT_DRIVEN=n
      - CONFIG_DMA=n
      - CONFIG_I2C_CALLBACK=n
```

## tests/drivers/i2c/i2c_at24/testcase.yaml
```yaml
# SPDX-License-Identifier: Apache-2.0

common:
  depends_on: i2c
  tags:
    - drivers
    - i2c
  filter: dt_compat_enabled("atmel,at24")
  harness: ztest
  harness_config:
    fixture: i2c_at24

tests:
  drivers.i2c.at24:
    depends_on: i2c
    tags:
      - drivers
      - i2c
  drivers.i2c.at24.pm:
    filter: CONFIG_HAS_PM
    extra_configs:
      - CONFIG_PM=y
      - CONFIG_PM_DEVICE=y
      - CONFIG_PM_DEVICE_RUNTIME=y
  drivers.i2c.at24.rtio:
    extra_configs:
      - CONFIG_I2C_RTIO=y
      - CONFIG_ZTEST_THREAD_PRIORITY=2
  drivers.i2c.at24.pm.rtio:
    filter: CONFIG_HAS_PM and CONFIG_I2C_RTIO
    extra_configs:
      - CONFIG_PM=y
      - CONFIG_PM_DEVICE=y
      - CONFIG_PM_DEVICE_RUNTIME=y
      - CONFIG_I2C_RTIO=y
      - CONFIG_ZTEST_THREAD_PRIORITY=2
```

## tests/drivers/i2c/i2c_bme688/Kconfig
```kconfig
# I2C BME688 test configuration options
# Copyright (c) 2024 Nordic Semiconductor ASA
# SPDX-License-Identifier: Apache-2.0

config TEST_I2C_SPEED
	int "Select I2C speed used during the test, selectable options are: I2C_SPEED_STANDARD (0x1U), I2C_SPEED_FAST (0x2U), I2C_SPEED_FAST_PLUS (0x3U)"
	default 1

source "Kconfig.zephyr"
```

## tests/drivers/i2c/i2c_bme688/testcase.yaml
```yaml
common:
  tags:
    - drivers
    - i2c
  depends_on: i2c
tests:
  drivers.i2c.bme688:
    filter: dt_compat_enabled("bosch,bme680")
```

## tests/drivers/i2c/i2c_eeprom/testcase.yaml
```yaml
common:
  tags:
    - drivers
    - i2c
  depends_on: i2c
  harness: ztest
  harness_config:
    fixture: i2c_eeprom
  filter: dt_compat_enabled("zephyr,i2c-target-eeprom")
tests:
  drivers.i2c.i2c_eeprom: {}
  drivers.i2c.i2c_eeprom_int:
    extra_configs:
      - CONFIG_DMA=n
```

## tests/drivers/i2c/i2c_emul/testcase.yaml
```yaml
# Copyright 2024 Google LLC
# SPDX-License-Identifier: Apache-2.0
common:
  tags:
    - drivers
    - i2c

tests:
  drivers.i2c.emul.target_pio:
    platform_allow:
      - native_sim
    extra_configs:
      - CONFIG_I2C_TARGET_BUFFER_MODE=n
  drivers.i2c.emul.target_buf:
    platform_allow:
      - native_sim
    extra_configs:
      - CONFIG_I2C_TARGET_BUFFER_MODE=y
    extra_dtc_overlay_files:
      - "boards/native_sim.overlay"
      - "boards/native_sim.buf.overlay"
```

## tests/drivers/i2c/i2c_loopback/testcase.yaml
```yaml
common:
  depends_on: i2c
  tags:
    - drivers
    - i2c
  harness: ztest
  harness_config:
    fixture: i2c_loopback
  filter: dt_nodelabel_enabled("dut") and dt_nodelabel_enabled("dut_aux")
tests:
  drivers.i2c.i2c_loopback: {}
  drivers.i2c.i2c_loopback_int:
    extra_configs:
      - CONFIG_DMA=n
```

## tests/drivers/i2c/i2c_nrfx_twim/testcase.yaml
```yaml
common:
  depends_on: i2c
  tags:
    - drivers
    - i2c
  harness: ztest
  harness_config:
    fixture: i2c_bus_short

tests:
  drivers.i2c.nrfx_twim_async_api:
    platform_allow:
      - nrf5340dk/nrf5340/cpuapp
      - nrf54h20dk/nrf54h20/cpuapp
      - nrf54l15dk/nrf54l15/cpuapp
    integration_platforms:
      - nrf5340dk/nrf5340/cpuapp
      - nrf54l15dk/nrf54l15/cpuapp
```

## tests/drivers/i2c/i2c_pec/testcase.yaml
```yaml
tests:
  drivers.i2c.pec:
    depends_on: i2c
    filter: dt_compat_enabled("zephyr,i2c-pec-test")
    tags:
      - drivers
      - i2c
```

## tests/drivers/i2c/i2c_ram/testcase.yaml
```yaml
common:
  depends_on: i2c
  tags:
    - drivers
    - i2c
  filter: dt_alias_exists("i2c-ram")
  harness: ztest
  harness_config:
    fixture: i2c_ram
tests:
  drivers.i2c.ram:
    depends_on: i2c
    tags:
      - drivers
      - i2c
  drivers.i2c.ram.rtio:
    filter: CONFIG_HAS_I2C_RTIO
    extra_configs:
      - CONFIG_I2C_RTIO=y
  drivers.i2c.ram.pm:
    filter: CONFIG_HAS_PM
    extra_configs:
      - CONFIG_PM=y
      - CONFIG_PM_DEVICE=y
      - CONFIG_PM_DEVICE_RUNTIME=y
  drivers.i2c.ram.pm.rtio:
    filter: CONFIG_HAS_PM and CONFIG_HAS_I2C_RTIO
    extra_configs:
      - CONFIG_PM=y
      - CONFIG_PM_DEVICE=y
      - CONFIG_PM_DEVICE_RUNTIME=y
      - CONFIG_I2C_RTIO=y
```

## tests/drivers/i2c/i2c_slave_api/Kconfig
```kconfig
# SPDX-License-Identifier: Apache-2.0

mainmenu "I2C Slave API Test"

source "Kconfig.zephyr"

source "tests/drivers/i2c/i2c_slave_api/common/Kconfig"
```

## tests/drivers/i2c/i2c_slave_api/testcase.yaml
```yaml
common:
  depends_on: i2c
  tags: drivers i2c
  harness: ztest
  harness_config:
    fixture: i2c_bus_short

tests:
  drivers.i2c.slave_api.dual_role:
    platform_allow: nucleo_f091rc stm32f072b_disco nucleo_g071rb rpi_pico
    extra_configs:
      - CONFIG_APP_DUAL_ROLE_I2C=y
```

## tests/drivers/i2c/i2c_target_api/Kconfig
```kconfig
# SPDX-License-Identifier: Apache-2.0

mainmenu "I2C Target API Test"

source "Kconfig.zephyr"

source "tests/drivers/i2c/i2c_target_api/common/Kconfig"
```

## tests/drivers/i2c/i2c_target_api/boards/bl54l15u_dvk_nrf54l15_cpuapp.conf
```kconfig
# Copyright (c) 2024 Nordic Semiconductor ASA
# Copyright (c) 2025 Ezurio LLC
# SPDX-License-Identifier: Apache-2.0

CONFIG_I2C_TARGET_BUFFER_MODE=y
CONFIG_I2C_NRFX_TWIS_BUF_SIZE=256
```

## tests/drivers/i2c/i2c_target_api/boards/max32655evkit_max32655_m4.conf
```kconfig
# Copyright (c) 2023 Analog Devices, Inc.
# SPDX-License-Identifier: Apache-2.0

CONFIG_I2C_VIRTUAL=n
```

## tests/drivers/i2c/i2c_target_api/boards/max32675evkit.conf
```kconfig
#
# Copyright (c) 2024 Analog Devices, Inc.
#
# SPDX-License-Identifier: Apache-2.0
#
CONFIG_I2C_VIRTUAL=n
```

## tests/drivers/i2c/i2c_target_api/boards/max78002evkit_max78002_m4.conf
```kconfig
#
# Copyright (c) 2024 Analog Devices, Inc.
#
# SPDX-License-Identifier: Apache-2.0
#
CONFIG_I2C_VIRTUAL=n
CONFIG_I2C_MAX32_DMA=y
```
