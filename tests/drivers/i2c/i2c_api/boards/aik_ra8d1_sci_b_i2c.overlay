/*
 * Copyright (c) 2026 Renesas Electronics Corporation
 *
 * SPDX-License-Identifier: Apache-2.0
 */

/ {
	aliases {
		i2c-0 = &pmod6_i2c;
		gy271 = &pmod6_i2c;
	};
};

&pmod6_i2c {
	status = "okay";
};
