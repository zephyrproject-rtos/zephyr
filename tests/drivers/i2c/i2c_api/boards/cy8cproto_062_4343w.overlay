/*
 * Copyright (c) 2023 Cypress Semiconductor Corporation (an Infineon company) or
 * an affiliate of Cypress Semiconductor Corporation
 *
 * SPDX-License-Identifier: Apache-2.0
 */

/ {
	aliases {
		gy271 = &i2c3;
	};
};

&i2c3 {
	status = "okay";
};
