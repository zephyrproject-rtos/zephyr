/*
 * SPDX-License-Identifier: Apache-2.0
 *
 * Copyright (c) 2024 Andrew Featherstone <andrew.featherstone@gmail.com>
 */

/* Pico 2 is compatible with the Pico 1, so reuse. */
#include "rpi_pico.overlay"

/* By default, we don't have ADC in the device tree. This is to ensure we
 * don't have conflicts where cpu0 and cpu1 both operate on the same
 * registers. However, this test can assume there is no conflict.
 */
&adc {
	pinctrl-0 = <&adc_default>;
	pinctrl-names = "default";
	status = "okay";
};
