/*
 * SPDX-License-Identifier: Apache-2.0
 *
 * Copyright (c) 2024 Andrew Featherstone <andrew.featherstone@gmail.com>
 */

/* Pico 2 is compatible with the Pico 1, so reuse. */
#include "rpi_pico.overlay"

&adc {
	status = "okay";
};
