/*
 * SPDX-License-Identifier: Apache-2.0
 *
 * Copyright (c) 2025 Andrew Featherstone <andrew.featherstone@gmail.com>
 */

/* Pico 2 is compatible with the Pico 1, so reuse. */
#include "rpi_pico.overlay"

&adc {
	status = "okay";
};
