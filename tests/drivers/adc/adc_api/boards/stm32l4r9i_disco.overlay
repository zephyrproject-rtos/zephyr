/*
 * SPDX-License-Identifier: Apache-2.0
 *
 * Copyright (c) STMicroelectronics
 */

/ {
	zephyr,user {
		io-channels = <&adc1 0>;
	};
};

&adc1 {
	#address-cells = <1>;
	#size-cells = <0>;

	channel@0 {
		reg = <0>;
		zephyr,gain = "ADC_GAIN_1";
		zephyr,reference = "ADC_REF_INTERNAL";
		zephyr,acquisition-time = <ADC_ACQ_TIME_MAX>;
		zephyr,resolution = <12>;
	};
};
