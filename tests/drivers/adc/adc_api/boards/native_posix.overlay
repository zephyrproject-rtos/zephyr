/*
 * Copyright 2021 Google LLC
 *
 * SPDX-License-Identifier: Apache-2.0
 */

/ {
	adc0: adc {
		compatible = "zephyr,adc-emul";
		nchannels = <2>;
		ref-internal-mv = <3300>;
		ref-external1-mv = <5000>;
		#io-channel-cells = <1>;
		status = "okay";
	};
};
