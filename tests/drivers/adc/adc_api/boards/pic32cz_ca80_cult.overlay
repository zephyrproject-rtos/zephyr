/*
 * Copyright (c) 2026 Microchip Technology Inc.
 *
 * SPDX-License-Identifier: Apache-2.0
 */

#include <dt-bindings/adc/adc.h>
#include <dt-bindings/adc/mchp_pic32cz_ca_adc.h>

/ {
	zephyr,user {
		io-channels = <&adc1 0>;
	};
};

&adc1 {
	#address-cells = <1>;
	#size-cells = <0>;
	status = "okay";

	channel@0 {
		reg = <0>;
		zephyr,gain = "ADC_GAIN_1";
		zephyr,reference = "ADC_REF_VDD_1";
		zephyr,acquisition-time = <ADC_ACQ_TIME_DEFAULT>;
		zephyr,resolution = <12>;
		zephyr,input-positive = <MCHP_ADC_VDD_CORE>;
	};
};
