/*
 * SPDX-License-Identifier: Apache-2.0
 *
 * Copyright (c) 2024 Gerson Fernando Budke <nandojve@gmail.com>
 */

/ {
	zephyr,user {
		io-channels = <&afec0 0>;
	};
};

&afec0 {
	#address-cells = <1>;
	#size-cells = <0>;

	channel@0 {
		reg = <0>;
		zephyr,gain = "ADC_GAIN_1";
		zephyr,reference = "ADC_REF_EXTERNAL0";
		zephyr,acquisition-time = <ADC_ACQ_TIME_DEFAULT>;
		zephyr,resolution = <12>;
		zephyr,input-positive = <15>;
	};
};
