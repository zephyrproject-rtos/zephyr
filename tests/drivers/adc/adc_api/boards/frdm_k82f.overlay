/*
 * SPDX-License-Identifier: Apache-2.0
 *
 * Copyright (c) 2023 Benjamin Björnsson <benjamin.bjornsson@gmail.com>
 */

&adc0 {
	clk-source = <0>;
	hw-trigger-src = <4>;
	continuous-convert;
	high-speed;
	periodic-trigger;
};

test_counter: &pit0_channel0 {
	status = "okay";
};

&edma0 {
	dma-buf-addr-alignment = <4>;
};
