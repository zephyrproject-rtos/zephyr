/*
 * SPDX-FileCopyrightText: Copyright The Zephyr Project Contributors
 * SPDX-License-Identifier: Apache-2.0
 *
 * Board DTS leaves ADC and VREFINT disabled. Enable the common block and
 * ADC1 so this Nucleo (local hardware) can build and run the test. Clock
 * settings match nucleo_g474re; VREFINT is an internal channel so no
 * pinctrl is required.
 */

&adc12_common {
	st,adc-clock-source = "SYNC";
	st,adc-prescaler = <4>;
	status = "okay";
};

&adc1 {
	status = "okay";
};

&vref {
	status = "okay";
};
