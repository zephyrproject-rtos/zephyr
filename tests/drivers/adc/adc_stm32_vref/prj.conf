## CMakeLists.txt
```
# SPDX-License-Identifier: Apache-2.0

cmake_minimum_required(VERSION 3.20.0)

find_package(Zephyr REQUIRED HINTS $ENV{ZEPHYR_BASE})
project(adc_stm32_vref)

file(GLOB app_sources src/*.c)
target_sources(app PRIVATE ${app_sources})
```

## prj.conf
```kconfig
CONFIG_ZTEST=y
CONFIG_ADC=y
CONFIG_ADC_STM32=y
```

## boards/nucleo_g431kb.overlay
```dts
/*
 * SPDX-FileCopyrightText: Copyright The Zephyr Project Contributors
 * SPDX-License-Identifier: Apache-2.0
 *
 * Board DTS leaves ADC and VREFINT disabled. Enable the common block and
 * ADC1 so this Nucleo (local hardware) can build and run the test. Clock
 * settings match nucleo_g474re; VREFINT is an internal channel so no
 * pinctrl is required.
 */

&adc12_common {
	st,adc-clock-source = "SYNC";
	st,adc-prescaler = <4>;
	status = "okay";
};

&adc1 {
	status = "okay";
};

&vref {
	status = "okay";
};
```

## boards/nucleo_h753zi.overlay
```dts
/*
 * SPDX-FileCopyrightText: Copyright The Zephyr Project Contributors
 * SPDX-License-Identifier: Apache-2.0
 *
 * Board DTS enables adc1/adc3 but leaves VREFINT disabled. On this H7
 * the factory-calibrated VREFINT path is ADC3 (16-bit VREFINT_CAL).
 */

&vref {
	status = "okay";
};
```

## boards/nucleo_u575zi_q.overlay
```dts
/*
 * SPDX-FileCopyrightText: Copyright The Zephyr Project Contributors
 * SPDX-License-Identifier: Apache-2.0
 *
 * Board already enables ADC1, ADC4, and vref1. Enable vref4 so both ADCs
 * are VREFINT owners and share one cached rail.
 */

&vref4 {
	status = "okay";
};
```

## src/main.c
```c
/*
 * SPDX-FileCopyrightText: Copyright The Zephyr Project Contributors
 * SPDX-License-Identifier: Apache-2.0
 */

#include <zephyr/devicetree.h>
#include <zephyr/drivers/adc.h>
#include <zephyr/ztest.h>

#define DT_DRV_COMPAT st_stm32_adc

#define VREF_OWNER_ENTRY(vref_n)                                                                   \
	IF_ENABLED(DT_NODE_HAS_PROP(vref_n, io_channels),                                          \
		   ({                                                                              \
			    .dev = DEVICE_DT_GET_OR_NULL(DT_IO_CHANNELS_CTLR(vref_n)),             \
			    .channel = DT_IO_CHANNELS_INPUT(vref_n),                               \
		    },))

#define ADC_CHILD_DEV(node_id) DEVICE_DT_GET(node_id),
#define ADC_CHILDREN(inst)     DT_INST_FOREACH_CHILD_STATUS_OKAY(inst, ADC_CHILD_DEV)

#define ADC_CHILD_VREF_MV(node_id) DT_PROP(DT_PARENT(node_id), vref_mv),
#define ADC_CHILDREN_VREF(inst)    DT_INST_FOREACH_CHILD_STATUS_OKAY(inst, ADC_CHILD_VREF_MV)

struct vref_owner {
	const struct device *dev;
	uint8_t channel;
};

static const struct vref_owner owners[] = {DT_FOREACH_STATUS_OKAY(st_stm32_vref, VREF_OWNER_ENTRY)};

static const struct device *const adcs[] = {DT_INST_FOREACH_STATUS_OKAY(ADC_CHILDREN)};

#ifndef CONFIG_ADC_STM32_VREFINT_CALIBRATE
static const uint16_t adc_dt_vref_mv[] = {DT_INST_FOREACH_STATUS_OKAY(ADC_CHILDREN_VREF)};
#endif

static void assert_owner_ready(const struct vref_owner *owner)
{
	zassert_not_null(owner->dev, "VREFINT ADC from io-channels is not instantiated");
	zassert_true(device_is_ready(owner->dev), "VREFINT-capable ADC not ready");
}

ZTEST(adc_stm32_vref, test_ref_internal_after_boot)
{
	uint16_t mv;
	uint16_t first = 0;
	int ret;

	zassert_true(ARRAY_SIZE(owners) > 0, "no okay st,stm32-vref node with io-channels");

	for (size_t i = 0; i < ARRAY_SIZE(owners); i++) {
		assert_owner_ready(&owners[i]);

		ret = adc_ref_get(owners[i].dev, ADC_REF_INTERNAL, &mv);
		zassert_ok(ret, "adc_ref_get(INTERNAL) failed on %s: %d", owners[i].dev->name, ret);
		zassert_true(mv > 0, "expected positive INTERNAL mV on %s", owners[i].dev->name);
		zassert_equal(adc_ref_internal(owners[i].dev), mv, "adc_ref_internal mismatch");

		ret = adc_ref_get(owners[i].dev, ADC_REF_EXTERNAL0, &mv);
		zassert_equal(ret, -ENOTSUP, "EXTERNAL0 should be -ENOTSUP, got %d", ret);

		if (i == 0) {
			first = adc_ref_internal(owners[i].dev);
		} else {
			zassert_equal(adc_ref_internal(owners[i].dev), first,
				      "owners must share one cached rail");
		}
	}
}

ZTEST(adc_stm32_vref, test_calibrate_refresh_does_not_fail)
{
	int16_t buf;
	int ret;

	zassert_true(ARRAY_SIZE(owners) > 0, "no okay st,stm32-vref node with io-channels");

	for (size_t i = 0; i < ARRAY_SIZE(owners); i++) {
		struct adc_sequence seq = {
			.channels = BIT(owners[i].channel),
			.buffer = &buf,
			.buffer_size = sizeof(buf),
			.resolution = 12,
			.calibrate = true,
		};

		assert_owner_ready(&owners[i]);

		ret = adc_read(owners[i].dev, &seq);
		if (ret == -EINVAL || ret == -ENOTSUP) {
			ztest_test_skip();
		}
		zassert_ok(ret, "calibrate sequence failed on %s: %d", owners[i].dev->name, ret);
		zassert_true(adc_ref_internal(owners[i].dev) > 0, "ref after calibrate");
	}

	if (ARRAY_SIZE(owners) < 2) {
		return;
	}

	zassert_equal(adc_ref_internal(owners[0].dev), adc_ref_internal(owners[1].dev),
		      "calibrate on one owner must keep a shared cache");
}

#ifdef CONFIG_ADC_STM32_VREFINT_CALIBRATE
ZTEST(adc_stm32_vref, test_calibrate_after_default_channel_setup)
{
	int16_t buf;
	int ret;

	zassert_true(ARRAY_SIZE(owners) > 0, "no okay st,stm32-vref node with io-channels");

	for (size_t i = 0; i < ARRAY_SIZE(owners); i++) {
		struct adc_channel_cfg ch_cfg = {
			.gain = ADC_GAIN_1,
			.reference = ADC_REF_INTERNAL,
			.acquisition_time = ADC_ACQ_TIME_DEFAULT,
			.channel_id = owners[i].channel,
		};
		struct adc_sequence seq = {
			.channels = BIT(owners[i].channel),
			.buffer = &buf,
			.buffer_size = sizeof(buf),
			.resolution = 12,
			.calibrate = true,
		};

		assert_owner_ready(&owners[i]);

		ret = adc_channel_setup(owners[i].dev, &ch_cfg);
		zassert_ok(ret, "channel_setup(DEFAULT) failed on %s: %d", owners[i].dev->name,
			   ret);

		ret = adc_read(owners[i].dev, &seq);
		zassert_ok(ret, "calibrate after DEFAULT setup failed on %s: %d",
			   owners[i].dev->name, ret);
		zassert_true(adc_ref_internal(owners[i].dev) > 0, "ref after calibrate");
	}
}
#endif /* CONFIG_ADC_STM32_VREFINT_CALIBRATE */

#ifndef CONFIG_ADC_STM32_VREFINT_CALIBRATE
ZTEST(adc_stm32_vref, test_ref_internal_matches_dt_vref_mv)
{
	zassert_equal(ARRAY_SIZE(adcs), ARRAY_SIZE(adc_dt_vref_mv));

	for (size_t i = 0; i < ARRAY_SIZE(adcs); i++) {
		zassert_true(device_is_ready(adcs[i]), "ADC not ready");
		zassert_equal(adc_ref_internal(adcs[i]), adc_dt_vref_mv[i],
			      "adc_ref_internal should match DT vref-mv on %s", adcs[i]->name);
	}
}
#endif /* CONFIG_ADC_STM32_VREFINT_CALIBRATE */

ZTEST(adc_stm32_vref, test_ref_internal_shared_across_adc_instances)
{
	uint16_t expected;

	zassert_true(ARRAY_SIZE(adcs) > 0, "no okay STM32 ADC");
	zassert_true(device_is_ready(adcs[0]), "ADC not ready");

	if (ARRAY_SIZE(adcs) < 2) {
		ztest_test_skip();
	}

	expected = adc_ref_internal(adcs[0]);
	for (size_t i = 1; i < ARRAY_SIZE(adcs); i++) {
		zassert_true(device_is_ready(adcs[i]), "ADC not ready");
		zassert_equal(adc_ref_internal(adcs[i]), expected,
			      "INTERNAL ref should be shared across ADC instances");
	}
}

ZTEST_SUITE(adc_stm32_vref, NULL, NULL, NULL, NULL, NULL);
```
