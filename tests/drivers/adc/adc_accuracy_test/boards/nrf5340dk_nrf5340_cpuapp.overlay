/*
 * SPDX-License-Identifier: Apache-2.0
 *
 * Copyright (c) 2026 Nordic Semiconductor ASA
 */

/ {
	zephyr,user {
		io-channels = <&adc 0>;
		reference-mv = <3000>;
		expected-accuracy = <64>;
	};
};

&adc {
	#address-cells = <1>;
	#size-cells = <0>;

	channel@0 {
		reg = <0>;
		zephyr,gain = "ADC_GAIN_1_6";
		zephyr,reference = "ADC_REF_INTERNAL";
		zephyr,acquisition-time = <ADC_ACQ_TIME_DEFAULT>;
		zephyr,input-positive = <NRF_SAADC_AIN4>; /* P0.25 */
		zephyr,resolution = <14>;
	};
};
