/*
 * Copyright (c) 2026 ITE Corporation. All Rights Reserved.
 *
 * SPDX-License-Identifier: Apache-2.0
 */

#include <zephyr/dt-bindings/adc/adc.h>

/* Connect a stable 3300 mV source to GPI5 and share ground. */

/ {
	zephyr,user {
		io-channels = <&adc0 5>;
		reference-mv = <3300>;
		expected-accuracy = <32>;
	};
};

&adc0 {
	pinctrl-0 = <&adc0_ch5_gpi5_default>;
	pinctrl-names = "default";
	#address-cells = <1>;
	#size-cells = <0>;
	status = "okay";

	channel@5 {
		reg = <5>;
		zephyr,gain = "ADC_GAIN_1";
		zephyr,reference = "ADC_REF_INTERNAL";
		zephyr,acquisition-time = <ADC_ACQ_TIME_DEFAULT>;
		zephyr,resolution = <12>;
	};
};
