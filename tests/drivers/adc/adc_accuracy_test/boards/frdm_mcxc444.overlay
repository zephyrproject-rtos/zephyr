/*
 * SPDX-License-Identifier: Apache-2.0
 *
 * Copyright 2024 NXP
 */

/* Please connect voltage reference to J4 pin 1 to run the test. */

/ {
	zephyr,user {
		io-channels = <&adc0 0>;
		reference_mv = <1650>;
		expected_accuracy = <32>;
	};
};

&adc0 {
	#address-cells = <1>;
	#size-cells = <0>;

	channel@0 {
		reg = <0>;
		zephyr,gain = "ADC_GAIN_1";
		zephyr,reference = "ADC_REF_VDD_1";
		zephyr,vref-mv = <3300>;
		zephyr,acquisition-time = <ADC_ACQ_TIME_DEFAULT>;
		zephyr,resolution = <12>;
	};
};
