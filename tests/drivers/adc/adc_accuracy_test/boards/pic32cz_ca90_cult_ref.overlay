/*
 * Copyright (c) 2026 Microchip Technology Inc.
 *
 * SPDX-License-Identifier: Apache-2.0
 */

/* Connect the PA18 (EXT1 Pin 3) to VCC for the test */

/ {
	zephyr,user {
		io-channels = <&adc1 0>;
		reference-mv = <3300>;
		expected-accuracy = <32>;
	};
};

&adc1 {
	#address-cells = <1>;
	#size-cells = <0>;
	status = "okay";

	channel@0 {
		reg = <0>;
		zephyr,gain = "ADC_GAIN_1";
		zephyr,reference = "ADC_REF_VDD_1";
		zephyr,vref-mv = <3300>;
		zephyr,acquisition-time = <ADC_ACQ_TIME_DEFAULT>;
		zephyr,input-positive = <MCHP_ADC_AIN0>;
		zephyr,resolution = <12>;
	};
};
