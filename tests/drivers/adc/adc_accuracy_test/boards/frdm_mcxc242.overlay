/*
 * SPDX-License-Identifier: Apache-2.0
 *
 * Copyright 2024 NXP
 */

 /* Please connect voltage reference to J6.AN pin to run the test. */

/ {
	zephyr,user {
		io-channels = <&adc0 1>;
		reference_mv = <1650>;
	};
};

&adc0 {
	#address-cells = <1>;
	#size-cells = <0>;

	channel@1 {
		reg = <1>;
		zephyr,gain = "ADC_GAIN_1";
		zephyr,reference = "ADC_REF_VDD_1";
		zephyr,vref-mv = <3300>;
		zephyr,acquisition-time = <ADC_ACQ_TIME_DEFAULT>;
		zephyr,resolution = <12>;
	};
};
