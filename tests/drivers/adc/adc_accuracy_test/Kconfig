## tests/drivers/adc/adc_accuracy_test/Kconfig
```kconfig
# Copyright (c) 2023 Intel Corporation
# Copyright (c) 2025 Renesas Electronics Corporation
#
# SPDX-License-Identifier: Apache-2.0

mainmenu "ADC accuracy test"

source "Kconfig.zephyr"

# Workaround to have commas on function arguments
ZEPHYR_USER := zephyr,user

config DAC_SOURCE_TEST
	bool "Test using a DAC source"
	select DAC
	depends on $(dt_node_has_prop,/$(ZEPHYR_USER),dac)
	depends on $(dt_node_has_prop,/$(ZEPHYR_USER),dac-channel-id)
	depends on $(dt_node_has_prop,/$(ZEPHYR_USER),dac-resolution)

config REFERENCE_VOLTAGE_TEST
	bool "Test using a ref voltage source"
	depends on $(dt_node_has_prop,/$(ZEPHYR_USER),reference-mv)
	depends on $(dt_node_has_prop,/$(ZEPHYR_USER),expected-accuracy)

config NUMBER_OF_PASSES
	int "Number of passes"
	default 5

if DAC_SOURCE_TEST

config DAC_BUFFER_NOT_SUPPORTED
	bool "DAC on board/SoC does not support output buffer mode"
	help
	  If this config is selected, the test will run with no output buffer enabled

endif # DAC_SOURCE_TEST
```

## tests/drivers/adc/adc_accuracy_test/boards/ek_ra4m1.conf
```kconfig
# Copyright (c) 2025 Renesas Electronics Corporation
# SPDX-License-Identifier: Apache-2.0

CONFIG_DAC_BUFFER_NOT_SUPPORTED=y
```

## tests/drivers/adc/adc_accuracy_test/boards/rts5912_evb.conf
```kconfig
# RTS5912 EVB ADC Accuracy Test Configuration
# Enable reference voltage test mode (using potentiometer as voltage source)
CONFIG_REFERENCE_VOLTAGE_TEST=y
```

## tests/drivers/adc/adc_accuracy_test/boards/sam_e54_xpro.conf
```kconfig
# Copyright (c) 2026 Microchip Technology Inc.
# SPDX-License-Identifier: Apache-2.0

CONFIG_DAC=y
CONFIG_DAC_BUFFER_NOT_SUPPORTED=y
```

## tests/drivers/adc/adc_accuracy_test/testcase.yaml
```yaml
common:
  tags:
    - adc
    - drivers
  depends_on:
    - adc
  filter: dt_node_has_prop("/zephyr,user","io-channels")

tests:
  drivers.adc.accuracy.dac_source:
    depends_on:
      - dac
    extra_configs:
      - CONFIG_DAC_SOURCE_TEST=y
    # Test scenario is filtered if Kconfig dependencies are not satisfied
    filter: CONFIG_DAC_SOURCE_TEST
    harness_config:
      fixture: dac_adc_loopback
    platform_allow:
      - frdm_k64f
      - ek_ra8d1
      - ek_ra8m1
      - mck_ra8t1
      - ek_ra6e2
      - ek_ra6m1
      - ek_ra6m2
      - ek_ra6m3
      - ek_ra6m4
      - ek_ra6m5
      - fpb_ra6e1
      - fpb_ra6e2
      - ek_ra4e2
      - ek_ra4l1
      - ek_ra4m1
      - ek_ra4m2
      - ek_ra4m3
      - ek_ra4w1
      - fpb_ra4e1
      - ek_ra2a1
      - ek_ra2l1
  drivers.adc.accuracy.ref_volt:
    extra_configs:
      - CONFIG_REFERENCE_VOLTAGE_TEST=y
    # Test scenario is filtered if Kconfig dependencies are not satisfied
    filter: CONFIG_REFERENCE_VOLTAGE_TEST
    harness_config:
      fixture: adc_ref_volt
    platform_allow:
      - frdm_kl25z
      - frdm_mcxc242
      - frdm_mcxc444
      - nrf52840dk/nrf52840
      - nrf54h20dk/nrf54h20/cpuapp
      - nrf54l15dk/nrf54l15/cpuapp
      - nrf54lm20dk/nrf54lm20a/cpuapp
      - ophelia4ev/nrf54l15/cpuapp
      - sltb010a
      - xg23_rb4210a
      - xg24_dk2601b
      - xg24_rb4187c
      - xg27_dk2602a
      - xg29_rb4412a
      - bg29_rb4420a
      - slwrb4180a
      - ek_ra4c1
      - pic32cx_sg41_cult
    extra_args:
      - platform:pic32cx_sg41_cult/pic32cx1025sg41128:"DTC_OVERLAY_FILE="boards/pic32cx_sg41_cult_ref.overlay"
    integration_platforms:
      - frdm_kl25z
      - nrf54l15dk/nrf54l15/cpuapp
```

## tests/drivers/adc/adc_api/boards/kit_pse84_ai_pse846gps2dbzc4a_m55.conf
```kconfig
# SPDX-FileCopyrightText: Copyright The Zephyr Project Contributors
# SPDX-License-Identifier: Apache-2.0

# The Infineon AutAnalog SAR ADC driver stores conversion results as 32-bit
# samples, so the test must use 32-bit wide sample buffers.
CONFIG_ADC_32_BITS_DATA=y
```

## tests/drivers/adc/adc_api/boards/native_posix.conf
```kconfig
# Copyright 2021 Google LLC
# SPDX-License-Identifier: Apache-2.0

CONFIG_ADC_EMUL=y
```

## tests/drivers/adc/adc_api/boards/nucleo_f746zg.conf
```kconfig
# SPDX-FileCopyrightText: Copyright The Zephyr Project Contributors
# SPDX-License-Identifier: Apache-2.0

CONFIG_NOCACHE_MEMORY=y
```

## tests/drivers/adc/adc_api/boards/nucleo_g071rb.conf
```kconfig
# SPDX-FileCopyrightText: Copyright The Zephyr Project Contributors
# SPDX-License-Identifier: Apache-2.0

CONFIG_TIMESLICE_SIZE=0
```

## tests/drivers/adc/adc_api/boards/rts5912_evb.conf
```kconfig
# RTS5912 ADC API Test Configuration
# Disable async mode (not implemented in driver)
CONFIG_ADC_ASYNC=n
```

## tests/drivers/adc/adc_api/boards/stm32n6570_dk_sb.conf
```kconfig
# USERSPACE not functional on N6 yet
CONFIG_TEST_USERSPACE=n
CONFIG_ADC_32_BITS_DATA=y
```

## tests/drivers/adc/adc_api/testcase.yaml
```yaml
common:
  tags:
    - adc
    - drivers
    - userspace
  depends_on: adc
  filter: dt_node_has_prop("/zephyr,user","io-channels")
  min_flash: 40

tests:
  drivers.adc:
    platform_exclude:
      - nucleo_u031r8
      - panb611evb/nrf54l15/cpuapp
      - panb611evb/nrf54l15/cpuapp/ns
      - nrf54l15dk/nrf54l15/cpuapp/ns
      - nrf54l15dk/nrf54l10/cpuapp/ns
      - nrf54lm20dk/nrf54lm20a/cpuapp/ns
      - bl54l15_dvk/nrf54l10/cpuapp/ns
      - bl54l15_dvk/nrf54l15/cpuapp/ns
      - bl54l15u_dvk/nrf54l15/cpuapp/ns
      - rpi_pico/rp2040/mcuboot
      - rpi_pico/rp2040/w/mcuboot
      - rpi_pico2/rp2350a/m33/mcuboot
      - rpi_pico2/rp2350a/m33/w/mcuboot
      - raytac_an54lq_db_15/nrf54l15/cpuapp/ns
  drivers.adc.b_u585i_iot02a_adc4:
    extra_args:
      - platform:b_u585i_iot02a/stm32u585xx:DTC_OVERLAY_FILE="boards/b_u585i_iot02a_adc4.overlay"
    integration_platforms:
      - native_sim
      - native_sim/native/64
  drivers.adc.dma_st_stm32:
    depends_on:
      - dma
    platform_allow:
      - b_u585i_iot02a
      - disco_l475_iot1
      - nucleo_f091rc
      - nucleo_f103rb
      - nucleo_f207zg
      - nucleo_f401re
      - nucleo_f429zi
      - nucleo_f439zi
      - nucleo_f746zg
      - nucleo_g071rb
      - nucleo_g474re
      - nucleo_h743zi
      - nucleo_h753zi
      - nucleo_l073rz
      - nucleo_l152re
      - nucleo_l476rg
      - nucleo_u083rc
      - nucleo_u385rg_q
      - nucleo_u575zi_q
      - nucleo_wb55rg
      - nucleo_wba55cg
      - nucleo_wba65ri
      - nucleo_wl55jc
      - stm32f3_disco
      - stm32h573i_dk
      - stm32u083c_dk
    extra_args:
      - EXTRA_CONF_FILE=overlay-dma-stm32.conf
      - platform:nucleo_f103rb/stm32f103xb:DTC_OVERLAY_FILE="boards/nucleo_f103rb_dma.overlay"
    integration_platforms:
      - disco_l475_iot1
      - nucleo_l476rg
  drivers.adc.dma_nxp_kinetis:
    extra_args:
      - EXTRA_CONF_FILE="overlay-dma-kinetis.conf"
    depends_on:
      - dma
    min_flash: 40
    platform_allow:
      - frdm_k64f
      - frdm_k82f
    integration_platforms:
      - frdm_k82f
  drivers.adc.dma_espressif:
    extra_args:
      - EXTRA_CONF_FILE="overlay-dma-esp32.conf"
    depends_on:
      - adc
    platform_allow:
      - esp32_devkitc/esp32/procpu
      - esp32c3_devkitm
      - esp32c6_devkitc/esp32c6/hpcore
      - esp32h2_devkitm
      - esp32s2_devkitc
      - esp32s3_devkitc/esp32s3/procpu
  drivers.adc.dma_silabs:
    extra_args:
      - EXTRA_CONF_FILE="overlay-dma-silabs.conf"
    depends_on:
      - dma
    platform_allow:
      - slwrb4180a
      - sltb010a
      - xg23_rb4210a
      - xg24_rb4187c
      - xg27_dk2602a
      - bg29_rb4420a
      - xg29_rb4412a
  drivers.adc.dma_silabs_async:
    extra_args:
      - EXTRA_CONF_FILE="overlay-dma-silabs.conf"
      - CONFIG_ADC_ASYNC=y
    depends_on:
      - dma
    platform_allow:
      - slwrb4180a
      - sltb010a
      - xg23_rb4210a
      - xg24_rb4187c
      - xg27_dk2602a
      - bg29_rb4420a
      - xg29_rb4412a
```

## tests/drivers/adc/adc_dma/boards/frdm_k64f.conf
```kconfig
#
# Copyright (c) 2020, NXP
#
# SPDX-License-Identifier: Apache-2.0
#

CONFIG_ADC_MCUX_ADC16_ENABLE_EDMA=y
```

## tests/drivers/adc/adc_dma/boards/frdm_k82f.conf
```kconfig
#
# Copyright (c) 2020, NXP
#
# SPDX-License-Identifier: Apache-2.0
#

CONFIG_ADC_MCUX_ADC16_ENABLE_EDMA=y
CONFIG_ADC_MCUX_ADC16_HW_TRIGGER=y
CONFIG_COUNTER=y
CONFIG_ADC_ASYNC=y
```
