## tests/drivers/adc/adc_dma/boards/nucleo_f401re.conf
```kconfig
#
# Copyright (c) 2024 STMicroelectronics
#
# SPDX-License-Identifier: Apache-2.0
#

CONFIG_ADC_STM32_DMA=y
CONFIG_ADC_ASYNC=y
```

## tests/drivers/adc/adc_dma/boards/nucleo_h743zi.conf
```kconfig
#
# Copyright (c) 2023 Nobleo Technology
#
# SPDX-License-Identifier: Apache-2.0
#

CONFIG_ADC_STM32_DMA=y
CONFIG_ADC_ASYNC=y
```

## tests/drivers/adc/adc_dma/testcase.yaml
```yaml
common:
  tags:
    - adc
    - dma
    - trigger
tests:
  drivers.adc.dma:
    depends_on:
      - adc
      - dma
    platform_allow:
      - frdm_k82f
      - frdm_k64f
      - nucleo_h743zi
      - nucleo_u575zi_q
    integration_platforms:
      - frdm_k82f
```

## tests/drivers/adc/adc_emul/testcase.yaml
```yaml
common:
  tags:
    - adc
    - drivers
    - userspace
tests:
  drivers.adc.emul:
    depends_on: adc
    platform_allow:
      - native_posix
      - native_sim
    integration_platforms:
      - native_sim
```

## tests/drivers/adc/adc_error_cases/Kconfig
```kconfig
# Copyright (c) 2025 Infineon Technologies AG,
# or an affiliate of Infineon Technologies AG.
#
# SPDX-License-Identifier: Apache-2.0

source "Kconfig.zephyr"

config TEST_ADC_ERROR_CASES_RESOLUTION
	int
	default 12 if SOC_FAMILY_SILABS_S2 || SOC_SERIES_PSC3
	default 10
```

## tests/drivers/adc/adc_error_cases/testcase.yaml
```yaml
common:
  tags:
    - adc
    - drivers
  depends_on: adc
  filter: dt_alias_exists("adc")

tests:
  drivers.adc_error_cases:
    platform_allow:
      - nrf52840dk/nrf52840
      - nrf54l15dk/nrf54l15/cpuapp
      - nrf54lm20dk/nrf54lm20a/cpuapp
      - nrf54h20dk/nrf54h20/cpuapp
      - ophelia4ev/nrf54l15/cpuapp
      - sltb010a
      - xg23_rb4210a
      - xg24_rb4187c
      - xg27_dk2602a
      - xg29_rb4412a
      - bg29_rb4420a
      - slwrb4180a
```

## tests/drivers/adc/adc_rescale/testcase.yaml
```yaml
common:
  tags: adc drivers userspace
tests:
  drivers.adc.rescale:
    depends_on: adc
    platform_allow:
      - native_sim
      - native_sim/native/64
```

## tests/drivers/adc/adc_rtio/testcase.yaml
```yaml
# Copyright (c) 2026 Nordic Semiconductor ASA
# SPDX-License-Identifier: Apache-2.0

common:
  tags:
    - drivers
    - adc
    - rtio
  platform_allow:
    - native_sim
    - native_sim/native/64
    - qemu_x86
    - qemu_cortex_m3
tests:
  drivers.adc.adc_rtio:
    extra_configs:
      - CONFIG_ADC_RTIO_WRAPPER=n
  drivers.adc.adc_rtio.wrapper: {}
```

## tests/drivers/aon_counter/aon_api/testcase.yaml
```yaml
tests:
  peripheral.counter:
    platform_whitelist: quark_se_c1000_devboard quark_se_c1000_ss_devboard
      quark_d2000_crb arduino_101 arduino_101_sss
    tags: drivers counter
```

## tests/drivers/audio/dmic_api/boards/native_sim_native_64.conf
```kconfig
# Copyright 2026 NXP
# SPDX-License-Identifier: Apache-2.0

CONFIG_AUDIO_DMIC_NATIVE_SIM=y
CONFIG_AUDIO_DMIC_NATIVE_SIM_FILE_PATH="/tmp/native_sim_dmic_in.pcm"
CONFIG_SAMPLE_BIT_WIDTH=16
CONFIG_SAMPLE_PDM_CHANNELS=2
CONFIG_HW_CHANNEL_INDEX=0
```

## tests/drivers/audio/dmic_api/testcase.yaml
```yaml
tests:
  drivers.audio.dmic_api:
    depends_on: dmic
    tags: dmic
    harness: ztest
    filter: dt_alias_exists("dmic-dev")
    integration_platforms:
      - mimxrt595_evk/mimxrt595s/cm33
```

## tests/drivers/audio/dmic_util/boards/kit_pse84_ai_pse846gps2dbzc4a_m55.conf
```kconfig
# Boot delay for PSE84 M55 targets.
#
# dmic_util is a pure compile-time devicetree-macro test that completes in
# ~2 ms from boot. On M55 the two-domain (enable_cm55 + image) OpenOCD flash
# sequence is slow enough that the test finishes and prints its output before
# Twister opens its serial-capture window, yielding a status=None result.
# Delaying the boot past the capture-window open lets Twister observe the
# PASS output.
CONFIG_BOOT_DELAY=2000
```

## tests/drivers/audio/dmic_util/testcase.yaml
```yaml
tests:
  drivers.audio.dmic_util:
    tags: dmic
    harness: ztest
    integration_platforms:
      - native_sim
```

## tests/drivers/audio/testcase.yaml
```yaml
---
tests:
  drivers.audio.unit:
    tags:
      - driver
      - audio
    type: unit
    extra_configs:
      - CONFIG_LOG_CUSTOM_HEADER=y
```

## tests/drivers/audio/wm8960/Kconfig
```kconfig
# Copyright 2026 NXP
# SPDX-License-Identifier: Apache-2.0

source "Kconfig.zephyr"

config AUDIO_CODEC_WM8960_EMUL
	bool "Wolfson WM8960 Audio Codec Emulator"
	default y
	depends on EMUL
	depends on AUDIO_CODEC_WM8960
	help
		Enable Wolfson WM8960 audio codec emulator.

		This emulator provides a virtual WM8960 audio codec for testing
		purposes on native_posix and other emulation platforms.

if AUDIO_CODEC_WM8960_EMUL

config WM8960_EMUL_LOG_LEVEL
	int "WM8960 emulator log level"
	default 2
	range 0 4
	help
		Set log level for WM8960 emulator.

		Levels are:
		- 0 OFF
		- 1 ERROR
		- 2 WARNING
		- 3 INFO
		- 4 DEBUG

endif # AUDIO_CODEC_WM8960_EMUL
```

## tests/drivers/audio/wm8960/dts/bindings/zephyr,wm8960-emul.yaml
```yaml
# Copyright 2026 NXP
# SPDX-License-Identifier: Apache-2.0

include: [i2c-device.yaml, base.yaml]

description: WM8960 audio codec emulator
compatible: "zephyr,wm8960-emul"

properties:
  reg:
    required: true
    description: I2C device address of the emulated WM8900 codec
  wakeup-source:
    type: boolean
    description: |
      If enabled, the device can wake the system from sleep states.
  reset-gpios:
    type: phandle-array
    description: |
      GPIO connected to the codec's reset pin. This is optional and
      represents the hardware reset line if present in the system.
```

## tests/drivers/bbram/emul/testcase.yaml
```yaml
# Copyright 2021 Google LLC
# SPDX-License-Identifier: Apache-2.0

tests:
  drivers.bbram.emul:
    tags:
      - drivers
      - bbram
    harness: ztest
    platform_allow: native_sim
    integration_platforms:
      - native_sim
```

## tests/drivers/bbram/testcase.yaml
```yaml
# Copyright 2021 Google LLC
# SPDX-License-Identifier: Apache-2.0

common:
  tags:
    - drivers
    - bbram
  build_only: true
  harness: ztest
  arch_exclude: posix
tests:
  drivers.bbram.it8xxx2:
    filter: dt_compat_enabled("ite,it8xxx2-bbram")
    integration_platforms:
      - it82xx2_evb
  drivers.bbram.npcx:
    filter: dt_compat_enabled("nuvoton,npcx-bbram")
    integration_platforms:
      - npcx9m6f_evb
  drivers.bbram.stm32:
    extra_args: OVERLAY_CONFIG="stm32.conf"
    filter: dt_compat_enabled("st,stm32-bbram")
    integration_platforms:
      - nucleo_g071rb
      - stm32f746g_disco
  drivers.bbram.stm32_rtc:
    extra_args: OVERLAY_CONFIG="stm32_rtc.conf"
    filter: dt_compat_enabled("st,stm32-bbram")
    integration_platforms:
      - nucleo_g071rb
      - stm32f746g_disco
```

## tests/drivers/bc12/boards/native_posix.conf
```kconfig
# Copyright (c) 2022 Google LLC
# SPDX-License-Identifier: Apache-2.0

CONFIG_EMUL=y
CONFIG_GPIO=y
CONFIG_I2C=y
CONFIG_USB_BC12=y
```

## tests/drivers/biometrics/biometrics_emul/testcase.yaml
```yaml
# Copyright (c) 2025 Siratul Islam
# SPDX-License-Identifier: Apache-2.0

tests:
  drivers.biometrics.biometrics_emul:
    integration_platforms:
      - native_sim
    platform_allow:
      - native_sim
      - native_sim/native/64
    tags:
      - biometrics
      - drivers
```
