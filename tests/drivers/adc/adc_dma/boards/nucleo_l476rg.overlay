/*
 * Copyright (c) 2023 Hein Wessels, Nobleo Technology
 *
 * SPDX-License-Identifier: Apache-2.0
 */

&adc1 {
	dmas = < &dma1 1 0 (STM32_DMA_PERIPH_RX |  STM32_DMA_MEM_16BITS | STM32_DMA_PERIPH_16BITS) >;
	dma-names = "dma";

	#address-cells = <1>;
	#size-cells = <0>;
};

test_dma: &dma1 {
    status = "okay";
};
