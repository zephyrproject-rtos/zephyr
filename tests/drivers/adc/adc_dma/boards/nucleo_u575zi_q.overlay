/*
 * Copyright (c) 2023 Brett Witherspoon
 *
 * SPDX-License-Identifier: Apache-2.0
 */

&adc1 {
	dmas = <&gpdma1 0 0 (STM32_DMA_PERIPH_TO_MEMORY |
		STM32_DMA_MEM_INC |  STM32_DMA_MEM_16BITS | STM32_DMA_PERIPH_16BITS) >;
	dma-names = "dmamux";

	#address-cells = <1>;
	#size-cells = <0>;

	channel@1 {
		reg = <1>;
		zephyr,gain = "ADC_GAIN_1";
		zephyr,reference = "ADC_REF_INTERNAL";
		zephyr,acquisition-time = <ADC_ACQ_TIME_DEFAULT>;
		zephyr,resolution = <12>;
	};
};

test_dma: &gpdma1 {
	status = "okay";
};
