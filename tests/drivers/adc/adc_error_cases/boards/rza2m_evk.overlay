/*
 * Copyright (c) 2025 Renesas Electronics Corporation
 *
 * SPDX-License-Identifier: Apache-2.0
 */

/ {
	aliases {
		adc = &adc;
	};
};

&adc {
	#address-cells = <1>;
	#size-cells = <0>;
	status = "okay";
};
