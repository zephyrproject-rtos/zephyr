## tests/drivers/clock_management/clock_management_hw/dts/bindings/vnd,emul-clock-consumer.yaml
```yaml
# Copyright 2024 NXP
#
# SPDX-License-Identifier: Apache-2.0

description: |
  Binding for emulated clock consumer device. This device is used in testing
  to verify that clock states are applied as expected.

compatible: "vnd,emul-clock-consumer"

include: [clock-device.yaml]

properties:
  default-freq:
    type: int
    required: true
    description: |
      Frequency this consumer expects to read when applying default clock
      management state

  sleep-freq:
    type: int
    required: true
    description: |
      Frequency this consumer expects to read when applying sleep clock
      management state

  test1-freq:
    type: int
    required: true
    description: |
      Frequency this consumer expects to read when applying test1 clock
      management state

  test2-freq:
    type: int
    required: true
    description: |
      Frequency this consumer expects to read when applying test2 clock
      management state

  test3-freq:
    type: int
    required: true
    description: |
      Frequency this consumer expects to read when applying test3 clock
      management state

  freq-req-1:
    type: int
    required: true
    description: |
     First frequency this consumer will request from the clock subsystem

  freq-req-2:
    type: int
    required: true
    description: |
     Second frequency this consumer will request from the clock subsystem

  freq-req-3:
    type: int
    required: true
    description: |
     Third frequency this consumer will request from the clock subsystem
```

## tests/drivers/clock_management/clock_management_minimal/dts/bindings/vnd,emul-clock-consumer.yaml
```yaml
# Copyright (c) 2024 Tenstorrent AI UL
#
# SPDX-License-Identifier: Apache-2.0

description: |
  Binding for emulated clock consumer device. This device is used in testing
  to verify that clock states are applied as expected.

compatible: "vnd,emul-clock-consumer"

include: [clock-device.yaml]

properties:
  fast-default-freq:
    type: int
    required: true
    description: |
      Frequency this consumer expects to read when applying default
      clock state for fast output

  fast-sleep-freq:
    type: int
    required: true
    description: |
      Frequency this consumer expects to read when applying sleep
      clock state for fast output

  slow-default-freq:
    type: int
    required: true
    description: |
      Frequency this consumer expects to read when applying default
      clock state for slow output

  slow-sleep-freq:
    type: int
    required: true
    description: |
      Frequency this consumer expects to read when applying sleep
      clock state for slow output
```

## tests/drivers/clock_management/common/emul_clock_drivers/Kconfig
```kconfig
# Copyright 2026 Analog Devices, Inc.
# SPDX-License-Identifier: Apache-2.0

config CLOCK_MANAGEMENT_EMUL_DIV
	bool "Emulated divider clock driver"
	default y
	depends on DT_HAS_VND_EMUL_CLOCK_DIV_ENABLED
	help
	  Emulated divider clock driver. Divides the input clock frequency

config CLOCK_MANAGEMENT_EMUL_MUX
	bool "Emulated multiplexer clock driver"
	default y
	depends on DT_HAS_VND_EMUL_CLOCK_MUX_ENABLED
	help
	  Emulated multiplexer clock driver. Selects one of the input clocks
```

## tests/drivers/clock_monitor/clock_monitor_pm/Kconfig
```kconfig
# SPDX-FileCopyrightText: 2026 NXP
# SPDX-License-Identifier: Apache-2.0

source "Kconfig.zephyr"

config TEST_CLOCK_MONITOR_MEASURE_NS
	int "Clock monitor measure duration (ns)"
	default 1000000
	help
	  Duration in nanoseconds for the measurement used by the cases that
	  re-measure after a power transition.

config TEST_CLOCK_MONITOR_PM_WINDOW_NS
	int "Clock monitor long measure window (ns)"
	range 1000000 2000000000
	default 100000000
	help
	  Duration in nanoseconds of the measurement that must still be in flight
	  when a case drives a power transition. The value is a request only: a
	  back-end may quantize it or substitute a fixed window of its own, so
	  keep it far above the microseconds a case spends between
	  clock_monitor_start() and the transition.

config TEST_CLOCK_MONITOR_PM_SETTLE_MS
	int "Clock monitor PM settle timeout (ms)"
	range 1 60000
	default 1000
	help
	  How long a case waits for a completion before asserting that none
	  arrives, in milliseconds. Must cover the worst case in which a
	  measurement never completes: the actual window plus the internal retry
	  budget of the back-end.
```

## tests/drivers/clock_monitor/clock_monitor_pm/dts/bindings/test-clock-monitor-pm.yaml
```yaml
# SPDX-FileCopyrightText: 2026 NXP
# SPDX-License-Identifier: Apache-2.0

description: |
  Fixture binding for the clock_monitor PM test suite.

  Each child node names one clock_monitor instance to exercise:

    / {
        clock-monitor-pm-test {
            compatible = "test-clock-monitor-pm";

            monitor0 {
                monitor = <&clock_monitor0>;
            };
        };
    };

  A board opts into the suite by providing an overlay with this node, which
  must also enable the monitor node and power the clocks the measurement
  needs (see test-required-clocks.yaml).

compatible: "test-clock-monitor-pm"

child-binding:
  description: One clock_monitor instance under test.

  properties:
    monitor:
      type: phandle
      required: true
      description: The clock_monitor device to exercise.
```

## tests/drivers/comparator/gpio_loopback/boards/frdm_mcxl255_mcxl255_cpu1_aon_lpcmp.conf
```kconfig
# Copyright 2026 NXP
# SPDX-License-Identifier: Apache-2.0

CONFIG_BOOT_BANNER=n
CONFIG_ZTEST_VERBOSE_OUTPUT=n
CONFIG_ZTEST_SUMMARY=y
CONFIG_HEAP_MEM_POOL_SIZE=64
CONFIG_THREAD_STACK_INFO=n
CONFIG_CBPRINTF_NANO=y
CONFIG_MAIN_STACK_SIZE=512
CONFIG_ZTEST_STACK_SIZE=512
CONFIG_IDLE_STACK_SIZE=256
CONFIG_ISR_STACK_SIZE=512
CONFIG_SYSTEM_WORKQUEUE_STACK_SIZE=256
```

## tests/drivers/counter/counter_basic_api/Kconfig
```kconfig
# Copyright 2025 NXP
# SPDX-License-Identifier: Apache-2.0

config TEST_DRIVER_COUNTER_MCUX_LPC_RTC_HIGHRES
	bool "tests the nxp_lpc_rtc_highres compatible driver"
	default y if COUNTER_MCUX_LPC_RTC_HIGHRES
	help
	  tests the nxp_lpc_rtc_highres compatible driver

config TEST_DRIVER_COUNTER_TOLERANCE
	int "Counter ticks tolerance (%)"
	default 10
	help
	  Error tolerance used in counter driver tests.
	  A number of ticks is estimated and counter is tested against systimer,
	  to verify accuracy. Tolerance is a percentage of deviation allowed for
	  the number of expected ticks.

config TEST_GUARD_PERIOD_US
	int "Guard Period in us"
	default 16000 if COUNTER_MCHP_RTC_G1
	default 200
	help
	  Guard period in us

config TEST_PROCESSING_LIMIT_US
	int "Processing limit in us"
	default 20000 if COUNTER_MCHP_RTC_G1
	default 1000
	help
	  Processing limit in us

config TEST_COUNTER_SHORT_RELATIVE_ALARM_ITERATIONS
	int "Iterations for the short relative alarm test (slow counters)"
	range 1 1000
	default 10
	help
	  Number of set-alarm/wait iterations performed by
	  test_short_relative_alarm for low-frequency (< 1000 Hz) counter
	  instances only; high-frequency counters always use the full 100
	  iterations. Each iteration busy-waits a few counter ticks, so on a
	  slow counter (e.g. a 1 Hz RTC) a large value makes the test run for
	  minutes and risk the test timeout. The default keeps slow-counter
	  coverage while bounding runtime.

source "Kconfig.zephyr"
```

## tests/drivers/counter/counter_capture/Kconfig
```kconfig
# SPDX-FileCopyrightText: Copyright The Zephyr Project Contributors
# SPDX-License-Identifier: Apache-2.0

mainmenu "Counter capture test configuration"

source "Kconfig.zephyr"

config NUM_OF_CONTINUOUS_CAPTURES
	int "Number of continuous capture iterations"
	default 5
	range 1 255
	help
	  Number of capture iterations run by each continuous capture test case.

# The trigger source the board provides, from its devicetree
ZEPHYR_USER := zephyr,user

config COUNTER_CAPTURE_TRIGGER_PWM
	bool
	default $(dt_node_has_prop,/$(ZEPHYR_USER),pwms)
	select PWM
	help
	  A PWM output of the zephyr,user node drives the capture input.

config COUNTER_CAPTURE_TRIGGER_GPIO
	bool
	default $(dt_node_has_prop,/$(ZEPHYR_USER),capture-tester-gpios)
	select GPIO
	help
	  A GPIO of the zephyr,user node drives the capture input.

config COUNTER_CAPTURE_MCUX_QTMR_XBAR_LOOPBACK
	bool
	default y if SOC_MIMXRT1064 && !COUNTER_CAPTURE_TRIGGER_PWM && \
		!COUNTER_CAPTURE_TRIGGER_GPIO
	help
	  The RT1064-specific trigger-source backend of the test. It configures
	  XBARA1 and IOMUXC_GPR so QTMR3 timer 0 output drives QTMR1 timer 0
	  input internally, avoiding an external loopback wire while exercising
	  the MCUX QTMR capture path.
```

## tests/drivers/counter/counter_pm/Kconfig
```kconfig
# Copyright (c) 2026 Espressif Systems (Shanghai) Co., Ltd.
# SPDX-License-Identifier: Apache-2.0

config COUNTER_PM_ACTIVE_MS
	int "Active counting time in milliseconds"
	default 20
	range 1 60000
	help
	  Time the counter runs while power management is blocked.

source "Kconfig.zephyr"
```

## tests/drivers/disk/disk_access/boards/mps2_an385_semihost.conf
```kconfig
# Copyright (c) 2026 RBR Ltd.
# SPDX-License-Identifier: Apache-2.0

CONFIG_SEMIHOST=y
```

## tests/drivers/display/led_strip_matrix/dts/bindings/vnd,led-strip-fake.yaml
```yaml
# SPDX-FileCopyrightText: Copyright The Zephyr Project Contributors
# SPDX-License-Identifier: Apache-2.0

description: Fake LED strip for matrix display tests

compatible: "vnd,led-strip-fake"

include: base.yaml

properties:
  chain-length:
    type: int
    required: true
    description: Number of pixels in the strip
```

## tests/drivers/dma/chan_blen_transfer/Kconfig
```kconfig
# Copyright (c) 2020 STMicroelectronics
# SPDX-License-Identifier: Apache-2.0

mainmenu "DMA Loop Transfer Test"

source "Kconfig.zephyr"

config DMA_TRANSFER_CHANNEL_NR_0
	int "first DMA channel to use"
	default 0

config DMA_TRANSFER_CHANNEL_NR_1
	int "second DMA channel to use"
	default 1

config DMA_LOOP_TRANSFER_RELOCATE_SECTION
	string "the section to place the memory buffers."
	depends on CODE_DATA_RELOCATION
	default "RAM"

config DMA_LOOP_TRANSFER_NUMBER_OF_DMAS
	int "Number of DMAs to test"
	default 1

config DMA_TRANSFER_BURST16
	bool "Enable loop transfers of 16-beat bursts"
	default y

config DMA_TRANSFER_LONG_BLOCK_SIZE
	int "Size in bytes of an additional long single-block transfer"
	default 0
	help
	  When non-zero, also copy one block of this many bytes with
	  one-byte bursts. Set it above what one descriptor of the
	  controller can carry to exercise a driver that splits a block.

config DMA_TRANSFER_LONG_BLOCK_RELOAD
	bool "Reload the channel after the long block"
	depends on DMA_TRANSFER_LONG_BLOCK_SIZE > 0
	help
	  For a driver that splits a long block on dma_config() but sends a
	  reload out as one descriptor: check that a reload of the long size
	  is refused with -EINVAL, and that a short reload then copies its
	  data and nothing else.

config DMA_TRANSFER_OVERSIZE_BLOCK_SIZE
	int "Size in bytes of a single block the driver must reject"
	default 0
	help
	  When non-zero, check that dma_config() rejects one block of this
	  many bytes with -EINVAL, returns with interrupts unlocked, and
	  leaves the channel usable for the next transfer.

config DMA_TRANSFER_IDLE_SLOT
	int "Request line of a peripheral that never requests"
	default -1
	help
	  When not negative, a peripheral-to-memory transfer on this request
	  line stays pending, which lets the test read dma_get_status() of a
	  started transfer: pending_length must be the whole block for 8-byte
	  bursts of 1-byte data.

config DMA_TRANSFER_FAULT_ADDRESS
	hex "Address a write to which ends in a bus error"
	default 0x0
	depends on DMA_TRANSFER_IDLE_SLOT >= 0
	help
	  When non-zero, start a memory-to-memory transfer to this address
	  while another channel waits on DMA_TRANSFER_IDLE_SLOT. The faulting
	  transfer must end with a negative status in its callback and the
	  waiting one must stay busy.

config DMA_TRANSFER_SOURCE_CHAINING_MAX_BLOCK_SIZE
	int "Largest block_size accepted with source_chaining_en"
	default 0
	help
	  When non-zero, dma_config() with source_chaining_en set and 1-byte
	  data and bursts must accept a block of this many bytes and reject
	  one byte more with -EINVAL.
```

## tests/drivers/dma/chan_blen_transfer/testcase.yaml
```yaml
tests:
  drivers.dma.chan_blen_transfer:
    min_ram: 16
    depends_on:
      - dma
    tags:
      - dma
    integration_platforms:
      - native_sim
      - native_sim/native/64
    filter: dt_nodelabel_enabled("tst_dma0")
  drivers.dma.chan_blen_transfer.mcux_edma_long_block:
    tags:
      - dma
    depends_on:
      - dma
    filter: dt_nodelabel_enabled("tst_dma0") and CONFIG_DMA_MCUX_EDMA
    platform_allow:
      - mimxrt1170_evk@A/mimxrt1176/cm7
    extra_configs:
      # Two descriptors of 0x7FFF loops fill the default pool of two.
      - CONFIG_DMA_TCD_QUEUE_SIZE=2
      - CONFIG_DMA_TRANSFER_LONG_BLOCK_SIZE=65534
      - CONFIG_DMA_TRANSFER_LONG_BLOCK_RELOAD=y
      - CONFIG_DMA_TRANSFER_OVERSIZE_BLOCK_SIZE=65535
  drivers.dma.chan_blen_transfer.low_footprint:
    tags:
      - dma
    min_ram: 12
    depends_on:
      - dma
    filter: dt_nodelabel_enabled("tst_dma0")
    platform_allow:
      - nucleo_c031c6
      - sam_e54_xpro
      - pic32cm_jh01_cpro
      - pic32cm_pl10_cnano
```

## tests/drivers/dma/concurrent_transfer/Kconfig
```kconfig
# Copyright (c) 2026 Tenstorrent AI ULC
# SPDX-License-Identifier: Apache-2.0

mainmenu "DMA Concurrent Transfer Test"

source "Kconfig.zephyr"

config DMA_CONCURRENT_CHANNEL_NR
	int "First DMA channel to use when dma_request_channel() is unsupported"
	default 0

config DMA_NUM_TEST_CHAN
	int "Number of DMA channels to test per controller"
	default 1
	help
	  Number of channels to run concurrently per DMA controller. All
	  channels are acquired up front (via dma_request_channel(), falling
	  back to CONFIG_DMA_CONCURRENT_CHANNEL_NR + index), configured, then
	  started together, so every channel is in flight at the same time.

config DMA_CONCURRENT_XFER_SIZE
	int "Number of bytes per block"
	default 64

config DMA_CONCURRENT_BURST_LEN
	int "Source and destination burst length"
	default 1

config DMA_CONCURRENT_TIMEOUT_MS
	int "Per-transfer completion timeout in milliseconds"
	default 2000
```

## tests/drivers/dma/error_handling/Kconfig
```kconfig
# SPDX-License-Identifier: Apache-2.0

mainmenu "DMA Error Handling Test"

source "Kconfig.zephyr"

config TEST_DMA_ERROR_HANDLING
	bool "Test DMA error handling"
	default y
	depends on DMA && DMA_EMUL
```

## tests/drivers/dma/loop_transfer/boards/frdm_imxrt1152.conf
```kconfig
# SPDX-FileCopyrightText: Copyright 2026 NXP
# SPDX-License-Identifier: Apache-2.0

CONFIG_CODE_DATA_RELOCATION=y
CONFIG_DMA_LOOP_TRANSFER_RELOCATE_SECTION="DTCM"
```
