/*
 * Copyright (c) 2025 Alexander Kozhinov <ak.alexander.kozhinov@gmail.com>
 * SPDX-License-Identifier: Apache-2.0
 */

&opamp2 {
	st,pmos-trimming-value = <0x11>;
	st,nmos-trimming-value = <0x07>;
};
