/*
 * Copyright (c) 2026 Texas Instruments Incorporated
 * SPDX-License-Identifier: Apache-2.0
 */

/ {
	zephyr,user {
		opamp = <&pga0>;
	};
};

&pga0 {
	programmable-gain = "OPAMP_GAIN_1",
			    "OPAMP_GAIN_2",
			    "OPAMP_GAIN_4",
			    "OPAMP_GAIN_8",
			    "OPAMP_GAIN_16",
			    "OPAMP_GAIN_32",
			    "OPAMP_GAIN_64";
	ti,pmux-input = "inp0";
	ti,nmux-input = "rtap";
	ti,mmux-input = "non-inverting";
	ti,output-to-pin;
	status = "okay";
};
