## CMakeLists.txt
```
# SPDX-FileCopyrightText: Copyright The Zephyr Project Contributors
# SPDX-License-Identifier: Apache-2.0

cmake_minimum_required(VERSION 3.28.0)
find_package(Zephyr REQUIRED HINTS $ENV{ZEPHYR_BASE})
project(uart_console_newline)

target_sources(app PRIVATE src/main.c)
```

## prj.conf
```kconfig
# SPDX-FileCopyrightText: Copyright The Zephyr Project Contributors
# SPDX-License-Identifier: Apache-2.0

CONFIG_SERIAL=y
CONFIG_EMUL=y
CONFIG_UART_EMUL=y
CONFIG_CONSOLE=y
CONFIG_PRINTK=y
CONFIG_UART_CONSOLE=y
CONFIG_POSIX_AEP_CHOICE_BASE=y
CONFIG_POSIX_DEVICE_IO=y
```

## app.overlay
```dts
/*
 * SPDX-FileCopyrightText: Copyright The Zephyr Project Contributors
 * SPDX-FileCopyrightText: Copyright (c) 2026 Ziyou Wang
 *
 * SPDX-License-Identifier: Apache-2.0
 *
 * The console is routed to an emulated UART so the bytes produced by
 * console_out() can be inspected from the test. The board UART stays enabled
 * and is used to report the verdict, which is what twister reads.
 */

/ {
	chosen {
		zephyr,console = &emul_uart;
	};

	emul_uart: uart-emul0 {
		compatible = "zephyr,uart-emul";
		current-speed = <0>;
		rx-fifo-size = <256>;
		tx-fifo-size = <256>;
		status = "okay";
	};
};
```

## src/main.c
```c
/*
 * SPDX-FileCopyrightText: Copyright The Zephyr Project Contributors
 * SPDX-FileCopyrightText: Copyright (c) 2026 Ziyou Wang
 *
 * SPDX-License-Identifier: Apache-2.0
 */

#include <zephyr/kernel.h>
#include <zephyr/device.h>
#include <zephyr/drivers/uart.h>
#include <zephyr/drivers/serial/uart_emul.h>
#include <unistd.h>

#define STDOUT_FD 1

static const struct device *const report_dev = DEVICE_DT_GET(DT_NODELABEL(uart0));

static void report(const char *s)
{
	while (*s != '\0') {
		uart_poll_out(report_dev, (uint8_t)*s);
		s++;
	}
}

int main(void)
{
	const struct device *const console_dev = DEVICE_DT_GET(DT_CHOSEN(zephyr_console));
	const uint8_t expected[] = {'A', '\r', '\n'};
	uint8_t buf[ARRAY_SIZE(expected)];

	if (!device_is_ready(report_dev)) {
		return 0;
	}

	if (!device_is_ready(console_dev)) {
		report("CONSOLE-NEWLINE-FAIL\n");
		return 0;
	}

	(void)uart_emul_flush_tx_data(console_dev);

	/*
	 * The libc bulk write path must hand the LF to console_out() untouched,
	 * and console_out() adds the CR. The wire therefore carries exactly one
	 * CR LF, not CR CR LF.
	 */
	if (write(STDOUT_FD, "A\n", 2) != 2) {
		report("CONSOLE-NEWLINE-FAIL\n");
		return 0;
	}

	if (uart_emul_get_tx_data(console_dev, buf, sizeof(buf)) != sizeof(buf)) {
		report("CONSOLE-NEWLINE-FAIL\n");
		return 0;
	}

	for (size_t i = 0; i < ARRAY_SIZE(expected); i++) {
		if (buf[i] != expected[i]) {
			report("CONSOLE-NEWLINE-FAIL\n");
			return 0;
		}
	}

	report("CONSOLE-NEWLINE-PASS\n");
	return 0;
}
```
