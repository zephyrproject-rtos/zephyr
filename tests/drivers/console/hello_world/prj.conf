## CMakeLists.txt
```
# SPDX-License-Identifier: Apache-2.0

cmake_minimum_required(VERSION 3.28.0)
find_package(Zephyr REQUIRED HINTS $ENV{ZEPHYR_BASE})

project(console)

FILE(GLOB app_sources src/*.c)
target_sources(app PRIVATE ${app_sources})
```

## prj.conf
```kconfig
CONFIG_TEST=y
CONFIG_CONSOLE=y
```

## boards/pocketbeagle_2_mspm0l1105.conf
```kconfig
# Enable Console
CONFIG_SERIAL=y
CONFIG_UART_CONSOLE=y
```

## boards/pocketbeagle_2_mspm0l1105.overlay
```dts
/*
 * Copyright (c) 2025 Ayush Singh, BeagleBoard.org Foundation
 *
 * SPDX-License-Identifier: Apache-2.0
 *
 * P1_25 = UART TX
 * P1_27 = UART RX
 */

/ {
	chosen {
		zephyr,console = &uart0;
	};
};

&uart0 {
	status = "okay";
	pinctrl-names = "default";
	pinctrl-0 = <&uart0_rx_pa26 &uart0_tx_pa25>;
};
```

## src/main.c
```c
/*
 * Copyright (c) 2020 Stephanos Ioannidis <root@stephanos.io>
 *
 * SPDX-License-Identifier: Apache-2.0
 */

#include <stdio.h>

int main(void)
{
	printf("Hello World from Console\n");
	return 0;
}
```
