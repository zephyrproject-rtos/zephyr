/*
 * Copyright (c) 2019, NXP
 *
 * SPDX-License-Identifier: Apache-2.0
 */

/ {
	resources {
		compatible = "test-gpio-basic-api";
		out-gpios = <&gpio0 8 0>; /* Arduino D0 */
		in-gpios = <&gpio0 9 0>;  /* Arduino D1 */
	};
};
