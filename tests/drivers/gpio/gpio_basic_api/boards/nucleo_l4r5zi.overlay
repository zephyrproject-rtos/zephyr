/*
 * Copyright (c) 2020 STMicroelectronics.
 *
 * SPDX-License-Identifier: Apache-2.0
 */

/ {
	resources {
		compatible = "test-gpio-basic-api";
		out-gpios = <&arduino_header 6 0>; /* Arduino D0 */
		in-gpios = <&arduino_header 7 0>;  /* Arduino D1 */
	};
};
