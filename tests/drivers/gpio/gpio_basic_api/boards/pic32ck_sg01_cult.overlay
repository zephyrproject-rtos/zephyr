/*
 * Copyright (c) 2026 Microchip Technology Inc.
 *
 * SPDX-License-Identifier: Apache-2.0
 */

/*connect the PA04 to PA05 for the test*/

/ {
	resources {
		compatible = "test-gpio-basic-api";
		out-gpios = <&porta 5 0>; /* EXT1.5 */
		in-gpios = <&porta 4 0>;  /* EXT1.4 */
	};
};

&porta {
	status = "okay";
};
