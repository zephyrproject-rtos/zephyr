/*
 * Copyright (c) 2020 STMicroelectronics.
 *
 * SPDX-License-Identifier: Apache-2.0
 */

/ {
	resources {
		compatible = "test,gpio_basic_api";
		out-gpios = <&arduino_header 4 0>; /* Arduino A4 */
		in-gpios = <&arduino_header 5 0>;  /* Arduino A5 */
	};
};
