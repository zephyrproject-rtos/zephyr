/*
 * Copyright (c) 2026 Microchip Technology Inc.
 *
 * SPDX-License-Identifier: Apache-2.0
 */

/* Connect PA12 and PA13 */

/ {
	resources {
		compatible = "test-gpio-basic-api";
		out-gpios = <&porta 12 0>;  /* EXT2.5 */
		in-gpios = <&porta 13 0>; /* EXT2.6 */
	};
};
