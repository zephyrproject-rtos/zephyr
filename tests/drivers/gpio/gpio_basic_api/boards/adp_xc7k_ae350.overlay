/*
 * Copyright (c) 2021 Andes Technology Corporation
 *
 * SPDX-License-Identifier: Apache-2.0
 */

/ {
	resources {
		compatible = "test-gpio-basic-api";
		status = "okay";
		out-gpios = <&gpio0 7 GPIO_ACTIVE_HIGH>;
		in-gpios = <&gpio0 8 GPIO_ACTIVE_HIGH>;
	};
};
