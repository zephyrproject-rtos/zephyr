/*
 * Copyright (c) 2025 Renesas Electronics Corporation
 * SPDX-License-Identifier: Apache-2.0
 */

/ {
	resources {
		compatible = "test-gpio-basic-api";
		out-gpios = <&gpio8 0 GPIO_ACTIVE_HIGH>;
		in-gpios = <&gpio8 1 GPIO_ACTIVE_HIGH>;
	};
};

&gpio {
	status = "okay";
};

&gpio8 {
	irqs = <1 24>;
	status = "okay";
};
