/*
 * Copyright (c) 2026 Jonathan Elliot Peace <jep@alphabetiq.com>
 *
 * SPDX-License-Identifier: Apache-2.0
 */

#include <zephyr/dt-bindings/gpio/gpio.h>

/ {
	resources {
		compatible = "test-gpio-basic-api";
		out-gpios = <&gpio0 5 GPIO_ACTIVE_HIGH>;
		in-gpios = <&gpio0 6 GPIO_ACTIVE_HIGH>;
	};
};
