/*
 * Copyright (c) 2023 Cypress Semiconductor Corporation.
 * SPDX-License-Identifier: Apache-2.0
 */

/ {
	resources {
		compatible = "test-gpio-basic-api";
		out-gpios = <&gpio_prt13 0 0>;
		in-gpios = <&gpio_prt13 1 0>;
	};
};

&gpio_prt13 {
	status = "okay";
};
