/*
 * Copyright NXP 2024
 *
 * SPDX-License-Identifier: Apache-2.0
 */

/ {
	resources {
		compatible = "test-gpio-basic-api";
		out-gpios = <&fgpioa 14 0>; /* J1-16 */
		in-gpios  = <&fgpioa 17 0>; /* J1-14 */
	};
};

&fgpioa{
	status = "okay";
};
