/*
 * Copyright (c) 2025 Renesas Electronics Corporation
 * SPDX-License-Identifier: Apache-2.0
 */

/ {
	resources {
		compatible = "test-gpio-basic-api";
		out-gpios = <&gpio8 0 GPIO_ACTIVE_HIGH>;
		in-gpios = <&gpio8 1 GPIO_ACTIVE_HIGH>;
	};
};

&tint24 {
	status = "okay";
};

&gpio8 {
	irqs = <&tint24 1>;
	status = "okay";
};
