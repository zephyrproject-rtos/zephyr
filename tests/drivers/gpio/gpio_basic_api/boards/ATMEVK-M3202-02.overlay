/*
 * Copyright (c) 2023 Atmosic
 *
 * SPDX-License-Identifier: Apache-2.0
 */

/ {
    resources {
	compatible = "test-gpio-basic-api";
	status = "okay";
	out-gpios = <&gpio0 11 GPIO_ACTIVE_HIGH>; /* P11 */
	in-gpios = <&gpio0 9 GPIO_ACTIVE_HIGH>;  /* P9 */
    };
};
