/*
 * Copyright (c) 2019, 2024 NXP
 *
 * SPDX-License-Identifier: Apache-2.0
 */

/* loopback with arduino header A0 and A1 */

/ {
	resources {
		compatible = "test-gpio-basic-api";
		out-gpios = <&arduino_header 0 (GPIO_ACTIVE_HIGH | GPIO_PUSH_PULL | GPIO_PULL_UP)>;
		in-gpios  = <&arduino_header 1 (GPIO_ACTIVE_HIGH | GPIO_PUSH_PULL | GPIO_PULL_UP)>;
	};
};
