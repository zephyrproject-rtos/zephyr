/*
 * Copyright (c) 2025 Atmosic
 *
 * SPDX-License-Identifier: Apache-2.0
 */

/ {
    resources {
	compatible = "test-gpio-basic-api";
	status = "okay";
	out-gpios = <&gpio0 2 GPIO_ACTIVE_HIGH>; /* P2 */
	in-gpios = <&gpio0 3 GPIO_ACTIVE_HIGH>;  /* P3 */
    };
};
