/*
 * Copyright (c) 2019 Nordic Semiconductor ASA
 *
 * SPDX-License-Identifier: Apache-2.0
 */

/ {
	resources {
		compatible = "test-gpio-basic-api";
		out-gpios = <&gpio1 23 0>; /* Arduino D0 */
		in-gpios = <&gpio1 22 0>;  /* Arduino D1 */
	};
};
