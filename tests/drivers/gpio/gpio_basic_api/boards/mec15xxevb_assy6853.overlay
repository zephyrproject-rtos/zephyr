/*
 * Copyright (c) 2019 Intel Corporation
 * Copyright (c) 2019 Nordic Semiconductor ASA
 *
 * SPDX-License-Identifier: Apache-2.0
 */

/ {
	resources {
		compatible = "test-gpio-basic-api";

		/*
		 * Remove jumpers on JP31 to disconnect pull-up resistor.
		 * Also remove jumpers on JP41 (1-2, 3-4) as the LEDs
		 * are connected to pull-up resistors also.
		 */
		in-gpios  = <&gpio_140_176 14 0>; /* GPIO_156, JP31 Pin 13 */
		out-gpios = <&gpio_140_176 15 0>; /* GPIO_157, JP31 Pin 15 */
	};
};
