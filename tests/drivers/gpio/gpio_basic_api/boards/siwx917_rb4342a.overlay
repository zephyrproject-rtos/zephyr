/*
 * Copyright (c) 2025 Silicon Laboratories Inc.
 *
 * SPDX-License-Identifier: Apache-2.0
 */

/ {
	resources {
		compatible = "test-gpio-basic-api";
		out-gpios = <&gpiod 0 0>; /* WPK P28 */
		in-gpios = <&gpiod 2 0>; /* WPK P32 */
	};
};
