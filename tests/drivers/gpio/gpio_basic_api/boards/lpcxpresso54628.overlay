/*
 * Copyright The Zephyr Project Contributors
 *
 * SPDX-License-Identifier: Apache-2.0
 */

/* Loopback between Arduino D2 and D7; D7 (PIO1_22) is reachable by the PINT. */
/ {
	resources {
		compatible = "test-gpio-basic-api";
		out-gpios = <&arduino_header 8 (GPIO_ACTIVE_HIGH | GPIO_PUSH_PULL | GPIO_PULL_UP)>;
		in-gpios = <&arduino_header 13 (GPIO_ACTIVE_HIGH | GPIO_PUSH_PULL | GPIO_PULL_UP)>;
	};
};
