/*
 * Copyright (c) 2019 Nordic Semiconductor ASA
 *
 * SPDX-License-Identifier: Apache-2.0
 */

/ {
	resources {
		compatible = "test,gpio_basic_api";
		out-gpios = <&gpio1 1 0>; /* Arduino D0 */
		in-gpios = <&gpio1 2 0>;  /* Arduino D1 */
	};
};

&uart1 {
	status = "disabled";
};
