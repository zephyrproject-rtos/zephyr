/*
 * Copyright (c) 2023 Atmosic
 *
 * SPDX-License-Identifier: Apache-2.0
 */

/ {
    resources {
	compatible = "test-gpio-basic-api";
	status = "okay";
	out-gpios = <&gpio0 4 GPIO_ACTIVE_HIGH>; /* P4 */
	in-gpios = <&gpio0 5 GPIO_ACTIVE_HIGH>;  /* P5 */
    };
};
