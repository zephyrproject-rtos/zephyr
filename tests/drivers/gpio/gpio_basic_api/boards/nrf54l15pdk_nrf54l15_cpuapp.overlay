/*
 * Copyright (c) 2024 Nordic Semiconductor ASA
 *
 * SPDX-License-Identifier: Apache-2.0
 */

 / {
	resources {
		compatible = "test-gpio-basic-api";
		out-gpios = <&gpio1 10 0>;
		in-gpios = <&gpio1 11 0>;
	};
};

&gpiote20 {
    status = "okay";
};

&gpio1 {
    status = "okay";
};
