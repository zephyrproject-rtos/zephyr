/*
 * Copyright (c) 2021 ITE Corporation.
 *
 * SPDX-License-Identifier: Apache-2.0
 */

/ {
	resources {
		compatible = "test-gpio-basic-api";
		out-gpios = <&gpioa 0 0>; /* GPIOA.0 */
		in-gpios = <&gpioa 1 0>;  /* GPIOA.1 */
	};
};
