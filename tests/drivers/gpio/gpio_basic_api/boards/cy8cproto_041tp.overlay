/*
 * Copyright (c) 2026 Infineon Technologies AG
 *
 * SPDX-License-Identifier: Apache-2.0
 */

/ {
	resources {
		compatible = "test-gpio-basic-api";
		out-gpios = <&gpio_prt4 2 0>;
		in-gpios = <&gpio_prt4 3 0>;
	};
};

&gpio_prt4 {
	status = "okay";
};
