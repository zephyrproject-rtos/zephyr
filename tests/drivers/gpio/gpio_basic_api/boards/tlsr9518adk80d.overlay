/*
 * Copyright (c) 2021 Telink Semiconductor
 *
 * SPDX-License-Identifier: Apache-2.0
 */

/ {
	resources {
		compatible = "test,gpio_basic_api";
		out-gpios = <&gpioc 6 0>; /* Port C 6 */
		in-gpios = <&gpioc 7 0>;  /* Port C 7 */
	};
};
