/*
 * Copyright (c) 2021 Teslabs Engineering S.L.
 *
 * SPDX-License-Identifier: Apache-2.0
 */

/ {
	resources {
		compatible = "test-gpio-basic-api";
		/* unplug camera from JP27 and bridge D0-D1 (pins 16 and 15) */
		out-gpios = <&gpioc 6 0>; /* DCI D0 (JP27 pin 16)*/
		in-gpios = <&gpioc 7 0>; /* DCI D1 (JP27 pin 15) */
	};
};
