/*
 * Copyright (c) 2025 Renesas Electronics Corporation
 * SPDX-License-Identifier: Apache-2.0
 */

/ {
	resources {
		compatible = "test-gpio-basic-api";
		out-gpios = <&gpio5 3 GPIO_ACTIVE_HIGH>;
		in-gpios = <&gpio5 0 GPIO_ACTIVE_HIGH>;
	};
};

&tint15 {
	status = "okay";
};

&gpio5 {
	irqs = <&tint15 0>;
	status = "okay";
};
