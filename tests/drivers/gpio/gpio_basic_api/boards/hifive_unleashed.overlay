/*
 * Copyright (c) 2021 Katsuhiro Suzuki
 *
 * SPDX-License-Identifier: Apache-2.0
 */

/ {
	resources {
		compatible = "test-gpio-basic-api";
		out-gpios = <&gpio0 0 0>; /* GPIO-A */
		in-gpios = <&gpio0 1 0>;  /* GPIO-B */
	};
};
