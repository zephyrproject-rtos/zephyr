/*
 * Copyright (c) 2025 Renesas Electronics Corporation
 * SPDX-License-Identifier: Apache-2.0
 */

/ {
	resources {
		compatible = "test-gpio-basic-api";
		out-gpios = <&gpio1 3 GPIO_ACTIVE_HIGH>;
		in-gpios = <&gpio1 4 GPIO_ACTIVE_HIGH>;
	};
};

&gpio {
	status = "okay";
};

&gpio1 {
	irqs = <4 20>;
	status = "okay";
};
