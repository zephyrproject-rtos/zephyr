/*
 * Copyright (c) 2023-2025 Analog Devices, Inc.
 *
 * SPDX-License-Identifier: Apache-2.0
 */

/ {
	resources {
		compatible = "test-gpio-basic-api";
		out-gpios = <&gpio0 7 0>;
		in-gpios = <&gpio0 8 0>;
	};
};
