/*
 * Copyright (c) 2019 Intel Corporation
 * Copyright (c) 2019 Nordic Semiconductor ASA
 *
 * SPDX-License-Identifier: Apache-2.0
 */

/ {
	resources {
		compatible = "test,gpio_basic_api";
		out-gpios = <&gpio0 18 0>; /* Pmod3 pin 9  */
		in-gpios = <&gpio0 19 0>;  /* Pmod3 pin 10 */
	};
};
