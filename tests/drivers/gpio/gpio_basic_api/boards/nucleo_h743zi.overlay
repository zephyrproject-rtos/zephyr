/*
 * Copyright (c) 2020 STMicroelectronics.
 *
 * SPDX-License-Identifier: Apache-2.0
 */

/ {
	resources {
		compatible = "test-gpio-basic-api";
		out-gpios = <&arduino_header 10 0>; /* Arduino D4 */
		in-gpios = <&arduino_header 11 0>;  /* Arduino D5 */
	};
};
