/*
 * Copyright (c) 2021, Antmicro <www.antmicro.com>
 *
 * SPDX-License-Identifier: Apache-2.0
 */

/ {
	resources {
		compatible = "test-gpio-basic-api";
		out-gpios = <&gpio 2 0>; /* Header J8 - pin 6 */
		in-gpios = <&gpio 0 0>;  /* Header J8 - pin 10 */
	};
};
