/*
 * Copyright (c) 2026 Intel Corporation
 *
 * SPDX-License-Identifier: Apache-2.0
 */
/*
 * Connect loopback between GPP_C_8 and GPP_C_9.
 * BIOS settings to mark these two pins as GPIO
 * Under Intel Advanced Menu > PCH-IO Configuration
 * Enable Timed GPIO0 > Disable
 * Enable Timed GPIO1 > Disable
 */

&gpio_c {
	status = "okay";
};

/ {
	resources {
		compatible = "test-gpio-basic-api";

		out-gpios = <&gpio_c 8 0>;
		in-gpios = <&gpio_c 9 0>;
	};
};
