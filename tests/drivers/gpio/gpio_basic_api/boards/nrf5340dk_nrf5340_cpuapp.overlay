/*
 * Copyright (c) 2026 Nordic Semiconductor ASA
 *
 * SPDX-License-Identifier: Apache-2.0
 */

/ {
	resources {
		compatible = "test-gpio-basic-api";
		out-gpios = <&gpio0 6 0>;
		in-gpios = <&gpio0 7 0>;
	};
};

&gpio0 {
	status = "okay";
};
