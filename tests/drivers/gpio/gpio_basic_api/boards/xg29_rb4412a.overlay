/*
 * Copyright (c) 2025 Silicon Laboratories Inc.
 *
 * SPDX-License-Identifier: Apache-2.0
 */

/*
 * Connect EXP4 (PC0) and EXP6 (PC1) of the Expansion Pin header
 */

/ {
	resources {
		compatible = "test-gpio-basic-api";
		out-gpios = <&gpioc 0 0>; /* WPK EXP4 (PC0) */
		in-gpios = <&gpioc 1 0>; /* WPK EXP6 (PC1) */
	};
};
