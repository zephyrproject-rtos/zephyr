/*
 * Copyright (c) 2021 Nuvoton Technology Corporation.
 *
 * SPDX-License-Identifier: Apache-2.0
 */

/ {
	resources {
		compatible = "test-gpio-basic-api";
		out-gpios = <&gpioh 2 0>; /* GPIO header A12 */
		in-gpios = <&gpioh 1 0>;  /* GPIO header B12 */
	};
};
