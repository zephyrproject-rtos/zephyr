/*
 * Copyright (c) 2025 Silicon Laboratories Inc.
 *
 * SPDX-License-Identifier: Apache-2.0
 */

/ {
	resources {
		compatible = "test-gpio-basic-api";
		out-gpios = <&uulpgpio 0 0>; /* WPK P14 */
		in-gpios = <&uulpgpio 3 0>; /* WPK P18 */
	};
};
