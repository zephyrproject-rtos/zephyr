/*
 * Copyright (c) 2024 Renesas Electronics Corporation
 * SPDX-License-Identifier: Apache-2.0
 */

/ {
	resources {
		compatible = "test-gpio-basic-api";
		out-gpios = <&gpio8 2 GPIO_ACTIVE_HIGH>;
		in-gpios = <&gpio8 3 GPIO_ACTIVE_HIGH>;
	};
};

&gpio {
	status = "okay";
};

&gpio8 {
	irqs = <3 20>;
	status = "okay";
};
