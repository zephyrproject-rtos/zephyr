/*
 * Copyright (c) 2025 Infineon Technologies AG, or an affiliate of
 * Infineon Technologies AG.
 *
 * SPDX-License-Identifier: Apache-2.0
 */

/ {
	resources {
		compatible = "test-gpio-basic-api";
		out-gpios = <&gpio_prt4 0 0>;
		in-gpios = <&gpio_prt4 1 0>;
	};
};

&gpio_prt4 {
	status = "okay";
};
