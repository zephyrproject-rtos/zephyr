/*
 * Copyright (c) 2025 Silicon Laboratories Inc.
 *
 * SPDX-License-Identifier: Apache-2.0
 */

/ {
	resources {
		compatible = "test-gpio-basic-api";
		out-gpios = <&gpiob 10 0>; /* Breakout Pad 5 */
		in-gpios = <&gpiob 11 0>; /* Breakout Pad 7 */
	};
};
