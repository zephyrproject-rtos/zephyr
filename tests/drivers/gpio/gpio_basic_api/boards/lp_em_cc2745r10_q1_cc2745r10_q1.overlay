/*
 * Copyright (c) 2026 Texas Instruments Incorporated
 *
 * SPDX-License-Identifier: Apache-2.0
 */

/ {
	resources {
		compatible = "test-gpio-basic-api";
		/* Use DIO4 and DIO12 for GPIO loopback testing */
		out-gpios = <&gpio0 4 0>;  /* DIO4 */
		in-gpios = <&gpio0 12 0>;  /* DIO12 */
	};
};
