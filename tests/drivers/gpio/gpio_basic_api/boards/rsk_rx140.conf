## tests/drivers/gpio/gpio_basic_api/boards/stm32mp157c_dk2.conf
```kconfig
# Copyright (c) 2019 Linaro Limited
# SPDX-License-Identifier: Apache-2.0

CONFIG_RAM_CONSOLE_BUFFER_SIZE=80000
```

## tests/drivers/gpio/gpio_basic_api/dts/bindings/test-gpio-basic-api.yaml
```yaml
#
# Copyright (c) 2019 Nordic Semiconductor ASA
#
# SPDX-License-Identifier: Apache-2.0
#

description: |
    This binding provides resources required to build and run the
    tests/drivers/gpio/gpio_basic_api test in Zephyr.

compatible: "test-gpio-basic-api"

properties:
  out-gpios:
    type: phandle-array
    required: true
    description: |
      Identity of a GPIO that will be configured as an output.  This
      must be on the same device as in-gpios, and physically
      connected to in-gpios.

  in-gpios:
    type: phandle-array
    required: true
    description: |
      Identity of a GPIO that will be configured as an input.  This
      must be on the same device as out-gpios,and physically
      connected to out-gpios.
```

## tests/drivers/gpio/gpio_basic_api/testcase.yaml
```yaml
common:
  tags:
    - drivers
    - gpio
  depends_on: gpio
  harness: ztest
  harness_config:
    fixture: gpio_loopback

tests:
  drivers.gpio.2pin:
    min_flash: 34
    filter: dt_compat_enabled("test-gpio-basic-api") and not dt_compat_enabled("arduino-header-r3")

  drivers.gpio.nrf_sense_edge:
    platform_allow:
      - nrf52840dk/nrf52840
      - nrf52_bsim
      - nrf5340bsim/nrf5340/cpuapp
      - nrf5340bsim/nrf5340/cpunet
      - nrf54l15bsim/nrf54l15/cpuapp
    integration_platforms:
      - nrf52840dk/nrf52840
    extra_args: "DTC_OVERLAY_FILE=boards/nrf52840dk_nrf52840.overlay;\
                 boards/nrf52840dk_nrf52840_sense_edge.overlay"

  drivers.gpio.mr_canhubk3_wkpu:
    platform_allow: mr_canhubk3
    extra_args: "DTC_OVERLAY_FILE=boards/mr_canhubk3_wkpu.overlay"

  drivers.gpio.2pin_ke17z_fgpio:
    min_flash: 34
    filter: dt_compat_enabled("test-gpio-basic-api")
    platform_allow:
      - frdm_ke17z
      - frdm_ke17z512
    extra_args: "DTC_OVERLAY_FILE=boards/frdm_ke17z_fgpio.overlay"
    harness_config:
      fixture: fgpio_loopback

  drivers.gpio.2pin_arduino:
    min_flash: 34
    depends_on:
      - gpio
      - arduino_gpio
    filter: >
      dt_compat_enabled("test-gpio-basic-api") and dt_compat_enabled("arduino-header-r3")
      and not CONFIG_SOC_FAMILY_STM32
    extra_args: "DTC_OVERLAY_FILE=arduino_D2D3.overlay"
    extra_configs:
      - CONFIG_SKIP_PULL_TEST=y
    integration_platforms:
      - frdm_k64f
    platform_exclude:
      # below boards are customized
      - mimxrt595_evk/mimxrt595s/cm33
      - mimxrt1020_evk
      - mimxrt1040_evk
      - mimxrt1060_evk@A/mimxrt1062/qspi
      - mimxrt1060_evk@B/mimxrt1062/qspi
      - mimxrt1060_evk@C/mimxrt1062/qspi
      - lpcxpresso55s69/lpc55s69/cpu0
      - lpcxpresso55s36
  drivers.gpio.2pin_arduino_customized:
    min_flash: 34
    depends_on:
      - gpio
      - arduino_gpio
    filter: dt_compat_enabled("test-gpio-basic-api") and dt_compat_enabled("arduino-header-r3")
    platform_allow:
      - mimxrt595_evk/mimxrt595s/cm33
      - mimxrt1020_evk
      - mimxrt1040_evk
      - mimxrt1060_evk/mimxrt1062/qspi
      - lpcxpresso55s69/lpc55s69/cpu0
      - lpcxpresso55s36
      - nucleo_wb09ke
      - nucleo_wb05kz
      - nucleo_wba55cg
    integration_platforms:
      - mimxrt595_evk/mimxrt595s/cm33
  drivers.gpio.st_2pin_arduino:
    min_flash: 34
    depends_on:
      - gpio
      - arduino_gpio
    filter: >
      dt_compat_enabled("test-gpio-basic-api") and dt_compat_enabled("arduino-header-r3")
      and CONFIG_SOC_FAMILY_STM32
    extra_args: "DTC_OVERLAY_FILE=arduino_D9D10.overlay"
    integration_platforms:
      - disco_l475_iot1
    platform_exclude:
      # below boards need customized
      - nucleo_wb05kz
      - nucleo_wb09ke
      - nucleo_wba55cg
  drivers.gpio.2pin_aw9523b:
    depends_on:
      - gpio
      - arduino_gpio
      - i2c
      - arduino_i2c
    harness_config:
      fixture: aw9523b_on_arduino_header
    filter: dt_compat_enabled("test-gpio-basic-api") and dt_compat_enabled("arduino-header-r3") and
            dt_nodelabel_enabled("arduino_i2c")
    extra_dtc_overlay_files:
      - boards/aw9523b_on_arduino_header.overlay
```

## tests/drivers/gpio/gpio_enable_disable_interrupt/testcase.yaml
```yaml
tests:
  drivers.gpio.enable_disable_interrupt:
    tags:
      - drivers
      - gpio
    depends_on: gpio
    filter: dt_compat_enabled("test-gpio-enable-disable-interrupt")
```

## tests/drivers/gpio/gpio_fast_api/dts/bindings/test-gpio-fast-api.yaml
```yaml
# SPDX-FileCopyrightText: Copyright (c) 2026 Perry Naseck, MIT Media Lab <pnaseck@media.mit.edu>
# SPDX-License-Identifier: Apache-2.0

description: Test node for the fast GPIO API.

compatible: "test-gpio-fast-api"

include: gpio-fast.yaml

properties:
  gpios:
    type: phandle-array
    required: true
    description: GPIO pin used for fast GPIO testing.
```

## tests/drivers/gpio/gpio_fast_oot/dts/bindings/test-gpio-fast-oot.yaml
```yaml
# SPDX-FileCopyrightText: Copyright (c) 2026 Perry Naseck, MIT Media Lab <pnaseck@media.mit.edu>
# SPDX-License-Identifier: Apache-2.0

description: Test node for the fast GPIO out-of-tree backend.

compatible: "test-gpio-fast-oot"

properties:
  gpios:
    type: phandle-array
    required: true
    description: GPIO pin used for fast GPIO out-of-tree testing.
```

## tests/drivers/gpio/gpio_get_direction/boards/nrf54h20dk_nrf54h20_cpuflpr.conf
```kconfig
# SPDX-License-Identifier: Apache-2.0

# FLPR does not support GPIO interrupts. Disabling interrupt support removes
# the driver's dependency on the (disabled-by-default) GPIOTE130 peripheral,
CONFIG_GPIO_NRFX_INTERRUPT=n
```

## tests/drivers/gpio/gpio_get_direction/testcase.yaml
```yaml
tests:
  drivers.gpio.get_direction:
    tags:
      - drivers
      - gpio
    depends_on: gpio
    min_flash: 48
    # Fix exclude when we can exclude just sim run
    platform_exclude:
      - mps2/an385
      - mps2/an521/cpu0
      - neorv32
    filter: dt_enabled_alias_with_parent_compat("led0", "gpio-leds")
```

## tests/drivers/gpio/gpio_hogs/testcase.yaml
```yaml
tests:
  drivers.gpio.hogs:
    tags:
      - drivers
      - gpio
    depends_on: gpio
    platform_allow:
      - native_sim
      - native_sim/native/64
      - frdm_k64f
      - nrf52840dk/nrf52840
      - nrf54l15dk/nrf54l15/cpuapp
      - nrf54h20dk/nrf54h20/cpuapp
      - nucleo_g474re
      - nrf52_bsim
      - nrf5340bsim/nrf5340/cpuapp
      - nrf5340bsim/nrf5340/cpunet
      - nrf54l15bsim/nrf54l15/cpuapp
      - mr_canhubk3
      - s32z2xxdc2/s32z270/rtu0
      - s32z2xxdc2/s32z270/rtu1
      - s32z2xxdc2@D/s32z270/rtu0
      - s32z2xxdc2@D/s32z270/rtu1
      - xg29_rb4412a
      - bg29_rb4420a
    integration_platforms:
      - native_sim
      - native_sim/native/64
```

## tests/drivers/gpio/gpio_irq/testcase.yaml
```yaml
# Copyright (c) 2023 Bjarki Arge Andreasen
# SPDX-License-Identifier: Apache-2.0

tests:
  drivers.gpio.irq:
    tags:
      - drivers
      - gpio
      - irq
    depends_on: gpio
    platform_allow:
      - native_sim
      - native_sim_64
    integration_platforms:
      - native_sim
      - native_sim_64
```

## tests/drivers/gpio/gpio_ite_it8xxx2_v2/testcase.yaml
```yaml
# Copyright 2023 The ChromiumOS Authors
#
# SPDX-License-Identifier: Apache-2.0

tests:
  gpio.gpio_ite_it8xxx2_v2:
    tags:
      - drivers
      - gpio
    depends_on: gpio
    platform_allow:
      - native_sim
    integration_platforms:
      - native_sim
```

## tests/drivers/gpio/gpio_nrf/testcase.yaml
```yaml
common:
  tags:
    - drivers
    - gpio
  depends_on: gpio
  harness: ztest
tests:
  drivers.gpio.gpio_nrf:
    filter: dt_compat_enabled("nordic,nrf-gpio") and dt_nodelabel_enabled("led0")
```

## tests/drivers/gpio/gpio_raw_regs/testcase.yaml
```yaml
tests:
  drivers.gpio.raw_regs:
    tags:
      - drivers
      - gpio
    depends_on: gpio
    platform_allow:
      - native_sim
```

## tests/drivers/gpio/gpio_reserved_ranges/testcase.yaml
```yaml
tests:
  drivers.gpio.reserved_ranges:
    tags:
      - drivers
      - gpio
    depends_on: gpio
    filter: dt_compat_enabled("test-gpio-reserved-ranges")
    platform_allow:
      - native_sim
      - native_sim/native/64
    integration_platforms:
      - native_sim
      - native_sim/native/64
```

## tests/drivers/gpio/gpio_retention/testcase.yaml
```yaml
tests:
  drivers.gpio.retention:
    platform_allow:
      - nucleo_f746zg
    tags: drivers gpio retention
```

## tests/drivers/gpio/gpio_simulated_level_interrupt_trigger/testcase.yaml
```yaml
tests:
  drivers.gpio.gpio_simulated_level_interrupt_trigger:
    tags:
      - drivers
      - gpio
    depends_on: gpio
    filter: dt_compat_enabled("test-gpio-simulated-level-interrupt-trigger")
    platform_allow:
      - native_sim
      - native_sim/native/64
```

## tests/drivers/hwinfo/api/testcase.yaml
```yaml
tests:
  drivers.hwinfo.api:
    platform_exclude:
      - nrf54h20dk/nrf54h20/cpuppr
    tags:
      - drivers
      - hwinfo
```

## tests/drivers/i2c/i2c_api/Kconfig
```kconfig
# Copyright (c) 2024 Renesas Electronics Corporation
# SPDX-License-Identifier: Apache-2.0

mainmenu "I2C API Test"

source "Kconfig.zephyr"

choice
	prompt "Select GY271 Sensor Type"
	default SENSOR_GY271_HMC

	config SENSOR_GY271_HMC
		bool "Use gy271 HMC type sensor"
		help
		  Use to enable the use of gy271 HMC sensor

	config SENSOR_GY271_QMC
		bool "Use gy271 QMC type sensor"
		help
		  Use to enable the use of gy271 QMC sensor

endchoice
```

## tests/drivers/i2c/i2c_api/boards/ek_ra4c1.conf
```kconfig
# Copyright (c) 2025 Renesas Electronics Corporation
# SPDX-License-Identifier: Apache-2.0

CONFIG_SENSOR_GY271_HMC=y
```

## tests/drivers/i2c/i2c_api/boards/ek_ra8p1_r7ka8p1kflcac_cm33_sci_b_i2c.conf
```kconfig
# Copyright (c) 2025 Renesas Electronics Corporation
# SPDX-License-Identifier: Apache-2.0

CONFIG_I2C=y
CONFIG_ZTEST=y
CONFIG_SENSOR_GY271_QMC=y
```

## tests/drivers/i2c/i2c_api/boards/ek_ra8t2_r7ka8t2lflcac_cm33_sci_b_i2c.conf
```kconfig
# Copyright (c) 2026 Renesas Electronics Corporation
# SPDX-License-Identifier: Apache-2.0

CONFIG_SENSOR_GY271_HMC=y
```
