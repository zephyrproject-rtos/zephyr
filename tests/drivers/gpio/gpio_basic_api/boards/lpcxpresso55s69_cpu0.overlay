/*
 * Copyright (c) 2019, NXP
 *
 * SPDX-License-Identifier: Apache-2.0
 */

/ {
	resources {
		compatible = "test,gpio_basic_api";
		out-gpios = <&gpio0 16 0>; /* Arduino A0 */
		in-gpios  = <&gpio0 23 0>; /* Arduino A1 */
	};
};
