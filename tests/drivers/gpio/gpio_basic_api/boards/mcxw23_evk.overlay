/*
 * Copyright 2025 NXP
 *
 * SPDX-License-Identifier: Apache-2.0
 */

/* loopback with arduino header D10 and D13
 * To test this sample, connect J24_3 to J24_6 on mcxw23_evk
 */

/ {
	resources {
		compatible = "test-gpio-basic-api";
		status = "okay";
		out-gpios = <&arduino_header 19 (GPIO_ACTIVE_HIGH | GPIO_PUSH_PULL | GPIO_PULL_UP)>;
		in-gpios = <&arduino_header 16 (GPIO_ACTIVE_HIGH | GPIO_PUSH_PULL | GPIO_PULL_UP)>;
	};
};
