/*
 * Copyright (c) 2026 Texas Instruments Incorporated
 *
 * SPDX-License-Identifier: Apache-2.0
 */

/ {
	resources {
		compatible = "test-gpio-basic-api";
		/* Use DIO17 and DIO18 for GPIO loopback testing */
		out-gpios = <&gpio0 17 0>;  /* DIO17 */
		in-gpios = <&gpio0 18 0>;  /* DIO18 */
	};
};
