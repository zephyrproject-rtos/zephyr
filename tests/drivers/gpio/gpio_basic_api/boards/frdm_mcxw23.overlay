/*
 * Copyright 2025 NXP
 *
 * SPDX-License-Identifier: Apache-2.0
 */

/* loopback with arduino header D12 and D13
 * To test this sample, connect J2_5 to J2_6 on frdm_mcxw23
 */

/ {
	resources {
		compatible = "test-gpio-basic-api";
		status = "okay";
		out-gpios = <&arduino_header 18 (GPIO_ACTIVE_HIGH | GPIO_PUSH_PULL | GPIO_PULL_UP)>;
		in-gpios = <&arduino_header 19 (GPIO_ACTIVE_HIGH | GPIO_PUSH_PULL | GPIO_PULL_UP)>;
	};
};
