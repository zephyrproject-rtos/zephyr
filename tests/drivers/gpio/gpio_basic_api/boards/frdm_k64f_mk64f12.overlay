/*
 * Copyright (c) 2019 Nordic Semiconductor ASA
 *
 * SPDX-License-Identifier: Apache-2.0
 */

/ {
	resources {
		compatible = "test-gpio-basic-api";
		out-gpios = <&gpioc 16 0>; /* Arduino D0 */
		in-gpios = <&gpioc 17 0>;  /* Arduino D1 */
	};
};
