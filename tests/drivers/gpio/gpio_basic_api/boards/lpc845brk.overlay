/*
 * Copyright (c) 2026 Aerlync Labs Inc.
 *
 * SPDX-License-Identifier: Apache-2.0
 */

#include <dt-bindings/gpio/gpio.h>

/ {
	resources {
		compatible = "test-gpio-basic-api";
		out-gpios = <&gpio0 8 0>;
		in-gpios = <&gpio0 9 0>;
	};
};
