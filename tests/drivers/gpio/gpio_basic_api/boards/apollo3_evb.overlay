/*
 * Copyright (c) 2024 Ambiq Micro Inc. <www.ambiq.com>
 *
 * SPDX-License-Identifier: Apache-2.0
 */

/ {
	resources {
		compatible = "test-gpio-basic-api";
		out-gpios = <&ambiq_header 5 0>;
		in-gpios = <&ambiq_header 6 0>;
	};
};
