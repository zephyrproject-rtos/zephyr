/*
 * Copyright (c) 2019 Linaro Limited
 *
 * SPDX-License-Identifier: Apache-2.0
 */

/ {
	resources {
		compatible = "test-gpio-basic-api";
		out-gpios = <&arduino_header 11 0>; /* Arduino D5 */
		in-gpios = <&arduino_header 12 0>;  /* Arduino D6 */
	};
};
