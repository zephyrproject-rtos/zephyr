/*
 * Copyright (c) 2024 Intel Corporation
 *
 * SPDX-License-Identifier: Apache-2.0
 */
/ {
	resources {
		compatible = "test-gpio-basic-api";

		out-gpios = <&gpio_0_i 16 0>;
		in-gpios = <&gpio_0_i 17 0>;
	};
};
