/*
 * Copyright (c) 2019 Nordic Semiconductor ASA
 *
 * SPDX-License-Identifier: Apache-2.0
 */

/ {
	resources {
		compatible = "test,gpio_basic_api";
		out-gpios = <&gpio0 12 0>; /* Arduino A4 */
		in-gpios = <&gpio0 13 0>;  /* Arduino A5 */
	};
};
