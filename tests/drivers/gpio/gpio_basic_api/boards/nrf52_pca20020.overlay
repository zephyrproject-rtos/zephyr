/*
 * Copyright (c) 2019 Nordic Semiconductor ASA
 *
 * SPDX-License-Identifier: Apache-2.0
 */

/ {
	resources {
		compatible = "test,gpio_basic_api";
		out-gpios = <&sx1509b 0 0>; /* EXT0 */
		in-gpios = <&sx1509b 1 0>;  /* EXT1 */
	};
};
