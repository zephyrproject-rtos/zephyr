/*
 * Copyright (c) 2019 Nordic Semiconductor ASA
 *
 * SPDX-License-Identifier: Apache-2.0
 */

/ {
	resources {
		compatible = "test,gpio_basic_api";
		out-gpios = <&arduino_header 6 0>; /* Arduino D0 */
		in-gpios = <&arduino_header 7 0>;  /* Arduino D1 */
	};
};
