/*
 * Copyright (c) 2024 NXP
 *
 * SPDX-License-Identifier: Apache-2.0
 */

/* loopback with arduino header D9 and D10 */

/ {
	resources {
		compatible = "test-gpio-basic-api";
		status = "okay";
		out-gpios = <&arduino_header 15 (GPIO_ACTIVE_HIGH | GPIO_PUSH_PULL | GPIO_PULL_UP)>;
		in-gpios = <&arduino_header 16 (GPIO_ACTIVE_HIGH | GPIO_PUSH_PULL | GPIO_PULL_UP)>;
	};
};
