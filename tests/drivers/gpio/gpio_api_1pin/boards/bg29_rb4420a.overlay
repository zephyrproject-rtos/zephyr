/*
 * Copyright (c) 2025 Silicon Laboratories Inc.
 *
 * SPDX-License-Identifier: Apache-2.0
 */

/ {
	resources {
		compatible = "test-gpio-external-pulldown";
		gpios = <&gpioc 6 GPIO_ACTIVE_HIGH>;
	};
};
