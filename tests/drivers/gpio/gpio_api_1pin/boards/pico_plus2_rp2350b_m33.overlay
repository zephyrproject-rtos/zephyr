/*
 * SPDX-License-Identifier: Apache-2.0
 *
 * Copyright (c) 2024 TOKITA Hiroshi
 */

/* Pico Plus2 is pin-compatible with the Raspberry Pi Pico 2, so reuse. */
#include "rpi_pico2_rp2350a_m33.overlay"
