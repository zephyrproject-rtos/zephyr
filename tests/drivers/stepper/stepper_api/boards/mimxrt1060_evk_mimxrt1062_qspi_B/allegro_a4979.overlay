/*
 * SPDX-FileCopyrightText: Copyright (c) 2025 Navimatix GmbH
 * SPDX-License-Identifier: Apache-2.0
 */

#include <zephyr/dt-bindings/gpio/gpio.h>

/ {
	aliases {
		stepper =  &allegro_a4979;
	};
};

/ {
	allegro_a4979: allegro_a4979{
		status = "okay";
		compatible = "allegro,a4979";

		dir-gpios = <&arduino_header 9 0>; /* D3 */
		step-gpios = <&arduino_header 10 0>; /* D4 */
		reset-gpios = <&arduino_header 8 0>; /* D2 */
		en-gpios  = <&arduino_header 11 0>; /* D5 */
		m0-gpios = <&arduino_header 12 0>; /* D6 */
		m1-gpios = <&arduino_header 13 0>; /* D7 */
		counter = <&pit0_channel0>;
	};
};

&pit0_channel0 {
	status = "okay";
};
