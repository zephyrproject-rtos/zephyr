/*
 * Copyright (c) 2025 Jilay Sandeep Pandya
 * SPDX-License-Identifier: Apache-2.0
 */

#include "native_sim.overlay"

/ {
	aliases {
		stepper = &zephyr_h_bridge_stepper;
	};
};

/ {
	zephyr_h_bridge_stepper: zephyr_h_bridge_stepper {
		compatible = "zephyr,h-bridge-stepper";
		status = "okay";
		micro-step-res = <1>;
		en-gpios = <&gpio1 0 0>;
		gpios = <&gpio1 0 0>,
			<&gpio2 0 0>,
			<&gpio3 0 0>,
			<&gpio4 0 0>;
	};
};
