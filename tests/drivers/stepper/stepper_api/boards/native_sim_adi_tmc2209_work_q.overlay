/*
 * Copyright (c) 2025 Josselin Bunt
 * SPDX-License-Identifier: Apache-2.0
 */

#include "native_sim.overlay"

/ {
	aliases {
		stepper = &adi_tmc2209;
	};
};

/ {
	adi_tmc2209: adi_tmc2209 {
		status = "okay";
		compatible = "adi,tmc2209";
		micro-step-res = <32>;
		dir-gpios = <&gpio1 0 0>;
		step-gpios = <&gpio1 1 0>;
		en-gpios = <&gpio2 1 0>;
		msx-gpios = <&gpio3 0 0>, <&gpio4 1 0>;
	};
};
