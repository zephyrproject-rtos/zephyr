/*
 * SPDX-FileCopyrightText: Copyright (c) 2024 Jilay Sandeep Pandya
 * SPDX-License-Identifier: Apache-2.0
 */

/ {
	test {
		#address-cells = <1>;
		#size-cells = <1>;

		test_gpio: gpio@deadbeef {
			compatible = "vnd,gpio";
			gpio-controller;
			reg = <0xdeadbeef 0x1000>;
			#gpio-cells = <0x2>;
			status = "okay";
		};
	};
};

/ {
	motor_1: motor_1 {
		compatible = "zephyr,gpio-stepper";
		status = "okay";
		micro-step-res = <1>;
		gpios = <&test_gpio 0 0>,
			<&test_gpio 0 0>,
			<&test_gpio 0 0>,
			<&test_gpio 0 0>;
	};
};
