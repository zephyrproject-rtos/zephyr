/*
 * Copyright (c) Navimatix GmbH
 * SPDX-License-Identifier: Apache-2.0
 */

#include "native_sim.overlay"

/ {
	aliases {
		stepper =  &allegro_a4979;
	};
};

/ {
	allegro_a4979: allegro_a4979 {
		status = "okay";
		compatible = "allegro,a4979";
		dir-gpios = <&gpio1 0 0>;
		step-gpios = <&gpio1 1 0>;
		reset-gpios = <&gpio2 0 0>;
		en-gpios = <&gpio2 1 0>;
		m0-gpios = <&gpio3 0 0>;
		m1-gpios = <&gpio3 1 0>;
		counter = <&counter0>;
	};
};
