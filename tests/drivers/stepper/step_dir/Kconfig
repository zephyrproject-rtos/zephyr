## tests/drivers/stepper/step_dir/Kconfig
```kconfig
# Copyright (c) 2024 Navimatix GmbH
# SPDX-License-Identifier: Apache-2.0

config ENTROPY_GENERATOR
	depends on ZTEST_SHUFFLE
	bool "Shuffle the order of tests and suites"
	default y

config MICRO_STEP_RESOLUTION
	int "Microstep resolution for step-dir driver tests"
	help
	  Set the microstep resolution (number of microsteps per full step)
	  for the step-dir driver tests.

config MICRO_STEP_RESOLUTION_M0
	int "Set Value for pin M0 for the given microstep resolution"

config MICRO_STEP_RESOLUTION_M1
	int "Set Value for pin M1 for the given microstep resolution"

source "Kconfig.zephyr"
```

## tests/drivers/stepper/step_dir/testcase.yaml
```yaml
# Copyright (c) 2024 Jilay Sandeep Pandya
# SPDX-License-Identifier: Apache-2.0

common:
  tags:
    - drivers
    - stepper
    - step_dir

tests:
  drivers.stepper.step_dir.adi_tmc2209:
    extra_args:
      - platform:native_sim/native/64:DTC_OVERLAY_FILE="boards/native_sim_adi_tmc2209.overlay"
    extra_configs:
      - CONFIG_MICRO_STEP_RESOLUTION=16
      - CONFIG_MICRO_STEP_RESOLUTION_M0=1
      - CONFIG_MICRO_STEP_RESOLUTION_M1=1
    platform_allow:
      - native_sim/native/64
  drivers.stepper.step_dir.allegro_a4979:
    extra_args:
      - platform:native_sim/native/64:DTC_OVERLAY_FILE="boards/native_sim_allegro_a4979.overlay"
    extra_configs:
      - CONFIG_MICRO_STEP_RESOLUTION=16
      - CONFIG_MICRO_STEP_RESOLUTION_M0=1
      - CONFIG_MICRO_STEP_RESOLUTION_M1=1
    platform_allow:
      - native_sim/native/64
  drivers.stepper.step_dir.drv84xx:
    extra_args:
      - platform:native_sim/native/64:DTC_OVERLAY_FILE="boards/native_sim_ti_drv84xx.overlay"
    extra_configs:
      - CONFIG_MICRO_STEP_RESOLUTION=8
      - CONFIG_MICRO_STEP_RESOLUTION_M0=1
      - CONFIG_MICRO_STEP_RESOLUTION_M1=1
    platform_allow:
      - native_sim/native/64
```

## tests/drivers/stepper/stepper_acceleration/testcase.yaml
```yaml
# Copyright (c) 2024 Navimatix GmbH
# SPDX-License-Identifier: Apache-2.0

common:
  tags:
    - drivers
    - stepper
    - api
tests:
  drivers.stepper.stepper_acceleration.ti_drv8424:
    tags:
      - stepper_step_dir
      - stepper_acceleration
      - stepper_step_dir_timing_counter
      - stepper_ti_drv8424
    extra_args:
      - platform:nucleo_f767zi/stm32f767xx:DTC_OVERLAY_FILE="boards/nucleo_f767zi/ti_drv8424.overlay"
      - platform:mimxrt1060_evk@B/mimxrt1062/qspi:DTC_OVERLAY_FILE="boards/mimxrt1060_evk_mimxrt1062_qspi_B/ti_drv8424.overlay"
    extra_configs:
      - CONFIG_GPIO=y
      - CONFIG_COUNTER=y
      - CONFIG_I2C=y
      - CONFIG_STEPPER_STEP_DIR_GENERATE_ISR_SAFE_EVENTS=y
    platform_allow:
      - nucleo_f767zi
      - mimxrt1060_evk@B/mimxrt1062/qspi
```

## tests/drivers/stepper/stepper_api/Kconfig
```kconfig
# Copyright (c) 2024 Josselin Bunt
# SPDX-License-Identifier: Apache-2.0

mainmenu "Stepper API Test"

source "Kconfig.zephyr"

config STEPPER_TEST_TIMING_TIMEOUT_TOLERANCE_PCT
	int "Stepper timing tolerance percentage"
	default 20
	help
	  Additional margin (%) added to step timing during test timeouts.
	  Accounts for execution and scheduling jitter.

config STEPPER_TEST_MICROSTEP_RESOLUTION
	int "Test microstep resolution"
	default 4
	help
	  Microstep resolution used to test setting the microstep resolution.
	  As not all drivers support all microstep resolutions, so this needs to be adjusted
	  on a per drvier basis.

config STEPPER_TEST_MICROSTEP_INTERVAL
	int "Microstep interval used for tests in usec"
	default 40000000
	range 1000000 1000000000
```

## tests/drivers/stepper/stepper_api/boards/mimxrt1060_evk_mimxrt1062_qspi_B.conf
```kconfig
# Copyright (c) 2024 Navimatix GmbH
# SPDX-License-Identifier: Apache-2.0

CONFIG_BASE_MS_RESOLUTION=1
CONFIG_TEST_MS_RESOLUTION=4
CONFIG_INCORRECT_MS_RESOLUTION=3
CONFIG_SPEED_STEPS=50
```

## tests/drivers/stepper/stepper_api/boards/nucleo_f767zi.conf
```kconfig
# Copyright (c) 2024 Navimatix GmbH
# SPDX-License-Identifier: Apache-2.0

CONFIG_GPIO=y
```

## tests/drivers/stepper/stepper_api/boards/qemu_x86_64.conf
```kconfig
# SPDX-FileCopyrightText: Copyright (c) 2024 Jilay Sandeep Pandya
# SPDX-License-Identifier: Apache-2.0

CONFIG_GPIO=y
CONFIG_GPIO_STEPPER=y
```

## tests/drivers/stepper/stepper_api/testcase.yaml
```yaml
# SPDX-FileCopyrightText: Copyright (c) 2024 Jilay Sandeep Pandya
# SPDX-License-Identifier: Apache-2.0

common:
  tags:
    - drivers
    - stepper
    - api
tests:
  drivers.stepper.stepper_api.gpio_step_dir:
    extra_args:
      - platform:native_sim/native/64:DTC_OVERLAY_FILE="boards/native_sim_gpio_step_dir.overlay"
    extra_configs:
      - CONFIG_GPIO=y
      - CONFIG_COUNTER=y
      - CONFIG_STEPPER_GPIO_STEPPER_GENERATE_ISR_SAFE_EVENTS=y
    platform_allow:
      - native_sim/native/64
  drivers.stepper.stepper_api.gpio_step_dir_work_q:
    extra_args:
      - platform:native_sim/native/64:DTC_OVERLAY_FILE="boards/native_sim_gpio_step_dir_workq.overlay"
    extra_configs:
      - CONFIG_GPIO=y
      - CONFIG_STEPPER_TEST_TIMING_TIMEOUT_TOLERANCE_PCT=130
    platform_allow:
      - native_sim/native/64
  drivers.stepper.stepper_api.h_bridge_stepper:
    extra_args:
      - platform:native_sim/native/64:DTC_OVERLAY_FILE="boards/native_sim_h_bridge_stepper.overlay"
    extra_configs:
      - CONFIG_GPIO=y
      - CONFIG_COUNTER=y
      - CONFIG_STEPPER_GPIO_STEPPER_GENERATE_ISR_SAFE_EVENTS=y
    platform_allow:
      - native_sim/native/64
  drivers.stepper.stepper_api.h_bridge_stepper_work_q:
    extra_args:
      - platform:native_sim/native/64:DTC_OVERLAY_FILE="boards/native_sim_h_bridge_stepper_workq.overlay"
    extra_configs:
      - CONFIG_GPIO=y
      - CONFIG_STEPPER_TEST_TIMING_TIMEOUT_TOLERANCE_PCT=130
    platform_allow:
      - native_sim/native/64
```

## tests/drivers/stepper/stepper_const_velocity/Kconfig
```kconfig
# SPDX-FileCopyrightText: Copyright (c) 2025 Navimatix GmbH
# SPDX-License-Identifier: Apache-2.0

config ZTEST_SHUFFLE
	select ENTROPY_GENERATOR
	bool "Shuffle the order of tests and suites"

config SPEED_STEPS
	int "Test speed in microsteps/s"
	default 50
	help
	  Besides being the test speed, this value is also used in several tests as the number of
	  steps to take.

source "Kconfig.zephyr"
```

## tests/drivers/stepper/stepper_const_velocity/boards/mimxrt1060_evk_mimxrt1062_qspi_B.conf
```kconfig
# SPDX-FileCopyrightText: Copyright (c) 2025 Navimatix GmbH
# SPDX-License-Identifier: Apache-2.0

CONFIG_SPEED_STEPS=50
```

## tests/drivers/stepper/stepper_const_velocity/boards/mimxrt1060_evk_mimxrt1062_qspi_C.conf
```kconfig
# Copyright (c) 2024 Navimatix GmbH
# SPDX-License-Identifier: Apache-2.0

CONFIG_SPEED_STEPS=50
```

## tests/drivers/stepper/stepper_const_velocity/boards/nucleo_g071rb.conf
```kconfig
# SPDX-FileCopyrightText: Copyright (c) 2024 Jilay Sandeep Pandya
# SPDX-License-Identifier: Apache-2.0

CONFIG_SPEED_STEPS=50
```

## tests/drivers/stepper/stepper_const_velocity/testcase.yaml
```yaml
# SPDX-FileCopyrightText: Copyright (c) 2025 Navimatix GmbH
# SPDX-License-Identifier: Apache-2.0

common:
  tags:
    - drivers
    - stepper
    - api
tests:
  drivers.stepper.stepper_const_velocity.allegro_a4979.counter:
    tags:
      - stepper_step_dir
      - stepper_const_velocity
      - stepper_step_dir_timing_counter
      - stepper_allegro_a4979
    extra_args:
      - platform:nucleo_f767zi/stm32f767xx:DTC_OVERLAY_FILE="boards/nucleo_f767zi/allegro_a4979.overlay"
      - platform:mimxrt1060_evk@B/mimxrt1062/qspi:DTC_OVERLAY_FILE="boards/mimxrt1060_evk_mimxrt1062_qspi_B/allegro_a4979.overlay"
    extra_configs:
      - CONFIG_GPIO=y
      - CONFIG_COUNTER=y
      - CONFIG_STEPPER_STEP_DIR_GENERATE_ISR_SAFE_EVENTS=y
      - CONFIG_USTEPS_PER_SECOND=50
    platform_allow:
      - nucleo_f767zi/stm32f767xx
      - mimxrt1060_evk@B/mimxrt1062/qspi
  drivers.stepper.stepper_const_velocity.adi_tmc2209.counter:
    tags:
      - stepper_step_dir
      - stepper_const_velocity
      - stepper_step_dir_timing_counter
      - stepper_adi_tmc2209
    extra_args:
      - platform:nucleo_f767zi/stm32f767xx:DTC_OVERLAY_FILE="boards/nucleo_f767zi/adi_tmc2209.overlay"
      - platform:mimxrt1060_evk@B/mimxrt1062/qspi:DTC_OVERLAY_FILE="boards/mimxrt1060_evk_mimxrt1062_qspi_B/adi_tmc2209.overlay"
    extra_configs:
      - CONFIG_GPIO=y
      - CONFIG_COUNTER=y
      - CONFIG_STEPPER_STEP_DIR_GENERATE_ISR_SAFE_EVENTS=y
      - CONFIG_USTEPS_PER_SECOND=50
    platform_allow:
      - nucleo_f767zi/stm32f767xx
      - mimxrt1060_evk@B/mimxrt1062/qspi
  drivers.stepper.stepper_const_velocity.adi_tmc2209.work:
    tags:
      - stepper_step_dir
      - stepper_const_velocity
      - stepper_step_dir_timing_work
      - stepper_adi_tmc2209
    extra_args:
      - platform:nucleo_f767zi/stm32f767xx:DTC_OVERLAY_FILE="boards/nucleo_f767zi/adi_tmc2209_workqueue.overlay"
      - platform:mimxrt1060_evk@B/mimxrt1062/qspi:DTC_OVERLAY_FILE="boards/mimxrt1060_evk_mimxrt1062_qspi_B/adi_tmc2209_workqueue.overlay"
    extra_configs:
      - CONFIG_GPIO=y
      - CONFIG_STEPPER_STEP_DIR_GENERATE_ISR_SAFE_EVENTS=y
      - CONFIG_USTEPS_PER_SECOND=50
    platform_allow:
      - nucleo_f767zi/stm32f767xx
      - mimxrt1060_evk@B/mimxrt1062/qspi
  drivers.stepper.stepper_const_velocity.ti_drv8424.counter:
    tags:
      - stepper_step_dir
      - stepper_const_velocity
      - stepper_step_dir_timing_counter
      - stepper_ti_drv8424
    extra_args:
      - platform:nucleo_f767zi/stm32f767xx:DTC_OVERLAY_FILE="boards/nucleo_f767zi/ti_drv8424.overlay"
      - platform:mimxrt1060_evk@B/mimxrt1062/qspi:DTC_OVERLAY_FILE="boards/mimxrt1060_evk_mimxrt1062_qspi_B/ti_drv8424.overlay"
    extra_configs:
      - CONFIG_GPIO=y
      - CONFIG_COUNTER=y
      - CONFIG_I2C=y
      - CONFIG_STEPPER_STEP_DIR_GENERATE_ISR_SAFE_EVENTS=y
      - CONFIG_USTEPS_PER_SECOND=50
    platform_allow:
      - nucleo_f767zi/stm32f767xx
      - mimxrt1060_evk@B/mimxrt1062/qspi
  drivers.stepper.stepper_const_velocity.ti_drv8424.work:
    tags:
      - stepper_step_dir
      - stepper_const_velocity
      - stepper_step_dir_timing_work
      - stepper_ti_drv8424
    extra_args:
      - platform:nucleo_f767zi/stm32f767xx:DTC_OVERLAY_FILE="boards/nucleo_f767zi/ti_drv8424_workqueue.overlay"
      - platform:mimxrt1060_evk@B/mimxrt1062/qspi:DTC_OVERLAY_FILE="boards/mimxrt1060_evk_mimxrt1062_qspi_B/ti_drv8424_workqueue.overlay"
    extra_configs:
      - CONFIG_GPIO=y
      - CONFIG_COUNTER=y
      - CONFIG_I2C=y
      - CONFIG_STEPPER_STEP_DIR_GENERATE_ISR_SAFE_EVENTS=y
      - CONFIG_USTEPS_PER_SECOND=50
    platform_allow:
      - nucleo_f767zi/stm32f767xx
      - mimxrt1060_evk@B/mimxrt1062/qspi
  drivers.stepper.stepper_const_velocity.zephyr_gpio_stepper:
    tags:
      - stepper_const_velocity
      - stepper_gpio_stepper
    extra_args:
      - platform:nucleo_f767zi/stm32f767xx:DTC_OVERLAY_FILE="boards/nucleo_f767zi/zephyr_gpio_stepper.overlay"
      - platform:nucleo_g071rb/stm32g071xx:DTC_OVERLAY_FILE="boards/nucleo_g071rb/zephyr_gpio_stepper.overlay"
      - platform:mimxrt1060_evk@B/mimxrt1062/qspi:DTC_OVERLAY_FILE="boards/mimxrt1060_evk_mimxrt1062_qspi_B/zephyr_gpio_stepper.overlay"
    extra_configs:
      - CONFIG_GPIO=y
      - CONFIG_USTEPS_PER_SECOND=50
    platform_allow:
      - nucleo_f767zi/stm32f767xx
      - nucleo_g071rb/stm32g071xx
      - mimxrt1060_evk@B/mimxrt1062/qspi
```

## tests/drivers/stepper/stepper_ctrl/Kconfig
```kconfig
# Copyright (c) 2024 Josselin Bunt
# SPDX-License-Identifier: Apache-2.0

mainmenu "Stepper API Test"

source "Kconfig.zephyr"

config STEPPER_TEST_TIMING_TIMEOUT_TOLERANCE_PCT
	int "Stepper timing tolerance percentage"
	default 20
	help
	  Additional margin (%) added to step timing during test timeouts.
	  Accounts for execution and scheduling jitter.

config STEPPER_STOP_SIGNAL_WAIT_TIME_MS
	int "Wait time in ms to wait for stopping to conclude"
	default 0
	help
	  Wait time in milliseconds between stop request and response
```

## tests/drivers/stepper/stepper_motor/Kconfig
```kconfig
# Copyright (c) 2024 Josselin Bunt
# SPDX-License-Identifier: Apache-2.0

mainmenu "Stepper API Test"

source "Kconfig.zephyr"

config STEPPER_TEST_TIMING_TIMEOUT_TOLERANCE_PCT
	int "Stepper timing tolerance percentage"
	default 20
	help
	  Additional margin (%) added to step timing during test timeouts.
	  Accounts for execution and scheduling jitter.
```

## tests/drivers/syscon/testcase.yaml
```yaml
# Copyright 2021 Google LLC
# SPDX-License-Identifier: Apache-2.0

tests:
  drivers.syscon:
    tags:
      - drivers
      - syscon
    harness: ztest
    platform_allow: qemu_cortex_a53
```

## tests/drivers/tee/optee/testcase.yaml
```yaml
# Copyright 2023 EPAM Systems
# SPDX-License-Identifier: Apache-2.0

tests:
  drivers.tee.optee:
    tags:
      - drivers
      - tee
      - optee
    timeout: 500
    integration_platforms:
      - native_sim/native/64
    platform_allow:
      - native_sim/native/64
```

## tests/drivers/timer/nrf_grtc_timer/testcase.yaml
```yaml
common:
  tags:
    - drivers
  timeout: 30

tests:
  drivers.timer.nrf_grtc_timer:
    platform_allow:
      - nrf54h20dk/nrf54h20/cpuapp
      - nrf54h20dk/nrf54h20/cpurad
      - nrf54h20dk/nrf54h20/cpuppr
      - nrf54l15dk/nrf54l15/cpuapp
      - nrf54l15dk/nrf54l15/cpuapp/ns
      - nrf54l15dk/nrf54l15/cpuflpr
      - nrf54l15bsim/nrf54l15/cpuapp
      - nrf54lm20dk/nrf54lm20a/cpuapp
      - nrf54lm20dk/nrf54lm20a/cpuflpr
      - ophelia4ev/nrf54l15/cpuapp
      - ophelia4ev/nrf54l15/cpuflpr
    integration_platforms:
      - nrf54lm20dk/nrf54lm20a/cpuapp
  drivers.timer.nrf_grtc_timer.no_assert:
    platform_allow:
      - nrf54h20dk/nrf54h20/cpuapp
      - nrf54h20dk/nrf54h20/cpurad
      - nrf54h20dk/nrf54h20/cpuppr
      - nrf54l15dk/nrf54l15/cpuapp
      - nrf54l15dk/nrf54l15/cpuapp/ns
      - nrf54l15dk/nrf54l15/cpuflpr
      - nrf54l15bsim/nrf54l15/cpuapp
      - nrf54lm20dk/nrf54lm20a/cpuapp
      - nrf54lm20dk/nrf54lm20a/cpuflpr
      - ophelia4ev/nrf54l15/cpuapp
      - ophelia4ev/nrf54l15/cpuflpr
    integration_platforms:
      - nrf54lm20dk/nrf54lm20a/cpuapp
    extra_configs:
      - CONFIG_ASSERT=n
  drivers.timer.nrf_grtc_timer.busy_sim:
    sysbuild: true
    extra_configs:
      - CONFIG_ASSERT=n
      - CONFIG_TEST_BUSY_SIM=y
    platform_allow:
      - nrf54h20dk/nrf54h20/cpuapp
      - nrf54l15dk/nrf54l15/cpuapp
    integration_platforms:
      - nrf54h20dk/nrf54h20/cpuapp
      - nrf54l15dk/nrf54l15/cpuapp
```

## tests/drivers/timer/nrf_rtc_timer/testcase.yaml
```yaml
tests:
  drivers.timer.nrf_rtc_timer:
    tags:
      - drivers
      - timer
    platform_allow:
      - nrf52dk/nrf52832
      - nrf52840dk/nrf52840
    integration_platforms:
      - nrf52dk/nrf52832
    extra_configs:
      - CONFIG_ZERO_LATENCY_IRQS=y

  drivers.timer.nrf_rtc_timer_no_zli:
    tags:
      - drivers
      - timer
    platform_allow:
      - nrf52dk/nrf52832
      - nrf52840dk/nrf52840
      - nrf52_bsim
      - nrf5340bsim/nrf5340/cpuapp
      - nrf5340bsim/nrf5340/cpunet
    integration_platforms:
      - nrf52dk/nrf52832
```

## tests/drivers/timer/nxp_utick_timer/boards/common.conf
```kconfig
# Copyright 2025 NXP
# SPDX-License-Identifier: Apache-2.0

CONFIG_CORTEX_M_SYSTICK=n
CONFIG_MCUX_OS_TIMER=n
```

## tests/drivers/timer/nxp_utick_timer/testcase.yaml
```yaml
common:
  filter: CONFIG_MCUX_UTICK_TIMER
  vendor_allow:
    - nxp
  tags:
    - drivers
    - timer
  timeout: 60
tests:
  drivers.timer.utick_timer:
    integration_platforms:
      - frdm_mcxa153
    platform_allow:
      - frdm_mcxa153
      - frdm_mcxn236
      - frdm_mcxn947
      - mimxrt798s/cm33_cpu0
    extra_args: EXTRA_CONF_FILE="boards/common.conf"
```
