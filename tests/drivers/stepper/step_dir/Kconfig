## tests/drivers/tisci/testcase.yaml
```yaml
# Copyright 2025 Texas Instruments Incorporated
# SPDX-License-Identifier: Apache-2.0

tests:
  drivers.tisci:
    tags:
      - drivers
      - tisci
    timeout: 500
    integration_platforms:
      - am243x_evm/am2434/r5f0_0
    platform_allow:
      - am243x_evm/am2434/r5f0_0
```

## tests/drivers/uart/uart_async_api/Kconfig
```kconfig
# Copyright (c) 2024 STMicroelectronics
#
# SPDX-License-Identifier: Apache-2.0

mainmenu "UART Async Test"

source "Kconfig.zephyr"

if DCACHE

config DT_DEFINED_NOCACHE
	bool "Enable this if a nocache region is defined in devicetree"

if DT_DEFINED_NOCACHE

config DT_DEFINED_NOCACHE_NAME
	string "Name of the nocache region defined in devicetree (uppercase)"

endif # DT_DEFINED_NOCACHE

endif # DCACHE

config TEST_LONG_BUFFER_SIZE
	int "Long buffer size"
	default 1024

config VAR_LENGTH_BUFFER_TEST_BUADRATE_LIMIT
	int "Above this UART baudrate value, var length buffer testing will be skipped"
	default 230400

config VAR_LENGTH_BUFFER_MAX_SIZE
	int "Max size of uart buffer used for testing. Testing buffer sizes from 1 to this value."
	default 10
```
