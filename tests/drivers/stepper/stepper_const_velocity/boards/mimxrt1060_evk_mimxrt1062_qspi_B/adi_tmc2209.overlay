/*
 * SPDX-FileCopyrightText: Copyright (c) 2025 Navimatix GmbH
 * SPDX-License-Identifier: Apache-2.0
 */

#include <zephyr/dt-bindings/gpio/gpio.h>

/ {
	aliases {
		stepper =  &adi_tmc2209;
	};
};

/ {
	adi_tmc2209: adi_tmc2209{
		status = "okay";
		compatible = "adi,tmc2209";

		dir-gpios = <&arduino_header 9 0>; /* D3 */
		step-gpios = <&arduino_header 10 0>; /* D4 */
		en-gpios = <&arduino_header 11 0>; /* D5 */
		msx-gpios = <&arduino_header 12 GPIO_ACTIVE_HIGH>, /* D6 */
			<&arduino_header 13 GPIO_ACTIVE_HIGH>; /* D7 */
		counter = <&pit0_channel0>;
		micro-step-res = <8>;
	};
};

&pit0_channel0 {
	status = "okay";
};
