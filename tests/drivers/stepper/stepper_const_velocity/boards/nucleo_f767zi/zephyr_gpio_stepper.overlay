/*
 * Copyright (c) 2025 Navimatix GmbH
 * SPDX-License-Identifier: Apache-2.0
 */

#include <zephyr/dt-bindings/gpio/gpio.h>

/ {
	aliases {
		stepper =  &zephyr_gpio_stepper;
	};
};

/ {

	zephyr_gpio_stepper: zephyr_gpio_stepper {
		compatible = "zephyr,gpio-stepper";
		status = "okay";
		micro-step-res = <1>;
		gpios = <&arduino_header 14 0>, /* D8 */
			<&arduino_header 15 0>, /* D9 */
			<&arduino_header 18 0>, /* D12 */
			<&arduino_header 19 0>; /* D13 */
	};
};
