/*
 * Copyright (c) 2024 Jilay Sandeep Pandya
 * SPDX-License-Identifier: Apache-2.0
 */

#include "native_sim.overlay"
#include <zephyr/dt-bindings/gpio/gpio.h>

/ {
	aliases {
		stepper = &ti_drv84xx;
	};

	ti_drv84xx: ti_drv84xx {
		status = "okay";
		compatible = "ti,drv84xx";
		sleep-gpios = <&gpio2 0 GPIO_ACTIVE_LOW>;
		en-gpios = <&gpio2 1 0>;
		m0-gpios = <&gpio3 0 0>;
		m1-gpios = <&gpio4 1 0>;
	};
};
