/*
 * Copyright (c) 2024 Fabian Blatz <fabianblatz@gmail.com>
 *
 * SPDX-License-Identifier: Apache-2.0
 */

/ {
	fake_stepper_driver: fake-stepper-driver {
		compatible = "zephyr,fake-stepper-driver";
		status = "okay";
	};

	fake_stepper_controller: fake-stepper-controller {
		compatible = "zephyr,fake-stepper-ctrl";
		status = "okay";
	};
};
