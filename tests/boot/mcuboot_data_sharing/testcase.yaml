## tests/boot/mcuboot_data_sharing/testcase.yaml
```yaml
#
# Copyright (c) 2023 Nordic Semiconductor ASA
#
# SPDX-License-Identifier: Apache-2.0
#
common:
  sysbuild: true
tests:
  bootloader.mcuboot.data.sharing:
    platform_allow:
      - nrf52840dk/nrf52840
      - apollo510_evb
      - apollo510_eb
    tags:
      - mcuboot
      - sysbuild
      - retention
```

## tests/boot/mcuboot_direct_xip/Kconfig.sysbuild
```kconfig
#
# Copyright (c) 2026 Nordic Semiconductor ASA
#
# SPDX-License-Identifier: Apache-2.0
#

config SLOT0_IMAGE_BUILD_ONLY
	bool "Slot0 image build only"

source "share/sysbuild/Kconfig"
```

## tests/boot/mcuboot_direct_xip/testcase.yaml
```yaml
#
# Copyright (c) 2026 Nordic Semiconductor ASA
#
# SPDX-License-Identifier: Apache-2.0
#

common:
  sysbuild: true
  timeout: 10
  harness: console
  platform_allow:
    - nrf52840dk/nrf52840
  integration_platforms:
    - nrf52840dk/nrf52840
  tags:
    - mcuboot
    - sysbuild
tests:
  bootloader.mcuboot.direct.xip:
    harness_config:
      type: multi_line
      regex:
        - "Starting Direct-XIP bootloader"
        - "Primary slot: version=0.0.0\\+0"
        - "Secondary slot: version=0.0.0\\+0"
        - "Image 0 loaded from the primary slot"
        - "Bootloader chainload address offset"
        - "Image version: v0.0.0"
        - "Jumping to the image slot"
        - "Hello World"
  bootloader.mcuboot.direct.xip.slot1.only:
    extra_args:
      - SB_CONFIG_SLOT0_IMAGE_BUILD_ONLY=y
    harness_config:
      type: multi_line
      regex:
        - "Starting Direct-XIP bootloader"
        - "Image 0 Primary slot: Image not found"
        - "Secondary slot: version=0.0.0\\+0"
        - "Image 0 loaded from the secondary slot"
        - "Bootloader chainload address offset"
        - "Image version: v0.0.0"
        - "Jumping to the image slot"
        - "Hello World"
```

## tests/boot/mcuboot_multiple_keys/boards/mps2_an385.conf
```kconfig
# Copyright (c) 2026 Intercreate, Inc.
#
# SPDX-License-Identifier: Apache-2.0

CONFIG_FLASH=y
CONFIG_FLASH_SIMULATOR=y

CONFIG_RETAINED_MEM=y
CONFIG_RETENTION=y
CONFIG_RETAINED_MEM_ZEPHYR_RAM=y
CONFIG_RETENTION_BOOTLOADER_INFO=y
CONFIG_RETENTION_BOOTLOADER_INFO_TYPE_MCUBOOT=y
```

## tests/boot/mcuboot_recovery_retention/boards/nrf52840dk_nrf52840_mem.conf
```kconfig
#
# Copyright (c) 2023 Nordic Semiconductor ASA
#
# SPDX-License-Identifier: Apache-2.0
#
CONFIG_RETAINED_MEM_NRF_GPREGRET=n
CONFIG_RETAINED_MEM_ZEPHYR_RAM=y
```

## tests/boot/mcuboot_recovery_retention/sysbuild/mcuboot/boards/nrf52840dk_nrf52840.conf
```kconfig
CONFIG_USE_SEGGER_RTT=n
CONFIG_NORDIC_QSPI_NOR=n
CONFIG_BOOT_VALIDATE_SLOT0=n
CONFIG_MCUBOOT_CLEANUP_ARM_CORE=n
CONFIG_BOOT_WATCHDOG_FEED=n
```

## tests/boot/mcuboot_recovery_retention/testcase.yaml
```yaml
#
# Copyright (c) 2023 Nordic Semiconductor ASA
#
# SPDX-License-Identifier: Apache-2.0
#
common:
  sysbuild: true
  timeout: 10
  harness: console
  harness_config:
    type: multi_line
    regex:
      - "mcuboot_status: 0"
      - "mcuboot_status: 2"
      - "Waiting..."
      - "mcuboot_status: 0"
      - "mcuboot_status: 8"
      - "Starting bootloader"
      - "Secondary image: magic"
      - "Boot source: none"
tests:
  bootloader.mcuboot.recovery.retention:
    platform_allow: nrf52840dk/nrf52840
    tags:
      - mcuboot
      - sysbuild
      - recovery
  bootloader.mcuboot.recovery.retention.mem:
    platform_allow: nrf52840dk/nrf52840
    extra_args:
      - EXTRA_CONF_FILE="boards/nrf52840dk_nrf52840_mem.conf"
      - DTC_OVERLAY_FILE="boards/nrf52840dk_nrf52840_mem.overlay"
      - mcuboot_TARGET_EXTRA_CONF_FILE="boards/nrf52840dk_nrf52840_mem.conf"
      - mcuboot_TARGET_DTC_OVERLAY_FILE="boards/nrf52840dk_nrf52840_mem.overlay"
    tags:
      - mcuboot
      - sysbuild
      - recovery
```

## tests/boot/mcuboot_version/Kconfig
```kconfig
# Override ROM_START_OFFSET
# Copyright (c) 2024 Embeint Inc

config ROM_START_OFFSET
	default 0

source "Kconfig.zephyr"
```

## tests/boot/mcuboot_version/testcase.yaml
```yaml
common:
  platform_allow:
    - mps2/an385
  integration_platforms:
    - mps2/an385
tests:
  bootloader.mcuboot.version:
    tags: mcuboot
  bootloader.mcuboot.version.git:
    tags: mcuboot
    extra_configs:
      - CONFIG_MCUBOOT_IMGTOOL_SIGN_VERSION_GIT_BUILD=y
```

## tests/boot/test_mcuboot/Kconfig
```kconfig
# Copyright 2022 NXP
#
# SPDX-License-Identifier: Apache-2.0

source "Kconfig.zephyr"

# Enable zephyr dfu boot utility library here, so that if
# KConfig dependencies prevent this symbol from being enabled, CMake
# still will succeed.
config IMG_MANAGER
	default y
	depends on FLASH_HAS_PAGE_LAYOUT

# Workaround for not being able to have commas in macro arguments
DT_CHOSEN_Z_FLASH := zephyr,flash
ZEPHYR_FLASH_NODE := $(dt_chosen_path,$(DT_CHOSEN_Z_FLASH))

# Since twister cannot parse the DTS to extract the write
# size of the flash node, we will use Kconfig functions to
# do this within the sample. Twister can then filter
# based on this KConfig
config FLASH_WRITE_SIZE
	int
	default $(dt_node_int_prop_int,$(ZEPHYR_FLASH_NODE),write-block-size)
```

## tests/boot/test_mcuboot/Kconfig.sysbuild
```kconfig
# Copyright 2022 NXP
#
# SPDX-License-Identifier: Apache-2.0

# Note that "Kconfig.zephyr" can only be sourced when SB_FULL_CONFIG=y
source "Kconfig.zephyr"

config FLASH
	default y

config BOOTLOADER_MCUBOOT
	depends on HAS_FLASH_LOAD_OFFSET && \
	  FLASH_HAS_DRIVER_ENABLED && \
	  $(dt_nodelabel_enabled,boot_partition) && \
	  $(dt_nodelabel_enabled,slot0_partition) && \
	  $(dt_nodelabel_enabled,slot1_partition)
	default y


# Since we don't source share/sysbuild/Kconfig, add bootloader options here.

if BOOTLOADER_MCUBOOT

config SIGNATURE_TYPE
	string
	default NONE if BOOT_SIGNATURE_TYPE_NONE
	default RSA  if BOOT_SIGNATURE_TYPE_RSA
	default ECDSA_P256 if BOOT_SIGNATURE_TYPE_ECDSA_P256
	default ED25519 if BOOT_SIGNATURE_TYPE_ED25519

choice
	prompt "Signature type"
	default BOOT_SIGNATURE_TYPE_RSA

config BOOT_SIGNATURE_TYPE_NONE
	bool "No signature; use only hash check"

config BOOT_SIGNATURE_TYPE_RSA
	bool "RSA signatures"

config BOOT_SIGNATURE_TYPE_ECDSA_P256
	bool "Elliptic curve digital signatures with curve P-256"

config BOOT_SIGNATURE_TYPE_ED25519
	bool "Edwards curve digital signatures using ed25519"

endchoice

config BOOT_SIGNATURE_KEY_FILE
	string "PEM key file"
	default "$(ZEPHYR_MCUBOOT_MODULE_DIR)/root-ec-p256.pem" if BOOT_SIGNATURE_TYPE_ECDSA_P256
	default "$(ZEPHYR_MCUBOOT_MODULE_DIR)/root-ed25519.pem" if BOOT_SIGNATURE_TYPE_ED25519
	default "$(ZEPHYR_MCUBOOT_MODULE_DIR)/root-rsa-2048.pem" if BOOT_SIGNATURE_TYPE_RSA
	default ""
	help
	  Absolute path to key file to use with MCUBoot.

endif
```

## tests/boot/test_mcuboot/testcase.yaml
```yaml
common:
  sysbuild: true
  tags: mcuboot
  harness: console
  harness_config:
    type: multi_line
    regex:
      - "Starting bootloader"
      - "Launching primary slot application on"
      - "Secondary application ready for swap, rebooting"
      - "Starting swap using|Image 0 upgrade secondary slot -> primary slot"
      - "Swapped application booted on"
tests:
  bootloader.mcuboot:
    platform_allow:
      - frdm_k22f
      - frdm_k64f
      - frdm_k82f
      - frdm_ke17z
      - frdm_ke17z512
      - frdm_mcxa156
      - frdm_mcxn236
      - frdm_mcxn947/mcxn947/cpu0
      - frdm_mcxw71
      - frdm_rw612
      - lpcxpresso55s06
      - lpcxpresso55s16
      - lpcxpresso55s28
      - lpcxpresso55s36
      - lpcxpresso55s69/lpc55s69/cpu0
      - mcx_n9xx_evk/mcxn947/cpu0
      - mimxrt1010_evk
      - mimxrt1015_evk
      - mimxrt1020_evk
      - mimxrt1024_evk
      - mimxrt1040_evk
      - mimxrt1050_evk/mimxrt1052/hyperflash
      - mimxrt1060_evk/mimxrt1062/qspi
      - mimxrt1062_fmurt6
      - mimxrt1064_evk
      - mimxrt1160_evk/mimxrt1166/cm7
      - mimxrt1170_evk/mimxrt1176/cm7
      - mimxrt1180_evk/mimxrt1189/cm33
      - mimxrt595_evk/mimxrt595s/cm33
      - mimxrt685_evk/mimxrt685s/cm33
      - rddrone_fmuk66
      - twr_ke18f
      - vmu_rt1170/mimxrt1176/cm7
      - nrf52840dk/nrf52840
      - rd_rw612_bga
      - esp32_devkitc/esp32/procpu
      - esp32s2_saola
      - esp32s3_devkitc/esp32s3/procpu
      - esp32c3_devkitm
      - esp32c6_devkitc/esp32c6/hpcore
      - esp8684_devkitm
      - stm32h750b_dk/stm32h750xx/ext_flash_app
      - stm32h573i_dk
      - stm32h573i_dk/stm32h573xx/ext_flash_app
      - sam_e54_xpro
      - pic32cx_sg41_cult
      - nucleo_c071rb
      - nucleo_f091rc
      - nucleo_g071rb
      - nucleo_g474re
      - nucleo_h753zi
      - nucleo_u385rg_q
      - nucleo_wb09ke
      - nucleo_wb55rg
      - nucleo_wba55cg
      - nucleo_wba65ri
      - nucleo_wl55jc
      - stm32f3_disco
      - stm32l562e_dk
      - stm32u083c_dk
      - stm32wba65i_dk1
    integration_platforms:
      - frdm_k64f
      - nrf52840dk/nrf52840
  bootloader.mcuboot.assert:
    platform_allow:
      - stm32h750b_dk/stm32h750xx/ext_flash_app
      - stm32h573i_dk/stm32h573xx/ext_flash_app
    extra_configs:
      - CONFIG_ASSERT=y
  bootloader.mcuboot.swap_using_move:
    platform_allow:
      - frdm_k64f
      - nrf5340dk/nrf5340/cpuapp
      - nrf52840dk/nrf52840
      - stm32h750b_dk/stm32h750xx/ext_flash_app
      - stm32h573i_dk/stm32h573xx/ext_flash_app
    integration_platforms:
      - frdm_k64f
      - nrf5340dk/nrf5340/cpuapp
      - nrf52840dk/nrf52840
    extra_args:
      - SB_CONFIG_MCUBOOT_MODE_SWAP_USING_MOVE=y
      - swapped_app_CONFIG_MCUBOOT_BOOTLOADER_MODE_SWAP_USING_MOVE=y
```

## tests/boot/uefi/testcase.yaml
```yaml
common:
  platform_allow: qemu_x86_64
  harness: console
  harness_config:
    type: one_line
    regex:
      - "Hello World! (.*)"
tests:
  boot.uefi:
    tags: uefi
```

## tests/boot/with_mcumgr/testcase.yaml
```yaml
common:
  sysbuild: true
  platform_allow:
    - nrf5340dk/nrf5340/cpuapp
    - nrf54l15dk/nrf54l15/cpuapp
    - nrf9160dk/nrf9160
    - nucleo_f091rc
    - nucleo_g474re
    - nucleo_h753zi
    - nucleo_u385rg_q
    - nucleo_wb09ke
    - nucleo_wb55rg
    - nucleo_wba55cg
    - nucleo_wba65ri
    - nucleo_wl55jc
    - stm32f3_disco
    - stm32h573i_dk
    - stm32l562e_dk
    - stm32u083c_dk
    - stm32wba65i_dk1
  timeout: 600
  slow: true
  tags:
    - pytest
    - mcuboot
    - mcumgr
tests:
  boot.with_mcumgr.test_upgrade:
    platform_allow:
      - nrf52840dk/nrf52840
    integration_platforms:
      - nrf52840dk/nrf52840
    harness: pytest
    harness_config:
      pytest_root:
        - "pytest/test_upgrade.py"

  boot.with_mcumgr.test_upgrade_ble:
    platform_allow:
      - nrf52840dk/nrf52840
    platform_exclude:
      - nrf9160dk/nrf9160
      - nucleo_f091rc
      - nucleo_g474re
      - nucleo_h753zi
      - nucleo_u385rg_q
      - nucleo_wb09ke
      - nucleo_wb55rg
      - nucleo_wba55cg
      - nucleo_wba65ri
      - nucleo_wl55jc
      - stm32f3_disco
      - stm32h573i_dk
      - stm32l562e_dk
      - stm32u083c_dk
      - stm32wba65i_dk1
    integration_platforms:
      - nrf52840dk/nrf52840
    extra_args: EXTRA_CONF_FILE="overlay-bt.conf"
    harness: pytest
    harness_config:
      fixture: usb_hci
      pytest_root:
        - "pytest/test_upgrade_ble.py"

  boot.with_mcumgr.test_downgrade_prevention:
    platform_allow:
      - nrf52840dk/nrf52840
    integration_platforms:
      - nrf52840dk/nrf52840
    harness: pytest
    harness_config:
      pytest_root:
        - "pytest/test_downgrade_prevention.py"
    extra_args:
      - mcuboot_CONFIG_MCUBOOT_DOWNGRADE_PREVENTION=y
    extra_configs:
      - CONFIG_MCUBOOT_IMGTOOL_SIGN_VERSION="1.1.1+1"

  boot.with_mcumgr.test_upgrade.swap_using_offset:
    integration_platforms:
      - nrf5340dk/nrf5340/cpuapp
    harness: pytest
    harness_config:
      pytest_root:
        - "pytest/test_upgrade.py"
    extra_args:
      - SB_CONFIG_MCUBOOT_MODE_SWAP_USING_OFFSET=y
```

## tests/bsim/bluetooth/audio/Kconfig
```kconfig
# Copyright (c) 2022 Nordic Semiconductor ASA
# SPDX-License-Identifier: Apache-2.0

# Workaround for pretending that the controller
# supports CIS as the host expects the controller
# to support these features.

config BT_LL_SW_SPLIT
	select BT_CTLR_SYNC_TRANSFER_RECEIVER_SUPPORT
	select BT_CTLR_SYNC_TRANSFER_SENDER_SUPPORT

menu "Zephyr Kernel"
source "Kconfig.zephyr"
endmenu
```

## tests/bsim/bluetooth/audio_samples/bap_broadcast_sink/Kconfig.sysbuild
```kconfig
# Copyright (c) 2023 Nordic Semiconductor ASA
# SPDX-License-Identifier: Apache-2.0

source "$(ZEPHYR_BASE)/samples/bluetooth/bap_broadcast_sink/Kconfig.sysbuild"

config NATIVE_SIMULATOR_PRIMARY_MCU_INDEX
	int
	# Let's pass the test arguments to the application MCU test
	# otherwise by default they would have gone to the net core.
	default 0 if $(BOARD_TARGET_STRING) = "NRF5340BSIM_NRF5340_CPUAPP"
```

## tests/bsim/bluetooth/audio_samples/cap/acceptor/Kconfig
```kconfig
# Copyright (c) 2024 Nordic Semiconductor ASA
# SPDX-License-Identifier: Apache-2.0

source "${ZEPHYR_BASE}/samples/bluetooth/cap_acceptor/Kconfig"
```

## tests/bsim/bluetooth/audio_samples/unicast_audio_client/boards/nrf52_bsim.conf
```kconfig
# This file content is just a copy of the equivalent one in the unicast client sample

# For LC3 the following configs are needed
CONFIG_FPU=y
CONFIG_LIBLC3=y
# LC3 lib requires floating point support in the c-lib.
CONFIG_REQUIRES_FULL_LIBC=y
```

## tests/bsim/bluetooth/audio_samples/unicast_audio_client/boards/nrf5340bsim_nrf5340_cpunet_native.conf
```kconfig
# This file content is just a copy of the equivalent one in the unicast client sample

# For LC3 the following configs are needed
CONFIG_FPU=y
CONFIG_LIBLC3=y
```

## tests/bsim/bluetooth/host/adv/adv_info/testcase.yaml
```yaml
common:
  build_only: true
  tags:
    - bluetooth
  platform_allow:
    - nrf52_bsim/native
    - nrf5340bsim/nrf5340/cpuapp
  harness: bsim

tests:
  bluetooth.host.legacy_adv_info:
    harness_config:
      bsim_exe_name: tests_bsim_bluetooth_host_legacy_adv_info_prj_conf
  bluetooth.host.ext_adv_info:
    harness_config:
      bsim_exe_name: tests_bsim_bluetooth_host_ext_adv_info_prj_conf
    extra_args:
      EXTRA_CONF_FILE="overlay-ext.conf"
  bluetooth.host.legacy_adv_info.privacy:
    harness_config:
      bsim_exe_name: tests_bsim_bluetooth_host_legacy_adv_info_privacy_prj_conf
    extra_args:
      EXTRA_CONF_FILE="overlay-privacy.conf"
  bluetooth.host.ext_adv_info.privacy:
    harness_config:
      bsim_exe_name: tests_bsim_bluetooth_host_ext_adv_info_privacy_prj_conf
    extra_args:
      EXTRA_CONF_FILE="overlay-ext.conf;overlay-privacy.conf"
```

## tests/bsim/bluetooth/host/adv/chain/testcase.yaml
```yaml
tests:
  bluetooth.host.adv.chain:
    tags:
      - bluetooth
    platform_allow:
      - nrf52_bsim/native
      - nrf5340bsim/nrf5340/cpunet
    harness: bsim
    timeout: 30
    harness_config:
      bsim_exe_name: tests_bsim_bluetooth_host_adv_chain_prj_conf
      bsim_verbosity: 2
      bsim_sim_length: 10e6
      bsim_devices:
        - test_id: adv
        - test_id: scan
```

## tests/bsim/bluetooth/host/adv/encrypted/css_sample_data/testcase.yaml
```yaml
tests:
  bluetooth.host.adv.encrypted.css_sample_data:
    build_only: true
    tags:
      - bluetooth
    platform_allow:
      - nrf52_bsim/native
      - nrf5340bsim/nrf5340/cpunet
    harness: bsim
    harness_config:
      bsim_exe_name: tests_bsim_bluetooth_host_adv_encrypted_css_sample_data_prj_conf
```

## tests/bsim/bluetooth/host/adv/encrypted/ead_sample/testcase.yaml
```yaml
tests:
  bluetooth.host.adv.encrypted.ead_sample:
    build_only: true
    tags:
      - bluetooth
    platform_allow:
      - nrf52_bsim/native
    harness: bsim
    harness_config:
      bsim_exe_name: tests_bsim_bluetooth_host_adv_encrypted_ead_sample_prj_conf
```
