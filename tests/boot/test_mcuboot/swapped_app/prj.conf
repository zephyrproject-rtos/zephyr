## Kconfig
```
# Copyright 2022 NXP
# Copyright 2025 Nordic Semiconductor ASA
# SPDX-License-Identifier: Apache-2.0
source "Kconfig.zephyr"

config BUILD_OUTPUT_ADJUST_LMA
	default "$(dt_node_reg_addr_hex,$(dt_nodelabel_path,slot1_partition))-\
		$(dt_chosen_reg_addr_hex,$(DT_CHOSEN_Z_CODE_PARTITION))+\
		$(dt_node_int_prop_hex,$(dt_node_parent,$(dt_node_parent,$(dt_nodelabel_path,slot1_partition))),erase-block-size)" if MCUBOOT_BOOTLOADER_MODE_SWAP_USING_OFFSET
	default "$(dt_node_reg_addr_hex,$(dt_nodelabel_path,slot1_partition))-\
		$(dt_chosen_reg_addr_hex,$(DT_CHOSEN_Z_CODE_PARTITION))"
```

## prj.conf
```kconfig
# Since LMA adjustment is used to move the image location to the secondary
# slot, we need to enable hex build output. Otherwise, some debuggers will not
# flash the binary to the second image slot.
CONFIG_BUILD_OUTPUT_HEX=y
CONFIG_BOOTLOADER_MCUBOOT=y
```

## src/main.c
```c
/*
 * Copyright 2022 NXP
 *
 * SPDX-License-Identifier: Apache-2.0
 */

#include <zephyr/kernel.h>

/* Main entry point */
int main(void)
{
	printk("Swapped application booted on %s\n", CONFIG_BOARD);
	return 0;
}
```
