## CMakeLists.txt
```
# SPDX-License-Identifier: Apache-2.0

cmake_minimum_required(VERSION 3.28.0)

find_package(Zephyr REQUIRED HINTS $ENV{ZEPHYR_BASE})
project(test_mcuboot)

FILE(GLOB app_sources src/*.c)
target_sources(app PRIVATE ${app_sources})
```

## Kconfig
```
# Copyright 2022 NXP
#
# SPDX-License-Identifier: Apache-2.0

source "Kconfig.zephyr"

# Enable zephyr dfu boot utility library here, so that if
# KConfig dependencies prevent this symbol from being enabled, CMake
# still will succeed.
config IMG_MANAGER
	default y
	depends on FLASH_HAS_PAGE_LAYOUT

# Workaround for not being able to have commas in macro arguments
DT_CHOSEN_Z_FLASH := zephyr,flash
ZEPHYR_FLASH_NODE := $(dt_chosen_path,$(DT_CHOSEN_Z_FLASH))

# Since twister cannot parse the DTS to extract the write
# size of the flash node, we will use Kconfig functions to
# do this within the sample. Twister can then filter
# based on this KConfig
config FLASH_WRITE_SIZE
	int
	default $(dt_node_int_prop_int,$(ZEPHYR_FLASH_NODE),write-block-size)
```

## Kconfig.sysbuild
```
# Copyright 2022 NXP
#
# SPDX-License-Identifier: Apache-2.0

# Note that "Kconfig.zephyr" can only be sourced when SB_FULL_CONFIG=y
source "Kconfig.zephyr"

config FLASH
	default y

config BOOTLOADER_MCUBOOT
	depends on HAS_FLASH_LOAD_OFFSET && \
	  FLASH_HAS_DRIVER_ENABLED && \
	  $(dt_nodelabel_enabled,boot_partition) && \
	  $(dt_nodelabel_enabled,slot0_partition) && \
	  $(dt_nodelabel_enabled,slot1_partition)
	default y


# Since we don't source share/sysbuild/Kconfig, add bootloader options here.

if BOOTLOADER_MCUBOOT

config SIGNATURE_TYPE
	string
	default NONE if BOOT_SIGNATURE_TYPE_NONE
	default RSA  if BOOT_SIGNATURE_TYPE_RSA
	default ECDSA_P256 if BOOT_SIGNATURE_TYPE_ECDSA_P256
	default ED25519 if BOOT_SIGNATURE_TYPE_ED25519

choice
	prompt "Signature type"
	default BOOT_SIGNATURE_TYPE_RSA

config BOOT_SIGNATURE_TYPE_NONE
	bool "No signature; use only hash check"

config BOOT_SIGNATURE_TYPE_RSA
	bool "RSA signatures"

config BOOT_SIGNATURE_TYPE_ECDSA_P256
	bool "Elliptic curve digital signatures with curve P-256"

config BOOT_SIGNATURE_TYPE_ED25519
	bool "Edwards curve digital signatures using ed25519"

endchoice

config BOOT_SIGNATURE_KEY_FILE
	string "PEM key file"
	default "$(ZEPHYR_MCUBOOT_MODULE_DIR)/root-ec-p256.pem" if BOOT_SIGNATURE_TYPE_ECDSA_P256
	default "$(ZEPHYR_MCUBOOT_MODULE_DIR)/root-ed25519.pem" if BOOT_SIGNATURE_TYPE_ED25519
	default "$(ZEPHYR_MCUBOOT_MODULE_DIR)/root-rsa-2048.pem" if BOOT_SIGNATURE_TYPE_RSA
	default ""
	help
	  Absolute path to key file to use with MCUBoot.

endif
```

## sysbuild.conf
```
SB_CONFIG_BOOTLOADER_MCUBOOT=y

SB_CONFIG_BOOT_SIGNATURE_TYPE_ECDSA_P256=y
```

## prj.conf
```kconfig
# Enable zephyr dfu boot utility library
CONFIG_IMG_MANAGER=y
# Enable flash drivers for MCUBoot
CONFIG_FLASH=y
CONFIG_FLASH_MAP=y
CONFIG_STREAM_FLASH=y
# Enable reboot API to reset board after selecting new image
CONFIG_REBOOT=y
```

## src/main.c
```c
/*
 * Copyright 2022-2024 NXP
 *
 * SPDX-License-Identifier: Apache-2.0
 */

#include <zephyr/kernel.h>
#include <zephyr/sys/reboot.h>
#include <zephyr/dfu/mcuboot.h>

/* Main entry point */
int main(void)
{
	int err;

	printk("Launching primary slot application on %s\n", CONFIG_BOARD);
	/* Perform a permanent swap of MCUBoot application */
	err = boot_request_upgrade(BOOT_UPGRADE_PERMANENT);
	if (err) {
		printk("Failed to request upgrade: %d", err);
	} else {
		printk("Secondary application ready for swap, rebooting\n");
		sys_reboot(SYS_REBOOT_COLD);
	}
	return 0;
}
```
