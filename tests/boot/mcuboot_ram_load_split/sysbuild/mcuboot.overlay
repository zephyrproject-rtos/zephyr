/*
 * Copyright (c) 2026 The Zephyr Project Contributors
 *
 * SPDX-License-Identifier: Apache-2.0
 */

#include "../boards/mps2_an385.overlay"

/delete-node/ &sram0;

/ {
	sram0: memory@20000000 {
		compatible = "mmio-sram";
		reg = <0x20000000 0x00040000>;
	};

	chosen {
		zephyr,sram = &sram0;
		zephyr,code-partition = &boot_partition;
	};
};
