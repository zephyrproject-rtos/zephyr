## CMakeLists.txt
```
# SPDX-License-Identifier: Apache-2.0

cmake_minimum_required(VERSION 3.28.0)

find_package(Zephyr REQUIRED HINTS $ENV{ZEPHYR_BASE})
project(boot_uefi)

target_sources(app PRIVATE src/main.c)
```

## prj.conf
```kconfig
CONFIG_QEMU_UEFI_BOOT=y
CONFIG_BUILD_OUTPUT_EFI=y
```

## boards/qemu_cortex_a53.conf
```kconfig
# QEMU without a secure world, as EDK2 for the virt machine expects
CONFIG_ARMV8_A_NS=y
# RAM for EDK2 above Zephyr's
CONFIG_QEMU_EXTRA_FLAGS="-m 512"
```

## boards/qemu_cortex_a53.overlay
```dts
/*
 * Copyright (c) 2026 BayLibre SAS
 *
 * SPDX-License-Identifier: Apache-2.0
 */

/*
 * QEMU puts the devicetree at the start of RAM (0x40000000) and EDK2 keeps
 * its stack and other data just below 0x48000000.
 */
/delete-node/ &sram0;

/ {
	chosen {
		zephyr,sram = &sram0;
	};

	soc {
		sram0: memory@48000000 {
			compatible = "mmio-sram";
			reg = <0x0 0x48000000 0x0 DT_SIZE_M(64)>;
		};
	};
};
```

## boards/qemu_x86_64.overlay
```dts
/*
 * Copyright The Zephyr Project Contributors
 *
 * SPDX-License-Identifier: Apache-2.0
 */

&dram0 {
	reg = <0x0 0xc800000>;
};
```

## src/main.c
```c
/*
 * Copyright (c) 2012-2014 Wind River Systems, Inc.
 *
 * SPDX-License-Identifier: Apache-2.0
 */

#include <zephyr/kernel.h>
#include <zephyr/sys/printk.h>
#ifdef CONFIG_ARM64
#include <zephyr/arch/arm64/efi.h>
#endif

int main(void)
{
#ifdef CONFIG_ARM64
	const struct arm64_efi_boot_info *info = arm64_efi_boot_info_get();

	if (info == NULL || info->memmap_size == 0 || info->memmap_desc_size == 0) {
		printk("No EFI boot information\n");
		return 0;
	}
	printk("EFI memory map: %zu entries\n", info->memmap_size / info->memmap_desc_size);
#endif
	printk("Hello World! %s\n", CONFIG_BOARD);
	return 0;
}
```
