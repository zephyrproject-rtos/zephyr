## CMakeLists.txt
```
# Copyright 2026 NXP
# SPDX-License-Identifier: Apache-2.0

cmake_minimum_required(VERSION 3.20.0)
find_package(Zephyr REQUIRED HINTS $ENV{ZEPHYR_BASE})
project(mpipe_utils_test)

file(GLOB app_sources src/*.c)
target_sources(app PRIVATE ${app_sources})
```

## prj.conf
```kconfig
CONFIG_ZTEST=y
CONFIG_MPIPE=y
CONFIG_MPIPE_FAKE_SRC=y
CONFIG_MPIPE_DUMP=y
CONFIG_MPIPE_PLAYER=y
CONFIG_MPIPE_PLAYER_NUM=2
CONFIG_MPIPE_THREADS_NUM=2
CONFIG_MPIPE_NET_BUF_POOL_COUNT=2
CONFIG_SHELL=n
```

## src/test_dump.c
```c
/*
 * Copyright 2026 NXP
 *
 * SPDX-License-Identifier: Apache-2.0
 */

#include <string.h>

#include <zephyr/ztest.h>

#include <zephyr/mpipe/mpipe.h>
#include <zephyr/mpipe/mpipe_fake_src.h>
#include <zephyr/mpipe/utils/mpipe_dump.h>

/* Element IDs (values are arbitrary; only uniqueness within the pipeline matters) */
enum {
	DUMP_PIPE_ID,
	DUMP_SRC_ID,
	DUMP_TRANSFORM_ID,
	DUMP_SINK_ID,
};

/* 'R', 'G', 'B', 'P': the fourcc VIDEO_PIX_FMT_RGB565 is spelled with */
#define TEST_FOURCC_RGBP 0x50424752U

#define TEST_DUMP_BUF_SIZE 2048

struct test_dump_capture {
	char buf[TEST_DUMP_BUF_SIZE];
	size_t len;
};

struct test_dump_fixture {
	struct mpipe pipeline;
	struct mpipe_fake_src fake_src;
	struct mpipe_transform transform;
	struct mpipe_sink sink;
	struct test_dump_capture capture;
};

/* Collects the dump into a buffer, which is what lets a test read it */
static void test_dump_print(void *ctx, const char *str)
{
	struct test_dump_capture *cap = ctx;
	size_t room = sizeof(cap->buf) - 1U - cap->len;
	size_t len = MIN(strlen(str), room);

	memcpy(&cap->buf[cap->len], str, len);
	cap->len += len;
	cap->buf[cap->len] = '\0';
}

static int test_dump_pipeline(struct test_dump_fixture *fix)
{
	return mpipe_dump_bin((struct mpipe_bin *)&fix->pipeline, test_dump_print, &fix->capture);
}

static void test_dump_reset(struct test_dump_fixture *fix)
{
	fix->capture.len = 0;
	fix->capture.buf[0] = '\0';
}

static void *dump_suite_setup(void)
{
	static struct test_dump_fixture fixture;

	return &fixture;
}

static void dump_before(void *f)
{
	struct test_dump_fixture *fix = f;

	memset(fix, 0, sizeof(*fix));

	zassert_ok(mpipe_pipeline_init(&fix->pipeline, DUMP_PIPE_ID));
	zassert_ok(mpipe_fake_src_init(&fix->fake_src, DUMP_SRC_ID));
	zassert_ok(mpipe_transform_init(&fix->transform, DUMP_TRANSFORM_ID));
	zassert_ok(mpipe_sink_init(&fix->sink, DUMP_SINK_ID));

	zassert_ok(mpipe_bin_add((struct mpipe_bin *)&fix->pipeline,
				 (struct mpipe_element *)&fix->fake_src,
				 (struct mpipe_element *)&fix->transform,
				 (struct mpipe_element *)&fix->sink, NULL),
		   "Failed to add elements");
}

ZTEST_SUITE(test_dump, NULL, dump_suite_setup, dump_before, NULL, NULL);

static void dump_link_chain(struct test_dump_fixture *fix)
{
	zassert_ok(mpipe_element_link((struct mpipe_element *)&fix->fake_src,
				      (struct mpipe_element *)&fix->transform,
				      (struct mpipe_element *)&fix->sink, NULL),
		   "Failed to link elements");
}

/* An element is named after its init function, with the prefix and suffix dropped */
ZTEST_F(test_dump, test_dump_names_every_element)
{
	dump_link_chain(fixture);

	zassert_ok(test_dump_pipeline(fixture));

	zassert_not_null(strstr(fixture->capture.buf, "pipeline #0"), "Bin not named:\n%s",
			 fixture->capture.buf);
	zassert_not_null(strstr(fixture->capture.buf, "fake_src #1"), "Source not named:\n%s",
			 fixture->capture.buf);
	zassert_not_null(strstr(fixture->capture.buf, "transform #2"), "Transform not named:\n%s",
			 fixture->capture.buf);
	zassert_not_null(strstr(fixture->capture.buf, "sink #3"), "Sink not named:\n%s",
			 fixture->capture.buf);

	/*
	 * Neither the "mpipe_" prefix nor the "_init" suffix belongs in a name.
	 * Checked against the names themselves rather than the whole rendering,
	 * which legitimately carries "mpipe_" in the graph's own name.
	 */
	zassert_is_null(strstr(fixture->capture.buf, "mpipe_fake_src"), "Prefix not stripped:\n%s",
			fixture->capture.buf);
	zassert_is_null(strstr(fixture->capture.buf, "_init"), "Suffix not stripped:\n%s",
			fixture->capture.buf);
}

/* Every link becomes an edge between the two ports it actually joins */
ZTEST_F(test_dump, test_dump_draws_an_edge_per_link)
{
	dump_link_chain(fixture);

	zassert_ok(test_dump_pipeline(fixture));

	zassert_not_null(strstr(fixture->capture.buf, "e0:src0 -> e1:sink0"),
			 "Edge from the source is missing or lands on the wrong pad:\n%s",
			 fixture->capture.buf);
	zassert_not_null(strstr(fixture->capture.buf, "e1:src1 -> e2:sink0"),
			 "Edge to the sink is missing or lands on the wrong pad:\n%s",
			 fixture->capture.buf);

	/* Every pad is linked, so nothing is marked */
	zassert_is_null(strstr(fixture->capture.buf, "#cc0000"),
			"A fully linked chain marked an element as unlinked:\n%s",
			fixture->capture.buf);
}

/* An element with a pad left over is marked, which is what a broken graph looks like */
ZTEST_F(test_dump, test_dump_marks_an_element_with_an_unlinked_pad)
{
	/* Deliberately left unlinked */
	zassert_ok(test_dump_pipeline(fixture));

	zassert_not_null(strstr(fixture->capture.buf, "#cc0000"),
			 "An unlinked element was not marked:\n%s", fixture->capture.buf);
	zassert_is_null(strstr(fixture->capture.buf, " -> "),
			"Nothing is linked, so no edge should be drawn:\n%s", fixture->capture.buf);
}

/* The capability negotiated on each pad is what the dump exists to show */
ZTEST_F(test_dump, test_dump_shows_negotiated_caps)
{
	dump_link_chain(fixture);

	zassert_ok(test_dump_pipeline(fixture));

	/* Nothing has negotiated yet, so every pad still constrains nothing */
	zassert_not_null(strstr(fixture->capture.buf, "<any>"),
			 "An un-negotiated pad should render as <any>:\n%s", fixture->capture.buf);

	zassert_ok(mpipe_element_set_state((struct mpipe_element *)&fixture->pipeline,
					   MPIPE_STATE_PAUSED),
		   "Pipeline failed to reach PAUSED");

	test_dump_reset(fixture);
	zassert_ok(test_dump_pipeline(fixture));

	/* Every element, not just the bin, has to report the state it reached */
	zassert_not_null(strstr(fixture->capture.buf, "pipeline #0 PAUSED"),
			 "Bin state not shown:\n%s", fixture->capture.buf);
	zassert_not_null(strstr(fixture->capture.buf, "fake_src #1\\nPAUSED"),
			 "Source still reports its initial state:\n%s", fixture->capture.buf);
	zassert_is_null(strstr(fixture->capture.buf, "READY"),
			"An element was left behind at READY:\n%s", fixture->capture.buf);

	zassert_ok(mpipe_element_set_state((struct mpipe_element *)&fixture->pipeline,
					   MPIPE_STATE_READY),
		   "Pipeline failed to return to READY");
}

/* The rendering has to be a graph dot(1) can actually lay out */
ZTEST_F(test_dump, test_dump_is_a_well_formed_digraph)
{
	dump_link_chain(fixture);

	zassert_ok(test_dump_pipeline(fixture));

	zassert_equal(strncmp(fixture->capture.buf, "digraph mpipe_pipeline {", 21), 0,
		      "DOT does not open a digraph:\n%s", fixture->capture.buf);
	zassert_not_null(strstr(fixture->capture.buf, "rankdir=LR;"), "DOT lacks its layout:\n%s",
			 fixture->capture.buf);

	/* Every brace opened has to close, or dot(1) rejects the whole graph */
	int depth = 0;

	for (size_t i = 0; i < fixture->capture.len; i++) {
		if (fixture->capture.buf[i] == '{') {
			depth++;
		} else if (fixture->capture.buf[i] == '}') {
			depth--;
		}

		zassert_true(depth >= 0, "DOT closes a brace it never opened:\n%s",
			     fixture->capture.buf);
	}

	zassert_equal(depth, 0, "DOT leaves %d brace(s) open:\n%s", depth, fixture->capture.buf);
}

/* A capability renders its media type, its field names and a fourcc as characters */
ZTEST_F(test_dump, test_dump_caps_renders_fields_by_name)
{
	struct mpipe_structure caps;

	zassert_ok(mpipe_structure_init_fields(
		&caps, MPIPE_MEDIA_VIDEO, MPIPE_CAPS_PIXEL_FORMAT, MPIPE_TYPE_UINT,
		TEST_FOURCC_RGBP, MPIPE_CAPS_IMAGE_WIDTH, MPIPE_TYPE_UINT, 640,
		MPIPE_CAPS_IMAGE_HEIGHT, MPIPE_TYPE_UINT_RANGE, 16, 480, 2, MPIPE_CAPS_END));

	zassert_ok(mpipe_dump_caps(&caps, test_dump_print, &fixture->capture));

	zassert_equal(strcmp(fixture->capture.buf,
			     "<video, format=RGBP, width=640, height=[16, 480, 2]>"),
		      0, "Unexpected rendering: '%s'", fixture->capture.buf);
}

/* An audio capability uses the same table, so its field names have to be there too */
ZTEST_F(test_dump, test_dump_caps_renders_audio_fields)
{
	struct mpipe_structure caps;

	zassert_ok(mpipe_structure_init_fields(&caps, MPIPE_MEDIA_AUDIO_PCM, MPIPE_CAPS_SAMPLE_RATE,
					       MPIPE_TYPE_UINT, 48000, MPIPE_CAPS_NUM_CHANNELS,
					       MPIPE_TYPE_UINT, 2, MPIPE_CAPS_INTERLEAVED,
					       MPIPE_TYPE_BOOLEAN, true, MPIPE_CAPS_END));

	zassert_ok(mpipe_dump_caps(&caps, test_dump_print, &fixture->capture));

	zassert_equal(strcmp(fixture->capture.buf,
			     "<audio/pcm, rate=48000, channels=2, interleaved=true>"),
		      0, "Unexpected rendering: '%s'", fixture->capture.buf);
}

/*
 * Constraining nothing because it intersects with everything is not the same as
 * constraining nothing because it intersects with nothing.
 */
ZTEST_F(test_dump, test_dump_caps_tells_any_from_empty)
{
	struct mpipe_structure caps;

	zassert_ok(mpipe_structure_init_any(&caps));
	zassert_ok(mpipe_dump_caps(&caps, test_dump_print, &fixture->capture));
	zassert_equal(strcmp(fixture->capture.buf, "<any>"), 0, "Unexpected rendering: '%s'",
		      fixture->capture.buf);

	test_dump_reset(fixture);

	zassert_ok(mpipe_structure_init(&caps, MPIPE_MEDIA_VIDEO));
	zassert_ok(mpipe_dump_caps(&caps, test_dump_print, &fixture->capture));
	zassert_equal(strcmp(fixture->capture.buf, "<empty>"), 0, "Unexpected rendering: '%s'",
		      fixture->capture.buf);
}

/* A dump with no callback goes to the console, which is how the player renders one */
ZTEST_F(test_dump, test_dump_to_the_console_is_accepted)
{
	dump_link_chain(fixture);

	zassert_ok(mpipe_dump_bin((struct mpipe_bin *)&fixture->pipeline, NULL, NULL),
		   "A dump to the console should be accepted");
}
```

## src/test_player.c
```c
/*
 * Copyright 2026 NXP
 *
 * SPDX-License-Identifier: Apache-2.0
 */

#include <string.h>

#include <zephyr/ztest.h>

#include <zephyr/mpipe/mpipe.h>
#include <zephyr/mpipe/mpipe_fake_src.h>
#include <zephyr/mpipe/mpipe_sink.h>
#include <zephyr/mpipe/utils/mpipe_player.h>

/* Element ids: a pipeline's id is what names its player, so they are distinct */
enum {
	PLAYER_PIPE_A_ID = 10,
	PLAYER_SRC_A_ID,
	PLAYER_SINK_A_ID,
	PLAYER_PIPE_B_ID = 20,
	PLAYER_SRC_B_ID,
	PLAYER_SINK_B_ID,
	PLAYER_PIPE_C_ID = 30,
};

/* Number of buffers each source produces before EOS */
#define TEST_BUFS_NUM 10

/* How long a run may take: a fake source finishes in simulated microseconds */
#define TEST_RUN_TIMEOUT K_SECONDS(2)

/* One pipeline the player drives: a fake source feeding a sink */
struct test_player_pipe {
	struct mpipe pipeline;
	struct mpipe_fake_src fake_src;
	struct mpipe_sink sink;
	struct mpipe_player player;
};

struct test_player_fixture {
	struct test_player_pipe a;
	struct test_player_pipe b;
	/* Only ever initialized as a pipeline, to ask for one player too many */
	struct mpipe pipeline_c;
	struct mpipe_player player_c;
};

static enum mpipe_state test_player_state(struct test_player_pipe *p)
{
	return ((struct mpipe_element *)&p->pipeline)->current_state;
}

/* Wait for the worker to bring the pipeline to a state, since commands are asynchronous */
static bool test_player_wait_state(struct test_player_pipe *p, enum mpipe_state state,
				   k_timeout_t timeout)
{
	k_timepoint_t end = sys_timepoint_calc(timeout);

	while (test_player_state(p) != state) {
		if (sys_timepoint_expired(end)) {
			return false;
		}

		k_sleep(K_MSEC(1));
	}

	return true;
}

static void test_player_pipe_init(struct test_player_pipe *p, uint8_t pipe_id, uint8_t src_id,
				  uint8_t sink_id)
{
	zassert_ok(mpipe_pipeline_init(&p->pipeline, pipe_id));
	zassert_ok(mpipe_fake_src_init(&p->fake_src, src_id));
	zassert_ok(mpipe_sink_init(&p->sink, sink_id));

	zassert_ok(mpipe_object_set_properties((struct mpipe_object *)&p->fake_src,
					       MPIPE_PROP_SRC_NUM_BUFS, TEST_BUFS_NUM,
					       MPIPE_PROP_LIST_END),
		   "Failed to set fake_src MPIPE_PROP_SRC_NUM_BUFS");

	zassert_ok(mpipe_bin_add((struct mpipe_bin *)&p->pipeline,
				 (struct mpipe_element *)&p->fake_src,
				 (struct mpipe_element *)&p->sink, NULL),
		   "Failed to add elements");
	zassert_ok(mpipe_element_link((struct mpipe_element *)&p->fake_src,
				      (struct mpipe_element *)&p->sink, NULL),
		   "Failed to link elements");

	zassert_ok(mpipe_player_init(&p->player, &p->pipeline), "Failed to init the player");
}

static void *player_suite_setup(void)
{
	static struct test_player_fixture fixture;

	return &fixture;
}

static void player_before(void *f)
{
	struct test_player_fixture *fix = f;

	memset(fix, 0, sizeof(*fix));

	test_player_pipe_init(&fix->a, PLAYER_PIPE_A_ID, PLAYER_SRC_A_ID, PLAYER_SINK_A_ID);
	test_player_pipe_init(&fix->b, PLAYER_PIPE_B_ID, PLAYER_SRC_B_ID, PLAYER_SINK_B_ID);
}

/* Deinit stops the pipeline and frees the slot, so every test leaves the table empty */
static void player_after(void *f)
{
	struct test_player_fixture *fix = f;

	zassert_ok(mpipe_player_deinit(&fix->a.player));
	zassert_ok(mpipe_player_deinit(&fix->b.player));
}

ZTEST_SUITE(test_player, NULL, player_suite_setup, player_before, player_after, NULL);

/* Two players drive two pipelines, and each one's end-of-stream stops only its own */
ZTEST_F(test_player, test_player_two_pipelines_run_independently)
{
	zassert_ok(mpipe_player_play(&fixture->a.player));
	zassert_ok(mpipe_player_play(&fixture->b.player));

	/* Both run to EOS, on which their player brings them back to READY */
	zassert_true(test_player_wait_state(&fixture->a, MPIPE_STATE_READY, TEST_RUN_TIMEOUT),
		     "Pipeline A did not run to EOS and stop");
	zassert_true(test_player_wait_state(&fixture->b, MPIPE_STATE_READY, TEST_RUN_TIMEOUT),
		     "Pipeline B did not run to EOS and stop");

	/* A replay of one is a run of one */
	zassert_ok(mpipe_player_replay(&fixture->a.player));
	zassert_true(test_player_wait_state(&fixture->a, MPIPE_STATE_READY, TEST_RUN_TIMEOUT),
		     "Pipeline A did not replay to EOS and stop");
	zassert_equal(test_player_state(&fixture->b), MPIPE_STATE_READY,
		      "Replaying A moved pipeline B");
}

/*
 * An end-of-stream reaches the player of the pipeline that posted it. Pipeline
 * B is parked at PAUSED, which no command of its own player would leave it at
 * once a stop from A's end-of-stream reached it.
 */
ZTEST_F(test_player, test_player_eos_reaches_its_own_player)
{
	zassert_ok(mpipe_element_set_state((struct mpipe_element *)&fixture->b.pipeline,
					   MPIPE_STATE_PAUSED),
		   "Pipeline B failed to reach PAUSED");

	zassert_ok(mpipe_player_play(&fixture->a.player));
	zassert_true(test_player_wait_state(&fixture->a, MPIPE_STATE_READY, TEST_RUN_TIMEOUT),
		     "Pipeline A did not run to EOS and stop");

	zassert_equal(test_player_state(&fixture->b), MPIPE_STATE_PAUSED,
		      "The end of stream of A stopped B");

	/* B still works under its own player from where it was left */
	zassert_ok(mpipe_player_play(&fixture->b.player));
	zassert_true(test_player_wait_state(&fixture->b, MPIPE_STATE_READY, TEST_RUN_TIMEOUT),
		     "Pipeline B did not run to EOS and stop");
}

/* The table has CONFIG_MPIPE_PLAYER_NUM slots, given back on deinit */
ZTEST_F(test_player, test_player_slots_are_bounded)
{
	BUILD_ASSERT(CONFIG_MPIPE_PLAYER_NUM == 2, "The test asks for one player too many");

	zassert_ok(mpipe_pipeline_init(&fixture->pipeline_c, PLAYER_PIPE_C_ID));

	zassert_equal(mpipe_player_init(&fixture->player_c, &fixture->pipeline_c), -ENOMEM,
		      "A third player was accepted with two slots");

	/* A pipeline gets one player, whether or not a slot is free */
	zassert_ok(mpipe_player_deinit(&fixture->b.player));
	zassert_equal(mpipe_player_init(&fixture->player_c, &fixture->a.pipeline), -EBUSY,
		      "A second player on pipeline A was accepted");
	zassert_ok(mpipe_player_init(&fixture->b.player, &fixture->b.pipeline));

	zassert_ok(mpipe_player_deinit(&fixture->b.player));
	zassert_ok(mpipe_player_init(&fixture->player_c, &fixture->pipeline_c),
		   "The slot freed by B was not reused");

	/* Leave the table as player_after() expects it: A and B initialized */
	zassert_ok(mpipe_player_deinit(&fixture->player_c));
	zassert_ok(mpipe_player_init(&fixture->b.player, &fixture->b.pipeline));
}
```
