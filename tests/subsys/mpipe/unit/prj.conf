## CMakeLists.txt
```
# Copyright 2026 NXP
# SPDX-License-Identifier: Apache-2.0

cmake_minimum_required(VERSION 3.20.0)
find_package(Zephyr REQUIRED HINTS $ENV{ZEPHYR_BASE})
project(mpipe_unit_test)

file(GLOB app_sources src/*.c)
target_sources(app PRIVATE ${app_sources})
```

## prj.conf
```kconfig
CONFIG_ZTEST=y
CONFIG_MPIPE=y
```

## src/mpipe_test_helpers.h
```c
/*
 * Copyright 2026 NXP
 *
 * SPDX-License-Identifier: Apache-2.0
 */

#ifndef TESTS_SUBSYS_MPIPE_UNIT_SRC_MPIPE_TEST_HELPERS_H_
#define TESTS_SUBSYS_MPIPE_UNIT_SRC_MPIPE_TEST_HELPERS_H_

#include <zephyr/mpipe/mpipe_value.h>
#include <zephyr/ztest.h>

#define validate_boolean_value(value, expected)                                                    \
	({                                                                                         \
		zassert_not_null(value);                                                           \
		zassert_equal((value)->type, MPIPE_TYPE_BOOLEAN);                                  \
		zassert_equal(mpipe_value_get_boolean(value), expected);                           \
	})

#define validate_int_value(value, expected)                                                        \
	({                                                                                         \
		zassert_not_null(value);                                                           \
		zassert_equal((value)->type, MPIPE_TYPE_INT);                                      \
		zassert_equal(mpipe_value_get_int(value), expected);                               \
	})

#define validate_uint_value(value, expected)                                                       \
	({                                                                                         \
		zassert_not_null(value);                                                           \
		zassert_equal((value)->type, MPIPE_TYPE_UINT);                                     \
		zassert_equal(mpipe_value_get_uint(value), expected);                              \
	})

#define validate_int_range_value(value, min, max, step)                                            \
	({                                                                                         \
		zassert_not_null(value);                                                           \
		zassert_equal((value)->type, MPIPE_TYPE_INT_RANGE);                                \
		zassert_equal(mpipe_value_get_int_range_min(value), min);                          \
		zassert_equal(mpipe_value_get_int_range_max(value), max);                          \
		zassert_equal(mpipe_value_get_int_range_step(value), step);                        \
	})

#define validate_uint_range_value(value, min, max, step)                                           \
	({                                                                                         \
		zassert_not_null(value);                                                           \
		zassert_equal((value)->type, MPIPE_TYPE_UINT_RANGE);                               \
		zassert_equal(mpipe_value_get_uint_range_min(value), min);                         \
		zassert_equal(mpipe_value_get_uint_range_max(value), max);                         \
		zassert_equal(mpipe_value_get_uint_range_step(value), step);                       \
	})

#endif /* TESTS_SUBSYS_MPIPE_UNIT_SRC_MPIPE_TEST_HELPERS_H_ */
```

## src/test_bin.c
```c
/*
 * Copyright 2026 NXP
 *
 * SPDX-License-Identifier: Apache-2.0
 */

#include <zephyr/kernel.h>
#include <zephyr/ztest.h>
#include <zephyr/mpipe/mpipe_bin.h>
#include <zephyr/mpipe/mpipe_element.h>
#include <zephyr/mpipe/mpipe_pad.h>
#include <zephyr/mpipe/mpipe_pipeline.h>
#include <zephyr/mpipe/mpipe_src.h>
#include <zephyr/mpipe/mpipe_sink.h>

struct mpipe_bin_api_fixture {
	struct mpipe_bin bin;
	struct mpipe pipeline;
	struct mpipe_sink sink;
	struct mpipe_src src;
};

static void *bin_suite_setup(void)
{
	static struct mpipe_bin_api_fixture fixture;

	return &fixture;
}

static void bin_before(void *f)
{
	struct mpipe_bin_api_fixture *fix = f;

	memset(fix, 0, sizeof(*fix));
	zassert_ok(mpipe_bin_init(&fix->bin, 0));
	zassert_ok(mpipe_src_init(&fix->src, 1));
	zassert_ok(mpipe_sink_init(&fix->sink, 2));

	zassert_equal(fix->bin.children_num, 0, "children_num != 0 after init");
	zassert_true(sys_dlist_is_empty(&fix->bin.children), "children list not empty after init");
	zassert_equal(((struct mpipe_element *)&fix->bin)->current_state, MPIPE_STATE_READY,
		      "state != READY after init");
}

ZTEST_SUITE(mpipe_bin_api, NULL, bin_suite_setup, bin_before, NULL, NULL);

ZTEST_F(mpipe_bin_api, test_add_elements)
{
	zassert_ok(mpipe_bin_add(&fixture->bin, NULL), "mpipe_bin_add(NULL) failed");
	zassert_equal(fixture->bin.children_num, 0, "children_num != 0");

	zassert_ok(mpipe_bin_add(&fixture->bin, (struct mpipe_element *)&fixture->src, NULL),
		   "mpipe_bin_add(src) failed");
	zassert_equal(fixture->bin.children_num, 1, "children_num != 1");
	zassert_equal(fixture->src.element.object.container, (struct mpipe_object *)&fixture->bin,
		      "src container != bin");

	zassert_ok(mpipe_bin_add(&fixture->bin, (struct mpipe_element *)&fixture->sink, NULL),
		   "mpipe_bin_add(sink) failed");
	zassert_equal(fixture->bin.children_num, 2, "children_num != 2");

	sys_dnode_t *first = sys_dlist_peek_head(&fixture->bin.children);

	zassert_not_null(first, "children list is empty");

	struct mpipe_element *first_elem = CONTAINER_OF(first, struct mpipe_element, object.node);

	zassert_equal(first_elem->object.id, 1, "first child id != 1");

	struct mpipe_src dup_src;

	memset(&dup_src, 0, sizeof(dup_src));
	zassert_ok(mpipe_src_init(&dup_src, 1));

	zassert_true(mpipe_bin_add(&fixture->bin, (struct mpipe_element *)&dup_src, NULL) < 0,
		     "duplicate id add did not fail");
	zassert_equal(fixture->bin.children_num, 2, "children_num changed on failed add");
}

ZTEST_F(mpipe_bin_api, test_add_varargs)
{
	zassert_ok(mpipe_bin_add(&fixture->bin, (struct mpipe_element *)&fixture->src,
				 (struct mpipe_element *)&fixture->sink, NULL),
		   "mpipe_bin_add(src, sink) failed");
	zassert_equal(fixture->bin.children_num, 2, "children_num != 2");
}
```

## src/test_buffer.c
```c
/*
 * Copyright 2026 NXP
 *
 * SPDX-License-Identifier: Apache-2.0
 */

/*
 * Buffer pools: what a pool requires stays apart from what a negotiation
 * settled on, and a stop forgets the latter, so one run's demands are not the
 * next run's floor.
 */

#include <zephyr/kernel.h>
#include <zephyr/ztest.h>

#include <zephyr/mpipe/mpipe_buffer.h>
#include <zephyr/mpipe/mpipe_structure.h>

struct mpipe_buffer_api_fixture {
	struct mpipe_buffer_pool pool;
};

static void *buffer_suite_setup(void)
{
	static struct mpipe_buffer_api_fixture fixture;

	return &fixture;
}

static void buffer_before(void *f)
{
	struct mpipe_buffer_api_fixture *fix = f;
	const struct mpipe_buffer_pool_config req = {
		.size = 1024,
		.align = 4,
		.min_buffers = 2,
		.max_buffers = 8,
	};

	memset(fix, 0, sizeof(*fix));

	mpipe_buffer_pool_init(&fix->pool);
	zassert_false(fix->pool.started, "pool.started != false after init");
	zassert_ok(mpipe_buffer_pool_set_req_config(&fix->pool, &req),
		   "stating the requirement failed");
}

ZTEST_SUITE(mpipe_buffer_api, NULL, buffer_suite_setup, buffer_before, NULL, NULL);

/* A pool with no hook has nothing to do, which is a state and not an error */
ZTEST_F(mpipe_buffer_api, test_a_pool_without_hooks_reports_enosys)
{
	struct mpipe_structure config;

	zassert_ok(mpipe_structure_init(&config, MPIPE_MEDIA_AUDIO_PCM), "config init failed");

	zassert_equal(mpipe_buffer_pool_configure(&fixture->pool, &config), -ENOSYS,
		      "configure without a hook did not report -ENOSYS");
	zassert_equal(mpipe_buffer_pool_start(&fixture->pool), -ENOSYS,
		      "start without a hook did not report -ENOSYS");
	zassert_equal(mpipe_buffer_pool_stop(&fixture->pool), -ENOSYS,
		      "stop without a hook did not report -ENOSYS");
}

/* The requirement is the floor a run starts from, so init seeds both configs */
ZTEST_F(mpipe_buffer_api, test_req_config_seeds_the_live_config)
{
	zassert_equal(fixture->pool.config.min_buffers, 2, "live config did not take the floor");
	zassert_equal(fixture->pool.config.align, 4, "live align did not take the floor");
	zassert_equal(fixture->pool.req_config.min_buffers, 2, "requirement not stored");
}

/*
 * The heart of it: a run's negotiated demands must not survive into the next
 * one. This is the JPEG parser's extra buffer, applied twice.
 */
ZTEST_F(mpipe_buffer_api, test_stop_forgets_what_the_run_negotiated)
{
	struct mpipe_buffer_pool_config negotiated;

	for (int run = 0; run < 3; run++) {
		/* Every run starts from the requirement, never from the last run */
		zassert_equal(fixture->pool.config.min_buffers, 2,
			      "run %d started from the previous run's demand", run);

		negotiated = fixture->pool.config;
		negotiated.min_buffers += 1;
		zassert_ok(mpipe_buffer_pool_set_config(&fixture->pool, &negotiated),
			   "applying the negotiated config failed");
		zassert_equal(fixture->pool.config.min_buffers, 3, "the demand did not reach it");

		zassert_ok(mpipe_buffer_pool_stop(&fixture->pool), "stop failed");
	}
}

/*
 * A pool can be proposed upstream, have a demand written into it, and then be
 * turned down without ever starting. It still has to forget the demand, which
 * is why the reset sits before the not-started early return.
 */
ZTEST_F(mpipe_buffer_api, test_stop_resets_a_pool_that_never_started)
{
	struct mpipe_buffer_pool_config negotiated = fixture->pool.config;

	negotiated.min_buffers = 7;
	zassert_ok(mpipe_buffer_pool_set_config(&fixture->pool, &negotiated), "set_config failed");
	zassert_equal(fixture->pool.config.min_buffers, 7, "the demand did not reach it");

	zassert_false(fixture->pool.started, "the pool should not be started");
	zassert_ok(mpipe_buffer_pool_stop(&fixture->pool), "stop of an unstarted pool failed");
	zassert_equal(fixture->pool.config.min_buffers, 2, "an unstarted pool kept the demand");
}

/* A started pool cannot be reconfigured under the elements already using it */
ZTEST_F(mpipe_buffer_api, test_a_started_pool_refuses_reconfiguration)
{
	struct mpipe_buffer_pool_config negotiated = fixture->pool.config;

	fixture->pool.started = true;
	negotiated.min_buffers = 5;

	zassert_equal(mpipe_buffer_pool_set_config(&fixture->pool, &negotiated), -EBUSY,
		      "a started pool accepted a new config");
	zassert_equal(mpipe_buffer_pool_set_req_config(&fixture->pool, &negotiated), -EBUSY,
		      "a started pool accepted a new requirement");
	zassert_equal(fixture->pool.config.min_buffers, 2, "the refused config was applied anyway");
}

static int refusing_set_config(struct mpipe_buffer_pool *pool,
			       const struct mpipe_buffer_pool_config *cfg)
{
	ARG_UNUSED(pool);
	ARG_UNUSED(cfg);

	return -ENOSPC;
}

static int clamping_set_config(struct mpipe_buffer_pool *pool,
			       const struct mpipe_buffer_pool_config *cfg)
{
	pool->config = *cfg;
	pool->config.min_buffers = MIN(cfg->min_buffers, 4);

	return 0;
}

/*
 * The demand reaches a pool only through its owner, which may accept it, clamp
 * it, or refuse. A refusal must leave the pool as it was: that is what lets an
 * adopter fall back to its own pool, as the JPEG parser does.
 */
ZTEST_F(mpipe_buffer_api, test_the_owner_decides_what_it_accepts)
{
	struct mpipe_buffer_pool_config negotiated = fixture->pool.config;

	negotiated.min_buffers = 6;

	fixture->pool.set_config = refusing_set_config;
	zassert_equal(mpipe_buffer_pool_set_config(&fixture->pool, &negotiated), -ENOSPC,
		      "the pool's refusal was not reported");
	zassert_equal(fixture->pool.config.min_buffers, 2, "a refused config was applied anyway");

	fixture->pool.set_config = clamping_set_config;
	zassert_ok(mpipe_buffer_pool_set_config(&fixture->pool, &negotiated), "set_config failed");
	zassert_equal(fixture->pool.config.min_buffers, 4, "the pool's clamp was not honored");

	/* Stopping still restores the requirement, whatever the owner accepted */
	zassert_ok(mpipe_buffer_pool_stop(&fixture->pool), "stop failed");
	zassert_equal(fixture->pool.config.min_buffers, 2, "stop did not restore the requirement");
}
```

## src/test_element.c
```c
/*
 * Copyright 2026 NXP
 *
 * SPDX-License-Identifier: Apache-2.0
 */

#include <zephyr/kernel.h>
#include <zephyr/ztest.h>
#include <zephyr/ztest_assert.h>

#include <zephyr/mpipe/mpipe_bin.h>
#include <zephyr/mpipe/mpipe_element.h>
#include <zephyr/mpipe/mpipe_pad.h>
#include <zephyr/mpipe/mpipe_pipeline.h>
#include <zephyr/mpipe/mpipe_sink.h>
#include <zephyr/mpipe/mpipe_src.h>

struct mpipe_element_api_fixture {
	struct mpipe pipeline;
	struct mpipe_element src;
	struct mpipe_element sink;
	struct mpipe_pad src_pad;
	struct mpipe_pad sink_pad;
};

static void *element_suite_setup(void)
{
	static struct mpipe_element_api_fixture fixture;

	return &fixture;
}

static void element_before(void *f)
{
	struct mpipe_element_api_fixture *fix = f;

	memset(fix, 0, sizeof(*fix));
	mpipe_element_init(&fix->src, 1);
	mpipe_element_init(&fix->sink, 2);
	mpipe_pad_init(&fix->src_pad, 0, MPIPE_PAD_SRC, MPIPE_PAD_ALWAYS);
	mpipe_pad_init(&fix->sink_pad, 1, MPIPE_PAD_SINK, MPIPE_PAD_ALWAYS);

	mpipe_structure_init_any(&fix->src_pad.caps);
	mpipe_structure_init_any(&fix->sink_pad.caps);

	zassert_equal(fix->src.object.id, 1, "Element ID shall be set by init");
	zassert_equal(fix->src.current_state, MPIPE_STATE_READY,
		      "Element shall start in READY state after init");
	zassert_true(sys_dlist_is_empty(&fix->src.src_pads),
		     "src_pads list shall be empty after init");
	zassert_true(sys_dlist_is_empty(&fix->sink.sink_pads),
		     "sink_pads list shall be empty after init");
}

ZTEST_SUITE(mpipe_element_api, NULL, element_suite_setup, element_before, NULL, NULL);

ZTEST_F(mpipe_element_api, test_link_two_elements)
{

	/* Add both pads and verify they are registered on the element */
	mpipe_element_add_pad(&fixture->src, &fixture->src_pad);
	zassert_false(sys_dlist_is_empty(&fixture->src.src_pads),
		      "src_pads shall not be empty after adding src pad");
	zassert_equal(fixture->src_pad.object.container, (struct mpipe_object *)&fixture->src,
		      "Pad container shall reference the owning element");

	mpipe_element_add_pad(&fixture->sink, &fixture->sink_pad);
	zassert_false(sys_dlist_is_empty(&fixture->sink.sink_pads),
		      "sink_pads shall not be empty after adding sink pad");
	zassert_equal(fixture->sink_pad.object.container, (struct mpipe_object *)&fixture->sink,
		      "Pad container shall reference the owning element");

	zassert_ok(mpipe_element_link(&fixture->src, &fixture->sink, NULL),
		   "Linking src and sink elements shall succeed");
	zassert_true(fixture->sink_pad.peer == &fixture->src_pad,
		     "sink pad peer must be linked to src pad");
	zassert_true(fixture->src_pad.peer == &fixture->sink_pad,
		     "src pad peer must be linked to sink pad");
}

/*
 * A bus lives on a bin, so a bin answers with its own and anything else with
 * the bin holding it. A nested bin is what makes "nearest" observable: its
 * children get its bus and stop there, rather than reaching the pipeline.
 */
ZTEST_F(mpipe_element_api, test_get_bus_finds_the_nearest_bin)
{
	struct mpipe_bin nested;
	struct mpipe_element child;
	struct mpipe_element orphan;

	memset(&nested, 0, sizeof(nested));
	memset(&child, 0, sizeof(child));
	memset(&orphan, 0, sizeof(orphan));

	zassert_ok(mpipe_pipeline_init(&fixture->pipeline, 0));
	zassert_ok(mpipe_bin_init(&nested, 1));
	mpipe_element_init(&child, 2);
	mpipe_element_init(&orphan, 3);

	/* Held by no bin, so there is nothing to hand out */
	zassert_is_null(mpipe_element_get_bus_chan(&orphan),
			"An element outside any bin shall have no bus");

	/* A pipeline has no container, and answers with its own bus */
	zassert_equal(mpipe_element_get_bus_chan((struct mpipe_element *)&fixture->pipeline),
		      &fixture->pipeline.bin.bus.channel,
		      "A pipeline shall answer with its own bus");

	zassert_ok(mpipe_bin_add((struct mpipe_bin *)&fixture->pipeline,
				 (struct mpipe_element *)&nested, NULL),
		   "mpipe_bin_add shall succeed");
	zassert_ok(mpipe_bin_add(&nested, &child, NULL), "mpipe_bin_add shall succeed");

	/* A bin answers with its own bus whether or not another bin holds it */
	zassert_equal(mpipe_element_get_bus_chan((struct mpipe_element *)&nested),
		      &nested.bus.channel,
		      "A nested bin shall answer with its own bus, not its parent's");

	/* The whole point of "nearest": the walk stops at the bin holding it */
	zassert_equal(mpipe_element_get_bus_chan(&child), &nested.bus.channel,
		      "A child shall get the bus of the bin holding it");
	zassert_not_equal(mpipe_element_get_bus_chan(&child), &fixture->pipeline.bin.bus.channel,
			  "A child shall not reach past its bin to the pipeline");
}

ZTEST_F(mpipe_element_api, test_sanity)
{
	/* Unknown direction pad shall not appear in either list */
	struct mpipe_element elem;
	struct mpipe_pad pad;

	memset(&elem, 0, sizeof(elem));
	memset(&pad, 0, sizeof(pad));
	mpipe_element_init(&elem, 1);

	mpipe_pad_init(&pad, 0, MPIPE_PAD_UNKNOWN, MPIPE_PAD_ALWAYS);
	mpipe_element_add_pad(&elem, &pad);

	zassert_true(sys_dlist_is_empty(&elem.src_pads),
		     "src_pads shall remain empty for UNKNOWN direction pad");
	zassert_true(sys_dlist_is_empty(&elem.sink_pads),
		     "sink_pads shall remain empty for UNKNOWN direction pad");

	/* Linking elements without pads shall fail */
	struct mpipe_element src, sink;

	memset(&src, 0, sizeof(src));
	memset(&sink, 0, sizeof(sink));
	mpipe_element_init(&src, 1);
	mpipe_element_init(&sink, 2);

	zassert_true(mpipe_element_link(&src, &sink, NULL) < 0,
		     "Linking elements without pads shall fail");
}
```

## src/test_pad.c
```c
/*
 * Copyright 2026 NXP
 *
 * SPDX-License-Identifier: Apache-2.0
 */

#include <zephyr/kernel.h>
#include <zephyr/ztest.h>

#include <zephyr/mpipe/mpipe_dispatch.h>
#include <zephyr/mpipe/mpipe_element.h>
#include <zephyr/mpipe/mpipe_pad.h>
#include <zephyr/mpipe/mpipe_structure.h>
#include <zephyr/mpipe/mpipe_value.h>

struct mpipe_pad_api_fixture {
	struct mpipe_pad src_pad;
	struct mpipe_pad sink_pad;
};

static void *pad_suite_setup(void)
{
	static struct mpipe_pad_api_fixture fixture;

	return &fixture;
}

static void pad_before(void *f)
{
	struct mpipe_pad_api_fixture *fix = f;

	memset(&fix->src_pad, 0, sizeof(fix->src_pad));
	memset(&fix->sink_pad, 0, sizeof(fix->sink_pad));

	mpipe_pad_init(&fix->src_pad, 0, MPIPE_PAD_SRC, MPIPE_PAD_ALWAYS);
	mpipe_pad_init(&fix->sink_pad, 1, MPIPE_PAD_SINK, MPIPE_PAD_ALWAYS);

	zassert_equal(fix->src_pad.object.id, 0, "id != 0 after init");
	zassert_equal(fix->src_pad.direction, MPIPE_PAD_SRC, "direction != SRC");
	zassert_equal(fix->sink_pad.direction, MPIPE_PAD_SINK, "direction != SINK");
	zassert_equal(fix->src_pad.presence, MPIPE_PAD_ALWAYS, "presence != ALWAYS");
	zassert_true(mpipe_structure_is_any(&fix->src_pad.caps), "caps not ANY after init");
	zassert_is_null(fix->src_pad.peer, "peer != NULL after init");
	zassert_equal(fix->src_pad.mode, MPIPE_PAD_MODE_NONE, "mode != NONE after init");
}

static void pad_after(void *f)
{
	struct mpipe_pad_api_fixture *fix = f;

	mpipe_structure_clear(&fix->src_pad.caps);
	mpipe_structure_clear(&fix->sink_pad.caps);
}

ZTEST_SUITE(mpipe_pad_api, NULL, pad_suite_setup, pad_before, pad_after, NULL);

ZTEST_F(mpipe_pad_api, test_link_sets_peers)
{
	mpipe_pad_link(&fixture->src_pad, &fixture->sink_pad);
	zassert_equal(fixture->src_pad.peer, &fixture->sink_pad, "src_pad peer != sink_pad");
	zassert_equal(fixture->sink_pad.peer, &fixture->src_pad, "sink_pad peer != src_pad");
}

/* A pad with no hook has no answer to give, which is a state and not an error */
ZTEST_F(mpipe_pad_api, test_a_pad_without_a_hook_answers_nothing)
{
	struct mpipe_dispatch query = {.type = MPIPE_DISPATCH_CAPS};
	struct mpipe_dispatch event = {.type = MPIPE_DISPATCH_EOS};
	struct mpipe_structure caps;

	zassert_ok(mpipe_structure_init_any(&caps), "caps init failed");
	query.caps = &caps;

	fixture->src_pad.query_fn = NULL;
	zassert_equal(mpipe_pad_query(&fixture->src_pad, &query), -ENOTSUP,
		      "a pad with no query hook did not report -ENOTSUP");

	fixture->src_pad.event_fn = NULL;
	zassert_equal(mpipe_pad_send_event(&fixture->src_pad, &event), -ENOTSUP,
		      "a pad with no event hook did not report -ENOTSUP");
}

static bool caps_query_fn_ran;

/* Answers a caps query the way a real one does, by writing into the storage it
 * carries. Dereferences it unguarded, which is what the refusal below protects.
 */
static int fake_caps_query_fn(struct mpipe_pad *pad, struct mpipe_dispatch *query)
{
	struct mpipe_value bitwidth = {.type = MPIPE_TYPE_UINT, .v_uint = 16U};

	ARG_UNUSED(pad);

	caps_query_fn_ran = true;

	if (mpipe_structure_init(query->caps, MPIPE_MEDIA_AUDIO_PCM) != 0) {
		return -EINVAL;
	}

	return mpipe_structure_append_value(query->caps, MPIPE_CAPS_BITWIDTH, &bitwidth);
}

ZTEST_F(mpipe_pad_api, test_caps_query_needs_storage_to_answer)
{
	struct mpipe_dispatch query = {.type = MPIPE_DISPATCH_CAPS, .caps = NULL};
	struct mpipe_structure caps;

	caps_query_fn_ran = false;
	fixture->src_pad.query_fn = fake_caps_query_fn;

	/* A caps query is answered into the storage it carries, so one that
	 * carries none is refused before the query function can dereference it.
	 */
	zassert_equal(mpipe_pad_query(&fixture->src_pad, &query), -EINVAL,
		      "caps query with no storage != -EINVAL");
	zassert_false(caps_query_fn_ran, "query function ran on a caps query with no storage");

	/* The same query, given storage, reaches the query function */
	query.caps = &caps;
	zassert_ok(mpipe_pad_query(&fixture->src_pad, &query), "caps query with storage failed");
	zassert_true(caps_query_fn_ran, "query function did not run");
	zassert_equal(mpipe_value_get_uint(mpipe_structure_get_value(&caps, MPIPE_CAPS_BITWIDTH)),
		      16U, "the answer did not reach the caller's storage");
}

/* Reports two capabilities, distinguished by their bit width */
static int fake_enum_caps(struct mpipe_pad *pad, uint32_t index,
			  const struct mpipe_structure *filter, struct mpipe_structure *out)
{
	static const uint32_t widths[] = {16U, 24U};
	struct mpipe_structure candidate;
	struct mpipe_value value;
	int ret;

	ARG_UNUSED(pad);

	if (index >= ARRAY_SIZE(widths)) {
		return -ENOENT;
	}

	mpipe_structure_init(&candidate, MPIPE_MEDIA_AUDIO_PCM);
	value.type = MPIPE_TYPE_UINT;
	value.v_uint = widths[index];
	zassert_ok(mpipe_structure_append_value(&candidate, MPIPE_CAPS_BITWIDTH, &value),
		   "append failed");

	if (filter == NULL) {
		*out = candidate;
		return 0;
	}

	ret = mpipe_structure_intersect(&candidate, filter, out);

	return (ret != 0) ? -EAGAIN : 0;
}

ZTEST_F(mpipe_pad_api, test_enum_caps)
{
	struct mpipe_structure out;
	struct mpipe_structure filter;
	struct mpipe_value bitwidth = {.type = MPIPE_TYPE_UINT};

	/* The default produces the pad's own capability, which is ANY here */
	zassert_ok(mpipe_pad_enum_caps(&fixture->src_pad, 0, NULL, &out), "default enum failed");
	zassert_true(mpipe_structure_is_any(&out), "ANY caps did not enumerate an ANY structure");
	zassert_equal(mpipe_pad_enum_caps(&fixture->src_pad, 1, NULL, &out), -ENOENT,
		      "ANY caps enumerated more than once");

	fixture->src_pad.enum_caps_fn = fake_enum_caps;

	zassert_ok(mpipe_pad_enum_caps(&fixture->src_pad, 1, NULL, &out), "enum 1 failed");
	zassert_equal(mpipe_value_get_uint(mpipe_structure_get_value(&out, MPIPE_CAPS_BITWIDTH)),
		      24U, "wrong capability at index 1");

	/* A filter only the second capability satisfies */
	zassert_ok(mpipe_structure_init(&filter, MPIPE_MEDIA_AUDIO_PCM), "filter init failed");
	bitwidth.v_uint = 24U;
	zassert_ok(mpipe_structure_append_value(&filter, MPIPE_CAPS_BITWIDTH, &bitwidth),
		   "filter append failed");

	zassert_equal(mpipe_pad_enum_caps(&fixture->src_pad, 0, &filter, &out), -EAGAIN,
		      "unmatched index != -EAGAIN");
	zassert_ok(mpipe_pad_enum_caps(&fixture->src_pad, 1, &filter, &out), "matching 1 failed");

	/* The search skips what does not match and stops at what does */
	zassert_ok(mpipe_pad_enum_first(&fixture->src_pad, &filter, &out), "enum_first failed");
	zassert_equal(mpipe_value_get_uint(mpipe_structure_get_value(&out, MPIPE_CAPS_BITWIDTH)),
		      24U, "enum_first picked the wrong capability");

	/* No filter means the first capability wins */
	zassert_ok(mpipe_pad_enum_first(&fixture->src_pad, NULL, &out), "enum_first(NULL) failed");
	zassert_equal(mpipe_value_get_uint(mpipe_structure_get_value(&out, MPIPE_CAPS_BITWIDTH)),
		      16U, "enum_first(NULL) did not pick index 0");

	/* A filter nothing satisfies exhausts the enumeration */
	zassert_ok(mpipe_structure_init(&filter, MPIPE_MEDIA_AUDIO_PCM), "filter re-init failed");
	bitwidth.v_uint = 32U;
	zassert_ok(mpipe_structure_append_value(&filter, MPIPE_CAPS_BITWIDTH, &bitwidth),
		   "filter re-append failed");
	zassert_equal(mpipe_pad_enum_first(&fixture->src_pad, &filter, &out), -ENODATA,
		      "unsatisfiable filter != -ENODATA");

	fixture->src_pad.enum_caps_fn = NULL;
	zassert_equal(mpipe_pad_enum_caps(&fixture->src_pad, 0, NULL, &out), -EINVAL,
		      "enum without a hook != -EINVAL");
}
```

## src/test_structure.c
```c
/*
 * Copyright 2026 NXP
 *
 * SPDX-License-Identifier: Apache-2.0
 */

#include <zephyr/kernel.h>
#include <zephyr/ztest.h>

#include <zephyr/mpipe/mpipe_structure.h>
#include <zephyr/mpipe/mpipe_value.h>

#include "mpipe_test_helpers.h"

ZTEST_SUITE(mpipe_structure_api, NULL, NULL, NULL, NULL, NULL);

/* Field IDs used by intersection tests */
enum test_field {
	TEST_BOOL = 0,
	TEST_INT,
	TEST_UINT,
	TEST_RANGE_INT,
	TEST_RANGE_UINT,
};

ZTEST(mpipe_structure_api, test_new)
{
	struct mpipe_structure s;

	zassert_ok(mpipe_structure_init_fields(&s, MPIPE_MEDIA_AUDIO_PCM, MPIPE_CAPS_SAMPLE_RATE,
					       MPIPE_TYPE_INT, 48000, MPIPE_CAPS_BIT_WIDTH,
					       MPIPE_TYPE_INT, 16, MPIPE_CAPS_END),
		   "init &s failed");

	zassert_equal(s.media_type_id, MPIPE_MEDIA_AUDIO_PCM, "media_type_id mismatch");

	zassert_ok(mpipe_structure_remove_field(&s, MPIPE_CAPS_SAMPLE_RATE), "remove_field failed");
	zassert_is_null(mpipe_structure_get_value(&s, MPIPE_CAPS_SAMPLE_RATE),
			"removed field still found");
	zassert_not_null(mpipe_structure_get_value(&s, MPIPE_CAPS_BIT_WIDTH),
			 "non-removed field missing");

	mpipe_structure_clear(&s);
	zassert_is_null(mpipe_structure_get_value(&s, MPIPE_CAPS_BIT_WIDTH),
			"field found after clear");

	struct mpipe_structure si;

	zassert_ok(mpipe_structure_init(&si, MPIPE_MEDIA_AUDIO_PCM));

	struct mpipe_value appended;

	mpipe_value_set(&appended, MPIPE_TYPE_INT, 44100);

	zassert_ok(mpipe_structure_append_value(&si, MPIPE_CAPS_SAMPLE_RATE, &appended),
		   "append failed");

	const struct mpipe_value *retrieved =
		mpipe_structure_get_value(&si, MPIPE_CAPS_SAMPLE_RATE);

	zassert_not_null(retrieved, "appended field not found");
	zassert_equal(mpipe_value_get_int(retrieved), 44100, "retrieved value != 44100");

	struct mpipe_value dup_val;

	mpipe_value_set(&dup_val, MPIPE_TYPE_INT, 0);

	zassert_equal(mpipe_structure_append_value(&si, MPIPE_CAPS_SAMPLE_RATE, &dup_val), -EEXIST,
		      "duplicate field != -EEXIST");
}

ZTEST(mpipe_structure_api, test_is_fixed_fixate_duplicate)
{
	struct mpipe_structure fixed_s;

	zassert_ok(mpipe_structure_init_fields(
			   &fixed_s, MPIPE_MEDIA_AUDIO_PCM, MPIPE_CAPS_SAMPLE_RATE, MPIPE_TYPE_INT,
			   48000, MPIPE_CAPS_BIT_WIDTH, MPIPE_TYPE_INT, 16, MPIPE_CAPS_END),
		   "init &fixed_s failed");

	zassert_true(mpipe_structure_is_fixed(&fixed_s), "structure not fixed");

	struct mpipe_structure dup;

	dup = fixed_s;

	zassert_equal(dup.media_type_id, fixed_s.media_type_id, "media_type_id mismatch");
	zassert_equal(mpipe_value_get_int(mpipe_structure_get_value(&dup, MPIPE_CAPS_SAMPLE_RATE)),
		      48000, "duplicated value != 48000");

	struct mpipe_structure range_s;

	zassert_ok(mpipe_structure_init_fields(&range_s, MPIPE_MEDIA_AUDIO_PCM,
					       MPIPE_CAPS_SAMPLE_RATE, MPIPE_TYPE_INT_RANGE, 8000,
					       48000, 8000, MPIPE_CAPS_END),
		   "init &range_s failed");

	zassert_false(mpipe_structure_is_fixed(&range_s), "range structure is fixed");

	struct mpipe_structure fixated;

	zassert_ok(mpipe_structure_fixate(&range_s, &fixated), "fixate failed");

	zassert_true(mpipe_structure_is_fixed(&fixated), "&fixated structure not fixed");
}

/* Intersect two structures where all fields are primitive (fixed) values. */
ZTEST(mpipe_structure_api, test_intersect_primitive)
{
	struct mpipe_structure s1;

	zassert_ok(mpipe_structure_init_fields(&s1, MPIPE_MEDIA_AUDIO_PCM, TEST_BOOL,
					       MPIPE_TYPE_BOOLEAN, true, TEST_INT, MPIPE_TYPE_INT,
					       -123, TEST_UINT, MPIPE_TYPE_UINT, 123,
					       MPIPE_CAPS_END),
		   "init &s1 failed");
	struct mpipe_structure s2;

	zassert_ok(mpipe_structure_init_fields(&s2, MPIPE_MEDIA_AUDIO_PCM, TEST_BOOL,
					       MPIPE_TYPE_BOOLEAN, true, TEST_INT, MPIPE_TYPE_INT,
					       -123, TEST_UINT, MPIPE_TYPE_UINT, 123,
					       MPIPE_CAPS_END),
		   "init &s2 failed");

	struct mpipe_structure result;

	zassert_ok(mpipe_structure_intersect(&s1, &s2, &result), "intersect failed");

	const struct mpipe_value *v = mpipe_structure_get_value(&result, TEST_BOOL);

	validate_boolean_value(v, true);

	v = mpipe_structure_get_value(&result, TEST_INT);
	validate_int_value(v, -123);

	v = mpipe_structure_get_value(&result, TEST_UINT);
	validate_uint_value(v, 123);
}

/* Intersect a structure with an INT_RANGE field against a structure with a fixed INT value. */
ZTEST(mpipe_structure_api, test_intersect_int_range)
{
	struct {
		int value;
		int expected;
	} test_cases[] = {
		{INT_MIN, INT_MIN},
		{INT_MAX, INT_MAX},
		{(INT_MIN + INT_MAX) / 2, (INT_MIN + INT_MAX) / 2},
	};

	struct mpipe_structure s_range;

	zassert_ok(mpipe_structure_init_fields(&s_range, MPIPE_MEDIA_AUDIO_PCM, TEST_RANGE_INT,
					       MPIPE_TYPE_INT_RANGE, INT_MIN, INT_MAX, 1,
					       MPIPE_CAPS_END),
		   "init &s_range failed");

	for (int i = 0; i < ARRAY_SIZE(test_cases); i++) {
		struct mpipe_structure s_val;

		zassert_ok(mpipe_structure_init_fields(&s_val, MPIPE_MEDIA_AUDIO_PCM,
						       TEST_RANGE_INT, MPIPE_TYPE_INT,
						       test_cases[i].value, MPIPE_CAPS_END),
			   "init &s_val failed");

		struct mpipe_structure result;

		zassert_ok(mpipe_structure_intersect(&s_range, &s_val, &result),
			   "intersect failed");

		const struct mpipe_value *v = mpipe_structure_get_value(&result, TEST_RANGE_INT);

		validate_int_value(v, test_cases[i].expected);
	}
}

/* Intersect a structure with a UINT_RANGE field against a structure with a fixed UINT value. */
ZTEST(mpipe_structure_api, test_intersect_uint_range)
{
	struct {
		unsigned int expected;
		const char *description;
	} test_cases[] = {
		{0, "Zero value"},
		{UINT32_MAX, "Maximum value"},
		{UINT32_MAX / 2, "Mid-range value"},
	};

	struct mpipe_structure s_range;

	zassert_ok(mpipe_structure_init_fields(&s_range, MPIPE_MEDIA_AUDIO_PCM, TEST_RANGE_UINT,
					       MPIPE_TYPE_UINT_RANGE, 0, UINT32_MAX, 1,
					       MPIPE_CAPS_END),
		   "init &s_range failed");

	for (int i = 0; i < ARRAY_SIZE(test_cases); i++) {
		struct mpipe_structure s_val;

		zassert_ok(mpipe_structure_init_fields(&s_val, MPIPE_MEDIA_AUDIO_PCM,
						       TEST_RANGE_UINT, MPIPE_TYPE_UINT,
						       test_cases[i].expected, MPIPE_CAPS_END),
			   "init &s_val failed");

		struct mpipe_structure result;

		zassert_ok(mpipe_structure_intersect(&s_range, &s_val, &result),
			   "intersect failed");

		const struct mpipe_value *v = mpipe_structure_get_value(&result, TEST_RANGE_UINT);

		validate_uint_value(v, test_cases[i].expected);
	}
}

/* Intersect structures whose field sets only partly overlap. */
ZTEST(mpipe_structure_api, test_intersect_asymmetric_fields)
{
	struct mpipe_structure s1;

	zassert_ok(mpipe_structure_init_fields(&s1, MPIPE_MEDIA_AUDIO_PCM, TEST_INT, MPIPE_TYPE_INT,
					       -42, TEST_UINT, MPIPE_TYPE_UINT, 100U,
					       MPIPE_CAPS_END),
		   "init &s1 failed");
	struct mpipe_structure s2;

	zassert_ok(mpipe_structure_init_fields(&s2, MPIPE_MEDIA_AUDIO_PCM, TEST_UINT,
					       MPIPE_TYPE_UINT, 100U, TEST_BOOL, MPIPE_TYPE_BOOLEAN,
					       true, MPIPE_CAPS_END),
		   "init &s2 failed");

	struct mpipe_structure result;

	zassert_ok(mpipe_structure_intersect(&s1, &s2, &result), "intersect failed");

	zassert_equal(result.num_fields, 3, "&result field count != 3");
	const struct mpipe_value *v = mpipe_structure_get_value(&result, TEST_INT);

	validate_int_value(v, -42);

	v = mpipe_structure_get_value(&result, TEST_UINT);
	validate_uint_value(v, 100U);

	v = mpipe_structure_get_value(&result, TEST_BOOL);
	validate_boolean_value(v, true);
}

/* A structure that constrains nothing intersects with anything. */
ZTEST(mpipe_structure_api, test_any_structure)
{
	struct mpipe_structure any;
	struct mpipe_structure result;

	zassert_ok(mpipe_structure_init_any(&any));
	zassert_true(mpipe_structure_is_any(&any), "init_any did not mark the structure");
	zassert_false(mpipe_structure_is_fixed(&any), "an ANY structure must not be fixed");

	/* Nothing to choose, so there is nothing to fixate */
	zassert_equal(mpipe_structure_fixate(&any, &result), -ENOENT, "fixate(ANY) != -ENOENT");

	struct mpipe_structure concrete;

	zassert_ok(mpipe_structure_init_fields(&concrete, MPIPE_MEDIA_AUDIO_PCM, TEST_UINT,
					       MPIPE_TYPE_UINT, 100U, TEST_RANGE_UINT,
					       MPIPE_TYPE_UINT_RANGE, 0, 50, 1, MPIPE_CAPS_END),
		   "init &concrete failed");

	/* ANY on either side yields the other side unchanged */
	zassert_ok(mpipe_structure_intersect(&any, &concrete, &result), "ANY x C failed");
	zassert_equal(result.num_fields, 2, "ANY x C lost a field");
	validate_uint_value(mpipe_structure_get_value(&result, TEST_UINT), 100U);
	validate_uint_range_value(mpipe_structure_get_value(&result, TEST_RANGE_UINT), 0, 50, 1);

	zassert_ok(mpipe_structure_intersect(&concrete, &any, &result), "C x ANY failed");
	zassert_equal(result.num_fields, 2, "C x ANY lost a field");

	/* An empty structure is not an ANY structure: it intersects with nothing */
	struct mpipe_structure empty;

	zassert_ok(mpipe_structure_init(&empty, MPIPE_MEDIA_AUDIO_PCM));
	zassert_false(mpipe_structure_is_any(&empty), "an empty structure must not be ANY");
	zassert_equal(mpipe_structure_intersect(&empty, &concrete, &result), -ENOENT,
		      "empty x C != -ENOENT");

	/*
	 * An empty structure constrains nothing just as an ANY one does, so both
	 * report the same: nothing has settled, and there is nothing to fixate.
	 */
	zassert_false(mpipe_structure_is_fixed(&empty), "an empty structure must not be fixed");
	zassert_equal(mpipe_structure_fixate(&empty, &result), -ENOENT, "fixate(empty) != -ENOENT");
}

ZTEST(mpipe_structure_api, test_cannot_intersect)
{
	struct mpipe_structure result;
	struct mpipe_structure s_sample_int;

	zassert_ok(mpipe_structure_init_fields(&s_sample_int, MPIPE_MEDIA_AUDIO_PCM,
					       MPIPE_CAPS_SAMPLE_RATE, MPIPE_TYPE_INT, 48000,
					       MPIPE_CAPS_END),
		   "init &s_sample_int failed");
	struct mpipe_structure s_bw;

	zassert_ok(mpipe_structure_init_fields(&s_bw, MPIPE_MEDIA_AUDIO_PCM, MPIPE_CAPS_BIT_WIDTH,
					       MPIPE_TYPE_INT, 16, MPIPE_CAPS_END),
		   "init &s_bw failed");
	struct mpipe_structure s_low;

	zassert_ok(mpipe_structure_init_fields(&s_low, MPIPE_MEDIA_AUDIO_PCM,
					       MPIPE_CAPS_SAMPLE_RATE, MPIPE_TYPE_INT_RANGE, 8000,
					       16000, 8000, MPIPE_CAPS_END),
		   "init &s_low failed");

	zassert_not_equal(mpipe_structure_intersect(&s_sample_int, &s_bw, &result), 0,
			  "intersect with no common field should fail");

	zassert_not_equal(mpipe_structure_intersect(&s_low, &s_sample_int, &result), 0,
			  "intersect with incompatible field value should fail");
}

/*
 * A tensor capability: MPIPE_MEDIA_TENSOR with MPIPE_CAPS_TENSOR_TYPE, reusing
 * the image geometry fields for an image-shaped tensor.
 */
ZTEST(mpipe_structure_api, test_tensor_media)
{
	struct mpipe_structure model_in;
	struct mpipe_structure conv_out;
	struct mpipe_structure other_type;
	struct mpipe_structure video;
	struct mpipe_structure result;
	const struct mpipe_value *v;

	/* A model input: fixed type and geometry, as an inference sink pad offers */
	zassert_ok(mpipe_structure_init_fields(
			   &model_in, MPIPE_MEDIA_TENSOR, MPIPE_CAPS_TENSOR_TYPE, MPIPE_TYPE_UINT,
			   1, MPIPE_CAPS_NUM_CHANNELS, MPIPE_TYPE_UINT, 1, MPIPE_CAPS_IMAGE_WIDTH,
			   MPIPE_TYPE_UINT, 96, MPIPE_CAPS_IMAGE_HEIGHT, MPIPE_TYPE_UINT, 96,
			   MPIPE_CAPS_END),
		   "init &model_in failed");

	zassert_equal(model_in.media_type_id, MPIPE_MEDIA_TENSOR, "media_type_id mismatch");

	v = mpipe_structure_get_value(&model_in, MPIPE_CAPS_TENSOR_TYPE);
	validate_uint_value(v, 1);

	/* A converter output: fixed type, open geometry, as a transform offers */
	zassert_ok(mpipe_structure_init_fields(
			   &conv_out, MPIPE_MEDIA_TENSOR, MPIPE_CAPS_TENSOR_TYPE, MPIPE_TYPE_UINT,
			   1, MPIPE_CAPS_NUM_CHANNELS, MPIPE_TYPE_UINT, 1, MPIPE_CAPS_END),
		   "init &conv_out failed");

	zassert_ok(mpipe_structure_intersect(&conv_out, &model_in, &result),
		   "tensor intersect failed");

	/* Geometry present on one side only passes through */
	v = mpipe_structure_get_value(&result, MPIPE_CAPS_IMAGE_WIDTH);
	validate_uint_value(v, 96);
	zassert_true(mpipe_structure_is_fixed(&result), "intersected tensor structure not fixed");
	mpipe_structure_clear(&result);

	/* A different type must not intersect */
	zassert_ok(mpipe_structure_init_fields(&other_type, MPIPE_MEDIA_TENSOR,
					       MPIPE_CAPS_TENSOR_TYPE, MPIPE_TYPE_UINT, 4,
					       MPIPE_CAPS_END),
		   "init &other_type failed");
	zassert_equal(mpipe_structure_intersect(&other_type, &model_in, &result), -ENOENT,
		      "different tensor types intersected");

	/* A different media type must not intersect, whatever the fields */
	zassert_ok(mpipe_structure_init_fields(&video, MPIPE_MEDIA_VIDEO, MPIPE_CAPS_IMAGE_WIDTH,
					       MPIPE_TYPE_UINT, 96, MPIPE_CAPS_END),
		   "init &video failed");
	zassert_equal(mpipe_structure_intersect(&video, &model_in, &result), -EINVAL,
		      "video x tensor != -EINVAL");

	mpipe_structure_clear(&model_in);
	mpipe_structure_clear(&conv_out);
	mpipe_structure_clear(&other_type);
	mpipe_structure_clear(&video);
}

ZTEST(mpipe_structure_api, test_sanity)
{
	struct mpipe_structure s;

	zassert_ok(mpipe_structure_init_fields(&s, MPIPE_MEDIA_AUDIO_PCM, MPIPE_CAPS_SAMPLE_RATE,
					       MPIPE_TYPE_INT, 48000, MPIPE_CAPS_END),
		   "init &s failed");

	zassert_is_null(mpipe_structure_get_value(&s, MPIPE_CAPS_IMAGE_WIDTH),
			"non-existent field != NULL");
	zassert_true(mpipe_structure_remove_field(&s, MPIPE_CAPS_IMAGE_WIDTH) < 0,
		     "remove non-existent field did not fail");
}

/* A structure holds CONFIG_MPIPE_STRUCTURE_MAX_FIELDS fields; the next one is refused. */
ZTEST(mpipe_structure_api, test_append_out_of_slots)
{
	struct mpipe_structure s;
	struct mpipe_value v;

	/* Filling every slot needs one more field identifier than there are slots */
	if (CONFIG_MPIPE_STRUCTURE_MAX_FIELDS >= MPIPE_CAPS_END) {
		ztest_test_skip();
	}

	zassert_ok(mpipe_structure_init(&s, MPIPE_MEDIA_AUDIO_PCM), "init &s failed");
	zassert_ok(mpipe_value_set(&v, MPIPE_TYPE_UINT, 1U), "set &v failed");

	for (uint8_t id = 0; id < CONFIG_MPIPE_STRUCTURE_MAX_FIELDS; id++) {
		zassert_ok(mpipe_structure_append_value(&s, id, &v), "append of field %u failed",
			   id);
	}

	zassert_equal(s.num_fields, CONFIG_MPIPE_STRUCTURE_MAX_FIELDS, "structure did not fill up");
	zassert_equal(mpipe_structure_append_value(&s, CONFIG_MPIPE_STRUCTURE_MAX_FIELDS, &v),
		      -ENOSPC, "append past the last slot did not report -ENOSPC");

	/* Freeing a slot makes room again */
	zassert_ok(mpipe_structure_remove_field(&s, 0), "remove_field failed");
	zassert_ok(mpipe_structure_append_value(&s, CONFIG_MPIPE_STRUCTURE_MAX_FIELDS, &v),
		   "append after freeing a slot failed");
}
```

## src/test_thread.c
```c
/*
 * Copyright 2025-2026 NXP
 *
 * SPDX-License-Identifier: Apache-2.0
 */

#include <zephyr/kernel.h>
#include <zephyr/ztest.h>
#include <zephyr/ztest_assert.h>

#include <zephyr/mpipe/mpipe_thread.h>

static struct k_sem thread_ran_sem;
static atomic_t thread_run_count;

static void simple_thread_func(void *p1, void *p2, void *p3)
{
	ARG_UNUSED(p2);
	ARG_UNUSED(p3);

	atomic_inc(&thread_run_count);
	k_sem_give((struct k_sem *)p1);
}

struct mpipe_thread_api_fixture {
	struct mpipe_thread thread;
};

static void *thread_suite_setup(void)
{
	static struct mpipe_thread_api_fixture fixture;

	return &fixture;
}

static void thread_before(void *f)
{
	struct mpipe_thread_api_fixture *fix = f;

	memset(&fix->thread, 0, sizeof(fix->thread));
	fix->thread.stack_id = -1;

	k_sem_init(&thread_ran_sem, 0, 1);
	atomic_set(&thread_run_count, 0);
}

ZTEST_SUITE(mpipe_thread_api, NULL, thread_suite_setup, thread_before, NULL, NULL);

ZTEST_F(mpipe_thread_api, test_create)
{
	k_tid_t tid =
		mpipe_thread_create(&fixture->thread, simple_thread_func, &thread_ran_sem, NULL,
				    NULL, CONFIG_MPIPE_THREAD_DEFAULT_PRIORITY, K_NO_WAIT);

	zassert_not_null(tid, "mpipe_thread_create returned NULL");
	zassert_true(fixture->thread.stack_id >= 0 &&
			     fixture->thread.stack_id < CONFIG_MPIPE_THREADS_NUM,
		     "stack_id %d out of range [0, %d)", fixture->thread.stack_id,
		     CONFIG_MPIPE_THREADS_NUM);

	int ret = k_sem_take(&thread_ran_sem, K_MSEC(1000));

	zassert_equal(ret, 0, "entry function not called within 1s");
	zassert_equal(atomic_get(&thread_run_count), 1, "entry function call count != 1");
}
```

## src/test_value.c
```c
/*
 * Copyright 2026 NXP
 *
 * SPDX-License-Identifier: Apache-2.0
 */

#include <zephyr/kernel.h>
#include <zephyr/ztest.h>

#include <zephyr/mpipe/mpipe_value.h>

ZTEST_SUITE(mpipe_value_api, NULL, NULL, NULL, NULL, NULL);

ZTEST(mpipe_value_api, test_new_values)
{
	struct mpipe_value bt;

	mpipe_value_set(&bt, MPIPE_TYPE_BOOLEAN, true);

	zassert_equal(bt.type, MPIPE_TYPE_BOOLEAN, "type != BOOLEAN");
	zassert_true(mpipe_value_get_boolean(&bt), "value != true");

	struct mpipe_value bf;

	mpipe_value_set(&bf, MPIPE_TYPE_BOOLEAN, false);

	zassert_false(mpipe_value_get_boolean(&bf), "value != false");

	struct mpipe_value iv;

	mpipe_value_set(&iv, MPIPE_TYPE_INT, -42);

	zassert_equal(iv.type, MPIPE_TYPE_INT, "type != INT");
	zassert_equal(mpipe_value_get_int(&iv), -42, "value != -42");

	struct mpipe_value uv;

	mpipe_value_set(&uv, MPIPE_TYPE_UINT, 123U);

	zassert_equal(uv.type, MPIPE_TYPE_UINT, "type != UINT");
	zassert_equal(mpipe_value_get_uint(&uv), 123U, "value != 123");

	struct mpipe_value rv;

	mpipe_value_set(&rv, MPIPE_TYPE_INT_RANGE, 8000, 48000, 8000);

	zassert_equal(rv.type, MPIPE_TYPE_INT_RANGE, "type != INT_RANGE");
	zassert_equal(mpipe_value_get_int_range_min(&rv), 8000, "min != 8000");
	zassert_equal(mpipe_value_get_int_range_max(&rv), 48000, "max != 48000");
	zassert_equal(mpipe_value_get_int_range_step(&rv), 8000, "step != 8000");

	struct mpipe_value ez;

	mpipe_value_set(&ez, MPIPE_TYPE_INT, 0);

	zassert_equal(mpipe_value_get_int(&ez), 0, "value != 0");
}

/* Two primitive values intersect when they are the same value, and not otherwise */
ZTEST(mpipe_value_api, test_primitive_equality)
{
	struct mpipe_value a;
	struct mpipe_value b;
	struct mpipe_value result;

	mpipe_value_set(&a, MPIPE_TYPE_INT, -42);
	mpipe_value_set(&b, MPIPE_TYPE_INT, -42);
	zassert_ok(mpipe_value_intersect(&a, &b, &result), "equal INT values did not intersect");
	zassert_equal(mpipe_value_get_int(&result), -42, "INT result != -42");

	mpipe_value_set(&b, MPIPE_TYPE_INT, 42);
	zassert_equal(mpipe_value_intersect(&a, &b, &result), -ENOENT,
		      "different INT values intersected");

	mpipe_value_set(&a, MPIPE_TYPE_UINT, 100U);
	mpipe_value_set(&b, MPIPE_TYPE_UINT, 100U);
	zassert_ok(mpipe_value_intersect(&a, &b, &result), "equal UINT values did not intersect");
	zassert_equal(mpipe_value_get_uint(&result), 100U, "UINT result != 100");

	mpipe_value_set(&b, MPIPE_TYPE_UINT, 200U);
	zassert_equal(mpipe_value_intersect(&a, &b, &result), -ENOENT,
		      "different UINT values intersected");

	mpipe_value_set(&a, MPIPE_TYPE_BOOLEAN, true);
	mpipe_value_set(&b, MPIPE_TYPE_BOOLEAN, true);
	zassert_ok(mpipe_value_intersect(&a, &b, &result),
		   "equal BOOLEAN values did not intersect");
	zassert_true(mpipe_value_get_boolean(&result), "BOOLEAN result != true");

	mpipe_value_set(&b, MPIPE_TYPE_BOOLEAN, false);
	zassert_equal(mpipe_value_intersect(&a, &b, &result), -ENOENT,
		      "different BOOLEAN values intersected");
}

ZTEST(mpipe_value_api, test_intersect)
{
	struct mpipe_value a;

	mpipe_value_set(&a, MPIPE_TYPE_INT, 48000);
	struct mpipe_value b;

	mpipe_value_set(&b, MPIPE_TYPE_INT, 48000);
	struct mpipe_value result;

	zassert_ok(mpipe_value_intersect(&a, &b, &result), "intersect(equal values) failed");
	zassert_equal(mpipe_value_get_int(&result), 48000, "result != 48000");

	struct mpipe_value range;

	mpipe_value_set(&range, MPIPE_TYPE_INT_RANGE, 8000, 48000, 8000);
	struct mpipe_value val;

	mpipe_value_set(&val, MPIPE_TYPE_INT, 16000);

	zassert_ok(mpipe_value_intersect(&range, &val, &result),
		   "intersect(value in &range) failed");
	zassert_equal(mpipe_value_get_int(&result), 16000, "result != 16000");
}

ZTEST(mpipe_value_api, test_copy_and_is_primitive)
{
	struct mpipe_value original;

	struct mpipe_value copy;

	/* A value owns nothing, so copying one is a plain assignment */
	mpipe_value_set(&original, MPIPE_TYPE_INT, 999);
	copy = original;
	zassert_equal(mpipe_value_get_int(&copy), 999, "copied value != 999");

	struct mpipe_value rorig;
	struct mpipe_value rcopy;

	mpipe_value_set(&rorig, MPIPE_TYPE_INT_RANGE, 1, 100, 1);
	rcopy = rorig;
	zassert_equal(mpipe_value_get_int_range_min(&rcopy), 1, "min != 1");
	zassert_equal(mpipe_value_get_int_range_max(&rcopy), 100, "max != 100");
	zassert_equal(mpipe_value_get_int_range_step(&rcopy), 1, "step != 1");

	struct mpipe_value iv;

	mpipe_value_set(&iv, MPIPE_TYPE_INT, 1);

	zassert_true(mpipe_value_is_primitive(&iv), "INT not primitive");

	struct mpipe_value bv;

	mpipe_value_set(&bv, MPIPE_TYPE_BOOLEAN, true);

	zassert_true(mpipe_value_is_primitive(&bv), "BOOLEAN not primitive");

	struct mpipe_value rv;

	mpipe_value_set(&rv, MPIPE_TYPE_INT_RANGE, 0, 10, 1);

	zassert_false(mpipe_value_is_primitive(&rv), "INT_RANGE is primitive");

	struct mpipe_value ci_a;

	mpipe_value_set(&ci_a, MPIPE_TYPE_INT, 10);
	struct mpipe_value ci_b;

	mpipe_value_set(&ci_b, MPIPE_TYPE_INT, 10);

	struct mpipe_value ci_out;

	zassert_ok(mpipe_value_intersect(&ci_a, &ci_b, &ci_out),
		   "same-type values cannot intersect");

	struct mpipe_value ci_range;

	mpipe_value_set(&ci_range, MPIPE_TYPE_INT_RANGE, 0, 100, 1);
	struct mpipe_value ci_val;

	mpipe_value_set(&ci_val, MPIPE_TYPE_INT, 50);

	zassert_ok(mpipe_value_intersect(&ci_range, &ci_val, &ci_out),
		   "&range and value cannot intersect");
}

ZTEST(mpipe_value_api, test_set_updates_value)
{
	struct mpipe_value val;

	mpipe_value_set(&val, MPIPE_TYPE_INT, 10);

	mpipe_value_set(&val, MPIPE_TYPE_INT, 99);
	zassert_equal(mpipe_value_get_int(&val), 99, "value != 99 after set");
}

ZTEST(mpipe_value_api, test_sanity)
{
	struct mpipe_value int_val;

	mpipe_value_set(&int_val, MPIPE_TYPE_INT, 42);
	struct mpipe_value uint_val;

	mpipe_value_set(&uint_val, MPIPE_TYPE_UINT, 42U);

	struct mpipe_value result;

	/* The same number under two types is not a common value */
	zassert_equal(mpipe_value_intersect(&int_val, &uint_val, &result), -ENOENT,
		      "values of different types intersect != -ENOENT");

	struct mpipe_value a;

	mpipe_value_set(&a, MPIPE_TYPE_INT, 100);
	struct mpipe_value b;

	mpipe_value_set(&b, MPIPE_TYPE_INT, 200);

	zassert_equal(mpipe_value_intersect(&a, &b, &result), -ENOENT,
		      "disjoint values intersect != -ENOENT");
}
```
