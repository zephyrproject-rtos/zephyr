## CMakeLists.txt
```
# SPDX-License-Identifier: Apache-2.0

cmake_minimum_required(VERSION 3.28.0)
find_package(Zephyr REQUIRED HINTS $ENV{ZEPHYR_BASE})
project(shell)

FILE(GLOB app_sources src/*.c)
target_sources(app PRIVATE ${app_sources})

if(CONFIG_SHELL_ALIASES_HAS_FILE)
  set(gen_dir ${ZEPHYR_BINARY_DIR}/include/generated/)
  set(aliases_src ${CONFIG_SHELL_ALIASES_FILE})

  generate_shell_aliases_inc_file_for_target(
    app
    ${aliases_src}
    ${gen_dir}/generated-shell-aliases.inc
  )
endif()
```

## prj.conf
```kconfig
CONFIG_SHELL=y
CONFIG_SHELL_BACKEND_SERIAL=n
CONFIG_SHELL_BACKEND_DUMMY=y
CONFIG_SHELL_CMDS_SELECT=y
CONFIG_SHELL_CMD_BUFF_SIZE=90
CONFIG_SHELL_PRINTF_BUFF_SIZE=15
CONFIG_SHELL_METAKEYS=n
CONFIG_LOG=n
CONFIG_ZTEST=y
CONFIG_TEST_LOGGING_DEFAULTS=n
# Remove the 50ms timeout to avoid potential failures (see commit description)
CONFIG_SHELL_TX_TIMEOUT_MS=0
```

## shell_min.conf
```kconfig
CONFIG_ZTEST=y
CONFIG_TEST_LOGGING_DEFAULTS=n
CONFIG_SHELL=y
CONFIG_SHELL_MINIMAL=y
CONFIG_SHELL_BACKEND_DUMMY=y
CONFIG_SHELL_BACKEND_SERIAL=n
CONFIG_THREAD_NAME=y
CONFIG_SHELL_STACK_SIZE=2048
#using CBPRINTF_NANO decreases significantly Flash usage.
CONFIG_CBPRINTF_NANO=y
CONFIG_LOG=n
CONFIG_THREAD_MONITOR=n
CONFIG_INIT_STACKS=y
CONFIG_BOOT_BANNER=n
```

## shell_min_cmds.conf
```kconfig
CONFIG_ZTEST=y
CONFIG_TEST_LOGGING_DEFAULTS=n
CONFIG_SHELL=y
CONFIG_SHELL_MINIMAL=y
CONFIG_SHELL_BACKEND_DUMMY=y
CONFIG_SHELL_BACKEND_SERIAL=n
CONFIG_THREAD_NAME=y
CONFIG_SHELL_STACK_SIZE=2048

#using CBPRINTF_NANO decreases significantly Flash usage.
CONFIG_CBPRINTF_NANO=y

CONFIG_LOG=n
#Shell features:
CONFIG_SHELL_CMDS=y


CONFIG_THREAD_MONITOR=n
CONFIG_INIT_STACKS=y
CONFIG_BOOT_BANNER=n
```

## shell_min_cmds_all.conf
```kconfig
CONFIG_ZTEST=y
CONFIG_TEST_LOGGING_DEFAULTS=n

CONFIG_SHELL=y
CONFIG_SHELL_MINIMAL=y
CONFIG_SHELL_BACKEND_DUMMY=y
CONFIG_SHELL_BACKEND_SERIAL=n
CONFIG_THREAD_NAME=y
CONFIG_SHELL_STACK_SIZE=2048

#using CBPRINTF_NANO decreases significantly Flash usage.
CONFIG_CBPRINTF_NANO=y

CONFIG_LOG=n
#Shell features:
CONFIG_SHELL_CMDS=y
CONFIG_SHELL_CMDS_RESIZE=y
CONFIG_SHELL_CMDS_SELECT=y


CONFIG_THREAD_MONITOR=n
CONFIG_INIT_STACKS=y
CONFIG_BOOT_BANNER=n
```

## shell_min_cmds_resize.conf
```kconfig
CONFIG_ZTEST=y
CONFIG_TEST_LOGGING_DEFAULTS=n

CONFIG_SHELL=y
CONFIG_SHELL_MINIMAL=y
CONFIG_SHELL_BACKEND_DUMMY=y
CONFIG_SHELL_BACKEND_SERIAL=n
CONFIG_THREAD_NAME=y
CONFIG_SHELL_STACK_SIZE=2048

#using CBPRINTF_NANO decreases significantly Flash usage.
CONFIG_CBPRINTF_NANO=y

CONFIG_LOG=n
#Shell features:
CONFIG_SHELL_CMDS=y
CONFIG_SHELL_CMDS_RESIZE=y


CONFIG_THREAD_MONITOR=n
CONFIG_INIT_STACKS=y
CONFIG_BOOT_BANNER=n
```

## shell_min_cmds_select.conf
```kconfig
CONFIG_ZTEST=y
CONFIG_TEST_LOGGING_DEFAULTS=n

CONFIG_SHELL=y
CONFIG_SHELL_MINIMAL=y
CONFIG_SHELL_BACKEND_DUMMY=y
CONFIG_SHELL_BACKEND_SERIAL=n
CONFIG_THREAD_NAME=y
CONFIG_SHELL_STACK_SIZE=2048

#using CBPRINTF_NANO decreases significantly Flash usage.
CONFIG_CBPRINTF_NANO=y

CONFIG_LOG=n
#Shell features:
CONFIG_SHELL_CMDS=y
CONFIG_SHELL_CMDS_SELECT=y


CONFIG_THREAD_MONITOR=n
CONFIG_INIT_STACKS=y
CONFIG_BOOT_BANNER=n
```

## shell_min_colors.conf
```kconfig
CONFIG_ZTEST=y
CONFIG_TEST_LOGGING_DEFAULTS=n

CONFIG_SHELL=y
CONFIG_SHELL_MINIMAL=y
CONFIG_SHELL_BACKEND_DUMMY=y
CONFIG_SHELL_BACKEND_SERIAL=n
CONFIG_THREAD_NAME=y
CONFIG_SHELL_STACK_SIZE=2048

#using CBPRINTF_NANO decreases significantly Flash usage.
CONFIG_CBPRINTF_NANO=y

CONFIG_LOG=n
#Shell features:
CONFIG_SHELL_VT100_COLORS=y


CONFIG_THREAD_MONITOR=n
CONFIG_INIT_STACKS=y
CONFIG_BOOT_BANNER=n
```

## src/test_module.c
```c
/*
 * Copyright (c) 2022 Nordic Semiconductor ASA
 *
 * SPDX-License-Identifier: Apache-2.0
 */
#include <zephyr/shell/shell.h>

static int cmd2_handler(const struct shell *sh, size_t argc, char **argv)
{
	ARG_UNUSED(sh);
	ARG_UNUSED(argc);
	ARG_UNUSED(argv);

	return 20;
}

SHELL_SUBCMD_ADD((section_cmd), cmd2, NULL, "help for cmd2", cmd2_handler, 1, 0);

static int sub_cmd1_handler(const struct shell *sh, size_t argc, char **argv)
{
	ARG_UNUSED(sh);
	ARG_UNUSED(argc);
	ARG_UNUSED(argv);

	return 11;
}

SHELL_SUBCMD_COND_ADD(1, (section_cmd, cmd1), sub_cmd1, NULL,
		      "help for sub cmd1", sub_cmd1_handler, 1, 0);

static int sub_cmd2_handler(const struct shell *sh, size_t argc, char **argv)
{
	ARG_UNUSED(sh);
	ARG_UNUSED(argc);
	ARG_UNUSED(argv);

	return 12;
}

/* Flag set to 0, command will not be compiled. Add to validate that setting
 * flag to 0 does not add command and does not generate any warnings.
 */
SHELL_SUBCMD_COND_ADD(0, (section_cmd, cmd1), sub_cmd2, NULL,
		      "help for sub cmd2", sub_cmd2_handler, 1, 0);
```
