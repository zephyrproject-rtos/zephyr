## tests/subsys/shell/shell/testcase.yaml
```yaml
common:
  tags: shell
  min_ram: 32
  integration_platforms:
    - native_sim

tests:
  shell.core:
    min_flash: 64

  shell.min:
    min_flash: 32
    extra_args: CONF_FILE=shell_min.conf
    build_only: true

  shell.min_cmds:
    min_flash: 32
    extra_args: CONF_FILE=shell_min_cmds.conf
    build_only: true

  shell.min_cmds_all:
    min_flash: 32
    extra_args: CONF_FILE=shell_min_cmds_all.conf
    build_only: true

  shell.min_cmds_resize:
    min_flash: 32
    extra_args: CONF_FILE=shell_min_cmds_resize.conf
    build_only: true

  shell.min_cmds_select:
    min_flash: 32
    extra_args: CONF_FILE=shell_min_cmds_select.conf
    build_only: true

  shell.min_colors:
    min_flash: 32
    extra_args: CONF_FILE=shell_min_colors.conf
    build_only: true

  shell.min_help:
    min_flash: 32
    extra_args: CONF_FILE=shell_min_help.conf
    build_only: true

  shell.min_help_all:
    min_flash: 32
    extra_args: CONF_FILE=shell_min_help_all.conf
    build_only: true

  shell.min_history:
    min_flash: 32
    extra_args: CONF_FILE=shell_min_history.conf
    build_only: true

  shell.min_log_backend:
    min_flash: 64
    extra_args: CONF_FILE=shell_min_log_backend.conf
    build_only: true

  shell.min_metakeys:
    min_flash: 32
    extra_args: CONF_FILE=shell_min_metakeys.conf
    build_only: true

  shell.min_tab:
    min_flash: 32
    extra_args: CONF_FILE=shell_min_tab.conf
    build_only: true

  shell.min_tab_auto:
    min_flash: 32
    extra_args: CONF_FILE=shell_min_tab_auto.conf
    build_only: true

  shell.min_wildcards:
    min_flash: 32
    extra_args: CONF_FILE=shell_min_wildcards.conf
    build_only: true
```

## tests/subsys/shell/shell_backend/testcase.yaml
```yaml
tests:
  shell.backend:
    min_flash: 64
    min_ram: 32
    tags:
      - shell
    filter: ( CONFIG_SHELL )
    platform_allow:
      - qemu_x86/atom
      - qemu_riscv32/qemu_virt_riscv32
```

## tests/subsys/shell/shell_backend_uart/testcase.yaml
```yaml
tests:
  shell.backend.uart:
    min_flash: 64
    min_ram: 32
    tags:
      - shell
      - backend
      - uart
    platform_allow:
      - qemu_x86
      - qemu_riscv32
```

## tests/subsys/shell/shell_custom_header/testcase.yaml
```yaml
common:
  integration_platforms:
    - native_sim

tests:
  shell.shell_custom_header:
    tags:
      - shell_custom_header
      - shell
```

## tests/subsys/shell/shell_device_filter/testcase.yaml
```yaml
# SPDX-License-Identifier: Apache-2.0

tests:
  shell.device_filter:
    platform_allow:
      - native_sim
    tags:
      - shell
    integration_platforms:
      - native_sim
```

## tests/subsys/shell/shell_flash/testcase.yaml
```yaml
tests:
  shell.flash:
    min_flash: 64
    min_ram: 32
    filter: ( CONFIG_FLASH_SHELL )
    tags:
      - flash
      - shell
    platform_allow:
      - qemu_x86
      - native_sim
```

## tests/subsys/shell/shell_fuzzer/testcase.yaml
```yaml
tests:
  shell.fuzzer:
    tags: shell fuzzer
    toolchain_allow: llvm
    harness: fuzzer
    platform_allow: native_posix_64
```

## tests/subsys/shell/shell_history/testcase.yaml
```yaml
tests:
  shell.history:
    integration_platforms:
      - native_sim
    min_flash: 64
    min_ram: 32
    filter: ( CONFIG_SHELL )
    tags: shell
```

## tests/subsys/shell/shell_remote/Kconfig.sysbuild
```kconfig
#
# Copyright (c) 2026 Nordic Semiconductor ASA
#
# SPDX-License-Identifier: Apache-2.0
#

config REMOTE_BOARD
	string
	default "$(BOARD)/nrf5340/cpunet" if BOARD_NRF5340DK_NRF5340_CPUAPP
	default "$(BOARD)/nrf5340/cpunet" if BOARD_NRF5340DK_NRF5340_CPUAPP_NS
	default "$(BOARD)/nrf5340/cpunet" if BOARD_NRF5340BSIM_NRF5340_CPUAPP
	default "$(BOARD)/nrf54l15/cpuflpr" if SOC_NRF54L15_CPUAPP

source "share/sysbuild/Kconfig"
```

## tests/subsys/shell/shell_remote/boards/nrf54h20dk_nrf54h20_cpuapp.conf
```kconfig
# Copyright (c) 2026 Nordic Semiconductor ASA
# SPDX-License-Identifier: Apache-2.0

# Boot the Radio core (CPURAD); devicetree IPC to CPURAD is enabled in board DTS.
CONFIG_SOC_NRF54H20_CPURAD_ENABLE=y
CONFIG_SHELL_REMOTE_PPR=y
CONFIG_SHELL_REMOTE_FLPR=y
CONFIG_SHELL_REMOTE_RADIO=y
```

## tests/subsys/shell/shell_remote/testcase.yaml
```yaml
common:
  sysbuild: true
  tags:
    - shell
    - ipc
  harness: ztest
tests:
  shell.shell_remote:
    platform_allow:
      - nrf5340dk/nrf5340/cpuapp
      - nrf5340bsim/nrf5340/cpuapp
      - nrf54h20dk/nrf54h20/cpuapp
      - nrf54l15dk/nrf54l15/cpuapp
    integration_platforms:
      - nrf5340bsim/nrf5340/cpuapp
      - nrf54l15dk/nrf54l15/cpuapp
  shell.shell_remote.no_multithreading:
    platform_allow:
      - nrf5340bsim/nrf5340/cpuapp
      - nrf5340dk/nrf5340/cpuapp
      - nrf54l15dk/nrf54l15/cpuapp
    integration_platforms:
      - nrf5340bsim/nrf5340/cpuapp
      - nrf54l15dk/nrf54l15/cpuapp
    extra_args:
      - remote_CONFIG_MULTITHREADING=n
```

## tests/subsys/sip_svc/Kconfig
```kconfig
# Private config options for sip svc stress test app

# Copyright (c) 2023 Intel Corporation
# SPDX-License-Identifier: Apache-2.0

mainmenu "Intel Agilex SiP SVC stress test"

config PACKETS_PER_ITERATION
	int
	default 3
	help
	  Number of SYNC and ASYNC packets to be sent per iteration

config ITERATIONS
	int
	default 7
	help
	  Number of iterations to be performed.

source "Kconfig.zephyr"
```

## tests/subsys/sip_svc/testcase.yaml
```yaml
# Copyright (c) 2022-2023, Intel Corporation.
# SPDX-License-Identifier: Apache-2.0

tests:
  sip_svc.stress_test.ztest:
    build_only: true
    platform_allow: intel_socfpga_agilex_socdk  intel_socfpga_agilex5_socdk
    integration_platforms:
      - intel_socfpga_agilex_socdk
      - intel_socfpga_agilex5_socdk
    tags: sip_svc
```

## tests/subsys/storage/flash_map/Kconfig
```kconfig
#
# Copyright (c) 2025 Nordic Semiconductor ASA
#
# SPDX-License-Identifier: Apache-2.0
#

mainmenu "Flash Map test configuration"

config TEST_FLASH_MAP_DISABLED_PARTITIONS
	bool "Test support for disabled partitions"
	default y if !FLASH_MAP_CUSTOM
	help
	  Test flash_area_open for returning -ENOENT for disabled partitions.
	  Note that custom flash maps may not support disabled partitions
	  and therefore not even generated id for them. In such case it would
	  not be possible to provide disabled partition id to flash_area_open,
	  making this test impossible to run.

config TEST_FLASH_MAP_NODE_MACROS
	bool "Test DTS macros for accessing partition info via DTS node"
	default y if !FLASH_MAP_CUSTOM
	help
	  Custom flash map may be defined outside of DTS definition, therefore
	  not have a DTS nodes for partitions.

menu "Zephyr"
source "Kconfig.zephyr"
endmenu
```

## tests/subsys/storage/flash_map/testcase.yaml
```yaml
tests:
  storage.flash_map:
    platform_allow:
      - nrf51dk/nrf51822
      - nrf9160dk/nrf9160/ns
      - qemu_x86
      - native_sim
      - native_sim/native/64
      - mr_canhubk3
      - s32z2xxdc2/s32z270/rtu0
      - s32z2xxdc2/s32z270/rtu1
      - s32z2xxdc2@D/s32z270/rtu0
      - s32z2xxdc2@D/s32z270/rtu1
    tags: flash_map
    integration_platforms:
      - native_sim
  storage.flash_map.mpu:
    extra_args: EXTRA_CONF_FILE=overlay-mpu.conf
    timeout: 120
    platform_allow:
      - nrf52840dk/nrf52840
      - nrf52dk/nrf52832
      - frdm_k64f
      - hexiwear/mk64f12
      - twr_ke18f
    integration_platforms:
      - nrf52840dk/nrf52840
    tags: flash_map
  storage.flash_map_sha.mbedtls:
    extra_args: EXTRA_CONF_FILE=overlay-mbedtls.conf
    platform_allow:
      - nrf51dk/nrf51822
      - qemu_x86
      - native_sim
      - native_sim/native/64
      - mr_canhubk3
      - s32z2xxdc2/s32z270/rtu0
      - s32z2xxdc2/s32z270/rtu1
      - s32z2xxdc2@D/s32z270/rtu0
      - s32z2xxdc2@D/s32z270/rtu1
    tags: flash_map
    integration_platforms:
      - native_sim
  storage.flash_map_sha.psa:
    extra_args: EXTRA_CONF_FILE=overlay-psa.conf
    platform_allow:
      - nrf51dk/nrf51822
      - native_sim
      - native_sim/native/64
      - mr_canhubk3
      - s32z2xxdc2/s32z270/rtu0
      - s32z2xxdc2/s32z270/rtu1
      - s32z2xxdc2@D/s32z270/rtu0
      - s32z2xxdc2@D/s32z270/rtu1
    tags: flash_map
    integration_platforms:
      - native_sim
```

## tests/subsys/storage/flash_mpa/testcase.yaml
```yaml
tests:
  test:
    build_only: true
    platform_whitelist: nrf52840_pca10056, nrf52_pca10040, nrf51_pca10028
    tags: flash_map
```

## tests/subsys/storage/flash_partitions/testcase.yaml
```yaml
common:
  depends_on:
    - flash_partitions
    - flash
  tags: flash_partitions
tests:
  storage.flash_partitions.native_sim.api:
    platform_allow:
      - native_sim
    timeout: 60
```

## tests/subsys/storage/nvmp/boards/qemu_cortex_m3.conf
```kconfig
# Copyright (c) 2023 Laczen
# SPDX-License-Identifier: Apache-2.0
CONFIG_RETAINED_MEM=y
CONFIG_LOG=y
```

## tests/subsys/storage/nvmp/boards/qemu_x86.conf
```kconfig
# Copyright (c) 2023 Laczen
# SPDX-License-Identifier: Apache-2.0
CONFIG_FLASH=y
CONFIG_NVMP_FLASH=y
CONFIG_EEPROM=y
CONFIG_NVMP_EEPROM=y
CONFIG_USERSPACE=n
```

## tests/subsys/storage/nvmp/testcase.yaml
```yaml
common:
  depends_on:
    - nvmp
    - flash
    - eeprom
  tags: nvmp
tests:
  storage.nvmp.native_sim.api:
    platform_allow:
      - native_sim
    integration_platforms:
      - native_sim
    timeout: 60
```

## tests/subsys/storage/storage_area/storage_area_api/testcase.yaml
```yaml
common:
  tags: storage_area_api
tests:
  storage.storage_area.api.flash:
    platform_allow:
      - native_sim
    extra_args:
      - EXTRA_CONF_FILE=cfg_flash.conf
  storage.storage_area.api.eeprom:
    platform_allow:
      - native_sim
    extra_args:
      - EXTRA_CONF_FILE=cfg_eeprom.conf
  storage.storage_area.api.ram:
    platform_allow:
      - qemu_cortex_m3
    extra_args:
      - EXTRA_CONF_FILE=cfg_ram.conf
  storage.storage_area.api.disk:
    platform_allow:
      - native_sim
    extra_args:
      - EXTRA_CONF_FILE=cfg_disk.conf
```

## tests/subsys/storage/storage_area/storage_area_store/testcase.yaml
```yaml
common:
  tags: storage_area_store
tests:
  storage.storage_area.store.flash:
    platform_allow:
      - native_sim
    extra_args:
      - EXTRA_CONF_FILE=cfg_flash.conf
  storage.storage_area.store.eeprom:
    platform_allow:
      - native_sim
    extra_args:
      - EXTRA_CONF_FILE=cfg_eeprom.conf
  storage.storage_area.store.ram:
    platform_allow:
      - qemu_cortex_m3
    extra_args:
      - EXTRA_CONF_FILE=cfg_ram.conf
  storage.storage_area.store.disk:
    platform_allow:
      - native_sim
    extra_args:
      - EXTRA_CONF_FILE=cfg_disk.conf
```

## tests/subsys/storage/stream/stream_flash/testcase.yaml
```yaml
common:
  platform_allow:
    - native_sim
    - native_sim/native/64
  integration_platforms:
    - native_sim
tests:
  storage.stream_flash:
    tags: stream_flash
    platform_allow:
      - nrf52840dk/nrf52840
    integration_platforms:
      - nrf52840dk/nrf52840
  storage.stream_flash.simulator.no_explicit_erase:
    filter: dt_compat_enabled("zephyr,sim-flash")
    extra_configs:
      - CONFIG_STREAM_FLASH_ERASE=n
      - CONFIG_FLASH_SIMULATOR_EXPLICIT_ERASE=n
    tags: stream_flash
  storage.stream_flash.no_explicit_erase:
    # Systems with zephyr,sim-flash are tested by simulator scenarios,
    # common platforms could bring them here too so filter these out.
    filter: not dt_compat_enabled("zephyr,sim-flash")
    platform_allow:
      - nrf54l09pdk/nrf54l09/cpuapp
      - nrf54l15dk/nrf54l15/cpuapp
    extra_configs:
      # Tests, currently, can only support single device testing
      # and platform enabling SPI NOR automatically brings in a device with
      # explicit erase requirement.
      - CONFIG_SPI_NOR=n
  storage.stream_flash.dword_wbs:
    extra_args: DTC_OVERLAY_FILE=unaligned_flush.overlay
    tags: stream_flash
  storage.stream_flash.no_erase:
    extra_configs:
      - CONFIG_STREAM_FLASH_ERASE=n
    tags: stream_flash
```

## tests/subsys/testsuite/fff_fake_contexts/testcase.yaml
```yaml
# Copyright (c) 2023 Legrand North America, LLC.
# SPDX-License-Identifier: Apache-2.0

tests:
  testing.testsuite.fff_fake_contexts.unit:
    tags: test_framework
    type: unit
  testing.testsuite.fff_fake_contexts:
    integration_platforms:
      - qemu_cortex_m3
      - native_sim/native/64
    tags: test_framework
    platform_allow:
      - qemu_cortex_m3
      - native_posix/native/64
      - native_sim/native/64
      - native_sim
```
