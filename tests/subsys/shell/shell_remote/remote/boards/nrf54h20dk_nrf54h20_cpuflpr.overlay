/*
 * Copyright (c) 2026 Nordic Semiconductor ASA
 *
 * SPDX-License-Identifier: Apache-2.0
 */

&cpuflpr_vevif {
	status = "okay";
};

&cpuapp_bellboard {
	status = "okay";
};

ipc0: &cpuapp_cpuflpr_ipc {
	status = "okay";
};

&uart120 {
	status = "disabled";
};
