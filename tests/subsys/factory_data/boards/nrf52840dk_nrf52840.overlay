/*
 * Copyright (c) 2022 GARDENA GmbH
 * SPDX-License-Identifier: Apache-2.0
 */

/* Reduce storage partition to 28kB. */
&storage_partition {
	reg = <0x000f8000 0x00007000>;
};

/* factory data: 1 page (4 kB) */
&flash0 {
	partitions {
		factory_partition: partition@ff000 {
			label = "factory";
			reg = <0x000ff000 0x00001000>;
		};
	};
};
