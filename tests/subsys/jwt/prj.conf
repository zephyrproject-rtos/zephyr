## CMakeLists.txt
```
# SPDX-License-Identifier: Apache-2.0

cmake_minimum_required(VERSION 3.28.0)

find_package(Zephyr REQUIRED HINTS $ENV{ZEPHYR_BASE})
project(jwt)

FILE(GLOB app_sources src/*.c)
target_sources(app PRIVATE ${app_sources})
zephyr_include_directories(${APPLICATION_SOURCE_DIR}/src/tls_config)
```

## prj.conf
```kconfig
CONFIG_JWT=y
CONFIG_ZTEST=y
CONFIG_ZTEST_STACK_SIZE=8192
CONFIG_MAIN_STACK_SIZE=8192

CONFIG_REQUIRES_FULL_LIBC=y

CONFIG_MBEDTLS_PSA_STATIC_KEY_SLOTS=n
CONFIG_PSA_WANT_KEY_TYPE_RSA_PUBLIC_KEY=y
CONFIG_PSA_WANT_KEY_TYPE_RSA_KEY_PAIR_IMPORT=y
CONFIG_PSA_WANT_ALG_RSA_PKCS1V15_SIGN=y
CONFIG_PSA_WANT_ALG_SHA_256=y
CONFIG_PSA_WANT_KEY_TYPE_ECC_KEY_PAIR_IMPORT=y
CONFIG_PSA_WANT_ALG_ECDSA=y
CONFIG_PSA_WANT_ECC_SECP_R1_256=y
```

## src/main.c
```c
/*
 * RFC 7519 Json Web Tokens
 *
 * Copyright (C) 2018, Linaro, Ltd
 * SPDX-License-Identifier: Apache-2.0
 *
 * Licensed under the Apache License, Version 2.0 (the "License"); you may
 * not use this file except in compliance with the License.
 * You may obtain a copy of the License at
 *
 * http://www.apache.org/licenses/LICENSE-2.0
 *
 * Unless required by applicable law or agreed to in writing, software
 * distributed under the License is distributed on an "AS IS" BASIS, WITHOUT
 * WARRANTIES OR CONDITIONS OF ANY KIND, either express or implied.
 * See the License for the specific language governing permissions and
 * limitations under the License.
 */

#include <zephyr/ztest.h>
#include <zephyr/data/json.h>
#include <zephyr/data/jwt.h>

#include <stdbool.h>

#define DEFAULT_SUB          "iot-work-199419"
#define DEFAULT_EXP          1530312026
#define DEFAULT_IAT          1530308426
#define DEFAULT_CUSTOM_CLAIM "custom_value"
#define DEFAULT_CLAIMS                                                                             \
	{                                                                                          \
		.sub = DEFAULT_SUB, .exp = DEFAULT_EXP, .iat = DEFAULT_IAT, .custom_claims_obj = { \
			.custom_claim = DEFAULT_CUSTOM_CLAIM                                       \
		}                                                                                  \
	}

extern unsigned char jwt_test_rsa_private_der[];
extern unsigned int jwt_test_rsa_private_der_len;
extern unsigned char jwt_test_ecdsa_private_der[];
extern unsigned int jwt_test_ecdsa_private_der_len;

struct custom_claims {
	const char *custom_claim;
};

struct jwt_claims {
	const char *sub;
	const int64_t exp;
	const int64_t iat;
	struct custom_claims custom_claims_obj;
};

struct json_obj_descr custom_claims_desc[] = {
	JSON_OBJ_DESCR_PRIM(struct custom_claims, custom_claim, JSON_TOK_STRING)};
struct json_obj_descr jwt_claims_desc[] = {
	JSON_OBJ_DESCR_PRIM(struct jwt_claims, sub, JSON_TOK_STRING),
	JSON_OBJ_DESCR_PRIM(struct jwt_claims, exp, JSON_TOK_INT64),
	JSON_OBJ_DESCR_PRIM(struct jwt_claims, iat, JSON_TOK_INT64),
	JSON_OBJ_DESCR_OBJECT(struct jwt_claims, custom_claims_obj, custom_claims_desc),
};

struct jwt_header {
	const char *alg;
	const char *typ;
};

static struct json_obj_descr jwt_header_descr[] = {
	JSON_OBJ_DESCR_PRIM(struct jwt_header, alg, JSON_TOK_STRING),
	JSON_OBJ_DESCR_PRIM(struct jwt_header, typ, JSON_TOK_STRING)};

psa_status_t key_import_helper(const uint8_t *key_der, const size_t key_der_len,
			       const psa_algorithm_t alg, const psa_key_type_t key_type,
			       psa_key_id_t *key_out_id)
{
	psa_key_attributes_t attr = PSA_KEY_ATTRIBUTES_INIT;

	psa_set_key_type(&attr, key_type);
	psa_set_key_algorithm(&attr, alg);
	psa_set_key_usage_flags(&attr, PSA_KEY_USAGE_SIGN_MESSAGE | PSA_KEY_USAGE_VERIFY_MESSAGE);
	psa_set_key_lifetime(&attr, PSA_KEY_LIFETIME_VOLATILE);
	return psa_import_key(&attr, key_der, key_der_len, key_out_id);
}

static psa_key_id_t import_rsa_key(void)
{
	psa_key_id_t key_id;
	const psa_status_t res = key_import_helper(
		jwt_test_rsa_private_der, jwt_test_rsa_private_der_len,
		PSA_ALG_RSA_PKCS1V15_SIGN(PSA_ALG_SHA_256), PSA_KEY_TYPE_RSA_KEY_PAIR, &key_id);

	zassert_equal(res, PSA_SUCCESS, "Key import");
	return key_id;
}

static psa_key_id_t import_ecdsa_key(void)
{
	psa_key_id_t key_id;
	const psa_status_t res =
		key_import_helper(jwt_test_ecdsa_private_der, jwt_test_ecdsa_private_der_len,
				  PSA_ALG_ECDSA(PSA_ALG_SHA_256),
				  PSA_KEY_TYPE_ECC_KEY_PAIR(PSA_ECC_FAMILY_SECP_R1), &key_id);

	zassert_equal(res, PSA_SUCCESS, "Key import");
	return key_id;
}

/*
 * Map the JWS "alg" name of RFC 7518 back to a PSA algorithm, so that the
 * token is verified with what its own header claims and not with what the
 * test asked for.  Only the names the tests can produce are listed.
 */
static psa_algorithm_t alg_from_name(const char *alg_name)
{
	if (strcmp(alg_name, "RS256") == 0) {
		return PSA_ALG_RSA_PKCS1V15_SIGN(PSA_ALG_SHA_256);
	}
	if (strcmp(alg_name, "ES256") == 0) {
		return PSA_ALG_ECDSA(PSA_ALG_SHA_256);
	}

	return PSA_ALG_NONE;
}

/* Courtesy of the Google AI beast */
int jwt_base64_decode(const uint8_t *in, const size_t in_len, uint8_t *out, const size_t out_max,
		      size_t *out_len)
{
	if (!in || !out || !out_len) {
		return -EINVAL;
	}

	const char *b64url = "ABCDEFGHIJKLMNOPQRSTUVWXYZabcdefghijklmnopqrstuvwxyz0123456789-_";
	unsigned int buf = 0;
	int bits = 0;
	size_t decoded_bytes = 0;

	*out_len = 0; /* Reset out parameter early */

	for (size_t i = 0; i < in_len; i++) {
		/* Early exit if we hit an unexpected null terminator before in_len */
		if (in[i] == '\0') {
			break;
		}

		/* Standard JWTs shouldn't have padding, but skip it if present */
		if (in[i] == '=') {
			continue;
		}

		char *p = strchr(b64url, in[i]);

		if (!p) {
			return -EBADMSG; /* Corrupted data / invalid Base64URL character */
		}

		buf = (buf << 6) | (p - b64url);
		bits += 6;

		if (bits >= 8) {
			bits -= 8;

			if (decoded_bytes >= out_max) {
				return -ENOBUFS; /* No buffer space available */
			}

			out[decoded_bytes++] = (buf >> bits) & 0xFF;
		}
	}

	*out_len = decoded_bytes;
	return 0;
}

void verify_jwt(const psa_key_id_t signature_key_id, const char *expected_alg_name,
		const char *null_terminated_jwt)
{
	/* Extract the three pieces of the JWT (header, payload, signature) */
	uint8_t header_buf_b64[512] = {0};
	uint8_t payload_buf_b64[512] = {0};
	uint8_t signature_buf_b64[512] = {0};

	int res = sscanf(null_terminated_jwt, "%[^.].%[^.].%s", header_buf_b64, payload_buf_b64,
			 signature_buf_b64);
	zassert_equal(res, 3, "Extracting JWT components");

	size_t header_buf_decoded_len = 0;
	uint8_t header_buf[512] = {0};
	size_t payload_buf_decoded_len = 0;
	uint8_t payload_buf[512] = {0};
	size_t signature_buf_decoded_len = 0;
	uint8_t signature_buf[512] = {0};

	/* Decode the header */
	res = jwt_base64_decode(header_buf_b64, strlen((const char *)header_buf_b64), header_buf,
				sizeof(header_buf), &header_buf_decoded_len);
	zassert_equal(res, 0, "Decoding header");

	/* Decode the payload */
	res = jwt_base64_decode(payload_buf_b64, strlen((const char *)payload_buf_b64), payload_buf,
				sizeof(payload_buf), &payload_buf_decoded_len);
	zassert_equal(res, 0, "Decoding payload");

	/* Decode the signature */
	res = jwt_base64_decode(signature_buf_b64, strlen((const char *)signature_buf_b64),
				signature_buf, sizeof(signature_buf), &signature_buf_decoded_len);
	zassert_equal(res, 0, "Decoding signature");

	/* Parse and verify the header */
	struct jwt_header header = {};

	int64_t parse_res = json_obj_parse((char *)header_buf, header_buf_decoded_len,
					   jwt_header_descr, ARRAY_SIZE(jwt_header_descr), &header);
	zassert_true(parse_res > 0, "JSON object parsing");
	zassert_str_equal(header.alg, expected_alg_name);
	zassert_str_equal(header.typ, "JWT");

	/*
	 * Verify the signature over the base64 encoded header and payload with
	 * the delimiter, using the algorithm the header announces.
	 */
	const psa_algorithm_t alg = alg_from_name(header.alg);

	zassert_not_equal(alg, PSA_ALG_NONE, "Unknown header algorithm");

	const size_t message_input_length =
		strlen((const char *)header_buf_b64) + 1 + strlen((const char *)payload_buf_b64);
	res = psa_verify_message(signature_key_id, alg, (const uint8_t *)null_terminated_jwt,
				 message_input_length, signature_buf, signature_buf_decoded_len);
	zassert_equal(res, 0, "Verifying payload");

	/* Parse and verify the payload (claims). */
	struct jwt_claims payload = {};

	parse_res = json_obj_parse((char *)payload_buf, payload_buf_decoded_len, jwt_claims_desc,
				   ARRAY_SIZE(jwt_claims_desc), &payload);
	zassert_true(parse_res > 0, "JSON object parsing");
	zassert_str_equal(payload.sub, DEFAULT_SUB);
	zassert_equal(payload.exp, DEFAULT_EXP);
	zassert_equal(payload.iat, DEFAULT_IAT);
	zassert_str_equal(payload.custom_claims_obj.custom_claim, DEFAULT_CUSTOM_CLAIM);
}

void create_and_validate_jwt(const psa_key_id_t signature_key_id, const psa_algorithm_t alg,
			     const char *expected_alg_name)
{
	char buf[1024] = {0};
	struct jwt_builder build;

	int res = jwt_init_builder(&build, buf, sizeof(buf), signature_key_id, alg);

	zassert_equal(res, 0, "Setting up jwt");

	const struct jwt_claims claims = DEFAULT_CLAIMS;

	res = jwt_add_payload(&build, &claims, jwt_claims_desc, ARRAY_SIZE(jwt_claims_desc));
	zassert_equal(res, 0, "Adding payload");

	res = jwt_sign(&build);
	zassert_equal(res, 0, "Signing payload");
	zassert_equal(build.overflowed, false, "Not overflow");

	verify_jwt(signature_key_id, expected_alg_name, buf);
}

ZTEST(jwt_tests, test_jwt_rsa)
{
	const psa_key_id_t key_id = import_rsa_key();

	create_and_validate_jwt(key_id, PSA_ALG_RSA_PKCS1V15_SIGN(PSA_ALG_SHA_256), "RS256");

	zassert_equal(psa_destroy_key(key_id), PSA_SUCCESS, "Key destroy");
}

ZTEST(jwt_tests, test_jwt_ecdsa)
{
	const psa_key_id_t key_id = import_ecdsa_key();

	create_and_validate_jwt(key_id, PSA_ALG_ECDSA(PSA_ALG_SHA_256), "ES256");

	zassert_equal(psa_destroy_key(key_id), PSA_SUCCESS, "Key destroy");
}

/*
 * The header has to describe the signature, so a combination that has no
 * JWS name must be rejected instead of being given an arbitrary one.
 */
ZTEST(jwt_tests, test_jwt_unsupported_algorithm)
{
	char buf[1024] = {0};
	struct jwt_builder build;
	const psa_key_id_t key_id = import_ecdsa_key();

	/* RFC 7518 only pairs SHA-384 with P-384, and this key is P-256. */
	int res =
		jwt_init_builder(&build, buf, sizeof(buf), key_id, PSA_ALG_ECDSA(PSA_ALG_SHA_384));

	zassert_equal(res, -ENOTSUP, "Curve and hash mismatch");

	/* An RSA algorithm with an EC key has no JWS name either. */
	res = jwt_init_builder(&build, buf, sizeof(buf), key_id,
			       PSA_ALG_RSA_PKCS1V15_SIGN(PSA_ALG_SHA_256));
	zassert_equal(res, -ENOTSUP, "Key type mismatch");

	zassert_equal(psa_destroy_key(key_id), PSA_SUCCESS, "Key destroy");
}

ZTEST(jwt_tests, test_jwt_unknown_key)
{
	char buf[1024] = {0};
	struct jwt_builder build;
	const int res = jwt_init_builder(&build, buf, sizeof(buf), PSA_KEY_ID_NULL,
					 PSA_ALG_ECDSA(PSA_ALG_SHA_256));

	zassert_equal(res, -EINVAL, "Unknown key");
}

/*
 * The signature is sized from the key, so a buffer that cannot hold it is
 * reported rather than silently truncated.
 */
ZTEST(jwt_tests, test_jwt_buffer_too_small)
{
	char buf[256] = {0};
	struct jwt_builder build;
	const psa_key_id_t key_id = import_rsa_key();

	int res = jwt_init_builder(&build, buf, sizeof(buf), key_id,
				   PSA_ALG_RSA_PKCS1V15_SIGN(PSA_ALG_SHA_256));

	zassert_equal(res, 0, "Setting up jwt");

	const struct jwt_claims claims = DEFAULT_CLAIMS;

	res = jwt_add_payload(&build, &claims, jwt_claims_desc, ARRAY_SIZE(jwt_claims_desc));
	zassert_equal(res, 0, "Adding payload");

	res = jwt_sign(&build);
	zassert_equal(res, -ENOMEM, "Signing into a short buffer");
	zassert_true(build.overflowed, "Overflow reported");

	zassert_equal(psa_destroy_key(key_id), PSA_SUCCESS, "Key destroy");
}

/*
 * The signature is encoded in place at the end of the free space, so the
 * smallest buffer that fits the token has to work and one byte less must
 * be refused.
 */
ZTEST(jwt_tests, test_jwt_minimum_buffer)
{
	char buf[1024] = {0};
	struct jwt_builder build;
	const psa_key_id_t key_id = import_ecdsa_key();
	const psa_algorithm_t alg = PSA_ALG_ECDSA(PSA_ALG_SHA_256);
	const struct jwt_claims claims = DEFAULT_CLAIMS;

	int res = jwt_init_builder(&build, buf, sizeof(buf), key_id, alg);

	zassert_equal(res, 0, "Setting up jwt");
	res = jwt_add_payload(&build, &claims, jwt_claims_desc, ARRAY_SIZE(jwt_claims_desc));
	zassert_equal(res, 0, "Adding payload");
	res = jwt_sign(&build);
	zassert_equal(res, 0, "Signing payload");

	/* The token plus its terminator is all the buffer that is needed. */
	const size_t token_size = strlen(buf) + 1;

	memset(buf, 0, sizeof(buf));
	res = jwt_init_builder(&build, buf, token_size, key_id, alg);
	zassert_equal(res, 0, "Setting up jwt");
	res = jwt_add_payload(&build, &claims, jwt_claims_desc, ARRAY_SIZE(jwt_claims_desc));
	zassert_equal(res, 0, "Adding payload");
	res = jwt_sign(&build);
	zassert_equal(res, 0, "Signing payload");
	zassert_equal(strlen(buf), token_size - 1, "Token length");
	verify_jwt(key_id, "ES256", buf);

	memset(buf, 0, sizeof(buf));
	res = jwt_init_builder(&build, buf, token_size - 1, key_id, alg);
	zassert_equal(res, 0, "Setting up jwt");
	res = jwt_add_payload(&build, &claims, jwt_claims_desc, ARRAY_SIZE(jwt_claims_desc));
	zassert_equal(res, 0, "Adding payload");
	res = jwt_sign(&build);
	zassert_equal(res, -ENOMEM, "Signing into a short buffer");

	zassert_equal(psa_destroy_key(key_id), PSA_SUCCESS, "Key destroy");
}

ZTEST_SUITE(jwt_tests, NULL, NULL, NULL, NULL, NULL);
```

## src/jwt-test-cert.c
```c
/*
 * Copyright (C) 2018, Linaro, Ltd
 * SPDX-License-Identifier: Apache-2.0
 *
 */

/* subject:/CN=jwt-test */
/* issuer :/CN=jwt-test */
unsigned char XXX_subject_name[21] = {
0x30, 0x13, 0x31, 0x11, 0x30, 0x0F, 0x06, 0x03, 0x55, 0x04, 0x03, 0x0C,
0x08, 0x6A, 0x77, 0x74, 0x2D, 0x74, 0x65, 0x73, 0x74,
};
unsigned char XXX_public_key[294] = {
0x30, 0x82, 0x01, 0x22, 0x30, 0x0D, 0x06, 0x09, 0x2A, 0x86, 0x48, 0x86, 0xF7,
0x0D, 0x01, 0x01,
0x01, 0x05, 0x00, 0x03, 0x82, 0x01, 0x0F, 0x00, 0x30, 0x82, 0x01, 0x0A, 0x02,
0x82, 0x01, 0x01,
0x00, 0xA6, 0x52, 0x98, 0xDF, 0x0E, 0x33, 0xD0, 0x69, 0x62, 0x32, 0xC4, 0x40,
0x7C, 0xEC, 0xBF,
0x9F, 0xA3, 0x35, 0x8A, 0x51, 0xCD, 0xED, 0x49, 0x99, 0xBE, 0xF8, 0x29, 0x3F,
0xD1, 0xD7, 0xA8,
0xFB, 0xC6, 0x36, 0x82, 0x45, 0x64, 0xDB, 0x6D, 0x73, 0xEF, 0x53, 0xCA, 0x02,
0x7E, 0xB0, 0x91,
0x06, 0xBD, 0xD5, 0x66, 0x4B, 0xEA, 0x87, 0x7A, 0x6D, 0x95, 0xA5, 0x6B, 0x64,
0xB9, 0xD6, 0xC3,
0xDD, 0xB2, 0x5C, 0x03, 0x8B, 0x00, 0x5C, 0x46, 0x16, 0x8B, 0x86, 0xC8, 0x28,
0x0D, 0xB4, 0xB1,
0x3E, 0xB6, 0x0D, 0x82, 0x22, 0x97, 0x5B, 0x75, 0x02, 0x00, 0x97, 0xC7, 0x57,
0x4B, 0xA0, 0x81,
0xFB, 0x2D, 0xC8, 0xBB, 0x81, 0x37, 0xC4, 0x8E, 0xE6, 0x7C, 0x9A, 0xF9, 0x2D,
0x0C, 0xD4, 0xB8,
0x22, 0xE5, 0x3B, 0xA0, 0xFE, 0xA8, 0x3E, 0x5E, 0x99, 0x36, 0x57, 0x76, 0x25,
0x7E, 0xFC, 0x89,
0x17, 0x3C, 0x39, 0xF0, 0x3C, 0x2E, 0xB3, 0x3F, 0x14, 0xF5, 0x23, 0x96, 0x92,
0x42, 0x7B, 0x1D,
0xD0, 0x0B, 0xB1, 0x44, 0x71, 0x89, 0x3B, 0x44, 0xE5, 0xEA, 0xEA, 0x2C, 0x67,
0xBB, 0xD9, 0xE3,
0x9C, 0x8A, 0x1A, 0x83, 0x1E, 0xE9, 0x13, 0xE3, 0x3C, 0x06, 0xB0, 0xA3, 0x98,
0x9D, 0x2B, 0xA5,
0x84, 0x65, 0xDB, 0x23, 0x77, 0x59, 0xCA, 0x64, 0x76, 0x9D, 0x54, 0x05, 0x57,
0xA7, 0x10, 0xCB,
0x62, 0xEC, 0x7F, 0x39, 0xFC, 0xD7, 0x53, 0x3D, 0x46, 0x2D, 0xEC, 0x11, 0xD1,
0x42, 0x10, 0x6A,
0x73, 0x39, 0x18, 0x10, 0xA0, 0xCF, 0x9B, 0x88, 0x6F, 0x1E, 0x88, 0x68, 0x8B,
0x3C, 0x30, 0x59,
0x3F, 0x66, 0xB5, 0x09, 0x65, 0xFC, 0x37, 0xF7, 0x9F, 0x4E, 0xD7, 0x1A, 0xC6,
0x16, 0x64, 0x67,
0x64, 0x41, 0xC0, 0x90, 0x51, 0xD9, 0xDA, 0xF5, 0x25, 0x5C, 0xC0, 0x62, 0x9F,
0x0D, 0xEC, 0x2C, 0xD3, 0x02, 0x03, 0x01, 0x00, 0x01,
};
unsigned char XXX_certificate[767] = {
0x30, 0x82, 0x02, 0xFB, 0x30, 0x82, 0x01, 0xE3, 0xA0, 0x03, 0x02, 0x01, 0x02,
0x02, 0x09, 0x00,
0x8A, 0x3A, 0x34, 0xB6, 0x77, 0xC8, 0x21, 0xEA, 0x30, 0x0D, 0x06, 0x09, 0x2A,
0x86, 0x48, 0x86,
0xF7, 0x0D, 0x01, 0x01, 0x0B, 0x05, 0x00, 0x30, 0x13, 0x31, 0x11, 0x30, 0x0F,
0x06, 0x03, 0x55,
0x04, 0x03, 0x0C, 0x08, 0x6A, 0x77, 0x74, 0x2D, 0x74, 0x65, 0x73, 0x74, 0x30,
0x20, 0x17, 0x0D,
0x31, 0x38, 0x30, 0x37, 0x30, 0x32, 0x31, 0x37, 0x32, 0x31, 0x31, 0x31, 0x5A,
0x18, 0x0F, 0x34,
0x37, 0x35, 0x36, 0x30, 0x35, 0x32, 0x39, 0x31, 0x37, 0x32, 0x31, 0x31, 0x31,
0x5A, 0x30, 0x13,
0x31, 0x11, 0x30, 0x0F, 0x06, 0x03, 0x55, 0x04, 0x03, 0x0C, 0x08, 0x6A, 0x77,
0x74, 0x2D, 0x74,
0x65, 0x73, 0x74, 0x30, 0x82, 0x01, 0x22, 0x30, 0x0D, 0x06, 0x09, 0x2A, 0x86,
0x48, 0x86, 0xF7,
0x0D, 0x01, 0x01, 0x01, 0x05, 0x00, 0x03, 0x82, 0x01, 0x0F, 0x00, 0x30, 0x82,
0x01, 0x0A, 0x02,
0x82, 0x01, 0x01, 0x00, 0xA6, 0x52, 0x98, 0xDF, 0x0E, 0x33, 0xD0, 0x69, 0x62,
0x32, 0xC4, 0x40,
0x7C, 0xEC, 0xBF, 0x9F, 0xA3, 0x35, 0x8A, 0x51, 0xCD, 0xED, 0x49, 0x99, 0xBE,
0xF8, 0x29, 0x3F,
0xD1, 0xD7, 0xA8, 0xFB, 0xC6, 0x36, 0x82, 0x45, 0x64, 0xDB, 0x6D, 0x73, 0xEF,
0x53, 0xCA, 0x02,
0x7E, 0xB0, 0x91, 0x06, 0xBD, 0xD5, 0x66, 0x4B, 0xEA, 0x87, 0x7A, 0x6D, 0x95,
0xA5, 0x6B, 0x64,
0xB9, 0xD6, 0xC3, 0xDD, 0xB2, 0x5C, 0x03, 0x8B, 0x00, 0x5C, 0x46, 0x16, 0x8B,
0x86, 0xC8, 0x28,
0x0D, 0xB4, 0xB1, 0x3E, 0xB6, 0x0D, 0x82, 0x22, 0x97, 0x5B, 0x75, 0x02, 0x00,
0x97, 0xC7, 0x57,
0x4B, 0xA0, 0x81, 0xFB, 0x2D, 0xC8, 0xBB, 0x81, 0x37, 0xC4, 0x8E, 0xE6, 0x7C,
0x9A, 0xF9, 0x2D,
0x0C, 0xD4, 0xB8, 0x22, 0xE5, 0x3B, 0xA0, 0xFE, 0xA8, 0x3E, 0x5E, 0x99, 0x36,
0x57, 0x76, 0x25,
0x7E, 0xFC, 0x89, 0x17, 0x3C, 0x39, 0xF0, 0x3C, 0x2E, 0xB3, 0x3F, 0x14, 0xF5,
0x23, 0x96, 0x92,
0x42, 0x7B, 0x1D, 0xD0, 0x0B, 0xB1, 0x44, 0x71, 0x89, 0x3B, 0x44, 0xE5, 0xEA,
0xEA, 0x2C, 0x67,
0xBB, 0xD9, 0xE3, 0x9C, 0x8A, 0x1A, 0x83, 0x1E, 0xE9, 0x13, 0xE3, 0x3C, 0x06,
0xB0, 0xA3, 0x98,
0x9D, 0x2B, 0xA5, 0x84, 0x65, 0xDB, 0x23, 0x77, 0x59, 0xCA, 0x64, 0x76, 0x9D,
0x54, 0x05, 0x57,
0xA7, 0x10, 0xCB, 0x62, 0xEC, 0x7F, 0x39, 0xFC, 0xD7, 0x53, 0x3D, 0x46, 0x2D,
0xEC, 0x11, 0xD1,
0x42, 0x10, 0x6A, 0x73, 0x39, 0x18, 0x10, 0xA0, 0xCF, 0x9B, 0x88, 0x6F, 0x1E,
0x88, 0x68, 0x8B,
0x3C, 0x30, 0x59, 0x3F, 0x66, 0xB5, 0x09, 0x65, 0xFC, 0x37, 0xF7, 0x9F, 0x4E,
0xD7, 0x1A, 0xC6,
0x16, 0x64, 0x67, 0x64, 0x41, 0xC0, 0x90, 0x51, 0xD9, 0xDA, 0xF5, 0x25, 0x5C,
0xC0, 0x62, 0x9F,
0x0D, 0xEC, 0x2C, 0xD3, 0x02, 0x03, 0x01, 0x00, 0x01, 0xA3, 0x50, 0x30, 0x4E,
0x30, 0x1D, 0x06,
0x03, 0x55, 0x1D, 0x0E, 0x04, 0x16, 0x04, 0x14, 0x83, 0x4A, 0xA4, 0x36, 0x22,
0x55, 0x9C, 0xA2,
0x26, 0x5C, 0xC7, 0x86, 0xAE, 0x57, 0xA3, 0x40, 0x31, 0xE1, 0xE4, 0xCA, 0x30,
0x1F, 0x06, 0x03,
0x55, 0x1D, 0x23, 0x04, 0x18, 0x30, 0x16, 0x80, 0x14, 0x83, 0x4A, 0xA4, 0x36,
0x22, 0x55, 0x9C,
0xA2, 0x26, 0x5C, 0xC7, 0x86, 0xAE, 0x57, 0xA3, 0x40, 0x31, 0xE1, 0xE4, 0xCA,
0x30, 0x0C, 0x06,
0x03, 0x55, 0x1D, 0x13, 0x04, 0x05, 0x30, 0x03, 0x01, 0x01, 0xFF, 0x30, 0x0D,
0x06, 0x09, 0x2A,
0x86, 0x48, 0x86, 0xF7, 0x0D, 0x01, 0x01, 0x0B, 0x05, 0x00, 0x03, 0x82, 0x01,
0x01, 0x00, 0x3C,
0xC4, 0xE5, 0x4F, 0xBF, 0x2E, 0x20, 0xDB, 0x23, 0xF3, 0xD2, 0xFB, 0x9A, 0x37,
0x27, 0x9C, 0xFE,
0xD1, 0xE6, 0x1D, 0x20, 0xE6, 0x14, 0xE1, 0x07, 0xBF, 0x96, 0xD7, 0x67, 0xB7,
0x4B, 0xE8, 0x44,
0xA6, 0x35, 0x6B, 0x45, 0x87, 0x91, 0x86, 0x17, 0xA0, 0x58, 0x8E, 0x35, 0x24,
0x6E, 0x00, 0xAF,
0xFA, 0x3B, 0x76, 0xC9, 0x07, 0x27, 0xD0, 0x09, 0xDF, 0xCD, 0x48, 0x03, 0x9B,
0x4E, 0x43, 0xD8,
0x47, 0x45, 0x8F, 0x0A, 0x0D, 0xAF, 0xAE, 0x2C, 0xED, 0xC4, 0xFC, 0x6C, 0xD9,
0xF7, 0x54, 0xD9,
0x50, 0x61, 0xE2, 0xA0, 0x7B, 0x58, 0xCF, 0xF2, 0x34, 0xE3, 0xE9, 0x31, 0xA9,
0x82, 0x0C, 0xF6,
0x73, 0x83, 0x9A, 0x2E, 0x6D, 0x52, 0x30, 0x79, 0xC6, 0x30, 0x67, 0x45, 0x7C,
0xF3, 0xCC, 0x55,
0x19, 0xF5, 0x87, 0xC1, 0x17, 0x0A, 0xB4, 0xDE, 0xD0, 0xA2, 0x03, 0x48, 0xA4,
0x68, 0x4C, 0x26,
0x3E, 0xB9, 0x31, 0x83, 0xEE, 0x07, 0x57, 0x17, 0x01, 0xD5, 0x2A, 0xEF, 0xFC,
0xE9, 0x44, 0x07,
0xB0, 0x0A, 0x9E, 0x3B, 0xD9, 0xD7, 0x14, 0x28, 0xBC, 0xCB, 0x4C, 0x7A, 0xBB,
0xCF, 0xC5, 0x54,
0x92, 0x8D, 0x2E, 0xD6, 0xE4, 0xDE, 0x9A, 0x1F, 0xB1, 0x1E, 0xD2, 0x4B, 0xA5,
0x5C, 0x6A, 0xAB,
0xB6, 0xBA, 0x72, 0x98, 0x24, 0x6B, 0x70, 0xD2, 0xEE, 0xAC, 0x23, 0xCF, 0x95,
0xD4, 0x2F, 0xA5,
0x16, 0x2B, 0x22, 0xF7, 0xB8, 0x97, 0x14, 0x2F, 0x7E, 0xA0, 0x84, 0xBD, 0x19,
0xC3, 0x24, 0x2F,
0x1E, 0x78, 0x1E, 0x7D, 0xB3, 0xD0, 0x14, 0xC0, 0xF2, 0xCA, 0x83, 0xE1, 0xE9,
0x03, 0xC6, 0x50,
0xC2, 0xF0, 0x80, 0xDE, 0x69, 0x30, 0x8E, 0x66, 0xBD, 0xDB, 0x40, 0xD0, 0x8E,
0xF3, 0xD0, 0x6E,
0xBB, 0x4C, 0xBA, 0x41, 0xFA, 0x1A, 0x5F, 0xF8, 0xA8, 0x32, 0xCF, 0x1E, 0x49,
0x8D, 0x0D,
};
```

## src/jwt-test-private.c
```c
/*
 * Copyright (C) 2018, Linaro, Ltd
 * SPDX-License-Identifier: Apache-2.0
 *
 */

/* To generate the RSA key in the correct format use the following command:
 * $ openssl genrsa 2048 | openssl rsa -outform DER | xxd -i
 */

unsigned char jwt_test_rsa_private_der[] = {
	0x30, 0x82, 0x04, 0xa5, 0x02, 0x01, 0x00, 0x02, 0x82, 0x01, 0x01, 0x00, 0xc3, 0x10, 0x4f,
	0x09, 0xcb, 0xfa, 0xfc, 0xc6, 0xb3, 0x93, 0x38, 0x00, 0x6b, 0x0c, 0x6a, 0x68, 0xa8, 0x65,
	0x0b, 0xf3, 0x88, 0x57, 0x0f, 0x94, 0x5c, 0xf0, 0x93, 0xb1, 0x24, 0xff, 0x3e, 0xe8, 0x6b,
	0xf3, 0xbd, 0xd1, 0xd3, 0x9e, 0x64, 0x2e, 0x65, 0xfd, 0x2f, 0x57, 0xe9, 0x8d, 0x12, 0x4b,
	0xae, 0x3f, 0xe5, 0x04, 0x77, 0xa9, 0x78, 0x1f, 0x8a, 0xe8, 0x03, 0x6c, 0x06, 0x6f, 0x9e,
	0x77, 0x5c, 0xfe, 0x87, 0x2a, 0xb3, 0xb7, 0x7f, 0xaa, 0xe1, 0x9b, 0x2b, 0x79, 0x69, 0xac,
	0x06, 0xb3, 0x2e, 0x2f, 0x0d, 0x3a, 0x99, 0x06, 0xf4, 0xb1, 0x0a, 0x3a, 0x90, 0x75, 0x18,
	0x29, 0x48, 0xc4, 0x2b, 0xd0, 0x67, 0x41, 0x4b, 0x82, 0x47, 0xf3, 0xae, 0x6d, 0x05, 0x37,
	0xe4, 0x4d, 0x7e, 0x19, 0x61, 0x2c, 0xb1, 0x4c, 0x9e, 0x05, 0xcb, 0x98, 0x7d, 0x1c, 0x92,
	0x90, 0xff, 0xef, 0xa0, 0x5c, 0x5d, 0xee, 0xa9, 0xce, 0x04, 0x8d, 0xbc, 0xea, 0xb0, 0x37,
	0x97, 0x65, 0x95, 0xdb, 0x23, 0xb7, 0x8a, 0x9e, 0x8e, 0x14, 0x08, 0xb1, 0x8a, 0x64, 0x85,
	0xc7, 0x55, 0xe0, 0x1e, 0x7f, 0x5a, 0x8c, 0x78, 0xc1, 0x03, 0xcb, 0x0f, 0x8c, 0x51, 0x8d,
	0x6f, 0x55, 0x0a, 0x6a, 0xc5, 0x82, 0xf4, 0xf5, 0xae, 0x1a, 0xcb, 0x5a, 0x16, 0x45, 0x0f,
	0xe2, 0xc3, 0xb8, 0xd2, 0xe1, 0x50, 0xc7, 0x02, 0xe5, 0xf8, 0xd5, 0x63, 0xb9, 0xd4, 0xc7,
	0x6b, 0xf2, 0x03, 0x25, 0xfb, 0x18, 0x64, 0x66, 0xab, 0xbc, 0xd8, 0x04, 0xf8, 0xb9, 0x88,
	0x23, 0x5e, 0x6a, 0x27, 0x20, 0xa2, 0x7c, 0xaf, 0x75, 0xad, 0xdc, 0x38, 0xea, 0x03, 0x25,
	0x42, 0x39, 0xdd, 0x49, 0xf3, 0xaa, 0xd4, 0x46, 0x98, 0x57, 0x61, 0x1e, 0xc8, 0x56, 0x0e,
	0xfc, 0x4b, 0x9a, 0xe2, 0x27, 0xc0, 0x83, 0xc5, 0xde, 0xb2, 0x3e, 0x7d, 0xd9, 0x02, 0x03,
	0x01, 0x00, 0x01, 0x02, 0x82, 0x01, 0x00, 0x53, 0x34, 0x7a, 0xb2, 0x70, 0x1b, 0x10, 0x85,
	0xe5, 0x85, 0x8f, 0xa6, 0xc6, 0x02, 0xd6, 0xc4, 0xeb, 0xc7, 0xa6, 0x70, 0x6c, 0x20, 0xce,
	0xd9, 0x77, 0x47, 0x7b, 0x88, 0x5d, 0x82, 0xaf, 0x1f, 0xcf, 0x24, 0x7a, 0x3c, 0xad, 0xaa,
	0xeb, 0x8a, 0xcb, 0x20, 0x53, 0x78, 0x89, 0x7c, 0x0e, 0x68, 0xcf, 0xdc, 0x1b, 0x61, 0x6b,
	0x75, 0x93, 0x72, 0xc8, 0xfa, 0xac, 0xb3, 0x00, 0x8f, 0xce, 0x25, 0x96, 0x3a, 0x50, 0x07,
	0xcb, 0xff, 0x22, 0xeb, 0x0e, 0x2e, 0xf5, 0x3d, 0x65, 0xf0, 0xe6, 0x2e, 0xba, 0x2d, 0x81,
	0xd4, 0x14, 0x00, 0x5e, 0x91, 0xc2, 0x0e, 0x37, 0x1e, 0x6b, 0x7e, 0xf8, 0xb6, 0x0d, 0x06,
	0x69, 0x74, 0xf5, 0xb3, 0x8d, 0xe3, 0x88, 0xec, 0xa2, 0x04, 0x34, 0x53, 0x45, 0xcd, 0xa7,
	0xa0, 0xbb, 0xc4, 0x35, 0xc7, 0xbd, 0x0f, 0xbf, 0x96, 0x57, 0x82, 0x98, 0x59, 0x6b, 0xaa,
	0x1c, 0x05, 0xc6, 0x9a, 0x0b, 0x55, 0xf4, 0x30, 0xd5, 0xf9, 0xb7, 0xe9, 0x90, 0xff, 0x77,
	0x8c, 0x92, 0xdd, 0x42, 0x6f, 0xcd, 0x08, 0xff, 0x84, 0x59, 0xed, 0xdf, 0x86, 0x55, 0x9c,
	0x30, 0x29, 0x19, 0x55, 0xcc, 0x86, 0x10, 0xd0, 0x4b, 0x59, 0xa4, 0x34, 0xc5, 0x75, 0x0a,
	0xca, 0x41, 0xf0, 0x02, 0x97, 0xa1, 0x2b, 0x36, 0x2c, 0xca, 0x5e, 0xca, 0xe6, 0xe7, 0xe0,
	0xcb, 0xe8, 0x1d, 0xa0, 0x09, 0x8f, 0x4d, 0xf9, 0x63, 0x97, 0xa2, 0x0a, 0xd8, 0x88, 0x1e,
	0x6e, 0xd4, 0x0c, 0x30, 0xad, 0xf2, 0xc7, 0xa7, 0xa8, 0xe2, 0xce, 0x23, 0x3e, 0xa7, 0x02,
	0x3d, 0xe3, 0xff, 0xe4, 0xf1, 0x7c, 0xdb, 0xad, 0x88, 0x1e, 0xcd, 0xc7, 0x0e, 0x90, 0xf3,
	0xe5, 0xc2, 0x88, 0x37, 0x06, 0xd6, 0x92, 0x4f, 0x67, 0x77, 0xd6, 0x47, 0xc6, 0x59, 0x1a,
	0x3a, 0xdf, 0x12, 0x79, 0x60, 0x5e, 0x68, 0x5d, 0x02, 0x81, 0x81, 0x00, 0xe5, 0x79, 0x43,
	0xa6, 0x8a, 0x67, 0x71, 0xed, 0x3c, 0xec, 0x75, 0xa8, 0x56, 0x3d, 0x37, 0x39, 0x3d, 0xbd,
	0x71, 0x98, 0x4f, 0x6c, 0x65, 0x02, 0x5c, 0xf6, 0x1f, 0xf1, 0x8c, 0xe5, 0x92, 0xd6, 0xe0,
	0x60, 0x23, 0x3d, 0x90, 0x07, 0x9c, 0x4c, 0xa6, 0x1d, 0x6f, 0x94, 0x2a, 0x7c, 0x71, 0x40,
	0xf3, 0x48, 0x89, 0xb3, 0xe0, 0x7f, 0x28, 0xf9, 0xc4, 0x57, 0xbf, 0x29, 0x9c, 0x74, 0xf1,
	0x24, 0x31, 0xdb, 0xd3, 0x8b, 0x04, 0xfa, 0x1f, 0x2d, 0x37, 0x12, 0x96, 0xe2, 0x07, 0xd1,
	0x6b, 0x2f, 0x0b, 0xc3, 0x52, 0x51, 0x23, 0x0a, 0x71, 0x5f, 0x44, 0xde, 0x93, 0x60, 0x91,
	0x9b, 0x9a, 0x83, 0x0a, 0xc0, 0xd1, 0xaa, 0xbc, 0xc9, 0xab, 0x66, 0xb4, 0x20, 0x7c, 0x72,
	0x17, 0x94, 0x9c, 0x3d, 0xd0, 0xc9, 0x08, 0x35, 0xfe, 0xb0, 0x07, 0x16, 0xf0, 0x98, 0xc7,
	0x22, 0x6e, 0x83, 0xf4, 0x8f, 0x02, 0x81, 0x81, 0x00, 0xd9, 0x9c, 0xc3, 0x01, 0x27, 0x3c,
	0xa6, 0xa1, 0xbe, 0xb1, 0x1e, 0xe8, 0x2e, 0x16, 0xc7, 0xcc, 0x70, 0x27, 0xe5, 0x84, 0xdb,
	0xd0, 0x76, 0xdd, 0x45, 0x10, 0xf8, 0x80, 0x41, 0x60, 0x24, 0xfa, 0x04, 0x1e, 0x44, 0x29,
	0x31, 0x2e, 0x63, 0x20, 0xe7, 0x44, 0xc2, 0x19, 0x39, 0x83, 0x49, 0xf7, 0x0b, 0x48, 0x76,
	0xf0, 0x4a, 0xab, 0xad, 0xc9, 0xfc, 0xcf, 0x06, 0x5e, 0x5b, 0x1b, 0xb9, 0x33, 0xa8, 0xbe,
	0x19, 0x23, 0x1f, 0x18, 0xe1, 0x74, 0xb5, 0x7b, 0xfd, 0x56, 0x2e, 0x08, 0xee, 0xe2, 0xa8,
	0x2b, 0x8a, 0x24, 0x7f, 0x13, 0xc2, 0xb7, 0xd7, 0x32, 0x58, 0x75, 0xb5, 0x06, 0x8f, 0x40,
	0x8d, 0xd8, 0x47, 0x5f, 0x0c, 0xa9, 0x08, 0x65, 0x06, 0x6d, 0x5f, 0xad, 0xa9, 0x1b, 0xcd,
	0x7c, 0x4c, 0x49, 0xb7, 0x51, 0x0f, 0x40, 0xf2, 0x7c, 0x46, 0xcc, 0x7f, 0x46, 0xb3, 0x78,
	0xab, 0x17, 0x02, 0x81, 0x81, 0x00, 0x9d, 0xaa, 0x8d, 0x0d, 0xcf, 0x88, 0xb5, 0xe1, 0x5f,
	0xfb, 0xc3, 0xf7, 0x8e, 0x91, 0x6e, 0xf1, 0x18, 0x77, 0xa2, 0xa6, 0x18, 0xe4, 0x0c, 0x1e,
	0xec, 0x8a, 0x7b, 0x76, 0x36, 0xed, 0xc1, 0xcf, 0x7b, 0xc8, 0xf2, 0x4d, 0xa9, 0x39, 0x61,
	0x6d, 0xd4, 0xb0, 0xe2, 0xea, 0x35, 0xaa, 0xdd, 0x11, 0xd8, 0x56, 0x5d, 0xae, 0xc6, 0xaf,
	0xf8, 0x12, 0x6c, 0x92, 0x31, 0x99, 0x40, 0x93, 0xa4, 0xdf, 0xce, 0x96, 0x10, 0xaa, 0x33,
	0x18, 0x3b, 0xf5, 0x90, 0x22, 0x68, 0xa3, 0x12, 0xe6, 0x13, 0xb3, 0xf6, 0x6c, 0x14, 0x92,
	0x04, 0xf6, 0x76, 0xe1, 0x13, 0x6b, 0xae, 0x6d, 0x2a, 0x7e, 0x74, 0x52, 0x57, 0x40, 0x16,
	0x8f, 0x2e, 0x39, 0x8e, 0x57, 0xf9, 0xa9, 0x5c, 0x77, 0xf3, 0xb5, 0xbb, 0x08, 0x49, 0xfc,
	0xe6, 0x74, 0x5a, 0xf2, 0xcd, 0x5c, 0x38, 0xa1, 0x70, 0x29, 0x3b, 0x2f, 0xd5, 0x07, 0x02,
	0x81, 0x81, 0x00, 0xa9, 0xe0, 0xa7, 0x96, 0x89, 0xe3, 0xde, 0x0d, 0x1c, 0x49, 0x36, 0xe0,
	0x77, 0xc2, 0x4e, 0xdc, 0xf8, 0x9d, 0x1c, 0x9e, 0xb7, 0xde, 0xa8, 0x3c, 0x1a, 0x03, 0xa2,
	0x8a, 0xb4, 0xfe, 0x72, 0x3f, 0x3e, 0xe1, 0xc5, 0xc2, 0x06, 0x63, 0xb8, 0xfc, 0xe1, 0xad,
	0x9a, 0x7c, 0x88, 0x9a, 0x46, 0x2e, 0x75, 0xff, 0x6e, 0xe2, 0x2c, 0xd8, 0x92, 0xc5, 0xc0,
	0xf6, 0x78, 0x79, 0x46, 0x54, 0x81, 0x22, 0xa3, 0xd3, 0x2a, 0xda, 0x71, 0x17, 0x42, 0x41,
	0x92, 0xbf, 0xa5, 0x48, 0x16, 0x8d, 0xe0, 0xb6, 0xce, 0x23, 0x97, 0x26, 0xe0, 0x91, 0x33,
	0x8b, 0xc2, 0x91, 0xc9, 0xde, 0xb1, 0x9f, 0xda, 0x4a, 0xc1, 0xb0, 0x9a, 0x1e, 0xc8, 0x4a,
	0x58, 0x84, 0x4d, 0x1d, 0x2a, 0xf8, 0xed, 0xb0, 0x07, 0x9c, 0xc6, 0x0d, 0x31, 0xef, 0x34,
	0xa2, 0x35, 0xe9, 0xf0, 0x77, 0x09, 0xd0, 0xce, 0xa0, 0x1f, 0xa7, 0x02, 0x81, 0x81, 0x00,
	0xb0, 0x9d, 0xd2, 0x7f, 0xff, 0xe0, 0x86, 0x3e, 0x5f, 0xfe, 0x83, 0xf6, 0x51, 0xa3, 0x09,
	0xb2, 0xb6, 0x4a, 0xe0, 0xdf, 0xd9, 0xdd, 0x2a, 0x9f, 0x68, 0x4c, 0xb2, 0x4f, 0x12, 0x1d,
	0x07, 0xb8, 0x75, 0x70, 0x28, 0x7a, 0x49, 0xaa, 0x56, 0x53, 0x7a, 0xc7, 0xbf, 0xbd, 0xea,
	0x38, 0x2c, 0xf0, 0x91, 0xf6, 0x71, 0x1e, 0x97, 0x10, 0x20, 0x79, 0x2b, 0x24, 0x6c, 0x1c,
	0x7b, 0x2e, 0x96, 0x8c, 0x72, 0x13, 0xc1, 0x60, 0x7c, 0x41, 0x20, 0x8b, 0x36, 0x4c, 0xe2,
	0x65, 0x8d, 0xc5, 0x0e, 0x1e, 0x34, 0x01, 0x6d, 0x45, 0x48, 0x86, 0x6e, 0x45, 0x43, 0xf4,
	0xff, 0xb8, 0xa0, 0xa8, 0x07, 0x49, 0x54, 0x92, 0x0f, 0x53, 0xe9, 0x2c, 0xd3, 0xdb, 0x6a,
	0x8a, 0xeb, 0xc4, 0x15, 0x51, 0xdf, 0x9c, 0x1a, 0x1a, 0x20, 0x8a, 0xed, 0xfe, 0xef, 0xe8,
	0xe1, 0x04, 0x14, 0x05, 0xfd, 0x71, 0xb0, 0x3e};

/* Here's how to generate the ECDSA key in the correct format:
 * - generate the key using OpenSSL:
 *   $ openssl ecparam -name prime256v1 -genkey | openssl ec -outform der | xxd -ps
 * - copy the content to https://lapo.it/asn1js/
 * - get the first OCTECT STRING, which is the private key, and copy it here
 */

unsigned char jwt_test_ecdsa_private_der[] = {0xAA, 0xE2, 0xA4, 0x5F, 0x3B, 0xC4, 0xCB, 0xA5,
					      0x0B, 0x17, 0xAE, 0x55, 0x4D, 0x21, 0x1B, 0xB0,
					      0xCC, 0x71, 0x42, 0x74, 0xBF, 0x1D, 0xC6, 0x5B,
					      0xF9, 0x50, 0x93, 0x06, 0x7B, 0xCE, 0x9D, 0x75};

unsigned int jwt_test_rsa_private_der_len = sizeof(jwt_test_rsa_private_der);
unsigned int jwt_test_ecdsa_private_der_len = sizeof(jwt_test_ecdsa_private_der);
```
