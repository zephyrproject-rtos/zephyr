/*
 * Copyright 2023 NXP
 *
 * SPDX-License-Identifier: Apache-2.0
 */

/delete-node/ &storage_partition;

&mx25l6433f {
	partitions {
		settings_file_partition: partition@0 {
			reg = <0x00000000 0x00010000>;
			label = "settings_file_partition";
		};
	};
};
