/*
 * Copyright 2024 NXP
 *
 * SPDX-License-Identifier: Apache-2.0
 */

/delete-node/ &storage_partition;

&s26hs512t {
	partitions {
		settings_file_partition: partition@0 {
			label = "settings_file_partition";
			reg = <0x00000000 0x00010000>;
		};
	};
};
