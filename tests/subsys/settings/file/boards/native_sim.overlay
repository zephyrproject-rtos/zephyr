/*
 * Copyright (c) 2019 Nordic Semiconductor ASA
 *
 * SPDX-License-Identifier: Apache-2.0
 */

&flashcontroller0 {
	reg = <0x00000000 DT_SIZE_K(4096)>;
};

&flash0 {
	reg = <0x00000000 DT_SIZE_K(4096)>;
	partitions {
		compatible = "fixed-partitions";

		settings_file_partition: partition@0 {
			label = "settings_file_partition";
			reg = <0x00000000 0x00010000>;
		};
	};
};
