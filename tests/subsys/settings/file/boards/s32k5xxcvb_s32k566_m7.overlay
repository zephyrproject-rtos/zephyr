/*
 * Copyright 2025 NXP
 *
 * SPDX-License-Identifier: Apache-2.0
 */

/delete-node/ &storage_partition;

&is66wvh8m8dall {
	partitions {
		settings_file_partition: partition@0 {
			label = "settings_file_partition";
			reg = <0x00000000 0x00010000>;
		};
	};
};
