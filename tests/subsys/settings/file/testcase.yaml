## tests/subsys/settings/file/testcase.yaml
```yaml
# SPDX-License-Identifier: Apache-2.0
# Copyright (c) 2019 Nordic Semiconductor ASA

tests:
  settings.file.raw:
    platform_allow:
      - nrf52840dk/nrf52840
      - native_sim
      - native_sim/native/64
      - mr_canhubk3
      - s32z2xxdc2/s32z270/rtu0
      - s32z2xxdc2/s32z270/rtu1
      - s32z2xxdc2@D/s32z270/rtu0
      - s32z2xxdc2@D/s32z270/rtu1
    integration_platforms:
      - nrf52840dk/nrf52840
    tags:
      - settings
      - file
      - littlefs
```

## tests/subsys/settings/functional/eeprom/testcase.yaml
```yaml
tests:
  system.settings.functional.eeprom:
    platform_allow: qemu_x86 native_posix native_posix_64
    tags: settings_eeprom
```

## tests/subsys/settings/functional/fcb/testcase.yaml
```yaml
tests:
  settings.functional.fcb:
    platform_allow:
      - nrf52840dk/nrf52840
      - nrf52dk/nrf52832
      - native_sim
      - native_sim/native/64
      - mr_canhubk3
      - s32z2xxdc2/s32z270/rtu0
      - s32z2xxdc2/s32z270/rtu1
      - s32z2xxdc2@D/s32z270/rtu0
      - s32z2xxdc2@D/s32z270/rtu1
    integration_platforms:
      - native_sim
    tags:
      - settings
      - fcb
  settings.functional.fcb.chosen:
    extra_args: DTC_OVERLAY_FILE=./chosen.overlay
    platform_allow:
      - native_sim
      - native_sim/native/64
      - mr_canhubk3
      - s32z2xxdc2/s32z270/rtu0
      - s32z2xxdc2/s32z270/rtu1
      - s32z2xxdc2@D/s32z270/rtu0
      - s32z2xxdc2@D/s32z270/rtu1
    integration_platforms:
      - native_sim
    tags:
      - settings
      - fcb
```

## tests/subsys/settings/functional/file/testcase.yaml
```yaml
tests:
  settings.file:
    platform_allow:
      - nrf52840dk/nrf52840
      - nrf52dk/nrf52832
      - native_sim
      - native_sim/native/64
      - mr_canhubk3
      - s32z2xxdc2/s32z270/rtu0
      - s32z2xxdc2/s32z270/rtu1
      - s32z2xxdc2@D/s32z270/rtu0
      - s32z2xxdc2@D/s32z270/rtu1
      - s32k5xxcvb/s32k566/m7
      - s32k5xxcvb/s32k566/r52
    integration_platforms:
      - native_sim
    tags:
      - settings
      - file
```

## tests/subsys/settings/functional/nvs/testcase.yaml
```yaml
tests:
  settings.functional.nvs:
    platform_allow:
      - qemu_x86
      - mps2/an385
      - native_sim
      - native_sim/native/64
      - s32z2xxdc2/s32z270/rtu0
      - s32z2xxdc2/s32z270/rtu1
      - s32z2xxdc2@D/s32z270/rtu0
      - s32z2xxdc2@D/s32z270/rtu1
    integration_platforms:
      - mps2/an385
    tags:
      - settings
      - nvs
  settings.functional.nvs.chosen:
    extra_args: DTC_OVERLAY_FILE=./chosen.overlay
    platform_allow:
      - mps2/an385
      - native_sim
      - native_sim/native/64
      - s32z2xxdc2/s32z270/rtu0
      - s32z2xxdc2/s32z270/rtu1
      - s32z2xxdc2@D/s32z270/rtu0
      - s32z2xxdc2@D/s32z270/rtu1
    integration_platforms:
      - mps2/an385
    tags:
      - settings
      - nvs
  settings.functional.nvs.dk:
    extra_args: EXTRA_CONF_FILE=mpu.conf
    platform_allow:
      - nrf52840dk/nrf52840
      - nrf52dk/nrf52832
      - s32z2xxdc2/s32z270/rtu0
      - s32z2xxdc2/s32z270/rtu1
      - s32z2xxdc2@D/s32z270/rtu0
      - s32z2xxdc2@D/s32z270/rtu1
      - mps2/an385
    integration_platforms:
      - mps2/an385
    tags:
      - settings
      - nvs
```

## tests/subsys/settings/functional/psa/testcase.yaml
```yaml
tests:
  settings.functional.psa-its:
    filter: CONFIG_TFM_PARTITION_INTERNAL_TRUSTED_STORAGE
    tags:
      - settings
      - trusted-firmware-m
    extra_args:
      - CONFIG_SETTINGS_TFM_ITS=y
```

## tests/subsys/settings/functional/ram/testcase.yaml
```yaml
tests:
  system.settings.functional.ram:
    platform_allow: native_posix native_posix_64
    tags: settings_ram
  system.settings.functional.ram.dk:
    platform_allow: nrf52840dk_nrf52840 nrf52dk_nrf52832
    tags: settings_ram
```

## tests/subsys/settings/functional/tfm_psa/testcase.yaml
```yaml
common:
  integration_platforms:
    - max32657evkit/max32657/ns
    - nrf5340dk/nrf5340/cpuapp/ns
    - nrf54l15dk/nrf54l15/cpuapp/ns
    - nrf54lm20dk/nrf54lm20a/cpuapp/ns
    - mps2/an521/cpu0/ns
  platform_exclude:
    - lpcxpresso55s69/lpc55s69/cpu0/ns
  tags:
    - settings
    - trusted-firmware-m
  extra_args:
    - CONFIG_SETTINGS_TFM_PSA=y

tests:
  settings.functional.tfm-ps:
    filter: CONFIG_TFM_PARTITION_PROTECTED_STORAGE
    extra_args:
      - CONFIG_SETTINGS_TFM_PSA_BACKEND_PS=y

  settings.functional.tfm-its:
    filter: CONFIG_TFM_PARTITION_INTERNAL_TRUSTED_STORAGE
    extra_args:
      - CONFIG_SETTINGS_TFM_PSA_BACKEND_ITS=y
```

## tests/subsys/settings/functional/zms/testcase.yaml
```yaml
tests:
  settings.functional.zms:
    platform_allow:
      - qemu_x86
      - native_sim
      - native_sim/native/64
    tags:
      - settings
      - zms
```

## tests/subsys/settings/its/testcase.yaml
```yaml
# Copyright (c) 2025 Analog Devices, Inc.
#
# SPDX-License-Identifier: Apache-2.0

tests:
  settings.tfm_its:
    filter: CONFIG_TFM_PARTITION_INTERNAL_TRUSTED_STORAGE
    min_ram: 32
    integration_platforms:
      - max32657evkit/max32657/ns
      - nrf5340dk/nrf5340/cpuapp/ns
      - nrf54l15dk/nrf54l15/cpuapp/ns
      - nrf54lm20dk/nrf54lm20a/cpuapp/ns
      - mps2/an521/cpu0/ns
      - lpcxpresso55s69/lpc55s69/cpu0/ns
    tags:
      - trusted-firmware-m
```

## tests/subsys/settings/littlefs/base64/testcase.yaml
```yaml
# SPDX-License-Identifier: Apache-2.0
# Copyright (c) 2019 Nordic Semiconductor ASA

tests:
  system.settings.littlefs.base64:
    platform_allow: nrf52840dk_nrf52840
    tags: settings_fs filesystem
    extra_configs:
    - CONFIG_STDOUT_CONSOLE=y
    - CONFIG_ARM_MPU=n
  system.settings.littlefs.base64_native_posix:
    platform_allow: native_posix native_posix_64
    tags: settings_fs filesystem
```

## tests/subsys/settings/littlefs/raw/boards/nrf52840_pca10056.conf
```kconfig
 # SPDX-License-Identifier: Apache-2.0
 # Copyright (c) 2019 Nordic Semiconductor ASA

CONFIG_SPI=y
CONFIG_SPI_NOR=y
CONFIG_SPI_NOR_FLASH_LAYOUT_PAGE_SIZE=4096
```

## tests/subsys/settings/littlefs/raw/boards/nrf52840dk_nrf52840.conf
```kconfig
 # SPDX-License-Identifier: Apache-2.0
 # Copyright (c) 2019 Nordic Semiconductor ASA

CONFIG_NORDIC_QSPI_NOR=y
CONFIG_NORDIC_QSPI_NOR_FLASH_LAYOUT_PAGE_SIZE=4096
```

## tests/subsys/settings/littlefs/raw/testcase.yaml
```yaml
# SPDX-License-Identifier: Apache-2.0
# Copyright (c) 2019 Nordic Semiconductor ASA

tests:
  system.settings.littlefs.raw:
    platform_allow: nrf52840dk_nrf52840 native_posix native_posix_64
    tags: settings_fs settings_littlefs
```

## tests/subsys/settings/littlefs/testcase.yaml
```yaml
# SPDX-License-Identifier: Apache-2.0
# Copyright (c) 2019 Nordic Semiconductor ASA

tests:
  system.settings.littlefs.raw:
    platform_allow: nrf52840dk_nrf52840
    tags: settings_fs settings_littlefs
    extra_configs:
    - CONFIG_STDOUT_CONSOLE=y
    - CONFIG_ARM_MPU=n
  system.settings.littlefs.raw_native_posix:
    platform_allow: native_posix native_posix_64
    tags: settings_fs settings_littlefs
```

## tests/subsys/settings/nvs/raw/testcase.yaml
```yaml
tests:
  system.settings.nvs:
    filter: dt_label_enabled("storage")
    min_ram: 32
    tags: settings nvs
```

## tests/subsys/settings/nvs/testcase.yaml
```yaml
tests:
  settings.nvs:
    depends_on: nvs
    min_ram: 32
    tags:
      - settings
      - nvs
```

## tests/subsys/settings/performance/testcase.yaml
```yaml
tests:
  settings.performance.zms:
    extra_configs:
      - CONFIG_SETTINGS_ZMS=y
      - CONFIG_ZMS_LOOKUP_CACHE=y
      - CONFIG_ZMS_LOOKUP_CACHE_SIZE=512
    platform_allow:
      - nrf52840dk/nrf52840
      - nrf54l15dk/nrf54l15/cpuapp
      - mps2/an385
    integration_platforms:
      - mps2/an385
    min_ram: 32
    tags:
      - settings
      - zms

  settings.performance.nvs:
    extra_configs:
      - CONFIG_ZMS=n
      - CONFIG_NVS=y
      - CONFIG_NVS_LOOKUP_CACHE=y
      - CONFIG_NVS_LOOKUP_CACHE_SIZE=512
      - CONFIG_SETTINGS_NVS_NAME_CACHE=y
      - CONFIG_SETTINGS_NVS_NAME_CACHE_SIZE=512
    platform_allow:
      - nrf52840dk/nrf52840
      - nrf54l15dk/nrf54l15/cpuapp
      - mps2/an385
    integration_platforms:
      - mps2/an385
    min_ram: 32
    tags:
      - settings
      - nvs

  settings.performance.zms_bt:
    extra_configs:
      - CONFIG_BT=y
      - CONFIG_BT_OBSERVER=y
      - CONFIG_BT_PERIPHERAL=y
      - CONFIG_SETTINGS_ZMS=y
      - CONFIG_ZMS_LOOKUP_CACHE=y
      - CONFIG_ZMS_LOOKUP_CACHE_SIZE=512
    platform_allow:
      - nrf52840dk/nrf52840
    min_ram: 32
    tags:
      - settings
      - zms

  settings.performance.nvs_bt:
    extra_configs:
      - CONFIG_BT=y
      - CONFIG_BT_OBSERVER=y
      - CONFIG_BT_PERIPHERAL=y
      - CONFIG_ZMS=n
      - CONFIG_NVS=y
      - CONFIG_NVS_LOOKUP_CACHE=y
      - CONFIG_NVS_LOOKUP_CACHE_SIZE=512
      - CONFIG_SETTINGS_NVS_NAME_CACHE=y
      - CONFIG_SETTINGS_NVS_NAME_CACHE_SIZE=512
    platform_allow:
      - nrf52840dk/nrf52840
    min_ram: 32
    tags:
      - settings
      - nvs
```

## tests/subsys/settings/ram/raw/testcase.yaml
```yaml
tests:
  system.settings.nvs:
    depends_on: ram
    min_ram: 32
    tags: settings_ram
```

## tests/subsys/settings/retention/testcase.yaml
```yaml
tests:
  settings.retention:
    platform_allow:
      - nrf52840dk/nrf52840
      - qemu_cortex_m3
      - apollo510_evb
      - apollo510b_evb
    min_ram: 8
    tags:
      - settings
      - retention
```

## tests/subsys/settings/tfm_psa/testcase.yaml
```yaml
# Copyright (c) 2025 Analog Devices, Inc.
#
# SPDX-License-Identifier: Apache-2.0

common:
  integration_platforms:
    - max32657evkit/max32657/ns
    - nrf5340dk/nrf5340/cpuapp/ns
    - nrf54l15dk/nrf54l15/cpuapp/ns
    - nrf54lm20dk/nrf54lm20a/cpuapp/ns
    - nrf7120dk/nrf7120/cpuapp/ns
    - mps2/an521/cpu0/ns
    - lpcxpresso55s69/lpc55s69/cpu0/ns
  tags:
    - settings
    - trusted-firmware-m

tests:
  settings.tfm_psa_ps:
    filter: CONFIG_TFM_PARTITION_PROTECTED_STORAGE
    extra_args:
      - CONFIG_SETTINGS_TFM_PSA_BACKEND_PS=y

  settings.tfm_psa_its:
    filter: CONFIG_TFM_PARTITION_INTERNAL_TRUSTED_STORAGE
    extra_args:
      - CONFIG_SETTINGS_TFM_PSA_BACKEND_PS=y
```

## tests/subsys/settings/zms/testcase.yaml
```yaml
tests:
  settings.zms:
    filter: dt_label_with_parent_compat_enabled("storage_partition", "fixed-partitions") or
            dt_label_compat_enabled("storage_partition", "zephyr,mapped-partition")
    min_ram: 32
    tags:
      - settings
      - zms
```

## tests/subsys/settings_static_data/testcase.yaml
```yaml
tests:
  settings.settings_static_data:
    platform_allow: native_sim
    tags: settings
```
