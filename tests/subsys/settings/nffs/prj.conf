## CMakeLists.txt
```
cmake_minimum_required(VERSION 3.8.2)
include($ENV{ZEPHYR_BASE}/cmake/app/boilerplate.cmake NO_POLICY_SCOPE)
project(nffs)

FILE(GLOB app_sources src/*.c ../src/*c)
target_sources(app PRIVATE ${app_sources})
zephyr_include_directories(
	$ENV{ZEPHYR_BASE}/subsys/settings/include
	$ENV{ZEPHYR_BASE}/subsys/settings/src
	$ENV{ZEPHYR_BASE}/tests/subsys/settings/nffs/src
	)

if(TEST)
	target_compile_definitions(app PRIVATE
		-DTEST_${TEST}
		)
endif()
```

## prj.conf
```kconfig
CONFIG_ZTEST=y
CONFIG_STDOUT_CONSOLE=y
CONFIG_FLASH=y
CONFIG_FLASH_PAGE_LAYOUT=y
CONFIG_FLASH_MAP=y
CONFIG_ARM_MPU=n

CONFIG_ZTEST_STACKSIZE=2048
CONFIG_MAIN_STACK_SIZE=1024
CONFIG_HEAP_MEM_POOL_SIZE=1024

CONFIG_FILE_SYSTEM=y
CONFIG_LOG=y
CONFIG_FILE_SYSTEM_NFFS=y
CONFIG_FS_NFFS_FLASH_DEV_NAME="NRF_FLASH_DRV_NAME"
CONFIG_FS_NFFS_NUM_FILES=4
CONFIG_FS_NFFS_NUM_DIRS=4
CONFIG_FS_NFFS_NUM_INODES=1024
CONFIG_FS_NFFS_NUM_BLOCKS=1024
CONFIG_FS_NFFS_NUM_CACHE_INODES=1
CONFIG_FS_NFFS_NUM_CACHE_BLOCKS=1
CONFIG_FILE_SYSTEM_NFFS=y
CONFIG_NFFS_FILESYSTEM_MAX_AREAS=12

CONFIG_SETTINGS=y
CONFIG_SETTINGS_FS=y
```

## src/settings_setup_nffs.c
```c
/*
 * Copyright (c) 2018 Nordic Semiconductor ASA
 * Copyright (c) 2015 Runtime Inc
 *
 * SPDX-License-Identifier: Apache-2.0
 */

#include "settings_test.h"
#include <device.h>
#include <fs/fs.h>
#include <nffs/nffs.h>

/* NFFS work area strcut */
static struct nffs_flash_desc flash_desc;

/* mounting info */
static struct fs_mount_t nffs_mnt = {
	.type = FS_NFFS,
	.mnt_point = TEST_FS_MPTR,
	.fs_data = &flash_desc,
};

void config_setup_nffs(void)
{
	struct device *flash_dev;
	int rc;

	flash_dev = device_get_binding(CONFIG_FS_NFFS_FLASH_DEV_NAME);
	zassert_not_null(flash_dev, "Can't bind to the flash device");

	/* set backend storage dev */
	nffs_mnt.storage_dev = flash_dev;

	rc = fs_mount(&nffs_mnt);
	zassert_true(rc == 0, "mounting nffs [%d]\n", rc);

	rc = fs_unlink(TEST_CONFIG_DIR);
	zassert_true(rc == 0 || rc == -ENOENT,
		     "can't delete config directory%d\n", rc);
}
```

## src/settings_test.h
```c
/*
 * Copyright (c) 2018 Nordic Semiconductor ASA
 * Copyright (c) 2015 Runtime Inc
 *
 * SPDX-License-Identifier: Apache-2.0
 */

#ifndef _SETTINGS_TEST_H
#define _SETTINGS_TEST_H

#include "settings_test_fs.h"

#define TEST_FS_MPTR "/nffs"
#define TEST_CONFIG_DIR TEST_FS_MPTR"/config"

#endif /* _SETTINGS_TEST_H */
```

## src/settings_test_compress_file.c
```c
/*
 * Copyright (c) 2018 Nordic Semiconductor ASA
 * Copyright (c) 2015 Runtime Inc
 *
 * SPDX-License-Identifier: Apache-2.0
 */

#include <stdlib.h>
#include <string.h>
#include "settings_test.h"
#include "settings/settings_file.h"

#ifdef CONFIG_SETTINGS_USE_BASE64
#define EXP_STR_CONTENT_1 "\x12\x00myfoo/mybar16=AAE="\
			  "\x10\x00myfoo/mybar=FA=="\
			  "\x1A\x00myfoo/mybar64=JQAAAAAAAAA="

#define EXP_STR_CONTENT_2 "\x10\x00myfoo/mybar=FA=="\
			  "\x12\x00myfoo/mybar16=AQE="\
			  "\x1A\x00myfoo/mybar64=EwAAAAAAAAA="
#else
#define EXP_STR_CONTENT_1 "\x10\x00myfoo/mybar16=\x00\x01"\
			  "\x0d\x00myfoo/mybar=\x14"\
			  "\x16\x00myfoo/mybar64=\x25\x00\x00\x00\x00\x00\x00\x00"

#define EXP_STR_CONTENT_2 "\x0d\x00myfoo/mybar=\x14"\
			  "\x10\x00myfoo/mybar16=\x01\x01"\
			  "\x16\x00myfoo/mybar64=\x13\x00\x00\x00\x00\x00\x00\x00"
#endif

int file_str_cmp(const char *fname, char const *string, size_t pattern_len);

void test_config_compress_file(void)
{
	int rc;
	struct settings_file cf;

	config_wipe_srcs();

	rc = fs_mkdir(TEST_CONFIG_DIR);
	zassert_true(rc == 0 || rc == -EEXIST, "can't create directory");

	cf.cf_name = TEST_CONFIG_DIR "/korwin";
	cf.cf_maxlines = 24;
	cf.cf_lines = 0; /* required as not start with load settings */

	rc = settings_file_src(&cf);
	zassert_true(rc == 0, "can't register FS as configuration source");

	rc = settings_file_dst(&cf);
	zassert_true(rc == 0,
		     "can't register FS as configuration destination");

	val64 = 1125U;
	val16 = 256U;

	for (int i = 0; i < 21; i++) {
		val8 = i;
		rc = settings_save();
		zassert_true(rc == 0, "fs write error");

		val8 = 0xff;
		settings_load();
		zassert_true(val8 == i, "Bad value loaded");
	}

	val64 = 37U;
	rc = settings_save();
	zassert_true(rc == 0, "fs write error");

	const char exp_content_1[] = EXP_STR_CONTENT_1;

	/* check 1st compression */
	rc = file_str_cmp(cf.cf_name, exp_content_1, sizeof(exp_content_1)-1);
	zassert_true(rc == 0, "bad value read");

	val16 = 257U;
	for (int i = 0; i < 20; i++) {
		val64 = i;
		rc = settings_save();
		zassert_true(rc == 0, "fs write error");

		val64 = 0xff;
		settings_load();
		zassert_true(val64 == i, "Bad value loaded");
	}

	const char exp_content_2[] = EXP_STR_CONTENT_2;

	/* check subsequent compression */
	rc = file_str_cmp(cf.cf_name, exp_content_2, sizeof(exp_content_2)-1);
	zassert_true(rc == 0, "bad value read");
}

int file_str_cmp(const char *fname, char const *string, size_t pattern_len)
{
	int rc;
	u32_t len;
	size_t rlen;
	char *buf;
	struct fs_dirent entry;

	rc = fs_stat(fname, &entry);
	if (rc) {
		return rc;
	}

	if (entry.size != pattern_len) {
		return -1;
	}

	len = entry.size;
	buf = (char *)k_malloc(len + 1);
	zassert_not_null(buf, "out of memory");

	rc = fsutil_read_file(fname, 0, len, buf, &rlen);
	zassert_true(rc == 0, "can't access the file\n'");
	zassert_true(rc == 0, "not enough data read\n'");
	buf[rlen] = '\0';

	if (memcmp(buf, string, len)) {
		return -1;
	}

	return -0;
}
```

## src/settings_test_empty_file.c
```c
/*
 * Copyright (c) 2018 Nordic Semiconductor ASA
 * Copyright (c) 2015 Runtime Inc
 *
 * SPDX-License-Identifier: Apache-2.0
 */

#include "settings_test.h"
#include "settings/settings_file.h"
#include <fs/fs.h>

void test_config_empty_file(void)
{
	int rc;
	struct settings_file cf_mfg;
	struct settings_file cf_running;
	const char cf_mfg_test[] = "";
	const char cf_running_test[] = "\n\n";

	config_wipe_srcs();

	cf_mfg.cf_name = TEST_CONFIG_DIR "/mfg";
	cf_running.cf_name = TEST_CONFIG_DIR "/running";

	rc = settings_file_src(&cf_mfg);
	zassert_true(rc == 0, "can't register FS as configuration source");
	rc = settings_file_src(&cf_running);
	zassert_true(rc == 0, "can't register FS as configuration source");

	settings_mount_fs_backend(&cf_mfg);
	/*
	 * No files
	 */
	settings_load();

	rc = fs_mkdir(TEST_CONFIG_DIR);
	zassert_true(rc == 0, "can't create directory");

	rc = fsutil_write_file(TEST_CONFIG_DIR "/mfg", cf_mfg_test,
			       0);
	zassert_true(rc == 0, "can't write to file");

	rc = fsutil_write_file(TEST_CONFIG_DIR "/running", cf_running_test,
			       sizeof(cf_running_test));
	zassert_true(rc == 0, "can't write to file");

	settings_load();
	config_wipe_srcs();
	ctest_clear_call_state();
}
```

## src/settings_test_multiple_in_file.c
```c
/*
 * Copyright (c) 2018 Nordic Semiconductor ASA
 * Copyright (c) 2015 Runtime Inc
 *
 * SPDX-License-Identifier: Apache-2.0
 */

#include "settings_test.h"
#include "settings/settings_file.h"

#ifdef CONFIG_SETTINGS_USE_BASE64
#define CF_MFG_TEST1 "\x10\x00myfoo/mybar=AQ=="\
		     "\x10\x00myfoo/mybar=Dg=="
#define CF_MFG_TEST2 "\x10\x00myfoo/mybar=AQ=="\
		     "\x10\x00myfoo/mybar=Dw=="
#else
#define CF_MFG_TEST1 "\x0d\x00myfoo/mybar=\x01"\
		     "\x0d\x00myfoo/mybar=\x0e"
#define CF_MFG_TEST2 "\x0d\x00myfoo/mybar=\x01"\
		     "\x0d\x00myfoo/mybar=\x0f"
#endif

void test_config_multiple_in_file(void)
{
	int rc;
	struct settings_file cf_mfg;
	const char cf_mfg_test1[] = CF_MFG_TEST1;
	const char cf_mfg_test2[] = CF_MFG_TEST2;

	config_wipe_srcs();

	cf_mfg.cf_name = TEST_CONFIG_DIR "/mfg";
	rc = settings_file_src(&cf_mfg);
	zassert_true(rc == 0, "can't register FS as configuration source");

	rc = fsutil_write_file(TEST_CONFIG_DIR "/mfg", cf_mfg_test1,
			       sizeof(cf_mfg_test1));
	zassert_true(rc == 0, "can't write to file");

	settings_load();
	zassert_true(test_set_called, "the SET handler wasn't called");
	zassert_true(val8 == 14U,
		     "SET handler: was called with wrong parameters");

	rc = fsutil_write_file(TEST_CONFIG_DIR "/mfg", cf_mfg_test2,
			       sizeof(cf_mfg_test2));
	zassert_true(rc == 0, "can't write to file");

	settings_load();
	zassert_true(test_set_called, "the SET handler wasn't called");
	zassert_true(val8 == 15U,
		     "SET handler: was called with wrong parameters");
}
```

## src/settings_test_nffs.c
```c
/*
 * Copyright (c) 2018 Nordic Semiconductor ASA
 * Copyright (c) 2015 Runtime Inc
 *
 * SPDX-License-Identifier: Apache-2.0
 */
#include <stdlib.h>
#include <string.h>

#include "settings_test.h"
#include "settings_priv.h"

void config_setup_nffs(void);

void test_main(void)
{
	ztest_test_suite(test_config_fcb,
			 /* Config tests */
			 ztest_unit_test(config_empty_lookups),
			 ztest_unit_test(test_config_insert),
			 ztest_unit_test(test_config_getset_unknown),
			 ztest_unit_test(test_config_getset_int),
			 ztest_unit_test(test_config_getset_int64),
			 ztest_unit_test(test_config_commit),
			 /* NFFS as backing storage. */
			 ztest_unit_test(config_setup_nffs),
			 ztest_unit_test(test_config_empty_file),
			 ztest_unit_test(test_config_small_file),
			 ztest_unit_test(test_config_multiple_in_file),
			 ztest_unit_test(test_config_save_in_file),
			 ztest_unit_test(test_config_save_one_file),
			 ztest_unit_test(test_config_compress_file)
			);

	ztest_run_test_suite(test_config_fcb);
}
```

## src/settings_test_save_in_file.c
```c
/*
 * Copyright (c) 2018 Nordic Semiconductor ASA
 * Copyright (c) 2015 Runtime Inc
 *
 * SPDX-License-Identifier: Apache-2.0
 */

#include "settings_test.h"
#include "settings/settings_file.h"

void test_config_save_in_file(void)
{
	int rc;
	struct settings_file cf;

	config_wipe_srcs();

	rc = fs_mkdir(TEST_CONFIG_DIR);
	zassert_true(rc == 0 || rc == -EEXIST, "can't create directory");

	cf.cf_name = TEST_CONFIG_DIR "/blah";
	rc = settings_file_src(&cf);
	zassert_true(rc == 0, "can't register FS as configuration source");

	rc = settings_file_dst(&cf);
	zassert_true(rc == 0,
		     "can't register FS as configuration destination");

	val8 = 8U;
	rc = settings_save();
	zassert_true(rc == 0, "fs write error");

	rc = settings_test_file_strstr(cf.cf_name, "\x10\x00myfoo/mybar=CA==",
				       18);
	zassert_true(rc == 0, "bad value read");

	val8 = 43U;
	rc = settings_save();
	zassert_true(rc == 0, "fs write error");

	rc = settings_test_file_strstr(cf.cf_name, "\x10\x00myfoo/mybar=Kw==",
				       18);
	zassert_true(rc == 0, "bad value read");
}
```

## src/settings_test_save_one_file.c
```c
/*
 * Copyright (c) 2018 Nordic Semiconductor ASA
 * Copyright (c) 2015 Runtime Inc
 *
 * SPDX-License-Identifier: Apache-2.0
 */

#include "settings_test.h"
#include "settings/settings_file.h"

static int test_config_save_one_byte_value(const char *name, u8_t val)
{
	return settings_save_one(name, &val, 1);
}


void test_config_save_one_file(void)
{
	int rc;
	struct settings_file cf;

	config_wipe_srcs();
	rc = fs_mkdir(TEST_CONFIG_DIR);
	zassert_true(rc == 0 || rc == -EEXIST, "can't create directory");

	cf.cf_name = TEST_CONFIG_DIR "/blah";
	rc = settings_file_src(&cf);
	zassert_true(rc == 0, "can't register FS as configuration source");

	rc = settings_file_dst(&cf);
	zassert_true(rc == 0,
		     "can't register FS as configuration destination");

	val8 = 33U;
	rc = settings_save();
	zassert_true(rc == 0, "fs write error");

	rc = test_config_save_one_byte_value("myfoo/mybar", 42);
	zassert_equal(rc, 0, "fs one item write error");

	rc = settings_load();
	zassert_true(rc == 0, "fs redout error");
	zassert_true(val8 == 42U, "bad value read");

	rc = test_config_save_one_byte_value("myfoo/mybar", 44);
	zassert_true(rc == 0, "fs one item write error");

	rc = settings_load();
	zassert_true(rc == 0, "fs redout error");
	zassert_true(val8 == 44U, "bad value read");
}
```

## src/settings_test_small_file.c
```c
/*
 * Copyright (c) 2018 Nordic Semiconductor ASA
 * Copyright (c) 2015 Runtime Inc
 *
 * SPDX-License-Identifier: Apache-2.0
 */

#include "settings_test.h"
#include "settings/settings_file.h"

#ifdef CONFIG_SETTINGS_USE_BASE64
#define CF_MFG_TEST_STR "\x10\x00myfoo/mybar=AQ=="
#define CF_RUNNING_TEST_STR "\x10\x00myfoo/mybar=CA=="
#else
#define CF_MFG_TEST_STR "\x0D\x00myfoo/mybar=\x01"
#define CF_RUNNING_TEST_STR "\x0D\x00myfoo/mybar=\x08"
#endif

void test_config_small_file(void)
{
	int rc;
	struct settings_file cf_mfg;
	struct settings_file cf_running;
	const char cf_mfg_test[] = CF_MFG_TEST_STR;
	const char cf_running_test[] = CF_RUNNING_TEST_STR;

	config_wipe_srcs();

	cf_mfg.cf_name = TEST_CONFIG_DIR "/mfg";
	cf_running.cf_name = TEST_CONFIG_DIR "/running";

	rc = settings_file_src(&cf_mfg);
	zassert_true(rc == 0, "can't register FS as configuration source");
	rc = settings_file_src(&cf_running);
	zassert_true(rc == 0, "can't register FS as configuration source");

	rc = fsutil_write_file(TEST_CONFIG_DIR "/mfg", cf_mfg_test,
			       sizeof(cf_mfg_test));
	zassert_true(rc == 0, "can't write to file");

	settings_load();
	zassert_true(test_set_called, "the SET handler wasn't called");
	zassert_true(val8 == 1U,
		     "SET handler: was called with wrong parameters");

	ctest_clear_call_state();

	rc = fsutil_write_file(TEST_CONFIG_DIR "/running", cf_running_test,
			       sizeof(cf_running_test));
	zassert_true(rc == 0, "can't write to file");

	settings_load();
	zassert_true(test_set_called, "the SET handler wasn't called");
	zassert_true(val8 == 8U,
		     "SET handler: was called with wrong parameters");

	ctest_clear_call_state();
}
```
