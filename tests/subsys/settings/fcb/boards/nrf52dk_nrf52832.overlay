/*
 * Copyright (c) 2018 Nordic Semiconductor ASA
 *
 * SPDX-License-Identifier: Apache-2.0
 */

/delete-node/ &storage_partition;
/delete-node/ &slot1_partition;

&flash0 {
	partitions {
		ranges;
		#address-cells = <1>;
		#size-cells = <1>;

		storage_partition: partition@70000 {
			compatible = "zephyr,mapped-partition";
			label = "storage";
			reg = <0x00070000 0x10000>;
		};
	};
};
