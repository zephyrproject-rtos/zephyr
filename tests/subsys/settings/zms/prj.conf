## CMakeLists.txt
```
# SPDX-License-Identifier: Apache-2.0

cmake_minimum_required(VERSION 3.28.0)
find_package(Zephyr REQUIRED HINTS $ENV{ZEPHYR_BASE})
project(test_settings_zms_raw)

add_subdirectory(./src zms_test_bindir)
```

## prj.conf
```kconfig
CONFIG_ZTEST=y
CONFIG_FLASH=y
CONFIG_FLASH_MAP=y
CONFIG_ZMS=y

CONFIG_SETTINGS=y
CONFIG_SETTINGS_RUNTIME=y
CONFIG_SETTINGS_ZMS=y
```

## src/settings_test.h
```c
/*
 * Copyright (c) 2024 BayLibre SAS
 *
 * SPDX-License-Identifier: Apache-2.0
 */

#ifndef _SETTINGS_TEST_ZMS_H
#define _SETTINGS_TEST_ZMS_H

#include <stdio.h>
#include <string.h>
#include <zephyr/ztest.h>

#include <zephyr/settings/settings.h>

#ifdef __cplusplus
extern "C" {
#endif

extern uint8_t val8;
extern uint8_t val8_un;
extern uint32_t val32;
extern uint64_t val64;

extern int test_get_called;
extern int test_set_called;
extern int test_commit_called;
extern int test_export_block;

extern struct settings_handler c_test_handlers[];

void ctest_clear_call_state(void);
int ctest_get_call_state(void);

void config_wipe_srcs(void);
void *settings_config_setup(void);
void settings_config_teardown(void *fixture);

#ifdef __cplusplus
}
#endif
#endif /* _SETTINGS_TEST_ZMS_H */
```

## src/settings_test_zms.c
```c
/*
 * Copyright (c) 2024 BayLibre SAS
 *
 * SPDX-License-Identifier: Apache-2.0
 */
#include <stdlib.h>
#include <string.h>

#include <settings_priv.h>
#include "settings_test.h"

uint8_t val8;
uint8_t val8_un;
uint32_t val32;
uint64_t val64;

int test_get_called;
int test_set_called;
int test_commit_called;
int test_export_block;

int c1_handle_get(const char *name, char *val, int val_len_max);
int c1_handle_set(const char *name, size_t len, settings_read_cb read_cb, void *cb_arg);
int c1_handle_commit(void);
int c1_handle_export(int (*cb)(const char *name, const void *value, size_t val_len));

struct settings_handler c_test_handlers[] = {
	{.name = "myfoo",
	 .h_get = c1_handle_get,
	 .h_set = c1_handle_set,
	 .h_commit = c1_handle_commit,
	 .h_export = c1_handle_export},
};

int c1_handle_get(const char *name, char *val, int val_len_max)
{
	const char *next;

	test_get_called = 1;

	if (settings_name_steq(name, "mybar", &next) && !next) {
		val_len_max = MIN(val_len_max, sizeof(val8));
		memcpy(val, &val8, MIN(val_len_max, sizeof(val8)));
		return val_len_max;
	}

	if (settings_name_steq(name, "mybar64", &next) && !next) {
		val_len_max = MIN(val_len_max, sizeof(val64));
		memcpy(val, &val64, MIN(val_len_max, sizeof(val64)));
		return val_len_max;
	}

	return -ENOENT;
}

int c1_handle_set(const char *name, size_t len, settings_read_cb read_cb, void *cb_arg)
{
	size_t val_len;
	int rc;
	const char *next;

	test_set_called = 1;
	if (settings_name_steq(name, "mybar", &next) && !next) {
		rc = read_cb(cb_arg, &val8, sizeof(val8));
		zassert_true(rc >= 0, "SETTINGS_VALUE_SET callback");
		return 0;
	}

	if (settings_name_steq(name, "mybar64", &next) && !next) {
		rc = read_cb(cb_arg, &val64, sizeof(val64));
		zassert_true(rc >= 0, "SETTINGS_VALUE_SET callback");
		return 0;
	}

	if (settings_name_steq(name, "unaligned", &next) && !next) {
		val_len = len;
		zassert_equal(val_len, sizeof(val8_un), "value length: %zd, ought equal 1",
			      val_len);
		rc = read_cb(cb_arg, &val8_un, sizeof(val8_un));
		zassert_true(rc >= 0, "SETTINGS_VALUE_SET callback");
		return 0;
	}

	return -ENOENT;
}

int c1_handle_commit(void)
{
	test_commit_called = 1;
	return 0;
}

int c1_handle_export(int (*cb)(const char *name, const void *value, size_t val_len))
{
	if (test_export_block) {
		return 0;
	}

	(void)cb("myfoo/mybar", &val8, sizeof(val8));

	(void)cb("myfoo/mybar64", &val64, sizeof(val64));

	(void)cb("myfoo/unaligned", &val8_un, sizeof(val8_un));

	return 0;
}

void ctest_clear_call_state(void)
{
	test_get_called = 0;
	test_set_called = 0;
	test_commit_called = 0;
}

int ctest_get_call_state(void)
{
	return test_get_called + test_set_called + test_commit_called;
}

void config_wipe_srcs(void)
{
	sys_slist_init(&settings_load_srcs);
	settings_save_dst = NULL;
}

ZTEST_SUITE(settings_config, NULL, settings_config_setup, NULL, NULL, settings_config_teardown);
```

## src/settings_test_zms_reset.c
```c
/*
 * Copyright (c) 2026 Classified Cycling BV
 *
 * SPDX-License-Identifier: Apache-2.0
 */

/*
 * Reset test for the settings ZMS backend on flash without explicit erase.
 *
 * ZMS keeps each setting as a name, a value and a node of a linked list. The
 * settings backend loads the settings through this linked list. If ZMS loses
 * entries after a reset, the linked list can break. The backend then does
 * not load the settings after the break, although their names are still in ZMS.
 * A save of such a setting is successful, but the backend does not load it.
 */

#include <string.h>

#include <zephyr/drivers/flash.h>
#include <zephyr/drivers/flash/flash_simulator.h>
#include <zephyr/kvss/zms.h>
#include <zephyr/settings/settings.h>
#include <zephyr/storage/flash_map.h>
#include <zephyr/ztest.h>

#include <settings_priv.h>
#include "zms_priv.h"

#define AREA_DEV    PARTITION_DEVICE(storage_partition)
#define AREA_OFFSET PARTITION_OFFSET(storage_partition)
#define AREA_SIZE   PARTITION_SIZE(storage_partition)

int settings_backend_init(void);

static struct {
	/* The reset occurs at the first write to this sector */
	int sector;
	bool occurred;
} reset = {.sector = -1};

static struct zms_fs *settings_fs(void)
{
	void *storage = NULL;

	zassert_ok(settings_storage_get(&storage));
	zassert_not_null(storage);
	return storage;
}

static int reset_write_byte(const struct device *dev, off_t offset, uint8_t data)
{
	ARG_UNUSED(dev);

	if (reset.sector >= 0 &&
	    (offset - AREA_OFFSET) / settings_fs()->sector_size == reset.sector) {
		reset.occurred = true;
	}

	/* After the reset, the flash content does not change */
	return reset.occurred ? -EIO : data;
}

static const struct flash_simulator_cb reset_callbacks = {
	.write_byte = reset_write_byte,
};

/*
 * Start again after a reset: let the flash writes continue and initialize the
 * settings backend with a cleared state
 */
static void restart(void)
{
	flash_simulator_set_callbacks(AREA_DEV, NULL);
	reset.sector = -1;
	reset.occurred = false;

	sys_slist_init(&settings_load_srcs);
	settings_save_dst = NULL;
	zassert_ok(settings_backend_init(), "settings backend init failed");
}

static uint32_t write_sector(void)
{
	return settings_fs()->ate_wra >> ADDR_SECT_SHIFT;
}

static uint32_t sector_after(uint32_t sector)
{
	return (sector + 1) % settings_fs()->sector_count;
}

static void change_write_sector(uint32_t count)
{
	for (uint32_t i = 0; i < count; i++) {
		zassert_ok(zms_sector_use_next(settings_fs()));
	}
}

/* Erase the settings area. ZMS did not use any of its sectors before. */
static void erase_settings_area(void)
{
	size_t mem_size;

	memset((uint8_t *)flash_simulator_get_memory(AREA_DEV, &mem_size) + AREA_OFFSET,
	       flash_get_parameters(AREA_DEV)->erase_value, AREA_SIZE);
}

/*
 * Use all sectors one time while ZMS contains no entries. Each garbage
 * collection copies no entries, thus each sector gets a gc_done ATE in its first
 * ATE position. At mount, ZMS looks for a gc_done ATE there when the write
 * sector is empty.
 */
static void use_all_sectors_without_entries(void)
{
	struct flash_pages_info info;
	struct zms_fs fs = {
		.flash_device = AREA_DEV,
		.offset = AREA_OFFSET,
	};

	zassert_ok(flash_get_page_info_by_offs(AREA_DEV, AREA_OFFSET, &info));
	fs.sector_size = info.size * CONFIG_SETTINGS_ZMS_SECTOR_SIZE_MULT;
	fs.sector_count = AREA_SIZE / fs.sector_size;
	zassert_ok(zms_mount(&fs));

	for (uint32_t i = 0; i < fs.sector_count; i++) {
		zassert_ok(zms_sector_use_next(&fs));
	}
}

static int load_cb(const char *key, size_t len, settings_read_cb read_cb, void *cb_arg, void *param)
{
	uint32_t *value = param;

	if (strcmp(key, "b") == 0 && len == sizeof(*value)) {
		zassert_equal(read_cb(cb_arg, value, sizeof(*value)), sizeof(*value));
	}

	return 0;
}

/**
 * @brief Test that the backend loads a setting that you save after a reset.
 *
 * A sector that ZMS used before still has the gc_done ATE of that use. The
 * reset occurs when ZMS changes the write sector, before the garbage
 * collection. A power loss, a watchdog reset or a software reset can cause
 * this. At the next initialization, ZMS erases the oldest sector without
 * a copy of its entries.
 */
ZTEST(settings_zms_reset, test_setting_saved_after_reset_is_loaded)
{
	const uint32_t first = 1;
	const uint32_t second = 2;
	uint32_t loaded = 0;

	if (flash_params_get_erase_cap(flash_get_parameters(AREA_DEV)) & FLASH_ERASE_C_EXPLICIT) {
		ztest_test_skip();
	}

	erase_settings_area();
	use_all_sectors_without_entries();
	restart();

	/* Save setting "test/a". Then make its sector the oldest sector. */
	zassert_ok(settings_save_one("test/a", &first, sizeof(first)));
	change_write_sector(settings_fs()->sector_count - 2);

	/* Save setting "test/b" in the write sector */
	zassert_ok(settings_save_one("test/b", &first, sizeof(first)));

	/* Change the write sector. The reset occurs before the garbage collection. */
	reset.sector = sector_after(write_sector());
	flash_simulator_set_callbacks(AREA_DEV, &reset_callbacks);
	(void)zms_sector_use_next(settings_fs());
	zassert_true(reset.occurred, "no reset");
	restart();

	zassert_ok(settings_save_one("test/b", &second, sizeof(second)));
	restart();

	zassert_ok(settings_load_subtree_direct("test", load_cb, &loaded));
	zassert_equal(loaded, second, "loaded value of test/b is %u, expected %u", loaded, second);
}

ZTEST_SUITE(settings_zms_reset, NULL, NULL, NULL, NULL, NULL);
```
