## CMakeLists.txt
```
# Copyright The Zephyr Project Contributors
# SPDX-License-Identifier: Apache-2.0

cmake_minimum_required(VERSION 3.28.0)
find_package(Zephyr REQUIRED HINTS $ENV{ZEPHYR_BASE})
project(tracing_user_callbacks)

target_sources(app PRIVATE src/main.c)
```

## prj.conf
```kconfig
CONFIG_ZTEST=y
CONFIG_TRACING=y
CONFIG_TRACING_USER=y
```

## src/main.c
```c
/*
 * Copyright The Zephyr Project Contributors
 *
 * SPDX-License-Identifier: Apache-2.0
 */

#include <zephyr/kernel.h>
#include <zephyr/sys/atomic.h>
#include <zephyr/ztest.h>

/*
 * With CONFIG_TRACING_USER, every kernel-object hook routes to a __weak
 * sys_trace_<obj>_<event>_user() callback. A downstream integrator overrides
 * only the callbacks it cares about - no header forking, no edits to Zephyr.
 * Here we override two of the (Stage B) newly exposed object callbacks and
 * confirm the kernel drives them.
 */
static unsigned int sem_give_calls;
static unsigned int mutex_lock_calls;
static atomic_t isr_enter_calls;
static atomic_t isr_exit_calls;

void sys_trace_k_sem_give_enter_user(struct k_sem *sem)
{
	ARG_UNUSED(sem);
	sem_give_calls++;
}

void sys_trace_k_mutex_lock_enter_user(struct k_mutex *mutex, k_timeout_t timeout)
{
	ARG_UNUSED(mutex);
	ARG_UNUSED(timeout);
	mutex_lock_calls++;
}

void sys_trace_isr_enter_user(void)
{
	atomic_inc(&isr_enter_calls);
}

void sys_trace_isr_exit_user(void)
{
	atomic_inc(&isr_exit_calls);
}

K_SEM_DEFINE(cb_sem, 0, 1);
K_MUTEX_DEFINE(cb_mutex);

/**
 * @brief Verify user tracing callbacks identify the objects being traced.
 *
 * @ingroup tracing_api_tests
 * @verifies ZEP-SRS-10-5
 */
ZTEST(tracing_user_callbacks, test_object_callbacks_fire)
{
	unsigned int sem_before = sem_give_calls;
	unsigned int mtx_before = mutex_lock_calls;

	k_sem_give(&cb_sem);
	zassert_true(sem_give_calls > sem_before,
		     "sys_trace_k_sem_give_enter_user() was not invoked");

	zassert_ok(k_mutex_lock(&cb_mutex, K_FOREVER));
	k_mutex_unlock(&cb_mutex);
	zassert_true(mutex_lock_calls > mtx_before,
		     "sys_trace_k_mutex_lock_enter_user() was not invoked");
}

/*
 * The ISR hooks live in each architecture's interrupt entry path rather than in
 * generic code, so an arch that never emits them looks exactly like an arch
 * with no interrupts. Sleeping guarantees at least one system timer interrupt.
 */
ZTEST(tracing_user_callbacks, test_isr_callbacks_fire)
{
	atomic_val_t enter_before = atomic_get(&isr_enter_calls);
	atomic_val_t exit_before = atomic_get(&isr_exit_calls);

	k_sleep(K_MSEC(50));

	zassert_true(atomic_get(&isr_enter_calls) > enter_before,
		     "sys_trace_isr_enter_user() was not invoked");
	zassert_true(atomic_get(&isr_exit_calls) > exit_before,
		     "sys_trace_isr_exit_user() was not invoked");
}

ZTEST_SUITE(tracing_user_callbacks, NULL, NULL, NULL, NULL, NULL);
```
