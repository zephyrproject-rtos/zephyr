## CMakeLists.txt
```
# Copyright The Zephyr Project Contributors
# SPDX-License-Identifier: Apache-2.0

cmake_minimum_required(VERSION 3.20.0)
find_package(Zephyr REQUIRED HINTS $ENV{ZEPHYR_BASE})
project(tracing_format_module)

# A real out-of-tree format ships this directory on the include path from its
# module CMakeLists; here the test app does it directly. The header named by
# CONFIG_TRACING_FORMAT_HEADER must be resolvable from this path.
zephyr_include_directories(format)

target_sources(app PRIVATE src/main.c)
```

## Kconfig
```
# Copyright The Zephyr Project Contributors
# SPDX-License-Identifier: Apache-2.0

# Emulate what an out-of-tree module's Kconfig does to register a tracing format:
# point CONFIG_TRACING_FORMAT_HEADER (a promptless string set only via defaults)
# at the format's header. No edits to the Zephyr core tree are required.
config TRACING_FORMAT_HEADER
	default "custom_trace_format.h" if TRACING

source "Kconfig.zephyr"
```

## prj.conf
```kconfig
CONFIG_ZTEST=y
CONFIG_TRACING=y
```

## src/main.c
```c
/*
 * Copyright The Zephyr Project Contributors
 *
 * SPDX-License-Identifier: Apache-2.0
 */

#include <zephyr/kernel.h>
#include <zephyr/ztest.h>

/*
 * Counters bumped by the out-of-tree format header
 * (format/custom_trace_format.h), selected via CONFIG_TRACING_FORMAT_HEADER.
 */
volatile unsigned int custom_trace_sem_give_count;
volatile unsigned int custom_trace_thread_create_count;

K_SEM_DEFINE(test_sem, 0, 1);

/*
 * Verify that a tracing format supplied purely through
 * CONFIG_TRACING_FORMAT_HEADER (no edits to the Zephyr tree) is actually wired
 * into the kernel hook points: exercising k_sem_give() must drive the format's
 * sys_port_trace_k_sem_give_enter() hook.
 */
ZTEST(tracing_format_module, test_format_hook_fires)
{
	unsigned int before = custom_trace_sem_give_count;

	k_sem_give(&test_sem);

	zassert_true(custom_trace_sem_give_count > before,
		     "out-of-tree format hook was not invoked on k_sem_give()");
}

ZTEST_SUITE(tracing_format_module, NULL, NULL, NULL, NULL, NULL);
```
