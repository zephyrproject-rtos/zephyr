## CMakeLists.txt
```
# SPDX-License-Identifier: Apache-2.0

cmake_minimum_required(VERSION 3.13.1)

find_package(Zephyr REQUIRED HINTS $ENV{ZEPHYR_BASE})
project(tracing_tests)

target_sources(app PRIVATE src/main.c)

target_sources_ifdef(
  CONFIG_TRACING_TEST
  app PRIVATE
  src/tracing_string_format_test.c
)
```

## prj.conf
```kconfig
# enable to use thread names
```

## prj_native_posix.conf
```kconfig
CONFIG_ZTEST=y
CONFIG_TRACING=y
CONFIG_TRACING_TEST=y
CONFIG_TRACING_SYNC=y
CONFIG_TRACING_BACKEND_POSIX=y
CONFIG_TRACING_PACKET_MAX_SIZE=512
```

## prj_native_posix_ctf.conf
```kconfig
CONFIG_ZTEST=y
CONFIG_TRACING=y
CONFIG_TRACING_CTF=y
CONFIG_TRACING_SYNC=y
CONFIG_TRACING_BACKEND_POSIX=y
CONFIG_TRACING_PACKET_MAX_SIZE=64
```

## prj_uart.conf
```kconfig
CONFIG_ZTEST=y
CONFIG_TRACING=y
CONFIG_TRACING_TEST=y
CONFIG_TRACING_BACKEND_UART=y
CONFIG_IDLE_STACK_SIZE=4096
CONFIG_TRACING_BUFFER_SIZE=4096
CONFIG_TRACING_BACKEND_UART_NAME="UART_1"
CONFIG_MAIN_STACK_SIZE=1024
```

## prj_uart_ctf.conf
```kconfig
CONFIG_THREAD_NAME=y
CONFIG_THREAD_STACK_INFO=y

CONFIG_UART_LINE_CTRL=y
CONFIG_UART_INTERRUPT_DRIVEN=y

CONFIG_TRACING=y
CONFIG_TRACING_CTF=y
CONFIG_TRACING_ISR=y
CONFIG_TRACING_BACKEND_UART=y
CONFIG_TRACING_BUFFER_SIZE=4096
CONFIG_TRACING_HANDLE_HOST_CMD=n
CONFIG_TRACING_BACKEND_UART_NAME="UART_1"
```

## prj_usb.conf
```kconfig
CONFIG_GPIO=y
CONFIG_USB=y
CONFIG_USB_DEVICE_STACK=y
CONFIG_USB_DEVICE_VID=0x2FE9

CONFIG_THREAD_NAME=y
CONFIG_THREAD_STACK_INFO=y

CONFIG_TRACING=y
CONFIG_TRACING_TEST=y
CONFIG_TRACING_BACKEND_USB=y
CONFIG_TRACING_BUFFER_SIZE=4096
CONFIG_TRACING_HANDLE_HOST_CMD=y
```

## src/main.c
```c
/*
 * Copyright (c) 2020 Intel Corporation
 *
 * SPDX-License-Identifier: Apache-2.0
 */
#include <ztest.h>
#if defined(CONFIG_TRACING_BACKEND_UART) || defined(CONFIG_TRACING_BACKEND_USB)
#include "../../../../subsys/tracing/include/tracing_backend.h"
#endif

/**
 * @defgroup subsys_tracing_tests subsys tracing
 * @ingroup all_tests
 * @{
 * @}
 */

/* size of stack area used by each thread */
#define STACK_SIZE (1024 + CONFIG_TEST_EXTRA_STACKSIZE)
#define LOOP_TIMES 10

bool thread_switched_found;
bool sys_trace_void_found;
bool sys_trace_semaphore_found;

static struct k_thread thread;
K_THREAD_STACK_DEFINE(thread_stack, STACK_SIZE);

/* define 2 semaphores */
K_SEM_DEFINE(thread1_sem, 1, 1);
K_SEM_DEFINE(thread2_sem, 0, 1);

/* thread handle for switch */
void thread_handle(void *p1, void *self_sem, void *other_sem)
{
	for (int i = 0; i < LOOP_TIMES; i++) {
		/* take my semaphore */
		k_sem_take(self_sem, K_FOREVER);
		/* wait for a while, then let other thread have a turn. */
		k_sleep(K_MSEC(10));

		k_sem_give(other_sem);
	}
}

#if (defined(CONFIG_TRACING_BACKEND_UART) || defined(CONFIG_TRACING_BACKEND_USB))
static void tracing_backends_output(
		const struct tracing_backend *backend,
		uint8_t *data, uint32_t length)
{
	/* Check the output data. */
	if (strstr(data, "sys_trace_thread_switched") != NULL) {
		thread_switched_found = true;
	}

	if (strstr(data, "sys_trace_void") != NULL) {
		sys_trace_void_found = true;
	}

	if (strstr(data, "sys_trace_semaphore") != NULL) {
		sys_trace_semaphore_found = true;
	}
}
#endif

#if defined(CONFIG_TRACING_BACKEND_UART)
const struct tracing_backend_api tracing_uart_backend_api = {
	.init = NULL,
	.output  = tracing_backends_output
};

TRACING_BACKEND_DEFINE(tracing_backend_uart, tracing_uart_backend_api);
#endif

#ifdef CONFIG_TRACING_BACKEND_USB
const struct tracing_backend_api tracing_usb_backend_api = {
	.output = tracing_backends_output
};

TRACING_BACKEND_DEFINE(tracing_backend_usb, tracing_usb_backend_api);
#endif

/*
 * spawn a thread to generate more tracing data about
 * thread switch and semaphore.
 */
void generate_more_tracing_data(void)
{
	k_thread_create(&thread, thread_stack, STACK_SIZE,
		thread_handle, NULL, &thread2_sem, &thread1_sem,
		K_PRIO_PREEMPT(0), K_INHERIT_PERMS,
		K_NO_WAIT);

	thread_handle(NULL, &thread1_sem, &thread2_sem);
}

/**
 * @brief Test tracing data which produced from backends.
 *
 * @ingroup driver_sensor_subsys_tests
 *
 * @details
 * Test Objective:
 * - Check the tracing data in backends, it should include thread/semaphore.. info,
 * if not, the related variable should be false.
 *
 * Testing techniques:
 * - function and black box testing.
 * - Interface testing.
 * - Dynamic analysis and testing.
 *
 * Prerequisite Conditions:
 * - CONFIG_TRACING
 * - CONFIG_TRACING_TEST
 * - CONFIG_TRACING_BACKEND_USB
 * - CONFIG_TRACING_BACKEND_UART
 *
 * Input Specifications:
 * - N/A
 *
 * Test Procedure:
 * -# Create a thread to generate more switch thread tracing data.
 * -# Define a USB and a UART backend to get tracing data.
 * -# Check the content of the traing output.
 *
 * Expected Test Result:
 * - Tracing data include thread,idle thread info
 * based on the provided trace data.
 *
 * Pass/Fail Criteria:
 * - Successful if check points in test procedure are all passed, otherwise failure.
 *
 * Assumptions and Constraints:
 * - N/A
 */
void test_tracing_function(void)
{
#ifdef CONFIG_TRACING_CTF
	ztest_test_skip();
#endif
	generate_more_tracing_data();
#ifdef CONFIG_TRACING
	zassert_true(thread_switched_found, "thread_switched can't be found.");
	zassert_true(sys_trace_void_found, "sys_trace_void can't be found.");
	zassert_true(sys_trace_semaphore_found,
			"sys_trace_semaphore can't be found.");
#else
	/* Should produce any tracing data when tracing disabled. */
	zassert_false(thread_switched_found, "thread_switched shouldn't be found.");
	zassert_false(sys_trace_void_found, "thread_switched shouldn't be found.");
	zassert_false(sys_trace_semaphore_found, "thread_switched shouldn't be found.");
#endif
}

void test_main(void)
{
	k_thread_access_grant(k_current_get(),
				  &thread, &thread_stack,
				  &thread1_sem, &thread2_sem);

	ztest_test_suite(test_tracing,
			 ztest_unit_test(test_tracing_function)
			 );

	ztest_run_test_suite(test_tracing);
}
```

## src/tracing_string_format_test.c
```c
/*
 * Copyright (c) 2020 Intel Corporation
 *
 * SPDX-License-Identifier: Apache-2.0
 */

#include <zephyr.h>
#include <tracing_test.h>
#include <tracing/tracing_format.h>

void sys_trace_thread_switched_out(void)
{
	TRACING_STRING("%s %d\n", __func__, __LINE__);
}

void sys_trace_thread_switched_in(void)
{
	TRACING_STRING("%s %d\n", __func__, __LINE__);
}

void sys_trace_thread_priority_set(struct k_thread *thread)
{
	TRACING_STRING("%s %d\n", __func__, __LINE__);
}

void sys_trace_thread_create(struct k_thread *thread)
{
	TRACING_STRING("%s %d\n", __func__, __LINE__);
}

void sys_trace_thread_abort(struct k_thread *thread)
{
	TRACING_STRING("%s %d\n", __func__, __LINE__);
}

void sys_trace_thread_suspend(struct k_thread *thread)
{
	TRACING_STRING("%s %d\n", __func__, __LINE__);
}

void sys_trace_thread_resume(struct k_thread *thread)
{
	TRACING_STRING("%s %d\n", __func__, __LINE__);
}

void sys_trace_thread_ready(struct k_thread *thread)
{
	TRACING_STRING("%s %d\n", __func__, __LINE__);
}

void sys_trace_thread_pend(struct k_thread *thread)
{
	TRACING_STRING("%s %d\n", __func__, __LINE__);
}

void sys_trace_thread_info(struct k_thread *thread)
{
	TRACING_STRING("%s %d\n", __func__, __LINE__);
}

void sys_trace_thread_name_set(struct k_thread *thread)
{
	TRACING_STRING("%s %d\n", __func__, __LINE__);
}

void sys_trace_isr_enter(void)
{
	TRACING_STRING("%s %d\n", __func__, __LINE__);
}

void sys_trace_isr_exit(void)
{
	TRACING_STRING("%s %d\n", __func__, __LINE__);
}

void sys_trace_isr_exit_to_scheduler(void)
{
	TRACING_STRING("%s %d\n", __func__, __LINE__);
}

void sys_trace_idle(void)
{
	TRACING_STRING("%s %d\n", __func__, __LINE__);
}

void sys_trace_void(unsigned int id)
{
	TRACING_STRING("%s %d\n", __func__, __LINE__);
}

void sys_trace_end_call(unsigned int id)
{
	TRACING_STRING("%s %d\n", __func__, __LINE__);
}

void sys_trace_semaphore_init(struct k_sem *sem)
{
	TRACING_STRING("%s %d\n", __func__, __LINE__);
}

void sys_trace_semaphore_take(struct k_sem *sem)
{
	TRACING_STRING("%s %d\n", __func__, __LINE__);
}

void sys_trace_semaphore_give(struct k_sem *sem)
{
	TRACING_STRING("%s %d\n", __func__, __LINE__);
}

void sys_trace_mutex_init(struct k_mutex *mutex)
{
	TRACING_STRING("%s %d\n", __func__, __LINE__);
}

void sys_trace_mutex_lock(struct k_mutex *mutex)
{
	TRACING_STRING("%s %d\n", __func__, __LINE__);
}

void sys_trace_mutex_unlock(struct k_mutex *mutex)
{
	TRACING_STRING("%s %d\n", __func__, __LINE__);
}
```
