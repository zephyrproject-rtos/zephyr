## CMakeLists.txt
```
# Copyright 2026 NXP
#
# SPDX-License-Identifier: Apache-2.0

cmake_minimum_required(VERSION 3.20.0)
find_package(Zephyr REQUIRED HINTS $ENV{ZEPHYR_BASE})
project(cpu_workload_estimator_test)

target_sources(app PRIVATE src/main.c)
```

## prj.conf
```kconfig
# Copyright 2026 NXP
#
# SPDX-License-Identifier: Apache-2.0

CONFIG_ZTEST=y
CONFIG_MAIN_STACK_SIZE=2048

CONFIG_CPU_WORKLOAD=y
CONFIG_CPU_WORKLOAD_ESTIMATE=y
```

## src/main.c
```c
/*
 * Copyright 2026 NXP
 *
 * SPDX-License-Identifier: Apache-2.0
 */

#include <zephyr/cpu_workload/cpu_workload.h>
#include <zephyr/kernel.h>
#include <zephyr/ztest.h>

#include <errno.h>

#define PROFILE_THREAD_STACK_SIZE 1024
#define PROFILE_THREAD_PRIORITY K_PRIO_PREEMPT(0)
#define BURN_ITERATIONS 20000U

K_SEM_DEFINE(profile_start_sem, 0, 1);
K_SEM_DEFINE(profile_done_sem, 0, 1);

K_THREAD_STACK_DEFINE(profile_thread_stack, PROFILE_THREAD_STACK_SIZE);
static struct k_thread profile_thread;
static bool profile_thread_started;
static volatile uint32_t burn_sink;

static void burn_cycles(void)
{
	for (uint32_t i = 0U; i < BURN_ITERATIONS; i++) {
		burn_sink += i;
	}
}

static void profile_thread_entry(void *p1, void *p2, void *p3)
{
	ARG_UNUSED(p1);
	ARG_UNUSED(p2);
	ARG_UNUSED(p3);

	while (true) {
		k_sem_take(&profile_start_sem, K_FOREVER);
		burn_cycles();
		k_sem_give(&profile_done_sem);
	}
}

static void prime_thread_profile(void)
{
	k_thread_runtime_stats_t stats;
	int ret;

	k_sem_give(&profile_start_sem);
	zassert_ok(k_sem_take(&profile_done_sem, K_SECONDS(1)));
	k_sleep(K_MSEC(10));

	ret = k_thread_runtime_stats_get(&profile_thread, &stats);
	zassert_ok(ret);
	zassert_true(stats.window_count > 0U, "thread stats did not collect windows");
	zassert_true(stats.total_cycles > 0U, "thread stats has no total cycles");
}

static void *workload_test_setup(void)
{
	if (profile_thread_started) {
		return NULL;
	}

	k_thread_create(&profile_thread, profile_thread_stack,
			K_THREAD_STACK_SIZEOF(profile_thread_stack), profile_thread_entry,
			NULL, NULL, NULL, PROFILE_THREAD_PRIORITY, 0, K_NO_WAIT);
	profile_thread_started = true;

	return NULL;
}

ZTEST(cpu_workload_estimator, test_invalid_arguments)
{
	struct cpu_workload_ready_backlog backlog;
	struct cpu_workload_arrival arrival;
	struct cpu_workload_estimate estimate;
	struct cpu_workload_history history;
	int invalid_cpu = arch_num_cpus();

	zassert_equal(cpu_workload_history_get(-1, &history), -EINVAL);
	zassert_equal(cpu_workload_history_get(invalid_cpu, &history), -EINVAL);
	zassert_equal(cpu_workload_history_get(0, NULL), -EINVAL);

	zassert_equal(cpu_workload_ready_backlog_get(-1, &backlog), -EINVAL);
	zassert_equal(cpu_workload_ready_backlog_get(invalid_cpu, &backlog), -EINVAL);
	zassert_equal(cpu_workload_ready_backlog_get(0, NULL), -EINVAL);

	zassert_equal(cpu_workload_arrival_get(-1, &arrival), -EINVAL);
	zassert_equal(cpu_workload_arrival_get(invalid_cpu, &arrival), -EINVAL);
	zassert_equal(cpu_workload_arrival_get(0, NULL), -EINVAL);

	zassert_equal(cpu_workload_estimate_get(-1, &estimate), -EINVAL);
	zassert_equal(cpu_workload_estimate_get(invalid_cpu, &estimate), -EINVAL);
	zassert_equal(cpu_workload_estimate_get(0, NULL), -EINVAL);
}

ZTEST(cpu_workload_estimator, test_runtime_history_sample)
{
	struct cpu_workload_history history;
	int ret;

	ret = cpu_workload_history_get(0, &history);
	if (ret == -EAGAIN) {
		burn_cycles();
		k_sleep(K_MSEC(10));
		ret = cpu_workload_history_get(0, &history);
	}

	zassert_ok(ret);
	zassert_true(history.window_cycles > 0U, "expected runtime-history window");
	zassert_true(history.window_us > 0U, "expected runtime-history window time");
	zassert_true(history.load <= 100U, "history load must be a percentage");
	zassert_equal(history.confidence, 100U, "unexpected history confidence");
}

ZTEST(cpu_workload_estimator, test_ready_backlog_and_arrival)
{
	struct cpu_workload_ready_backlog backlog;
	struct cpu_workload_arrival arrival;
	int ret;

	prime_thread_profile();

	k_sched_lock();
	k_sem_give(&profile_start_sem);

	ret = cpu_workload_ready_backlog_get(0, &backlog);
	zassert_ok(ret);
	zassert_true(backlog.runnable_threads > 0U, "expected runnable thread");
	zassert_true(backlog.profiled_threads > 0U, "expected profiled runnable thread");
	zassert_true(backlog.ready_backlog_cycles > 0U, "expected backlog cycles");
	zassert_true((backlog.source_mask & CPU_WORKLOAD_SOURCE_READY_BACKLOG) != 0U);
	zassert_true((backlog.source_mask & CPU_WORKLOAD_SOURCE_THREAD_BURST_PROFILE) != 0U);
	zassert_true(backlog.confidence > 0U, "expected backlog confidence");

	ret = cpu_workload_arrival_get(0, &arrival);
	zassert_ok(ret);
	zassert_true(arrival.arrivals > 0U, "expected attributed arrival");
	zassert_true(arrival.profiled_arrivals > 0U, "expected profiled arrival");
	zassert_true(arrival.expected_arrival_cycles > 0U, "expected arrival cycles");
	zassert_true((arrival.source_mask & CPU_WORKLOAD_SOURCE_ARRIVAL) != 0U);
	zassert_true((arrival.source_mask & CPU_WORKLOAD_SOURCE_ARRIVAL_SYNC) != 0U,
		     "expected sync arrival source");

	ret = cpu_workload_arrival_get(0, &arrival);
	zassert_ok(ret);
	zassert_equal(arrival.arrivals, 0U, "arrival workload was not consumed");
	zassert_equal(arrival.source_mask, 0U, "empty arrival workload should not report sources");

	k_sched_unlock();
	zassert_ok(k_sem_take(&profile_done_sem, K_SECONDS(1)));
}

ZTEST(cpu_workload_estimator, test_unified_estimate)
{
	struct cpu_workload_estimate estimate;
	uint64_t expected_cycles;
	uint64_t forward_cycles;
	int ret;

	prime_thread_profile();

	k_sched_lock();
	k_sem_give(&profile_start_sem);

	ret = cpu_workload_estimate_get(0, &estimate);
	zassert_ok(ret);
	zassert_true(estimate.ready_backlog_cycles > 0U, "expected backlog contribution");
	zassert_true(estimate.expected_arrival_cycles > 0U, "expected arrival contribution");
	forward_cycles = estimate.ready_backlog_cycles + estimate.expected_arrival_cycles;
	expected_cycles = MAX(forward_cycles, estimate.history_cycles);
	zassert_equal(estimate.estimated_cycles, expected_cycles,
		      "estimate must be max(history, backlog + arrival)");
	zassert_true((estimate.source_mask & CPU_WORKLOAD_SOURCE_READY_BACKLOG) != 0U);
	zassert_true((estimate.source_mask & CPU_WORKLOAD_SOURCE_ARRIVAL) != 0U);
	zassert_true((estimate.source_mask & CPU_WORKLOAD_SOURCE_ARRIVAL_SYNC) != 0U,
		     "expected sync arrival source");
	zassert_true(estimate.confidence > 0U, "expected estimate confidence");

	k_sched_unlock();
	zassert_ok(k_sem_take(&profile_done_sem, K_SECONDS(1)));

	burn_cycles();

	ret = cpu_workload_estimate_get(0, &estimate);
	zassert_ok(ret);
	zassert_true((estimate.source_mask & CPU_WORKLOAD_SOURCE_RUNTIME_HISTORY) != 0U,
		     "expected runtime-history contribution");
	zassert_true(estimate.history_cycles > 0U, "expected runtime-history cycles");
	zassert_true(estimate.history_window_us > 0U, "expected runtime-history window");

	forward_cycles = estimate.ready_backlog_cycles + estimate.expected_arrival_cycles;
	expected_cycles = MAX(forward_cycles, estimate.history_cycles);
	zassert_equal(estimate.estimated_cycles, expected_cycles,
		      "estimate must be max(history, backlog + arrival)");
}

ZTEST_SUITE(cpu_workload_estimator, NULL, workload_test_setup, NULL, NULL, NULL);
```
