## CMakeLists.txt
```
# SPDX-License-Identifier: Apache-2.0

cmake_minimum_required(VERSION 3.28.0)
find_package(Zephyr REQUIRED HINTS $ENV{ZEPHYR_BASE})

project(input_double_tap)

FILE(GLOB app_sources src/*.c)
target_sources(app PRIVATE ${app_sources})
```

## prj.conf
```kconfig
# SPDX-License-Identifier: Apache-2.0

CONFIG_ZTEST=y
CONFIG_INPUT=y
CONFIG_INPUT_MODE_SYNCHRONOUS=y
```

## boards/native_sim.overlay
```dts
/*
 * Copyright 2024 Kelly Helmut Lord
 *
 * SPDX-License-Identifier: Apache-2.0
 */

#include <zephyr/dt-bindings/input/input-event-codes.h>

/ {
	fake_input_device: fake-device {
		compatible = "vnd,input-device";
	};

	double_tap: doubletap {
		compatible = "zephyr,input-double-tap";
		input = <&fake_input_device>;
		input-codes = <INPUT_KEY_0>, <INPUT_KEY_1>;
		double-tap-codes = <INPUT_KEY_X>, <INPUT_KEY_Y>;
		double-tap-delay-ms = <300>;
	};

	double_tap_single: doubletap-single {
		compatible = "zephyr,input-double-tap";
		input = <&fake_input_device>;
		input-codes = <INPUT_KEY_0>, <INPUT_KEY_1>;
		single-tap-codes = <INPUT_KEY_A>, <INPUT_KEY_B>;
		double-tap-codes = <INPUT_KEY_X>, <INPUT_KEY_Y>;
		double-tap-delay-ms = <300>;
	};
};
```

## src/main.c
```c
/*
 * Copyright 2024 Kelly Helmut Lord
 *
 * SPDX-License-Identifier: Apache-2.0
 */

#include <zephyr/device.h>
#include <zephyr/input/input.h>
#include <zephyr/kernel.h>
#include <zephyr/ztest.h>

static const struct device *const fake_dev = DEVICE_DT_GET(
		DT_NODELABEL(fake_input_device));
static const struct device *const double_tap_dev = DEVICE_DT_GET(
		DT_NODELABEL(double_tap));
static const struct device *const double_tap_single_dev = DEVICE_DT_GET(
		DT_NODELABEL(double_tap_single));

DEVICE_DT_DEFINE(DT_INST(0, vnd_input_device), NULL, NULL, NULL, NULL,
		 PRE_KERNEL_1, CONFIG_KERNEL_INIT_PRIORITY_DEVICE, NULL);

static int event_count;
static struct input_event last_events[2];

static void test_cb(struct input_event *evt, void *user_data)
{
	TC_PRINT("%s: %d %x %d\n", __func__, event_count, evt->code, evt->value);

	event_count++;
	memcpy(&last_events[1], &last_events[0], sizeof(struct input_event));
	memcpy(&last_events[0], evt, sizeof(struct input_event));
}
INPUT_CALLBACK_DEFINE(double_tap_dev, test_cb, NULL);

static int event_count_single;
static struct input_event last_events_single[2];

static void test_cb_single(struct input_event *evt, void *user_data)
{
	TC_PRINT("%s: %d %x %d\n", __func__, event_count_single, evt->code, evt->value);

	event_count_single++;
	memcpy(&last_events_single[1], &last_events_single[0], sizeof(struct input_event));
	memcpy(&last_events_single[0], evt, sizeof(struct input_event));
}
INPUT_CALLBACK_DEFINE(double_tap_single_dev, test_cb_single, NULL);

ZTEST(double_tap, test_double_tap_test)
{
	zassert_equal(event_count, 0);

	/* ignored */
	input_report_key(fake_dev, INPUT_KEY_3, 1, true, K_FOREVER);
	input_report_key(fake_dev, INPUT_KEY_3, 0, true, K_FOREVER);
	zassert_equal(event_count, 0);
	input_report_abs(fake_dev, INPUT_KEY_0, 1, true, K_FOREVER);
	input_report_abs(fake_dev, INPUT_KEY_0, 0, true, K_FOREVER);
	zassert_equal(event_count, 0);

	/* double tap*/
	input_report_key(fake_dev, INPUT_KEY_0, 1, true, K_FOREVER);
	k_sleep(K_MSEC(50));
	input_report_key(fake_dev, INPUT_KEY_0, 0, true, K_FOREVER);
	k_sleep(K_MSEC(50));
	input_report_key(fake_dev, INPUT_KEY_0, 1, true, K_FOREVER);
	k_sleep(K_MSEC(50));
	input_report_key(fake_dev, INPUT_KEY_0, 0, true, K_FOREVER);
	zassert_equal(event_count, 2);
	zassert_equal(last_events[1].type, INPUT_EV_KEY);
	zassert_equal(last_events[1].code, INPUT_KEY_X);
	zassert_equal(last_events[1].value, 1);
	zassert_equal(last_events[0].type, INPUT_EV_KEY);
	zassert_equal(last_events[0].code, INPUT_KEY_X);
	zassert_equal(last_events[0].value, 0);

	/* double tap - other key */
	input_report_key(fake_dev, INPUT_KEY_1, 1, true, K_FOREVER);
	k_sleep(K_MSEC(50));
	input_report_key(fake_dev, INPUT_KEY_1, 0, true, K_FOREVER);
	k_sleep(K_MSEC(50));
	input_report_key(fake_dev, INPUT_KEY_1, 1, true, K_FOREVER);
	k_sleep(K_MSEC(50));
	input_report_key(fake_dev, INPUT_KEY_1, 0, true, K_FOREVER);
	zassert_equal(event_count, 4);
	zassert_equal(last_events[1].type, INPUT_EV_KEY);
	zassert_equal(last_events[1].code, INPUT_KEY_Y);
	zassert_equal(last_events[1].value, 1);
	zassert_equal(last_events[0].type, INPUT_EV_KEY);
	zassert_equal(last_events[0].code, INPUT_KEY_Y);
	zassert_equal(last_events[0].value, 0);
}

/* Test that "slow" double taps are not generating events */
ZTEST(double_tap, test_single_tap_timeout)
{
	event_count = 0;

	/* Single tap - should start double tap sequence */
	input_report_key(fake_dev, INPUT_KEY_0, 1, true, K_FOREVER);
	k_sleep(K_MSEC(50));
	input_report_key(fake_dev, INPUT_KEY_0, 0, true, K_FOREVER);
	zassert_equal(event_count, 0, "No event should be generated for single tap");

	/* Wait for timeout to expire (double_tap_delay_ms is 300ms so we wait just a bit longer) */
	k_sleep(K_MSEC(310));
	zassert_equal(event_count, 0, "No event should be generated after timeout");

	/* Another single tap - should start a new sequence (not trigger double tap) */
	input_report_key(fake_dev, INPUT_KEY_0, 1, true, K_FOREVER);
	k_sleep(K_MSEC(50));
	input_report_key(fake_dev, INPUT_KEY_0, 0, true, K_FOREVER);
	zassert_equal(event_count, 0, "No event should be generated for single tap");

	/* Quickly complete the double tap with an additional tap */
	input_report_key(fake_dev, INPUT_KEY_0, 1, true, K_FOREVER);
	k_sleep(K_MSEC(50));
	input_report_key(fake_dev, INPUT_KEY_0, 0, true, K_FOREVER);
	zassert_equal(event_count, 2, "Double tap should be detected after timeout reset");
	zassert_equal(last_events[1].type, INPUT_EV_KEY);
	zassert_equal(last_events[1].code, INPUT_KEY_X);
	zassert_equal(last_events[1].value, 1);
	zassert_equal(last_events[0].type, INPUT_EV_KEY);
	zassert_equal(last_events[0].code, INPUT_KEY_X);
	zassert_equal(last_events[0].value, 0);
}

/* Test that a tap not followed by a second one generates a single tap event */
ZTEST(double_tap, test_single_tap)
{
	event_count = 0;
	event_count_single = 0;

	input_report_key(fake_dev, INPUT_KEY_0, 1, true, K_FOREVER);
	k_sleep(K_MSEC(50));
	input_report_key(fake_dev, INPUT_KEY_0, 0, true, K_FOREVER);
	zassert_equal(event_count_single, 0, "No event before the double tap delay expires");

	k_sleep(K_MSEC(310));
	zassert_equal(event_count_single, 2);
	zassert_equal(last_events_single[1].type, INPUT_EV_KEY);
	zassert_equal(last_events_single[1].code, INPUT_KEY_A);
	zassert_equal(last_events_single[1].value, 1);
	zassert_equal(last_events_single[0].type, INPUT_EV_KEY);
	zassert_equal(last_events_single[0].code, INPUT_KEY_A);
	zassert_equal(last_events_single[0].value, 0);

	/* other key */
	input_report_key(fake_dev, INPUT_KEY_1, 1, true, K_FOREVER);
	k_sleep(K_MSEC(50));
	input_report_key(fake_dev, INPUT_KEY_1, 0, true, K_FOREVER);
	k_sleep(K_MSEC(310));
	zassert_equal(event_count_single, 4);
	zassert_equal(last_events_single[1].code, INPUT_KEY_B);
	zassert_equal(last_events_single[1].value, 1);
	zassert_equal(last_events_single[0].code, INPUT_KEY_B);
	zassert_equal(last_events_single[0].value, 0);

	/* no single tap code specified, no event */
	zassert_equal(event_count, 0);
}

/* Test that a double tap does not generate any single tap event */
ZTEST(double_tap, test_single_tap_not_reported_on_double_tap)
{
	event_count_single = 0;

	input_report_key(fake_dev, INPUT_KEY_0, 1, true, K_FOREVER);
	k_sleep(K_MSEC(50));
	input_report_key(fake_dev, INPUT_KEY_0, 0, true, K_FOREVER);
	k_sleep(K_MSEC(50));
	input_report_key(fake_dev, INPUT_KEY_0, 1, true, K_FOREVER);
	k_sleep(K_MSEC(50));
	input_report_key(fake_dev, INPUT_KEY_0, 0, true, K_FOREVER);

	k_sleep(K_MSEC(310));
	zassert_equal(event_count_single, 2, "Only the double tap event should be generated");
	zassert_equal(last_events_single[1].code, INPUT_KEY_X);
	zassert_equal(last_events_single[1].value, 1);
	zassert_equal(last_events_single[0].code, INPUT_KEY_X);
	zassert_equal(last_events_single[0].value, 0);

	/* a tap after a double tap starts a new sequence */
	input_report_key(fake_dev, INPUT_KEY_0, 1, true, K_FOREVER);
	k_sleep(K_MSEC(50));
	input_report_key(fake_dev, INPUT_KEY_0, 0, true, K_FOREVER);

	k_sleep(K_MSEC(310));
	zassert_equal(event_count_single, 4);
	zassert_equal(last_events_single[1].code, INPUT_KEY_A);
	zassert_equal(last_events_single[1].value, 1);
	zassert_equal(last_events_single[0].code, INPUT_KEY_A);
	zassert_equal(last_events_single[0].value, 0);
}

/* Test that holding a key down does not generate a single tap event */
ZTEST(double_tap, test_single_tap_hold)
{
	event_count_single = 0;

	input_report_key(fake_dev, INPUT_KEY_0, 1, true, K_FOREVER);
	k_sleep(K_MSEC(310));
	zassert_equal(event_count_single, 0, "No event should be generated while holding");

	input_report_key(fake_dev, INPUT_KEY_0, 0, true, K_FOREVER);
	k_sleep(K_MSEC(310));
	zassert_equal(event_count_single, 0, "No event should be generated on release");
}

/* Test that a release with no matching press does not generate any event */
ZTEST(double_tap, test_single_tap_release_only)
{
	event_count_single = 0;

	input_report_key(fake_dev, INPUT_KEY_0, 0, true, K_FOREVER);
	k_sleep(K_MSEC(310));
	zassert_equal(event_count_single, 0, "No event should be generated for a lone release");

	input_report_key(fake_dev, INPUT_KEY_0, 1, true, K_FOREVER);
	k_sleep(K_MSEC(50));
	input_report_key(fake_dev, INPUT_KEY_0, 0, true, K_FOREVER);

	k_sleep(K_MSEC(310));
	zassert_equal(event_count_single, 2, "Single tap should be reported");
	zassert_equal(last_events_single[1].code, INPUT_KEY_A);
	zassert_equal(last_events_single[1].value, 1);
	zassert_equal(last_events_single[0].code, INPUT_KEY_A);
	zassert_equal(last_events_single[0].value, 0);
}

ZTEST_SUITE(double_tap, NULL, NULL, NULL, NULL, NULL);
```
