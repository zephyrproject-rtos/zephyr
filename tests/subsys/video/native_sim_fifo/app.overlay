/*
 * SPDX-FileCopyrightText: Copyright The Zephyr Project Contributors
 * SPDX-License-Identifier: Apache-2.0
 */

/ {
	chosen {
		zephyr,camera = &video_fifo;
	};
};

&video_fifo {
	fifo-path = "video-native-sim-fifo-test.fifo";
	poll-interval-ms = <1>;
	status = "okay";
};
