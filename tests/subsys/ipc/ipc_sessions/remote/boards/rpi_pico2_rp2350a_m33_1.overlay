/*
 * Copyright (c) 2025 Dmitrii Sharshakov <d3dx12.xx@gmail.com>
 *
 * SPDX-License-Identifier: Apache-2.0
 */

&mbox {
	status = "okay";
};

/ {
	ipc {
		ipc0: ipc0 {
			compatible = "zephyr,ipc-icmsg";
			tx-region = <&sram9>;
			rx-region = <&sram8>;
			dcache-alignment = <32>;
			mboxes = <&mbox>, <&mbox>;
			mbox-names = "rx", "tx";
			unbound = "detect";
			status = "okay";
		};
	};
};
