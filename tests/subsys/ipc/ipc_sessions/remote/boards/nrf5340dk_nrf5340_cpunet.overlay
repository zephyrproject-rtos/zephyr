/*
 * Copyright (c) 2024 Nordic Semiconductor ASA
 *
 * SPDX-License-Identifier: Apache-2.0
 */

&ipc0 {
	compatible = "zephyr,ipc-icmsg";
	unbound = "detect";
	dcache-alignment = <8>;
	/delete-property/ tx-blocks;
	/delete-property/ rx-blocks;
};
