/*
 * Copyright (c) 2026 Nordic Semiconductor ASA
 *
 * SPDX-License-Identifier: Apache-2.0
 */

/ {
	aliases {
		dut-ipc = &ipc0;
	};
};

&ipc0 {
	compatible = "zephyr,ipc-icmsg";
	/delete-property/ tx-blocks;
	/delete-property/ rx-blocks;
};
