/*
 * Copyright (c) 2026 Nordic Semiconductor ASA
 *
 * SPDX-License-Identifier: Apache-2.0
 */

#include "nrf54h20dk_nrf54h20_cpuapp_common.dtsi"
#include "nrf54h20dk_nrf54h20_cpuppr_common.dtsi"

&cpuapp_cpuppr_ipc {
	compatible = "zephyr,ipc-icmsg";
	/delete-property/ tx-blocks;
	/delete-property/ rx-blocks;
};
