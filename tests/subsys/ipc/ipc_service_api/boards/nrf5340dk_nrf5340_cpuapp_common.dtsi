/*
 * Copyright (c) 2026 Nordic Semiconductor ASA
 *
 * SPDX-License-Identifier: Apache-2.0
 */

/delete-node/ &ipc0;
/delete-node/ &sram0_shared;

/ {
	chosen {
		/delete-property/ zephyr,ipc_shm;
		/delete-property/ zephyr,bt-hci;
	};
};
