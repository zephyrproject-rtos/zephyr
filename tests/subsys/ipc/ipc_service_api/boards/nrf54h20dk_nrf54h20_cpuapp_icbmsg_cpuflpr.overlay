/*
 * Copyright (c) 2026 Nordic Semiconductor ASA
 *
 * SPDX-License-Identifier: Apache-2.0
 */

#include "nrf54h20dk_nrf54h20_cpuapp_common.dtsi"
#include "nrf54h20dk_nrf54h20_cpuflpr_common.dtsi"

&cpuapp_cpuflpr_ipc {
	status = "okay";
};

&cpuflpr_vevif {
	status = "okay";
};
