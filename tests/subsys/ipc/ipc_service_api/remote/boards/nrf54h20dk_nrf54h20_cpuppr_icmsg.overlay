/*
 * Copyright (c) 2026 Nordic Semiconductor ASA
 *
 * SPDX-License-Identifier: Apache-2.0
 */

&cpuapp_cpuppr_ipc {
	compatible = "zephyr,ipc-icmsg";
	/delete-property/ tx-blocks;
	/delete-property/ rx-blocks;
};
