/*
 * Copyright (c) 2026 Nordic Semiconductor ASA
 *
 * SPDX-License-Identifier: Apache-2.0
 */

#include "nrf54l15dk_nrf54l15_cpuflpr_common.dtsi"

&ipc0 {
	compatible = "zephyr,ipc-icmsg";
	/delete-property/ tx-blocks;
	/delete-property/ rx-blocks;
};
