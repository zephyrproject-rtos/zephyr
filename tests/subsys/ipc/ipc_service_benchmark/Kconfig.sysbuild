## tests/subsys/ipc/ipc_service_benchmark/Kconfig.sysbuild
```kconfig
# Copyright 2026 Nordic Semiconductor ASA
#
# SPDX-License-Identifier: Apache-2.0

source "share/sysbuild/Kconfig"

config REMOTE_BOARD
	string "The board used for remote target"
	default "$(BOARD)/nrf5340/cpunet" if BOARD_NRF5340DK_NRF5340_CPUAPP
	default "$(BOARD)/nrf5340/cpunet" if BOARD_NRF5340BSIM_NRF5340_CPUAPP
	default "nrf54l15dk/nrf54l15/cpuflpr" if $(BOARD) = "nrf54l15dk"
	default "nrf54h20dk/nrf54h20/cpurad" if BOARD_NRF54H20DK_NRF54H20_CPUAPP
	default "stm32h747i_disco/stm32h747xx/m4" if $(BOARD) = "stm32h747i_disco"
```

## tests/subsys/ipc/ipc_service_benchmark/boards/nrf54h20dk_nrf54h20_cpuapp.conf
```kconfig
CONFIG_SOC_NRF54H20_CPURAD_ENABLE=y
CONFIG_MRAM_LATENCY=y
CONFIG_MRAM_LATENCY_AUTO_REQ=y
```

## tests/subsys/ipc/ipc_service_benchmark/remote/Kconfig
```kconfig
source "Kconfig.zephyr"

config TEST_MULTI_ENDPOINT
	bool
	default y if $(dt_nodelabel_has_compat,ipc0,$(DT_COMPAT_ZEPHYR_IPC_ICBMSG))
	default n
```

## tests/subsys/ipc/ipc_service_benchmark/testcase.yaml
```yaml
common:
  timeout: 30
tests:
  tests.ipc.ipc_service.benchmark:
    platform_allow:
      - nrf5340dk/nrf5340/cpuapp
      - nrf5340bsim/nrf5340/cpuapp
      - nrf54l15dk/nrf54l15/cpuapp
      - nrf54h20dk/nrf54h20/cpuapp
    integration_platforms:
      - nrf54l15dk/nrf54l15/cpuapp
      - nrf5340bsim/nrf5340/cpuapp
    tags: ipc
    sysbuild: true
  tests.ipc.ipc_service.benchmark.icmsg.flpr:
    platform_allow:
      - nrf54l15dk/nrf54l15/cpuapp
    integration_platforms:
      - nrf54l15dk/nrf54l15/cpuapp
    tags: ipc
    sysbuild: true
    extra_args:
      - ipc_service_benchmark_SNIPPET=nordic-flpr
      - remote_CONFIG_IPC_SERVICE_BACKEND_ICMSG=y
      - remote_CONFIG_MBOX=y
    extra_configs:
      - CONFIG_IPC_SERVICE_BACKEND_ICMSG=y
      - CONFIG_MBOX=y
  tests.ipc.ipc_service.benchmark.icbmsg.flpr:
    platform_allow:
      - nrf54l15dk/nrf54l15/cpuapp
    integration_platforms:
      - nrf54l15dk/nrf54l15/cpuapp
    tags: ipc
    sysbuild: true
    extra_args:
      - ipc_service_benchmark_DTC_OVERLAY_FILE="boards/nrf54l15dk_nrf54l15_cpuapp_icbmsg.overlay"
      - ipc_service_benchmark_SNIPPET=nordic-flpr
      - remote_DTC_OVERLAY_FILE="boards/nrf54l15dk_nrf54l15_cpuflpr_icbmsg.overlay"
      - remote_CONFIG_MBOX=y
    extra_configs:
      - CONFIG_MBOX=y
  tests.ipc.ipc_service.benchmark.icbmsg.nrf54h.cpurad:
    platform_allow:
      - nrf54h20dk/nrf54h20/cpuapp
    integration_platforms:
      - nrf54h20dk/nrf54h20/cpuapp
    tags: ipc
    sysbuild: true
    extra_configs:
      - CONFIG_TEST_NO_COPY=y
  tests.ipc.ipc_service.benchmark.icbmsg.nrf54h.cpurad.stm:
    platform_allow:
      - nrf54h20dk/nrf54h20/cpuapp
    integration_platforms:
      - nrf54h20dk/nrf54h20/cpuapp
    tags: ipc
    sysbuild: true
    required_snippets: nordic-log-stm
    extra_configs:
      - CONFIG_TEST_NO_COPY=y
    extra_args:
      - remote_SNIPPET=nordic-log-stm
  tests.ipc.ipc_service.benchmark.icmsg.nrf54h.cpurad:
    platform_allow:
      - nrf54h20dk/nrf54h20/cpuapp
    integration_platforms:
      - nrf54h20dk/nrf54h20/cpuapp
    tags: ipc
    sysbuild: true
    extra_args:
      - ipc_service_benchmark_DTC_OVERLAY_FILE="boards/nrf54h20dk_nrf54h20_cpuapp_icmsg.overlay"
      - remote_DTC_OVERLAY_FILE="boards/nrf54h20dk_nrf54h20_cpurad_icmsg.overlay"
```

## tests/subsys/ipc/ipc_sessions/Kconfig
```kconfig
#
# Copyright (c) 2024 Nordic Semiconductor ASA
#
# SPDX-License-Identifier: Apache-2.0
#

rsource "interoperability/Kconfig"

menu "Zephyr"
source "Kconfig.zephyr"
endmenu

config IPC_TEST_MSG_HEAP_SIZE
	int "The heap to copy processed messages"
	default 512
	help
		Internal heap where all the message data would be copied to be processed
		linearry in tests.

config IPC_TEST_SKIP_CORE_RESET
	bool "Skip the tests that includes core resetting"
	help
		Some of the cores cannot be safely restarted.
		Skip the tests that require it in such a cases.

config IPC_TEST_BLOCK_SIZE
	int "Block size for multiple transfers test"
	default 32

config IPC_TEST_BLOCK_CNT
	int "Number of blocks for multiple transfers test"
	default 8000

config IPC_TEST_SKIP_UNBOUND
	bool "Skip unbound tests"
	help
		Whether to skip tests that requires unbound callback functionality.
```

## tests/subsys/ipc/ipc_sessions/Kconfig.sysbuild
```kconfig
#
# Copyright (c) 2024 Nordic Semiconductor ASA
#
# SPDX-License-Identifier: Apache-2.0
#

source "${ZEPHYR_BASE}/share/sysbuild/Kconfig"

config REMOTE_BOARD
	string "The board used for remote target"
	default "nrf5340dk/nrf5340/cpunet" if BOARD_NRF5340DK_NRF5340_CPUAPP
	default "nrf5340dk/nrf5340/cpunet" if BOARD_NRF5340DK_NRF5340_CPUAPP_NS
	default "nrf54h20dk/nrf54h20/cpurad" if BOARD_NRF54H20DK_NRF54H20_CPUAPP
```

## tests/subsys/ipc/ipc_sessions/boards/nrf5340bsim_nrf5340_cpuapp.conf
```kconfig
#
# Copyright (c) 2025 Dmitrii Sharshakov <d3dx12.xx@gmail.com>
#
# SPDX-License-Identifier: Apache-2.0
#

CONFIG_IPC_TEST_SKIP_CORE_RESET=y
```

## tests/subsys/ipc/ipc_sessions/boards/nrf5340dk_nrf5340_cpuapp_icbmsg.conf
```kconfig
#
# Copyright (c) 2025 Nordic Semiconductor ASA
#
# SPDX-License-Identifier: LicenseRef-Nordic-5-Clause
#

CONFIG_SOC_NRF53_CPUNET_ENABLE=y
```

## tests/subsys/ipc/ipc_sessions/boards/nrf54h20dk_nrf54h20_cpuapp_icbmsg.conf
```kconfig
#
# Copyright (c) 2025 Nordic Semiconductor ASA
#
# SPDX-License-Identifier: LicenseRef-Nordic-5-Clause
#

CONFIG_IPC_TEST_SKIP_CORE_RESET=y
```

## tests/subsys/ipc/ipc_sessions/interoperability/Kconfig
```kconfig
#
# Copyright (c) 2024 Nordic Semiconductor ASA
#
# SPDX-License-Identifier: Apache-2.0
#

config IPC_SERVICE_BACKEND_ICMSG
	default n if IPC_SERVICE_BACKEND_ICMSG_V1

config IPC_SERVICE_ICMSG
	default n if IPC_SERVICE_ICMSG_V1

config IPC_SERVICE_BACKEND_ICMSG_V1
	bool "ICMSG backend with SPSC packet buffer (old implementation)"
	depends on MBOX
	select IPC_SERVICE_ICMSG_V1
	help
	  Chosing this backend results in single endpoint implementation based
	  on circular packet buffer.

menuconfig IPC_SERVICE_ICMSG_V1
	bool "icmsg IPC library (old implementation)"
	select PBUF_V1
	help
	  Icmsg library

if IPC_SERVICE_ICMSG_V1
	rsource "Kconfig.icmsg_v1"
endif
```

## tests/subsys/ipc/ipc_sessions/remote/Kconfig
```kconfig
#
# Copyright (c) 2024 Nordic Semiconductor ASA
#
# SPDX-License-Identifier: Apache-2.0
#

rsource "../interoperability/Kconfig"

menu "Zephyr"
source "Kconfig.zephyr"
endmenu
```

## tests/subsys/ipc/ipc_sessions/testcase.yaml
```yaml
sample:
  name: IPC Service integration test
  description: IPC Service integration and efficiency test

common:
  sysbuild: true
  tags: ipc ipc_sessions
  harness: ztest

tests:
  sample.ipc.ipc_sessions.nrf5340dk:
    platform_allow:
      - nrf5340dk/nrf5340/cpuapp
    integration_platforms:
      - nrf5340dk/nrf5340/cpuapp
  sample.ipc.ipc_sessions.icbmsg:
    platform_allow:
      - nrf5340dk/nrf5340/cpuapp
      - nrf54h20dk/nrf54h20/cpuapp
    integration_platforms:
      - nrf5340dk/nrf5340/cpuapp
      - nrf54h20dk/nrf54h20/cpuapp
    extra_configs:
      - FILE_SUFFIX=icbmsg
  sample.ipc.ipc_sessions.nrf54h20dk_cpuapp_cpurad_icmsg:
    platform_allow:
      - nrf54h20dk/nrf54h20/cpuapp
    integration_platforms:
      - nrf54h20dk/nrf54h20/cpuapp
    extra_args:
      - CONFIG_IPC_TEST_SKIP_CORE_RESET=y
      - FILE_SUFFIX=icmsg
  sample.ipc.ipc_sessions.nrf54h20dk_cpuapp_cpuppr:
    platform_allow:
      - nrf54h20dk/nrf54h20/cpuapp
    integration_platforms:
      - nrf54h20dk/nrf54h20/cpuapp
    extra_args:
      - FILE_SUFFIX=cpuppr
      # Note that currently only XIP variant of PPR properly resets itself
      - ipc_sessions_SNIPPET=nordic-ppr-xip
      - remote_CONFIG_XIP=y
  sample.ipc.ipc_sessions.nrf54h20dk_cpuapp_cpuppr_icbmsg:
    platform_allow:
      - nrf54h20dk/nrf54h20/cpuapp
    integration_platforms:
      - nrf54h20dk/nrf54h20/cpuapp
    extra_args:
      - FILE_SUFFIX=cpuppr_icbmsg
      # Note that currently only XIP variant of PPR properly resets itself
      - ipc_sessions_SNIPPET=nordic-ppr-xip
      - remote_CONFIG_XIP=y
  sample.ipc.ipc_sessions.nrf54h20dk_cpuapp_no_unbound_cpuppr:
    platform_allow:
      - nrf54h20dk/nrf54h20/cpuapp
    integration_platforms:
      - nrf54h20dk/nrf54h20/cpuapp
    extra_args:
      - FILE_SUFFIX=cpuppr
      - ipc_sessions_SNIPPET=nordic-ppr
      - CONFIG_IPC_TEST_SKIP_UNBOUND=y
      - CONFIG_IPC_SERVICE_BACKEND_ICMSG_V1=y
  sample.ipc.ipc_sessions.nrf54h20dk_cpuapp_cpuppr_no_unbound:
    platform_allow:
      - nrf54h20dk/nrf54h20/cpuapp
    integration_platforms:
      - nrf54h20dk/nrf54h20/cpuapp
    extra_args:
      - FILE_SUFFIX=cpuppr
      - ipc_sessions_SNIPPET=nordic-ppr
      - CONFIG_IPC_TEST_SKIP_UNBOUND=y
      - remote_CONFIG_IPC_SERVICE_BACKEND_ICMSG_V1=y
```

## tests/subsys/ipc/pbuf/testcase.yaml
```yaml
tests:
  ipc.icmsg_pbuf:
    # For native(POSIX arch) targets, let's skip those which do not produce an executable
    # (amp targets which need more images)
    filter: not CONFIG_ARCH_POSIX or CONFIG_BUILD_OUTPUT_EXE
    integration_platforms:
      - native_sim
    timeout: 120
```

## tests/subsys/jwt/testcase.yaml
```yaml
common:
  filter: CONFIG_FULL_LIBC_SUPPORTED
  min_ram: 96
  min_flash: 72
  timeout: 120
  tags: jwt
  integration_platforms:
    - qemu_x86
tests:
  libraries.encoding.jwt: {}
```

## tests/subsys/kvss/zms/Kconfig
```kconfig
# Copyright 2025 NXP
# SPDX-License-Identifier: Apache-2.0

mainmenu "ZMS test configuration"

config TEST_ZMS_SIMULATOR
	bool "Enable ZMS tests designed to be run using a flash-simulator"
	default y if BOARD_QEMU_X86 || ARCH_POSIX
	help
	  If y, enables ZMS tests designed to be run using a flash-simulator,
	  which provide functionality for flash property customization
	  and emulating errors in flash operation in parallel to
	  the regular flash API.
	  The tests must be run only on qemu_x86 or native_sim target.

source "Kconfig.zephyr"
```

## tests/subsys/kvss/zms/testcase.yaml
```yaml
common:
  tags: zms
tests:
  keyvalstorage.zms:
    platform_allow:
      - qemu_x86
  keyvalstorage.zms.0x00:
    extra_args: DTC_OVERLAY_FILE=boards/qemu_x86_ev_0x00.overlay
    platform_allow: qemu_x86
  keyvalstorage.zms.sim.no_erase:
    extra_configs:
      - CONFIG_FLASH_SIMULATOR_EXPLICIT_ERASE=n
    platform_allow: qemu_x86
  keyvalstorage.zms.sim.corrupt_close:
    extra_configs:
      - CONFIG_FLASH_SIMULATOR_EXPLICIT_ERASE=y
      - CONFIG_FLASH_SIMULATOR_DOUBLE_WRITES=y
    platform_allow: qemu_x86
  keyvalstorage.zms.cache:
    extra_configs:
      - CONFIG_ZMS_LOOKUP_CACHE=y
      - CONFIG_ZMS_LOOKUP_CACHE_SIZE=64
    platform_allow: native_sim
  keyvalstorage.zms.data_crc:
    extra_configs:
      - CONFIG_ZMS_DATA_CRC=y
    platform_allow:
      - native_sim
      - qemu_x86
  keyvalstorage.zms.no_double_write:
    extra_configs:
      - CONFIG_ZMS_NO_DOUBLE_WRITE=y
    platform_allow:
      - native_sim
      - qemu_x86
  keyvalstorage.zms.no_double_write_cache:
    extra_configs:
      - CONFIG_ZMS_NO_DOUBLE_WRITE=y
      - CONFIG_ZMS_LOOKUP_CACHE=y
      - CONFIG_ZMS_LOOKUP_CACHE_SIZE=64
    platform_allow:
      - native_sim
      - qemu_x86
  keyvalstorage.zms.id_64bit:
    extra_configs:
      - CONFIG_ZMS_ID_64BIT=y
      - CONFIG_ZMS_LOOKUP_CACHE=y
      - CONFIG_ZMS_LOOKUP_CACHE_SIZE=64
    platform_allow: qemu_x86
```

## tests/subsys/llext/boards/intel_adsp_ace15_mtpm_sim.conf
```kconfig
# xt-clang cannot link shared libs for xtensa
CONFIG_LLEXT_TYPE_ELF_RELOCATABLE=y
```

## tests/subsys/llext/boards/intel_adsp_ace20_lnl_sim.conf
```kconfig
# xt-clang cannot link shared libs for xtensa
CONFIG_LLEXT_TYPE_ELF_RELOCATABLE=y
CONFIG_LLEXT_INC_IN_TEXT=y
```

## tests/subsys/llext/boards/nsim_nsim_vpx5.conf
```kconfig
CONFIG_LLEXT_INSTR_HEAP_SIZE=16
CONFIG_LLEXT_DATA_HEAP_SIZE=48
CONFIG_LLEXT_DATA_HEAP_SECTION=".rodata.llext_data_heap"
```

## tests/subsys/llext/hello_world/Kconfig
```kconfig
# SPDX-License-Identifier: Apache-2.0
# Copyright (c) 2024 Intel Corporation.

mainmenu "LLEXT functionality test"

source "Kconfig.zephyr"

config LLEXT_TEST_HELLO
	tristate "llext hello test"
	default y
	help
	  This enables building the hello_world test case.
```

## tests/subsys/llext/hello_world/testcase.yaml
```yaml
common:
  tags: llext
  arch_allow:
    - arm
    - xtensa
  platform_exclude:
    - numaker_pfm_m487 # See #63167
tests:
  llext.simple.readonly:
    arch_exclude: xtensa # for now
    filter: not CONFIG_MPU and not CONFIG_MMU and not CONFIG_SOC_SERIES_S32ZE
    extra_configs:
      - arch:arm:CONFIG_ARM_MPU=n
      - CONFIG_LLEXT_STORAGE_WRITABLE=n
  llext.simple.readonly_mpu:
    min_ram: 128
    arch_exclude: xtensa # for now
    filter: CONFIG_CPU_HAS_MPU
    extra_configs:
      - CONFIG_USERSPACE=y
      - CONFIG_LLEXT_STORAGE_WRITABLE=n
  llext.simple.writable:
    filter: not CONFIG_MPU and not CONFIG_MMU and not CONFIG_SOC_SERIES_S32ZE
    extra_configs:
      - arch:arm:CONFIG_ARM_MPU=n
      - CONFIG_LLEXT_STORAGE_WRITABLE=y
  llext.simple.modules_enabled_writable:
    filter: not CONFIG_MPU and not CONFIG_MMU
    platform_key:
      - simulation
      - arch
    platform_exclude:
      - qemu_cortex_a9 # MMU
    extra_configs:
      - arch:arm:CONFIG_ARM_MPU=n
      - CONFIG_MODULES=y
      - CONFIG_LLEXT_STORAGE_WRITABLE=y
      - CONFIG_LLEXT_TEST_HELLO=m
  llext.simple.modules_enabled_readonly:
    filter: not CONFIG_MPU and not CONFIG_MMU
    arch_exclude: xtensa # for now
    platform_key:
      - simulation
      - arch
    platform_exclude:
      - qemu_cortex_a9 # MMU
    extra_configs:
      - arch:arm:CONFIG_ARM_MPU=n
      - CONFIG_MODULES=y
      - CONFIG_LLEXT_TEST_HELLO=m
  llext.simple.modules_enabled_readonly_mpu:
    filter: CONFIG_CPU_HAS_MPU
    arch_exclude: xtensa # for now
    platform_key:
      - simulation
      - arch
    extra_configs:
      - CONFIG_USERSPACE=y
      - CONFIG_MODULES=y
      - CONFIG_LLEXT_TEST_HELLO=m
```

## tests/subsys/llext/simple/boards/qemu_cortex_r5.conf
```kconfig
CONFIG_FILE_SYSTEM=y
CONFIG_FILE_SYSTEM_LITTLEFS=y
CONFIG_FS_LITTLEFS_FMP_DEV=y
CONFIG_FLASH_MAP=y
CONFIG_FLASH=y
CONFIG_FLASH_SIMULATOR=y
```
