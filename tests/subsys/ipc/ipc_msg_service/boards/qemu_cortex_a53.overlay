/*
 * Copyright 2021 Carlo Caione <ccaione@baylibre.com>
 * Copyright 2025 Intel Corporation
 *
 * SPDX-License-Identifier: Apache-2.0
 */

/ {
	ipc10: ipc10 {
		compatible = "ipc-msg-service-backend";
		offset = <10>;
		status = "okay";
	};

	ipc20: ipc20 {
		compatible = "ipc-msg-service-backend";
		offset = <20>;
		status = "okay";
	};
};
