## CMakeLists.txt
```
#
# Copyright 2021 Google LLC
# Copyright 2025 Intel Corporation
#
# SPDX-License-Identifier: Apache-2.0
#

cmake_minimum_required(VERSION 3.20.0)

find_package(Zephyr REQUIRED HINTS $ENV{ZEPHYR_BASE})
project(ipc_msg_service)

FILE(GLOB app_sources src/*.c)
target_sources(app PRIVATE ${app_sources})
```

## prj.conf
```kconfig
#
# Copyright 2021 Carlo Caione <ccaione@baylibre.com>
# Copyright 2025 Intel Corporation
#
# SPDX-License-Identifier: Apache-2.0
#

CONFIG_ZTEST=y
CONFIG_IPC_MSG_SERVICE=y
```

## boards/qemu_cortex_a53.overlay
```dts
/*
 * Copyright 2021 Carlo Caione <ccaione@baylibre.com>
 * Copyright 2025 Intel Corporation
 *
 * SPDX-License-Identifier: Apache-2.0
 */

/ {
	ipc10: ipc10 {
		compatible = "ipc-msg-service-backend";
		offset = <10>;
		status = "okay";
	};

	ipc20: ipc20 {
		compatible = "ipc-msg-service-backend";
		offset = <20>;
		status = "okay";
	};
};
```

## dts/bindings/ipc-service-backend.yaml
```yaml
#
# Copyright (c) 2021 Carlo Caione <ccaione@baylibre.com>
# Copyright (c) 2025 Intel Corporation
#
# SPDX-License-Identifier: Apache-2.0
#

description: Backend binding to test the IPC message service

compatible: "ipc-msg-service-backend"

properties:
  offset:
    type: int
    required: true
    description: offset to add
```

## src/main.c
```c
/*
 * Copyright 2021 Carlo Caione, <ccaione@baylibre.com>
 * Copyright 2025 Intel Corporation
 *
 * SPDX-License-Identifier: Apache-2.0
 */

#include <zephyr/device.h>
#include <zephyr/devicetree.h>
#include <zephyr/ztest.h>
#include <zephyr/ipc/ipc_msg_service.h>

static K_SEM_DEFINE(evt_done_sem, 0, 1);

static int received_cb(uint16_t msg_type, const void *msg_data, void *priv)
{
	uintptr_t expected = (uintptr_t)priv;
	const struct ipc_msg_type_cmd *msg = (const struct ipc_msg_type_cmd *)msg_data;

	zassert_equal(msg_type, IPC_MSG_TYPE_CMD, "received incorrect type of message");

	printk("<<< Received cmd: %d, expected: %ld\n", msg->cmd, expected);

	zassert_equal(msg->cmd, expected, "msg doesn't match the expected value");

	return 0;
}

static int event_cb(uint16_t evt_type, const void *evt_data, void *priv)
{
	ARG_UNUSED(evt_data);

	zassert_equal(evt_type, IPC_MSG_EVT_REMOTE_DONE, "received incorrect event");

	k_sem_give(&evt_done_sem);

	return 0;
}

static struct ipc_msg_ept_cfg ept_cfg = {
	.name = "test_ept",
	.cb = {
		.received = received_cb,
		.event = event_cb,
	},
};

ZTEST(ipc_msg_service, test_ipc_msg_service_send)
{
	const struct device *dev_10;
	const struct device *dev_20;
	struct ipc_msg_ept ept_10;
	struct ipc_msg_ept ept_20;
	struct ipc_msg_type_cmd msg;
	int ret;

	dev_10 = DEVICE_DT_GET(DT_NODELABEL(ipc10));
	dev_20 = DEVICE_DT_GET(DT_NODELABEL(ipc20));

	/*
	 * We send 10 through the ipc10 instance so we expect 20 in the
	 * receiving callback (10 + 10 == 20)
	 */
	msg.cmd = 10;
	printk(">>> Sending cmd %d\n", msg.cmd);

	/* Save the expected result in priv */
	ept_cfg.priv = (void *)20;

	ret = ipc_msg_service_register_endpoint(dev_10, &ept_10, &ept_cfg);
	zassert_ok(ret, "ipc_msg_service_register_endpoint() failed");

	ret = ipc_msg_service_send(&ept_10, IPC_MSG_TYPE_CMD, (const void *)&msg);
	zassert_ok(ret, "ipc_msg_service_send() failed");

	zassert_ok(k_sem_take(&evt_done_sem, K_MSEC(100)), "done event not received");

	/*
	 * We send 10 again this time through the ipc20 instance so we expect
	 * 20 in the receiving callback (10 + 20 == 30)
	 */
	msg.cmd = 10;
	printk(">>> Sending cmd %d\n", msg.cmd);

	/* Save the expected result in priv */
	ept_cfg.priv = (void *)30;

	ret = ipc_msg_service_register_endpoint(dev_20, &ept_20, &ept_cfg);
	zassert_ok(ret, "ipc_msg_service_register_endpoint() failed");

	ret = ipc_msg_service_send(&ept_20, IPC_MSG_TYPE_CMD, (const void *)&msg);
	zassert_ok(ret, "ipc_msg_service_send() failed");

	zassert_ok(k_sem_take(&evt_done_sem, K_MSEC(100)), "done event not received");

	/* Deregister the endpoint and ensure that we fail correctly. */
	ret = ipc_msg_service_deregister_endpoint(&ept_10);
	zassert_ok(ret, "ipc_msg_service_deregister_endpoint() failed");

	ret = ipc_msg_service_deregister_endpoint(&ept_20);
	zassert_ok(ret, "ipc_msg_service_deregister_endpoint() failed");
}

ZTEST(ipc_msg_service, test_ipc_msg_endpoint_not_registered)
{
	const struct device *dev_10;
	struct ipc_msg_ept ept_10;
	int ret;

	dev_10 = DEVICE_DT_GET(DT_NODELABEL(ipc10));

	/* Register then de-register endpoint. */
	ret = ipc_msg_service_register_endpoint(dev_10, &ept_10, &ept_cfg);
	zassert_ok(ret, "ipc_msg_service_register_endpoint() failed");

	ret = ipc_msg_service_deregister_endpoint(&ept_10);
	zassert_ok(ret, "ipc_msg_service_deregister_endpoint() failed");

	/* Should fail as endpoint has already been de-registered. */
	ret = ipc_msg_service_send(&ept_10, IPC_MSG_TYPE_CMD, NULL);
	zassert_equal(ret, -ENOENT, "ipc_msg_service_send() should return -ENOENT");
}

ZTEST(ipc_msg_service, test_ipc_msg_wrong_message_type)
{
	const struct device *dev_10;
	struct ipc_msg_ept ept_10;
	struct ipc_msg_type_cmd msg = {.cmd = 10};
	int ret;

	dev_10 = DEVICE_DT_GET(DT_NODELABEL(ipc10));

	ret = ipc_msg_service_register_endpoint(dev_10, &ept_10, &ept_cfg);
	zassert_ok(ret, "ipc_msg_service_register_endpoint() failed");

	/* IPC_MSG_TYPE_CUSTOM_START is not a valid type in this test. */
	ret = ipc_msg_service_send(&ept_10, IPC_MSG_TYPE_CUSTOM_START, (const void *)&msg);
	zassert_equal(ret, -ENOTSUP, "ipc_msg_service_send() should return -ENOTSUP");

	zassert_equal(k_sem_take(&evt_done_sem, K_MSEC(100)), -EAGAIN,
		      "done event received but should not");

	ret = ipc_msg_service_deregister_endpoint(&ept_10);
	zassert_ok(ret, "ipc_msg_service_deregister_endpoint() failed");
}

ZTEST(ipc_msg_service, test_ipc_msg_endpoint_query)
{
	const struct device *dev_10;
	struct ipc_msg_ept ept_10;
	int ret;

	dev_10 = DEVICE_DT_GET(DT_NODELABEL(ipc10));

	/* Since endpointe has never registered, API pointer is not valid, hence -EIO. */
	ret = ipc_msg_service_query(&ept_10, IPC_MSG_QUERY_IS_READY, NULL, NULL);
	zassert_equal(ret, -EIO, "ipc_msg_service_query() should return -EIO");

	ret = ipc_msg_service_register_endpoint(dev_10, &ept_10, &ept_cfg);
	zassert_ok(ret, "ipc_msg_service_register_endpoint() failed");

	ret = ipc_msg_service_query(&ept_10, IPC_MSG_QUERY_IS_READY, NULL, NULL);
	zassert_equal(ret, 0, "ipc_msg_service_query() should return 0");

	ret = ipc_msg_service_deregister_endpoint(&ept_10);
	zassert_ok(ret, "ipc_msg_service_deregister_endpoint() failed");

	/* Now this will -ENOENT as API pointer has been set above. */
	ret = ipc_msg_service_query(&ept_10, IPC_MSG_QUERY_IS_READY, NULL, NULL);
	zassert_equal(ret, -ENOENT, "ipc_msg_service_query() should return -ENOENT");
}

ZTEST_SUITE(ipc_msg_service, NULL, NULL, NULL, NULL, NULL);
```

## src/backend.c
```c
/*
 * Copyright (c) 2021, Carlo Caione <ccaione@baylibre.com>
 * Copyright (c) 2025 Intel Corporation
 *
 * SPDX-License-Identifier: Apache-2.0
 *
 * Simple backend that adds an offset (defined into the DT) to whatever it is
 * passed in input as IPC message.
 */

#include <zephyr/ipc/ipc_msg_service_backend.h>

#include <zephyr/device.h>
#include <zephyr/kernel.h>
#include <zephyr/logging/log.h>
#include <zephyr/sys/util_macro.h>

#define DT_DRV_COMPAT ipc_msg_service_backend

struct backend_data_t {
	bool endpoint_registered;
	const struct ipc_msg_ept_cfg *cfg;
};

struct backend_config_t {
	unsigned int offset;
};

static int send(const struct device *instance, void *token, uint16_t msg_type, const void *msg_data)
{
	const struct backend_config_t *dev_config;
	struct backend_data_t *dev_data;
	const struct ipc_msg_type_cmd *msg;
	struct ipc_msg_type_cmd cb_msg;
	int ret;

	if (msg_type != IPC_MSG_TYPE_CMD) {
		return -ENOTSUP;
	}

	dev_config = instance->config;
	dev_data = instance->data;
	msg = (const struct ipc_msg_type_cmd *)msg_data;

	cb_msg.cmd = msg->cmd + dev_config->offset;

	ret = dev_data->cfg->cb.event(IPC_MSG_EVT_REMOTE_DONE, NULL, dev_data->cfg->priv);
	ARG_UNUSED(ret);

	ret = dev_data->cfg->cb.received(msg_type, &cb_msg, dev_data->cfg->priv);
	ARG_UNUSED(ret);

	return 0;
}

static int query(const struct device *instance, void *token, uint16_t query_type,
		 const void *query_data, void *query_response)
{
	struct backend_data_t *dev_data = instance->data;
	int ret;

	ARG_UNUSED(query_data);
	ARG_UNUSED(query_response);

	if (query_type == IPC_MSG_QUERY_IS_READY) {
		ret = dev_data->endpoint_registered ? 0 : -ENOENT;
	} else {
		ret = -ENOTSUP;
	}

	return ret;
}

static int register_ept(const struct device *instance, void **token,
			const struct ipc_msg_ept_cfg *cfg)
{
	struct backend_data_t *data = instance->data;

	data->cfg = cfg;
	data->endpoint_registered = true;

	return 0;
}

static int deregister_ept(const struct device *instance, void *token)
{
	struct backend_data_t *data = instance->data;

	data->cfg = NULL;
	data->endpoint_registered = false;

	return 0;
}

const static struct ipc_msg_service_backend backend_ops = {
	.query = query,
	.send = send,
	.register_endpoint = register_ept,
	.deregister_endpoint = deregister_ept,
};

#define DEFINE_BACKEND_DEVICE(i)                                                                   \
	static struct backend_config_t backend_config_##i = {                                      \
		.offset = DT_INST_PROP(i, offset),                                                 \
	};                                                                                         \
                                                                                                   \
	static struct backend_data_t backend_data_##i;                                             \
                                                                                                   \
	DEVICE_DT_INST_DEFINE(i, NULL, NULL, &backend_data_##i, &backend_config_##i, POST_KERNEL,  \
			      CONFIG_IPC_MSG_SERVICE_REG_BACKEND_PRIORITY, &backend_ops);

DT_INST_FOREACH_STATUS_OKAY(DEFINE_BACKEND_DEVICE)
```
