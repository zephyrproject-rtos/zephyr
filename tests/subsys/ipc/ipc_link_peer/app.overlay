/*
 * SPDX-FileCopyrightText: Copyright (c) 2026 Basalte bv
 * SPDX-License-Identifier: Apache-2.0
 */

/* The second PTY UART carries the link, the first stays the console */
&uart1 {
	status = "okay";

	ipc0: ipc-uart {
		compatible = "zephyr,ipc-uart";
		mtu = <256>;
		retransmit-timeout-ms = <100>;
	};
};
