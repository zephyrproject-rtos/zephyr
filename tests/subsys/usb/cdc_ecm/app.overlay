/*
 * Copyright 2025 - 2026 NXP
 * SPDX-License-Identifier: Apache-2.0
 */

/ {
	cdc_ecm_eth0: cdc_ecm_eth0 {
		compatible = "zephyr,cdc-ecm-ethernet";
		remote-mac-address = "00005EAABBCC";
		status = "okay";
	};

	zephyr_uhc0: uhc_vrt0 {
		compatible = "zephyr,uhc-virtual";
		status = "okay";

		zephyr_udc0: udc_vrt0 {
			compatible = "zephyr,udc-virtual";
			num-bidir-endpoints = <8>;
			maximum-speed = "high-speed";
			status = "okay";
		};
	};
};
