/*
 * SPDX-FileCopyrightText: Copyright Nordic Semiconductor ASA
 * SPDX-License-Identifier: Apache-2.0
 */

/delete-node/ &zephyr_udc0;

/ {
	zephyr_uhc0: uhc_vrt0 {
		compatible = "zephyr,uhc-virtual";

		zephyr_udc0: udc_vrt0 {
			compatible = "zephyr,udc-virtual";
			num-bidir-endpoints = <8>;
			maximum-speed = "high-speed";
		};
	};
};

&zephyr_udc0 {
	cdc_acm_uart0 {
		compatible = "zephyr,cdc-acm-uart";
	};
};
