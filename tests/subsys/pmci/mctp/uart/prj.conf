## CMakeLists.txt
```
cmake_minimum_required(VERSION 3.28.0)

find_package(Zephyr REQUIRED HINTS $ENV{ZEPHYR_BASE})
project(mctp_uart_test)

target_sources(app PRIVATE src/main.c)
```

## prj.conf
```kconfig
CONFIG_SERIAL=y
CONFIG_UART_ASYNC_API=y
CONFIG_MCTP=y
CONFIG_MCTP_UART=y
CONFIG_MCTP_HEAP_SIZE=10240
CONFIG_ZTEST=y
```

## boards/frdm_mcxn947_mcxn947_cpu0.overlay
```dts
/*
 * Copyright (c) 2026 Intel Corporation
 *
 * SPDX-License-Identifier: Apache-2.0
 */

/* Connect RX to TX:
 * J1.2 to J1.4
 */
&flexcomm2_lpuart2 {
	status = "okay";
};

host_serial: &flexcomm2_lpuart2 {};

endpoint_serial: &flexcomm2_lpuart2 {};
```

## boards/npcx4m8f_evb.overlay
```dts
/*
 * Copyright (c) 2026 Intel Corporation
 *
 * SPDX-License-Identifier: Apache-2.0
 */

/* Connect RX to TX:
 *  - CR_SIN2 to CR_SOUT2
 * Note that there are different form factors of the board, so the actual pin
 * numbers may vary. Check the relevant schematics for details.
 */
&uart2 {
	current-speed = <115200>;
	pinctrl-0 = <&uart2_sin_gp75 &uart2_sout_gp86>;
	pinctrl-names = "default";
	status = "okay";
};

host_serial: &uart2 {};

endpoint_serial: &uart2 {};
```

## src/main.c
```c
/*
 * Copyright (c) 2025 Intel Corporation
 *
 * SPDX-License-Identifier: Apache-2.0
 */

#include <stdlib.h>
#include <stdio.h>
#include <assert.h>
#include <zephyr/types.h>
#include <zephyr/kernel.h>
#include <libmctp.h>
#include <zephyr/pmci/mctp/mctp_uart.h>

#include <zephyr/ztest.h>

#define HOST_EID 20
#define ENDPOINT_EID 11

MCTP_UART_DT_DEFINE(mctp_uart_host, DEVICE_DT_GET(DT_NODELABEL(host_serial)));
MCTP_UART_DT_DEFINE(mctp_uart_endpoint, DEVICE_DT_GET(DT_NODELABEL(endpoint_serial)));

K_SEM_DEFINE(mctp_rx, 0, 1);

struct reply_data {
	struct k_work work;
	struct mctp *mctp_ctx;
	uint8_t eid;
	const void *reply_msg;
	size_t reply_len;
};

bool ping_pong_done;

static struct reply_data reply_handler;

static const char big_message[] =
	"0123456789012345678901234567890123456789012345678901234567890123456789012345678 "
	"0123456789012345678901234567890123456789012345678901234567890123456789012345678 "
	"01234567890123456789012345678END";

static void target_reply(struct k_work *item)
{
	struct reply_data *reply = CONTAINER_OF(item, struct reply_data, work);
	int rc;

	/* As this test may share a single UART device between host and endpoint,
	 * we need to stop RX on endpoint before restarting RX on host.
	 */
	rc = mctp_uart_stop_rx(&mctp_uart_endpoint);
	zassert_ok(rc, "Failed to stop endpoint RX");
	mctp_uart_start_rx(&mctp_uart_host);

	TC_PRINT("Target replying to endpoint %d\n", reply->eid);
	rc = mctp_message_tx(reply->mctp_ctx, reply->eid, false, 0, (void *)reply->reply_msg,
			     reply->reply_len);
	zassert_ok(rc, "Failed to send reply message");
}

static void rx_message_target(uint8_t eid, bool tag_owner, uint8_t msg_tag, void *data,
			      void *msg, size_t len)
{
	ARG_UNUSED(tag_owner);
	ARG_UNUSED(msg_tag);
	ARG_UNUSED(data);
	ARG_UNUSED(len);

	TC_PRINT("Target received message \"%s\" from endpoint %d, queuing reply\n",
		(char *)msg, eid);

	zassert_ok(memcmp(msg, "ping", sizeof("ping")));

	reply_handler.eid = eid;
	k_work_submit(&reply_handler.work);
}

static void rx_message_target_big_msg(uint8_t eid, bool tag_owner, uint8_t msg_tag, void *data,
				      void *msg, size_t len)
{
	ARG_UNUSED(tag_owner);
	ARG_UNUSED(msg_tag);
	ARG_UNUSED(data);
	ARG_UNUSED(len);

	TC_PRINT("Target received message \"%s\" from endpoint %d, queuing reply\n", (char *)msg,
		 eid);
	zassert_ok(memcmp(msg, big_message, sizeof(big_message)));

	reply_handler.eid = eid;
	k_work_submit(&reply_handler.work);
}

static struct mctp *init_target(void (*rx_callback)(uint8_t eid, bool tag_owner, uint8_t msg_tag,
						    void *data, void *msg, size_t len))
{
	struct mctp *mctp_ctx;

	TC_PRINT("MCTP Endpoint EID:%d on %s\n", ENDPOINT_EID, CONFIG_BOARD_TARGET);
	mctp_ctx = mctp_init();

	zassert_not_null(mctp_ctx, "Failed to initialize MCTP target context");
	mctp_register_bus(mctp_ctx, &mctp_uart_endpoint.binding, ENDPOINT_EID);
	mctp_set_rx_all(mctp_ctx, rx_callback, NULL);
	mctp_uart_start_rx(&mctp_uart_endpoint);

	reply_handler.mctp_ctx = mctp_ctx;
	k_work_init(&reply_handler.work, target_reply);

	return mctp_ctx;
}

static void rx_message(uint8_t eid, bool tag_owner, uint8_t msg_tag, void *data, void *msg,
		       size_t len)
{
	TC_PRINT("Received message \"%s\" from endpoint %d to %d, msg_tag %d, len %zu\n",
		(char *)msg, eid, HOST_EID, msg_tag, len);

	zassert_ok(memcmp(msg, "pong", sizeof("pong")));

	ping_pong_done = true;
	k_sem_give(&mctp_rx);
}

static void rx_message_big(uint8_t eid, bool tag_owner, uint8_t msg_tag, void *data, void *msg,
			   size_t len)
{
	ARG_UNUSED(tag_owner);
	ARG_UNUSED(msg_tag);
	ARG_UNUSED(data);

	TC_PRINT("Received big message from endpoint %d to %d, len %zu\n", eid, HOST_EID, len);

	zassert_equal(len, sizeof(big_message));
	zassert_ok(memcmp(msg, big_message, sizeof(big_message)));

	ping_pong_done = true;
	k_sem_give(&mctp_rx);
}

ZTEST(mctp_uart_test_suite, test_mctp_uart_ping_pong)
{
	int rc;
	struct mctp *mctp_ctx, *mctp_ctx_target;

	TC_PRINT("MCTP Host EID:%d on %s\n", HOST_EID, CONFIG_BOARD_TARGET);
	mctp_ctx = mctp_init();

	zassert_not_null(mctp_ctx, "Failed to initialize MCTP context");
	mctp_register_bus(mctp_ctx, &mctp_uart_host.binding, HOST_EID);
	mctp_set_rx_all(mctp_ctx, rx_message, NULL);

	mctp_ctx_target = init_target(rx_message_target);
	reply_handler.reply_msg = "pong";
	reply_handler.reply_len = sizeof("pong");

	TC_PRINT("Sending message \"ping\" to endpoint %u\n", ENDPOINT_EID);

	rc = mctp_message_tx(mctp_ctx, ENDPOINT_EID, false, 0, (void *)"ping", sizeof("ping"));
	zassert_ok(rc, "Failed to send message");

	/* Wait ping-pong to complete */
	k_sem_take(&mctp_rx, K_SECONDS(5));

	zassert_true(ping_pong_done, "Ping-pong message exchange failed");

	mctp_destroy(mctp_ctx);
	mctp_destroy(mctp_ctx_target);
}

ZTEST(mctp_uart_test_suite, test_mctp_uart_ping_pong_big_message)
{
	int rc;
	struct mctp *mctp_ctx, *mctp_ctx_target;

	TC_PRINT("MCTP Host EID:%d on %s\n", HOST_EID, CONFIG_BOARD_TARGET);
	mctp_ctx = mctp_init();

	zassert_not_null(mctp_ctx, "Failed to initialize MCTP context");
	mctp_register_bus(mctp_ctx, &mctp_uart_host.binding, HOST_EID);
	mctp_set_rx_all(mctp_ctx, rx_message_big, NULL);

	mctp_ctx_target = init_target(rx_message_target_big_msg);
	reply_handler.reply_msg = big_message;
	reply_handler.reply_len = sizeof(big_message);

	TC_PRINT("Sending big message to endpoint %u\n", ENDPOINT_EID);

	rc = mctp_message_tx(mctp_ctx, ENDPOINT_EID, false, 0, (void *)big_message,
			     sizeof(big_message));
	zassert_ok(rc, "Failed to send message");

	/* Wait ping-pong to complete */
	k_sem_take(&mctp_rx, K_SECONDS(5));

	zassert_true(ping_pong_done, "Ping-pong message exchange failed");

	mctp_destroy(mctp_ctx);
	mctp_destroy(mctp_ctx_target);
}

extern sys_slist_t mctp_uart_bindings;

static void cleanup(void *p)
{
	ARG_UNUSED(p);

	ping_pong_done = false;
	mctp_uart_stop_rx(&mctp_uart_host);

	sys_slist_init(&mctp_uart_bindings);
}

ZTEST_SUITE(mctp_uart_test_suite, NULL, NULL, NULL, cleanup, NULL);
```
