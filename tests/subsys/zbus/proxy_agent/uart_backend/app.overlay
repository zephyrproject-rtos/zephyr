/*
 * Copyright (c) 2026 Nordic Semiconductor ASA
 *
 * SPDX-License-Identifier: Apache-2.0
 */

/ {
	euart0: uart-emul-a {
		compatible = "zephyr,uart-emul";
		status = "okay";
		current-speed = <0>;
		rx-fifo-size = <512>;
		tx-fifo-size = <512>;
	};

	euart1: uart-emul-b {
		compatible = "zephyr,uart-emul";
		status = "okay";
		current-speed = <0>;
		rx-fifo-size = <512>;
		tx-fifo-size = <512>;
	};
};
