## CMakeLists.txt
```
#
# Copyright (c) 2026 Nordic Semiconductor ASA
#
# SPDX-License-Identifier: Apache-2.0
#

cmake_minimum_required(VERSION 3.28.0)

find_package(Zephyr REQUIRED HINTS $ENV{ZEPHYR_BASE})
project(test_zbus_proxy_agent)

FILE(GLOB app_sources src/main.c src/zbus_proxy_agent_mock.c)
target_sources(app PRIVATE ${app_sources})
```

## prj.conf
```kconfig
#
# Copyright (c) 2026 Nordic Semiconductor ASA
#
# SPDX-License-Identifier: Apache-2.0
#

CONFIG_ZTEST=y
CONFIG_ASSERT=y
CONFIG_ZTEST_MOCKING=y
CONFIG_ZBUS_ASSERT_MOCK=y

CONFIG_LOG=y

CONFIG_ZBUS=y
CONFIG_ZBUS_PROXY_AGENT=y
CONFIG_ZBUS_PROXY_AGENT_LOG_LEVEL_DBG=y

CONFIG_ZBUS_PROXY_AGENT_WORK_QUEUE_STACK_SIZE=2048
CONFIG_ZTEST_STACK_SIZE=2048
```

## app.overlay
```dts
/*
 * Copyright (c) 2025 Nordic Semiconductor ASA
 *
 * SPDX-License-Identifier: Apache-2.0
 */

/ {
	test_proxy_agent: test-proxy {
		compatible = "zephyr,zbus-proxy-agent-mock";
		status = "okay";
		ack-timeout-start-ms = <10>;
		ack-timeout-max-ms = <100>;
		ack-attempt-limit = <5>;
		tracking-msg-pool-size = <4>;
	};
};
```

## dts/bindings/zephyr,zbus-proxy-agent-mock.yaml
```yaml
# Copyright (c) 2025 Nordic Semiconductor ASA
# SPDX-License-Identifier: Apache-2.0

description: Zbus proxy agent mock backend

compatible: "zephyr,zbus-proxy-agent-mock"

include: zephyr,zbus-proxy-agent-base.yaml
```

## src/main.c
```c
/*
 * Copyright (c) 2026 Nordic Semiconductor ASA
 *
 * SPDX-License-Identifier: Apache-2.0
 */

#include <zephyr/kernel.h>
#include <zephyr/ztest.h>
#include <zephyr/fff.h>
#include <zephyr/zbus/zbus.h>
#include <zephyr/zbus/proxy_agent/zbus_proxy_agent.h>
#include "zbus_proxy_agent_mock.h"

#include <zephyr/logging/log.h>
LOG_MODULE_REGISTER(proxy_agent_test, LOG_LEVEL_DBG);

DEFINE_FFF_GLOBALS;

struct test_data {
	uint32_t test_value;
};

struct test_data last_received_data;
struct zbus_channel last_received_chan;
K_SEM_DEFINE(listener_event_sem, 0, K_SEM_MAX_LIMIT);

ZBUS_PROXY_AGENT_DEFINE(test_proxy_agent, ZBUS_PROXY_AGENT_MOCK, NULL);

ZBUS_CHAN_DEFINE(test_channel, struct test_data, NULL, NULL, ZBUS_OBSERVERS_EMPTY,
		 ZBUS_MSG_INIT(0));

ZBUS_PROXY_ADD_CHAN(test_proxy_agent, test_channel);

ZBUS_SHADOW_CHAN_DEFINE(test_shadow_channel, struct test_data, test_proxy_agent, NULL,
			ZBUS_OBSERVERS_EMPTY, ZBUS_MSG_INIT(0));

ZBUS_PROXY_AGENT_DEFINE(unused_proxy_agent, ZBUS_PROXY_AGENT_MOCK, NULL);

ZBUS_SHADOW_CHAN_DEFINE(unused_shadow_channel, struct test_data, unused_proxy_agent, NULL,
			ZBUS_OBSERVERS_EMPTY, ZBUS_MSG_INIT(0));

K_THREAD_STACK_DEFINE(test_error_handling_stack, CONFIG_ZBUS_PROXY_AGENT_WORK_QUEUE_STACK_SIZE);

void test_channel_listener_cb(const struct zbus_channel *chan)
{
	const struct test_data *data = zbus_chan_const_msg(chan);

	LOG_INF("Received message on channel %s: test_value=%d", chan->name, data->test_value);

	memcpy(&last_received_data, data, sizeof(last_received_data));
	memcpy(&last_received_chan, chan, sizeof(last_received_chan));
	k_sem_give(&listener_event_sem);
}

ZBUS_LISTENER_DEFINE(test_channel_listener, test_channel_listener_cb);
ZBUS_CHAN_ADD_OBS(test_channel, test_channel_listener, 0);
ZBUS_CHAN_ADD_OBS(test_shadow_channel, test_channel_listener, 0);

static void stop_manual_proxy_agent_config(k_tid_t *thread_id,
					   struct zbus_proxy_agent_mock_data *backend_data)
{
	if (thread_id != NULL && *thread_id != NULL) {
		k_thread_abort(*thread_id);
		*thread_id = NULL;
	}

	if (backend_data != NULL) {
		backend_data->recv_cb = NULL;
		backend_data->recv_cb_config_ptr = NULL;
	}
}

struct zbus_proxy_msg create_proxy_agent_msg(const char *chan_name, const uint8_t *msg_data,
					     uint32_t msg_size)
{
	struct zbus_proxy_msg msg = {0};

	msg.message_size = msg_size;
	memcpy(msg.message, msg_data, msg_size);
	msg.channel_name_len = strlen(chan_name) + 1; /* includes NUL terminator */
	memcpy(msg.channel_name, chan_name, msg.channel_name_len);
	return msg;
}

const struct zbus_proxy_agent *get_test_proxy_agent_ptr(void)
{
	/* zbus_proxy_agent "test_proxy_agent" is generated by the ZBUS_PROXY_AGENT_DEFINE
	 * macro
	 */
	return &test_proxy_agent;
}

static void reset_listener_event_sem(void)
{
	k_sem_reset(&listener_event_sem);
}

static void assert_listener_event_received(const char *msg)
{
	int ret = k_sem_take(&listener_event_sem, K_MSEC(100));

	zassert_equal(ret, 0, "%s", msg);
}

static void assert_listener_event_not_received(const char *msg)
{
	int ret = k_sem_take(&listener_event_sem, K_MSEC(100));

	zassert_not_equal(ret, 0, "%s", msg);
}

static void test_cleanup(void *fixture)
{
	ARG_UNUSED(fixture);

	memset(&last_received_data, 0, sizeof(last_received_data));
	memset(&last_received_chan, 0, sizeof(last_received_chan));
	reset_listener_event_sem();

	mock_backend_reset();
}

/* macro tests */

ZTEST(zbus_proxy_agent_tests, test_proxy_agent_config_generation)
{
	/* zbus_proxy_agent "test_proxy_agent" should be generated by the
	 * ZBUS_PROXY_AGENT_DEFINE macro
	 */
	extern const struct zbus_proxy_agent test_proxy_agent;
	struct zbus_proxy_agent_mock_config *backend_config =
		_ZBUS_PROXY_AGENT_GET_BACKEND_CONFIG_ZBUS_PROXY_AGENT_MOCK(test_proxy_agent);

	zassert_str_equal(test_proxy_agent.name, "test_proxy_agent", "Proxy agent name mismatch");
	zassert_equal(test_proxy_agent.backend_config, backend_config,
		      "Backend config pointer mismatch");
	zassert_not_null(backend_config, "Backend config should not be NULL");
	zassert_str_equal(backend_config->name, "test_proxy_agent", "Backend config name mismatch");
	zassert_not_null(backend_config->data, "Backend config data should not be NULL");

	/* Verify the values set on initialization is as expected, indicating that the SYS_INIT is
	 * working correctly
	 */
	zassert_not_null(test_proxy_agent.backend_api,
			 "Proxy agent backend API should not be NULL");
	zassert_not_equal(backend_config->data->recv_cb, NULL,
			  "Backend config recv_cb should not be NULL");
	zassert_not_equal(backend_config->data->recv_cb_config_ptr, NULL,
			  "Backend config recv_cb_config_ptr should not be NULL");

	zassert_not_null(test_proxy_agent.thread, "Thread pointer should not be NULL");
	zassert_not_null(test_proxy_agent.msgq, "Message queue pointer should not be NULL");
	zassert_not_null(test_proxy_agent.stack, "Thread stack pointer should not be NULL");
}

ZTEST(zbus_proxy_agent_tests, test_shadow_channel_validator)
{
	struct test_data data = {.test_value = 42};
	int ret;

	/* Publishing to the shadow channel from outside the proxy agent work queue should fail */
	ret = zbus_chan_pub(&test_shadow_channel, &data, K_NO_WAIT);
	zassert_not_equal(ret, 0,
			  "Publishing to shadow channel from non-proxy context should fail");
	zassert_equal(last_received_data.test_value, 0,
		      "Shadow channel should not receive message from non-proxy context");
}

/* zbus_init_proxy_agent tests */
ZTEST(zbus_proxy_agent_tests, test_zbus_init_proxy_agent_invalid_params)
{
	int ret;
	struct zbus_proxy_agent invalid_config = {0};

	ret = zbus_init_proxy_agent(NULL);
	zassert_equal(ret, -EFAULT, "zbus_init_proxy_agent should fail with NULL config");

	ret = zbus_init_proxy_agent(&invalid_config);
	zassert_equal(
		ret, -EFAULT,
		"zbus_init_proxy_agent should fail with missing runtime data/thread resources");
}

ZTEST(zbus_proxy_agent_tests, test_zbus_init_proxy_agent_error_handling)
{
	int ret;
	struct zbus_proxy_agent_mock_data backend_data = {0};
	struct zbus_proxy_agent_mock_config backend_config = {
		.data = &backend_data,
		.name = "error_handling_agent",
	};
	static struct k_thread thread;
	static struct k_msgq msgq;
	k_tid_t thread_id = NULL;
	static char msgq_buf[CONFIG_ZBUS_PROXY_AGENT_RX_QUEUE_DEPTH *
			     sizeof(struct zbus_proxy_agent_rx_msg)];
	struct zbus_proxy_agent agent = {
		.name = "error_handling_agent",
		.backend_config = &backend_config,
		.backend_api = _ZBUS_PROXY_AGENT_GET_BACKEND_API_ZBUS_PROXY_AGENT_MOCK,
		.thread = &thread,
		.msgq = &msgq,
		.thread_id = &thread_id,
		.stack = test_error_handling_stack,
	};

	k_msgq_init(&msgq, msgq_buf, sizeof(struct zbus_proxy_agent_rx_msg),
		    CONFIG_ZBUS_PROXY_AGENT_RX_QUEUE_DEPTH);

	mock_backend_set_set_recv_cb_retval(-1);
	ret = zbus_init_proxy_agent(&agent);
	zassert_equal(ret, -1, "zbus_init_proxy_agent should fail when backend_set_recv_cb fails");
	mock_backend_set_set_recv_cb_retval(0);
	stop_manual_proxy_agent_config(&thread_id, &backend_data);

	k_msgq_init(&msgq, msgq_buf, sizeof(struct zbus_proxy_agent_rx_msg),
		    CONFIG_ZBUS_PROXY_AGENT_RX_QUEUE_DEPTH);

	mock_backend_set_init_retval(-5);
	ret = zbus_init_proxy_agent(&agent);
	zassert_equal(ret, -5, "zbus_init_proxy_agent should fail when backend_init fails");
	mock_backend_set_init_retval(0);
	stop_manual_proxy_agent_config(&thread_id, &backend_data);
}

/* zbus_proxy_agent_listener_cb tests */
ZTEST(zbus_proxy_agent_tests, test_zbus_proxy_agent_listener_cb_from_zbus)
{
	int ret;
	struct test_data data = {.test_value = 123};
	int send_count = mock_backend_get_send_count();

	/* Publish a message to the test channel */
	ret = zbus_chan_pub(&test_channel, &data, K_NO_WAIT);
	zassert_equal(ret, 0, "Failed to publish message to test channel");

	/* Verify that the msg was received and processed by the test listener callback */
	zassert_equal(last_received_data.test_value, 123,
		      "Listener callback did not receive correct message data");
	zassert_str_equal(last_received_chan.name, test_channel.name,
			  "Listener callback did not receive correct channel reference");

	/* Verify that the message was sent to the proxy agent backend */
	zassert_equal(mock_backend_get_send_count() - send_count, 1,
		      "Message was not queued to proxy agent's work handler");
}

ZTEST(zbus_proxy_agent_tests, test_zbus_proxy_agent_listener_cb_error_handling)
{
	int send_count = mock_backend_get_send_count();
	const struct zbus_proxy_agent *agent = get_test_proxy_agent_ptr();

	uint8_t valid_msg[10] = {0, 1, 2, 3, 4, 5, 6, 7, 8, 9};
	char long_name[CONFIG_ZBUS_PROXY_AGENT_MAX_CHANNEL_NAME_SIZE + 1];

	memset(long_name, 'A', sizeof(long_name) - 1);
	long_name[sizeof(long_name) - 1] = '\0';

	struct zbus_channel invalid_name_chan = {
		.name = long_name,
		.message_size = 10,
	};
	struct zbus_channel invalid_size_chan = {
		.name = "invalid_size_chan",
		.message_size = CONFIG_ZBUS_PROXY_AGENT_MAX_MESSAGE_SIZE + 1,
	};
	struct zbus_channel valid_chan = {
		.name = "valid_chan",
		.message = valid_msg,
		.message_size = sizeof(valid_msg),
	};

	zbus_proxy_agent_listener_cb(&invalid_size_chan, agent);
	zassert_equal(mock_backend_get_send_count(), send_count,
		      "Backend send should not be called when message size exceeds maximum");

	zbus_proxy_agent_listener_cb(&invalid_name_chan, agent);
	zassert_equal(mock_backend_get_send_count(), send_count,
		      "Backend send should not be called when channel name length exceeds maximum");

	mock_backend_set_send_retval(-3);
	zbus_proxy_agent_listener_cb(&valid_chan, agent);
	zassert_equal(mock_backend_get_send_count(), send_count,
		      "Backend send failure must not increment successful send count");
	mock_backend_set_send_retval(0);

	zbus_proxy_agent_listener_cb(&valid_chan, agent);
	zassert_equal(mock_backend_get_send_count() - send_count, 1,
		      "Message was not sent by backend after error cases");
}

/* zbus_proxy_agent_receive_cb tests */

ZTEST(zbus_proxy_agent_tests, test_zbus_proxy_agent_receive_cb)
{
	const struct zbus_proxy_agent *agent = get_test_proxy_agent_ptr();
	struct test_data data = {.test_value = 567};
	struct zbus_proxy_msg msg =
		create_proxy_agent_msg(test_shadow_channel.name, (uint8_t *)&data, sizeof(data));
	int ret;

	reset_listener_event_sem();

	ret = mock_backend_trigger_receive(agent, &msg);
	zassert_equal(ret, 0, "Receive callback should accept valid shadow channel message");

	assert_listener_event_received("Receive callback did not publish to the shadow channel");

	/* Verify that the message was sent all the way to test_channel_listener_cb by checking the
	 * last received data and channel
	 */
	zassert_equal(last_received_data.test_value, 567,
		      "Receive callback did not process correct message data");
	zassert_str_equal(last_received_chan.name, test_shadow_channel.name,
			  "Receive callback did not process correct channel reference");
}

ZTEST(zbus_proxy_agent_tests, test_zbus_proxy_agent_receive_cb_no_channel)
{
	const struct zbus_proxy_agent *agent = get_test_proxy_agent_ptr();
	struct test_data data = {.test_value = 890};
	struct zbus_proxy_msg msg =
		create_proxy_agent_msg("non_existent_channel", (uint8_t *)&data, sizeof(data));
	int ret;

	reset_listener_event_sem();

	ret = mock_backend_trigger_receive(agent, &msg);
	zassert_equal(ret, -ENOENT, "Receive callback should reject non-existent channel");

	assert_listener_event_not_received("Non-existent channel should not publish any message");

	zassert_equal(last_received_data.test_value, 0,
		      "Non-existent channel should not publish any message");
}

ZTEST(zbus_proxy_agent_tests, test_zbus_proxy_agent_receive_cb_wrong_shadow_channel)
{
	const struct zbus_proxy_agent *agent = get_test_proxy_agent_ptr();
	struct test_data data = {.test_value = 345};
	struct zbus_proxy_msg msg =
		create_proxy_agent_msg(unused_shadow_channel.name, (uint8_t *)&data, sizeof(data));
	int ret;

	reset_listener_event_sem();

	ret = mock_backend_trigger_receive(agent, &msg);
	zassert_equal(ret, -EINVAL,
		      "Receive callback should reject message for shadow channel not associated "
		      "with the proxy agent");

	assert_listener_event_not_received("Wrong shadow channel should not publish any message");

	zassert_equal(last_received_data.test_value, 0,
		      "Wrong shadow channel should not publish any message");
}

ZTEST(zbus_proxy_agent_tests, test_zbus_proxy_agent_receive_cb_invalid_msg)
{
	const struct zbus_proxy_agent *agent = get_test_proxy_agent_ptr();
	uint8_t msg_data[10] = {0};
	struct zbus_proxy_msg msg =
		create_proxy_agent_msg(test_shadow_channel.name, msg_data, sizeof(msg_data));
	int ret;

	reset_listener_event_sem();

	ret = mock_backend_trigger_receive(agent, &msg);
	zassert_equal(ret, -EMSGSIZE, "Receive callback should reject message with invalid size");

	assert_listener_event_not_received("Invalid message should not publish any message");

	zassert_equal(last_received_data.test_value, 0,
		      "Invalid message should not publish any message");
}

ZTEST_SUITE(zbus_proxy_agent_tests, NULL, NULL, NULL, test_cleanup, NULL);
```

## src/zbus_proxy_agent_mock.c
```c
/*
 * Copyright (c) 2026 Nordic Semiconductor ASA
 *
 * SPDX-License-Identifier: Apache-2.0
 */

#include "zbus_proxy_agent_mock.h"
#include <zephyr/zbus/proxy_agent/zbus_proxy_agent.h>
#include <zephyr/logging/log.h>
LOG_MODULE_REGISTER(proxy_agent_mock, LOG_LEVEL_DBG);

/* Mock backend state for testing */
struct mock_state {
	int init_retval;
	int send_retval;
	int set_recv_cb_retval;
	uint32_t send_count;
};

static struct mock_state backend_mock_state = {
	.init_retval = 0,
	.send_retval = 0,
	.set_recv_cb_retval = 0,
	.send_count = 0,
};

void mock_backend_reset(void)
{
	backend_mock_state.init_retval = 0;
	backend_mock_state.send_retval = 0;
	backend_mock_state.set_recv_cb_retval = 0;
	backend_mock_state.send_count = 0;
}

void mock_backend_set_init_retval(int retval)
{
	backend_mock_state.init_retval = retval;
}

void mock_backend_set_send_retval(int retval)
{
	backend_mock_state.send_retval = retval;
}

void mock_backend_set_set_recv_cb_retval(int retval)
{
	backend_mock_state.set_recv_cb_retval = retval;
}

uint32_t mock_backend_get_send_count(void)
{
	return backend_mock_state.send_count;
}

int mock_backend_trigger_receive(const struct zbus_proxy_agent *config, struct zbus_proxy_msg *msg)
{
	const struct zbus_proxy_agent_mock_config *mock_config =
		(const struct zbus_proxy_agent_mock_config *)config->backend_config;

	if (mock_config->data != NULL && mock_config->data->recv_cb != NULL) {
		return mock_config->data->recv_cb(mock_config->data->recv_cb_config_ptr, msg);
	}

	return -ENOSYS;
}

static int zbus_proxy_agent_mock_backend_init(const struct zbus_proxy_agent *config)
{
	LOG_DBG("Mock backend init called, returning %d", backend_mock_state.init_retval);
	return backend_mock_state.init_retval;
}

static int zbus_proxy_agent_mock_backend_send(const struct zbus_proxy_agent *config,
					      struct zbus_proxy_msg *msg)
{
	if (backend_mock_state.send_retval == 0) {
		backend_mock_state.send_count++;
		LOG_DBG("Mock backend send: channel=%s, size=%u, count=%u", msg->channel_name,
			msg->message_size, backend_mock_state.send_count);
	} else {
		LOG_DBG("Mock backend send failing with %d", backend_mock_state.send_retval);
	}
	return backend_mock_state.send_retval;
}

static int zbus_proxy_agent_mock_backend_set_recv_cb(const struct zbus_proxy_agent *agent_config,
						     zbus_proxy_agent_recv_cb_t recv_cb)
{
	if (backend_mock_state.set_recv_cb_retval != 0) {
		LOG_DBG("Mock backend set_recv_cb failing with %d",
			backend_mock_state.set_recv_cb_retval);
		return backend_mock_state.set_recv_cb_retval;
	}

	_ZBUS_ASSERT(recv_cb != NULL, "Receive callback is NULL in set_recv_cb for MOCK backend");

	const struct zbus_proxy_agent_mock_config *mock_config =
		(const struct zbus_proxy_agent_mock_config *)agent_config->backend_config;

	_ZBUS_ASSERT(mock_config->data != NULL, "Mock backend data is NULL in set_recv_cb");

	mock_config->data->recv_cb = recv_cb;
	mock_config->data->recv_cb_config_ptr = agent_config;

	LOG_DBG("Mock backend set_recv_cb success");
	return 0;
}

const struct zbus_proxy_agent_backend_api zbus_proxy_agent_mock_backend_api = {
	.backend_init = zbus_proxy_agent_mock_backend_init,
	.backend_send = zbus_proxy_agent_mock_backend_send,
	.backend_set_recv_cb = zbus_proxy_agent_mock_backend_set_recv_cb,
};
```

## src/zbus_proxy_agent_mock.h
```c
/*
 * Copyright (c) 2026 Nordic Semiconductor ASA
 *
 * SPDX-License-Identifier: Apache-2.0
 */

#ifndef ZEPHYR_INCLUDE_ZBUS_PROXY_AGENT_MOCK_H_
#define ZEPHYR_INCLUDE_ZBUS_PROXY_AGENT_MOCK_H_

#include <zephyr/kernel.h>
#include <zephyr/zbus/proxy_agent/zbus_proxy_agent.h>

struct zbus_proxy_agent_mock_config {
	/* Name of the mock proxy agent, used to validate config generation */
	char name[20];

	/* Pointer to mutable mock backend runtime data */
	struct zbus_proxy_agent_mock_data *data;
};

struct zbus_proxy_agent_mock_data {
	/* Callback function for simulating received messages in tests */
	zbus_proxy_agent_recv_cb_t recv_cb;
	/* pointer to proxy agent config, used as user data for the receive callback */
	const struct zbus_proxy_agent *recv_cb_config_ptr;
};

enum zbus_proxy_agent_backend_test_type {
	ZBUS_PROXY_AGENT_MOCK = 99
};

/* Helper functions */
void mock_backend_reset(void);
void mock_backend_set_init_retval(int retval);
void mock_backend_set_send_retval(int retval);
void mock_backend_set_set_recv_cb_retval(int retval);
uint32_t mock_backend_get_send_count(void);
int mock_backend_trigger_receive(const struct zbus_proxy_agent *config, struct zbus_proxy_msg *msg);

/* backend config creation for MOCK type */
#define _ZBUS_PROXY_AGENT_BACKEND_CONFIG_DEFINE_ZBUS_PROXY_AGENT_MOCK(_name, _backend_dt_node)     \
	static struct zbus_proxy_agent_mock_data _name##_mock_data;                                \
	static struct zbus_proxy_agent_mock_config _name##_mock_config = {                         \
		.name = STRINGIFY(_name), .data = &_name##_mock_data,                              \
	};

/* backend config getter for MOCK type */
#define _ZBUS_PROXY_AGENT_GET_BACKEND_CONFIG_ZBUS_PROXY_AGENT_MOCK(_name) (&_name##_mock_config)

/* Forward declaration and backend API getter for MOCK type */
extern const struct zbus_proxy_agent_backend_api zbus_proxy_agent_mock_backend_api;

#define _ZBUS_PROXY_AGENT_GET_BACKEND_API_ZBUS_PROXY_AGENT_MOCK (&zbus_proxy_agent_mock_backend_api)

#endif /* ZEPHYR_INCLUDE_ZBUS_PROXY_AGENT_MOCK_H_ */
```
