/*
 * Copyright (c) 2025 Nordic Semiconductor ASA
 *
 * SPDX-License-Identifier: Apache-2.0
 */

/ {
	euart0: uart-emul0 {
		compatible = "zephyr,uart-emul";
		status = "okay";
		current-speed = <0>;
		rx-fifo-size = <256>;
		tx-fifo-size = <256>;
	};
	euart1: uart-emul1 {
		compatible = "zephyr,uart-emul";
		status = "okay";
		current-speed = <0>;
		rx-fifo-size = <512>;
		tx-fifo-size = <512>;
	};
};
