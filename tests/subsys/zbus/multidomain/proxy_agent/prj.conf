## CMakeLists.txt
```
#
# Copyright (c) 2025 Nordic Semiconductor ASA
#
# SPDX-License-Identifier: Apache-2.0
#

cmake_minimum_required(VERSION 3.20.0)

find_package(Zephyr REQUIRED HINTS $ENV{ZEPHYR_BASE})
project(test_channel_name)

FILE(GLOB app_sources src/main.c src/zbus_multidomain_mock_backend.c)
target_sources(app PRIVATE ${app_sources})
```

## prj.conf
```kconfig
#
# Copyright (c) 2025 Nordic Semiconductor ASA
#
# SPDX-License-Identifier: Apache-2.0
#

CONFIG_LOG=y
CONFIG_CRC=y
CONFIG_ZBUS=y
CONFIG_ZBUS_CHANNEL_NAME=y
CONFIG_ZBUS_MSG_SUBSCRIBER=y

CONFIG_ZBUS_MULTIDOMAIN=y
CONFIG_ZBUS_MULTIDOMAIN_LOG_LEVEL_INF=y
CONFIG_ZBUS_MULTIDOMAIN_SENT_MSG_ACK_TIMEOUT=10
CONFIG_ZBUS_MULTIDOMAIN_SENT_MSG_ACK_TIMEOUT_MAX=100
CONFIG_ZBUS_MULTIDOMAIN_MAX_TRANSMIT_ATTEMPTS=5
CONFIG_ZBUS_MULTIDOMAIN_SENT_MSG_POOL_SIZE=8

CONFIG_ZTEST=y
CONFIG_ASSERT=n
CONFIG_ZTEST_MOCKING=y

CONFIG_MAIN_STACK_SIZE=2048
CONFIG_ZBUS_MULTIDOMAIN_PROXY_STACK_SIZE=2048
```

## boards/qemu_cortex_a53_qemu_cortex_a53_smp.conf
```kconfig
#
# Copyright (c) 2025 Nordic Semiconductor ASA
#
# SPDX-License-Identifier: Apache-2.0
#

# Necessary to enable QEMU ICOUNT support for tests to complete on qemu_cortex_a53
CONFIG_QEMU_ICOUNT=y
```

## boards/qemu_riscv32_qemu_virt_riscv32_smp.conf
```kconfig
#
# Copyright (c) 2025 Nordic Semiconductor ASA
#
# SPDX-License-Identifier: Apache-2.0
#

# Necessary to enable QEMU ICOUNT support for tests to complete on qemu_riscv32
CONFIG_QEMU_ICOUNT=y
```

## boards/qemu_riscv64_qemu_virt_riscv64_smp.conf
```kconfig
#
# Copyright (c) 2025 Nordic Semiconductor ASA
#
# SPDX-License-Identifier: Apache-2.0
#

# Necessary to enable QEMU ICOUNT support for tests to complete on qemu_riscv64
CONFIG_QEMU_ICOUNT=y
```

## boards/qemu_x86_64_atom.conf
```kconfig
#
# Copyright (c) 2025 Nordic Semiconductor ASA
#
# SPDX-License-Identifier: Apache-2.0
#

# Necessary to enable QEMU ICOUNT support for tests to complete on qemu_x86_64
CONFIG_QEMU_ICOUNT=y
CONFIG_QEMU_ICOUNT_SHIFT=6
```

## src/main.c
```c
/*
 * Copyright (c) 2025 Nordic Semiconductor ASA
 *
 * SPDX-License-Identifier: Apache-2.0
 */

#include <zephyr/zbus/zbus.h>
#include <zephyr/ztest.h>
#include <zephyr/fff.h>

#include "zbus_multidomain_mock_backend.h"
#include <zephyr/zbus/multidomain/zbus_multidomain.h>

/* Define test channels */
ZBUS_CHAN_DEFINE(test_channel_1, uint32_t, NULL, NULL, ZBUS_OBSERVERS_EMPTY, ZBUS_MSG_INIT(0));
ZBUS_CHAN_DEFINE(test_channel_2, uint32_t, NULL, NULL, ZBUS_OBSERVERS_EMPTY, ZBUS_MSG_INIT(0));

/* Define shadow channels for receiving tests */
ZBUS_SHADOW_CHAN_DEFINE(test_shadow_channel_1, uint32_t, NULL, NULL, ZBUS_OBSERVERS_EMPTY,
			ZBUS_MSG_INIT(0));
ZBUS_SHADOW_CHAN_DEFINE(test_shadow_channel_2, uint32_t, NULL, NULL, ZBUS_OBSERVERS_EMPTY,
			ZBUS_MSG_INIT(0));

/* Channel for max size testing */
typedef struct {
	uint8_t data[CONFIG_ZBUS_MULTIDOMAIN_MESSAGE_SIZE];
} max_size_msg_t;
ZBUS_CHAN_DEFINE(test_max_size_channel, max_size_msg_t, NULL, NULL, ZBUS_OBSERVERS_EMPTY,
		 ZBUS_MSG_INIT({}));

/* Define the proxy agent using the mock backend */
ZBUS_PROXY_AGENT_DEFINE(test_proxy_agent, ZBUS_MULTIDOMAIN_TYPE_MOCK, "test_mock_backend");

/* Add channels to the proxy agent */
ZBUS_PROXY_ADD_CHANNEL(test_proxy_agent, test_channel_1);
ZBUS_PROXY_ADD_CHANNEL(test_proxy_agent, test_channel_2);
ZBUS_PROXY_ADD_CHANNEL(test_proxy_agent, test_max_size_channel);

/* Global variables for tracking received messages in tests */
static bool message_received;
static const struct zbus_channel *last_published_channel;

/* Observer callback to track shadow channel publications */
static void test_shadow_channel_observer_cb(const struct zbus_channel *chan)
{
	last_published_channel = chan;
	message_received = true;
}

/* Define observer for shadow channels */
ZBUS_LISTENER_DEFINE(test_shadow_observer, test_shadow_channel_observer_cb);

/* Add observer to shadow channels */
ZBUS_CHAN_ADD_OBS(test_shadow_channel_1, test_shadow_observer, 3);
ZBUS_CHAN_ADD_OBS(test_shadow_channel_2, test_shadow_observer, 3);

int get_total_timeout(int attempts)
{
	int total = 0;

	for (int i = 0; i < attempts; i++) {
		int timeout = CONFIG_ZBUS_MULTIDOMAIN_SENT_MSG_ACK_TIMEOUT << i;

		if (timeout > CONFIG_ZBUS_MULTIDOMAIN_SENT_MSG_ACK_TIMEOUT_MAX) {
			timeout = CONFIG_ZBUS_MULTIDOMAIN_SENT_MSG_ACK_TIMEOUT_MAX;
		}
		total += timeout;
	}
	return total;
}

ZTEST(proxy_agent_test, test_proxy_agent_creation)
{
	extern struct zbus_proxy_agent_config test_proxy_agent_config;

	zassert_not_null(&test_proxy_agent_config, "Proxy agent config should exist");
	zassert_str_equal(test_proxy_agent_config.name, "test_proxy_agent", "Name should match");
	zassert_equal((int)test_proxy_agent_config.type, (int)ZBUS_MULTIDOMAIN_TYPE_MOCK,
		      "Type should be MOCK");
	zassert_not_null(test_proxy_agent_config.api, "API should not be NULL");
	zassert_not_null(test_proxy_agent_config.backend_config,
			 "Backend config should not be NULL");
	zassert_not_null(test_proxy_agent_config.sent_msg_pool, "Sent msg pool should not be NULL");
}

ZTEST(proxy_agent_test, test_proxy_agent_initialization)
{
	extern struct zbus_proxy_agent_config test_proxy_agent_config;
	extern const struct zbus_observer test_proxy_agent_subscriber;

	/* Test that the proxy agent was created with correct configuration */
	zassert_not_null(&test_proxy_agent_config, "Config should exist");
	zassert_not_null(&test_proxy_agent_subscriber, "Subscriber should exist");

	/* Verify that the API structure is properly set up */
	zassert_not_null(test_proxy_agent_config.api, "API should not be NULL");
	zassert_not_null(test_proxy_agent_config.api->backend_init,
			 "Backend init should not be NULL");
	zassert_not_null(test_proxy_agent_config.api->backend_send,
			 "Backend send should not be NULL");
	zassert_not_null(test_proxy_agent_config.api->backend_set_recv_cb,
			 "Set recv CB should not be NULL");
	zassert_not_null(test_proxy_agent_config.api->backend_set_ack_cb,
			 "Set ack CB should not be NULL");

	/* Test that the API functions can be called */
	int ret = test_proxy_agent_config.api->backend_init(test_proxy_agent_config.backend_config);

	zassert_equal(ret, 0, "Mock backend init should return 0");
}

ZTEST(proxy_agent_test, test_message_forwarding)
{
	uint32_t test_data = 0x12345678U;

	zbus_chan_pub(&test_channel_1, &test_data, K_MSEC(100));
	k_sleep(K_MSEC(1));

	/* Verify the backend send was called */
	zassert_true(mock_backend_send_fake.call_count == 1,
		     "Backend send should be called at least once");

	/* Verify the sent message content */
	if (mock_backend_send_fake.call_count > 0) {
		struct zbus_proxy_agent_msg *sent_msg = mock_backend_get_last_sent_message();

		zassert_not_null(sent_msg, "Sent message should not be NULL");
		zassert_equal(sent_msg->type, ZBUS_PROXY_AGENT_MSG_TYPE_MSG,
			      "Message type should be MSG");
		zassert_str_equal(sent_msg->channel_name, "test_channel_1",
				  "Channel name should match");
	}
}

ZTEST(proxy_agent_test, test_multiple_channels)
{
	uint32_t test_data1 = 0xAABBCCDDU;
	uint32_t test_data2 = 0x11223344U;

	zbus_chan_pub(&test_channel_1, &test_data1, K_MSEC(100));
	zbus_chan_pub(&test_channel_2, &test_data2, K_MSEC(100));
	k_sleep(K_MSEC(1));

	zassert_true(mock_backend_send_fake.call_count == 2,
		     "Should send messages for both channels");
}

ZTEST(proxy_agent_test, test_retransmission_timeout)
{
	/* Disable auto-ACK for this test to observe retransmissions */
	mock_backend_set_auto_ack(false);

	size_t initial_send_count = mock_backend_send_fake.call_count;

	uint32_t test_data = 0xDEADBEEFU;

	zbus_chan_pub(&test_channel_1, &test_data, K_MSEC(100));
	k_sleep(K_MSEC(1));

	zassert_true(mock_backend_send_fake.call_count > initial_send_count,
		     "Message should be sent initially");

	size_t first_send_count = mock_backend_send_fake.call_count;

	/* Wait for retransmission timeout */
	k_sleep(K_MSEC(get_total_timeout(2) - 1));

	zassert_true(mock_backend_send_fake.call_count > first_send_count,
		     "Message should be retransmitted after timeout");
}

ZTEST(proxy_agent_test, test_ack_stops_retransmission)
{
	/* Disable auto-ACK initially to test manual ACK behavior */
	mock_backend_set_auto_ack(false);

	size_t initial_send_count = mock_backend_send_fake.call_count;
	uint32_t test_data = 0xACEACE00U;

	zbus_chan_pub(&test_channel_1, &test_data, K_MSEC(100));
	k_sleep(K_MSEC(1));

	zassert_true(mock_backend_send_fake.call_count > initial_send_count,
		     "Message should be sent initially");

	/* Get the message ID from the copied message to avoid use-after-scope */
	struct zbus_proxy_agent_msg *sent_msg = mock_backend_get_last_sent_message();

	zassert_not_null(sent_msg, "Sent message should not be NULL");

	uint32_t msg_id = sent_msg->id;
	size_t send_count_after_first = mock_backend_send_fake.call_count;

	/* Simulate receiving an ACK for the message using the stored callback from backend */
	if (mock_backend_stored_ack_cb) {
		mock_backend_stored_ack_cb(msg_id, mock_backend_stored_ack_user_data);
	}

	printk("Sleeping to check no retransmission after ACK\n");
	/* Wait longer than retransmission timeout */
	k_sleep(K_MSEC(get_total_timeout(2) - 1));

	zassert_equal(mock_backend_send_fake.call_count, send_count_after_first,
		      "No retransmissions should occur after ACK received");
}

ZTEST(proxy_agent_test, test_max_retransmission_attempts)
{
	/* Disable auto-ACK for this test to observe max retransmission behavior */
	mock_backend_set_auto_ack(false);

	size_t initial_send_count = mock_backend_send_fake.call_count;
	uint32_t test_data = 0xDEADBEADU;

	zbus_chan_pub(&test_channel_1, &test_data, K_MSEC(100));
	k_sleep(K_MSEC(1));

	zassert_true(mock_backend_send_fake.call_count > initial_send_count,
		     "Message should be sent initially");

	k_sleep(K_MSEC(get_total_timeout(CONFIG_ZBUS_MULTIDOMAIN_MAX_TRANSMIT_ATTEMPTS) + 10));

	/* Verify that the number of sends matches max attempts (5 total sends) */
	size_t final_send_count = mock_backend_send_fake.call_count;

	zassert_equal(final_send_count,
		      initial_send_count + CONFIG_ZBUS_MULTIDOMAIN_MAX_TRANSMIT_ATTEMPTS,
		      "Should have exactly max retransmission attempts (5 total sends)");

	k_sleep(K_MSEC(get_total_timeout(CONFIG_ZBUS_MULTIDOMAIN_MAX_TRANSMIT_ATTEMPTS)));

	zassert_equal(mock_backend_send_fake.call_count, final_send_count,
		      "Retransmissions should eventually stop after max attempts");
}

ZTEST(proxy_agent_test, test_message_content_in_retransmissions)
{
	/* Disable auto-ACK for this test to observe retransmissions */
	mock_backend_set_auto_ack(false);

	size_t initial_send_count = mock_backend_send_fake.call_count;
	uint32_t test_data = 0x12345678U;

	printk("Send count: %u\n", mock_backend_send_fake.call_count);

	zbus_chan_pub(&test_channel_1, &test_data, K_MSEC(100));

	k_sleep(K_MSEC(get_total_timeout(2) - 1));

	/* Verify multiple sends occurred */
	printk("Send count: %u\n", mock_backend_send_fake.call_count);
	zassert_true(mock_backend_send_fake.call_count >= initial_send_count + 1,
		     "At least initial send + 1 retransmission should occur, "
		     "initial_send_count=%u, send_count=%u",
		     initial_send_count, mock_backend_send_fake.call_count);

	/* Verify the content */
	struct zbus_proxy_agent_msg *last_sent_msg = mock_backend_get_last_sent_message();

	zassert_not_null(last_sent_msg, "Last sent message should not be NULL");
	zassert_equal(last_sent_msg->type, ZBUS_PROXY_AGENT_MSG_TYPE_MSG,
		      "Should be a data message");
	zassert_str_equal(last_sent_msg->channel_name, "test_channel_1",
			  "Channel name should match");

	/* Verify message data */
	uint32_t received_data;

	memcpy(&received_data, last_sent_msg->message_data, sizeof(received_data));

	zassert_equal(received_data, test_data, "Message data should match original");
}

ZTEST(proxy_agent_test, test_backend_send_failure_cleanup)
{
	/* Configure backend to fail on send */
	mock_backend_send_fake.return_val = -EIO;

	size_t initial_count = mock_backend_send_fake.call_count;
	uint32_t test_data = 0xFADEU;

	zbus_chan_pub(&test_channel_1, &test_data, K_MSEC(100));

	k_sleep(K_MSEC(1));

	/* Verify backend was called but failed */
	zassert_true(mock_backend_send_fake.call_count > initial_count,
		     "Backend send should be attempted");

	/* Restore normal behavior */
	mock_backend_send_fake.return_val = 0;

	/* Verify system continues working after failure */
	size_t count_before_recovery = mock_backend_send_fake.call_count;
	uint32_t recovery_data = 0xC0FFEEU;

	zbus_chan_pub(&test_channel_1, &recovery_data, K_MSEC(100));
	k_sleep(K_MSEC(1));

	zassert_true(mock_backend_send_fake.call_count > count_before_recovery,
		     "System should recover and send new messages after backend failure");
}

ZTEST(proxy_agent_test, test_concurrent_messages)
{
	/* Send multiple messages rapidly */
	for (int i = 0; i < 3; i++) {
		uint32_t test_data = 0x1000 + i;

		zbus_chan_pub(&test_channel_1, &test_data, K_NO_WAIT);
	}

	k_sleep(K_MSEC(20));

	zassert_true(mock_backend_send_fake.call_count == 3,
		     "All concurrent messages should be sent, count=%u",
		     mock_backend_send_fake.call_count);
}

ZTEST(proxy_agent_test, test_pool_exhaustion_recovery)
{
	mock_backend_set_auto_ack(false);

	/* Fill the message pool */
	for (int i = 0; i < CONFIG_ZBUS_MULTIDOMAIN_SENT_MSG_POOL_SIZE + 2; i++) {
		uint32_t test_data = 0x2000 + i;

		zbus_chan_pub(&test_channel_1, &test_data, K_NO_WAIT);
		k_sleep(K_MSEC(1)); /* Small delay between messages */
	}
	k_sleep(K_MSEC(get_total_timeout(2)));

	printk("Send count after pool exhaustion: %u\n", mock_backend_send_fake.call_count);
	zassert_true(mock_backend_send_fake.call_count >= 10,
		     "Multiple messages should be sent even with pool pressure");

	/* Re-enable auto-ACK to clear pool */
	mock_backend_set_auto_ack(true);
	/* Wait enough time for all messages to be ACKed and pool to recover */
	k_sleep(K_MSEC(get_total_timeout(CONFIG_ZBUS_MULTIDOMAIN_MAX_TRANSMIT_ATTEMPTS) + 20));

	/* Reset counter to test recovery */
	RESET_FAKE(mock_backend_send);
	mock_backend_send_fake.return_val = 0;

	/* Verify normal operation resumes */
	uint32_t recovery_data = 0xEC08E7U;

	zbus_chan_pub(&test_channel_1, &recovery_data, K_MSEC(100));
	k_sleep(K_MSEC(1));

	printk("Send count after pool recovery: %u\n", mock_backend_send_fake.call_count);
	zassert_true(mock_backend_send_fake.call_count >= 1,
		     "Normal operation should resume after pool recovery");
}

ZTEST(proxy_agent_test, test_invalid_ack_message_id)
{
	/* Send ACK for non-existent message ID */
	if (mock_backend_stored_ack_cb) {
		uint32_t invalid_id = 0xDEADBEEFU;
		int ret = mock_backend_stored_ack_cb(invalid_id, mock_backend_stored_ack_user_data);

		zassert_equal(ret, -ENOENT, "ACK for invalid ID should return -ENOENT");
	}

	/* System should continue working normally after invalid ACK */
	uint32_t test_data = 0x87654321U;

	zbus_chan_pub(&test_channel_1, &test_data, K_MSEC(100));
	k_sleep(K_MSEC(1));

	zassert_true(mock_backend_send_fake.call_count >= 1,
		     "System should continue working after invalid ACK");
}

ZTEST(proxy_agent_test, test_duplicate_ack_handling)
{
	/* Disable auto-ACK for manual control */
	mock_backend_set_auto_ack(false);

	uint32_t test_data = 0xDCDE1234U;

	zbus_chan_pub(&test_channel_1, &test_data, K_MSEC(100));
	k_sleep(K_MSEC(1));

	zassert_true(mock_backend_send_fake.call_count >= 1, "Message should be sent");

	/* Get the message ID from the copied message to avoid use-after-scope */
	struct zbus_proxy_agent_msg *sent_msg = mock_backend_get_last_sent_message();

	zassert_not_null(sent_msg, "Sent message should not be NULL");
	uint32_t msg_id = sent_msg->id;

	/* Send duplicate ACKs manually */
	mock_backend_send_duplicate_ack(msg_id);

	/* Verify no retransmissions occur after first ACK */
	size_t count_after_acks = mock_backend_send_fake.call_count;

	k_sleep(K_MSEC(get_total_timeout(2) - 1));

	zassert_equal(mock_backend_send_fake.call_count, count_after_acks,
		      "No retransmissions should occur after duplicate ACKs");
}

ZTEST(proxy_agent_test, test_message_size_edge_cases)
{
	max_size_msg_t max_data;

	memset(&max_data, 0xAB, sizeof(max_data));

	/* Publish maximum size message */
	zbus_chan_pub(&test_max_size_channel, &max_data, K_MSEC(100));
	k_sleep(K_MSEC(1));

	zassert_true(mock_backend_send_fake.call_count >= 1, "Should send maximum size message");

	if (mock_backend_send_fake.call_count > 0) {
		struct zbus_proxy_agent_msg *sent_msg = mock_backend_get_last_sent_message();

		zassert_not_null(sent_msg, "Sent message should not be NULL");
		zassert_equal(sent_msg->message_size, sizeof(max_size_msg_t),
			      "Message size should be maximum");
		zassert_mem_equal(sent_msg->message_data, &max_data, sent_msg->message_size,
				  "Message data should match");
	}
}

ZTEST(proxy_agent_test, test_backend_initialization_failure)
{
	/* Configure backend init to fail */
	mock_backend_init_fake.return_val = -ENODEV;

	extern struct zbus_proxy_agent_config test_proxy_agent_config;

	/* Call init directly to test failure handling */
	int ret = test_proxy_agent_config.api->backend_init(test_proxy_agent_config.backend_config);

	zassert_equal(ret, -ENODEV, "Backend init should fail with -ENODEV");

	/* Restore normal behavior */
	mock_backend_init_fake.return_val = 0;
}

ZTEST(proxy_agent_test, test_thread_safety_concurrent_publishing)
{
	/* Send messages from "different threads" rapidly with different data */
	for (int i = 0; i < 8; i++) {
		uint32_t data1 = 0x1000 + i;
		uint32_t data2 = 0x2000 + i;

		/* Simulate concurrent publishing */
		zbus_chan_pub(&test_channel_1, &data1, K_NO_WAIT);
		zbus_chan_pub(&test_channel_2, &data2, K_NO_WAIT);
		k_sleep(K_MSEC(1));
	}

	/* Give time for all messages to be processed */
	k_sleep(K_MSEC(10));

	zassert_true(mock_backend_send_fake.call_count >= 10,
		     "Should handle concurrent messages from multiple channels");
}

ZTEST(proxy_agent_test, test_message_receiving_basic)
{
	zassert_true(mock_backend_has_recv_callback(), "Receive callback should be stored");

	/* Create a message to simulate receiving from backend */
	struct zbus_proxy_agent_msg recv_msg;
	uint32_t test_data = 0xABCDEF00U;

	mock_backend_create_test_message(&recv_msg, "test_shadow_channel_1", &test_data,
					 sizeof(test_data));

	/* Simulate receiving the message via callback */
	int ret = mock_backend_get_stored_recv_cb()(&recv_msg);

	zassert_equal(ret, 0, "Receive callback should succeed");

	zassert_true(message_received, "Message should be received on shadow channel");
	zassert_not_null(last_published_channel, "Published channel should be tracked");
	zassert_str_equal(last_published_channel->name, "test_shadow_channel_1",
			  "Should publish to correct shadow channel");
}

ZTEST(proxy_agent_test, test_message_receiving_unknown_channel)
{
	zassert_true(mock_backend_has_recv_callback(), "Receive callback should be stored");

	/* Create a message for unknown channel */
	struct zbus_proxy_agent_msg recv_msg;
	uint32_t test_data = 0xDEADBEEFU;

	mock_backend_create_test_message(&recv_msg, "unknown_channel", &test_data,
					 sizeof(test_data));

	/* Simulate receiving the message via callback */
	int ret = mock_backend_get_stored_recv_cb()(&recv_msg);

	zassert_equal(ret, -ENOENT, "Should fail for unknown channel");

	zassert_false(message_received, "No message should be received for unknown channel");
}

ZTEST(proxy_agent_test, test_message_receiving_non_shadow_channel)
{
	zassert_true(mock_backend_has_recv_callback(), "Receive callback should be stored");

	/* Create a message for regular (non-shadow) channel */
	struct zbus_proxy_agent_msg recv_msg;
	uint32_t test_data = 0xCAFEBABEU;

	mock_backend_create_test_message(&recv_msg, "test_channel_1", &test_data,
					 sizeof(test_data));

	/* Simulate receiving the message via callback */
	int ret = mock_backend_get_stored_recv_cb()(&recv_msg);

	zassert_equal(ret, -EPERM, "Should fail for non-shadow channel");

	zassert_false(message_received, "No message should be received for non-shadow channel");
}

ZTEST(proxy_agent_test, test_message_receiving_null_message)
{
	zassert_true(mock_backend_has_recv_callback(), "Receive callback should be stored");

	int ret = mock_backend_get_stored_recv_cb()(NULL);

	zassert_equal(ret, -EINVAL, "Should fail for NULL message");
}

ZTEST(proxy_agent_test, test_message_receiving_max_size)
{
	zassert_true(mock_backend_has_recv_callback(), "Receive callback should be stored");

	struct zbus_proxy_agent_msg recv_msg;
	uint8_t pattern_data[CONFIG_ZBUS_MULTIDOMAIN_MESSAGE_SIZE];

	for (size_t i = 0; i < sizeof(pattern_data); i++) {
		pattern_data[i] = (uint8_t)(i & 0xFF);
	}

	mock_backend_create_test_message(&recv_msg, "test_shadow_channel_2", pattern_data,
					 sizeof(pattern_data));

	/* Simulate receiving the message via callback */
	int ret = mock_backend_get_stored_recv_cb()(&recv_msg);

	zassert_equal(ret, 0, "Should handle maximum size message");

	zassert_true(message_received, "Max size message should be received on shadow channel");
	zassert_not_null(last_published_channel, "Published channel should be tracked");
	zassert_str_equal(last_published_channel->name, "test_shadow_channel_2",
			  "Should publish to correct shadow channel");
}

static void test_setup(void *fixture)
{
	RESET_FAKE(mock_backend_init);
	RESET_FAKE(mock_backend_send);
	RESET_FAKE(mock_backend_set_recv_cb);
	RESET_FAKE(mock_backend_set_ack_cb);

	mock_backend_init_fake.return_val = 0;
	mock_backend_send_fake.return_val = 0;
	mock_backend_set_recv_cb_fake.return_val = 0;
	mock_backend_set_ack_cb_fake.return_val = 0;
	message_received = false;
	last_published_channel = NULL;

	mock_backend_set_auto_ack(true);
}

static void test_teardown(void *fixture)
{
	/* Re-enable auto-ACK to clear any pending messages */
	mock_backend_set_auto_ack(true);

	/* Wait long enough for all messages to either be ACK'd or reach max attempts */
	k_sleep(K_MSEC(get_total_timeout(CONFIG_ZBUS_MULTIDOMAIN_MAX_TRANSMIT_ATTEMPTS + 1)));

	RESET_FAKE(mock_backend_init);
	RESET_FAKE(mock_backend_send);
	RESET_FAKE(mock_backend_set_recv_cb);
	RESET_FAKE(mock_backend_set_ack_cb);
}

ZTEST_SUITE(proxy_agent_test, NULL, NULL, test_setup, test_teardown, NULL);
```

## src/zbus_multidomain_mock_backend.c
```c
/*
 * Copyright (c) 2025 Nordic Semiconductor ASA
 *
 * SPDX-License-Identifier: Apache-2.0
 */

#include "zbus_multidomain_mock_backend.h"
#include <zephyr/kernel.h>
#include <zephyr/logging/log.h>

LOG_MODULE_REGISTER(mock_backend, LOG_LEVEL_DBG);

/* Define FFF globals */
DEFINE_FFF_GLOBALS;

/* Define fake function instances */
DEFINE_FAKE_VALUE_FUNC1(int, mock_backend_init, void *);
DEFINE_FAKE_VALUE_FUNC2(int, mock_backend_send, void *, struct zbus_proxy_agent_msg *);
DEFINE_FAKE_VALUE_FUNC2(int, mock_backend_set_recv_cb, void *, zbus_recv_cb_t);
DEFINE_FAKE_VALUE_FUNC3(int, mock_backend_set_ack_cb, void *, zbus_ack_cb_t, void *);

/* Global state for auto-ACK functionality */
bool mock_backend_auto_ack_enabled = true;
zbus_ack_cb_t mock_backend_stored_ack_cb;
void *mock_backend_stored_ack_user_data;

/* Global state for receive callback */
static zbus_recv_cb_t mock_backend_stored_recv_cb;

/* Store a copy of the last sent message to avoid use-after-scope issues */
static struct zbus_proxy_agent_msg last_sent_msg_copy;
static bool last_sent_msg_valid;

/* Custom send implementation that provides auto-ACK */
int mock_backend_send_with_auto_ack(void *config, struct zbus_proxy_agent_msg *msg)
{
	/* Create a copy of the message to avoid use-after-scope issues */
	if (msg) {
		memcpy(&last_sent_msg_copy, msg, sizeof(last_sent_msg_copy));
		last_sent_msg_valid = true;
	}

	LOG_DBG("Mock backend: Sending message ID %u on channel '%s'", msg ? msg->id : 0,
		msg ? msg->channel_name : "NULL");

	int ret = mock_backend_send(config, msg);

	/* If auto-ACK is enabled and ACK callback is stored, send ACK immediately */
	if (mock_backend_auto_ack_enabled && mock_backend_stored_ack_cb && msg) {
		LOG_DBG("Auto-ACK: Sending immediate ACK for message ID %u", msg->id);
		int ack_ret;

		ack_ret = mock_backend_stored_ack_cb(msg->id, mock_backend_stored_ack_user_data);
		LOG_DBG("Auto-ACK: ACK callback returned %d", ack_ret);
	}

	return ret;
}

/* Custom ACK callback setter that stores the callback for auto-ACK use */
int mock_backend_set_ack_cb_with_storage(void *config, zbus_ack_cb_t ack_cb, void *user_data)
{
	/* Store the callback and user data for auto-ACK functionality */
	mock_backend_stored_ack_cb = ack_cb;
	mock_backend_stored_ack_user_data = user_data;

	LOG_DBG("Mock backend: Stored ACK callback %p with user data %p", ack_cb, user_data);

	return mock_backend_set_ack_cb(config, ack_cb, user_data);
}

/* Helper function to enable/disable auto-ACK */
void mock_backend_set_auto_ack(bool enabled)
{
	mock_backend_auto_ack_enabled = enabled;
	LOG_DBG("Mock backend: Auto-ACK %s", enabled ? "enabled" : "disabled");
}

/* Helper function to manually send duplicate ACKs for testing */
void mock_backend_send_duplicate_ack(uint32_t msg_id)
{
	if (mock_backend_stored_ack_cb) {
		mock_backend_stored_ack_cb(msg_id, mock_backend_stored_ack_user_data);

		k_sleep(K_MSEC(1));

		mock_backend_stored_ack_cb(msg_id, mock_backend_stored_ack_user_data);
	}
}

/* Custom receive callback setter that stores the callback */
int mock_backend_set_recv_cb_with_storage(void *config, zbus_recv_cb_t recv_cb)
{
	if (!recv_cb) {
		LOG_ERR("Invalid receive callback pointer");
		return -EINVAL;
	}

	/* Store the callback for state management */
	mock_backend_stored_recv_cb = recv_cb;

	LOG_DBG("Mock backend: Stored receive callback %p", recv_cb);

	return mock_backend_set_recv_cb(config, recv_cb);
}

/* Mock state management functions */
zbus_recv_cb_t mock_backend_get_stored_recv_cb(void)
{
	return mock_backend_stored_recv_cb;
}

void mock_backend_reset_callbacks(void)
{
	mock_backend_stored_recv_cb = NULL;
	mock_backend_stored_ack_cb = NULL;
	mock_backend_stored_ack_user_data = NULL;
	last_sent_msg_valid = false;
	LOG_DBG("Mock backend: All callbacks reset");
}

bool mock_backend_has_recv_callback(void)
{
	return mock_backend_stored_recv_cb;
}

/* Get the copied message to avoid use-after-scope issues */
struct zbus_proxy_agent_msg *mock_backend_get_last_sent_message(void)
{
	return last_sent_msg_valid ? &last_sent_msg_copy : NULL;
}

/* Test helper function to create messages */
void mock_backend_create_test_message(struct zbus_proxy_agent_msg *msg, const char *channel_name,
				      const void *data, size_t data_size)
{
	if (!msg) {
		LOG_ERR("Invalid message pointer");
		return;
	}

	if (!channel_name || strlen(channel_name) == 0) {
		LOG_ERR("Invalid channel name");
		return;
	}

	if (!data && data_size > 0) {
		LOG_ERR("Invalid data pointer with non-zero size");
		return;
	}

	if (data_size > sizeof(msg->message_data)) {
		LOG_ERR("Data size %zu exceeds maximum %zu", data_size, sizeof(msg->message_data));
		return;
	}

	if (strlen(channel_name) >= sizeof(msg->channel_name)) {
		LOG_ERR("Channel name too long: %zu >= %zu", strlen(channel_name),
			sizeof(msg->channel_name));
		return;
	}

	memset(msg, 0, sizeof(*msg));
	msg->type = ZBUS_PROXY_AGENT_MSG_TYPE_MSG;
	msg->id = k_cycle_get_32();
	msg->message_size = data_size;

	if (data_size > 0) {
		memcpy(msg->message_data, data, data_size);
	}

	msg->channel_name_len = strlen(channel_name);
	strncpy(msg->channel_name, channel_name, sizeof(msg->channel_name) - 1);
	msg->channel_name[sizeof(msg->channel_name) - 1] = '\0';

	LOG_DBG("Created test message for channel '%s' with %zu bytes", channel_name, data_size);
}
```

## src/zbus_multidomain_mock_backend.h
```c
/*
 * Copyright (c) 2025 Nordic Semiconductor ASA
 *
 * SPDX-License-Identifier: Apache-2.0
 */

#ifndef ZBUS_MULTIDOMAIN_MOCK_BACKEND_H_
#define ZBUS_MULTIDOMAIN_MOCK_BACKEND_H_

#include <zephyr/kernel.h>
#include <zephyr/fff.h>
#include <zephyr/zbus/multidomain/zbus_multidomain_types.h>

/* Define MOCK backend type as a simple token for macro concatenation */
enum test_zbus_multidomain_type {
	ZBUS_MULTIDOMAIN_TYPE_MOCK = 99
};

typedef int (*zbus_recv_cb_t)(const struct zbus_proxy_agent_msg *);
typedef int (*zbus_ack_cb_t)(uint32_t, void *);

/* Global state for auto-ACK functionality */
extern bool mock_backend_auto_ack_enabled;
extern zbus_ack_cb_t mock_backend_stored_ack_cb;
extern void *mock_backend_stored_ack_user_data;

DECLARE_FAKE_VALUE_FUNC1(int, mock_backend_init, void *);
DECLARE_FAKE_VALUE_FUNC2(int, mock_backend_send, void *, struct zbus_proxy_agent_msg *);
DECLARE_FAKE_VALUE_FUNC2(int, mock_backend_set_recv_cb, void *, zbus_recv_cb_t);
DECLARE_FAKE_VALUE_FUNC3(int, mock_backend_set_ack_cb, void *, zbus_ack_cb_t, void *);

/* Custom implementations for auto-ACK and callback storage */
int mock_backend_send_with_auto_ack(void *config, struct zbus_proxy_agent_msg *msg);
int mock_backend_set_ack_cb_with_storage(void *config, zbus_ack_cb_t ack_cb, void *user_data);
int mock_backend_set_recv_cb_with_storage(void *config, zbus_recv_cb_t recv_cb);

/* Helper to enable/disable auto-ACK */
void mock_backend_set_auto_ack(bool enabled);

/* Helper to manually send duplicate ACKs for testing */
void mock_backend_send_duplicate_ack(uint32_t msg_id);

/* Mock state management functions */
zbus_recv_cb_t mock_backend_get_stored_recv_cb(void);
void mock_backend_reset_callbacks(void);
bool mock_backend_has_recv_callback(void);

/* Test helper functions */
void mock_backend_create_test_message(struct zbus_proxy_agent_msg *msg, const char *channel_name,
				      const void *data, size_t data_size);

/* Get the copied message to avoid use-after-scope issues */
struct zbus_proxy_agent_msg *mock_backend_get_last_sent_message(void);

static struct zbus_proxy_agent_api mock_backend_api __attribute__((unused)) = {
	.backend_init = mock_backend_init,
	.backend_send = mock_backend_send_with_auto_ack,
	.backend_set_recv_cb = mock_backend_set_recv_cb_with_storage,
	.backend_set_ack_cb = mock_backend_set_ack_cb_with_storage,
};

struct zbus_multidomain_mock_config {
	char *nodeid;
};

/* Define the required macros for MOCK backend type */
#define _ZBUS_GENERATE_BACKEND_CONFIG_ZBUS_MULTIDOMAIN_TYPE_MOCK(_name, _nodeid)                   \
	static struct zbus_multidomain_mock_config _name##_backend_config = {.nodeid = _nodeid};

#define _ZBUS_GET_API_ZBUS_MULTIDOMAIN_TYPE_MOCK()         (&mock_backend_api)
#define _ZBUS_GET_CONFIG_ZBUS_MULTIDOMAIN_TYPE_MOCK(_name) ((void *)&_name##_backend_config)

#endif /* ZBUS_MULTIDOMAIN_MOCK_BACKEND_H_ */
```
