## tests/subsys/zbus/async_listeners/testcase.yaml
```yaml
tests:
  message_bus.zbus.async_listeners:
    tags: zbus
    integration_platforms:
      - qemu_x86
    platform_exclude:
      - qemu_leon3
    harness: console
    harness_config:
      type: one_line
      regex:
        - "^.*?E: could not deliver notification to observer . Error code -12"
```

## tests/subsys/zbus/dyn_channel/testcase.yaml
```yaml
tests:
  message_bus.zbus.dyn_channel.static_and_dynamic_channels:
    platform_exclude: fvp_base_revc_2xaemv8a/fvp_base_revc_2xaemv8a/smp/ns
    tags: zbus
    integration_platforms:
      - native_sim
```

## tests/subsys/zbus/hlp_priority_boost/testcase.yaml
```yaml
tests:
  message_bus.zbus.hlp_priority_boost:
    platform_exclude:
      - fvp_base_revc_2xaemv8a/fvp_base_revc_2xaemv8a/smp/ns
      # All Intel Audio DSP platforms have non-coherent cache
      # between CPUs. So the zbus_channel struct data goes
      # out-of-sync between CPUs with multiple producer and
      # consumer threads running concurrently on multiple CPUs,
      # resulting in bad pointer being used, e.g. passed to
      # memcpy(). So exclude these platforms from running in
      # twister as they are certain to fail.
      - intel_adsp/ace15_mtpm/sim
      - intel_adsp/ace15_mtpm
      - intel_adsp/ace20_lnl/sim
      - intel_adsp/ace20_lnl
      - intel_adsp/ace30/ptl/sim
      - intel_adsp/ace30/ptl
      - intel_adsp/cavs25/tgph
      - intel_adsp/cavs25
    tags: zbus
    integration_platforms:
      - native_sim
```

## tests/subsys/zbus/integration/testcase.yaml
```yaml
tests:
  message_bus.zbus.module_interaction_no_error:
    platform_exclude:
      - m2gl025_miv
      - qemu_cortex_a9
      - hifive_unleashed/fu540/e51
      - hifive_unleashed/fu540/u54
      - fvp_base_revc_2xaemv8a/fvp_base_revc_2xaemv8a/smp/ns
    tags: zbus
    integration_platforms:
      - native_sim
```

## tests/subsys/zbus/multidomain/ipc_backend/dts/bindings/fake-ipc.yaml
```yaml
description: Fake IPC backend for testing zbus multidomain

compatible: "fake-ipc"
```

## tests/subsys/zbus/multidomain/ipc_backend/testcase.yaml
```yaml
tests:
  message_bus.zbus.multidomain.ipc_backend:
    platform_exclude:
      - mps3/corstone300/fvp
      - mps3/corstone310/fvp
      - mps4/corstone315/fvp
      - mps4/corstone320/fvp
    tags: zbus
    integration_platforms:
      - native_sim
    harness: console
    harness_config:
      type: multi_line
      ordered: false
      regex:
        - ".* ACK callback not set, dropping ACK"
        - ".* Failed to process received ACK: -1"
        - ".* Received message with invalid CRC, dropping"
        - ".* Unknown message type: 99"
        - ".* No receive callback set for IPC endpoint ipc_ept_test_agent"
        - ".* Received empty data on IPC endpoint"
        - ".* Invalid message size: expected .*, got .*"
        - ".* Failed to process received message on IPC endpoint ipc_ept_test_agent: -1"
        - ".* Failed to send ACK message: -1"
        - ".* Failed to send ACK for message 3: -1"
        - ".* IPC error: Test error on endpoint ipc_ept_test_agent"
```

## tests/subsys/zbus/multidomain/proxy_agent/boards/qemu_riscv32_qemu_virt_riscv32_smp.conf
```kconfig
#
# Copyright (c) 2025 Nordic Semiconductor ASA
#
# SPDX-License-Identifier: Apache-2.0
#

# Necessary to enable QEMU ICOUNT support for tests to complete on qemu_riscv32
CONFIG_QEMU_ICOUNT=y
```

## tests/subsys/zbus/multidomain/proxy_agent/testcase.yaml
```yaml
tests:
  message_bus.zbus.multidomain.proxy_agent:
    platform_exclude:
      - m2gl025_miv
      - mps3/corstone300/fvp
      - mps3/corstone310/fvp
      - mps4/corstone315/fvp
      - mps4/corstone320/fvp
    tags: zbus
    timeout: 180
    integration_platforms:
      - native_sim
```

## tests/subsys/zbus/multidomain/uart_backend/testcase.yaml
```yaml
tests:
  message_bus.zbus.uart_backend:
    tags: zbus
    timeout: 180
    integration_platforms:
      - native_sim
    harness: console
    harness_config:
      type: multi_line
      ordered: false
      regex:
        - ".* ACK callback not set, dropping ACK"
        - ".* Failed to process received ACK: -1"
        - ".* Receive callback not set, dropping message"
        - ".* Received message with invalid CRC, dropping"
        - ".* Invalid message size: .*"
        - ".* Unknown message type: 99"
```

## tests/subsys/zbus/proxy_agent/ipc_backend/dts/bindings/fake-ipc.yaml
```yaml
description: Fake IPC backend for testing zbus proxy agent

compatible: "fake-ipc"
```

## tests/subsys/zbus/proxy_agent/ipc_backend/testcase.yaml
```yaml
tests:
  message_bus.zbus.proxy_agent.ipc_backend:
    tags: zbus
    integration_platforms:
      - native_sim
    platform_exclude:
      - nrf5340bsim/nrf5340/cpunet
    harness: console
    harness_config:
      type: multi_line
      ordered: false
      regex:
        - ".* IPC error: Test error message on endpoint test_ept"
```

## tests/subsys/zbus/proxy_agent/proxy_agent/dts/bindings/zephyr,zbus-proxy-agent-mock.yaml
```yaml
# Copyright (c) 2025 Nordic Semiconductor ASA
# SPDX-License-Identifier: Apache-2.0

description: Zbus proxy agent mock backend

compatible: "zephyr,zbus-proxy-agent-mock"

include: zephyr,zbus-proxy-agent-base.yaml
```

## tests/subsys/zbus/proxy_agent/proxy_agent/testcase.yaml
```yaml
tests:
  message_bus.zbus.proxy_agent.proxy_agent:
    tags: zbus
    timeout: 180
    integration_platforms:
      - native_sim
    platform_exclude:
      - mps3/corstone300/fvp
      - mps3/corstone310/fvp
      - mps4/corstone315/fvp
      - mps4/corstone320/fvp
    harness: console
    harness_config:
      type: multi_line
      ordered: false
      regex:
        - ".* Failed to send message via proxy agent .*"
        - ".* Sent message pool full, cannot track message ID .*"
        - ".* Unknown channel .*, cannot publish message"
        - ".* Channel .* is not a shadow channel for this proxy agent, cannot publish message"
        - ".* Received NACK for message ID .* remote processing failed"
```

## tests/subsys/zbus/proxy_agent/uart_backend/testcase.yaml
```yaml
common:
  tags:
    - zbus
    - proxy_agent
    - uart
  harness: ztest
  platform_allow:
    - native_sim
  extra_args: DTC_OVERLAY_FILE="app.overlay"

tests:
  subsys.zbus.proxy_agent.uart_backend: {}
```

## tests/subsys/zbus/publish_stats/testcase.yaml
```yaml
tests:
  message_bus.zbus.publish_stats:
    tags: zbus
    filter: not CONFIG_SMP
    integration_platforms:
      - native_sim
```

## tests/subsys/zbus/runtime_observers_registration/testcase.yaml
```yaml
tests:
  message_bus.zbus.runtime_obs_reg.add_and_remove_observers_dynamic_memory:
    tags: zbus
    integration_platforms:
      - native_sim
    extra_configs:
      - CONFIG_HEAP_MEM_POOL_SIZE=2048
  message_bus.zbus.runtime_obs_reg.add_and_remove_observers_static_memory:
    tags: zbus
    integration_platforms:
      - native_sim
    extra_configs:
      - CONFIG_ZBUS_RUNTIME_OBSERVERS_NODE_POOL_SIZE=6
```

## tests/subsys/zbus/shadow_channels/testcase.yaml
```yaml
tests:
  message_bus.zbus.shadow_channels:
    tags: zbus
    integration_platforms:
      - native_sim
```

## tests/subsys/zbus/unittests/testcase.yaml
```yaml
tests:
  message_bus.zbus.general_unittests:
    platform_exclude: fvp_base_revc_2xaemv8a//smp/ns
    tags: zbus
    integration_platforms:
      - native_sim
  message_bus.zbus.general_unittests.linker_generator:
    tags:
      - linker_generator
      - zbus
    platform_allow:
      - qemu_cortex_m3
    extra_configs:
      - CONFIG_CMAKE_LINKER_GENERATOR=y
  message_bus.zbus.general_unittests_without_priority_boost:
    platform_exclude: fvp_base_revc_2xaemv8a//smp/ns
    tags: zbus
    integration_platforms:
      - native_sim
    extra_configs:
      - CONFIG_ZBUS_PRIORITY_BOOST=n
```

## tests/subsys/zbus/user_data/testcase.yaml
```yaml
tests:
  message_bus.zbus.user_data.channel_user_data:
    platform_exclude: fvp_base_revc_2xaemv8a/fvp_base_revc_2xaemv8a/smp/ns
    tags: zbus
    integration_platforms:
      - native_sim
```

## tests/task_wdt/syswq_stall/testcase.yaml
```yaml
tests:
  task_wdt.syswq_stall:
    harness: ztest
    integration_platforms:
      - native_sim
```
