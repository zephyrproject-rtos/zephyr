## CMakeLists.txt
```
# SPDX-License-Identifier: Apache-2.0
cmake_minimum_required(VERSION 3.28.0)

find_package(Zephyr REQUIRED HINTS $ENV{ZEPHYR_BASE})
project(zbus_buffer_alloc_failure)

file(GLOB app_sources src/main.c)
target_sources(app PRIVATE ${app_sources})
```

## prj.conf
```kconfig
CONFIG_ZTEST=y
CONFIG_ASSERT=y
CONFIG_ZBUS=y
CONFIG_ZBUS_MSG_SUBSCRIBER=y
CONFIG_ZBUS_MSG_SUBSCRIBER_NET_BUF_POOL_ISOLATION=y
```

## src/main.c
```c
/*
 * Copyright (c) 2026 Jean Nanchen <jean.nanchen@gmail.com>
 * SPDX-License-Identifier: Apache-2.0
 */

#include <zephyr/kernel.h>
#include <zephyr/net_buf.h>
#include <zephyr/zbus/zbus.h>
#include <zephyr/ztest.h>

static unsigned int listener_calls;

static void on_message(const struct zbus_channel *chan)
{
	ARG_UNUSED(chan);
	++listener_calls;
}

ZBUS_LISTENER_DEFINE(listener, on_message);
ZBUS_MSG_SUBSCRIBER_DEFINE(msg_subscriber);

NET_BUF_POOL_HEAP_DEFINE(exhausted_pool, 2, sizeof(struct zbus_channel *), NULL);

ZBUS_CHAN_DEFINE(exhausted_pool_chan,                      /* Name */
		 int,                                       /* Message type */
		 NULL,                                      /* Validator */
		 NULL,                                      /* User data */
		 ZBUS_OBSERVERS(listener, msg_subscriber),  /* observers */
		 ZBUS_MSG_INIT(0)                           /* Initial value */
);

ZTEST(buffer_alloc_failure, test_returns_enomem_when_pool_is_exhausted)
{
	const struct zbus_channel *received_channel;
	const int msg = 42;
	int received_msg;
	struct net_buf *first = net_buf_alloc_len(&exhausted_pool, sizeof(int), K_NO_WAIT);
	struct net_buf *second = net_buf_alloc_len(&exhausted_pool, sizeof(int), K_NO_WAIT);

	zassert_not_null(first);
	zassert_not_null(second);
	zbus_chan_set_msg_sub_pool(&exhausted_pool_chan, &exhausted_pool);

	zassert_ok(zbus_chan_claim(&exhausted_pool_chan, K_NO_WAIT));
	*(int *)zbus_chan_msg(&exhausted_pool_chan) = 0;
	zassert_ok(zbus_chan_finish(&exhausted_pool_chan));
	listener_calls = 0;

	zassert_equal(zbus_chan_pub(&exhausted_pool_chan, &msg, K_NO_WAIT), -ENOMEM);
	zassert_equal(zbus_chan_notify(&exhausted_pool_chan, K_NO_WAIT), -ENOMEM);
	zassert_equal(listener_calls, 0);
	zassert_ok(zbus_chan_read(&exhausted_pool_chan, &received_msg, K_NO_WAIT));
	zassert_equal(received_msg, msg);

	net_buf_unref(first);
	net_buf_unref(second);

	zassert_ok(zbus_chan_notify(&exhausted_pool_chan, K_NO_WAIT));
	zassert_equal(listener_calls, 1);
	zassert_ok(zbus_sub_wait_msg(&msg_subscriber, &received_channel, &received_msg, K_NO_WAIT));
	zassert_equal_ptr(received_channel, &exhausted_pool_chan);
	zassert_equal(received_msg, msg);
}

ZTEST_SUITE(buffer_alloc_failure, NULL, NULL, NULL, NULL, NULL);
```
