## CMakeLists.txt
```
cmake_minimum_required(VERSION 3.28.0)
find_package(Zephyr REQUIRED HINTS $ENV{ZEPHYR_BASE})
project(app)

target_sources(app PRIVATE src/main.c)

zephyr_sources_ifdef(CONFIG_SECURE_STORAGE_ITS_TRANSFORM_IMPLEMENTATION_CUSTOM
  src/custom_transform.c)

zephyr_sources_ifdef(CONFIG_SECURE_STORAGE_ITS_TRANSFORM_AEAD_CRYPT_CUSTOM
  src/custom_aead_crypt.c)

zephyr_sources_ifdef(CONFIG_SECURE_STORAGE_ITS_STORE_IMPLEMENTATION_CUSTOM
  src/custom_store.c)

zephyr_sources_ifdef(CONFIG_SETTINGS_CUSTOM
  src/settings_backend.c)
```

## Kconfig
```
# Copyright (c) 2025 Embeint Inc
# SPDX-License-Identifier: Apache-2.0

# We explicitly don't want SECURE_STORAGE_ITS_IMPLEMENTATION_MBEDTLS here
choice SECURE_STORAGE_ITS_IMPLEMENTATION
	default SECURE_STORAGE_ITS_IMPLEMENTATION_ZEPHYR
	default SECURE_STORAGE_ITS_IMPLEMENTATION_CUSTOM
endchoice

source "Kconfig.zephyr"
```

## prj.conf
```kconfig
CONFIG_ZTEST=y

# PS is not the part under test here. Set it to fallback to ITS in all test
# configurations.
CONFIG_SECURE_STORAGE_PS_IMPLEMENTATION_ITS=y
```

## overlay-custom_store.conf
```kconfig
CONFIG_SECURE_STORAGE_ITS_STORE_IMPLEMENTATION_CUSTOM=y
```

## overlay-custom_transform.conf
```kconfig
CONFIG_SECURE_STORAGE_ITS_TRANSFORM_IMPLEMENTATION_CUSTOM=y
CONFIG_SECURE_STORAGE_ITS_TRANSFORM_OUTPUT_OVERHEAD=0

# SETTINGS_MAX_VAL_LEN (256) - flags (1)
CONFIG_SECURE_STORAGE_ITS_MAX_DATA_SIZE=255
```

## overlay-default_store.conf
```kconfig
# Limit the space available for the maximum entry test to not take too long.
CONFIG_SETTINGS_NVS_SECTOR_COUNT=2
```

## overlay-default_transform.conf
```kconfig
CONFIG_MBEDTLS=y
CONFIG_TEST_RANDOM_GENERATOR=y
CONFIG_TIMER_RANDOM_GENERATOR=y
# PSA Crypto needs some heap, but MINIMAL_LIBC has none by default.
CONFIG_COMMON_LIBC_MALLOC_ARENA_SIZE=2048
CONFIG_MBEDTLS_PSA_CRYPTO_C=y

# SETTINGS_MAX_VAL_LEN (256) - flags (1) - CONFIG_SECURE_STORAGE_ITS_TRANSFORM_OUTPUT_OVERHEAD (28)
CONFIG_SECURE_STORAGE_ITS_MAX_DATA_SIZE=227
```

## overlay-secure_storage.conf
```kconfig
CONFIG_ZTEST_STACK_SIZE=4096
CONFIG_MAIN_STACK_SIZE=3072

CONFIG_SECURE_STORAGE=y
```

## overlay-store_default.conf
```kconfig
CONFIG_SECURE_STORAGE_ITS_STORE_IMPLEMENTATION_SETTINGS=y

# 256 - flags (1) - CONFIG_SECURE_STORAGE_ITS_TRANSFORM_OUTPUT_OVERHEAD (28)
CONFIG_SECURE_STORAGE_ITS_MAX_DATA_SIZE=227

# Limit the space available for the maximum entry test to not take too long with NVS.
CONFIG_SETTINGS_NVS_SECTOR_COUNT=2
```

## zms.overlay
```dts
/ {
	chosen {
		secure_storage_its_partition = &storage_partition;
	};
};
```

## src/main.c
```c
/* Copyright (c) 2024 Nordic Semiconductor
 * SPDX-License-Identifier: Apache-2.0
 */
#include <zephyr/types.h>
#include <zephyr/ztest.h>
#include <zephyr/drivers/flash.h>
#include <zephyr/storage/flash_map.h>
#include <psa/internal_trusted_storage.h>

/* The flash must be erased after this test suite is run for the write-once entry test to pass. */
#if !defined(CONFIG_BUILD_WITH_TFM) && defined(CONFIG_FLASH_PAGE_LAYOUT) &&                        \
	PARTITION_EXISTS(storage_partition)
static int erase_flash(void)
{
	const struct device *const fdev = PARTITION_DEVICE(storage_partition);
	int rc;

	rc = flash_flatten(fdev, PARTITION_OFFSET(storage_partition),
			   PARTITION_SIZE(storage_partition));
	if (rc < 0) {
		TC_PRINT("Failed to flatten the storage partition (%d) !", rc);
		return rc;
	}

	return 0;
}

/* Low priority to ensure we run after any flash drivers are initialized */
SYS_INIT(erase_flash, POST_KERNEL, 100);

#endif /* !CONFIG_BUILD_WITH_TFM && CONFIG_FLASH_PAGE_LAYOUT && storage_partition */

ZTEST_SUITE(secure_storage_psa_its, NULL, NULL, NULL, NULL, NULL);

#ifdef CONFIG_SECURE_STORAGE
#define MAX_DATA_SIZE CONFIG_SECURE_STORAGE_ITS_MAX_DATA_SIZE
#else
#define MAX_DATA_SIZE CONFIG_TFM_ITS_MAX_ASSET_SIZE
#endif

#define UID (psa_storage_uid_t)1

static void fill_data_buffer(uint8_t data[static MAX_DATA_SIZE])
{
	for (unsigned int i = 0; i != MAX_DATA_SIZE; ++i) {
		data[i] = i;
	}
}

ZTEST(secure_storage_psa_its, test_all_sizes)
{
	psa_status_t ret;
	uint8_t written_data[MAX_DATA_SIZE];
	struct psa_storage_info_t info;
	uint8_t read_data[MAX_DATA_SIZE];
	size_t data_length;

	fill_data_buffer(written_data);

	for (unsigned int i = 0; i <= sizeof(written_data); ++i) {

		ret = psa_its_set(UID, i, written_data, PSA_STORAGE_FLAG_NONE);
		zassert_equal(ret, PSA_SUCCESS);

		ret = psa_its_get_info(UID, &info);
		zassert_equal(ret, PSA_SUCCESS);
		zassert_equal(info.flags, PSA_STORAGE_FLAG_NONE);
		zassert_equal(info.size, i);
		zassert_equal(info.capacity, i);

		ret = psa_its_get(UID, 0, sizeof(read_data), read_data, &data_length);
		zassert_equal(ret, PSA_SUCCESS);
		zassert_equal(data_length, i);
		zassert_mem_equal(read_data, written_data, data_length);

		ret = psa_its_remove(UID);
		zassert_equal(ret, PSA_SUCCESS);
		ret = psa_its_get_info(UID, &info);
		zassert_equal(ret, PSA_ERROR_DOES_NOT_EXIST);
	}
}

ZTEST(secure_storage_psa_its, test_all_offsets)
{
	psa_status_t ret;
	uint8_t written_data[MAX_DATA_SIZE];
	uint8_t read_data[MAX_DATA_SIZE];
	size_t data_length;

	fill_data_buffer(written_data);
	ret = psa_its_set(UID, sizeof(written_data), written_data, PSA_STORAGE_FLAG_NONE);
	zassert_equal(ret, PSA_SUCCESS);

	for (unsigned int i = 0; i <= sizeof(read_data); ++i) {

		ret = psa_its_get(UID, i, sizeof(read_data) - i, read_data, &data_length);
		zassert_equal(ret, PSA_SUCCESS);
		zassert_equal(data_length, sizeof(read_data) - i);

		zassert_mem_equal(read_data, written_data + i, data_length);
	}
}

ZTEST(secure_storage_psa_its, test_max_num_entries)
{
	psa_status_t ret = PSA_SUCCESS;
	unsigned int i;
	struct psa_storage_info_t info;

	for (i = 0; ret == PSA_SUCCESS; ++i) {
		ret = psa_its_set(UID + i, sizeof(i), &i, PSA_STORAGE_FLAG_NONE);
	}
	const unsigned int max_num_entries = i - 1;

	zassert_true(max_num_entries > 1);
	printk("Successfully wrote %u entries.\n", max_num_entries);
	zassert_equal(ret, PSA_ERROR_INSUFFICIENT_STORAGE);

	for (i = 0; i != max_num_entries; ++i) {
		unsigned int data;
		size_t data_length;

		ret = psa_its_get(UID + i, 0, sizeof(data), &data, &data_length);
		zassert_equal(ret, PSA_SUCCESS);
		zassert_equal(data, i);
	}
	for (i = 0; i != max_num_entries; ++i) {
		ret = psa_its_remove(UID + i);
		zassert_equal(ret, PSA_SUCCESS);
	}
	for (i = 0; i != max_num_entries; ++i) {
		ret = psa_its_get_info(UID + i, &info);
		zassert_equal(ret, PSA_ERROR_DOES_NOT_EXIST);
	}
}

/* The flash must be erased between runs of this test for it to pass. */
ZTEST(secure_storage_psa_its, test_write_once_flag)
{
	psa_status_t ret;
	/* Use a UID that isn't used in the other tests for the write-once entry. */
	const psa_storage_uid_t uid = 1 << 16;
	const uint8_t data[MAX_DATA_SIZE] = {};
	struct psa_storage_info_t info;

	ret = psa_its_set(uid, sizeof(data), data, PSA_STORAGE_FLAG_WRITE_ONCE);
	zassert_equal(ret, PSA_SUCCESS, "%s%d",
		      (ret == PSA_ERROR_NOT_PERMITTED)
			      ? "Has the flash been erased since this test ran? "
			      : "",
		      ret);

	ret = psa_its_get_info(uid, &info);
	zassert_equal(ret, PSA_SUCCESS);
	zassert_equal(info.flags, PSA_STORAGE_FLAG_WRITE_ONCE);

	ret = psa_its_set(uid, sizeof(data), data, PSA_STORAGE_FLAG_NONE);
	zassert_equal(ret, PSA_ERROR_NOT_PERMITTED);

	ret = psa_its_remove(uid);
	zassert_equal(ret, PSA_ERROR_NOT_PERMITTED);
}
```

## src/custom_aead_crypt.c
```c
/* Copyright (c) 2026 Nordic Semiconductor
 * SPDX-License-Identifier: Apache-2.0
 */
#include <zephyr/secure_storage/its/transform/aead.h>
#include <zephyr/sys/__assert.h>
#include <psa/crypto.h>
#include <string.h>

#define NONCE_SIZE CONFIG_SECURE_STORAGE_ITS_TRANSFORM_AEAD_NONCE_SIZE
#define TAG_SIZE SECURE_STORAGE_ITS_TRANSFORM_AEAD_TAG_SIZE

static void xor_crypt(const uint8_t nonce[static NONCE_SIZE], size_t len,
		      const uint8_t *input, uint8_t *output)
{
	for (size_t i = 0; i != len; ++i) {
		output[i] = input[i] ^ nonce[i % NONCE_SIZE];
	}
}

static void compute_tag(size_t add_data_len, const uint8_t *add_data, size_t data_len,
			const uint8_t *data, uint8_t tag[static TAG_SIZE])
{
	memset(tag, 0, TAG_SIZE);
	for (size_t i = 0; i != add_data_len; ++i) {
		tag[i % TAG_SIZE] ^= add_data[i];
	}
	for (size_t i = 0; i != data_len; ++i) {
		tag[i % TAG_SIZE] ^= data[i];
	}
}

psa_status_t secure_storage_its_transform_aead_crypt(
		psa_key_usage_t operation, secure_storage_uid_t uid,
		const uint8_t nonce[static CONFIG_SECURE_STORAGE_ITS_TRANSFORM_AEAD_NONCE_SIZE],
		size_t add_data_len, const uint8_t *add_data, size_t input_len,
		const uint8_t *input, size_t output_size, uint8_t *output, size_t *output_len)
{
	if (operation == PSA_KEY_USAGE_ENCRYPT) {
		__ASSERT_NO_MSG(output_size >= input_len + TAG_SIZE);
		xor_crypt(nonce, input_len, input, output);
		compute_tag(add_data_len, add_data, input_len, input, output + input_len);
		*output_len = input_len + TAG_SIZE;
	} else {
		uint8_t tag[TAG_SIZE];

		if (input_len < TAG_SIZE) {
			return PSA_ERROR_DATA_CORRUPT;
		}
		__ASSERT_NO_MSG(output_size >= input_len - TAG_SIZE);
		const size_t data_len = input_len - TAG_SIZE;

		xor_crypt(nonce, data_len, input, output);
		compute_tag(add_data_len, add_data, data_len, output, tag);
		if (memcmp(tag, input + data_len, TAG_SIZE) != 0) {
			return PSA_ERROR_INVALID_SIGNATURE;
		}
		*output_len = data_len;
	}
	return PSA_SUCCESS;
}
```

## src/custom_store.c
```c
/* Copyright (c) 2024 Nordic Semiconductor
 * SPDX-License-Identifier: Apache-2.0
 */
#include <zephyr/secure_storage/its/store.h>
#include <zephyr/kernel.h>
#include <zephyr/sys/util.h>
#include <string.h>

static struct {
	secure_storage_uid_t uid;
	size_t data_length;
	uint8_t data[SECURE_STORAGE_ITS_TRANSFORM_MAX_STORED_DATA_SIZE];
} s_its_entries[100];

static K_MUTEX_DEFINE(s_its_entries_mutex);

static int get_existing_entry_index(secure_storage_uid_t uid)
{
	__ASSERT_NO_MSG(uid.uid != 0);

	for (unsigned int i = 0; i != ARRAY_SIZE(s_its_entries); ++i) {
		if (!memcmp(&uid, &s_its_entries[i].uid, sizeof(uid))) {
			return i;
		}
	}
	return -1;
}

psa_status_t secure_storage_its_store_set(secure_storage_uid_t uid,
					  size_t data_length, const void *data)
{
	k_mutex_lock(&s_its_entries_mutex, K_FOREVER);

	__ASSERT_NO_MSG(data_length <= sizeof(s_its_entries[0].data));
	int index = get_existing_entry_index(uid);

	if (index == -1) {
		for (unsigned int i = 0; i != ARRAY_SIZE(s_its_entries); ++i) {
			if (s_its_entries[i].uid.uid == 0) {
				index = i;
				break;
			}
		}
		if (index == -1) {
			k_mutex_unlock(&s_its_entries_mutex);
			return PSA_ERROR_INSUFFICIENT_STORAGE;
		}
		s_its_entries[index].uid = uid;
	}

	s_its_entries[index].data_length = data_length;
	memcpy(s_its_entries[index].data, data, data_length);

	k_mutex_unlock(&s_its_entries_mutex);
	return PSA_SUCCESS;
}

psa_status_t secure_storage_its_store_get(secure_storage_uid_t uid, size_t data_size,
					  void *data, size_t *data_length)
{
	k_mutex_lock(&s_its_entries_mutex, K_FOREVER);

	const int index = get_existing_entry_index(uid);

	if (index == -1) {
		k_mutex_unlock(&s_its_entries_mutex);
		return PSA_ERROR_DOES_NOT_EXIST;
	}
	*data_length = MIN(data_size, s_its_entries[index].data_length);
	memcpy(data, s_its_entries[index].data, *data_length);

	k_mutex_unlock(&s_its_entries_mutex);
	return PSA_SUCCESS;
}

psa_status_t secure_storage_its_store_remove(secure_storage_uid_t uid)
{
	k_mutex_lock(&s_its_entries_mutex, K_FOREVER);

	const int index = get_existing_entry_index(uid);

	if (index == -1) {
		k_mutex_unlock(&s_its_entries_mutex);
		return PSA_ERROR_DOES_NOT_EXIST;
	}
	s_its_entries[index].uid.uid = 0;

	k_mutex_unlock(&s_its_entries_mutex);
	return PSA_SUCCESS;
}
```

## src/custom_transform.c
```c
/* Copyright (c) 2024 Nordic Semiconductor
 * SPDX-License-Identifier: Apache-2.0
 */
#include <zephyr/secure_storage/its/transform.h>
#include <zephyr/sys/__assert.h>
#include <string.h>

psa_status_t secure_storage_its_transform_to_store(
		secure_storage_uid_t uid, size_t data_len, const void *data,
		secure_storage_packed_create_flags_t create_flags,
		uint8_t stored_data[static SECURE_STORAGE_ITS_TRANSFORM_MAX_STORED_DATA_SIZE],
		size_t *stored_data_len)
{
	*stored_data_len = data_len + sizeof(secure_storage_packed_create_flags_t);
	__ASSERT_NO_MSG(data_len <= CONFIG_SECURE_STORAGE_ITS_MAX_DATA_SIZE);
	__ASSERT_NO_MSG(*stored_data_len <= SECURE_STORAGE_ITS_TRANSFORM_MAX_STORED_DATA_SIZE);
	memcpy(stored_data, data, data_len);
	*(secure_storage_packed_create_flags_t *)(&stored_data[data_len]) = create_flags;
	return PSA_SUCCESS;
}

psa_status_t secure_storage_its_transform_from_store(
		secure_storage_uid_t uid, size_t stored_data_len,
		const uint8_t stored_data[static SECURE_STORAGE_ITS_TRANSFORM_MAX_STORED_DATA_SIZE],
		size_t data_size, void *data, size_t *data_len,
		psa_storage_create_flags_t *create_flags)
{
	*data_len = stored_data_len - sizeof(secure_storage_packed_create_flags_t);
	__ASSERT_NO_MSG(data_size >= *data_len);
	memcpy(data, stored_data, *data_len);
	*create_flags = *(secure_storage_packed_create_flags_t *)(&stored_data[*data_len]);
	return PSA_SUCCESS;
}
```

## src/settings_backend.c
```c
/*
 * Copyright (c) 2026 Elyorbek Kholikov
 * SPDX-License-Identifier: Apache-2.0
 */

/* A settings backend that keeps the entries in RAM and counts how they are
 * loaded, to check which settings calls the ITS store implementation makes.
 */
#include <errno.h>
#include <string.h>

#include <zephyr/settings/settings.h>
#include <zephyr/sys/util.h>
#include <zephyr/ztest.h>
#include <psa/internal_trusted_storage.h>

#define ENTRY_COUNT    8
#define ENTRY_MAX_SIZE (CONFIG_SECURE_STORAGE_ITS_MAX_DATA_SIZE + 64)

struct entry {
	char name[SETTINGS_MAX_NAME_LEN + 1];
	uint8_t data[ENTRY_MAX_SIZE];
	size_t len;
};

static struct entry entries[ENTRY_COUNT];
static unsigned int load_calls;
static unsigned int load_one_calls;

static struct entry *find_entry(const char *name)
{
	ARRAY_FOR_EACH_PTR(entries, entry) {
		if (entry->len != 0 && strcmp(entry->name, name) == 0) {
			return entry;
		}
	}
	return NULL;
}

static ssize_t read_entry(void *cb_arg, void *data, size_t len)
{
	const struct entry *entry = cb_arg;

	len = MIN(len, entry->len);
	memcpy(data, entry->data, len);
	return len;
}

static int backend_load(struct settings_store *cs, const struct settings_load_arg *arg)
{
	ARG_UNUSED(cs);

	++load_calls;

	ARRAY_FOR_EACH_PTR(entries, entry) {
		int ret;

		if (entry->len == 0) {
			continue;
		}
		ret = settings_call_set_handler(entry->name, entry->len, read_entry, entry, arg);
		if (ret != 0) {
			return ret;
		}
	}
	return 0;
}

static ssize_t backend_load_one(struct settings_store *cs, const char *name, char *buf,
				size_t buf_len)
{
	const struct entry *entry = find_entry(name);

	ARG_UNUSED(cs);

	++load_one_calls;

	if (entry == NULL) {
		return 0;
	}
	memcpy(buf, entry->data, MIN(buf_len, entry->len));
	return entry->len;
}

static int backend_save(struct settings_store *cs, const char *name, const char *value,
			size_t val_len)
{
	struct entry *entry = find_entry(name);

	ARG_UNUSED(cs);

	if (value == NULL || val_len == 0) {
		if (entry != NULL) {
			entry->len = 0;
		}
		return 0;
	}
	if (val_len > ENTRY_MAX_SIZE || strlen(name) > SETTINGS_MAX_NAME_LEN) {
		return -ENOSPC;
	}
	if (entry == NULL) {
		ARRAY_FOR_EACH_PTR(entries, free_entry) {
			if (free_entry->len == 0) {
				entry = free_entry;
				break;
			}
		}
	}
	if (entry == NULL) {
		return -ENOSPC;
	}

	strcpy(entry->name, name);
	memcpy(entry->data, value, val_len);
	entry->len = val_len;
	return 0;
}

static const struct settings_store_itf backend_itf = {
	.csi_load = backend_load,
	.csi_load_one = backend_load_one,
	.csi_save = backend_save,
};

static struct settings_store backend_store = {.cs_itf = &backend_itf};

int settings_backend_init(void)
{
	settings_dst_register(&backend_store);
	settings_src_register(&backend_store);
	return 0;
}

/* Reading an entry must not make the settings backend go through the other
 * stored settings.
 */
ZTEST(secure_storage_psa_its, test_get_loads_one_setting)
{
	const psa_storage_uid_t uid = 2 << 16;
	const uint8_t written_data[] = {1, 2, 3, 4};
	uint8_t read_data[sizeof(written_data)];
	size_t data_length;
	psa_status_t ret;

	ret = psa_its_set(uid, sizeof(written_data), written_data, PSA_STORAGE_FLAG_NONE);
	zassert_equal(ret, PSA_SUCCESS);

	load_calls = 0;
	load_one_calls = 0;

	ret = psa_its_get(uid, 0, sizeof(read_data), read_data, &data_length);
	zassert_equal(ret, PSA_SUCCESS);
	zassert_equal(data_length, sizeof(written_data));
	zassert_mem_equal(read_data, written_data, sizeof(written_data));

	zassert_equal(load_one_calls, 1, "%u loads of one setting", load_one_calls);
	zassert_equal(load_calls, 0, "%u loads of all the settings", load_calls);

	ret = psa_its_remove(uid);
	zassert_equal(ret, PSA_SUCCESS);

	ret = psa_its_get(uid, 0, sizeof(read_data), read_data, &data_length);
	zassert_equal(ret, PSA_ERROR_DOES_NOT_EXIST);
	zassert_equal(load_calls, 0, "%u loads of all the settings", load_calls);
}
```
