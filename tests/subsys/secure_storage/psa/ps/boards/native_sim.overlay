/*
 * Copyright (c) 2026 BayLibre SAS
 *
 * SPDX-License-Identifier: Apache-2.0
 */

&flash0 {
	partitions {
		storage_partition_2: partition@100000 {
			compatible = "zephyr,mapped-partition";
			reg = <0x00100000 0x00100000>;
			label = "storage-2";
		};
	};
};
