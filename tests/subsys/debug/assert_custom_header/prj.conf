## CMakeLists.txt
```
#SPDX - License - Identifier : Apache - 2.0

cmake_minimum_required(VERSION 3.28.0)
find_package(Zephyr REQUIRED HINTS $ENV{ZEPHYR_BASE})
project(assert_custom_header)

FILE(GLOB app_sources src/*.c)
target_sources(app PRIVATE ${app_sources})

zephyr_include_directories(src)
```

## prj.conf
```kconfig
CONFIG_ASSERT=y
CONFIG_ASSERT_CUSTOM_HEADER=y
CONFIG_LOG=n
CONFIG_ZTEST=y
CONFIG_TEST_LOGGING_DEFAULTS=n
```

## src/main.c
```c
/*
 * Copyright (c) 2025 Google, Inc.
 *
 * SPDX-License-Identifier: Apache-2.0
 */

/** @file
 *  @brief Custom header assert test suite
 *
 */

#include <zephyr/kernel.h>
#include <zephyr/ztest.h>

#include <zephyr/sys/__assert.h>

static unsigned int last_assert_line;

void assert_post_action(const char *file, unsigned int line)
{
	last_assert_line = line;
}

ZTEST_SUITE(assert, NULL, NULL, NULL, NULL, NULL);

ZTEST(assert, test_assert_call)
{
	/* Because CONFIG_ASSERT_TEST is not enabled in this test, and we're using a
	 * custom assert macro, this should not crash and the test should proceed.
	 */
	__ASSERT(false, "This is a custom assert test");

	zassert_true(last_assert_line != 0, "Assert was called on line 0");
}
```

## src/zephyr_custom_assert.h
```c
/*
 * Copyright (c) 2025 Google, Inc.
 *
 * SPDX-License-Identifier: Apache-2.0
 */

#ifndef __ZEPHYR_CUSTOM_ASSERT_H
#define __ZEPHYR_CUSTOM_ASSERT_H

#undef __ASSERT

#define __ASSERT(test, fmt, ...)                                                                   \
	do {                                                                                       \
		if (!(test)) {                                                                     \
			__ASSERT_POST_ACTION();                                                    \
		}                                                                                  \
	} while (false)

#endif /* __ZEPHYR_CUSTOM_ASSERT_H */
```
