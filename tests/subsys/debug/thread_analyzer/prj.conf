## CMakeLists.txt
```
# SPDX-License-Identifier: Apache-2.0

cmake_minimum_required(VERSION 3.28.0)

find_package(Zephyr REQUIRED HINTS $ENV{ZEPHYR_BASE})
project(thread_analyzer_tests)

target_sources(app PRIVATE src/main.c)
```

## prj.conf
```kconfig
CONFIG_THREAD_ANALYZER=y
CONFIG_THREAD_ANALYZER_AUTO=y

# log immediate mode requires a bit more stack to print
CONFIG_THREAD_ANALYZER_AUTO_STACK_SIZE=2048
```

## src/main.c
```c
/*
 * Copyright (c) 2024 Intel Corporation
 *
 * SPDX-License-Identifier: Apache-2.0
 */

#include <zephyr/kernel.h>

#define EXTRA_THREAD_STACKSIZE 2048

struct k_thread extra_thread;
K_THREAD_STACK_DEFINE(extra_stack, EXTRA_THREAD_STACKSIZE);

static void thread_entry(void *p1, void *p2, void *p3)
{
	/* This thread does not have a name so thread analyzer will display
	 * the memory address of the thread struct, which is needed for
	 * the twister console harness to match (even if CONFIG_THREAD_NAME=y).
	 */
	while (true) {
		k_sleep(K_SECONDS(300));
	}
}

int main(void)
{
	k_thread_create(&extra_thread, extra_stack, EXTRA_THREAD_STACKSIZE,
			thread_entry, NULL, NULL, NULL, K_PRIO_PREEMPT(0),
			IS_ENABLED(CONFIG_USERSPACE) ? K_USER : 0,
			K_MSEC(0));
	return 0;
}
```
