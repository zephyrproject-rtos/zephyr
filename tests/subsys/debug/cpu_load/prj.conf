## CMakeLists.txt
```
# SPDX-License-Identifier: Apache-2.0

cmake_minimum_required(VERSION 3.20.0)

find_package(Zephyr REQUIRED HINTS $ENV{ZEPHYR_BASE})
project(debug_cpu_load)

target_sources(app PRIVATE src/main.c)
```

## prj.conf
```kconfig
CONFIG_ZTEST=y
CONFIG_CPU_LOAD=y
CONFIG_CPU_LOAD_USE_COUNTER=n
#CONFIG_CPU_LOAD_DETECT_FULL_UTILIZATION=n
```

## prj_periodic.conf
```kconfig
CONFIG_CPU_LOAD_LOG_PERIODICALLY=50
CONFIG_LOG=y
CONFIG_TEST_LOGGING_DEFAULTS=n
CONFIG_LOG_PRINTK=n
CONFIG_LOG_BACKEND_UART=n
CONFIG_LOG_MODE_IMMEDIATE=y
```

## boards/apollo510b_evb.conf
```kconfig
CONFIG_TRACING=y
```

## boards/apollo510_evb.overlay
```dts
/ {
	chosen {
		zephyr,cpu-load-counter = &counter12;
	};
};

&timer12{
	clk-source = "CLK_SELECT_HFRC_DIV4";

	counter12: counter {
		status = "okay";
	};
};
```

## boards/apollo510b_evb.overlay
```dts
/*****************************************************************************
 * SPDX-FileCopyrightText: 2025 Ambiq Micro Inc.
 *
 * SPDX-License-Identifier: Apache-2.0
 ***************************************************************************
 */

/ {
	chosen {
		zephyr,cpu-load-counter = &counter12;
	};
};

&timer12 {
	clk-source = "CLK_SELECT_HFRC_DIV4";

	counter12: counter {
		status = "okay";
	};
};
```

## boards/nrf52840dk_nrf52840.overlay
```dts
/ {
	chosen {
		zephyr,cpu-load-counter = &timer0;
	};
};

&timer0 {
	status = "okay";
	prescaler = <0>;
};
```

## src/main.c
```c
/*
 * Copyright (c) 2024, Nordic Semiconductor ASA
 *
 * SPDX-License-Identifier: Apache-2.0
 */

#include <zephyr/kernel.h>
#include <zephyr/sys/cpu_load.h>
#include <zephyr/ztest.h>
#include <zephyr/logging/log_ctrl.h>
#include <zephyr/logging/log_backend.h>

#include <zephyr/drivers/counter.h>

#define DELTA 30

ZTEST(cpu_load, test_load)
{
	int load;
	uint32_t t_ms = 100;

	if (CONFIG_CPU_LOAD_LOG_PERIODICALLY > 0) {
		cpu_load_log_control(false);
	}

	/* Reset the measurement */
	(void)cpu_load_get(true);
	k_busy_wait(t_ms * USEC_PER_MSEC);

	/* Measurement is not reset. */
	load = cpu_load_get(false);
	/* Result in per mille */
	zassert_within(load, 1000, DELTA);

	k_msleep(t_ms);
	load = cpu_load_get(false);
	zassert_within(load, 500, DELTA);

	/* Reset the measurement */
	(void)cpu_load_get(true);
	k_msleep(t_ms);
	load = cpu_load_get(false);
	zassert_within(load, 0, DELTA);
}

#if CONFIG_CPU_LOAD_LOG_PERIODICALLY > 0
static int cpu_load_src_id;
static atomic_t log_cnt;

static void process(const struct log_backend *const backend,
		union log_msg_generic *msg)
{
	ARG_UNUSED(backend);
	const void *source = msg->log.hdr.source;
	int source_id = log_const_source_id((const struct log_source_const_data *)source);

	if (source_id == cpu_load_src_id) {
		atomic_inc(&log_cnt);
	}
}

static void init(const struct log_backend *const backend)
{
	ARG_UNUSED(backend);
}

const struct log_backend_api mock_log_backend_api = {
	.process = process,
	.init = init
};

LOG_BACKEND_DEFINE(dummy, mock_log_backend_api, false, NULL);

ZTEST(cpu_load, test_periodic_report)
{
	log_backend_enable(&dummy, NULL, LOG_LEVEL_INF);
	cpu_load_log_control(true);

	cpu_load_src_id = log_source_id_get(STRINGIFY(cpu_load));
	atomic_set(&log_cnt, 0);
	k_msleep(3 * CONFIG_CPU_LOAD_LOG_PERIODICALLY);
	log_flush();
	zassert_within(log_cnt, 3, 1);

	cpu_load_log_control(false);
	k_msleep(1);
	atomic_set(&log_cnt, 0);
	k_msleep(3 * CONFIG_CPU_LOAD_LOG_PERIODICALLY);
	log_flush();
	zassert_equal(log_cnt, 0);

	cpu_load_log_control(true);
	k_msleep(3 * CONFIG_CPU_LOAD_LOG_PERIODICALLY);
	log_flush();
	zassert_within(log_cnt, 3, 1);

	cpu_load_log_control(false);
	log_backend_disable(&dummy);
}

void low_load_cb(uint8_t percent)
{
	/* Should never be called */
	zassert_true(false, NULL);
}

static uint32_t num_load_callbacks;
static uint8_t last_cpu_load_percent;

void high_load_cb(uint8_t percent)
{
	last_cpu_load_percent = percent;
	num_load_callbacks++;
}

ZTEST(cpu_load, test_callback_load_low)
{
	int ret;

	cpu_load_log_control(true);

	ret = cpu_load_cb_reg(low_load_cb, 99);
	zassert_equal(ret, 0);

	k_msleep(CONFIG_CPU_LOAD_LOG_PERIODICALLY * 4);
	zassert_equal(num_load_callbacks, 0);
	cpu_load_log_control(false);
}

ZTEST(cpu_load, test_callback_load_high)
{
	int ret;

	cpu_load_log_control(true);

	ret = cpu_load_cb_reg(high_load_cb, 99);
	zassert_equal(ret, 0);

	k_busy_wait(CONFIG_CPU_LOAD_LOG_PERIODICALLY * 4 * 1000);
	zassert_between_inclusive(last_cpu_load_percent, 99, 100);
	zassert_between_inclusive(num_load_callbacks, 2, 7);

	/* Reset the callback */
	ret = cpu_load_cb_reg(NULL, 99);
	zassert_equal(ret, 0);

	num_load_callbacks = 0;
	k_busy_wait(CONFIG_CPU_LOAD_LOG_PERIODICALLY * 4 * 1000);
	zassert_equal(num_load_callbacks, 0);
	cpu_load_log_control(false);
}

#endif /* CONFIG_CPU_LOAD_LOG_PERIODICALLY > 0 */

ZTEST_SUITE(cpu_load, NULL, NULL, NULL, NULL, NULL);
```
