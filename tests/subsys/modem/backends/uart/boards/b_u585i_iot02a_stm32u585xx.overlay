/* SPDX-License-Identifier: Apache-2.0 */

/*
 * The Arduino D0 and D1 must be connected to each other to loopback RX/TX.
 */

dut: &usart3 {
	dmas = <&gpdma1 0 29 STM32_DMA_PERIPH_TX
		&gpdma1 1 28 STM32_DMA_PERIPH_RX>;
	dma-names = "tx", "rx";
};
