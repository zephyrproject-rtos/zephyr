/* SPDX-License-Identifier: Apache-2.0 */

/*
 * The following bridges must be applied:
 *
 *   CN2 pin 2 <-> CN2 pin 3
 *   CN2 pin 1 <-> CN2 pin 4
 *
 */

&gpioh {
	status = "okay";

	stmod_alternate_uart {
		gpio-hog;
		gpios = <15 GPIO_ACTIVE_HIGH>;
		output-high;
	};
};

dut: &usart3 {
	pinctrl-0 = <&usart3_tx_pd8
		     &usart3_rx_pd9
		     &usart3_rts_pd12
		     &usart3_cts_pd11>;
	pinctrl-names = "default";
	dmas = <&gpdma1 0 29 STM32_DMA_PERIPH_TX>,
	       <&gpdma1 1 28 STM32_DMA_PERIPH_RX>;
	dma-names = "tx", "rx";
	hw-flow-control;
};
