## tests/subsys/sd/sdmmc/boards/stm32h747i_disco_stm32h747xx_m7.conf
```kconfig
# Copyright (c) 2025 EXALT Technologies.
# SPDX-License-Identifier: Apache-2.0

CONFIG_SDMMC_STM32=n
```

## tests/subsys/secure_storage/psa/ps/boards/mps2_an521_cpu0_ns.conf
```kconfig
# Copyright (c) 2026 BayLibre SAS
# SPDX-License-Identifier: Apache-2.0

CONFIG_MAIN_STACK_SIZE=8192
CONFIG_ZTEST_STACK_SIZE=8192
```

## tests/subsys/shell/shell_backend_uart/boards/nrf54lm20dk_nrf54lm20a_cpuapp.conf
```kconfig
CONFIG_TEST_BUSY_SIM=y
CONFIG_CPU_LOAD=y
CONFIG_UART_NRFX_UARTE_BOUNCE_BUF_SWAP_LATENCY=500
CONFIG_UART_NRFX_UARTE_BOUNCE_BUF_LEN=512
CONFIG_UART_22_ASYNC=y
CONFIG_UART_22_INTERRUPT_DRIVEN=n
```

## tests/subsys/shell/shell_backend_uart/boards/nrf54lm20dk_nrf54lm20b_cpuapp.conf
```kconfig
CONFIG_EMUL=n
CONFIG_UART_ASYNC_API=y
CONFIG_UART_22_INTERRUPT_DRIVEN=n
CONFIG_UART_20_INTERRUPT_DRIVEN=n
```

## tests/subsys/task_wdt/testcase.yaml
```yaml
common:
  tags:
    - task_wdt
    - watchdog
  harness: ztest
  platform_allow:
    - native_sim
    - qemu_cortex_m3
  integration_platforms:
    - native_sim
tests:
  subsys.task_wdt.hw_fallback: {}
```

## tests/subsys/usb/cdc_acm_work/Kconfig
```kconfig
# Copyright (c) 2026 Neoventor AB
# SPDX-License-Identifier: Apache-2.0

source "Kconfig.zephyr"
```

## tests/subsys/usb/hid/Kconfig
```kconfig
# SPDX-FileCopyrightText: Copyright The Zephyr Project Contributors
# SPDX-License-Identifier: Apache-2.0

config SYS_CLOCK_TICKS_PER_SEC
	default 1000000 if BOARD_NATIVE_SIM

source "samples/subsys/usb/common/Kconfig.sample_usbd"

source "Kconfig.zephyr"
```

## tests/subsys/usb/usbh_msd/testcase.yaml
```yaml
tests:
  subsys.usb.usbh_msd:
    tags:
      - usb
      - msd
    harness: ztest
    harness_config:
      type: one_line
      regex:
        - "PASS"
    depends_on: usb_host
    platform_allow:
      - rdrw612_evk
      - mimxrt700_evk
```
