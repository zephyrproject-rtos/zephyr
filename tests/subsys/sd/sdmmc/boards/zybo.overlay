/*
 * Copyright (c) 2026 David Paul-Beier
 *
 * SPDX-License-Identifier: Apache-2.0
 */

/* Zybo's microSD slot is on PS SDIO0 */
/ {
	aliases {
		sdhc0 = &sdhc0;
	};
};

&sdhc0 {
	status = "okay";

	sdmmc {
		compatible = "zephyr,sdmmc-disk";
		disk-name = "SD";
		status = "okay";
	};
};
