/*
 * Copyright (c) 2025 EXALT Technologies.
 *
 * SPDX-License-Identifier: Apache-2.0
 */

/ {
	aliases {
		sdhc0 = &sdhc;
	};
};

sdhc: &sdmmc1 {
	hw-flow-control;
	bus-width = <4>;
	min-bus-freq = <DT_FREQ_K(400)>;
	max-bus-freq = <DT_FREQ_M(208)>;

	sdmmc {
		compatible = "zephyr,sdmmc-disk";
		disk-name = "SD";
		status = "okay";
	};
};
