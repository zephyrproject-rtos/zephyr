## CMakeLists.txt
```
# Copyright 2026 Nordic Semiconductor ASA
# SPDX-License-Identifier: Apache-2.0
cmake_minimum_required(VERSION 3.20.0)
find_package(Zephyr REQUIRED HINTS $ENV{ZEPHYR_BASE})
project(sdio_stream)
target_sources(app PRIVATE src/main.c)
```

## prj.conf
```kconfig
CONFIG_ZTEST=y
CONFIG_SDIO_DC=y
CONFIG_SDIO_DC_VIRTUAL=y
CONFIG_SDIO_DEVICE=y
CONFIG_SDIO_DEVICE_STREAM=y
CONFIG_LOG=y
```

## boards/native_sim.overlay
```dts
/*
 * Copyright 2026 Nordic Semiconductor ASA
 * SPDX-License-Identifier: Apache-2.0
 */
/ {
	sdio_dc0: sdio_dc0 {
		compatible = "zephyr,sdio-device-virtual";
		status = "okay";
		num-functions = <3>;
		max-block-size = <512>;
	};

	sdio_dc1: sdio_dc1 {
		compatible = "zephyr,sdio-device-virtual";
		status = "okay";
		num-functions = <3>;
		max-block-size = <512>;
	};
};
```

## src/main.c
```c
/*
 * Copyright 2026 Nordic Semiconductor ASA
 *
 * SPDX-License-Identifier: Apache-2.0
 */

#include <zephyr/ztest.h>
#include <zephyr/device.h>
#include <zephyr/sd/sd_spec.h>
#include <zephyr/sd/sdio_device.h>
#include <zephyr/sd/sdio_stream.h>
#include <zephyr/drivers/sdio_dc.h>
#include <zephyr/drivers/sdio_dc_virtual.h>

#define DC_NODE   DT_NODELABEL(sdio_dc0)
#define FIFO_REG  0x0

/* Function-0 config: the virtual controller does not serve function 0. */
static const struct sdio_device_config stream_cfg = {
	.cccr_revision = SDIO_CCCR_CCCR_REV_3_00,
	.sd_spec = 0x03,
	.max_blk_size = 512,
};

static struct sdio_device endpoint;
static struct sdio_stream_function sf;

/* Host-side interrupt bookkeeping. */
static volatile uint32_t irq_count;

static void irq_cb(const struct device *dc, enum sdio_func_num func, void *user)
{
	ARG_UNUSED(dc);
	ARG_UNUSED(func);
	ARG_UNUSED(user);

	irq_count++;
}

static int host_access(enum sdio_dc_dir dir, uint8_t *data, uint32_t len)
{
	const struct device *dc = DEVICE_DT_GET(DC_NODE);
	struct sdio_dc_xfer xfer = {
		.func = SDIO_FUNC_NUM_1,
		.dir = dir,
		.reg = FIFO_REG,
		.increment = false,
		.data = data,
		.len = len,
	};

	return sdio_dc_virtual_access(dc, &xfer);
}

static void *setup(void)
{
	const struct device *dc = DEVICE_DT_GET(DC_NODE);

	zassert_true(device_is_ready(dc), "controller not ready");
	zassert_ok(sdio_device_init(&endpoint, dc, &stream_cfg));
	zassert_ok(sdio_stream_function_init(&sf, SDIO_FUNC_NUM_1, FIFO_REG));
	zassert_ok(sdio_device_register_function(&endpoint, &sf.base));
	zassert_ok(sdio_device_enable(&endpoint));
	sdio_dc_virtual_set_irq_cb(dc, irq_cb, NULL);

	return NULL;
}

/* A host FIFO write is delivered to the RX path and read out by the device. */
ZTEST(sdio_stream, test_rx_from_host)
{
	uint8_t tx[32];
	uint8_t rx[32];
	int n;

	for (int i = 0; i < (int)sizeof(tx); i++) {
		tx[i] = (uint8_t)(0xF0 ^ i);
	}

	zassert_ok(host_access(SDIO_DC_DIR_WRITE, tx, sizeof(tx)));

	n = sdio_stream_read(&sf, rx, sizeof(rx), K_MSEC(100));
	zassert_equal(n, (int)sizeof(tx), "wrong rx length: %d", n);
	zassert_mem_equal(rx, tx, sizeof(tx), "rx payload mismatch");
}

/* poll() reports readable once a host write has landed. */
ZTEST(sdio_stream, test_poll_in)
{
	uint8_t tx[4] = {1, 2, 3, 4};
	uint8_t rx[4];
	uint32_t revents = 0;

	zassert_ok(host_access(SDIO_DC_DIR_WRITE, tx, sizeof(tx)));

	zassert_ok(sdio_stream_poll(&sf, SDIO_STREAM_POLLIN, &revents,
				    K_MSEC(100)));
	zassert_true(revents & SDIO_STREAM_POLLIN, "POLLIN not set");

	/* drain */
	zassert_equal(sdio_stream_read(&sf, rx, sizeof(rx), K_NO_WAIT),
		      (int)sizeof(tx));
}

/* A device write queues a TX packet, raises the interrupt, and the host
 * retrieves the payload by reading the function data port.
 */
ZTEST(sdio_stream, test_tx_to_host)
{
	uint8_t tx[24];
	uint8_t rx[24];
	uint32_t before = irq_count;

	for (int i = 0; i < (int)sizeof(tx); i++) {
		tx[i] = (uint8_t)(i + 3);
	}

	zassert_ok(sdio_stream_write(&sf, tx, sizeof(tx)));
	zassert_equal(irq_count, before + 1, "host not interrupted");

	memset(rx, 0, sizeof(rx));
	zassert_ok(host_access(SDIO_DC_DIR_READ, rx, sizeof(rx)));
	zassert_mem_equal(rx, tx, sizeof(tx), "tx payload mismatch");
}

ZTEST_SUITE(sdio_stream, NULL, setup, NULL, NULL, NULL);
```
