## CMakeLists.txt
```
# SPDX-FileCopyrightText: Copyright The Zephyr Project Contributors
# SPDX-License-Identifier: Apache-2.0

cmake_minimum_required(VERSION 3.28.0)

find_package(Zephyr REQUIRED HINTS $ENV{ZEPHYR_BASE})
project(sdio_speed)

target_include_directories(app PRIVATE "${ZEPHYR_BASE}/subsys/sd")

target_sources(app PRIVATE
  src/speed_test.c
  src/speed_cases.c
  src/init_cases.c
  src/timing_cases.c
)
```

## Kconfig
```
# SPDX-FileCopyrightText: Copyright The Zephyr Project Contributors
# SPDX-License-Identifier: Apache-2.0

mainmenu "SDIO bus speed tests"

source "Kconfig.zephyr"

config SDIO_SPEED_TEST
	bool
	default y
	select SDMMC_STACK
	select SDHC_SUPPORTS_NATIVE_MODE
	select SDHC_SUPPORTS_UHS
```

## prj.conf
```kconfig
# SPDX-FileCopyrightText: Copyright The Zephyr Project Contributors
# SPDX-License-Identifier: Apache-2.0

CONFIG_ZTEST=y
CONFIG_LOG=y
CONFIG_SD_LOG_LEVEL_OFF=y
CONFIG_TEST_EXTRA_STACK_SIZE=2048
```

## src/init_cases.c
```c
/*
 * SPDX-FileCopyrightText: Copyright The Zephyr Project Contributors
 * SPDX-License-Identifier: Apache-2.0
 */

#include <errno.h>
#include <zephyr/ztest.h>

#include "speed_test.h"

ZTEST(sdio_speed, test_init_rejected_sdr50_skips_tuning)
{
	const struct init_case test = {
		.uhs_reg = 0x01U, .speed_write = 0x05U,
		.want_clock = 25000000U, .want_timing = SDHC_TIMING_SDR12,
	};

	sdio_speed_run_init_case(&test);
}

ZTEST(sdio_speed, test_init_rejected_sdr104_skips_tuning)
{
	const struct init_case test = {
		.uhs_reg = 0x02U, .speed_write = 0x07U,
		.want_clock = 25000000U, .want_timing = SDHC_TIMING_SDR12,
	};

	sdio_speed_run_init_case(&test);
}

ZTEST(sdio_speed, test_init_accepted_sdr50_tunes)
{
	const struct init_case test = {
		.uhs_reg = 0x01U, .speed_write = 0x05U, .accept = true,
		.want_clock = 100000000U, .want_timing = SDHC_TIMING_SDR50, .want_tunes = 1U,
	};

	sdio_speed_run_init_case(&test);
}

ZTEST(sdio_speed, test_init_accepted_sdr104_tunes)
{
	const struct init_case test = {
		.uhs_reg = 0x02U, .speed_write = 0x07U, .accept = true,
		.want_clock = 208000000U, .want_timing = SDHC_TIMING_SDR104, .want_tunes = 1U,
	};

	sdio_speed_run_init_case(&test);
}

ZTEST(sdio_speed, test_init_tuning_error_propagates)
{
	const struct init_case test = {
		.uhs_reg = 0x02U, .speed_write = 0x07U, .accept = true,
		.want_clock = 208000000U, .want_timing = SDHC_TIMING_SDR104, .want_tunes = 1U,
		.tuning_error = -EIO, .want_ret = -EIO,
	};

	sdio_speed_run_init_case(&test);
}
```

## src/speed_cases.c
```c
/*
 * SPDX-FileCopyrightText: Copyright The Zephyr Project Contributors
 * SPDX-License-Identifier: Apache-2.0
 */

#include <errno.h>
#include <zephyr/ztest.h>

#include "speed_test.h"

ZTEST(sdio_speed, test_rejected_hs)
{
	const struct speed_case test = {
		REJECTED(SDIO_SUPPORT_HS, SD_VOL_3_3_V, 0x83U, 0x81U, SDHC_TIMING_LEGACY)
	};

	sdio_speed_run_case(&test);
}

ZTEST(sdio_speed, test_rejected_sdr50)
{
	const struct speed_case test = {
		REJECTED(SDIO_SUPPORT_SDR50, SD_VOL_1_8_V, 0x85U, 0x81U, SDHC_TIMING_SDR12)
	};

	sdio_speed_run_case(&test);
}

ZTEST(sdio_speed, test_rejected_sdr104)
{
	const struct speed_case test = {
		REJECTED(SDIO_SUPPORT_SDR104, SD_VOL_1_8_V, 0x87U, 0x81U, SDHC_TIMING_SDR12)
	};

	sdio_speed_run_case(&test);
}

ZTEST(sdio_speed, test_rejected_ddr50)
{
	const struct speed_case test = {
		REJECTED(SDIO_SUPPORT_DDR50, SD_VOL_1_8_V, 0x89U, 0x81U, SDHC_TIMING_SDR12)
	};

	sdio_speed_run_case(&test);
}

ZTEST(sdio_speed, test_wrong_nonzero_bss)
{
	const struct speed_case test = {
		REJECTED(SDIO_SUPPORT_SDR104, SD_VOL_1_8_V, 0x87U, 0x83U, SDHC_TIMING_SDR12)
	};

	sdio_speed_run_case(&test);
}

ZTEST(sdio_speed, test_default_rejected)
{
	const struct speed_case test = {
		.voltage = SD_VOL_3_3_V, .host_max = 208000000U,
		.initial_reg = 0x80U, .rejected_reg = 0x82U, .want_write_data = 0x80U,
		.want_writes = -1, .want_clock = 25000000U, .want_timing = SDHC_TIMING_LEGACY
	};

	sdio_speed_run_case(&test);
}

ZTEST(sdio_speed, test_immediate_sdr50)
{
	const struct speed_case test = {
		ACCEPTED(SDIO_SUPPORT_SDR50, SD_VOL_1_8_V, 0x85U, 100000000U, SDHC_TIMING_SDR50)
	};

	sdio_speed_run_case(&test);
}

ZTEST(sdio_speed, test_immediate_sdr104)
{
	const struct speed_case test = {
		ACCEPTED(SDIO_SUPPORT_SDR104, SD_VOL_1_8_V, 0x87U, 208000000U, SDHC_TIMING_SDR104)
	};

	sdio_speed_run_case(&test);
}

ZTEST(sdio_speed, test_immediate_ddr50)
{
	const struct speed_case test = {
		ACCEPTED(SDIO_SUPPORT_DDR50, SD_VOL_1_8_V, 0x89U, 50000000U, SDHC_TIMING_DDR50)
	};

	sdio_speed_run_case(&test);
}

ZTEST(sdio_speed, test_sdr50_accepted_shs_clear)
{
	const struct speed_case test = {
		.caps = SDIO_SUPPORT_SDR50, .voltage = SD_VOL_1_8_V, .host_max = 208000000U,
		.initial_reg = 0x81U, .accepted_reg = 0x04U, .want_write_data = 0x85U,
		.accept_at = 1, .want_writes = 1, .want_sets = 1U,
		.want_clock = 100000000U, .want_timing = SDHC_TIMING_SDR50
	};

	sdio_speed_run_case(&test);
}

ZTEST(sdio_speed, test_final_sdr104)
{
	const struct speed_case test = {
		.caps = SDIO_SUPPORT_SDR104, .voltage = SD_VOL_1_8_V, .host_max = 208000000U,
		.initial_reg = 0x81U, .rejected_reg = 0x81U, .accepted_reg = 0x87U,
		.want_write_data = 0x87U, .accept_at = -1, .want_writes = -1, .want_sets = 1U,
		.want_clock = 208000000U, .want_timing = SDHC_TIMING_SDR104
	};

	sdio_speed_run_case(&test);
}

ZTEST(sdio_speed, test_delayed_sdr50)
{
	if (CONFIG_SD_RETRY_COUNT == 0) {
		ztest_test_skip();
	}
	const struct speed_case test = {
		.caps = SDIO_SUPPORT_SDR50, .voltage = SD_VOL_1_8_V, .host_max = 208000000U,
		.initial_reg = 0x8FU, .rejected_reg = 0xC1U, .accepted_reg = 0xC5U,
		.want_write_data = 0x85U, .accept_at = 2, .want_writes = 2, .want_sets = 1U,
		.want_clock = 100000000U, .want_timing = SDHC_TIMING_SDR50,
	};

	sdio_speed_run_case(&test);
}

ZTEST(sdio_speed, test_control_hs_3v3)
{
	const struct speed_case test = {
		ACCEPTED(SDIO_SUPPORT_HS, SD_VOL_3_3_V, 0x83U, 50000000U, SDHC_TIMING_HS)
	};

	sdio_speed_run_case(&test);
}

ZTEST(sdio_speed, test_control_hs_3v0)
{
	const struct speed_case test = {
		ACCEPTED(SDIO_SUPPORT_HS, SD_VOL_3_0_V, 0x83U, 50000000U, SDHC_TIMING_HS)
	};

	sdio_speed_run_case(&test);
}

ZTEST(sdio_speed, test_control_default_accepted)
{
	const struct speed_case test = {
		.voltage = SD_VOL_3_3_V, .host_max = 208000000U,
		.initial_reg = 0x80U, .accepted_reg = 0x80U, .want_write_data = 0x80U,
		.accept_at = 1, .want_writes = 1, .want_sets = 1U,
		.want_clock = 25000000U, .want_timing = SDHC_TIMING_LEGACY
	};

	sdio_speed_run_case(&test);
}

ZTEST(sdio_speed, test_control_host_cap)
{
	const struct speed_case test = {
		.caps = SDIO_SUPPORT_HS, .voltage = SD_VOL_3_3_V, .host_max = 40000000U,
		.initial_reg = 0x81U, .accepted_reg = 0x83U, .want_write_data = 0x83U,
		.accept_at = 1, .want_writes = 1, .want_sets = 1U,
		.want_clock = 40000000U, .want_timing = SDHC_TIMING_HS
	};

	sdio_speed_run_case(&test);
}

ZTEST(sdio_speed, test_control_read_error)
{
	const struct speed_case test = {
		.caps = SDIO_SUPPORT_HS, .voltage = SD_VOL_3_3_V, .host_max = 208000000U,
		.initial_reg = 0x81U, .read_error = -EIO, .want_ret = -EIO,
		.want_clock = 25000000U, .want_timing = SDHC_TIMING_LEGACY
	};

	sdio_speed_run_case(&test);
}

ZTEST(sdio_speed, test_control_write_error)
{
	const struct speed_case test = {
		.caps = SDIO_SUPPORT_HS, .voltage = SD_VOL_3_3_V, .host_max = 208000000U,
		.initial_reg = 0x81U, .want_write_data = 0x83U,
		.write_error = -ETIMEDOUT, .write_error_at = 1, .want_ret = -ETIMEDOUT,
		.want_writes = 1, .want_clock = 25000000U, .want_timing = SDHC_TIMING_LEGACY
	};

	sdio_speed_run_case(&test);
}

ZTEST(sdio_speed, test_control_second_write_error)
{
	if (CONFIG_SD_RETRY_COUNT == 0) {
		ztest_test_skip();
	}
	const struct speed_case test = {
		.caps = SDIO_SUPPORT_SDR50, .voltage = SD_VOL_1_8_V, .host_max = 208000000U,
		.initial_reg = 0x81U, .rejected_reg = 0x81U, .want_write_data = 0x85U,
		.write_error = -ETIMEDOUT, .write_error_at = 2, .want_ret = -ETIMEDOUT,
		.want_writes = 2, .want_clock = 25000000U, .want_timing = SDHC_TIMING_SDR12,
	};

	sdio_speed_run_case(&test);
}

ZTEST(sdio_speed, test_control_set_io_error)
{
	const struct speed_case test = {
		ACCEPTED(SDIO_SUPPORT_HS, SD_VOL_3_3_V, 0x83U, 50000000U, SDHC_TIMING_HS),
		.host_error = -EIO, .want_ret = -EIO
	};

	sdio_speed_run_case(&test);
}

ZTEST(sdio_speed, test_literal_01_rejected_hs)
{
	const struct speed_case test = {
		.caps = SDIO_SUPPORT_HS, .voltage = SD_VOL_3_3_V, .host_max = 208000000U,
		.initial_reg = 0x01U, .rejected_reg = 0x01U, .want_write_data = 0x03U,
		.want_writes = -1, .want_clock = 25000000U, .want_timing = SDHC_TIMING_LEGACY,
	};

	sdio_speed_run_case(&test);
}

ZTEST(sdio_speed, test_literal_01_rejected_sdr50)
{
	const struct speed_case test = {
		.caps = SDIO_SUPPORT_SDR50, .voltage = SD_VOL_1_8_V, .host_max = 208000000U,
		.initial_reg = 0x01U, .rejected_reg = 0x01U, .want_write_data = 0x05U,
		.want_writes = -1, .want_clock = 25000000U, .want_timing = SDHC_TIMING_SDR12,
	};

	sdio_speed_run_case(&test);
}

ZTEST(sdio_speed, test_literal_05_immediate_sdr50)
{
	const struct speed_case test = {
		.caps = SDIO_SUPPORT_SDR50, .voltage = SD_VOL_1_8_V, .host_max = 208000000U,
		.initial_reg = 0x01U, .accepted_reg = 0x05U, .want_write_data = 0x05U,
		.accept_at = 1, .want_writes = 1, .want_sets = 1U,
		.want_clock = 100000000U, .want_timing = SDHC_TIMING_SDR50,
	};

	sdio_speed_run_case(&test);
}

ZTEST(sdio_speed, test_literal_07_final_sdr104)
{
	const struct speed_case test = {
		.caps = SDIO_SUPPORT_SDR104, .voltage = SD_VOL_1_8_V, .host_max = 208000000U,
		.initial_reg = 0x01U, .rejected_reg = 0x01U, .accepted_reg = 0x07U,
		.want_write_data = 0x07U, .accept_at = -1, .want_writes = -1, .want_sets = 1U,
		.want_clock = 208000000U, .want_timing = SDHC_TIMING_SDR104,
	};

	sdio_speed_run_case(&test);
}

ZTEST_SUITE(sdio_speed, NULL, NULL, NULL, NULL, NULL);
```

## src/speed_test.c
```c
/*
 * SPDX-FileCopyrightText: Copyright The Zephyr Project Contributors
 * SPDX-License-Identifier: Apache-2.0
 */

#include <errno.h>
#include <zephyr/device.h>
#include <zephyr/drivers/sdhc.h>
#include <zephyr/fff.h>
#include <zephyr/sd/sd.h>
#include <zephyr/sd/sd_spec.h>
#include <zephyr/ztest.h>

#include "speed_test.h"
#include "sdio.c"

DEFINE_FFF_GLOBALS;
FAKE_VALUE_FUNC(int, fake_sdhc_request, const struct device *, struct sdhc_command *,
		struct sdhc_data *);
FAKE_VALUE_FUNC(int, fake_sdhc_set_io, const struct device *, struct sdhc_io *);
FAKE_VALUE_FUNC(int, fake_sdhc_execute_tuning, const struct device *);

static DEVICE_API(sdhc, fake_sdhc_api) = {
	.request = fake_sdhc_request,
	.set_io = fake_sdhc_set_io,
	.execute_tuning = fake_sdhc_execute_tuning,
};

DEVICE_DEFINE(sdio_speed_host, "sdio-speed-host", NULL, NULL, NULL, NULL,
	      POST_KERNEL, CONFIG_SDHC_INIT_PRIORITY, &fake_sdhc_api);

struct speed_fixture {
	const struct speed_case *test;
	uint32_t reads;
	uint32_t writes;
	uint8_t last_readback;
	bool card_accepted;
	struct sdhc_io requested_io;
};

static struct speed_fixture fixture;

static int request(const struct device *dev, struct sdhc_command *cmd,
		   struct sdhc_data *data)
{
	const struct speed_case *test = fixture.test;
	uint32_t read_arg = 0x13U << 9;
	int32_t accept_at = test->accept_at < 0 ? CONFIG_SD_RETRY_COUNT + 1 : test->accept_at;
	uint8_t expected_data;

	zassert_equal_ptr(dev, DEVICE_GET(sdio_speed_host));
	zassert_is_null(data);
	zassert_equal(cmd->opcode, 52U, "Expected CMD52");
	zassert_equal(cmd->response_type, SD_RSP_TYPE_R5 | SD_SPI_RSP_TYPE_R5);
	zassert_equal(cmd->timeout_ms, CONFIG_SD_CMD_TIMEOUT);
	if ((cmd->arg & BIT(31)) == 0U) {
		zassert_equal(cmd->arg, read_arg, "Unexpected CMD52 read encoding");
		fixture.reads++;
		if (test->read_error != 0) {
			return test->read_error;
		}
		cmd->response[0] = test->initial_reg;
		fixture.last_readback = test->initial_reg;
		return 0;
	}

	/* BSS bits are literal fixtures; other bits come from the latest readback. */
	expected_data = (fixture.last_readback & 0xF1U) | (test->want_write_data & 0x0EU);
	zassert_equal(cmd->arg, BIT(31) | BIT(27) | read_arg | expected_data,
		      "Unexpected CMD52 write/RAW/BSS encoding");
	fixture.writes++;
	if (test->write_error != 0 && fixture.writes == test->write_error_at) {
		return test->write_error;
	}
	fixture.card_accepted = accept_at > 0 && fixture.writes >= accept_at;
	fixture.last_readback = fixture.card_accepted ? test->accepted_reg : test->rejected_reg;
	cmd->response[0] = fixture.last_readback;
	return 0;
}

static int set_io(const struct device *dev, struct sdhc_io *io)
{
	zassert_equal_ptr(dev, DEVICE_GET(sdio_speed_host));
	zassert_true(fixture.card_accepted, "Host changed before CMD52 acceptance");
	fixture.requested_io = *io;
	if (fixture.test->validate_high_speed) {
		bool valid = (io->signal_voltage == SD_VOL_1_8_V &&
			      io->timing == SDHC_TIMING_SDR25) ||
			     ((io->signal_voltage == SD_VOL_3_0_V ||
			       io->signal_voltage == SD_VOL_3_3_V) &&
			      io->timing == SDHC_TIMING_HS);

		if (!valid) {
			return -EINVAL;
		}
	}
	return fixture.test->host_error;
}

void sdio_speed_run_case(const struct speed_case *test)
{
	struct sd_card card = {
		.sdhc = DEVICE_GET(sdio_speed_host),
		.bus_io = {
			.clock = 25000000U,
			.timing = test->voltage == SD_VOL_1_8_V ? SDHC_TIMING_SDR12 :
								       SDHC_TIMING_LEGACY,
			.signal_voltage = test->voltage,
		},
		.host_props = {
			.f_max = test->host_max,
			.host_caps = {
				.high_spd_support = true,
				.sdr50_support = true,
				.sdr104_support = true,
				.ddr50_support = true,
			},
		},
		.cccr_flags = test->caps,
	};
	uint32_t want_writes = test->want_writes < 0 ? CONFIG_SD_RETRY_COUNT + 1 :
						    test->want_writes;
	int32_t ret;

	fixture = (struct speed_fixture){.test = test};
	RESET_FAKE(fake_sdhc_request);
	RESET_FAKE(fake_sdhc_set_io);
	RESET_FAKE(fake_sdhc_execute_tuning);
	FFF_RESET_HISTORY();
	fake_sdhc_request_fake.custom_fake = request;
	fake_sdhc_set_io_fake.custom_fake = set_io;
	zassert_true(device_is_ready(card.sdhc));

	sdio_select_bus_speed(&card);
	ret = sdio_set_bus_speed(&card);
	if (test->validate_high_speed) {
		printk("SDIO validating host: raw=0x%02x voltage=%u timing=%u "
		       "clock=%u ret=%d\n", fixture.last_readback,
		       fixture.requested_io.signal_voltage, fixture.requested_io.timing,
		       fixture.requested_io.clock, ret);
	}

	zassert_equal(ret, test->want_ret, "Unexpected return code");
	zassert_equal(fixture.reads, 1U, "Must read initial CCCR speed once");
	zassert_equal(fixture.writes, want_writes, "Unexpected speed write count");
	zassert_equal(fake_sdhc_request_fake.call_count, 1U + want_writes);
	zassert_equal(fake_sdhc_set_io_fake.call_count, test->want_sets,
		      "Host changes require accepted card speed");
	zassert_equal(card.bus_io.clock, test->want_clock);
	zassert_equal(card.bus_io.timing, test->want_timing);
	zassert_equal(card.bus_io.signal_voltage, test->voltage);
	if (test->want_sets > 0U) {
		zassert_equal(fixture.requested_io.clock, test->want_clock);
		zassert_equal(fixture.requested_io.timing, test->want_timing);
		zassert_equal(fixture.requested_io.signal_voltage, test->voltage);
	}
}

struct sdio_init_fixture {
	const struct init_case *test;
	struct sd_card *card;
	uint32_t ocr_calls;
	uint32_t rca_calls;
	uint32_t select_calls;
	uint32_t read_index;
	uint32_t width_writes;
	uint32_t speed_writes;
	uint8_t speed_reg;
	struct sdhc_io tuning_io;
};

static struct sdio_init_fixture init_fixture;

static const uint32_t init_read_addresses[] = {
	0x00U, 0x01U, 0x08U, 0x13U, 0x14U, 0x15U,
	0x09U, 0x0AU, 0x0BU, 0x1000U, 0x07U, 0x13U,
};

static int init_request(const struct device *dev, struct sdhc_command *cmd,
			struct sdhc_data *data)
{
	uint32_t address;
	bool write;

	zassert_equal_ptr(dev, DEVICE_GET(sdio_speed_host));
	zassert_is_null(data);
	zassert_equal(cmd->timeout_ms, CONFIG_SD_CMD_TIMEOUT);
	switch (cmd->opcode) {
	case 5U:
		zassert_equal(cmd->response_type, SD_RSP_TYPE_R4 | SD_SPI_RSP_TYPE_R4);
		zassert_true(init_fixture.ocr_calls < 2U);
		zassert_equal(cmd->arg, init_fixture.ocr_calls == 0U ? 0U : 0x01300000U);
		init_fixture.ocr_calls++;
		cmd->response[0] = 0x91300000U;
		return 0;
	case 3U:
		zassert_equal(init_fixture.ocr_calls, 2U);
		zassert_equal(init_fixture.rca_calls++, 0U);
		zassert_equal(cmd->response_type, SD_RSP_TYPE_R6);
		zassert_equal(cmd->arg, 0U);
		cmd->response[0] = 0x00010000U;
		return 0;
	case 7U:
		zassert_equal(init_fixture.rca_calls, 1U);
		zassert_equal(init_fixture.select_calls++, 0U);
		zassert_equal(cmd->response_type, SD_RSP_TYPE_R1);
		zassert_equal(cmd->arg, 0x00010000U);
		cmd->response[0] = 0x00000900U;
		return 0;
	case 52U:
		zassert_equal(init_fixture.select_calls, 1U);
		zassert_equal(cmd->response_type, SD_RSP_TYPE_R5 | SD_SPI_RSP_TYPE_R5);
		break;
	default:
		zassert_unreachable("Unexpected initialization command %u", cmd->opcode);
		return -EINVAL;
	}

	address = (cmd->arg >> 9) & 0x1FFFFU;
	write = (cmd->arg & BIT(31)) != 0U;
	if (write) {
		uint8_t value;

		if (address == 0x07U) {
			zassert_equal(init_fixture.read_index, 11U);
			zassert_equal(init_fixture.width_writes++, 0U);
			value = 0x02U;
		} else {
			zassert_equal(address, 0x13U);
			zassert_equal(init_fixture.read_index, ARRAY_SIZE(init_read_addresses));
			zassert_equal(init_fixture.width_writes, 1U);
			init_fixture.speed_writes++;
			value = init_fixture.test->speed_write;
		}
		zassert_equal(cmd->arg, BIT(31) | BIT(27) | (address << 9) | value);
		if (address == 0x13U) {
			init_fixture.speed_reg = init_fixture.test->accept ? value : 0x01U;
			value = init_fixture.speed_reg;
		}
		cmd->response[0] = value;
		return 0;
	}

	zassert_equal(cmd->arg, address << 9);
	zassert_true(init_fixture.read_index < ARRAY_SIZE(init_read_addresses));
	zassert_equal(address, init_read_addresses[init_fixture.read_index++]);
	switch (address) {
	case 0x00U:
	case 0x01U:
		cmd->response[0] = 0x03U;
		break;
	case 0x13U:
		cmd->response[0] = init_fixture.speed_reg;
		break;
	case 0x14U:
		cmd->response[0] = init_fixture.test->uhs_reg;
		break;
	case 0x0AU:
		cmd->response[0] = 0x10U;
		break;
	case 0x1000U:
		cmd->response[0] = 0xFFU;
		break;
	default:
		cmd->response[0] = 0U;
		break;
	}
	return 0;
}

static int init_set_io(const struct device *dev, struct sdhc_io *io)
{
	zassert_equal_ptr(dev, DEVICE_GET(sdio_speed_host));
	zassert_equal(io->signal_voltage, SD_VOL_1_8_V);
	zassert_equal(io->bus_width, SDHC_BUS_WIDTH4BIT);
	if (fake_sdhc_set_io_fake.call_count == 1U) {
		zassert_equal(init_fixture.width_writes, 1U);
		zassert_equal(init_fixture.speed_writes, 0U);
		zassert_equal(io->clock, 25000000U);
		zassert_equal(io->timing, SDHC_TIMING_SDR12);
	} else {
		zassert_true(init_fixture.test->accept);
		zassert_equal(init_fixture.speed_writes, 1U);
		zassert_equal(io->clock, init_fixture.test->want_clock);
		zassert_equal(io->timing, init_fixture.test->want_timing);
	}
	return 0;
}

static int init_tune(const struct device *dev)
{
	zassert_equal_ptr(dev, DEVICE_GET(sdio_speed_host));
	init_fixture.tuning_io = init_fixture.card->bus_io;
	return init_fixture.test->tuning_error;
}

void sdio_speed_run_init_case(const struct init_case *test)
{
	struct sd_card card = {
		.sdhc = DEVICE_GET(sdio_speed_host),
		.bus_io = {
			.clock = 25000000U,
			.timing = SDHC_TIMING_SDR12,
			.signal_voltage = SD_VOL_1_8_V,
			.bus_width = SDHC_BUS_WIDTH1BIT,
		},
		.card_voltage = SD_VOL_1_8_V,
		.host_props = {
			.f_max = 208000000U,
			.bus_4_bit_support = true,
			.host_caps = {
				.vol_180_support = true,
				.high_spd_support = true,
				.sdr50_support = true,
				.sdr104_support = true,
			},
		},
	};
	uint32_t want_writes = test->accept ? 1U : CONFIG_SD_RETRY_COUNT + 1U;
	int32_t ret;

	init_fixture = (struct sdio_init_fixture){
		.test = test,
		.card = &card,
		.speed_reg = 0x01U,
	};
	RESET_FAKE(fake_sdhc_request);
	RESET_FAKE(fake_sdhc_set_io);
	RESET_FAKE(fake_sdhc_execute_tuning);
	FFF_RESET_HISTORY();
	fake_sdhc_request_fake.custom_fake = init_request;
	fake_sdhc_set_io_fake.custom_fake = init_set_io;
	fake_sdhc_execute_tuning_fake.custom_fake = init_tune;
	zassert_true(device_is_ready(card.sdhc));

	ret = sdio_card_init(&card);
	printk("SDIO init: uhs=0x%02x accept=%u requested=%u raw=0x%02x "
	       "clock=%u timing=%u width=%u sets=%u tunes=%u ret=%d\n",
	       test->uhs_reg, test->accept, card.card_speed, init_fixture.speed_reg,
	       card.bus_io.clock, card.bus_io.timing, card.bus_io.bus_width,
	       fake_sdhc_set_io_fake.call_count, fake_sdhc_execute_tuning_fake.call_count, ret);

	zassert_equal(ret, test->want_ret);
	zassert_equal(init_fixture.ocr_calls, 2U);
	zassert_equal(init_fixture.rca_calls, 1U);
	zassert_equal(init_fixture.select_calls, 1U);
	zassert_equal(init_fixture.read_index, ARRAY_SIZE(init_read_addresses));
	zassert_equal(init_fixture.width_writes, 1U);
	zassert_equal(init_fixture.speed_writes, want_writes);
	zassert_equal(fake_sdhc_request_fake.call_count, 17U + want_writes);
	zassert_equal(fake_sdhc_set_io_fake.call_count, test->accept ? 2U : 1U);
	zassert_equal(fake_sdhc_execute_tuning_fake.call_count, test->want_tunes);
	zassert_equal(card.type, CARD_SDIO);
	zassert_equal(card.num_io, 1U);
	zassert_equal(card.relative_addr, 1U);
	zassert_not_equal(card.flags & SD_1800MV_FLAG, 0U);
	zassert_equal_ptr(card.func0.card, &card);
	zassert_equal(card.bus_io.clock, test->want_clock);
	zassert_equal(card.bus_io.timing, test->want_timing);
	zassert_equal(card.bus_io.signal_voltage, SD_VOL_1_8_V);
	zassert_equal(card.bus_io.bus_width, SDHC_BUS_WIDTH4BIT);
	if (test->want_tunes > 0U) {
		zassert_equal(init_fixture.tuning_io.clock, test->want_clock);
		zassert_equal(init_fixture.tuning_io.timing, test->want_timing);
	}
}
```

## src/speed_test.h
```c
/*
 * SPDX-FileCopyrightText: Copyright The Zephyr Project Contributors
 * SPDX-License-Identifier: Apache-2.0
 */

#ifndef SDIO_SPEED_TEST_H_
#define SDIO_SPEED_TEST_H_

#include <stdbool.h>
#include <stdint.h>
#include <zephyr/drivers/sdhc.h>
#include <zephyr/sd/sd_spec.h>

struct speed_case {
	uint32_t caps;
	enum sd_voltage voltage;
	uint32_t host_max;
	uint8_t initial_reg;
	uint8_t rejected_reg;
	uint8_t accepted_reg;
	uint8_t want_write_data;
	int32_t accept_at;
	int32_t read_error;
	int32_t write_error;
	int32_t write_error_at;
	int32_t host_error;
	bool validate_high_speed;
	int32_t want_ret;
	int32_t want_writes;
	uint32_t want_sets;
	uint32_t want_clock;
	enum sdhc_timing_mode want_timing;
};

/* Initial attempt plus N retries; persistent rejection leaves the host unchanged. */
#define REJECTED(caps_, volts_, write_, readback_, timing_) \
	.caps = caps_, .voltage = volts_, .host_max = 208000000U, \
	.initial_reg = 0x81U, .rejected_reg = readback_, .want_write_data = write_, \
	.want_writes = -1, .want_clock = 25000000U, .want_timing = timing_

#define ACCEPTED(caps_, volts_, write_, clock_, timing_) \
	.caps = caps_, .voltage = volts_, .host_max = 208000000U, \
	.initial_reg = 0x81U, .rejected_reg = 0x81U, .accepted_reg = write_, \
	.want_write_data = write_, .accept_at = 1, .want_writes = 1, .want_sets = 1U, \
	.want_clock = clock_, .want_timing = timing_

void sdio_speed_run_case(const struct speed_case *test);

struct init_case {
	uint8_t uhs_reg;
	uint8_t speed_write;
	bool accept;
	uint32_t want_clock;
	enum sdhc_timing_mode want_timing;
	uint32_t want_tunes;
	int32_t tuning_error;
	int32_t want_ret;
};

void sdio_speed_run_init_case(const struct init_case *test);

#endif /* SDIO_SPEED_TEST_H_ */
```

## src/timing_cases.c
```c
/*
 * SPDX-FileCopyrightText: Copyright The Zephyr Project Contributors
 * SPDX-License-Identifier: Apache-2.0
 */

#include <errno.h>
#include <zephyr/ztest.h>

#include "speed_test.h"

ZTEST(sdio_speed, test_hs_1v8)
{
	const struct speed_case test = {
		ACCEPTED(SDIO_SUPPORT_HS, SD_VOL_1_8_V, 0x83U, 50000000U, SDHC_TIMING_SDR25)
	};

	sdio_speed_run_case(&test);
}

ZTEST(sdio_speed, test_hs_1v8_host_cap)
{
	const struct speed_case test = {
		.caps = SDIO_SUPPORT_HS, .voltage = SD_VOL_1_8_V, .host_max = 40000000U,
		.initial_reg = 0x81U, .accepted_reg = 0x83U, .want_write_data = 0x83U,
		.accept_at = 1, .want_writes = 1, .want_sets = 1U,
		.want_clock = 40000000U, .want_timing = SDHC_TIMING_SDR25
	};

	sdio_speed_run_case(&test);
}

ZTEST(sdio_speed, test_hs_1v8_set_io_error)
{
	const struct speed_case test = {
		ACCEPTED(SDIO_SUPPORT_HS, SD_VOL_1_8_V, 0x83U, 50000000U, SDHC_TIMING_SDR25),
		.host_error = -EIO, .want_ret = -EIO
	};

	sdio_speed_run_case(&test);
}

ZTEST(sdio_speed, test_literal_03_hs_1v8_validating_host)
{
	const struct speed_case test = {
		.caps = SDIO_SUPPORT_HS, .voltage = SD_VOL_1_8_V, .host_max = 208000000U,
		.initial_reg = 0x01U, .accepted_reg = 0x03U, .want_write_data = 0x03U,
		.accept_at = 1, .want_writes = 1, .want_sets = 1U,
		.want_clock = 50000000U, .want_timing = SDHC_TIMING_SDR25,
		.validate_high_speed = true,
	};

	sdio_speed_run_case(&test);
}
```
