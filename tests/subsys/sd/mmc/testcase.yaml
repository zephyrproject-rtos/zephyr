## tests/subsys/sd/mmc/testcase.yaml
```yaml
common:
  depends_on: sdhc
  tags: drivers sdhc
tests:
  sd.mmc:
    harness: ztest
    filter: dt_compat_enabled("zephyr,mmc-disk")
    tags: sdhc
    min_ram: 32
    integration_platforms:
      - mimxrt595_evk_cm33
```

## tests/subsys/sd/mmc_bandwidth/testcase.yaml
```yaml
common:
  depends_on: sdhc
  tags:
    - drivers
    - sdhc
tests:
  sd.mmcbandwidth:
    harness: ztest
    filter: dt_compat_enabled("zephyr,mmc-disk")
    tags: sdhc
    min_ram: 32
```

## tests/subsys/sd/multiple_mmcs/testcase.yaml
```yaml
common:
  depends_on: sdhc
  tags:
    - drivers
    - sdhc
    - kernel
tests:
  sd.multiple_mmc:
    harness: ztest
    filter: dt_alias_exists("sdhc0") and dt_compat_enabled("zephyr,mmc-disk")
            and dt_alias_exists("sdhc1")
    tags: sdhc
    min_ram: 32
    platform_allow:
      - apollo510_eb
  sd.multiple_mmc.build_only:
    harness: ztest
    filter: dt_alias_exists("sdhc0") and dt_compat_enabled("zephyr,mmc-disk")
            and dt_alias_exists("sdhc1")
    tags: sdhc
    min_ram: 32
    platform_allow: apollo510_evb
    build_only: true # Only support in Apollo EB board
```

## tests/subsys/sd/sdio/boards/arduino_giga_r1_stm32h747xx_m7.conf
```kconfig
# Copyright (c) 2025 EXALT Technologies.
# SPDX-License-Identifier: Apache-2.0

CONFIG_HEAP_MEM_POOL_SIZE=24576
```

## tests/subsys/sd/sdio/boards/arduino_nicla_vision_stm32h747xx_m7.conf
```kconfig
CONFIG_LOG=y
CONFIG_LOG_DEFAULT_LEVEL=3
CONFIG_LOG_MODE_MINIMAL=y
CONFIG_SDHC=y
CONFIG_SDMMC_STM32=y
CONFIG_HEAP_MEM_POOL_SIZE=24576
CONFIG_USB_DEVICE_STACK=y
CONFIG_USB_DEVICE_INITIALIZE_AT_BOOT=y
CONFIG_USB_CDC_ACM=y
CONFIG_LOG_MODE_DEFERRED=y
```

## tests/subsys/sd/sdio/boards/arduino_portenta_h7_stm32h747xx_m7.conf
```kconfig
# Copyright (c) 2022 Benjamin Björnsson <benjamin.bjornsson@gmail.com>.
# SPDX-License-Identifier: Apache-2.0
CONFIG_LOG=y
CONFIG_LOG_DEFAULT_LEVEL=3
CONFIG_LOG_MODE_MINIMAL=y
CONFIG_SDHC=y
CONFIG_SDMMC_STM32=y
CONFIG_HEAP_MEM_POOL_SIZE=24576
CONFIG_CACHE_MANAGEMENT=y
```

## tests/subsys/sd/sdio/testcase.yaml
```yaml
common:
  depends_on: sdhc
  tags: drivers sdhc
tests:
  sd.sdio:
    harness: ztest
    harness_config:
      fixture: fixture_sdhc
    filter: dt_alias_exists("sdhc0")
    tags: sdhc
    min_ram: 32
    integration_platforms:
      - mimxrt1064_evk
```

## tests/subsys/sd/sdio_card/testcase.yaml
```yaml
common:
  depends_on: sdhc
  tags:
    - drivers
    - sdhc
tests:
  sd.sdio_card:
    harness: ztest
    harness_config:
      fixture: fixture_sdhc
    filter: dt_alias_exists("sdhc1")
    tags: sdhc
    min_ram: 32
    platform_allow:
      - apollo510_eb
    build_only: true # Ambiq boards require physical SDIO card connection
```

## tests/subsys/sd/sdmmc/Kconfig
```kconfig
# Copyright 2022 NXP
# SPDX-License-Identifier: Apache-2.0

mainmenu "SD Host controller test"

source "Kconfig.zephyr"

config SDHC_LABEL
	string "SD host controller label"
	default "SDHC_0"
	help
	  Devicetree label for SD host controller. Used to get reference to
	  device
```

## tests/subsys/sd/sdmmc/boards/stm32h573i_dk.conf
```kconfig
# Copyright (c) 2026 STMicroelectronics
# SPDX-License-Identifier: Apache-2.0

CONFIG_HEAP_MEM_POOL_SIZE=2048
```

## tests/subsys/sd/sdmmc/testcase.yaml
```yaml
common:
  depends_on: sdhc
  tags:
    - drivers
    - sdhc
tests:
  sd.sdmmc:
    harness: ztest
    harness_config:
      fixture: fixture_sdhc
    filter: dt_compat_enabled("zephyr,sdmmc-disk")
    tags: sdhc
    min_ram: 32
    integration_platforms:
      - mimxrt1064_evk
```

## tests/subsys/secure_storage/psa/crypto/Kconfig
```kconfig
# Copyright (c) 2025 Embeint Inc
# SPDX-License-Identifier: Apache-2.0

# We explicitly don't want SECURE_STORAGE_ITS_IMPLEMENTATION_MBEDTLS here
# as it implements `psa_ps_*` and not the underlying `secure_storage_its_*`.
choice SECURE_STORAGE_ITS_IMPLEMENTATION
	default SECURE_STORAGE_ITS_IMPLEMENTATION_ZEPHYR
	default SECURE_STORAGE_ITS_IMPLEMENTATION_CUSTOM
endchoice

source "Kconfig.zephyr"
```

## tests/subsys/secure_storage/psa/crypto/testcase.yaml
```yaml
common:
  tags:
    - psa.secure_storage
tests:
  secure_storage.psa.crypto.secure_storage:
    filter: CONFIG_SECURE_STORAGE and not CONFIG_SECURE_STORAGE_ITS_STORE_IMPLEMENTATION_NONE
    extra_args: EXTRA_CONF_FILE=overlay-secure_storage.conf
    integration_platforms:
      - native_sim
      - nrf54l15dk/nrf54l15/cpuapp
      - ophelia4ev/nrf54l15/cpuapp
  secure_storage.psa.crypto.tfm:
    filter: CONFIG_BUILD_WITH_TFM
    extra_args: EXTRA_CONF_FILE=overlay-tfm.conf
    integration_platforms:
      - nrf9151dk/nrf9151/ns
```

## tests/subsys/secure_storage/psa/its/Kconfig
```kconfig
# Copyright (c) 2025 Embeint Inc
# SPDX-License-Identifier: Apache-2.0

# We explicitly don't want SECURE_STORAGE_ITS_IMPLEMENTATION_MBEDTLS here
choice SECURE_STORAGE_ITS_IMPLEMENTATION
	default SECURE_STORAGE_ITS_IMPLEMENTATION_ZEPHYR
	default SECURE_STORAGE_ITS_IMPLEMENTATION_CUSTOM
endchoice

source "Kconfig.zephyr"
```

## tests/subsys/secure_storage/psa/its/testcase.yaml
```yaml
common:
  integration_platforms:
    - native_sim
  platform_exclude:
    - qemu_cortex_m0 # settings subsystem initialization fails
  timeout: 120
  tags:
    - psa.secure_storage
tests:
  secure_storage.psa.its.secure_storage:
    filter: CONFIG_SECURE_STORAGE and not CONFIG_SECURE_STORAGE_ITS_STORE_IMPLEMENTATION_NONE
    extra_args: "EXTRA_CONF_FILE=\
      overlay-secure_storage.conf;overlay-default_transform.conf;overlay-default_store.conf"
    integration_platforms:
      - native_sim
      - nrf54l15dk/nrf54l15/cpuapp
  secure_storage.psa.its.secure_storage.custom.transform:
    filter: CONFIG_SECURE_STORAGE and not CONFIG_SECURE_STORAGE_ITS_STORE_IMPLEMENTATION_NONE
    extra_args: "EXTRA_CONF_FILE=\
      overlay-secure_storage.conf;overlay-custom_transform.conf;overlay-default_store.conf"
    integration_platforms:
      - native_sim
      - nrf54l15dk/nrf54l15/cpuapp
  secure_storage.psa.its.secure_storage.custom.store:
    filter: CONFIG_SECURE_STORAGE
    extra_args: "EXTRA_CONF_FILE=\
      overlay-secure_storage.conf;overlay-default_transform.conf;overlay-custom_store.conf"
    integration_platforms:
      - native_sim
      - nrf54l15dk/nrf54l15/cpuapp
  secure_storage.psa.its.secure_storage.custom.both:
    filter: CONFIG_SECURE_STORAGE
    extra_args: "EXTRA_CONF_FILE=\
      overlay-secure_storage.conf;overlay-custom_transform.conf;overlay-custom_store.conf"
    integration_platforms:
      - native_sim
      - nrf54l15dk/nrf54l15/cpuapp
  secure_storage.psa.its.tfm:
    filter: CONFIG_BUILD_WITH_TFM
    extra_args: EXTRA_CONF_FILE=overlay-tfm.conf
    integration_platforms:
      - nrf9151dk/nrf9151/ns
```

## tests/subsys/sensing/boards/native_sim.conf
```kconfig
#Enable BMI160 and BMI160 Emulator
CONFIG_BMI160_TRIGGER_NONE=y
CONFIG_EMUL_BMI160=y
CONFIG_SENSOR=y
CONFIG_SENSOR_INFO=y
```

## tests/subsys/settings/dt_init/testcase.yaml
```yaml
# SPDX-License-Identifier: Apache-2.0
# Copyright (c) 2022 Marcin Niestroj

common:
  platform_allow: nrf52840dk_nrf52840 native_posix native_posix_64
  integration_platforms:
    - nrf52840dk_nrf52840
    - native_posix

tests:
  system.settings.dt_init.fcb_nvs:
    tags: settings_fcb settings_nvs
    extra_args: DTC_OVERLAY_FILE=fcb_nvs.overlay
  system.settings.dt_init.file_file_one_partition:
    tags: settings_file
    extra_args: DTC_OVERLAY_FILE=file_file_one_partition.overlay
  system.settings.dt_init.file_file_two_partitions:
    tags: settings_file
    extra_args: DTC_OVERLAY_FILE=file_file_two_partitions.overlay
  system.settings.dt_init.file_nvs:
    tags: settings_file settings_nvs
    extra_args: DTC_OVERLAY_FILE=file_nvs.overlay
  system.settings.dt_init.nvs_fcb:
    tags: settings_fcb settings_nvs
    extra_args: DTC_OVERLAY_FILE=nvs_fcb.overlay
  system.settings.dt_init.nvs_file:
    tags: settings_file settings_nvs
    extra_args: DTC_OVERLAY_FILE=nvs_file.overlay
```

## tests/subsys/settings/eeprom/raw/testcase.yaml
```yaml
tests:
  system.settings.eeprom:
    depends_on: eeprom
    min_ram: 32
    tags: settings_eeprom
```

## tests/subsys/settings/fcb/base64/testcase.yaml
```yaml
tests:
  system.settings.fcb.base64:
    platform_allow: nrf52840dk_nrf52840 nrf52dk_nrf52832 native_posix native_posix_64
    tags: settings_fcb
```

## tests/subsys/settings/fcb/raw/Kconfig
```kconfig
config SETTINGS_FCB_FLASH_AREA
	default $(dt_int_val,DT_FLASH_AREA_IMAGE_SCRATCH_ID)

source "Kconfig.zephyr"
```

## tests/subsys/settings/fcb/testcase.yaml
```yaml
tests:
  settings.fcb.raw:
    platform_allow:
      - nrf52840dk/nrf52840
      - nrf52dk/nrf52832
      - native_sim
      - native_sim/native/64
      - mr_canhubk3
      - s32z2xxdc2/s32z270/rtu0
      - s32z2xxdc2/s32z270/rtu1
      - s32z2xxdc2@D/s32z270/rtu0
      - s32z2xxdc2@D/s32z270/rtu1
    integration_platforms:
      - nrf52840dk/nrf52840
      - native_sim
    tags:
      - settings
      - fcb
```

## tests/subsys/settings/fcb_init/Kconfig
```kconfig
config SETTINGS_FCB_FLASH_AREA
	default $(dt_int_val,DT_FLASH_AREA_STORAGE_ID)

source "Kconfig.zephyr"
```

## tests/subsys/settings/fcb_init/testcase.yaml
```yaml
tests:
  system.settings.fcb:
    platform_allow: nrf52840dk_nrf52840 nrf52dk_nrf52832
    integration_platforms:
      - nrf52840dk_nrf52840
    tags: settings_intialization_fcb
```
