/*
 * Copyright 2026 Alif Semiconductor
 *
 * SPDX-License-Identifier: Apache-2.0
 */
/ {
	sdio_speed_host: sdhc-emul-controller-sdio {
		compatible = "zephyr,sdhc-emul-controller";
		#address-cells = <1>;
		#size-cells = <0>;
		max-bus-freq = <50000000>;
		bus-width = <4>;
		high-speed;
		voltage-330;
		status = "okay";

		sdio_card: sdio-card@0 {
			compatible = "zephyr,sdhc-emul-card";
			reg = <0>;
			card-type = "sdio";
			capacity-blocks = <128>;
			sdio-func-count = <2>;
			card-inserted;
			status = "okay";
		};
	};
};
