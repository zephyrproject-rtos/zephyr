## tests/subsys/logging/log_benchmark/testcase.yaml
```yaml
common:
  integration_platforms:
    - native_sim/native
  tags: logging
tests:
  logging.benchmark:
    extra_configs:
      - CONFIG_LOG_MODE_DEFERRED=y
      - CONFIG_CBPRINTF_COMPLETE=y
  logging.benchmark_speed:
    extra_configs:
      - CONFIG_LOG_MODE_DEFERRED=y
      - CONFIG_CBPRINTF_COMPLETE=y
      - CONFIG_LOG_SPEED=y
  logging.benchmark_user:
    integration_platforms:
      - qemu_x86/atom
    platform_allow:
      - qemu_x86/atom
      - native_posix/native
      - native_sim/native
    extra_configs:
      - CONFIG_LOG_MODE_DEFERRED=y
      - CONFIG_CBPRINTF_COMPLETE=y
      - CONFIG_TEST_USERSPACE=y
```

## tests/subsys/logging/log_blocking/Kconfig
```kconfig
# Copyright (c) 2023 Meta
# SPDX-License-Identifier: Apache-2.0

source "Kconfig.zephyr"

config TEST_NUM_LOGS
	int "Number of log messages per test"
	default 5000

config TEST_INPUT_LOG_RATE
	int "Maximal input log rate for the test (in msg/s)"
	default 1000
	help
	  Specify the maximum rate at which messages will be logged from the
	  application.

config TEST_OUTPUT_LOG_RATE
	int "Maximal output log rate for the test (in msg/s)"
	default 1000
	help
	  Specify the maximum rate at which log messages will be handled by
	  the log backend.
```

## tests/subsys/logging/log_blocking/testcase.yaml
```yaml
common:
  filter: CONFIG_QEMU_TARGET and not CONFIG_SMP
  tags:
    - log_api
    - logging
  integration_platforms:
    - qemu_x86
tests:
  logging.blocking.rate.input_limited:
    extra_configs:
      - CONFIG_TEST_INPUT_LOG_RATE=500
      - CONFIG_TEST_OUTPUT_LOG_RATE=1000
  logging.blocking.rate.matched:
    extra_configs:
      - CONFIG_TEST_INPUT_LOG_RATE=1000
      - CONFIG_TEST_OUTPUT_LOG_RATE=1000
  logging.blocking.rate.output_limited:
    extra_configs:
      - CONFIG_TEST_INPUT_LOG_RATE=1000
      - CONFIG_TEST_OUTPUT_LOG_RATE=500
  logging.blocking.rate.stalled:
    platform_exclude:
      # twister fails with "unexpected eof" even though the test passes
      - qemu_cortex_r5
    timeout: 5
    extra_configs:
      - CONFIG_TEST_INPUT_LOG_RATE=1000
      - CONFIG_TEST_OUTPUT_LOG_RATE=0
```

## tests/subsys/logging/log_cache/testcase.yaml
```yaml
common:
  integration_platforms:
    - native_sim/native

tests:
  logging.cache:
    tags:
      - log_cache
      - logging
```

## tests/subsys/logging/log_core/testcase.yaml
```yaml
tests:
  logging.log_core:
    integration_platforms:
      - native_posix
    tags: log_core logging
    filter: not CONFIG_LOG_IMMEDIATE
```

## tests/subsys/logging/log_core_additional/testcase.yaml
```yaml
tests:
  logging.async:
    tags: logging
    extra_args: CONF_FILE=prj.conf
    integration_platforms:
      - native_sim
  logging.sync:
    tags: logging
    extra_args: CONF_FILE=log_sync.conf
    integration_platforms:
      - native_sim
  logging.thread:
    tags: logging
    extra_args: CONF_FILE=log_thread.conf
    integration_platforms:
      - native_sim
  logging.log_user:
    tags: logging
    filter: CONFIG_USERSPACE
    extra_args:
      - CONF_FILE=log_user.conf
      - USERSPACE_TEST=1
    integration_platforms:
      - qemu_x86
```

## tests/subsys/logging/log_custom_header/testcase.yaml
```yaml
common:
  integration_platforms:
    - native_sim/native

tests:
  logging.log_custom_header:
    tags:
      - log_custom_header
      - logging
```

## tests/subsys/logging/log_disabled/testcase.yaml
```yaml
common:
  tags:
    - logging
  build_only: true
  platform_allow:
    - native_sim
  integration_platforms:
    - native_sim

tests:
  logging.log_disable:
    harness: console
    harness_config:
      type: one_line
      regex:
        - "All done."
```

## tests/subsys/logging/log_frontend_stmesp_demux/testcase.yaml
```yaml
common:
  filter: not CONFIG_BIG_ENDIAN
tests:
  debug.coresight.stp_demux:
    integration_platforms:
      - native_posix
  debug.coresight.stp_demux_max_utilization:
    integration_platforms:
      - native_posix
    extra_configs:
      - CONFIG_LOG_FRONTEND_STMESP_DEMUX_MAX_UTILIZATION=y
```

## tests/subsys/logging/log_immediate/boards/intel_adsp_cavs25.conf
```kconfig
CONFIG_DMA=y
CONFIG_LOG_BACKEND_ADSP=n
CONFIG_LOG_BACKEND_ADSP_HDA=y
CONFIG_LOG_BACKEND_ADSP_HDA_CAVSTOOL=y
```

## tests/subsys/logging/log_immediate/testcase.yaml
```yaml
common:
  integration_platforms:
    - native_sim

tests:
  logging.immediate:
    tags:
      - log_core
      - logging
    timeout: 80
    platform_exclude:
      - nucleo_l053r8
      - nucleo_f030r8
      - stm32f0_disco
      - nrf52_bsim
  logging.immediate.clean_output:
    extra_args: CONFIG_LOG_IMMEDIATE_CLEAN_OUTPUT=y
    tags:
      - log_core
      - logging
    timeout: 80
    platform_exclude:
      - nucleo_l053r8
      - nucleo_f030r8
      - stm32f0_disco
      - nrf52_bsim
```
