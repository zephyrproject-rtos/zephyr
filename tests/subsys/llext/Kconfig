## tests/subsys/llext/Kconfig
```kconfig
# SPDX-License-Identifier: Apache-2.0
# Copyright (c) 2025 Intel Corporation.

mainmenu "LLEXT tests"

config MP_MAX_NUM_CPUS
	default 1 if LLEXT_READONLY_1CPU

source "Kconfig.zephyr"

config LLEXT_INC_IN_TEXT
	bool "Put extension .inc array in .text instead of .data"
	help
	  Put the llext extension .inc arrays from the LLEXT subsys tests
	  in .text instead of .data by default. This is useful for when the
	  memory region the linker places .data in by default is not suitable
	  for execution.

config LLEXT_READONLY_1CPU
	bool "Enable this when using readonly elf buffer on 1 CPU"
	depends on SOC_SERIES_INTEL_ADSP_ACE20 || \
		SOC_SERIES_INTEL_ADSP_ACE30 || \
		SOC_SERIES_INTEL_ADSP_ACE40
	select LLEXT_CUSTOM_HEAP_PLACEMENT
```

## tests/subsys/llext/userspace/Kconfig
```kconfig
# SPDX-License-Identifier: Apache-2.0
# Copyright (c) 2025 Intel Corporation.

rsource "../Kconfig"
```

## tests/subsys/logging/log_backend_limit/Kconfig
```kconfig
# Copyright (c) 2026 Jacob Beningo
# SPDX-License-Identifier: Apache-2.0

config TEST_NUM_BACKENDS
	int "Number of test backends"
	default 32 if !LOG_RUNTIME_FILTERING
	default 8 if LOG_FRONTEND
	default 9
	help
	  Must equal the maximum number of backends. With runtime filtering this
	  is LOG_FILTERS_MAX_BACKENDS: 32-bit filter word of 3-bit slots, minus
	  the aggregated slot, minus the frontend slot if present. Without it,
	  the limit is the 32-bit backend activation mask.

source "Kconfig.zephyr"
```

## tests/subsys/logging/log_ipc/Kconfig
```kconfig
# Copyright (c) 2026 Nordic Semiconductor ASA
# SPDX-License-Identifier: Apache-2.0

config TEST_LOG_IPC_EARLY_LOGS
	bool "Remote delivers logs created before IPC is bound"
	default y
	help
	  Set by sysbuild based on the remote configuration. When enabled, logs
	  created by the remote before the IPC endpoint is bound shall arrive.
	  When disabled, they shall be dropped and the drop shall be reported.

config TEST_LOG_IPC_BURST_CNT
	int "Number of messages in the burst test"
	default 20
	help
	  Set by sysbuild based on the remote configuration. IPC backend on the
	  remote sends each log message in a separate IPC buffer and drops
	  messages when there are no free buffers so burst must be smaller than
	  the number of IPC TX blocks.

source "Kconfig.zephyr"
```

## tests/subsys/logging/log_ipc/remote/boards/nrf54l15dk_nrf54l15_cpuflpr.conf
```kconfig
# CPUFLPR has limited RAM.
CONFIG_CBPRINTF_CONVERT_CHECK_PTR=n
#CONFIG_SERIAL=n
#CONFIG_CONSOLE=n
#CONFIG_UART_CONSOLE=n
#CONFIG_PRINTK=n
```

## tests/subsys/lorawan/join_backoff/Kconfig
```kconfig
# SPDX-License-Identifier: Apache-2.0
# Copyright (c) 2026 Embeint Inc

config LORAWAN
	bool "Override without dependencies"

source "Kconfig.zephyr"
```

## tests/subsys/lorawan/native/Kconfig
```kconfig
# Copyright (c) 2026 Embeint Inc
# SPDX-License-Identifier: Apache-2.0

source "Kconfig.zephyr"

choice TEST_LORAWAN_NATIVE_REGION
	prompt "LoRaWAN native test region"
	default TEST_LORAWAN_NATIVE_REGION_EU868

config TEST_LORAWAN_NATIVE_REGION_EU868
	bool "EU868"
	depends on LORAWAN_REGION_EU868

endchoice
```

## tests/subsys/mc/board/Kconfig
```kconfig
# Copyright The Zephyr Project Contributors
# SPDX-License-Identifier: Apache-2.0

mainmenu "MC two-board tests"

source "Kconfig.zephyr"

config MC_BOARD_COMBINED
	bool
	default y

config MC_UART_SENDER
	bool "Run the sender role"
	help
	  Initiate the UART communication and message tests.

config TEST_MC_STRESS_UART
	bool
	default y
	depends on SERIAL

config TEST_MC_STRESS_SENDER
	bool
	default MC_UART_SENDER
	depends on TEST_MC_STRESS_UART
```

## tests/subsys/mc/comm_stress/Kconfig
```kconfig
# Copyright The Zephyr Project Contributors
# SPDX-License-Identifier: Apache-2.0

mainmenu "MC communication stress tests"

source "Kconfig.zephyr"

config TEST_MC_STRESS_UART
	bool "Use the two-board UART transport"
	depends on SERIAL
	help
	  Run the communication tests between two boards over UART.

config TEST_MC_STRESS_SENDER
	bool "Run the UART sender role"
	depends on TEST_MC_STRESS_UART
	help
	  Send test payloads to the receiver board.
```

## tests/subsys/mc/uart/Kconfig
```kconfig
# Copyright The Zephyr Project Contributors
# SPDX-License-Identifier: Apache-2.0

mainmenu "MC UART integration test"

source "Kconfig.zephyr"

config MC_UART_SENDER
	bool "MC UART sender"
	help
	  Configure this board to initiate the UART integration test. Disable
	  this option on the peer board to configure it as the receiver.

config MC_UART_MSG_TEST
	bool "Test the MC message layer over UART"
	help
	  Select the message and signal test instead of the communication test.
```

## tests/subsys/mgmt/mcumgr/transport_ethernet/Kconfig
```kconfig
# Copyright The Zephyr Project Contributors
# SPDX-License-Identifier: Apache-2.0

mainmenu "Ethernet SMP transport tests"

config TEST_ETH_HW_FILTERING
	bool "Advertise hardware MAC filtering on the test interfaces"
	help
	  Exercise destination rejection when the driver advertises hardware
	  MAC filtering. The test interfaces still deliver group frames to L2.

source "Kconfig.zephyr"
```

## tests/subsys/pm/device_runtime_stress/Kconfig
```kconfig
# SPDX-FileCopyrightText: Copyright 2026 NXP
#
# SPDX-License-Identifier: Apache-2.0

source "Kconfig.zephyr"

config TEST_PM_DEVICE_RUNTIME_HOOKS
	bool "Enable runtime PM test hooks"
	default y

config TEST_PM_DEVICE_ISR_SAFE
	bool "Use ISR-safe PM for the stress device"
```

## tests/subsys/pm/power_mgmt/Kconfig
```kconfig
# Copyright (c) 2023 Nordic Semiconductor ASA
# Copyright 2026 NXP
# SPDX-License-Identifier: Apache-2.0

menu "Zephyr"
source "Kconfig.zephyr"
endmenu

config TEST_PROVIDE_PM_HOOKS
	bool "Provide PM hooks for test purposes"
	default y
	select HAS_PM

config TEST_PM_TIMER_RESTART
	bool "Test timer and PM resume ordering"
	depends on CORTEX_M_SYSTICK
```

## tests/subsys/pm/system_timer_lpm/boards/nucleo_l152re.conf
```kconfig
# SPDX-FileCopyrightText: Copyright The Zephyr Project Contributors
# SPDX-License-Identifier: Apache-2.0

CONFIG_IDLE_STACK_SIZE=512
```

## tests/subsys/rc/core/Kconfig
```kconfig
# SPDX-FileCopyrightText: Copyright (c) 2026 Linumiz
# SPDX-License-Identifier: Apache-2.0

config TEST_RC_CALLBACKS
	bool "Build the rc callback tests"
	default y
	help
	  Disable to test a build without any rc callback.

source "Kconfig.zephyr"
```

## tests/subsys/retention/api/Kconfig
```kconfig
#
# Copyright (c) 2023, Nordic Semiconductor ASA
#
# SPDX-License-Identifier: Apache-2.0
#

mainmenu "Retention test"

config RETENTION_SIZE_LIMITED
	bool "Size limited test"
	help
	  Will limit data size for test to 1 byte instead of 10 bytes

source "Kconfig.zephyr"
```

## tests/subsys/safety/safety_test/Kconfig
```kconfig
# Copyright (c) 2026 Aerlync Labs Inc.
# SPDX-License-Identifier: Apache-2.0

choice
	prompt "Critical boot test registered by this suite"
	default SAFETY_TEST_TESTS_BOOT_PASS
	help
	  Which critical boot test the suite registers. safety_test_boot_passed()
	  has three answers and they need three different sets of registered
	  tests, which is a compile-time property.

config SAFETY_TEST_TESTS_BOOT_PASS
	bool "one that passes"

config SAFETY_TEST_TESTS_BOOT_FAIL
	bool "one that fails"

config SAFETY_TEST_TESTS_BOOT_NONE
	bool "none at all"

endchoice

source "Kconfig.zephyr"
```

## tests/subsys/sd/sdio/emul/boards/native_sim.conf
```kconfig
# Copyright 2026 Alif Semiconductor
# SPDX-License-Identifier: Apache-2.0

CONFIG_SDHC_EMUL=y
```

## tests/subsys/sd/sdio_speed/Kconfig
```kconfig
# SPDX-FileCopyrightText: Copyright The Zephyr Project Contributors
# SPDX-License-Identifier: Apache-2.0

mainmenu "SDIO bus speed tests"

source "Kconfig.zephyr"

config SDIO_SPEED_TEST
	bool
	default y
	select SDMMC_STACK
	select SDHC_SUPPORTS_NATIVE_MODE
	select SDHC_SUPPORTS_UHS
```

## tests/subsys/sd/sdmmc/boards/stm32h5f5j_dk.conf
```kconfig
# Copyright (c) 2026 EXALT Technologies
# SPDX-License-Identifier: Apache-2.0

CONFIG_SDHC=y
CONFIG_SDHC_STM32_DMA_MODE=y
```

## tests/subsys/sd/sdmmc/boards/stm32h735g_disco.conf
```kconfig
# Copyright (c) 2026 EXALT Technologies
# SPDX-License-Identifier: Apache-2.0

CONFIG_SDHC=y
CONFIG_SDMMC_STM32=n
CONFIG_SDHC_STM32_DMA_MODE=y
CONFIG_HEAP_MEM_POOL_SIZE=2048
```
