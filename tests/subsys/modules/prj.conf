## CMakeLists.txt
```
# Copyright (c) 2023 Intel Corporation.
# SPDX-License-Identifier: Apache-2.0

cmake_minimum_required(VERSION 3.20.0)
find_package(Zephyr REQUIRED HINTS $ENV{ZEPHYR_BASE})
project(modules_test)

target_sources(app PRIVATE src/test_modules_simple.c)

target_include_directories(app PRIVATE
  ${ZEPHYR_BASE}/include
	${ZEPHYR_BASE}/kernel/include
	${ZEPHYR_BASE}/arch/${ARCH}/include)

set(gen_dir ${ZEPHYR_BINARY_DIR}/include/generated/)

# Each architecture should build its own elf using the SDK toolchain
# in a required manner.
foreach(inc_file
    hello_world_armv7_thumb.elf
    hello_world_xtensa.elf
    )
  generate_inc_file_for_target(
    app
    src/${inc_file}
    ${gen_dir}/${inc_file}.inc
    )
endforeach()
```

## prj.conf
```kconfig
CONFIG_ZTEST=y
CONFIG_ZTEST_NEW_API=y
CONFIG_ZTEST_STACK_SIZE=8192
CONFIG_LOG=y
CONFIG_LOG_MODE_IMMEDIATE=y
CONFIG_MODULES=y
CONFIG_MODULES_HEAP_SIZE=32
CONFIG_MODULES_LOG_LEVEL_DBG=y
```

## src/hello_world.c
```c
/*
 * Copyright (c) 2023 Intel Corporation.
 *
 * SPDX-License-Identifier: Apache-2.0
 */

/*
 * This very simple hello world C code can be used as a test case for building probably the simplest
 * loadable module. It requires a single symbol be linked, section relocation support, and the
 * ability to export and call out to a function.
 *
 */

/* Various build options should be documented here to generate the test elf for each architecture
 *
 * armv7-thumb: -mlong-call -mthumb -c -o hello_world_armv7_thumb.elf hello_world.c
 */

extern void printk(char *fmt, ...);

extern void hello_world(void)
{
	printk("hello world\n");
}
```

## src/test_modules_simple.c
```c
/*
 * Copyright (c) 2023 Intel Corporation.
 *
 * SPDX-License-Identifier: Apache-2.0
 */

#include <zephyr/ztest.h>
#include <zephyr/kernel.h>
#include <zephyr/modules/module.h>
#include <zephyr/modules/buf_stream.h>

#if defined(CONFIG_ARM) /* ARMV7 */
const static uint8_t hello_world_elf[] = {
#include "hello_world_armv7_thumb.elf.inc"
};
#elif defined(CONFIG_XTENSA)
const static uint8_t hello_world_elf[] __attribute__((aligned(4))) = {
#include "hello_world_xtensa.elf.inc"
};
#endif

/**
 * Attempt to load, list, list symbols, call a fn, and unload a
 * hello world module for each supported architecture
 *
 * This requires a single linked symbol (printk) and a single
 * exported symbol from the module ( void hello_world(void))
 */
ZTEST(modules, test_modules_simple)
{
	const char name[16] = "hello";
	struct module_buf_stream buf_stream =
		MODULE_BUF_STREAM(hello_world_elf, ARRAY_SIZE(hello_world_elf));
	struct module_stream *stream = &buf_stream.stream;
	struct module *m;

	int res = module_load(stream, name, &m, true);

	zassert_ok(res, "Load should succeed");

	void *hello_world_fn = module_find_sym(&m->sym_tab, "hello_world");

	zassert_not_null(hello_world_fn, "hello_world should be an exported module symbol");

	res = module_call_fn(m, "hello_world");

	zassert_ok(res, "Calling hello world should succeed");

	module_unload(m);
}

ZTEST_SUITE(modules, NULL, NULL, NULL, NULL, NULL);
```
