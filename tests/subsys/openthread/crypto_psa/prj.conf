## CMakeLists.txt
```
# Copyright (c) 2026 The Zephyr Project Contributors
# SPDX-License-Identifier: Apache-2.0

cmake_minimum_required(VERSION 3.28.0)
find_package(Zephyr REQUIRED HINTS $ENV{ZEPHYR_BASE})
project(openthread_crypto_psa)

if(NOT ZEPHYR_OPENTHREAD_MODULE_DIR)
  message(FATAL_ERROR "OpenThread module directory not found")
endif()

# Build the platform implementation here. CONFIG_OPENTHREAD also builds and
# links the OpenThread stack, which this test does not run. The compile
# definitions select the same context ownership as
# CONFIG_OPENTHREAD_CRYPTO_PLATFORM_ALLOCS_CONTEXT with PSA key references.
target_sources(app PRIVATE
  src/main.c
  ${ZEPHYR_BASE}/modules/openthread/platform/crypto_psa.c
)
# Use one context of each type so the tests can exhaust every slab. This test
# enables the feature with a compile definition instead of CONFIG_OPENTHREAD,
# so the slab sizes are not supplied by Kconfig.
target_compile_definitions(app PRIVATE
  CONFIG_OPENTHREAD_CRYPTO_PLATFORM_ALLOCS_CONTEXT
  CONFIG_OPENTHREAD_CRYPTO_PLATFORM_ALLOCS_CONTEXT_SHA256_COUNT=1
  CONFIG_OPENTHREAD_CRYPTO_PLATFORM_ALLOCS_CONTEXT_HMAC_SHA256_COUNT=1
  CONFIG_OPENTHREAD_CRYPTO_PLATFORM_ALLOCS_CONTEXT_HKDF_COUNT=1
  CONFIG_OPENTHREAD_CRYPTO_PLATFORM_ALLOCS_CONTEXT_AES_COUNT=1
  CONFIG_OPENTHREAD_PLATFORM_KEY_REF=1
)
target_include_directories(app PRIVATE
  ${ZEPHYR_OPENTHREAD_MODULE_DIR}/include
)
```

## prj.conf
```kconfig
# SPDX-License-Identifier: Apache-2.0

CONFIG_ZTEST=y
CONFIG_ZTEST_STACK_SIZE=4096
CONFIG_MAIN_STACK_SIZE=4096

# Algorithms used by the OpenThread PSA platform crypto API.
CONFIG_PSA_CRYPTO=y
CONFIG_PSA_WANT_ALG_SHA_256=y
CONFIG_PSA_WANT_ALG_HMAC=y
CONFIG_PSA_WANT_KEY_TYPE_HMAC=y
CONFIG_PSA_WANT_KEY_TYPE_AES=y
CONFIG_PSA_WANT_ALG_ECB_NO_PADDING=y
CONFIG_PSA_WANT_ALG_HKDF=y
CONFIG_PSA_WANT_ALG_HKDF_EXTRACT=y
CONFIG_PSA_WANT_ALG_HKDF_EXPAND=y
CONFIG_PSA_WANT_KEY_TYPE_DERIVE=y

# PSA key import uses the system heap. Crypto contexts use slabs.
CONFIG_HEAP_MEM_POOL_SIZE=8192

CONFIG_ENTROPY_GENERATOR=y
```

## src/main.c
```c
/*
 * Copyright (c) 2026 The Zephyr Project Contributors
 *
 * SPDX-License-Identifier: Apache-2.0
 */

/*
 * Exercise OpenThread platform crypto with contexts allocated by the platform
 * (CONFIG_OPENTHREAD_CRYPTO_PLATFORM_ALLOCS_CONTEXT).
 */

#include <stdint.h>

#include <zephyr/kernel.h>
#include <zephyr/sys/atomic.h>
#include <zephyr/ztest.h>

#include <openthread/platform/crypto.h>

#include <psa/crypto.h>

#ifndef CONFIG_OPENTHREAD_CRYPTO_PLATFORM_ALLOCS_CONTEXT
#error Platform-allocated OpenThread crypto contexts are not enabled
#endif

#define CONTEXT_REUSE_ITERATIONS 4U

struct context_slab_test {
	otError (*init)(otCryptoContext *context);
	otError (*deinit)(otCryptoContext *context);
};

static struct k_thread exhaustion_thread;
static K_THREAD_STACK_DEFINE(exhaustion_thread_stack, 1024);
static atomic_t expect_panic;
static atomic_t fatal_reason;
static atomic_t init_returned;

void k_sys_fatal_error_handler(unsigned int reason, const struct arch_esf *esf)
{
	ARG_UNUSED(esf);

	if ((atomic_cas(&expect_panic, 1, 0)) && (reason == K_ERR_KERNEL_PANIC)) {
		atomic_set(&fatal_reason, (atomic_val_t)reason);
		return;
	}

	k_fatal_halt(reason);
}

static void exhaust_context_slab(void *p1, void *p2, void *p3)
{
	const struct context_slab_test *test = p1;
	otCryptoContext context = { 0 };

	ARG_UNUSED(p2);
	ARG_UNUSED(p3);

	(void)test->init(&context);
	atomic_set(&init_returned, 1);
}

static void test_context_slab_exhaustion(const struct context_slab_test *test)
{
	otCryptoContext context = { 0 };
	k_tid_t thread;

	zassert_equal(test->init(&context), OT_ERROR_NONE);

	atomic_set(&fatal_reason, -1);
	atomic_clear(&init_returned);
	atomic_set(&expect_panic, 1);

	thread = k_thread_create(&exhaustion_thread, exhaustion_thread_stack,
				 K_THREAD_STACK_SIZEOF(exhaustion_thread_stack),
				 exhaust_context_slab, (void *)test, NULL, NULL,
				 K_PRIO_PREEMPT(0), 0, K_NO_WAIT);
	zassert_ok(k_thread_join(thread, K_SECONDS(1)));
	zassert_equal(atomic_get(&fatal_reason), K_ERR_KERNEL_PANIC);
	zassert_equal(atomic_get(&init_returned), 0);

	zassert_equal(test->deinit(&context), OT_ERROR_NONE);
}

/* FIPS 180-4 SHA-256("abc") */
static const uint8_t sha256_input[] = { 'a', 'b', 'c' };
static const uint8_t sha256_expected[OT_CRYPTO_SHA256_HASH_SIZE] = {
	0xba, 0x78, 0x16, 0xbf, 0x8f, 0x01, 0xcf, 0xea, 0x41, 0x41, 0x40,
	0xde, 0x5d, 0xae, 0x22, 0x23, 0xb0, 0x03, 0x61, 0xa3, 0x96, 0x17,
	0x7a, 0x9c, 0xb4, 0x10, 0xff, 0x61, 0xf2, 0x00, 0x15, 0xad,
};

/* RFC 4231 HMAC-SHA-256 test case 1 */
static const uint8_t hmac_key[] = {
	0x0b, 0x0b, 0x0b, 0x0b, 0x0b, 0x0b, 0x0b, 0x0b, 0x0b, 0x0b,
	0x0b, 0x0b, 0x0b, 0x0b, 0x0b, 0x0b, 0x0b, 0x0b, 0x0b, 0x0b,
};
static const uint8_t hmac_input[] = {
	'H', 'i', ' ', 'T', 'h', 'e', 'r', 'e',
};
static const uint8_t hmac_expected[OT_CRYPTO_SHA256_HASH_SIZE] = {
	0xb0, 0x34, 0x4c, 0x61, 0xd8, 0xdb, 0x38, 0x53, 0x5c, 0xa8, 0xaf,
	0xce, 0xaf, 0x0b, 0xf1, 0x2b, 0x88, 0x1d, 0xc2, 0x00, 0xc9, 0x83,
	0x3d, 0xa7, 0x26, 0xe9, 0x37, 0x6c, 0x2e, 0x32, 0xcf, 0xf7,
};

/* AES-128 ECB, plaintext 0x05 * 16, key 0x00..0x0f */
static const uint8_t aes_key[] = {
	0x00, 0x01, 0x02, 0x03, 0x04, 0x05, 0x06, 0x07,
	0x08, 0x09, 0x0a, 0x0b, 0x0c, 0x0d, 0x0e, 0x0f,
};
static const uint8_t aes_plain[] = {
	0x05, 0x05, 0x05, 0x05, 0x05, 0x05, 0x05, 0x05,
	0x05, 0x05, 0x05, 0x05, 0x05, 0x05, 0x05, 0x05,
};
static const uint8_t aes_expected[] = {
	0xea, 0x5e, 0x61, 0xae, 0x81, 0x67, 0xca, 0xa0,
	0x58, 0x63, 0x88, 0xeb, 0x9a, 0x7c, 0xb7, 0x55,
};

/* RFC 5869 HKDF-SHA-256 test case 1, 42-byte OKM */
static const uint8_t hkdf_ikm[] = {
	0x0b, 0x0b, 0x0b, 0x0b, 0x0b, 0x0b, 0x0b, 0x0b, 0x0b, 0x0b, 0x0b,
	0x0b, 0x0b, 0x0b, 0x0b, 0x0b, 0x0b, 0x0b, 0x0b, 0x0b, 0x0b, 0x0b,
};
static const uint8_t hkdf_salt[] = {
	0x00, 0x01, 0x02, 0x03, 0x04, 0x05, 0x06,
	0x07, 0x08, 0x09, 0x0a, 0x0b, 0x0c,
};
static const uint8_t hkdf_info[] = {
	0xf0, 0xf1, 0xf2, 0xf3, 0xf4, 0xf5, 0xf6, 0xf7, 0xf8, 0xf9,
};
static const uint8_t hkdf_expected[] = {
	0x3c, 0xb2, 0x5f, 0x25, 0xfa, 0xac, 0xd5, 0x7a, 0x90, 0x43, 0x4f,
	0x64, 0xd0, 0x36, 0x2f, 0x2a, 0x2d, 0x2d, 0x0a, 0x90, 0xcf, 0x1a,
	0x5a, 0x4c, 0x5d, 0xb0, 0x2d, 0x56, 0xec, 0xc4, 0xc5, 0xbf, 0x34,
	0x00, 0x72, 0x08, 0xd5, 0xb8, 0x87, 0x18, 0x58, 0x65,
};

#define ASSERT_CONTEXT_ALLOCATED(context, size)                                        \
	do {                                                                           \
		zassert_not_null((context)->mContext);                                \
		zassert_equal((context)->mContextSize, (uint16_t)(size));             \
		zassert_equal((uintptr_t)(context)->mContext % sizeof(uint64_t), 0U); \
	} while (0)

#define ASSERT_CONTEXT_CLEARED(context)                    \
	do {                                               \
		zassert_is_null((context)->mContext);     \
		zassert_equal((context)->mContextSize, 0); \
	} while (0)

static void *suite_setup(void)
{
	otPlatCryptoInit();
	zassert_equal(psa_crypto_init(), PSA_SUCCESS);

	return NULL;
}

static otCryptoKeyRef import_volatile_key(otCryptoKeyType type, otCryptoKeyAlgorithm algorithm,
					  int usage, const uint8_t *key, size_t key_len)
{
	otCryptoKeyRef key_ref = 0U;
	otError err;

	err = otPlatCryptoImportKey(&key_ref, type, algorithm, usage,
				    OT_CRYPTO_KEY_STORAGE_VOLATILE, key, key_len);
	zassert_equal(err, OT_ERROR_NONE);

	return key_ref;
}

ZTEST(openthread_crypto_psa, test_init_null_context)
{
	zassert_equal(otPlatCryptoSha256Init(NULL), OT_ERROR_INVALID_ARGS);
	zassert_equal(otPlatCryptoHmacSha256Init(NULL), OT_ERROR_INVALID_ARGS);
	zassert_equal(otPlatCryptoHkdfInit(NULL), OT_ERROR_INVALID_ARGS);
	zassert_equal(otPlatCryptoAesInit(NULL), OT_ERROR_INVALID_ARGS);
}

ZTEST(openthread_crypto_psa, test_deinit_without_context)
{
	otCryptoContext context = { 0 };

	zassert_equal(otPlatCryptoSha256Deinit(&context), OT_ERROR_INVALID_ARGS);
	zassert_equal(otPlatCryptoHmacSha256Deinit(&context), OT_ERROR_INVALID_ARGS);
	zassert_equal(otPlatCryptoHkdfDeinit(&context), OT_ERROR_INVALID_ARGS);
	zassert_equal(otPlatCryptoAesFree(&context), OT_ERROR_INVALID_ARGS);
	ASSERT_CONTEXT_CLEARED(&context);
}

ZTEST(openthread_crypto_psa, test_sha256_allocated_context)
{
	uint64_t caller_storage;
	otCryptoContext context = {
		.mContext = &caller_storage,
		.mContextSize = sizeof(caller_storage),
	};
	uint8_t digest[OT_CRYPTO_SHA256_HASH_SIZE];

	for (uint8_t i = 0U; i < CONTEXT_REUSE_ITERATIONS; i++) {
		zassert_equal(otPlatCryptoSha256Init(&context), OT_ERROR_NONE);
		zassert_not_equal(context.mContext, &caller_storage);
		ASSERT_CONTEXT_ALLOCATED(&context, sizeof(psa_hash_operation_t));

		zassert_equal(otPlatCryptoSha256Start(&context), OT_ERROR_NONE);
		zassert_equal(otPlatCryptoSha256Update(&context, sha256_input,
						      sizeof(sha256_input)),
			      OT_ERROR_NONE);
		zassert_equal(otPlatCryptoSha256Finish(&context, digest, sizeof(digest)),
			      OT_ERROR_NONE);
		zassert_mem_equal(digest, sha256_expected, sizeof(sha256_expected));

		zassert_equal(otPlatCryptoSha256Deinit(&context), OT_ERROR_NONE);
		ASSERT_CONTEXT_CLEARED(&context);

		zassert_equal(otPlatCryptoSha256Deinit(&context), OT_ERROR_INVALID_ARGS);
	}
}

ZTEST(openthread_crypto_psa, test_hmac_sha256_allocated_context)
{
	otCryptoContext context = { 0 };
	otCryptoKey key = { 0 };
	psa_key_attributes_t attributes = PSA_KEY_ATTRIBUTES_INIT;
	psa_key_id_t key_id = PSA_KEY_ID_NULL;
	psa_status_t status;
	uint8_t mac[OT_CRYPTO_SHA256_HASH_SIZE];

	/*
	 * psa_mac_sign_setup() requires PSA_KEY_USAGE_SIGN_MESSAGE.
	 * otPlatCryptoImportKey() maps OT_CRYPTO_KEY_USAGE_SIGN_HASH onto
	 * PSA_KEY_USAGE_SIGN_HASH, so import this HMAC key through PSA.
	 */
	psa_set_key_type(&attributes, PSA_KEY_TYPE_HMAC);
	psa_set_key_algorithm(&attributes, PSA_ALG_HMAC(PSA_ALG_SHA_256));
	psa_set_key_usage_flags(&attributes, PSA_KEY_USAGE_SIGN_MESSAGE);
	status = psa_import_key(&attributes, hmac_key, sizeof(hmac_key), &key_id);
	psa_reset_key_attributes(&attributes);
	zassert_equal(status, PSA_SUCCESS);

	key.mKeyRef = key_id;

	zassert_equal(otPlatCryptoHmacSha256Init(&context), OT_ERROR_NONE);
	ASSERT_CONTEXT_ALLOCATED(&context, sizeof(psa_mac_operation_t));

	zassert_equal(otPlatCryptoHmacSha256Start(&context, &key), OT_ERROR_NONE);
	zassert_equal(otPlatCryptoHmacSha256Update(&context, hmac_input, sizeof(hmac_input)),
		      OT_ERROR_NONE);
	zassert_equal(otPlatCryptoHmacSha256Finish(&context, mac, sizeof(mac)), OT_ERROR_NONE);
	zassert_mem_equal(mac, hmac_expected, sizeof(hmac_expected));

	zassert_equal(otPlatCryptoHmacSha256Deinit(&context), OT_ERROR_NONE);
	ASSERT_CONTEXT_CLEARED(&context);
	zassert_equal(otPlatCryptoHmacSha256Deinit(&context), OT_ERROR_INVALID_ARGS);

	zassert_equal(psa_destroy_key(key_id), PSA_SUCCESS);
}

ZTEST(openthread_crypto_psa, test_hkdf_allocated_context)
{
	otCryptoContext context = { 0 };
	otCryptoKey input_key = { 0 };
	otCryptoKeyRef key_ref;
	uint8_t okm[sizeof(hkdf_expected)];

	key_ref = import_volatile_key(OT_CRYPTO_KEY_TYPE_DERIVE, OT_CRYPTO_KEY_ALG_HKDF_SHA256,
				      OT_CRYPTO_KEY_USAGE_DERIVE, hkdf_ikm, sizeof(hkdf_ikm));
	input_key.mKeyRef = key_ref;

	zassert_equal(otPlatCryptoHkdfInit(&context), OT_ERROR_NONE);
	ASSERT_CONTEXT_ALLOCATED(&context, sizeof(psa_key_derivation_operation_t));

	zassert_equal(otPlatCryptoHkdfExtract(&context, hkdf_salt, sizeof(hkdf_salt), &input_key),
		      OT_ERROR_NONE);
	zassert_equal(otPlatCryptoHkdfExpand(&context, hkdf_info, sizeof(hkdf_info), okm,
					     sizeof(okm)),
		      OT_ERROR_NONE);
	zassert_mem_equal(okm, hkdf_expected, sizeof(hkdf_expected));

	zassert_equal(otPlatCryptoHkdfDeinit(&context), OT_ERROR_NONE);
	ASSERT_CONTEXT_CLEARED(&context);
	zassert_equal(otPlatCryptoHkdfDeinit(&context), OT_ERROR_INVALID_ARGS);

	zassert_equal(otPlatCryptoDestroyKey(key_ref), OT_ERROR_NONE);
}

ZTEST(openthread_crypto_psa, test_aes_allocated_context)
{
	otCryptoContext context = { 0 };
	otCryptoKey key = { 0 };
	otCryptoKeyRef key_ref;
	uint8_t cipher[sizeof(aes_expected)];

	key_ref = import_volatile_key(OT_CRYPTO_KEY_TYPE_AES, OT_CRYPTO_KEY_ALG_AES_ECB,
				      OT_CRYPTO_KEY_USAGE_ENCRYPT, aes_key, sizeof(aes_key));
	key.mKeyRef = key_ref;

	zassert_equal(otPlatCryptoAesInit(&context), OT_ERROR_NONE);
	ASSERT_CONTEXT_ALLOCATED(&context, sizeof(psa_key_id_t));

	zassert_equal(otPlatCryptoAesSetKey(&context, &key), OT_ERROR_NONE);
	zassert_equal(otPlatCryptoAesEncrypt(&context, aes_plain, cipher), OT_ERROR_NONE);
	zassert_mem_equal(cipher, aes_expected, sizeof(aes_expected));

	zassert_equal(otPlatCryptoAesFree(&context), OT_ERROR_NONE);
	ASSERT_CONTEXT_CLEARED(&context);
	zassert_equal(otPlatCryptoAesFree(&context), OT_ERROR_INVALID_ARGS);

	zassert_equal(otPlatCryptoDestroyKey(key_ref), OT_ERROR_NONE);
}

ZTEST(openthread_crypto_psa, test_concurrent_contexts)
{
	otCryptoContext sha = { 0 };
	otCryptoContext hmac = { 0 };
	otCryptoContext hkdf = { 0 };
	otCryptoContext aes = { 0 };

	zassert_equal(otPlatCryptoSha256Init(&sha), OT_ERROR_NONE);
	zassert_equal(otPlatCryptoHmacSha256Init(&hmac), OT_ERROR_NONE);
	zassert_equal(otPlatCryptoHkdfInit(&hkdf), OT_ERROR_NONE);
	zassert_equal(otPlatCryptoAesInit(&aes), OT_ERROR_NONE);

	ASSERT_CONTEXT_ALLOCATED(&sha, sizeof(psa_hash_operation_t));
	ASSERT_CONTEXT_ALLOCATED(&hmac, sizeof(psa_mac_operation_t));
	ASSERT_CONTEXT_ALLOCATED(&hkdf, sizeof(psa_key_derivation_operation_t));
	ASSERT_CONTEXT_ALLOCATED(&aes, sizeof(psa_key_id_t));

	zassert_not_equal(sha.mContext, hmac.mContext);
	zassert_not_equal(sha.mContext, hkdf.mContext);
	zassert_not_equal(sha.mContext, aes.mContext);
	zassert_not_equal(hmac.mContext, hkdf.mContext);
	zassert_not_equal(hmac.mContext, aes.mContext);
	zassert_not_equal(hkdf.mContext, aes.mContext);

	zassert_equal(otPlatCryptoSha256Deinit(&sha), OT_ERROR_NONE);
	zassert_equal(otPlatCryptoHmacSha256Deinit(&hmac), OT_ERROR_NONE);
	zassert_equal(otPlatCryptoHkdfDeinit(&hkdf), OT_ERROR_NONE);
	zassert_equal(otPlatCryptoAesFree(&aes), OT_ERROR_NONE);

	ASSERT_CONTEXT_CLEARED(&sha);
	ASSERT_CONTEXT_CLEARED(&hmac);
	ASSERT_CONTEXT_CLEARED(&hkdf);
	ASSERT_CONTEXT_CLEARED(&aes);
}

ZTEST(openthread_crypto_psa, test_sha256_slab_exhaustion)
{
	const struct context_slab_test test = {
		.init = otPlatCryptoSha256Init,
		.deinit = otPlatCryptoSha256Deinit,
	};

	test_context_slab_exhaustion(&test);
}

ZTEST(openthread_crypto_psa, test_hmac_sha256_slab_exhaustion)
{
	const struct context_slab_test test = {
		.init = otPlatCryptoHmacSha256Init,
		.deinit = otPlatCryptoHmacSha256Deinit,
	};

	test_context_slab_exhaustion(&test);
}

ZTEST(openthread_crypto_psa, test_hkdf_slab_exhaustion)
{
	const struct context_slab_test test = {
		.init = otPlatCryptoHkdfInit,
		.deinit = otPlatCryptoHkdfDeinit,
	};

	test_context_slab_exhaustion(&test);
}

ZTEST(openthread_crypto_psa, test_aes_slab_exhaustion)
{
	const struct context_slab_test test = {
		.init = otPlatCryptoAesInit,
		.deinit = otPlatCryptoAesFree,
	};

	test_context_slab_exhaustion(&test);
}

ZTEST_SUITE(openthread_crypto_psa, NULL, suite_setup, NULL, NULL, NULL);
```
