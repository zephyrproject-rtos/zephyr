## CMakeLists.txt
```
# SPDX-FileCopyrightText: Copyright 2026 NXP
# SPDX-License-Identifier: Apache-2.0

cmake_minimum_required(VERSION 3.20.0)
find_package(Zephyr REQUIRED HINTS $ENV{ZEPHYR_BASE})
project(ebpf_verifier_test)

target_sources(app PRIVATE src/main.c)
```

## prj.conf
```kconfig
# SPDX-FileCopyrightText: Copyright 2026 NXP
# SPDX-License-Identifier: Apache-2.0

CONFIG_ZTEST=y
CONFIG_EBPF=y
CONFIG_EBPF_TRACING=n
CONFIG_EBPF_SHELL=n
CONFIG_EBPF_RUNTIME_BOUNDS_CHECK=y
```

## src/main.c
```c
/*
 * SPDX-FileCopyrightText: Copyright 2026 NXP
 *
 * SPDX-License-Identifier: Apache-2.0
 */

#include <zephyr/ztest.h>
#include <zephyr/ebpf/ebpf.h>

extern int ebpf_verify(const struct ebpf_prog *prog);

ZTEST(ebpf_verifier, test_positive_r10_offset_is_rejected)
{
	static const struct ebpf_insn prog_insns[] = {
		EBPF_ST_MEM_W(EBPF_REG_R10, 4, 1),
		EBPF_EXIT_INSN(),
	};
	struct ebpf_prog prog = {
		.name = "bad_r10_offset",
		.type = EBPF_PROG_TYPE_TRACEPOINT,
		.insns = prog_insns,
		.insn_cnt = ARRAY_SIZE(prog_insns),
	};

	zassert_equal(ebpf_verify(&prog), -EINVAL,
		      "positive R10 offset should be rejected");
}

ZTEST(ebpf_verifier, test_negative_r10_offset_is_accepted)
{
	static const struct ebpf_insn prog_insns[] = {
		EBPF_ST_MEM_W(EBPF_REG_R10, -4, 1),
		EBPF_EXIT_INSN(),
	};
	struct ebpf_prog prog = {
		.name = "good_r10_offset",
		.type = EBPF_PROG_TYPE_TRACEPOINT,
		.insns = prog_insns,
		.insn_cnt = ARRAY_SIZE(prog_insns),
	};

	zassert_ok(ebpf_verify(&prog), "negative R10 offset should pass");
}

ZTEST_SUITE(ebpf_verifier, NULL, NULL, NULL, NULL, NULL);
```
