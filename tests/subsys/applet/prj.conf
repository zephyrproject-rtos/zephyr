## CMakeLists.txt
```
# Copyright (c) 2026 Intel Corporation.
# SPDX-License-Identifier: Apache-2.0

cmake_minimum_required(VERSION 3.20.0)
find_package(Zephyr REQUIRED HINTS $ENV{ZEPHYR_BASE})
project(applet_test)

if(CONFIG_TEST_APPLET_HALT_SYSTEM)
  target_sources(app PRIVATE
    src/test_halt_system.c
  )
else()
  target_sources(app PRIVATE
    src/test_applet.c
  )
endif()

target_include_directories(app PRIVATE
  ${PROJECT_SOURCE_DIR}/applet
  ${ZEPHYR_BASE}/include
  ${ZEPHYR_BASE}/kernel/include
  ${ZEPHYR_BASE}/arch/${ARCH}/include
)

set(applet_names
  cpu_pinning
  worker
)

foreach(applet_name ${applet_names})
  if(CONFIG_APPLET_LLEXT)
    set(applet_src ${PROJECT_SOURCE_DIR}/applet/${applet_name}_applet.c)
    set(applet_bin ${PROJECT_BINARY_DIR}/llext/${applet_name}.llext)
    set(applet_inc ${ZEPHYR_BINARY_DIR}/include/generated/${applet_name}.inc)
    add_llext_target(${applet_name}_applet
      OUTPUT  ${applet_bin}
      SOURCES ${applet_src}
    )
    generate_inc_file_for_target(app ${applet_bin} ${applet_inc})
  else()
    target_sources(app PRIVATE ${PROJECT_SOURCE_DIR}/applet/${applet_name}_applet.c)
  endif()
endforeach()
```

## Kconfig
```
# Copyright (c) 2026 Intel Corporation
# SPDX-License-Identifier: Apache-2.0

mainmenu "Applet subsystem test"

config TEST_APPLET_HALT_SYSTEM
	bool "Cover APPLET_HALT_ON_FAULT_SYSTEM"
	depends on APPLET_FATAL_HANDLER
	help
	  Run the halt-on-fault SYSTEM case instead of the main ztest suite.
	  That mode ends in k_fatal_halt(), so the image never returns to the
	  test runner and the result has to be matched on the console.

source "Kconfig.zephyr"
```

## prj.conf
```kconfig
CONFIG_ZTEST=y
CONFIG_ZTEST_STACK_SIZE=4096
CONFIG_MAIN_STACK_SIZE=2048
CONFIG_HEAP_MEM_POOL_SIZE=8192
CONFIG_LOG=y
CONFIG_APPLET=y

# One bookkeeping slot per applet thread, plus the k_thread itself when
# CONFIG_USERSPACE is off. The suite runs up to six threads in one applet, and
# struct k_thread is close to a kilobyte on the 64-bit targets.
CONFIG_APPLET_HEAP_SIZE=16384
```

## no_mem_protection.conf
```kconfig
# Disable MPU and MMU on all supported arches for the bulk of the tests.
#
# This uses the fact that setting an unknown symbol to 'n' has no effect,
# so it is safe to group different arch-specific settings here.
#
CONFIG_ARM_MPU=n
CONFIG_ARM_AARCH32_MMU=n
CONFIG_RISCV_PMP=n
CONFIG_ARC_MPU_ENABLE=n
CONFIG_X86_MMU=n
CONFIG_XTENSA_MMU=n
CONFIG_XTENSA_MPU=n
```

## boards/qemu_cortex_a53_qemu_cortex_a53_smp.overlay
```dts
/*
 * Copyright 2026 Intel Corporation
 *
 * SPDX-License-Identifier: Apache-2.0
 */

/ {
	cpus {
		cpu@2 {
			device_type = "cpu";
			compatible = "arm,cortex-a53";
			reg = <2>;
		};

		cpu@3 {
			device_type = "cpu";
			compatible = "arm,cortex-a53";
			reg = <3>;
		};
	};
};
```

## src/test_halt_system.c
```c
/*
 * Copyright (c) 2026 Intel Corporation
 *
 * SPDX-License-Identifier: Apache-2.0
 */

/*
 * APPLET_HALT_ON_FAULT_SYSTEM ends in k_fatal_halt(), so the image never
 * returns to the test runner. This file replaces src/test_applet.c so that the
 * halting case is the only thing the image does, and twister scores it with
 * the console harness instead of a ztest verdict.
 */

#include <zephyr/kernel.h>
#include <zephyr/ztest.h>
#include <zephyr/applet/applet.h>

#define HALT_STACK_SIZE (CONFIG_APPLET_THREAD_STACK_SIZE_DEFAULT * 2)

APPLET_THREAD_STACK_DEFINE(halt_stack, HALT_STACK_SIZE);

static struct applet halt_applet;

static void fault_entry(void *p1, void *p2, void *p3)
{
	ARG_UNUSED(p1);
	ARG_UNUSED(p2);
	ARG_UNUSED(p3);

	k_oops();
}

ZTEST(applet_halt_system, test_halt_system_on_fault)
{
	struct applet_opts opts = APPLET_OPTS_DEFAULT;

	/* User mode would report the fault as a different reason. */
	opts.user_mode = false;
	opts.halt_on_fault = APPLET_HALT_ON_FAULT_SYSTEM;

	zassert_ok(applet_init(&halt_applet, "halt-system", &opts));
	zassert_ok(applet_add_thread(&halt_applet, halt_stack, K_THREAD_STACK_SIZEOF(halt_stack),
				     fault_entry, NULL, "faulter"));
	zassert_ok(applet_start(&halt_applet));

	k_sleep(K_SECONDS(2));

	zassert_unreachable("the fatal handler should have halted the system");
}

ZTEST_SUITE(applet_halt_system, NULL, NULL, NULL, NULL, NULL);
```
