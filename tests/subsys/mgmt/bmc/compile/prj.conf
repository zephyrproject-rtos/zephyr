## CMakeLists.txt
```
# SPDX-FileCopyrightText: Copyright The Zephyr Project Contributors
# SPDX-License-Identifier: Apache-2.0

cmake_minimum_required(VERSION 3.20.0)
find_package(Zephyr REQUIRED HINTS $ENV{ZEPHYR_BASE})
project(bmc_compile)

target_sources(app PRIVATE src/main.c)
```

## prj.conf
```kconfig
# SPDX-FileCopyrightText: Copyright The Zephyr Project Contributors
# SPDX-License-Identifier: Apache-2.0

CONFIG_BMC=y
CONFIG_BMC_NTP=n
CONFIG_BMC_SETTINGS=n
CONFIG_BMC_CONSOLE_LOGGER=n
# CONFIG_NET_TEST leaves the websocket library referencing a test hook that
# only the networking tests provide.
CONFIG_BMC_WEBSOCKET=n

CONFIG_SHELL=y

CONFIG_NETWORKING=y
CONFIG_NET_TEST=y
CONFIG_NET_DRIVERS=y
CONFIG_NET_LOOPBACK=y
CONFIG_NET_IPV4=y
CONFIG_NET_IPV6=n
CONFIG_NET_TCP=y
CONFIG_NET_SOCKETS=y
CONFIG_NET_MGMT=y
CONFIG_NET_MGMT_EVENT=y
CONFIG_NET_DHCPV4=y
CONFIG_NET_CONFIG_AUTO_INIT=n
CONFIG_NET_CONFIG_MY_IPV4_ADDR="127.0.0.1"
CONFIG_NET_CONFIG_MY_IPV4_NETMASK="255.0.0.0"

CONFIG_POSIX_API=y
CONFIG_EVENTFD=y

CONFIG_BMC_DEFAULT_USE_DHCP4=n
CONFIG_BMC_DEFAULT_IPV4_ADDRESS="127.0.0.1"
CONFIG_BMC_DEFAULT_IPV4_SUBNET_MASK="255.0.0.0"
CONFIG_BMC_DEFAULT_ADMIN_PASSWORD="admin"
```

## overlay-minimal.conf
```kconfig
# SPDX-FileCopyrightText: Copyright The Zephyr Project Contributors
# SPDX-License-Identifier: Apache-2.0
#
# The BMC core without any of the optional policy layers, to prove that
# nothing in it depends on the shell, the web services or Redfish.

CONFIG_SHELL=n
CONFIG_BMC_HTTP=n
CONFIG_BMC_REDFISH=n
CONFIG_BMC_SENSORS=n
CONFIG_BMC_JTAG=n
```

## src/main.c
```c
/*
 * SPDX-FileCopyrightText: Copyright The Zephyr Project Contributors
 * SPDX-License-Identifier: Apache-2.0
 */

#include <zephyr/mgmt/bmc.h>

int main(void)
{
	return bmc_init();
}
```
