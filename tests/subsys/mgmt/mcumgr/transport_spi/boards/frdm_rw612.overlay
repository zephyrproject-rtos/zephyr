/*
 * Copyright (c) 2026 Zephyr Project Contributors
 *
 * SPDX-License-Identifier: Apache-2.0
 */

#include <zephyr/dt-bindings/gpio/gpio.h>

/ {
	spibb0: spibb0 {
		compatible = "zephyr,spi-bitbang";
		status = "okay";
		#address-cells = <1>;
		#size-cells = <0>;
		clk-gpios = <&hsgpio0 7 GPIO_ACTIVE_HIGH>;
		mosi-gpios = <&hsgpio0 9 GPIO_ACTIVE_HIGH>;
		miso-gpios = <&hsgpio0 8 0>;
		cs-gpios = <&hsgpio0 10 GPIO_ACTIVE_LOW>;

		smp_spi: smp-spi@0 {
			compatible = "zephyr,smp-spi";
			reg = <0>;
			spi-max-frequency = <1000000>;
			data-ready-gpios = <&hsgpio0 1 GPIO_ACTIVE_HIGH>;
		};
	};
};
