## CMakeLists.txt
```
#
# Copyright (c) 2023 Nordic Semiconductor ASA
#
# SPDX-License-Identifier: Apache-2.0
#

cmake_minimum_required(VERSION 3.28.0)
find_package(Zephyr REQUIRED HINTS $ENV{ZEPHYR_BASE})
project(settings_mgmt)

FILE(GLOB app_sources
  src/*.c
)

target_sources(app PRIVATE ${app_sources})
target_include_directories(app PRIVATE ${ZEPHYR_BASE}/subsys/mgmt/mcumgr/transport/include/mgmt/mcumgr/transport/)
```

## prj.conf
```kconfig
#
# Copyright (c) 2023 Nordic Semiconductor ASA
#
# SPDX-License-Identifier: Apache-2.0
#
CONFIG_ZTEST=y
CONFIG_NET_BUF=y
CONFIG_BASE64=y
CONFIG_ZCBOR=y
CONFIG_CRC=y
CONFIG_MCUMGR=y
CONFIG_MCUMGR_TRANSPORT_DUMMY=y
CONFIG_MCUMGR_TRANSPORT_DUMMY_RX_BUF_SIZE=256
CONFIG_MCUMGR_GRP_SETTINGS=y
CONFIG_MCUMGR_MGMT_NOTIFICATION_HOOKS=y
CONFIG_MCUMGR_GRP_SETTINGS_ACCESS_HOOK=y
CONFIG_ZTEST_STACK_SIZE=2048
CONFIG_SETTINGS=y
CONFIG_SETTINGS_RUNTIME=y
CONFIG_SETTINGS_NVS=y
CONFIG_FLASH_MAP=y
CONFIG_FLASH=y
CONFIG_NVS=y
```

## src/settings.c
```c
/*
 * Copyright (c) 2023-2025 Nordic Semiconductor ASA
 *
 * SPDX-License-Identifier: Apache-2.0
 */

#include "settings.h"
#include <stdio.h>
#include <string.h>
#include <zephyr/kernel.h>
#include <zephyr/settings/settings.h>

static bool set_called;
static bool get_called;
static bool export_called;
static bool commit_called;
static uint8_t val_aa[4];
static uint8_t val_bb;

struct save_single_data single_data;

static int val_handle_set(const char *name, size_t len, settings_read_cb read_cb, void *cb_arg);
static int val_handle_commit(void);
static int val_handle_export(int (*cb)(const char *name, const void *value, size_t val_len));
static int val_handle_get(const char *name, char *val, int val_len_max);

SETTINGS_STATIC_HANDLER_DEFINE(val, "test_val", val_handle_get, val_handle_set, val_handle_commit,
			       val_handle_export);

static int val_handle_set(const char *name, size_t len, settings_read_cb read_cb, void *cb_arg)
{
	const char *next;
	int rc;

	set_called = true;

	if (settings_name_steq(name, "aa", &next) && !next) {
		if (len != sizeof(val_aa)) {
			return -EINVAL;
		}

		rc = read_cb(cb_arg, val_aa, sizeof(val_aa));

		return 0;
	} else if (settings_name_steq(name, "bb", &next) && !next) {
		if (len != sizeof(val_bb)) {
			return -EINVAL;
		}

		rc = read_cb(cb_arg, &val_bb, sizeof(val_bb));

		return 0;
	}

	return -ENOENT;
}

static int val_handle_commit(void)
{
	commit_called = true;
	return 0;
}

static int val_handle_export(int (*cb)(const char *name, const void *value, size_t val_len))
{
	export_called = true;

	(void)cb("test_val/aa", val_aa, sizeof(val_aa));
	(void)cb("test_val/bb", &val_bb, sizeof(val_bb));

	return 0;
}

static int val_handle_get(const char *name, char *val, int val_len_max)
{
	const char *next;

	get_called = true;

	if (val_len_max < 0) {
		return -EINVAL;
	}

	if (settings_name_steq(name, "aa", &next) && !next) {
		val_len_max = MIN(val_len_max, sizeof(val_aa));
		memcpy(val, val_aa, val_len_max);
		return val_len_max;
	} else if (settings_name_steq(name, "bb", &next) && !next) {
		val_len_max = MIN(val_len_max, sizeof(val_bb));
		memcpy(val, &val_bb, val_len_max);
		return val_len_max;
	}

	return -ENOENT;
}

void settings_state_reset(void)
{
	set_called = false;
	get_called = false;
	export_called = false;
	commit_called = false;
}

void settings_state_get(bool *set, bool *get, bool *export, bool *commit)
{
	*set = set_called;
	*get = get_called;
	*export = export_called;
	*commit = commit_called;
}

static int first_set(const char *name, size_t len, settings_read_cb read_cb, void *cb_arg)
{
	const char *next;

	if (settings_name_steq(name, "value1", &next) && !next) {
		if (len != sizeof(single_data.first_val)) {
			return -EINVAL;
		}
		(void)read_cb(cb_arg, &single_data.first_val, sizeof(single_data.first_val));
		single_data.first_set_called = true;
		return 0;
	}
	if (settings_name_steq(name, "value2", &next) && !next) {
		if (len != sizeof(single_data.second_val)) {
			return -EINVAL;
		}
		(void)read_cb(cb_arg, &single_data.second_val, sizeof(single_data.second_val));
		single_data.second_set_called = true;
		return 0;
	}

	return -ENOENT;
}

static int first_get(const char *name, char *val, int val_len_max)
{
	const char *next;

	if (val_len_max < 0) {
		return -EINVAL;
	}

	if (settings_name_steq(name, "value1", &next) && !next) {
		val_len_max = MIN(val_len_max, sizeof(single_data.first_val));
		memcpy(val, &single_data.first_val, val_len_max);
		single_data.first_get_called = true;
		return val_len_max;
	} else if (settings_name_steq(name, "value2", &next) && !next) {
		val_len_max = MIN(val_len_max, sizeof(single_data.second_val));
		memcpy(val, &single_data.second_val, val_len_max);
		single_data.second_get_called = true;
		return val_len_max;
	}

	return -ENOENT;
}

static int first_commit(void)
{
	single_data.first_second_commit_called = true;
	return 0;
}

static int first_export(int (*cb)(const char *name, const void *value, size_t val_len))
{
	(void)cb("first/value1", &single_data.first_val, sizeof(single_data.first_val));
	(void)cb("first/value2", &single_data.second_val, sizeof(single_data.second_val));

	single_data.first_second_export_called = true;
	return 0;
}

SETTINGS_STATIC_HANDLER_DEFINE(first, "first", first_get, first_set, first_commit, first_export);

static int third_set(const char *name, size_t len, settings_read_cb read_cb, void *cb_arg)
{
	const char *next;

	if (settings_name_steq(name, "value3", &next) && !next) {
		if (len != sizeof(single_data.third_val)) {
			return -EINVAL;
		}
		(void)read_cb(cb_arg, &single_data.third_val, sizeof(single_data.third_val));
		single_data.third_set_called = true;
		return 0;
	}

	return -ENOENT;
}

static int third_get(const char *name, char *val, int val_len_max)
{
	const char *next;

	if (val_len_max < 0) {
		return -EINVAL;
	}

	if (settings_name_steq(name, "value3", &next) && !next) {
		val_len_max = MIN(val_len_max, sizeof(single_data.third_val));
		memcpy(val, &single_data.third_val, val_len_max);
		single_data.third_get_called = true;
		return val_len_max;
	}

	return -ENOENT;
}

static int third_commit(void)
{
	single_data.third_commit_called = true;
	return 0;
}

static int third_export(int (*cb)(const char *name, const void *value, size_t val_len))
{
	(void)cb("first/other/value3", &single_data.third_val, sizeof(single_data.third_val));

	single_data.third_export_called = true;
	return 0;
}

SETTINGS_STATIC_HANDLER_DEFINE(third, "first/other", third_get, third_set, third_commit,
			       third_export);

static int forth_set(const char *name, size_t len, settings_read_cb read_cb, void *cb_arg)
{
	const char *next;

	if (settings_name_steq(name, "value4", &next) && !next) {
		if (len != sizeof(single_data.forth_val)) {
			return -EINVAL;
		}
		(void)read_cb(cb_arg, &single_data.forth_val, sizeof(single_data.forth_val));
		single_data.forth_set_called = true;
		return 0;
	}

	return -ENOENT;
}

static int forth_commit(void)
{
	single_data.forth_commit_called = true;
	return 0;
}

static int forth_export(int (*cb)(const char *name, const void *value, size_t val_len))
{
	(void)cb("first/expected_fail/value4", &single_data.forth_val,
		 sizeof(single_data.forth_val));

	single_data.forth_export_called = true;
	return 0;
}

SETTINGS_STATIC_HANDLER_DEFINE(forth, "first/expected_fail", NULL, forth_set, forth_commit,
			       forth_export);

void single_modification_reset(void)
{
	single_data.first_second_export_called = false;
	single_data.first_second_commit_called = false;
	single_data.first_get_called = false;
	single_data.first_set_called = false;
	single_data.second_get_called = false;
	single_data.second_set_called = false;
	single_data.third_export_called = false;
	single_data.third_commit_called = false;
	single_data.third_get_called = false;
	single_data.third_set_called = false;
	single_data.forth_export_called = false;
	single_data.forth_commit_called = false;
	single_data.forth_get_called = false;
	single_data.forth_set_called = false;
}
```

## src/settings.h
```c
/*
 * Copyright (c) 2023 Nordic Semiconductor ASA
 *
 * SPDX-License-Identifier: Apache-2.0
 */

#include <stdint.h>
#include <stdbool.h>

struct save_single_data {
	uint8_t first_val;
	uint8_t second_val;
	uint8_t third_val;
	uint8_t forth_val;

	bool first_second_export_called;
	bool first_second_commit_called;
	bool first_get_called;
	bool first_set_called;

	bool second_get_called;
	bool second_set_called;

	bool third_export_called;
	bool third_commit_called;
	bool third_get_called;
	bool third_set_called;

	bool forth_export_called;
	bool forth_commit_called;
	bool forth_get_called;
	bool forth_set_called;
};

extern struct save_single_data single_data;

void settings_state_reset(void);

void single_modification_reset(void);

void settings_state_get(bool *set, bool *get, bool *export, bool *commit);
```

## src/smp_test_util.c
```c
/*
 * Copyright (c) 2022-2025 Nordic Semiconductor ASA
 *
 * SPDX-License-Identifier: Apache-2.0
 */

#include "smp_test_util.h"
#include <zephyr/mgmt/mcumgr/grp/settings_mgmt/settings_mgmt.h>
#include <zephyr/net_buf.h>
#include <zephyr/sys/byteorder.h>
#include <zcbor_encode.h>

/* SMP header function for generating MCUmgr command header with sequence number set to 1 */
static void smp_make_hdr(struct smp_hdr *rsp_hdr, size_t len, uint8_t type, bool write)
{
	*rsp_hdr = (struct smp_hdr) {
		.nh_len = sys_cpu_to_be16(len),
		.nh_flags = 0,
		.nh_op = (write ? MGMT_OP_WRITE : MGMT_OP_READ),
		.nh_group = sys_cpu_to_be16(MGMT_GROUP_ID_SETTINGS),
		.nh_seq = 1,
		.nh_id = type,
		.nh_version = 1,
	};
}

bool create_settings_mgmt_read_packet(zcbor_state_t *zse, uint8_t *buffer, uint8_t *output_buffer,
				      uint16_t *buffer_size, char *name, uint32_t max_size)
{
	bool ok;

	ok = zcbor_map_start_encode(zse, 2)				&&
	     zcbor_tstr_put_lit(zse, "name")				&&
	     zcbor_tstr_put_term(zse, name, CONFIG_ZCBOR_MAX_STR_LEN)	&&
	     (max_size == 0 || (zcbor_tstr_put_lit(zse, "max_size")	&&
	      zcbor_uint32_put(zse, max_size)))				&&
	     zcbor_map_end_encode(zse, 2);

	*buffer_size = (zse->payload_mut - buffer);
	smp_make_hdr((struct smp_hdr *)output_buffer, *buffer_size, SETTINGS_MGMT_ID_READ_WRITE,
		     false);
	memcpy(&output_buffer[sizeof(struct smp_hdr)], buffer, *buffer_size);
	*buffer_size += sizeof(struct smp_hdr);

	return ok;
}

bool create_settings_mgmt_write_packet(zcbor_state_t *zse, uint8_t *buffer, uint8_t *output_buffer,
				       uint16_t *buffer_size, char *name, const uint8_t *val,
				       size_t val_size)
{
	bool ok;

	ok = zcbor_map_start_encode(zse, 2)				&&
	     zcbor_tstr_put_lit(zse, "name")				&&
	     zcbor_tstr_put_term(zse, name, CONFIG_ZCBOR_MAX_STR_LEN)	&&
	     zcbor_tstr_put_lit(zse, "val")				&&
	     zcbor_bstr_encode_ptr(zse, val, val_size)			&&
	     zcbor_map_end_encode(zse, 2);

	*buffer_size = (zse->payload_mut - buffer);
	smp_make_hdr((struct smp_hdr *)output_buffer, *buffer_size, SETTINGS_MGMT_ID_READ_WRITE,
		     true);
	memcpy(&output_buffer[sizeof(struct smp_hdr)], buffer, *buffer_size);
	*buffer_size += sizeof(struct smp_hdr);

	return ok;
}

bool create_settings_mgmt_delete_packet(zcbor_state_t *zse, uint8_t *buffer,
					uint8_t *output_buffer, uint16_t *buffer_size, char *name)
{
	bool ok;

	ok = zcbor_map_start_encode(zse, 2)				&&
	     zcbor_tstr_put_lit(zse, "name")				&&
	     zcbor_tstr_put_term(zse, name, CONFIG_ZCBOR_MAX_STR_LEN)	&&
	     zcbor_map_end_encode(zse, 2);

	*buffer_size = (zse->payload_mut - buffer);
	smp_make_hdr((struct smp_hdr *)output_buffer, *buffer_size, SETTINGS_MGMT_ID_DELETE, true);
	memcpy(&output_buffer[sizeof(struct smp_hdr)], buffer, *buffer_size);
	*buffer_size += sizeof(struct smp_hdr);

	return ok;
}

bool create_settings_mgmt_commit_packet(zcbor_state_t *zse, uint8_t *buffer,
					uint8_t *output_buffer, uint16_t *buffer_size)
{
	bool ok;

	ok = zcbor_map_start_encode(zse, 2)	&&
	     zcbor_map_end_encode(zse, 2);

	*buffer_size = (zse->payload_mut - buffer);
	smp_make_hdr((struct smp_hdr *)output_buffer, *buffer_size, SETTINGS_MGMT_ID_COMMIT, true);
	memcpy(&output_buffer[sizeof(struct smp_hdr)], buffer, *buffer_size);
	*buffer_size += sizeof(struct smp_hdr);

	return ok;
}

bool create_settings_mgmt_load_packet(zcbor_state_t *zse, uint8_t *buffer, uint8_t *output_buffer,
				      uint16_t *buffer_size)
{
	bool ok;

	ok = zcbor_map_start_encode(zse, 2)	&&
	     zcbor_map_end_encode(zse, 2);

	*buffer_size = (zse->payload_mut - buffer);
	smp_make_hdr((struct smp_hdr *)output_buffer, *buffer_size, SETTINGS_MGMT_ID_LOAD_SAVE,
		     false);
	memcpy(&output_buffer[sizeof(struct smp_hdr)], buffer, *buffer_size);
	*buffer_size += sizeof(struct smp_hdr);

	return ok;
}

bool create_settings_mgmt_save_packet(zcbor_state_t *zse, uint8_t *buffer, uint8_t *output_buffer,
				      uint16_t *buffer_size)
{
	bool ok;

	ok = zcbor_map_start_encode(zse, 2)	&&
	     zcbor_map_end_encode(zse, 2);

	*buffer_size = (zse->payload_mut - buffer);
	smp_make_hdr((struct smp_hdr *)output_buffer, *buffer_size, SETTINGS_MGMT_ID_LOAD_SAVE,
		     true);
	memcpy(&output_buffer[sizeof(struct smp_hdr)], buffer, *buffer_size);
	*buffer_size += sizeof(struct smp_hdr);

	return ok;
}

bool create_settings_mgmt_save_key_packet(zcbor_state_t *zse, uint8_t *buffer,
					  uint8_t *output_buffer, uint16_t *buffer_size,
					  char *name)
{
	bool ok;

	ok = zcbor_map_start_encode(zse, 2)				&&
	     zcbor_tstr_put_lit(zse, "name")				&&
	     zcbor_tstr_put_term(zse, name, CONFIG_ZCBOR_MAX_STR_LEN)	&&
	     zcbor_map_end_encode(zse, 2);

	*buffer_size = (zse->payload_mut - buffer);
	smp_make_hdr((struct smp_hdr *)output_buffer, *buffer_size, SETTINGS_MGMT_ID_LOAD_SAVE,
		     true);
	memcpy(&output_buffer[sizeof(struct smp_hdr)], buffer, *buffer_size);
	*buffer_size += sizeof(struct smp_hdr);

	return ok;
}
```

## src/smp_test_util.h
```c
/*
 * Copyright (c) 2023-2025 Nordic Semiconductor ASA
 *
 * SPDX-License-Identifier: Apache-2.0
 */

#ifndef H_SMP_TEST_UTIL_
#define H_SMP_TEST_UTIL_

#include <zephyr/ztest.h>
#include <zephyr/mgmt/mcumgr/mgmt/mgmt.h>
#include <zcbor_common.h>
#include <smp_internal.h>

/* Function for creating a settings_mgmt read command */
bool create_settings_mgmt_read_packet(zcbor_state_t *zse, uint8_t *buffer, uint8_t *output_buffer,
				      uint16_t *buffer_size, char *name, uint32_t max_size);

/* Function for creating a settings_mgmt write command */
bool create_settings_mgmt_write_packet(zcbor_state_t *zse, uint8_t *buffer, uint8_t *output_buffer,
				       uint16_t *buffer_size, char *name, const uint8_t *val,
				       size_t val_size);

/* Function for creating a settings_mgmt delete command */
bool create_settings_mgmt_delete_packet(zcbor_state_t *zse, uint8_t *buffer,
					uint8_t *output_buffer, uint16_t *buffer_size, char *name);

/* Function for creating a settings_mgmt commit command */
bool create_settings_mgmt_commit_packet(zcbor_state_t *zse, uint8_t *buffer,
					uint8_t *output_buffer, uint16_t *buffer_size);

/* Function for creating a settings_mgmt load command */
bool create_settings_mgmt_load_packet(zcbor_state_t *zse, uint8_t *buffer, uint8_t *output_buffer,
				      uint16_t *buffer_size);

/* Function for creating a settings_mgmt save command */
bool create_settings_mgmt_save_packet(zcbor_state_t *zse, uint8_t *buffer, uint8_t *output_buffer,
				      uint16_t *buffer_size);

/* Function for creating a settings_mgmt save (with key name) command */
bool create_settings_mgmt_save_key_packet(zcbor_state_t *zse, uint8_t *buffer,
					  uint8_t *output_buffer, uint16_t *buffer_size,
					  char *name);

#endif
```
