## tests/subsys/mgmt/mcumgr/zcbor_bulk/testcase.yaml
```yaml
#
# Copyright (c) 2022 Nordic Semiconductor ASA
#
# SPDX-License-Identifier: Apache-2.0
#
tests:
  mgmt.mcumgr.zcbor.bulk:
    platform_allow:
      - native_posix
      - native_sim
      - qemu_cortex_m0
      - qemu_cortex_m3
    tags:
      - zcbor_bulk
      - mgmt
      - mcumgr
```

## tests/subsys/mgmt/smp_reassembly/Kconfig
```kconfig
#
# Copyright (c) 2022 Nordic Semiconductor ASA
#
# SPDX-License-Identifier: Apache-2.0
#
mainmenu "SMP Reassembly unit test"

config MCUMGR_SMP_REASSEMBLY_UNIT_TESTS
	def_bool y
	select MCUMGR_SMP_REASSEMBLY
	help
	  Enable SMP Reassembly unit tests.

source "Kconfig.zephyr"
```

## tests/subsys/mgmt/zcbor_bulk/testcase.yaml
```yaml
#
# Copyright (c) 2022 Nordic Semiconductor ASA
#
# SPDX-License-Identifier: Apache-2.0
#
tests:
  zcbor.bulk:
    platform_allow: native_posix
    tags: zcbor_bulk
```

## tests/subsys/modbus/testcase.yaml
```yaml
tests:
  modbus.rtu:
    tags: modbus
    platform_allow: frdm_k64f
    harness_config:
      # MODBUS test fixture for FRDM-K64F:
      # UART3(PTC16)-RX <-> UART2(PTD3)-TX
      # UART3(PTC17)-TX <-> UART2(PTD2)-RX
      fixture: uart_loopback
  modbus.rtu.build_only:
    build_only: true
    tags: modbus
    filter: CONFIG_UART_CONSOLE and CONFIG_UART_INTERRUPT_DRIVEN
```

## tests/subsys/modem/backends/tty/testcase.yaml
```yaml
# Copyright (c) 2023 Trackunit Corporation
# SPDX-License-Identifier: Apache-2.0

tests:
  modem.backends.tty:
    tags: modem_backend_tty
    harness: ztest
    platform_allow:
      - native_posix
      - native_sim
    integration_platforms:
      - native_sim
```

## tests/subsys/modem/backends/uart/Kconfig
```kconfig
# Copyright (c) 2025 Nordic Semiconductor ASA
# SPDX-License-Identifier: Apache-2.0

source "Kconfig.zephyr"

config TEST_HW_FLOW_CONTROL
	bool "Test hardware flow control"
	help
	  By default, the test uses backend transmit and receive
	  buffers of adequate size, and waits until transmitted
	  data has been fully received before next transmit.

	  This option limits the backend receive buffer size and
	  imposes a delay on reading received data, ensuring
	  transmitted data will be dropped if hw flow control is
	  not enabled.
```

## tests/subsys/modem/backends/uart/testcase.yaml
```yaml
# Copyright (c) 2023 Trackunit Corporation
# SPDX-License-Identifier: Apache-2.0

common:
  harness: ztest
  harness_config:
    fixture: gpio_loopback
  platform_allow:
    - b_u585i_iot02a
    - nrf5340dk/nrf5340/cpuapp

tests:
  modem.backends.uart.async:
    extra_configs:
      - CONFIG_UART_ASYNC_API=y

  modem.backends.uart.isr:
    extra_configs:
      - CONFIG_UART_INTERRUPT_DRIVEN=y
```

## tests/subsys/modem/modem_chat/Kconfig
```kconfig
# Copyright (c) 2025 Embeint Pty Ltd
# SPDX-License-Identifier: Apache-2.0

config MODEM_MOCK_BACKEND_LIMIT
	int "Mock backend TX limit for test"
	default 8

config MODEM_CHAT_TEST_CONDITIONAL_COMMANDS
	bool "Force MODEM_CHAT_CONDITIONAL_COMMANDS for testing"
	select MODEM_CHAT_CONDITIONAL_COMMANDS

source "Kconfig.zephyr"
```

## tests/subsys/modem/modem_chat/testcase.yaml
```yaml
# Copyright (c) 2023 Trackunit Corporation
# SPDX-License-Identifier: Apache-2.0

common:
  tags: modem_chat
  harness: ztest
  platform_allow:
    - native_sim
  integration_platforms:
    - native_sim
tests:
  modem.modem_chat: {}
  modem.modem_chat.workq:
    extra_configs:
      - CONFIG_MODEM_DEDICATED_WORKQUEUE=y
```

## tests/subsys/modem/modem_cmux/testcase.yaml
```yaml
# Copyright (c) 2023 Trackunit Corporation
# SPDX-License-Identifier: Apache-2.0

common:
  tags: modem_cmux
  harness: ztest
  platform_allow:
    - native_sim
  integration_platforms:
    - native_sim
tests:
  modem.modem_cmux: {}
  modem.modem_cmux.double_transmit:
    extra_configs:
      - CONFIG_TEST_MODEM_MOCK_BACKEND_DOUBLE_TRANSMIT=y
```

## tests/subsys/modem/modem_pipe/Kconfig
```kconfig
# Copyright (c) 2026 Embeint Inc
# SPDX-License-Identifier: Apache-2.0

config TEST_PIPE_BACKEND_TRANSMIT_CHAIN
	bool "Support the `transmit_chain` API variant"

source "Kconfig.zephyr"
```

## tests/subsys/modem/modem_pipe/testcase.yaml
```yaml
# Copyright (c) 2023 Trackunit Corporation
# SPDX-License-Identifier: Apache-2.0

common:
  tags: modem_pipe
  harness: ztest
  platform_allow: native_sim
tests:
  modem.modem_pipe: {}
  modem.modem_pipe.double_transmit:
    extra_configs:
      - CONFIG_TEST_PIPE_BACKEND_DOUBLE_TRANSMIT=y
```

## tests/subsys/modem/modem_pipelink/testcase.yaml
```yaml
# Copyright (c) 2024 Trackunit Corporation
# SPDX-License-Identifier: Apache-2.0

tests:
  modem.modem_pipelink:
    tags: modem_pipelink
    harness: ztest
```

## tests/subsys/modem/modem_ppp/testcase.yaml
```yaml
# Copyright (c) 2023 Trackunit Corporation
# SPDX-License-Identifier: Apache-2.0

tests:
  modem.modem_ppp:
    tags: modem_ppp
    harness: ztest
    platform_allow:
      - native_sim
    integration_platforms:
      - native_sim
```

## tests/subsys/modules/testcase.yaml
```yaml
common:
  tags: modules
tests:
  modules.simple.arm:
    filter: not CONFIG_CPU_HAS_MMU
    arch_allow: arm
    extra_configs:
      - CONFIG_ARM_MPU=n
```

## tests/subsys/morse/api/testcase.yaml
```yaml
# SPDX-License-Identifier: Apache-2.0

tests:
  subsys.morse.api:
    tags:
      - morse
      - subsys
    platform_allow:
      - native_sim
```

## tests/subsys/morse/rx/testcase.yaml
```yaml
# SPDX-License-Identifier: Apache-2.0

tests:
  subsys.morse.rx:
    tags:
      - morse
      - subsys
    platform_allow:
      - native_sim
    timeout: 120
```

## tests/subsys/morse/tx/testcase.yaml
```yaml
# SPDX-License-Identifier: Apache-2.0

tests:
  subsys.morse.tx:
    tags:
      - morse
      - subsys
    platform_allow:
      - native_sim
    timeout: 120
```

## tests/subsys/mp/build_all/testcase.yaml
```yaml
tests:

  mp.core.build:
    tags:
      - subsys
      - mp
    build_only: true
    platform_allow:
      - native_sim/native/64

  mp.audio.build:
    tags:
      - subsys
      - mp
    build_only: true
    platform_allow:
      - native_sim/native/64
    extra_args:
      - CONFIG_I2S=y
      - CONFIG_AUDIO_DMIC=y
      - CONFIG_AUDIO_CODEC=y
      - CONFIG_MP_PLUGIN_ZAUD=y
```

## tests/subsys/mp/core/pipeline/testcase.yaml
```yaml
tests:
  mp.core.pipeline:
    tags:
      - subsys
      - mp
    platform_allow:
      - native_sim/native/64
```

## tests/subsys/mp/core/unit/testcase.yaml
```yaml
tests:
  mp.core.unit:
    platform_allow:
      - native_sim/native/64
    tags:
      - mp
      - unit
    integration_platforms:
      - native_sim/native/64
    timeout: 60
```

## tests/subsys/mp/plugins/zaud/testcase.yaml
```yaml
tests:
  mp.plugins.zaud:
    platform_allow:
      - native_sim/native/64
    tags:
      - mp
      - audio
      - unit
    integration_platforms:
      - native_sim/native/64
    timeout: 60
```

## tests/subsys/nvmem/api/testcase.yaml
```yaml
common:
  tags:
    - nvmem
tests:
  nvmem.api.bbram:
    platform_allow:
      - native_sim
    integration_platforms:
      - native_sim
    extra_configs:
      - CONFIG_BBRAM=y
    extra_dtc_overlay_files:
      - bbram.overlay
  nvmem.api.eeprom:
    platform_allow:
      - native_sim
    integration_platforms:
      - native_sim
    extra_configs:
      - CONFIG_EEPROM=y
    extra_dtc_overlay_files:
      - eeprom.overlay
  nvmem.api.flash:
    platform_allow:
      - native_sim
    integration_platforms:
      - native_sim
    extra_configs:
      - CONFIG_FLASH=y
      - CONFIG_NVMEM_FLASH_WRITE=y
    extra_dtc_overlay_files:
      - flash.overlay
  nvmem.api.otp:
    platform_allow:
      - native_sim
    integration_platforms:
      - native_sim
    extra_configs:
      - CONFIG_OTP=y
      - CONFIG_OTP_PROGRAM=y
      - CONFIG_NVMEM_OTP_WRITE=y
    extra_dtc_overlay_files:
      - otp.overlay
  nvmem.api.mmio:
    # MMIO needs a real, dereferenceable physical address, so it runs on a
    # target with memory backed at a fixed address rather than native_sim.
    platform_allow:
      - qemu_cortex_m3
    integration_platforms:
      - qemu_cortex_m3
    extra_configs:
      - CONFIG_NVMEM_MMIO=y
    extra_dtc_overlay_files:
      - mmio.overlay
```

## tests/subsys/openthread/testcase.yaml
```yaml
common:
  platform_allow:
    - native_posix
    - native_posix/native/64
    - native_sim
    - native_sim/native/64
  integration_platforms:
    - native_sim
  tags:
    - openthread
tests:
  openthread.radio_test.min: {}
  openthread.radio_test.timed_tx:
    extra_configs:
      - CONFIG_NET_PKT_TXTIME=y
  openthread.radio_test.csl:
    # Hack to enable CSL w/o having to enable CONFIG_OPENTHREAD
    extra_args:
      - EXTRA_CPPFLAGS=-DCONFIG_OPENTHREAD_CSL_RECEIVER
```

## tests/subsys/osal/testcase.yaml
```yaml
common:
  tags: osal
tests:
  osal.api:
    platform_allow:
      - native_sim
      - native_sim/native/64
      - qemu_x86
      - qemu_cortex_m3
    integration_platforms:
      - native_sim
  osal.api.smp:
    # Real multi-core SMP target so the cross-CPU spinlock / critical-section
    # contention tests actually run (native_sim is single-CPU only).
    extra_args:
      - CONFIG_SCHED_CPU_MASK=y
    platform_allow:
      - qemu_cortex_a53/qemu_cortex_a53/smp
      - qemu_riscv64/qemu_virt_riscv64/smp
    integration_platforms:
      - qemu_cortex_a53/qemu_cortex_a53/smp
  osal.api.static_alloc:
    extra_args:
      - CONFIG_OSAL_DYNAMIC_ALLOC=n
      - CONFIG_OSAL_MAX_THREADS=8
      - CONFIG_OSAL_MAX_OBJECTS=16
    platform_allow:
      - native_sim
    integration_platforms:
      - native_sim
```
