## CMakeLists.txt
```
#
# Copyright (c) 2022 Nordic Semiconductor ASA
#
# SPDX-License-Identifier: Apache-2.0
#

cmake_minimum_required(VERSION 3.20.0)
find_package(Zephyr REQUIRED HINTS $ENV{ZEPHYR_BASE})
project(all_options)

FILE(GLOB app_sources
	src/*.c
)

target_sources(app PRIVATE ${app_sources})
```

## prj.conf
```kconfig
#
# Copyright (c) 2024 Jamie McCrae
#
# SPDX-License-Identifier: Apache-2.0
#

CONFIG_ZTEST=y
CONFIG_NET_BUF=y
CONFIG_ZCBOR=y
CONFIG_MCUMGR=y
CONFIG_LORA=y
CONFIG_LORAWAN=y
CONFIG_LORAWAN_REGION_EU868=y
CONFIG_SYSTEM_WORKQUEUE_STACK_SIZE=3000
CONFIG_MCUMGR_TRANSPORT_LORAWAN=y
CONFIG_MCUMGR_TRANSPORT_LORAWAN_CONFIRMED_UPLINKS=n
CONFIG_MCUMGR_TRANSPORT_LORAWAN_REASSEMBLY=n
CONFIG_MCUMGR_TRANSPORT_LORAWAN_POLL_FOR_DATA=n
CONFIG_MCUMGR_TRANSPORT_LORAWAN_FRAGMENTED_UPLINKS=n
```

## lorawan_all.conf
```kconfig
#
# Copyright (c) 2024 Jamie McCrae
#
# SPDX-License-Identifier: Apache-2.0
#

CONFIG_MCUMGR_TRANSPORT_LORAWAN_CONFIRMED_UPLINKS=y
CONFIG_MCUMGR_TRANSPORT_LORAWAN_REASSEMBLY=y
CONFIG_MCUMGR_TRANSPORT_LORAWAN_POLL_FOR_DATA=y
CONFIG_MCUMGR_TRANSPORT_LORAWAN_FRAGMENTED_UPLINKS=y
```

## src/main.c
```c
/*
 * Copyright (c) 2024 Jamie McCrae
 *
 * SPDX-License-Identifier: Apache-2.0
 */

#if !defined(CONFIG_MCUMGR_TRANSPORT_LORAWAN)
#error "Expected Kconfig option CONFIG_MCUMGR_TRANSPORT_LORAWAN not enabled"
#endif
```
