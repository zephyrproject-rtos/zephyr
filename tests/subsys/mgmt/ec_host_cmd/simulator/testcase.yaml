## tests/subsys/mgmt/ec_host_cmd/simulator/testcase.yaml
```yaml
tests:
  mgmt.ec_host_cmd.simulator.core:
    platform_allow:
      - native_sim
    integration_platforms:
      - native_sim
    tags: ec_host_cmd
```

## tests/subsys/mgmt/ec_host_cmd/testcase.yaml
```yaml
tests:
  ec_host_cmd.core:
    platform_allow: native_posix
    tags: ec_host_cmd
```

## tests/subsys/mgmt/ec_host_cmd/uart/Kconfig
```kconfig
# Copyright (c) 2023 Google LLC
# SPDX-License-Identifier: Apache-2.0

# This config is used to select SERIAL_SUPPORT_ASYNC, to satisfy CONFIG_UART_ASYNC_API dependencies
config UART_ASYNC_MOCK
	bool "Mock UART async driver"
	default y
	select SERIAL_SUPPORT_ASYNC

source "Kconfig.zephyr"
```

## tests/subsys/mgmt/ec_host_cmd/uart/testcase.yaml
```yaml
tests:
  mgmt.ec_host_cmd.uart.core:
    platform_allow:
      - native_posix
      - native_sim
    integration_platforms:
      - native_sim
    tags: ec_host_cmd
```

## tests/subsys/mgmt/mcumgr/all_options/testcase.yaml
```yaml
#
# Copyright (c) 2022-2023 Nordic Semiconductor ASA
#
# SPDX-License-Identifier: Apache-2.0
#
common:
  platform_allow: nrf52840dk_nrf52840
  tags:
    - mgmt
    - mcumgr
    - all_options
  build_only: true
tests:
  mgmt.mcumgr.all.options: {}
  mgmt.mcumgr.all.options.other:
    extra_args:
      - OVERLAY_CONFIG="other-options.conf"
```

## tests/subsys/mgmt/mcumgr/cb_notifications/testcase.yaml
```yaml
#
# Copyright (c) 2023 Nordic Semiconductor ASA
#
# SPDX-License-Identifier: Apache-2.0
#
tests:
  mgmt.mcumgr.cb.notifications:
    platform_allow:
      - qemu_cortex_m3
      - native_sim
      - native_sim/native/64
      - qemu_riscv/qemu_virt_riscv/rv32/smp
      - qemu_riscv/qemu_virt_riscv/rv64
    integration_platforms:
      - native_sim
    tags:
      - cb_notifications
      - mcumgr
```

## tests/subsys/mgmt/mcumgr/enum_mgmt/testcase.yaml
```yaml
#
# Copyright (c) 2024 Nordic Semiconductor ASA
#
# SPDX-License-Identifier: Apache-2.0
#
common:
  platform_allow:
    - native_sim
    - native_sim/native/64
    - nrf52840dk/nrf52840
  tags:
    - mgmt
    - mcumgr
    - enum_mgmt
tests:
  mgmt.mcumgr.enum.mgmt:
    build_only: false
  mgmt.mcumgr.enum.mgmt.shell:
    extra_configs:
      - CONFIG_SHELL=y
      - CONFIG_SHELL_BACKEND_DUMMY=y
      - CONFIG_MCUMGR_GRP_SHELL=y
  mgmt.mcumgr.enum.mgmt.os:
    extra_configs:
      - CONFIG_MCUMGR_GRP_OS=y
  mgmt.mcumgr.enum.mgmt.shell.os:
    extra_configs:
      - CONFIG_SHELL=y
      - CONFIG_SHELL_BACKEND_DUMMY=y
      - CONFIG_MCUMGR_GRP_SHELL=y
      - CONFIG_MCUMGR_GRP_OS=y
```

## tests/subsys/mgmt/mcumgr/fs_mgmt_hash_supported/testcase.yaml
```yaml
#
# Copyright (c) 2022 Nordic Semiconductor ASA
#
# SPDX-License-Identifier: Apache-2.0
#
common:
  tags:
    - mgmt
    - mcumgr
    - fs_mgmt_hash_supported
  integration_platforms:
    - native_sim
  platform_exclude:
    - lpcxpresso51u68
    - lpcxpresso55s69/lpc55s69/cpu1
    - mpfs_icicle/polarfire/u54
    - mpfs_icicle/polarfire/u54/smp
    - mpfs_icicle/polarfire/e51
    - apollo4p_evb
    - cyw920829m2evk_02
tests:
  mgmt.mcumgr.fs.mgmt.hash.supported.crc32:
    extra_args: >
      OVERLAY_CONFIG="configuration/crc32.conf"
  mgmt.mcumgr.fs.mgmt.hash.supported.sha256:
    extra_args: >
      OVERLAY_CONFIG="configuration/sha256.conf"
  mgmt.mcumgr.fs.mgmt.hash.supported.all:
    extra_args: >
      OVERLAY_CONFIG="configuration/all.conf"
```

## tests/subsys/mgmt/mcumgr/handler_demo/Kconfig
```kconfig
# Copyright Nordic Semiconductor ASA 2023. All rights reserved.
# SPDX-License-Identifier: Apache-2.0
# The Kconfig file is dedicated to example management group of
# of MCUmgr subsystem and provides Kconfig options to configure
# group commands behaviour and other aspects.
#
# Options defined in this file should be prefixed:
#  MCUMGR_GRP_EXAMPLE_ -- general group options;
#
# When adding Kconfig options, that control the same feature,
# try to group them together by the same stem after prefix.
if MCUMGR

menuconfig MCUMGR_GRP_EXAMPLE_APP
	bool "MCUmgr handlers for example management (app)"
	select MCUMGR_SMP_CBOR_MIN_DECODING_LEVEL_2
	default y
	help
	  Enables MCUmgr handlers for example management. This demonstrates the
	  file at application-level.

if MCUMGR_GRP_EXAMPLE_APP
config MCUMGR_GRP_EXAMPLE_OTHER_HOOK
	bool "Other hook"
	depends on MCUMGR_MGMT_NOTIFICATION_HOOKS
	help
	  Allows applications to receive callback when the "other" example
	  management function is called

module = MCUMGR_GRP_EXAMPLE
module-str = mcumgr_grp_example
source "subsys/logging/Kconfig.template.log_config"

endif

endif

source "Kconfig.zephyr"
```

## tests/subsys/mgmt/mcumgr/handler_demo/example_as_module/Kconfig
```kconfig
# Copyright Nordic Semiconductor ASA 2023. All rights reserved.
# SPDX-License-Identifier: Apache-2.0
# The Kconfig file is dedicated to example management group of
# of MCUmgr subsystem and provides Kconfig options to configure
# group commands behaviour and other aspects.
#
# Options defined in this file should be prefixed:
#  MCUMGR_GRP_EXAMPLE_ -- general group options;
#
# When adding Kconfig options, that control the same feature,
# try to group them together by the same stem after prefix.
if MCUMGR

menuconfig MCUMGR_GRP_EXAMPLE_MODULE
	bool "MCUmgr handlers for example management (module)"
	depends on !MCUMGR_GRP_EXAMPLE_APP
	select MCUMGR_SMP_CBOR_MIN_DECODING_LEVEL_2
	help
	  Enables MCUmgr handlers for example management. This demonstrates the
	  file at a zephyr module level.

if MCUMGR_GRP_EXAMPLE_MODULE

config MCUMGR_GRP_EXAMPLE_OTHER_HOOK
	bool "Other hook"
	depends on MCUMGR_MGMT_NOTIFICATION_HOOKS
	help
	  Allows applications to receive callback when the "other" example
	  management function is called

module = MCUMGR_GRP_EXAMPLE
module-str = mcumgr_grp_example
source "subsys/logging/Kconfig.template.log_config"

endif
endif
```

## tests/subsys/mgmt/mcumgr/handler_demo/testcase.yaml
```yaml
#
# Copyright (c) 2023 Nordic Semiconductor ASA
#
# SPDX-License-Identifier: Apache-2.0
#

common:
  tags:
    - handler_demo
    - mcumgr
    - mgmt
tests:
  mgmt.mcumgr.handler.demo:
    platform_allow:
      - nrf52840dk/nrf52840
    integration_platforms:
      - nrf52840dk/nrf52840
    build_only: true
  mgmt.mcumgr.handler.demo.module:
    extra_args:
      - OVERLAY_CONFIG="module.conf"
    platform_allow:
      - nrf52840dk/nrf52840
    integration_platforms:
      - nrf52840dk/nrf52840
    build_only: true
```

## tests/subsys/mgmt/mcumgr/img_mgmt_slot_info/testcase.yaml
```yaml
#
# Copyright (c) 2024 Nordic Semiconductor ASA
#
# SPDX-License-Identifier: Apache-2.0
#
common:
  platform_allow:
    - nrf52840dk/nrf52840
    - nrf5340dk/nrf5340/cpuapp
  tags:
    - mgmt
    - mcumgr
    - img_mgmt
  build_only: false
tests:
  img.mgmt.slot.info: {}
  img.mgmt.slot.info.too.large:
    extra_args:
      - FILE_SUFFIX=too_large
  img.mgmt.slot.info.dual.slot:
    extra_args:
      - FILE_SUFFIX=dual_slot
```

## tests/subsys/mgmt/mcumgr/mcumgr_client/testcase.yaml
```yaml
#
# Copyright (c) 2023 Nordic Semiconductor ASA
#
# SPDX-License-Identifier: Apache-2.0
#
tests:
  mgmt.mcumgr.mcumgr.client:
    platform_allow: native_posix
    tags:
      - mcumgr
      - mcumgr_client
```

## tests/subsys/mgmt/mcumgr/os_mgmt_datetime/testcase.yaml
```yaml
#
# Copyright (c) 2023 Nordic Semiconductor ASA
#
# SPDX-License-Identifier: Apache-2.0
#
common:
  tags:
    - mcumgr
    - os_mgmt_datetime
  platform_allow:
    - native_sim
    - qemu_cortex_m0
    - qemu_riscv/qemu_virt_riscv/rv64
    - qemu_riscv/qemu_virt_riscv/rv64/smp
    - qemu_malta
    - qemu_arc/qemu_arc_hs6x
    - qemu_leon3
  integration_platforms:
    - native_sim
tests:
  mgmt.mcumgr.os.datetime: {}
```

## tests/subsys/mgmt/mcumgr/os_mgmt_echo/testcase.yaml
```yaml
#
# Copyright (c) 2022 Nordic Semiconductor ASA
#
# SPDX-License-Identifier: Apache-2.0
#
tests:
  os.mgmt.echo:
    # FIXME: Exclude architectures that lack a reboot handler function
    arch_exclude: arm64 nios2 sparc arc xtensa mips
    tags: os_mgmt_echo
```

## tests/subsys/mgmt/mcumgr/os_mgmt_info/Kconfig
```kconfig
# Copyright (c) 2022 Nordic Semiconductor ASA
# SPDX-License-Identifier: Apache-2.0

config CUSTOM_OS_NAME_VALUE
	string "Custom OS name"
	default "Fake OS Name"

config BUILD_DATE_TIME_TEST
	bool "Build date time test"
	select MCUMGR_GRP_OS_INFO_BUILD_DATE_TIME

config LIMITED_TEST
	bool "Limited buffer size test"

source "Kconfig.zephyr"
```

## tests/subsys/mgmt/mcumgr/os_mgmt_info/testcase.yaml
```yaml
#
# Copyright (c) 2022 Nordic Semiconductor ASA
#
# SPDX-License-Identifier: Apache-2.0
#
common:
  tags:
    - mcumgr
    - os_mgmt_info
  # FIXME: Exclude architectures that lack a reboot handler function
  arch_exclude:
    - arm64
    - nios2
    - sparc
    - arc
    - xtensa
    - mips
    - posix
tests:
  mgmt.mcumgr.os.info: {}
  mgmt.mcumgr.os.info.no_hooks:
    extra_configs:
      - CONFIG_MCUMGR_GRP_OS_INFO_CUSTOM_HOOKS=n
      - CONFIG_MCUMGR_MGMT_NOTIFICATION_HOOKS=n
  mgmt.mcumgr.os.info.bt:
    depends_on: ble
    extra_configs:
      - CONFIG_BT=y
      - CONFIG_BT_DEVICE_NAME="a_bt_name"
  mgmt.mcumgr.os.info.net:
    depends_on: netif
    # FIXME: Exclude systems whereby the processor type is not known and emits a warning
    platform_exclude:
      - qemu_cortex_a9
      - qemu_x86
      - qemu_riscv64_smp
      - qemu_riscv64
      - qemu_riscv32e
      - qemu_riscv32
      - qemu_riscv32_smp
      - qemu_cortex_m3
      - mps2_an385
    extra_configs:
      - CONFIG_NETWORKING=y
      - CONFIG_NET_HOSTNAME_ENABLE=y
      - CONFIG_NET_HOSTNAME="test_net_name"
      - CONFIG_TEST_RANDOM_GENERATOR=y
  mgmt.mcumgr.os.info.build_date:
    extra_configs:
      - CONFIG_BUILD_DATE_TIME_TEST=y
  mgmt.mcumgr.os.info.limited_size:
    extra_configs:
      - CONFIG_LIMITED_TEST=y
      - CONFIG_MCUMGR_TRANSPORT_DUMMY_RX_BUF_SIZE=64
      - CONFIG_MCUMGR_GRP_OS_INFO_MAX_RESPONSE_SIZE=32
```

## tests/subsys/mgmt/mcumgr/settings_mgmt/testcase.yaml
```yaml
#
# Copyright (c) 2023 Nordic Semiconductor ASA
#
# SPDX-License-Identifier: Apache-2.0
#
tests:
  settings.mgmt:
    platform_allow:
      - native_posix
      - native_posix/native/64
      - native_sim
      - native_sim/native/64
      - nrf52840dk/nrf52840
    tags:
      - settings_mgmt
      - mcumgr
```

## tests/subsys/mgmt/mcumgr/smp_client/testcase.yaml
```yaml
#
# Copyright (c) 2023 Nordic Semiconductor ASA
#
# SPDX-License-Identifier: Apache-2.0
#
tests:
  mgmt.mcumgr.smp.client:
    platform_allow:
      - native_sim
    integration_platforms:
      - native_sim
    tags:
      - mcumgr
      - smp_client
```

## tests/subsys/mgmt/mcumgr/smp_group_0/testcase.yaml
```yaml
#
# Copyright (c) 2022 Nordic Semiconductor ASA
#
# SPDX-License-Identifier: Apache-2.0
#
tests:
  mcumgr.smp_group_0:
    platform_allow: native_posix
    tags: mcumgr, smp
```

## tests/subsys/mgmt/mcumgr/smp_reassembly/Kconfig
```kconfig
#
# Copyright (c) 2022 Nordic Semiconductor ASA
#
# SPDX-License-Identifier: Apache-2.0
#
mainmenu "SMP Reassembly unit test"

config MCUMGR_TRANSPORT_REASSEMBLY_UNIT_TESTS
	def_bool y
	select MCUMGR_TRANSPORT_REASSEMBLY
	help
	  Enable SMP Reassembly unit tests.

source "Kconfig.zephyr"
```

## tests/subsys/mgmt/mcumgr/smp_reassembly/testcase.yaml
```yaml
#
# Copyright (c) 2022 Nordic Semiconductor ASA
#
# SPDX-License-Identifier: Apache-2.0
#
tests:
  mgmt.mcumgr.smp.reassembly:
    platform_allow:
      - native_posix/native
      - native_sim/native
    integration_platforms:
      - native_sim/native
    tags:
      - smp_reassembly
      - mgmt
      - mcumgr
```

## tests/subsys/mgmt/mcumgr/smp_version/testcase.yaml
```yaml
#
# Copyright (c) 2023 Nordic Semiconductor ASA
#
# SPDX-License-Identifier: Apache-2.0
#
tests:
  mgmt.mcumgr.smp.version:
    tags:
      - smp_version
      - mcumgr
    # FIXME: Exclude systems whereby the processor type is not known and emits a warning
    arch_exclude:
      - nios2
      - mips
      - posix
    platform_exclude:
      - qemu_kvm_arm64
  mgmt.mcumgr.smp.version_no_legacy:
    tags:
      - smp_version
      - mcumgr
    extra_configs:
      - CONFIG_MCUMGR_SMP_SUPPORT_ORIGINAL_PROTOCOL=n
    # FIXME: Exclude systems whereby the processor type is not known and emits a warning
    arch_exclude:
      - nios2
      - mips
      - posix
    platform_exclude:
      - qemu_kvm_arm64
```

## tests/subsys/mgmt/mcumgr/transport_lorawan/testcase.yaml
```yaml
#
# Copyright (c) 2024 Jamie McCrae
#
# SPDX-License-Identifier: Apache-2.0
#
common:
  platform_allow: rm1xx_dvk
  tags:
    - mgmt
    - mcumgr
    - all_options
    - transport
    - lorawan
  build_only: true
tests:
  mgmt.mcumgr.transport.lorawan: {}
  mgmt.mcumgr.transport.lorawan.all:
    extra_args:
      - EXTRA_CONF_FILE="lorawan_all.conf"
```
