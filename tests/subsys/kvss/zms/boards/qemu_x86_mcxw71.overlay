/*
 * Copyright (c) 2026 Seyoung Jeong <seyoungjeong@gmail.com>
 *
 * SPDX-License-Identifier: Apache-2.0
 *
 * Simulate flash geometry closer to frdm_mcxw71 to catch alignment bugs
 * due to write_block_size > 1.
 */

&flash_sim0 {
	write-block-size = <8>;
};
