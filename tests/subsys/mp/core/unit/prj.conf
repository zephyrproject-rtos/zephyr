## CMakeLists.txt
```
# SPDX-License-Identifier: Apache-2.0

cmake_minimum_required(VERSION 3.20.0)
find_package(Zephyr REQUIRED HINTS $ENV{ZEPHYR_BASE})
project(mp_core_unit)

FILE(GLOB app_sources src/*.c)
target_sources(app PRIVATE ${app_sources})
```

## prj.conf
```kconfig
CONFIG_ZTEST=y
CONFIG_MP=y
CONFIG_SYS_HEAP_RUNTIME_STATS=y
CONFIG_HEAP_MEM_POOL_SIZE=32768
```

## src/mp_test_helpers.h
```c
/*
 * Copyright 2026 NXP
 *
 * SPDX-License-Identifier: Apache-2.0
 */

#ifndef TESTS_SUBSYS_MP_CORE_UNIT_SRC_MP_TEST_HELPERS_H_
#define TESTS_SUBSYS_MP_CORE_UNIT_SRC_MP_TEST_HELPERS_H_

#include <zephyr/mp/mp_value.h>
#include <zephyr/ztest.h>

#define validate_boolean_value(value, expected)                                                    \
	({                                                                                         \
		zassert_not_null(value);                                                           \
		zassert_equal((value)->type, MP_TYPE_BOOLEAN);                                     \
		zassert_equal(mp_value_get_boolean(value), expected);                              \
	})

#define validate_int_value(value, expected)                                                        \
	({                                                                                         \
		zassert_not_null(value);                                                           \
		zassert_equal((value)->type, MP_TYPE_INT);                                         \
		zassert_equal(mp_value_get_int(value), expected);                                  \
	})

#define validate_uint_value(value, expected)                                                       \
	({                                                                                         \
		zassert_not_null(value);                                                           \
		zassert_equal((value)->type, MP_TYPE_UINT);                                        \
		zassert_equal(mp_value_get_uint(value), expected);                                 \
	})

#define validate_string_value(value, expected)                                                     \
	({                                                                                         \
		zassert_not_null(value);                                                           \
		zassert_equal((value)->type, MP_TYPE_STRING);                                      \
		zassert_str_equal(mp_value_get_string(value), expected);                           \
	})

#define validate_int_fraction_value(value, num, denom)                                             \
	({                                                                                         \
		zassert_not_null(value);                                                           \
		zassert_equal((value)->type, MP_TYPE_INT_FRACTION);                                \
		zassert_equal(mp_value_get_fraction_numerator(value), num);                        \
		zassert_equal(mp_value_get_fraction_denominator(value), denom);                    \
	})

#define validate_uint_fraction_value(value, num, denom)                                            \
	({                                                                                         \
		zassert_not_null(value);                                                           \
		zassert_equal((value)->type, MP_TYPE_UINT_FRACTION);                               \
		zassert_equal(mp_value_get_fraction_numerator(value), num);                        \
		zassert_equal(mp_value_get_fraction_denominator(value), denom);                    \
	})

#define validate_int_range_value(value, min, max, step)                                            \
	({                                                                                         \
		zassert_not_null(value);                                                           \
		zassert_equal((value)->type, MP_TYPE_INT_RANGE);                                   \
		zassert_equal(mp_value_get_int_range_min(value), min);                             \
		zassert_equal(mp_value_get_int_range_max(value), max);                             \
		zassert_equal(mp_value_get_int_range_step(value), step);                           \
	})

#define validate_uint_range_value(value, min, max, step)                                           \
	({                                                                                         \
		zassert_not_null(value);                                                           \
		zassert_equal((value)->type, MP_TYPE_UINT_RANGE);                                  \
		zassert_equal(mp_value_get_uint_range_min(value), min);                            \
		zassert_equal(mp_value_get_uint_range_max(value), max);                            \
		zassert_equal(mp_value_get_uint_range_step(value), step);                          \
	})

#define validate_fraction_int_range(value, min_num, min_denom, max_num, max_denom, step_num,       \
				    step_denom)                                                    \
	({                                                                                         \
		zassert_not_null(value);                                                           \
		zassert_equal((value)->type, MP_TYPE_INT_FRACTION_RANGE);                          \
		const struct mp_value *frac = mp_value_get_fraction_range_min(value);              \
		zassert_equal(mp_value_get_fraction_numerator(frac), min_num);                     \
		zassert_equal(mp_value_get_fraction_denominator(frac), min_denom);                 \
		frac = mp_value_get_fraction_range_max(value);                                     \
		zassert_equal(mp_value_get_fraction_numerator(frac), max_num);                     \
		zassert_equal(mp_value_get_fraction_denominator(frac), max_denom);                 \
		frac = mp_value_get_fraction_range_step(value);                                    \
		zassert_equal(mp_value_get_fraction_numerator(frac), step_num);                    \
		zassert_equal(mp_value_get_fraction_denominator(frac), step_denom);                \
	})

#define validate_uint_fraction_range(value, min_num, min_denom, max_num, max_denom, step_num,      \
				     step_denom)                                                   \
	({                                                                                         \
		zassert_not_null(value);                                                           \
		zassert_equal((value)->type, MP_TYPE_UINT_FRACTION_RANGE);                         \
		const struct mp_value *frac = mp_value_get_fraction_range_min(value);              \
		zassert_equal(mp_value_get_fraction_numerator(frac), min_num);                     \
		zassert_equal(mp_value_get_fraction_denominator(frac), min_denom);                 \
		frac = mp_value_get_fraction_range_max(value);                                     \
		zassert_equal(mp_value_get_fraction_numerator(frac), max_num);                     \
		zassert_equal(mp_value_get_fraction_denominator(frac), max_denom);                 \
		frac = mp_value_get_fraction_range_step(value);                                    \
		zassert_equal(mp_value_get_fraction_numerator(frac), step_num);                    \
		zassert_equal(mp_value_get_fraction_denominator(frac), step_denom);                \
	})

#define validate_list_value_type_and_size(value, expected_size)                                    \
	({                                                                                         \
		zassert_not_null(value);                                                           \
		zassert_equal((value)->type, MP_TYPE_LIST);                                        \
		zassert_equal(mp_value_list_get_size(value), expected_size);                       \
	})

#endif /* TESTS_SUBSYS_MP_CORE_UNIT_SRC_MP_TEST_HELPERS_H_ */
```

## src/test_bin.c
```c
/*
 * Copyright 2026 NXP
 *
 * SPDX-License-Identifier: Apache-2.0
 */

#include <zephyr/kernel.h>
#include <zephyr/ztest.h>
#include <zephyr/mp/mp_bin.h>
#include <zephyr/mp/mp_element.h>
#include <zephyr/mp/mp_pad.h>
#include <zephyr/mp/mp_pipeline.h>
#include <zephyr/mp/mp_src.h>
#include <zephyr/mp/mp_sink.h>

struct mp_bin_api_fixture {
	struct mp_bin bin;
	struct mp_pipeline pipeline;
	struct mp_sink sink;
	struct mp_src src;
};

static void *bin_suite_setup(void)
{
	static struct mp_bin_api_fixture fixture;

	return &fixture;
}

static void bin_before(void *f)
{
	struct mp_bin_api_fixture *fix = f;

	memset(fix, 0, sizeof(*fix));
	MP_ELEMENT_INIT((struct mp_element *)&fix->bin, mp_bin_init, 0);
	MP_ELEMENT_INIT((struct mp_element *)&fix->src, mp_src_init, 1);
	MP_ELEMENT_INIT((struct mp_element *)&fix->sink, mp_sink_init, 2);

	zassert_equal(fix->bin.children_num, 0, "children_num != 0 after init");
	zassert_true(sys_dlist_is_empty(&fix->bin.children), "children list not empty after init");
	zassert_equal(((struct mp_element *)&fix->bin)->current_state, MP_STATE_READY,
		      "state != READY after init");
}

ZTEST_SUITE(mp_bin_api, NULL, bin_suite_setup, bin_before, NULL, NULL);

ZTEST_F(mp_bin_api, test_add_elements)
{
	zassert_ok(mp_bin_add(&fixture->bin, NULL), "mp_bin_add(NULL) failed");
	zassert_equal(fixture->bin.children_num, 0, "children_num != 0");

	zassert_ok(mp_bin_add(&fixture->bin, (struct mp_element *)&fixture->src, NULL),
		   "mp_bin_add(src) failed");
	zassert_equal(fixture->bin.children_num, 1, "children_num != 1");
	zassert_equal(fixture->src.element.object.container, (struct mp_object *)&fixture->bin,
		      "src container != bin");

	zassert_ok(mp_bin_add(&fixture->bin, (struct mp_element *)&fixture->sink, NULL),
		   "mp_bin_add(sink) failed");
	zassert_equal(fixture->bin.children_num, 2, "children_num != 2");

	sys_dnode_t *first = sys_dlist_peek_head(&fixture->bin.children);

	zassert_not_null(first, "children list is empty");

	struct mp_element *first_elem = CONTAINER_OF(first, struct mp_element, object.node);

	zassert_equal(first_elem->object.id, 1, "first child id != 1");

	struct mp_src dup_src;

	memset(&dup_src, 0, sizeof(dup_src));
	MP_ELEMENT_INIT((struct mp_element *)&dup_src, mp_src_init, 1);

	zassert_true(mp_bin_add(&fixture->bin, (struct mp_element *)&dup_src, NULL) < 0,
		     "duplicate id add did not fail");
	zassert_equal(fixture->bin.children_num, 2, "children_num changed on failed add");
}

ZTEST_F(mp_bin_api, test_add_varargs)
{
	zassert_ok(mp_bin_add(&fixture->bin, (struct mp_element *)&fixture->src,
			      (struct mp_element *)&fixture->sink, NULL),
		   "mp_bin_add(src, sink) failed");
	zassert_equal(fixture->bin.children_num, 2, "children_num != 2");
}
```

## src/test_buffer.c
```c
/*
 * Copyright 2026 NXP
 *
 * SPDX-License-Identifier: Apache-2.0
 */

#include <zephyr/kernel.h>
#include <zephyr/sys/sys_heap.h>
#include <zephyr/ztest.h>

#include <zephyr/mp/core/mp_buffer.h>
#include <zephyr/mp/core/mp_caps.h>
#include <zephyr/mp/core/mp_structure.h>

extern struct k_heap _system_heap;

struct mp_buffer_api_fixture {
	struct sys_memory_stats mem_before;
};

static void *buffer_suite_setup(void)
{
	static struct mp_buffer_api_fixture fixture;

	return &fixture;
}

static void buffer_before(void *f)
{
	struct mp_buffer_api_fixture *fix = f;

	sys_heap_runtime_stats_get(&_system_heap.heap, &fix->mem_before);
}

static void buffer_after(void *f)
{
	struct mp_buffer_api_fixture *fix = f;
	struct sys_memory_stats mem_after;

	sys_heap_runtime_stats_get(&_system_heap.heap, &mem_after);
	zassert_equal(fix->mem_before.allocated_bytes, mem_after.allocated_bytes,
		      "Memory leak detected: before=%zu after=%zu", fix->mem_before.allocated_bytes,
		      mem_after.allocated_bytes);
}

ZTEST_SUITE(mp_buffer_api, NULL, buffer_suite_setup, buffer_before, buffer_after, NULL);

static struct mp_buffer_pool pool;

ZTEST(mp_buffer_api, test_sanity)
{
	struct mp_structure *config = mp_structure_new(MP_MEDIA_AUDIO_PCM, MP_STRUCTURE_END);

	mp_buffer_pool_init(&pool);
	zassert_false(pool.started, "pool.started != false after init");

	zassert_true(mp_buffer_pool_configure(NULL, config) < 0,
		     "configure NULL pool did not fail");

	zassert_true(mp_buffer_pool_configure(&pool, config) < 0,
		     "configure(no callback) did not fail");

	mp_structure_destroy(config);

	zassert_true(mp_buffer_pool_start(NULL) < 0, "start NULL pool did not fail");

	pool.start = NULL;
	zassert_true(mp_buffer_pool_start(&pool) < 0, "start no callback did not fail");

	zassert_true(mp_buffer_pool_stop(NULL) < 0, "stop NULL pool did not fail");

	pool.stop = NULL;
	zassert_true(mp_buffer_pool_stop(&pool) < 0, "stop no callback did not fail");
}
```

## src/test_bus.c
```c
/*
 * Copyright 2026 NXP
 *
 * SPDX-License-Identifier: Apache-2.0
 */

#include <zephyr/kernel.h>
#include <zephyr/sys/sys_heap.h>
#include <zephyr/ztest.h>

#include <zephyr/mp/core/mp_bus.h>
#include <zephyr/mp/core/mp_element.h>
#include <zephyr/mp/core/mp_message.h>

extern struct k_heap _system_heap;

struct mp_bus_api_fixture {
	struct mp_bus bus;
	struct mp_element elem;
	struct sys_memory_stats mem_before;
	struct mp_bus_sync_listener listener;
};

static void *bus_suite_setup(void)
{
	static struct mp_bus_api_fixture fixture;

	return &fixture;
}

static void bus_before(void *f)
{
	struct mp_bus_api_fixture *fix = f;
	struct mp_message out;

	mp_bus_init(&fix->bus);
	memset(&fix->elem, 0, sizeof(fix->elem));
	mp_element_init(&fix->elem, 42);

	zassert_equal(mp_bus_peek(&fix->bus, &out), -ENOMSG, "bus not empty after init");

	sys_heap_runtime_stats_get(&_system_heap.heap, &fix->mem_before);
}

static void bus_after(void *f)
{
	struct mp_bus_api_fixture *fix = f;
	struct sys_memory_stats mem_after;

	sys_heap_runtime_stats_get(&_system_heap.heap, &mem_after);
	zassert_equal(fix->mem_before.allocated_bytes, mem_after.allocated_bytes,
		      "memory leak detected: before=%zu after=%zu", fix->mem_before.allocated_bytes,
		      mem_after.allocated_bytes);
}

ZTEST_SUITE(mp_bus_api, NULL, bus_suite_setup, bus_before, bus_after, NULL);

static int listener_call_count;
static enum mp_message_type listener_last_type;
static struct mp_element *listener_last_src;

static bool test_listener_cb(struct mp_message *message, void *user_data)
{
	listener_call_count++;
	listener_last_type = message->type;
	listener_last_src = message->origin;

	return true;
}

ZTEST_F(mp_bus_api, test_post_peek_pop)
{
	struct mp_element *src = &fixture->elem;
	struct mp_message msg;
	struct mp_message peeked;
	struct mp_message popped;

	MP_MESSAGE_INIT(&msg, src, MP_MESSAGE_EOS);
	zassert_ok(mp_bus_post(&fixture->bus, &msg), "mp_bus_post failed");

	zassert_ok(mp_bus_peek(&fixture->bus, &peeked), "mp_bus_peek failed");
	zassert_equal(peeked.type, MP_MESSAGE_EOS, "peeked type != EOS");
	zassert_equal(peeked.origin, src, "peeked src mismatch");

	zassert_ok(mp_bus_pop(&fixture->bus, &popped), "mp_bus_pop failed");
	zassert_equal(popped.type, peeked.type, "peek and pop type mismatch");
	zassert_equal(popped.origin, peeked.origin, "peek and pop src mismatch");

	zassert_equal(mp_bus_peek(&fixture->bus, &peeked), -ENOMSG, "bus not empty after pop");
}

ZTEST_F(mp_bus_api, test_post_multiple_fifo_order)
{
	struct mp_element *src = &fixture->elem;
	struct mp_message msg1;
	struct mp_message msg2;
	struct mp_message first;
	struct mp_message second;

	MP_MESSAGE_INIT(&msg1, src, MP_MESSAGE_EOS);
	MP_MESSAGE_INIT(&msg2, NULL, MP_MESSAGE_ERROR);

	mp_bus_post(&fixture->bus, &msg1);
	mp_bus_post(&fixture->bus, &msg2);

	zassert_ok(mp_bus_pop(&fixture->bus, &first));
	zassert_ok(mp_bus_pop(&fixture->bus, &second));

	zassert_equal(first.type, MP_MESSAGE_EOS, "first type != EOS");
	zassert_equal(first.origin, src, "first src mismatch");
	zassert_equal(second.type, MP_MESSAGE_ERROR, "second type != ERROR");
	zassert_is_null(second.origin, "second src != NULL");
}

ZTEST_F(mp_bus_api, test_sanity)
{
	struct mp_message msg;
	struct mp_message out;

	MP_MESSAGE_INIT(&msg, NULL, MP_MESSAGE_EOS);

	zassert_true(mp_bus_post(NULL, &msg) < 0, "post to NULL bus did not fail");
	zassert_true(mp_bus_post(&fixture->bus, NULL) < 0, "post NULL msg did not fail");
	zassert_true(mp_bus_peek(NULL, &out) < 0, "peek on NULL bus did not fail");
	zassert_true(mp_bus_peek(&fixture->bus, NULL) < 0, "peek with NULL out did not fail");
	zassert_true(mp_bus_pop(NULL, &out) < 0, "pop on NULL bus did not fail");
	zassert_true(mp_bus_pop(&fixture->bus, NULL) < 0, "pop with NULL out did not fail");
}

ZTEST_F(mp_bus_api, test_pop_msg_filters_by_type)
{
	struct mp_element *src = &fixture->elem;
	struct mp_message eos;
	struct mp_message err;
	struct mp_message found;

	MP_MESSAGE_INIT(&eos, src, MP_MESSAGE_EOS);
	MP_MESSAGE_INIT(&err, src, MP_MESSAGE_ERROR);

	mp_bus_post(&fixture->bus, &eos);
	mp_bus_post(&fixture->bus, &err);

	zassert_ok(mp_bus_pop_msg(&fixture->bus, MP_MESSAGE_ERROR, &found));
	zassert_equal(found.type, MP_MESSAGE_ERROR, "found type != ERROR");
	zassert_equal(found.origin, src, "found src mismatch");
}

ZTEST_F(mp_bus_api, test_flush_clears_all)
{
	struct mp_message msg1;
	struct mp_message msg2;
	struct mp_message out;

	MP_MESSAGE_INIT(&msg1, NULL, MP_MESSAGE_EOS);
	MP_MESSAGE_INIT(&msg2, NULL, MP_MESSAGE_ERROR);

	mp_bus_post(&fixture->bus, &msg1);
	mp_bus_post(&fixture->bus, &msg2);

	mp_bus_flush(&fixture->bus);

	zassert_equal(mp_bus_peek(&fixture->bus, &out), -ENOMSG, "bus not empty after flush");
}

ZTEST_F(mp_bus_api, test_sync_listener)
{
	struct mp_element *src = &fixture->elem;
	struct mp_message msg;

	listener_call_count = 0;
	listener_last_type = MP_MESSAGE_UNKNOWN;
	listener_last_src = NULL;

	fixture->listener.cb = test_listener_cb;
	fixture->listener.filter_mask = MP_MESSAGE_EOS;
	fixture->listener.user_data = NULL;

	zassert_ok(mp_bus_add_sync_listener(&fixture->bus, &fixture->listener),
		   "adding sync listener failed");

	MP_MESSAGE_INIT(&msg, src, MP_MESSAGE_EOS);
	mp_bus_post(&fixture->bus, &msg);

	zassert_equal(listener_call_count, 1, "listener call count != 1");
	zassert_equal(listener_last_type, MP_MESSAGE_EOS, "listener type != EOS");
	zassert_equal(listener_last_src, src, "listener src mismatch");
}

ZTEST_F(mp_bus_api, test_sync_listener_filters_type)
{
	struct mp_message msg;

	listener_call_count = 0;
	fixture->listener.cb = test_listener_cb;
	fixture->listener.filter_mask = MP_MESSAGE_ERROR;
	fixture->listener.user_data = NULL;

	zassert_ok(mp_bus_add_sync_listener(&fixture->bus, &fixture->listener));

	MP_MESSAGE_INIT(&msg, NULL, MP_MESSAGE_EOS);
	mp_bus_post(&fixture->bus, &msg);

	zassert_equal(listener_call_count, 0, "listener called for non-matching type");
}
```

## src/test_caps.c
```c
/*
 * Copyright 2026 NXP
 *
 * SPDX-License-Identifier: Apache-2.0
 */

#include <zephyr/kernel.h>
#include <zephyr/ztest.h>

#include <zephyr/mp/core/mp.h>

extern struct k_heap _system_heap;

struct caps_fixture {
	struct mp_caps *caps[3];
	struct mp_caps *caps_intersect;
	struct mp_caps *caps_fixate;
	struct sys_memory_stats stats_before;
	struct sys_memory_stats stats_after;
	struct mp_structure *structure;
	struct mp_value *value;
};

static void *caps_suite_setup(void)
{
	static struct caps_fixture fixture;

	return &fixture;
}

static void caps_before(void *f)
{
	struct caps_fixture *fix = f;

	memset(fix, 0, sizeof(*fix));
	sys_heap_runtime_stats_get(&_system_heap.heap, &fix->stats_before);
}

static void caps_after(void *f)
{
	struct caps_fixture *fix = f;

	sys_heap_runtime_stats_get(&_system_heap.heap, &fix->stats_after);
	zassert_equal(fix->stats_before.allocated_bytes, fix->stats_after.allocated_bytes,
		      "Memory leak detected: before=%zu, after=%zu",
		      fix->stats_before.allocated_bytes, fix->stats_after.allocated_bytes);
}

ZTEST_SUITE(caps, NULL, caps_suite_setup, caps_before, caps_after, NULL);

#define validate_boolean_value(value, expected)                                                    \
	({                                                                                         \
		zassert_not_null(value);                                                           \
		zassert_equal((value)->type, MP_TYPE_BOOLEAN);                                     \
		zassert_equal(mp_value_get_boolean(value), expected);                              \
	})

#define validate_int_value(value, expected)                                                        \
	({                                                                                         \
		zassert_not_null(value);                                                           \
		zassert_equal((value)->type, MP_TYPE_INT);                                         \
		zassert_equal(mp_value_get_int(value), expected);                                  \
	})

#define validate_uint_value(value, expected)                                                       \
	({                                                                                         \
		zassert_not_null(value);                                                           \
		zassert_equal((value)->type, MP_TYPE_UINT);                                        \
		zassert_equal(mp_value_get_uint(value), expected);                                 \
	})

#define validate_string_value(value, expected)                                                     \
	({                                                                                         \
		zassert_not_null(value);                                                           \
		zassert_equal((value)->type, MP_TYPE_STRING);                                      \
		zassert_str_equal(mp_value_get_string(value), expected);                           \
	})

#define validate_int_fraction_value(value, num, denom)                                             \
	({                                                                                         \
		zassert_not_null(value);                                                           \
		zassert_equal((value)->type, MP_TYPE_INT_FRACTION);                                \
		zassert_equal(mp_value_get_fraction_numerator(value), num);                        \
		zassert_equal(mp_value_get_fraction_denominator(value), denom);                    \
	})

#define validate_uint_fraction_value(value, num, denom)                                            \
	({                                                                                         \
		zassert_not_null(value);                                                           \
		zassert_equal((value)->type, MP_TYPE_UINT_FRACTION);                               \
		zassert_equal(mp_value_get_fraction_numerator(value), num);                        \
		zassert_equal(mp_value_get_fraction_denominator(value), denom);                    \
	})

#define validate_int_range_value(value, min, max, step)                                            \
	({                                                                                         \
		zassert_not_null(value);                                                           \
		zassert_equal((value)->type, MP_TYPE_INT_RANGE);                                   \
		zassert_equal(mp_value_get_int_range_min(value), min);                             \
		zassert_equal(mp_value_get_int_range_max(value), max);                             \
		zassert_equal(mp_value_get_int_range_step(value), step);                           \
	})

#define validate_uint_range_value(value, min, max, step)                                           \
	({                                                                                         \
		zassert_not_null(value);                                                           \
		zassert_equal((value)->type, MP_TYPE_UINT_RANGE);                                  \
		zassert_equal(mp_value_get_uint_range_min(value), min);                            \
		zassert_equal(mp_value_get_uint_range_max(value), max);                            \
		zassert_equal(mp_value_get_uint_range_step(value), step);                          \
	})

#define validate_fraction_int_range(value, min_num, min_denom, max_num, max_denom, step_num,       \
				    step_denom)                                                    \
	({                                                                                         \
		zassert_not_null(value);                                                           \
		zassert_equal((value)->type, MP_TYPE_INT_FRACTION_RANGE);                          \
		const struct mp_value *frac = mp_value_get_fraction_range_min(value);              \
		zassert_equal(mp_value_get_fraction_numerator(frac), min_num);                     \
		zassert_equal(mp_value_get_fraction_denominator(frac), min_denom);                 \
		frac = mp_value_get_fraction_range_max(value);                                     \
		zassert_equal(mp_value_get_fraction_numerator(frac), max_num);                     \
		zassert_equal(mp_value_get_fraction_denominator(frac), max_denom);                 \
		frac = mp_value_get_fraction_range_step(value);                                    \
		zassert_equal(mp_value_get_fraction_numerator(frac), step_num);                    \
		zassert_equal(mp_value_get_fraction_denominator(frac), step_denom);                \
	})

#define validate_uint_fraction_range(value, min_num, min_denom, max_num, max_denom, step_num,      \
				     step_denom)                                                   \
	({                                                                                         \
		zassert_not_null(value);                                                           \
		zassert_equal((value)->type, MP_TYPE_UINT_FRACTION_RANGE);                         \
		const struct mp_value *frac = mp_value_get_fraction_range_min(value);              \
		zassert_equal(mp_value_get_fraction_numerator(frac), min_num);                     \
		zassert_equal(mp_value_get_fraction_denominator(frac), min_denom);                 \
		frac = mp_value_get_fraction_range_max(value);                                     \
		zassert_equal(mp_value_get_fraction_numerator(frac), max_num);                     \
		zassert_equal(mp_value_get_fraction_denominator(frac), max_denom);                 \
		frac = mp_value_get_fraction_range_step(value);                                    \
		zassert_equal(mp_value_get_fraction_numerator(frac), step_num);                    \
		zassert_equal(mp_value_get_fraction_denominator(frac), step_denom);                \
	})

#define validate_list_value_type_and_size(value, expected_size)                                    \
	({                                                                                         \
		zassert_not_null(value);                                                           \
		zassert_equal((value)->type, MP_TYPE_LIST);                                        \
		zassert_equal(mp_value_list_get_size(value), expected_size);                       \
	})

enum test_field {
	TEST_BOOL = 0,
	TEST_INT,
	TEST_UINT,
	TEST_STRING,
	TEST_FRACTION,
	TEST_RANGE_INT,
	TEST_RANGE_UINT,
	TEST_INT_FRACTION_RANGE,
	TEST_UINT_FRACTION_RANGE,
	TEST_LIST,
};

ZTEST_F(caps, test_caps_intersection_primitive)
{
	fixture->caps[1] = mp_caps_new(MP_MEDIA_AUDIO_PCM, TEST_BOOL, MP_TYPE_BOOLEAN, true,
				       TEST_INT, MP_TYPE_INT, -123, TEST_UINT, MP_TYPE_UINT, 123,
				       TEST_STRING, MP_TYPE_STRING, "xRGB", TEST_FRACTION,
				       MP_TYPE_INT_FRACTION, 30, 1, MP_CAPS_END);
	fixture->caps[2] = mp_caps_new(MP_MEDIA_AUDIO_PCM, TEST_BOOL, MP_TYPE_BOOLEAN, true,
				       TEST_INT, MP_TYPE_INT, -123, TEST_UINT, MP_TYPE_UINT, 123,
				       TEST_STRING, MP_TYPE_STRING, "xRGB", TEST_FRACTION,
				       MP_TYPE_INT_FRACTION, 30, 1, MP_CAPS_END);
	fixture->caps_intersect = mp_caps_intersect(fixture->caps[1], fixture->caps[1]);
	fixture->structure = mp_caps_get_structure(fixture->caps_intersect, 0);

	fixture->value = mp_structure_get_value(fixture->structure, TEST_BOOL);
	validate_boolean_value(fixture->value, true);

	fixture->value = mp_structure_get_value(fixture->structure, TEST_INT);
	validate_int_value(fixture->value, -123);

	fixture->value = mp_structure_get_value(fixture->structure, TEST_UINT);
	validate_uint_value(fixture->value, 123);

	fixture->value = mp_structure_get_value(fixture->structure, TEST_STRING);
	validate_string_value(fixture->value, "xRGB");

	fixture->value = mp_structure_get_value(fixture->structure, TEST_FRACTION);
	validate_int_fraction_value(fixture->value, 30, 1);

	mp_caps_unref(fixture->caps[1]);
	mp_caps_unref(fixture->caps[2]);
	mp_caps_unref(fixture->caps_intersect);
}

ZTEST_F(caps, test_caps_int_with_int_range)
{
	struct {
		int value;
		int expected;
	} test_cases[] = {
		{INT_MIN, INT_MIN},
		{INT_MAX, INT_MAX},
		{(INT_MIN + INT_MAX) / 2, (INT_MIN + INT_MAX) / 2},
	};

	fixture->caps[0] = mp_caps_new(MP_MEDIA_AUDIO_PCM, TEST_RANGE_INT, MP_TYPE_INT_RANGE,
				       INT_MIN, INT_MAX, 1, MP_CAPS_END);
	zassert_not_null(fixture->caps[0], "caps[0] alloc failed");

	for (int i = 0; i < ARRAY_SIZE(test_cases); i++) {
		fixture->caps[1] = mp_caps_new(MP_MEDIA_AUDIO_PCM, TEST_RANGE_INT, MP_TYPE_INT,
					       test_cases[i].value, MP_CAPS_END);
		zassert_not_null(fixture->caps[1], "caps[1] alloc failed");

		fixture->caps_intersect = mp_caps_intersect(fixture->caps[0], fixture->caps[1]);
		zassert_not_null(fixture->caps_intersect, "intersection returned NULL");

		fixture->structure = mp_caps_get_structure(fixture->caps_intersect, 0);
		fixture->value = mp_structure_get_value(fixture->structure, TEST_RANGE_INT);
		validate_int_value(fixture->value, test_cases[i].expected);

		mp_caps_unref(fixture->caps[1]);
		mp_caps_unref(fixture->caps_intersect);
	}

	mp_caps_unref(fixture->caps[0]);
}

ZTEST_F(caps, test_caps_uint_with_uint_range)
{
	struct {
		unsigned int expected;
		bool should_succeed;
		const char *description;
	} test_cases[] = {
		{0, true, "Zero value"},
		{UINT32_MAX, true, "Maximum value"},
		{UINT32_MAX / 2, true, "Mid-range value"},
	};

	fixture->caps[0] = mp_caps_new(MP_MEDIA_AUDIO_PCM, TEST_RANGE_UINT, MP_TYPE_UINT_RANGE, 0,
				       UINT32_MAX, 1, MP_CAPS_END);
	zassert_not_null(fixture->caps[0], "caps[0] alloc failed");

	for (int i = 0; i < ARRAY_SIZE(test_cases); i++) {
		fixture->caps[1] = mp_caps_new(MP_MEDIA_AUDIO_PCM, TEST_RANGE_UINT, MP_TYPE_UINT,
					       test_cases[i].expected, MP_CAPS_END);
		zassert_not_null(fixture->caps[1], "caps[1] alloc failed for: %s",
				 test_cases[i].description);

		fixture->caps_intersect = mp_caps_intersect(fixture->caps[0], fixture->caps[1]);
		zassert_not_null(fixture->caps_intersect, "intersection returned NULL for: %s",
				 test_cases[i].description);

		fixture->structure = mp_caps_get_structure(fixture->caps_intersect, 0);
		fixture->value = mp_structure_get_value(fixture->structure, TEST_RANGE_UINT);
		validate_uint_value(fixture->value, test_cases[i].expected);

		mp_caps_unref(fixture->caps_intersect);
		mp_caps_unref(fixture->caps[1]);
	}

	mp_caps_unref(fixture->caps[0]);
}

ZTEST_F(caps, test_caps_int_fraction_range_intersection)
{
	fixture->caps[0] = mp_caps_new(MP_MEDIA_AUDIO_PCM, TEST_INT_FRACTION_RANGE,
				       MP_TYPE_INT_FRACTION, 1, INT_MIN, MP_CAPS_END);
	fixture->caps[1] =
		mp_caps_new(MP_MEDIA_AUDIO_PCM, TEST_INT_FRACTION_RANGE, MP_TYPE_INT_FRACTION_RANGE,
			    1, INT_MIN, INT_MAX, 1, 1, 1, MP_CAPS_END);

	fixture->caps_intersect = mp_caps_intersect(fixture->caps[1], fixture->caps[1]);
	zassert_not_null(fixture->caps_intersect, "intersection returned NULL");
	fixture->structure = mp_caps_get_structure(fixture->caps_intersect, 0);
	fixture->value = mp_structure_get_value(fixture->structure, TEST_INT_FRACTION_RANGE);
	validate_fraction_int_range(fixture->value, 1, INT_MIN, INT_MAX, 1, 1, 1);
	mp_caps_unref(fixture->caps_intersect);

	fixture->caps_intersect = mp_caps_intersect(fixture->caps[0], fixture->caps[1]);
	zassert_not_null(fixture->caps_intersect, "intersection returned NULL");
	fixture->structure = mp_caps_get_structure(fixture->caps_intersect, 0);
	fixture->value = mp_structure_get_value(fixture->structure, TEST_INT_FRACTION_RANGE);
	validate_int_fraction_value(fixture->value, 1, INT_MIN);

	mp_caps_unref(fixture->caps_intersect);
	mp_caps_unref(fixture->caps[0]);
	mp_caps_unref(fixture->caps[1]);
}

ZTEST_F(caps, test_caps_uint_fraction_range_intersection)
{
	fixture->caps[0] = mp_caps_new(MP_MEDIA_AUDIO_PCM, TEST_UINT_FRACTION_RANGE,
				       MP_TYPE_UINT_FRACTION, 1, UINT32_MAX, MP_CAPS_END);
	fixture->caps[1] = mp_caps_new(MP_MEDIA_AUDIO_PCM, TEST_UINT_FRACTION_RANGE,
				       MP_TYPE_UINT_FRACTION_RANGE, 1, UINT32_MAX, UINT32_MAX, 1, 1,
				       1, MP_CAPS_END);

	fixture->caps_intersect = mp_caps_intersect(fixture->caps[1], fixture->caps[1]);
	zassert_not_null(fixture->caps_intersect, "intersection returned NULL");
	fixture->structure = mp_caps_get_structure(fixture->caps_intersect, 0);
	fixture->value = mp_structure_get_value(fixture->structure, TEST_UINT_FRACTION_RANGE);
	validate_uint_fraction_range(fixture->value, 1, UINT32_MAX, UINT32_MAX, 1, 1, 1);
	mp_caps_unref(fixture->caps_intersect);

	fixture->caps_intersect = mp_caps_intersect(fixture->caps[0], fixture->caps[1]);
	zassert_not_null(fixture->caps_intersect, "intersection returned NULL");
	fixture->structure = mp_caps_get_structure(fixture->caps_intersect, 0);
	fixture->value = mp_structure_get_value(fixture->structure, TEST_UINT_FRACTION_RANGE);
	validate_uint_fraction_value(fixture->value, 1, UINT32_MAX);

	mp_caps_unref(fixture->caps_intersect);
	mp_caps_unref(fixture->caps[0]);
	mp_caps_unref(fixture->caps[1]);
}

ZTEST_F(caps, test_caps_int_fraction_range)
{
	fixture->caps[0] = mp_caps_new(MP_MEDIA_AUDIO_PCM, TEST_FRACTION, MP_TYPE_INT_FRACTION, 1,
				       INT32_MIN, MP_CAPS_END);
	fixture->caps[1] =
		mp_caps_new(MP_MEDIA_AUDIO_PCM, TEST_FRACTION, MP_TYPE_INT_FRACTION_RANGE, 1,
			    INT32_MIN, INT32_MAX, 1, 1, 1, MP_CAPS_END);
	fixture->caps[2] =
		mp_caps_new(MP_MEDIA_AUDIO_PCM, TEST_FRACTION, MP_TYPE_INT_FRACTION_RANGE, 1,
			    INT32_MIN, INT32_MAX, 1, 1, 1, MP_CAPS_END);

	fixture->caps_intersect = mp_caps_intersect(fixture->caps[0], fixture->caps[1]);
	zassert_not_null(fixture->caps_intersect, "intersection returned NULL");

	fixture->structure = mp_caps_get_structure(fixture->caps_intersect, 0);
	fixture->value = mp_structure_get_value(fixture->structure, TEST_FRACTION);
	validate_int_fraction_value(fixture->value, 1, INT32_MIN);
	mp_caps_unref(fixture->caps_intersect);

	fixture->caps_intersect = mp_caps_intersect(fixture->caps[1], fixture->caps[2]);
	zassert_not_null(fixture->caps_intersect, "intersection returned NULL");

	fixture->structure = mp_caps_get_structure(fixture->caps_intersect, 0);
	fixture->value = mp_structure_get_value(fixture->structure, TEST_FRACTION);
	validate_fraction_int_range(fixture->value, 1, INT_MIN, INT_MAX, 1, 1, 1);

	mp_caps_unref(fixture->caps[0]);
	mp_caps_unref(fixture->caps[1]);
	mp_caps_unref(fixture->caps[2]);
	mp_caps_unref(fixture->caps_intersect);
}

ZTEST_F(caps, test_caps_intersection_list)
{
	fixture->caps[0] = mp_caps_new(
		MP_MEDIA_AUDIO_PCM, TEST_LIST, MP_TYPE_LIST,
		mp_value_new(MP_TYPE_LIST, mp_value_new(MP_TYPE_INT, 15),
			     mp_value_new(MP_TYPE_UINT, 30),
			     mp_value_new(MP_TYPE_INT_FRACTION, 15, 1),
			     mp_value_new(MP_TYPE_INT_RANGE, 1, 100, 1),
			     mp_value_new(MP_TYPE_INT_FRACTION_RANGE, 100, 1, 60, 1, 1, 1),
			     mp_value_new(MP_TYPE_STRING, "RGB"),
			     mp_value_new(MP_TYPE_LIST, mp_value_new(MP_TYPE_INT, 15), NULL), NULL),
		MP_CAPS_END);
	fixture->caps[1] = mp_caps_new(
		MP_MEDIA_AUDIO_PCM, TEST_LIST, MP_TYPE_LIST,
		mp_value_new(MP_TYPE_LIST, mp_value_new(MP_TYPE_STRING, "RGB"),
			     mp_value_new(MP_TYPE_UINT, 30),
			     mp_value_new(MP_TYPE_LIST, mp_value_new(MP_TYPE_INT, 15), NULL),
			     mp_value_new(MP_TYPE_INT_RANGE, 1, 100, 1),
			     mp_value_new(MP_TYPE_INT_FRACTION, 15, 1),
			     mp_value_new(MP_TYPE_INT_FRACTION_RANGE, 100, 1, 60, 1, 1, 1),
			     mp_value_new(MP_TYPE_INT, 15), NULL),
		MP_CAPS_END);

	fixture->caps_intersect = mp_caps_intersect(fixture->caps[0], fixture->caps[1]);
	fixture->structure = mp_caps_get_structure(fixture->caps_intersect, 0);
	struct mp_value *list = mp_structure_get_value(fixture->structure, TEST_LIST);

	validate_list_value_type_and_size(list, 7);

	struct mp_value *list_val = mp_value_list_get(list, 0);

	validate_int_value(list_val, 15);

	list_val = mp_value_list_get(list, 1);
	validate_uint_value(list_val, 30);

	list_val = mp_value_list_get(list, 2);
	validate_int_fraction_value(list_val, 15, 1);

	mp_caps_unref(fixture->caps[0]);
	mp_caps_unref(fixture->caps[1]);
	mp_caps_unref(fixture->caps_intersect);
}

ZTEST_F(caps, test_caps_video_sample)
{
	struct mp_value *frmrates1 = mp_value_new(MP_TYPE_LIST, NULL);

	for (int i = 15; i <= 60; i += 15) {
		zassert_ok(
			mp_value_list_append(frmrates1, mp_value_new(MP_TYPE_INT_FRACTION, i, 1)),
			"mp_value_list_append failed");
	}

	fixture->caps[0] = mp_caps_new(MP_MEDIA_VIDEO, MP_CAPS_PIXEL_FORMAT, MP_TYPE_STRING, "xRGB",
				       MP_CAPS_IMAGE_WIDTH, MP_TYPE_UINT_RANGE, 1280, 1280, 0,
				       MP_CAPS_IMAGE_HEIGHT, MP_TYPE_UINT_RANGE, 720, 720, 0,
				       MP_CAPS_FRAME_RATE, MP_TYPE_LIST, frmrates1, MP_CAPS_END);
	zassert_not_null(fixture->caps[0], "caps[0] alloc failed");

	fixture->caps[1] =
		mp_caps_new(MP_MEDIA_VIDEO, MP_CAPS_PIXEL_FORMAT, MP_TYPE_LIST,
			    mp_value_new(MP_TYPE_LIST, mp_value_new(MP_TYPE_STRING, "RGB565"),
					 mp_value_new(MP_TYPE_STRING, "xRGB"),
					 mp_value_new(MP_TYPE_STRING, "YUV"), NULL),
			    MP_CAPS_IMAGE_WIDTH, MP_TYPE_UINT_RANGE, 1280, 1280, 0,
			    MP_CAPS_IMAGE_HEIGHT, MP_TYPE_UINT_RANGE, 720, 720, 0, MP_CAPS_END);
	zassert_not_null(fixture->caps[1], "caps[1] alloc failed");

	fixture->caps_intersect = mp_caps_intersect(fixture->caps[0], fixture->caps[1]);
	zassert_not_null(fixture->caps_intersect, "intersection returned NULL");
	zassert_false(mp_caps_is_any(fixture->caps_intersect), "caps is any");
	zassert_false(mp_caps_is_empty(fixture->caps_intersect), "caps is empty");

	fixture->structure = mp_caps_get_structure(fixture->caps_intersect, 0);
	fixture->value = mp_structure_get_value(fixture->structure, MP_CAPS_PIXEL_FORMAT);

	validate_list_value_type_and_size(fixture->value, 1);
	zassert_str_equal(mp_value_get_string(mp_value_list_get(fixture->value, 0)), "xRGB");

	fixture->value = mp_structure_get_value(fixture->structure, MP_CAPS_IMAGE_WIDTH);
	validate_uint_range_value(fixture->value, 1280, 1280, 0);

	fixture->value = mp_structure_get_value(fixture->structure, MP_CAPS_IMAGE_HEIGHT);
	validate_uint_range_value(fixture->value, 720, 720, 0);

	fixture->value = mp_structure_get_value(fixture->structure, MP_CAPS_FRAME_RATE);
	validate_list_value_type_and_size(fixture->value, 4);

	for (int i = 15, j = 0; i <= 60; i += 15, j++) {
		struct mp_value *frac = mp_value_list_get(fixture->value, j);

		validate_int_fraction_value(frac, i, 1);
	}

	mp_caps_unref(fixture->caps[0]);
	mp_caps_unref(fixture->caps[1]);

	fixture->caps_fixate = mp_caps_fixate(fixture->caps_intersect);
	mp_caps_unref(fixture->caps_intersect);

	zassert_not_null(fixture->caps_fixate, "caps_fixate returned NULL");
	fixture->structure = mp_caps_get_structure(fixture->caps_fixate, 0);

	fixture->value = mp_structure_get_value(fixture->structure, MP_CAPS_PIXEL_FORMAT);
	validate_string_value(fixture->value, "xRGB");

	fixture->value = mp_structure_get_value(fixture->structure, MP_CAPS_IMAGE_WIDTH);
	validate_uint_value(fixture->value, 1280);

	fixture->value = mp_structure_get_value(fixture->structure, MP_CAPS_IMAGE_HEIGHT);
	validate_uint_value(fixture->value, 720);

	fixture->value = mp_structure_get_value(fixture->structure, MP_CAPS_FRAME_RATE);
	validate_int_fraction_value(fixture->value, 15, 1);

	mp_caps_unref(fixture->caps_fixate);
}

ZTEST_F(caps, test_caps_error_paths)
{
	struct mp_caps caps_stack;
	struct mp_caps *ptr = NULL;

	zassert_equal(mp_caps_init(NULL, 0), -EINVAL, "mp_caps_init(NULL) != -EINVAL");
	zassert_ok(mp_caps_init(&caps_stack, 0), "mp_caps_init failed");

	zassert_equal(mp_caps_replace(NULL, fixture->caps[0]), -EINVAL,
		      "mp_caps_replace(NULL target) != -EINVAL");
	zassert_equal(mp_caps_replace(&ptr, NULL), -EINVAL, "mp_caps_replace(NULL new) != -EINVAL");
}
```

## src/test_element.c
```c
/*
 * Copyright 2026 NXP
 *
 * SPDX-License-Identifier: Apache-2.0
 */

#include <zephyr/kernel.h>
#include <zephyr/sys/sys_heap.h>
#include <zephyr/ztest.h>
#include <zephyr/ztest_assert.h>

#include <zephyr/mp/core/mp_bin.h>
#include <zephyr/mp/core/mp_caps.h>
#include <zephyr/mp/core/mp_element.h>
#include <zephyr/mp/core/mp_pad.h>
#include <zephyr/mp/core/mp_pipeline.h>
#include <zephyr/mp/core/mp_sink.h>
#include <zephyr/mp/core/mp_src.h>

extern struct k_heap _system_heap;

struct mp_element_api_fixture {
	struct mp_pipeline pipeline;
	struct mp_element src;
	struct mp_element sink;
	struct mp_pad src_pad;
	struct mp_pad sink_pad;
	struct sys_memory_stats mem_before;
};

static void *element_suite_setup(void)
{
	static struct mp_element_api_fixture fixture;

	return &fixture;
}

static void element_before(void *f)
{
	struct mp_element_api_fixture *fix = f;

	memset(fix, 0, sizeof(*fix));
	mp_element_init(&fix->src, 1);
	mp_element_init(&fix->sink, 2);
	mp_pad_init(&fix->src_pad, 0, MP_PAD_SRC, MP_PAD_ALWAYS, NULL);
	mp_pad_init(&fix->sink_pad, 1, MP_PAD_SINK, MP_PAD_ALWAYS, NULL);

	sys_heap_runtime_stats_get(&_system_heap.heap, &fix->mem_before);

	fix->src_pad.caps = mp_caps_new_any();
	fix->sink_pad.caps = mp_caps_new_any();

	zassert_equal(fix->src.object.id, 1, "Element ID shall be set by init");
	zassert_equal(fix->src.current_state, MP_STATE_READY,
		      "Element shall start in READY state after init");
	zassert_equal(fix->src.pending_state, MP_STATE_READY,
		      "pending_state shall be READY after init");
	zassert_true(sys_dlist_is_empty(&fix->src.srcpads),
		     "srcpads list shall be empty after init");
	zassert_true(sys_dlist_is_empty(&fix->sink.sinkpads),
		     "sinkpads list shall be empty after init");
}

static void element_after(void *f)
{
	struct mp_element_api_fixture *fix = f;
	struct sys_memory_stats mem_after;

	mp_caps_unref(fix->src_pad.caps);
	mp_caps_unref(fix->sink_pad.caps);

	sys_heap_runtime_stats_get(&_system_heap.heap, &mem_after);
	zassert_equal(fix->mem_before.allocated_bytes, mem_after.allocated_bytes,
		      "Memory leak detected: before=%zu after=%zu", fix->mem_before.allocated_bytes,
		      mem_after.allocated_bytes);
}

ZTEST_SUITE(mp_element_api, NULL, element_suite_setup, element_before, element_after, NULL);

ZTEST_F(mp_element_api, test_link_two_elements)
{

	/* Add both pads and verify they are registered on the element */
	mp_element_add_pad(&fixture->src, &fixture->src_pad);
	zassert_false(sys_dlist_is_empty(&fixture->src.srcpads),
		      "srcpads shall not be empty after adding src pad");
	zassert_equal(fixture->src_pad.object.container, (struct mp_object *)&fixture->src,
		      "Pad container shall reference the owning element");

	mp_element_add_pad(&fixture->sink, &fixture->sink_pad);
	zassert_false(sys_dlist_is_empty(&fixture->sink.sinkpads),
		      "sinkpads shall not be empty after adding sink pad");
	zassert_equal(fixture->sink_pad.object.container, (struct mp_object *)&fixture->sink,
		      "Pad container shall reference the owning element");

	/* src/sink are already initialised by element_before via MP_ELEMENT_INIT */
	zassert_ok(mp_element_link(&fixture->src, &fixture->sink, NULL),
		   "Linking src and sink elements shall succeed");
	zassert_true(fixture->sink_pad.peer == &fixture->src_pad,
		     "sink pad peer must be linked to src pad");
	zassert_true(fixture->src_pad.peer == &fixture->sink_pad,
		     "src pad peer must be linked to sink pad");
}

ZTEST_F(mp_element_api, test_sanity)
{
	/* get_bus: child element inside pipeline shall return the pipeline bus */
	struct mp_element child;

	MP_ELEMENT_INIT((struct mp_element *)&fixture->pipeline, mp_pipeline_init, 0);
	mp_element_init(&child, 1);

	zassert_ok(
		mp_bin_add((struct mp_bin *)&fixture->pipeline, (struct mp_element *)&child, NULL),
		"mp_bin_add shall succeed");

	struct mp_bus *bus = mp_element_get_bus((struct mp_element *)&fixture->pipeline);

	zassert_not_null(bus, "Child element shall find the pipeline bus");
	zassert_equal(bus, &fixture->pipeline.bin.bus, "Bus shall be the pipeline's bus");

	/* Unknown direction pad shall not appear in either list */
	struct mp_element elem;
	struct mp_pad pad;

	memset(&elem, 0, sizeof(elem));
	memset(&pad, 0, sizeof(pad));
	mp_element_init(&elem, 1);

	mp_pad_init(&pad, 0, MP_PAD_UNKNOWN, MP_PAD_ALWAYS, NULL);
	mp_element_add_pad(&elem, &pad);

	zassert_true(sys_dlist_is_empty(&elem.srcpads),
		     "srcpads shall remain empty for UNKNOWN direction pad");
	zassert_true(sys_dlist_is_empty(&elem.sinkpads),
		     "sinkpads shall remain empty for UNKNOWN direction pad");

	/* Linking elements without pads shall fail */
	struct mp_element src, sink;

	memset(&src, 0, sizeof(src));
	memset(&sink, 0, sizeof(sink));
	mp_element_init(&src, 1);
	mp_element_init(&sink, 2);

	zassert_true(mp_element_link(&src, &sink, NULL) < 0,
		     "Linking elements without pads shall fail");

	/* get_bus on NULL shall return NULL */
	zassert_is_null(mp_element_get_bus(NULL), "mp_element_get_bus(NULL) shall return NULL");
}
```

## src/test_pad.c
```c
/*
 * Copyright 2026 NXP
 *
 * SPDX-License-Identifier: Apache-2.0
 */

#include <zephyr/kernel.h>
#include <zephyr/ztest.h>

#include <zephyr/mp/mp_caps.h>
#include <zephyr/mp/mp_dispatch.h>
#include <zephyr/mp/mp_element.h>
#include <zephyr/mp/mp_pad.h>

struct mp_pad_api_fixture {
	struct mp_pad src_pad;
	struct mp_pad sink_pad;
	struct mp_caps *any_caps;
};

static void *pad_suite_setup(void)
{
	static struct mp_pad_api_fixture fixture;

	return &fixture;
}

static void pad_before(void *f)
{
	struct mp_pad_api_fixture *fix = f;

	memset(&fix->src_pad, 0, sizeof(fix->src_pad));
	memset(&fix->sink_pad, 0, sizeof(fix->sink_pad));

	fix->any_caps = mp_caps_new_any();
	mp_pad_init(&fix->src_pad, 0, MP_PAD_SRC, MP_PAD_ALWAYS, fix->any_caps);
	mp_pad_init(&fix->sink_pad, 1, MP_PAD_SINK, MP_PAD_ALWAYS, fix->any_caps);

	zassert_equal(fix->src_pad.object.id, 0, "id != 0 after init");
	zassert_equal(fix->src_pad.direction, MP_PAD_SRC, "direction != SRC");
	zassert_equal(fix->sink_pad.direction, MP_PAD_SINK, "direction != SINK");
	zassert_equal(fix->src_pad.presence, MP_PAD_ALWAYS, "presence != ALWAYS");
	zassert_equal(fix->src_pad.caps, fix->any_caps, "caps mismatch after init");
	zassert_is_null(fix->src_pad.peer, "peer != NULL after init");
	zassert_equal(fix->src_pad.mode, MP_PAD_MODE_NONE, "mode != NONE after init");
}

static void pad_after(void *f)
{
	struct mp_pad_api_fixture *fix = f;

	if (fix->any_caps) {
		mp_caps_unref(fix->src_pad.caps);
		mp_caps_unref(fix->sink_pad.caps);
		mp_caps_unref(fix->any_caps);
	}
}

ZTEST_SUITE(mp_pad_api, NULL, pad_suite_setup, pad_before, pad_after, NULL);

ZTEST_F(mp_pad_api, test_new)
{
	struct mp_pad *pad = mp_pad_new(5, MP_PAD_SINK, MP_PAD_SOMETIMES, fixture->any_caps);

	zassert_not_null(pad, "mp_pad_new returned NULL");
	zassert_equal(pad->object.id, 5, "id != 5");
	zassert_equal(pad->direction, MP_PAD_SINK, "direction != SINK");
	zassert_equal(pad->presence, MP_PAD_SOMETIMES, "presence != SOMETIMES");
	zassert_equal(pad->caps, fixture->any_caps, "caps mismatch");
	mp_caps_unref(pad->caps);
	k_free(pad);

	struct mp_pad *pad_null_caps = mp_pad_new(0, MP_PAD_SRC, MP_PAD_ALWAYS, NULL);

	zassert_not_null(pad_null_caps, "mp_pad_new(NULL caps) returned NULL");
	zassert_is_null(pad_null_caps->caps, "caps != NULL");
	k_free(pad_null_caps);
}

ZTEST_F(mp_pad_api, test_link_sets_peers)
{
	zassert_ok(mp_pad_link(&fixture->src_pad, &fixture->sink_pad), "mp_pad_link failed");
	zassert_equal(fixture->src_pad.peer, &fixture->sink_pad, "src_pad peer != sink_pad");
	zassert_equal(fixture->sink_pad.peer, &fixture->src_pad, "sink_pad peer != src_pad");
}

ZTEST_F(mp_pad_api, test_sanity)
{
	zassert_true(mp_pad_link(NULL, &fixture->sink_pad) < 0, "link(NULL, sink) did not fail");
	zassert_true(mp_pad_link(&fixture->src_pad, NULL) < 0, "link(src, NULL) did not fail");
	zassert_true(mp_pad_link(NULL, NULL) < 0, "link(NULL, NULL) did not fail");

	struct mp_dispatch evt;

	mp_dispatch_eos_init(&evt);

	zassert_true(mp_pad_send_event(NULL, &evt) < 0, "send_event(NULL, evt) did not fail");
	zassert_true(mp_pad_send_event(&fixture->src_pad, NULL) < 0,
		     "send_event(pad, NULL) did not fail");

	mp_dispatch_clear(&evt);

	struct mp_dispatch q;

	mp_dispatch_caps_init(&q, NULL);

	zassert_true(mp_pad_query(NULL, &q) < 0, "query(NULL, q) did not fail");
	zassert_true(mp_pad_query(&fixture->src_pad, NULL) < 0, "query(pad, NULL) did not fail");

	fixture->src_pad.queryfn = NULL;
	zassert_true(mp_pad_query(&fixture->src_pad, &q) < 0, "query(no queryfn) did not fail");

	mp_dispatch_clear(&q);
}
```
