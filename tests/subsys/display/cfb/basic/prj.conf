## CMakeLists.txt
```
# Copyright (c) 2024 TOKITA Hiroshi
# SPDX-License-Identifier: Apache-2.0

cmake_minimum_required(VERSION 3.28.0)

find_package(Zephyr REQUIRED HINTS $ENV{ZEPHYR_BASE})

project(cfb_basic)

target_sources(app PRIVATE
  ../common/utils.c
  src/testdata.c
  src/clear.c
  src/draw_point.c
  src/draw_line.c
  src/draw_rect.c
  src/draw_circle.c
  src/invert.c
  src/invert_area.c
  src/cfb_font_stub.c
)
```

## Kconfig
```
# Copyright (c) 2024 TOKITA Hiroshi
# SPDX-License-Identifier: Apache-2.0

config TEST_MSB_FIRST_FONT
	bool "Use MSB_FIRST font"

config TEST_TRANSFER_BUF_SIZE
	int "transfer buffer size"
	default 0

config TEST_COMMAND_BUF_SIZE
	int "command buffer size"
	default 0

source "Kconfig.zephyr"
```

## prj.conf
```kconfig
# Copyright (c) 2024 TOKITA Hiroshi
# SPDX-License-Identifier: Apache-2.0

CONFIG_ZTEST=y
CONFIG_DISPLAY=y
CONFIG_CHARACTER_FRAMEBUFFER=y
CONFIG_CHARACTER_FRAMEBUFFER_USE_DEFAULT_FONTS=n

CONFIG_HEAP_MEM_POOL_SIZE=16384

CONFIG_LOG=y
```

## src/cfb_font_dot0101.c
```c
/*
 * Copyright (c) 2024 TOKITA Hiroshi
 *
 * SPDX-License-Identifier: Apache-2.0
 *
 * This file was generated from the font DroidSansMono.ttf
 * Copyright (C) 2008 The Android Open Source Project
 * Licensed under the Apache License, Version 2.0
 */

#include <zephyr/kernel.h>
#include <zephyr/display/cfb.h>

const uint8_t cfb_font_0101_dot[2][1] = {
	/* 0 */
	{
		0x00,
	},
	/* 1 */
	{
		0x01,
	},
};

FONT_ENTRY_DEFINE(font_0101_dot, 1, 1, CFB_FONT_MONO_VPACKED, cfb_font_0101_dot, 48, 50);
```

## src/cfb_font_dot0101_msb.c
```c
/*
 * Copyright (c) 2024 TOKITA Hiroshi
 *
 * SPDX-License-Identifier: Apache-2.0
 *
 * This file was generated from the font DroidSansMono.ttf
 * Copyright (C) 2008 The Android Open Source Project
 * Licensed under the Apache License, Version 2.0
 */

#include <zephyr/kernel.h>
#include <zephyr/display/cfb.h>

const uint8_t cfb_font_0101_dot[2][1] = {
	/* 0 */
	{
		0x00,
	},
	/* 1 */
	{
		0x80,
	},
};

FONT_ENTRY_DEFINE(font_0101_dot, 1, 1, CFB_FONT_MONO_VPACKED | CFB_FONT_MSB_FIRST,
		  cfb_font_0101_dot, 48, 50);
```

## src/cfb_font_rectspace1016.c
```c
/*
 * Copyright (c) 2024 TOKITA Hiroshi
 *
 * SPDX-License-Identifier: Apache-2.0
 */

#include <zephyr/kernel.h>
#include <zephyr/display/cfb.h>

const uint8_t cfb_font_1016_rectspace[1][20] = {
	/*   */
	{
		0xFF, 0xFF,
		0x01, 0x80,
		0x01, 0x80,
		0x01, 0x80,
		0x01, 0x80,
		0x01, 0x80,
		0x01, 0x80,
		0x01, 0x80,
		0x01, 0x80,
		0xFF, 0xFF,
	},
};

FONT_ENTRY_DEFINE(font1016_rectspace, 10, 16, CFB_FONT_MONO_VPACKED, cfb_font_1016_rectspace, 32,
		  33);
```

## src/cfb_font_rectspace1016_msb.c
```c
/*
 * Copyright (c) 2024 TOKITA Hiroshi
 *
 * SPDX-License-Identifier: Apache-2.0
 */

#include <zephyr/kernel.h>
#include <zephyr/display/cfb.h>

const uint8_t cfb_font_1016_rectspace[1][20] = {
	/*   */
	{
		0xFF, 0xFF, 0x80, 0x01, 0x80, 0x01, 0x80, 0x01, 0x80, 0x01,
		0x80, 0x01, 0x80, 0x01, 0x80, 0x01, 0x80, 0x01, 0xFF, 0xFF,
	},
};

FONT_ENTRY_DEFINE(font1016_rectspace, 10, 16, CFB_FONT_MONO_VPACKED | CFB_FONT_MSB_FIRST,
		  cfb_font_1016_rectspace, 32, 33);
```

## src/cfb_font_rectspace1123.c
```c
/*
 * Copyright (c) 2024 TOKITA Hiroshi
 *
 * SPDX-License-Identifier: Apache-2.0
 *
 * This file was generated from the font DroidSansMono.ttf
 * Copyright (C) 2008 The Android Open Source Project
 * Licensed under the Apache License, Version 2.0
 */

#include <zephyr/kernel.h>
#include <zephyr/display/cfb.h>

const uint8_t cfb_font_1123_rectspace[1][33] = {
	/*   */
	{
		0xFF, 0xFF, 0x7F, 0x01, 0x00, 0x40, 0x01, 0x00, 0x40, 0x01, 0x00,
		0x40, 0x01, 0x00, 0x40, 0x01, 0x00, 0x40, 0x01, 0x00, 0x40, 0x01,
		0x00, 0x40, 0x01, 0x00, 0x40, 0x01, 0x00, 0x40, 0xFF, 0xFF, 0x7F,
	},
};

FONT_ENTRY_DEFINE(font1123_rect_space, 11, 23, CFB_FONT_MONO_VPACKED, cfb_font_1123_rectspace, 32,
		  33);
```

## src/cfb_font_rectspace1123_msb.c
```c
/*
 * Copyright (c) 2024 TOKITA Hiroshi
 *
 * SPDX-License-Identifier: Apache-2.0
 *
 * This file was generated from the font DroidSansMono.ttf
 * Copyright (C) 2008 The Android Open Source Project
 * Licensed under the Apache License, Version 2.0
 */

#include <zephyr/kernel.h>
#include <zephyr/display/cfb.h>

const uint8_t cfb_font_1123_rectspace[1][39] = {
	/*   */
	{
		0xFF, 0xFF, 0xFE, 0x80, 0x00, 0x02, 0x80, 0x00, 0x02, 0x80, 0x00,
		0x02, 0x80, 0x00, 0x02, 0x80, 0x00, 0x02, 0x80, 0x00, 0x02, 0x80,
		0x00, 0x02, 0x80, 0x00, 0x02, 0x80, 0x00, 0x02, 0xFF, 0xFF, 0xFE,
	},
};

FONT_ENTRY_DEFINE(font1123_rect_space, 11, 23, CFB_FONT_MONO_VPACKED | CFB_FONT_MSB_FIRST,
		  cfb_font_1123_rectspace, 32, 33);
```

## src/cfb_font_stub.c
```c
/*
 * Copyright (c) 2024 TOKITA Hiroshi
 *
 * SPDX-License-Identifier: Apache-2.0
 */

#include <zephyr/kernel.h>
#include <zephyr/display/cfb.h>

const uint8_t cfb_font_stub[1][1] = {
	/*   */
	{
		0x00,
	},
};

FONT_ENTRY_DEFINE(font_stub, 1, 1, CFB_FONT_MONO_VPACKED | CFB_FONT_MSB_FIRST,
		  cfb_font_stub, 32, 33);
```

## src/clear.c
```c
/*
 * Copyright (c) 2024 TOKITA Hiroshi
 *
 * SPDX-License-Identifier: Apache-2.0
 */

#include <zephyr/drivers/display.h>
#include <zephyr/ztest.h>
#include <zephyr/device.h>
#include <zephyr/logging/log.h>
#include <zephyr/display/cfb.h>

#include "testdata.h"
#include "../../common/utils.h"

LOG_MODULE_REGISTER(clear, CONFIG_DISPLAY_LOG_LEVEL);


static struct cfb_display *disp;
static struct cfb_framebuffer *fb;

/**
 * Fill the buffer with 0xAA before running tests.
 */
static void cfb_test_before(void *text_fixture)
{
	struct display_buffer_descriptor desc = {
		.height = display_height,
		.pitch = display_width,
		.width = display_width,
		.buf_size = display_buf_size(dev),
	};

	disp = display_init();
	fb = cfb_display_get_framebuffer(disp);

	memset(read_buffer, 0xAA, sizeof(read_buffer));
	zassert_ok(display_write(dev, 0, 0, &desc, read_buffer));
}

static void cfb_test_after(void *test_fixture)
{
	display_deinit(disp);
}

ZTEST(clear, test_clear_false)
{
	zassert_ok(cfb_framebuffer_clear(fb, false));

	/* checking memory not updated */
	zassert_false(verify_color_inside_rect(0, 0, 320, 240, 0x0));
}

ZTEST(clear, test_clear_true)
{
	zassert_ok(cfb_framebuffer_clear(fb, true));

	zassert_true(verify_color_inside_rect(0, 0, 320, 240, 0x0));
}

ZTEST_SUITE(clear, NULL, NULL, cfb_test_before, cfb_test_after, NULL);
```

## src/color_conv.c
```c
/*
 * Copyright (c) 2024 TOKITA Hiroshi
 *
 * SPDX-License-Identifier: Apache-2.0
 */

#include <zephyr/drivers/display.h>
#include <zephyr/ztest.h>
#include <zephyr/device.h>
#include <zephyr/logging/log.h>
#include <zephyr/display/cfb.h>

#include "testdata.h"
#include "utils.h"

LOG_MODULE_REGISTER(color_conv, CONFIG_DISPLAY_LOG_LEVEL);

void test_color_to_rgba(const enum display_pixel_format pixel_format, uint32_t color, uint8_t *r,
			uint8_t *g, uint8_t *b, uint8_t *a);
uint32_t test_rgba_to_color(const enum display_pixel_format pixel_format, uint8_t r, uint8_t g,
			    uint8_t b, uint8_t a);

ZTEST(color_conv, test_color_to_rgba_0_mono01)
{
	const enum display_pixel_format format = PIXEL_FORMAT_MONO01;
	uint8_t r = 0, g = 0, b = 0, a = 0;
	uint32_t color = 0;

	test_color_to_rgba(format, color, &r, &g, &b, &a);

	zassert_equal(0, r);
	zassert_equal(0, g);
	zassert_equal(0, b);
	zassert_equal(0, a);

	zassert_equal(color, test_rgba_to_color(format, r, g, b, a));
}

ZTEST(color_conv, test_color_to_rgba_1_mono01)
{
	const enum display_pixel_format format = PIXEL_FORMAT_MONO01;
	uint8_t r = 0, g = 0, b = 0, a = 0;
	uint32_t color = 1;

	test_color_to_rgba(format, color, &r, &g, &b, &a);

	zassert_equal(0xFF, r);
	zassert_equal(0xFF, g);
	zassert_equal(0xFF, b);
	zassert_equal(0xFF, a);

	zassert_equal(0xFFFFFFFF, test_rgba_to_color(format, r, g, b, a));
}

ZTEST(color_conv, test_color_to_rgba_0xFFFFFFFF_mono01)
{
	const enum display_pixel_format format = PIXEL_FORMAT_MONO01;
	uint8_t r = 0, g = 0, b = 0, a = 0;
	uint32_t color = 0xFFFFFFFF;

	test_color_to_rgba(format, color, &r, &g, &b, &a);

	zassert_equal(0xFF, r);
	zassert_equal(0xFF, g);
	zassert_equal(0xFF, b);
	zassert_equal(0xFF, a);

	zassert_equal(color, test_rgba_to_color(format, r, g, b, a));
}

ZTEST(color_conv, test_color_to_rgba_0_mono10)
{
	const enum display_pixel_format format = PIXEL_FORMAT_MONO10;
	uint8_t r = 0, g = 0, b = 0, a = 0;
	uint32_t color = 0;

	test_color_to_rgba(format, color, &r, &g, &b, &a);

	zassert_equal(0xFF, r);
	zassert_equal(0xFF, g);
	zassert_equal(0xFF, b);
	zassert_equal(0xFF, a);

	zassert_equal(color, test_rgba_to_color(format, r, g, b, a));
}

ZTEST(color_conv, test_color_to_rgba_1_mono10)
{
	const enum display_pixel_format format = PIXEL_FORMAT_MONO10;
	uint8_t r = 0, g = 0, b = 0, a = 0;
	uint32_t color = 1;

	test_color_to_rgba(format, color, &r, &g, &b, &a);

	zassert_equal(0, r);
	zassert_equal(0, g);
	zassert_equal(0, b);
	zassert_equal(0, a);

	zassert_equal(0xFFFFFFFF, test_rgba_to_color(format, r, g, b, a));
}

ZTEST(color_conv, test_color_to_rgba_0xFFFFFFFF_mono10)
{
	const enum display_pixel_format format = PIXEL_FORMAT_MONO10;
	uint8_t r = 0, g = 0, b = 0, a = 0;
	uint32_t color = 0xFFFFFFFF;

	test_color_to_rgba(format, color, &r, &g, &b, &a);

	zassert_equal(0, r);
	zassert_equal(0, g);
	zassert_equal(0, b);
	zassert_equal(0, a);

	zassert_equal(color, test_rgba_to_color(format, r, g, b, a));
}

ZTEST(color_conv, test_color_to_rgba_0_rgb888)
{
	const enum display_pixel_format format = PIXEL_FORMAT_RGB_888;
	uint8_t r = 0, g = 0, b = 0, a = 0;
	uint32_t color = 0;

	test_color_to_rgba(format, color, &r, &g, &b, &a);

	zassert_equal(0, r);
	zassert_equal(0, g);
	zassert_equal(0, b);
	zassert_equal(0xFF, a);

	zassert_equal(0xFF000000, test_rgba_to_color(format, r, g, b, a));
}

ZTEST(color_conv, test_color_to_rgba_1_rgb888)
{
	const enum display_pixel_format format = PIXEL_FORMAT_RGB_888;
	uint8_t r = 0, g = 0, b = 0, a = 0;
	uint32_t color = 0xFF010203;

	test_color_to_rgba(format, color, &r, &g, &b, &a);

	zassert_equal(1, r);
	zassert_equal(2, g);
	zassert_equal(3, b);
	zassert_equal(0xFF, a);

	zassert_equal(color, test_rgba_to_color(format, r, g, b, a));
}

ZTEST(color_conv, test_color_to_rgba_0xFFFFFFFF_rgb888)
{
	const enum display_pixel_format format = PIXEL_FORMAT_RGB_888;
	uint8_t r = 0, g = 0, b = 0, a = 0;
	uint32_t color = 0xFFFFFFFF;

	test_color_to_rgba(format, color, &r, &g, &b, &a);

	zassert_equal(0xFF, r);
	zassert_equal(0xFF, g);
	zassert_equal(0xFF, b);
	zassert_equal(0xFF, a);

	zassert_equal(color, test_rgba_to_color(format, r, g, b, a));
}

ZTEST(color_conv, test_color_to_rgba_0_argb888)
{
	const enum display_pixel_format format = PIXEL_FORMAT_ARGB_8888;
	uint8_t r = 0, g = 0, b = 0, a = 0;
	uint32_t color = 0;

	test_color_to_rgba(format, color, &r, &g, &b, &a);

	zassert_equal(0, r);
	zassert_equal(0, g);
	zassert_equal(0, b);
	zassert_equal(0, a);

	zassert_equal(color, test_rgba_to_color(format, r, g, b, a));
}

ZTEST(color_conv, test_color_to_rgba_1_argb888)
{
	const enum display_pixel_format format = PIXEL_FORMAT_ARGB_8888;
	uint8_t r = 0, g = 0, b = 0, a = 0;
	uint32_t color = 0x05010203;

	test_color_to_rgba(format, color, &r, &g, &b, &a);

	zassert_equal(1, r);
	zassert_equal(2, g);
	zassert_equal(3, b);
	zassert_equal(5, a);

	zassert_equal(color, test_rgba_to_color(format, r, g, b, a));
}

ZTEST(color_conv, test_color_to_rgba_0xFFFFFFFF_argb8888)
{
	const enum display_pixel_format format = PIXEL_FORMAT_ARGB_8888;
	uint8_t r = 0, g = 0, b = 0, a = 0;
	uint32_t color = 0xFFFFFFFF;

	test_color_to_rgba(format, color, &r, &g, &b, &a);

	zassert_equal(0xFF, r);
	zassert_equal(0xFF, g);
	zassert_equal(0xFF, b);
	zassert_equal(0xFF, a);

	zassert_equal(color, test_rgba_to_color(format, r, g, b, a));
}

ZTEST(color_conv, test_color_to_rgba_0_rgb565)
{
	const enum display_pixel_format format = PIXEL_FORMAT_RGB_565;
	uint8_t r = 0, g = 0, b = 0, a = 0;
	uint32_t color = 0;

	test_color_to_rgba(format, color, &r, &g, &b, &a);

	zassert_equal(0, r);
	zassert_equal(0, g);
	zassert_equal(0, b);
	zassert_equal(0xFF, a);

	zassert_equal(color, test_rgba_to_color(format, r, g, b, a));
}

ZTEST(color_conv, test_color_to_rgba_1_rgb565)
{
	const enum display_pixel_format format = PIXEL_FORMAT_RGB_565;
	uint8_t r = 0, g = 0, b = 0, a = 0;
	uint32_t color = 0x2108;

	test_color_to_rgba(format, color, &r, &g, &b, &a);

	zassert_equal(8, r);
	zassert_equal(4, g);
	zassert_equal(8, b);
	zassert_equal(0xFF, a);

	zassert_equal(color, test_rgba_to_color(format, r, g, b, a));
}

ZTEST(color_conv, test_color_to_rgba_0xFFFFFFFF_rgb565)
{
	const enum display_pixel_format format = PIXEL_FORMAT_RGB_565;
	uint8_t r = 0, g = 0, b = 0, a = 0;
	uint32_t color = 0xFFFFFFFF;

	test_color_to_rgba(format, color, &r, &g, &b, &a);

	zassert_equal(0xF8, r);
	zassert_equal(0xFC, g);
	zassert_equal(0xF8, b);
	zassert_equal(0xFF, a);

	zassert_equal(0xFFFF, test_rgba_to_color(format, r, g, b, a));
}

ZTEST(color_conv, test_color_to_rgba_0_bgr565)
{
	const enum display_pixel_format format = PIXEL_FORMAT_BGR_565;
	uint8_t r = 0, g = 0, b = 0, a = 0;
	uint32_t color = 0;

	test_color_to_rgba(format, color, &r, &g, &b, &a);

	zassert_equal(0, r);
	zassert_equal(0, g);
	zassert_equal(0, b);
	zassert_equal(0xFF, a);

	zassert_equal(color, test_rgba_to_color(format, r, g, b, a));
}

ZTEST(color_conv, test_color_to_rgba_1_bgr565)
{
	const enum display_pixel_format format = PIXEL_FORMAT_BGR_565;
	uint8_t r = 0, g = 0, b = 0, a = 0;
	uint32_t color = 0x0821;

	test_color_to_rgba(format, color, &r, &g, &b, &a);

	zassert_equal(8, r);
	zassert_equal(4, g);
	zassert_equal(8, b);
	zassert_equal(0xFF, a);

	zassert_equal(color, test_rgba_to_color(format, r, g, b, a));
}

ZTEST(color_conv, test_color_to_rgba_0xFFFFFFFF_bgr565)
{
	const enum display_pixel_format format = PIXEL_FORMAT_BGR_565;
	uint8_t r = 0, g = 0, b = 0, a = 0;
	uint32_t color = 0xFFFFFFFF;

	test_color_to_rgba(format, color, &r, &g, &b, &a);

	zassert_equal(0xF8, r);
	zassert_equal(0xFC, g);
	zassert_equal(0xF8, b);
	zassert_equal(0xFF, a);

	zassert_equal(0xFFFF, test_rgba_to_color(format, r, g, b, a));
}

ZTEST_SUITE(color_conv, NULL, NULL, NULL, NULL, NULL);
```

## src/draw_circle.c
```c
/*
 * Copyright (c) 2024 TOKITA Hiroshi
 *
 * SPDX-License-Identifier: Apache-2.0
 */

#include <zephyr/drivers/display.h>
#include <zephyr/ztest.h>
#include <zephyr/device.h>
#include <zephyr/logging/log.h>
#include <zephyr/display/cfb.h>

#include "testdata.h"
#include "../../common/utils.h"

LOG_MODULE_REGISTER(draw_circle, CONFIG_DISPLAY_LOG_LEVEL);

static struct cfb_display *disp;
static struct cfb_framebuffer *fb;

/**
 * Fill the buffer with 0 before running tests.
 */
static void cfb_test_before(void *text_fixture)
{
	disp = display_init();
	fb = cfb_display_get_framebuffer(disp);
}

static void cfb_test_after(void *test_fixture)
{
	display_deinit(disp);
}

/*
 * normal rendering
 */
ZTEST(draw_circle, test_draw_circle_10_at_10_10)
{
	const uint16_t radius = 10;
	const uint16_t rect_side_len = 21;
	const struct cfb_position center = {10, 10};

	zassert_ok(cfb_draw_circle(fb, &center, radius), "");
	zassert_ok(cfb_framebuffer_finalize(fb), "");

	zassert_true(verify_image(0, 0, circle10, rect_side_len, rect_side_len), "");
}

ZTEST(draw_circle, test_draw_circle_10_at_11_11)
{
	const uint16_t radius = 10;
	const uint16_t rect_side_len = 21;
	const struct cfb_position center = {11, 11};

	zassert_ok(cfb_draw_circle(fb, &center, radius), "");
	zassert_ok(cfb_framebuffer_finalize(fb), "");

	zassert_true(verify_image(1, 1, circle10, rect_side_len, rect_side_len), "");
}

/* tile border case */
ZTEST(draw_circle, test_draw_circle_10_at_19_25)
{
	const uint16_t radius = 10;
	const uint16_t rect_side_len = 21;
	const struct cfb_position center = {19, 25};

	zassert_ok(cfb_draw_circle(fb, &center, radius), "");
	zassert_ok(cfb_framebuffer_finalize(fb), "");

	zassert_true(verify_image(9, 15, circle10, rect_side_len, rect_side_len), "");
}

ZTEST(draw_circle, test_draw_circle_10_at_20_26)
{
	const uint16_t radius = 10;
	const uint16_t rect_side_len = 21;
	const struct cfb_position center = {20, 26};

	zassert_ok(cfb_draw_circle(fb, &center, radius), "");
	zassert_ok(cfb_framebuffer_finalize(fb), "");

	zassert_true(verify_image(10, 16, circle10, rect_side_len, rect_side_len), "");
}

ZTEST(draw_circle, test_draw_circle_10_at_21_27)
{
	const uint16_t radius = 10;
	const uint16_t rect_side_len = 21;
	const struct cfb_position center = {21, 27};

	zassert_ok(cfb_draw_circle(fb, &center, radius), "");
	zassert_ok(cfb_framebuffer_finalize(fb), "");

	zassert_true(verify_image(11, 17, circle10, rect_side_len, rect_side_len), "");
}

/*
 * Case of including coordinates outside the area
 */
ZTEST(draw_circle, test_draw_circle_10_outside_top_left)
{
	const uint16_t radius = 10;
	const struct cfb_position center = {-4, -4};

	zassert_ok(cfb_draw_circle(fb, &center, radius), "");
	zassert_ok(cfb_framebuffer_finalize(fb), "");

	zassert_true(verify_image_and_bg(0, 0, circle10_outside_top_left, 6, 6, 0), "");
}

ZTEST(draw_circle, test_draw_circle_10_outside_top_right)
{
	const uint16_t radius = 10;
	const uint16_t rect_side_len = 21;
	const struct cfb_position center = {display_width - 5 + radius,
					    -(rect_side_len - 8) + radius};

	zassert_ok(cfb_draw_circle(fb, &center, radius), "");
	zassert_ok(cfb_framebuffer_finalize(fb), "");

	zassert_true(verify_image(display_width - 5, 0, circle10_outside_top_right, 5, 8), "");
}

ZTEST(draw_circle, test_draw_circle_10_outside_bottom_right)
{
	const uint16_t radius = 10;
	const struct cfb_position center = {display_width + 3, display_height + 3};

	zassert_ok(cfb_draw_circle(fb, &center, radius), "");
	zassert_ok(cfb_framebuffer_finalize(fb), "");

	zassert_true(verify_image_and_bg(display_width - 6, display_height - 6,
					 circle10_outside_bottom_right, 6, 6, 0),
		     "");
}

ZTEST(draw_circle, test_draw_circle_10_outside_bottom_left)
{
	const uint16_t radius = 10;
	const uint16_t rect_side_len = 21;
	const struct cfb_position center = {-(rect_side_len - 3) + radius,
					    display_height - 14 + radius};

	zassert_ok(cfb_draw_circle(fb, &center, radius), "");
	zassert_ok(cfb_framebuffer_finalize(fb), "");

	zassert_true(verify_image(0, display_height - 14, circle10_outside_bottom_left, 3, 14), "");
}

ZTEST(draw_circle, test_draw_circle_10_outside_top_left_no_visible_pixels)
{
	const uint16_t radius = 10;
	const struct cfb_position center = {-12, -12};

	zassert_ok(cfb_draw_circle(fb, &center, radius), "");
	zassert_ok(cfb_framebuffer_finalize(fb), "");

	zassert_true(verify_color_inside_rect(0, 0, display_width, display_height, 0), "");
}

ZTEST_SUITE(draw_circle, NULL, NULL, cfb_test_before, cfb_test_after, NULL);
```

## src/draw_line.c
```c
/*
 * Copyright (c) 2024 TOKITA Hiroshi
 *
 * SPDX-License-Identifier: Apache-2.0
 */

#include <zephyr/drivers/display.h>
#include <zephyr/ztest.h>
#include <zephyr/device.h>
#include <zephyr/logging/log.h>
#include <zephyr/display/cfb.h>

#include "testdata.h"
#include "../../common/utils.h"

LOG_MODULE_REGISTER(draw_line, CONFIG_DISPLAY_LOG_LEVEL);

static struct cfb_display *disp;
static struct cfb_framebuffer *fb;

/**
 * Fill the buffer with 0 before running tests.
 */
static void cfb_test_before(void *text_fixture)
{
	disp = display_init();
	fb = cfb_display_get_framebuffer(disp);
}

static void cfb_test_after(void *test_fixture)
{
	display_deinit(disp);
}

ZTEST(draw_line, test_draw_line_top_end)
{
	struct cfb_position start = {0, 0};
	struct cfb_position end = {display_width, 0};

	zassert_ok(cfb_draw_line(fb, &start, &end));
	zassert_ok(cfb_framebuffer_finalize(fb));

	zassert_true(verify_color_inside_rect(0, 0, display_width, 1, 0xFFFFFF));
}

ZTEST(draw_line, test_draw_line_left_end)
{
	struct cfb_position start = {0, 0};
	struct cfb_position end = {0, display_height};

	zassert_ok(cfb_draw_line(fb, &start, &end));
	zassert_ok(cfb_framebuffer_finalize(fb));

	zassert_true(verify_color_inside_rect(0, 0, 1, display_height, 0xFFFFFF));
}

ZTEST(draw_line, test_draw_right_end)
{
	struct cfb_position start = {display_width - 1, 0};
	struct cfb_position end = {display_width - 1, display_height};

	zassert_ok(cfb_draw_line(fb, &start, &end));
	zassert_ok(cfb_framebuffer_finalize(fb));

	zassert_true(verify_color_inside_rect(display_width - 1, 0, 1, display_height, 0xFFFFFF));
}

ZTEST(draw_line, test_draw_line_bottom_end)
{
	struct cfb_position start = {0, 239};
	struct cfb_position end = {display_width, 239};

	zassert_ok(cfb_draw_line(fb, &start, &end));
	zassert_ok(cfb_framebuffer_finalize(fb));

	zassert_true(verify_color_inside_rect(0, display_height - 1, display_width, 1, 0xFFFFFF));
}

ZTEST(draw_line, test_render_twice_on_same_tile)
{
	struct cfb_position start = {0, 0};
	struct cfb_position end = {display_width, 0};

	zassert_ok(cfb_draw_line(fb, &start, &end));
	start.y = 7;
	end.y = 7;
	zassert_ok(cfb_draw_line(fb, &start, &end));
	zassert_ok(cfb_framebuffer_finalize(fb));

	zassert_true(verify_color_inside_rect(0, 0, display_width, 1, 0xFFFFFF));
	zassert_true(verify_color_inside_rect(0, 1, display_width, 6, 0x0));
	zassert_true(verify_color_inside_rect(0, 7, display_width, 1, 0xFFFFFF));
	zassert_true(verify_color_inside_rect(0, 8, display_width, 232, 0x0));
}

ZTEST(draw_line, test_crossing_diagonally_end_to_end)
{
	struct cfb_position start = {0, 0};
	struct cfb_position end = {320, 240};

	zassert_ok(cfb_draw_line(fb, &start, &end));
	zassert_ok(cfb_framebuffer_finalize(fb));

	for (size_t i = 0; i < 10; i++) {
		zassert_true(verify_image(32 * i, 24 * i, diagonal3224, 32, 24));
	}
}

ZTEST(draw_line, test_crossing_diagonally_from_outside_area)
{
	struct cfb_position start = {-32, -48};
	struct cfb_position end = {384, 264};

	zassert_ok(cfb_draw_line(fb, &start, &end));
	zassert_ok(cfb_framebuffer_finalize(fb));

	for (size_t i = 0; i < 9; i++) {
		zassert_true(verify_image(32 + 32 * i, 24 * i, diagonal3224, 32, 24));
	}
}

ZTEST_SUITE(draw_line, NULL, NULL, cfb_test_before, cfb_test_after, NULL);
```

## src/draw_point.c
```c
/*
 * Copyright (c) 2024 TOKITA Hiroshi
 *
 * SPDX-License-Identifier: Apache-2.0
 */

#include <zephyr/drivers/display.h>
#include <zephyr/ztest.h>
#include <zephyr/device.h>
#include <zephyr/logging/log.h>
#include <zephyr/display/cfb.h>

#include "testdata.h"
#include "../../common/utils.h"

LOG_MODULE_REGISTER(draw_point, CONFIG_DISPLAY_LOG_LEVEL);

static struct cfb_display *disp;
static struct cfb_framebuffer *fb;

/**
 * Fill the buffer with 0 before running tests.
 */
static void cfb_test_before(void *text_fixture)
{
	disp = display_init();
	fb = cfb_display_get_framebuffer(disp);
}

static void cfb_test_after(void *test_fixture)
{
	display_deinit(disp);
}

/*
 * normal rendering
 */
ZTEST(draw_point, test_draw_point_at_0_0)
{
	struct cfb_position pos = {0, 0};

	zassert_ok(cfb_draw_point(fb, &pos));
	zassert_ok(cfb_framebuffer_finalize(fb));

	zassert_true(verify_pixel_and_bg(0, 0, 1, 0));
}

ZTEST(draw_point, test_draw_point_at_1_1)
{
	struct cfb_position pos = {1, 1};

	zassert_ok(cfb_draw_point(fb, &pos));
	zassert_ok(cfb_framebuffer_finalize(fb));

	zassert_true(verify_pixel_and_bg(1, 1, 1, 0));
}

/*
 * around tile border
 */
ZTEST(draw_point, test_draw_pont_at_9_15)
{
	struct cfb_position pos = {9, 15};

	zassert_ok(cfb_draw_point(fb, &pos));
	zassert_ok(cfb_framebuffer_finalize(fb));

	zassert_true(verify_pixel_and_bg(9, 15, 1, 0));
}

ZTEST(draw_point, test_draw_point_at_10_16)
{
	struct cfb_position pos = {10, 16};

	zassert_ok(cfb_draw_point(fb, &pos));
	zassert_ok(cfb_framebuffer_finalize(fb));

	zassert_true(verify_pixel_and_bg(10, 16, 1, 0));
}

ZTEST(draw_point, test_draw_point_at_11_17)
{
	struct cfb_position pos = {11, 17};

	zassert_ok(cfb_draw_point(fb, &pos));
	zassert_ok(cfb_framebuffer_finalize(fb));

	zassert_true(verify_pixel_and_bg(11, 17, 1, 0));
}

ZTEST(draw_point, test_draw_point_twice_on_same_tile)
{
	struct cfb_position pos = {10, 0};

	pos.y = 7;
	zassert_ok(cfb_draw_point(fb, &pos));

	pos.y = 8;
	zassert_ok(cfb_draw_point(fb, &pos));

	pos.y = 9;
	zassert_ok(cfb_draw_point(fb, &pos));

	zassert_ok(cfb_framebuffer_finalize(fb));

	zassert_true(verify_color_inside_rect(10, 7, 1, 3, 0xFFFFFF));
	zassert_true(verify_color_outside_rect(10, 7, 1, 3, 0x0));
}

ZTEST(draw_point, test_draw_point_outside_top_left)
{
	struct cfb_position pos = {0, -1};

	zassert_ok(cfb_draw_point(fb, &pos));
	zassert_ok(cfb_framebuffer_finalize(fb));

	zassert_true(verify_color_inside_rect(0, 0, display_width, display_height, 0));
}

ZTEST(draw_point, test_draw_point_outside_top_right)
{
	struct cfb_position pos = {display_width, 0};

	zassert_ok(cfb_draw_point(fb, &pos));
	zassert_ok(cfb_framebuffer_finalize(fb));

	zassert_true(verify_color_inside_rect(0, 0, display_width, display_height, 0));
}

ZTEST(draw_point, test_draw_point_outside_bottom_right)
{
	struct cfb_position pos = {0, display_height};

	zassert_ok(cfb_draw_point(fb, &pos));
	zassert_ok(cfb_framebuffer_finalize(fb));

	zassert_true(verify_color_inside_rect(0, 0, display_width, display_height, 0));
}

ZTEST(draw_point, test_draw_point_outside_bottom_left)
{
	struct cfb_position pos = {-1, display_height};

	zassert_ok(cfb_draw_point(fb, &pos));
	zassert_ok(cfb_framebuffer_finalize(fb));

	zassert_true(verify_color_inside_rect(0, 0, display_width, display_height, 0));
}

ZTEST_SUITE(draw_point, NULL, NULL, cfb_test_before, cfb_test_after, NULL);
```
