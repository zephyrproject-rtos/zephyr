## CMakeLists.txt
```
# SPDX-FileCopyrightText: 2026 Muhammad Waleed Badar
# SPDX-License-Identifier: Apache-2.0

cmake_minimum_required(VERSION 3.28.0)

find_package(Zephyr REQUIRED HINTS $ENV{ZEPHYR_BASE})
project(display_console)

target_sources(app PRIVATE src/main.c src/fake_display.c)
```

## prj.conf
```kconfig
CONFIG_ZTEST=y
CONFIG_DISPLAY=y
CONFIG_DISPLAY_CONSOLE=y
CONFIG_SERIAL=y
CONFIG_EMUL=y
CONFIG_LOG=y
CONFIG_SDL_DISPLAY=n
CONFIG_UART_CONSOLE=n
CONFIG_POSIX_ARCH_CONSOLE=y
CONFIG_INPUT=y
```

## app.overlay
```dts
/*
 * SPDX-FileCopyrightText: 2026 Muhammad Waleed Badar
 * SPDX-License-Identifier: Apache-2.0
 */

/ {
	fake_display: fake-display {
		compatible = "vnd,display-fake";
		width = <128>;
		height = <64>;
	};

	uart_console: uart-console {
		compatible = "zephyr,uart-emul";
		tx-fifo-size = <256>;
	};

	chosen {
		zephyr,display = &fake_display;
		zephyr,console = &uart_console;
	};
};
```

## argb8888.overlay
```dts
/*
 * SPDX-FileCopyrightText: 2026 Muhammad Waleed Badar
 * SPDX-License-Identifier: Apache-2.0
 */

&fake_display {
	pixel-format = "argb8888";
};
```

## l8.overlay
```dts
/*
 * SPDX-FileCopyrightText: 2026 Muhammad Waleed Badar
 * SPDX-License-Identifier: Apache-2.0
 */

&fake_display {
	pixel-format = "l8";
};
```

## mono01.overlay
```dts
/*
 * SPDX-FileCopyrightText: 2026 Muhammad Waleed Badar
 * SPDX-License-Identifier: Apache-2.0
 */

&fake_display {
	pixel-format = "mono01";
};
```

## mono01_vtiled.overlay
```dts
/*
 * SPDX-FileCopyrightText: 2026 Muhammad Waleed Badar
 * SPDX-License-Identifier: Apache-2.0
 */

&fake_display {
	pixel-format = "mono01";
	mono-vtiled;
};
```

## mono10.overlay
```dts
/*
 * SPDX-FileCopyrightText: 2026 Muhammad Waleed Badar
 * SPDX-License-Identifier: Apache-2.0
 */

&fake_display {
	pixel-format = "mono10";
};
```

## dts/bindings/display/vnd,display-fake.yaml
```yaml
# SPDX-FileCopyrightText: 2026 Muhammad Waleed Badar
# SPDX-License-Identifier: Apache-2.0

description: Display that counts the writes it receives and checks their size, for tests

compatible: "vnd,display-fake"

include: display-controller.yaml

properties:
  x-alignment-width:
    type: boolean
    description: Accept full-width writes only, as reported with SCREEN_INFO_X_ALIGNMENT_WIDTH.

  pixel-format:
    type: string
    default: "rgb565"
    enum:
      - "rgb565"
      - "rgb888"
      - "argb8888"
      - "l8"
      - "mono01"
      - "mono10"
    description: Pixel format reported and expected in the writes.

  mono-vtiled:
    type: boolean
    description: Report SCREEN_INFO_MONO_VTILED with a monochrome format.
```

## src/main.c
```c
/*
 * SPDX-FileCopyrightText: 2026 Muhammad Waleed Badar
 * SPDX-License-Identifier: Apache-2.0
 */

#include <string.h>

#include <zephyr/display/display_console.h>
#include <zephyr/drivers/uart.h>
#include <zephyr/dt-bindings/input/input-event-codes.h>
#include <zephyr/input/input.h>
#include <zephyr/kernel.h>
#include <zephyr/logging/log_ctrl.h>
#include <zephyr/ztest.h>

#include "fake_display.h"

/* Long enough for the work queue to draw what was written. */
#define SETTLE K_MSEC(CONFIG_DISPLAY_CONSOLE_FLUSH_DELAY_MS + 100)

static void write_str(const char *str)
{
	display_console_write(str, strlen(str));
}

/* The bytes queued on the receive side of the console UART since the last call. */
static const char *read_rx(const struct device *uart)
{
	static char buf[8];
	size_t n = 0;
	unsigned char c;

	k_sleep(K_MSEC(20));
	while (n < sizeof(buf) - 1U && uart_poll_in(uart, &c) == 0) {
		buf[n++] = (char)c;
	}
	buf[n] = '\0';

	return buf;
}

/* Keyboard front end: key events become terminal bytes on the console UART RX side. */
ZTEST(display_console, test_0_keyboard)
{
	const struct device *uart = DEVICE_DT_GET(DT_CHOSEN(zephyr_console));
	static const struct {
		uint16_t code;
		const char *bytes;
	} keys[] = {
		{INPUT_KEY_H, "h"},
		{INPUT_KEY_1, "1"},
		{INPUT_KEY_SPACE, " "},
		{INPUT_KEY_MINUS, "-"},
		{INPUT_KEY_ENTER, "\r"},
		{INPUT_KEY_BACKSPACE, "\b"},
		{INPUT_KEY_TAB, "\t"},
		{INPUT_KEY_ESC, "\x1b"},
		{INPUT_KEY_UP, "\x1b[A"},
		{INPUT_KEY_DOWN, "\x1b[B"},
		{INPUT_KEY_RIGHT, "\x1b[C"},
		{INPUT_KEY_LEFT, "\x1b[D"},
		{INPUT_KEY_HOME, "\x1b[H"},
		{INPUT_KEY_END, "\x1b[F"},
		{INPUT_KEY_DELETE, "\x1b[3~"},
		{INPUT_KEY_KP1, "1"},
		{INPUT_KEY_KPENTER, "\r"},
	};
	static const struct {
		uint16_t modifier;
		uint16_t code;
		const char *bytes;
	} chords[] = {
		{INPUT_KEY_LEFTSHIFT, INPUT_KEY_H, "H"},
		{INPUT_KEY_RIGHTSHIFT, INPUT_KEY_1, "!"},
		{INPUT_KEY_LEFTSHIFT, INPUT_KEY_MINUS, "_"},
		{INPUT_KEY_LEFTCTRL, INPUT_KEY_C, "\x03"},
		{INPUT_KEY_LEFTCTRL, INPUT_KEY_H, "\x08"},
	};

	zassert_true(device_is_ready(uart));

	for (size_t i = 0; i < ARRAY_SIZE(keys); i++) {
		zassert_ok(input_report_key(NULL, keys[i].code, 1, true, K_FOREVER));
		zassert_ok(input_report_key(NULL, keys[i].code, 0, true, K_FOREVER));
		zassert_str_equal(read_rx(uart), keys[i].bytes, "key %u", keys[i].code);
	}

	for (size_t i = 0; i < ARRAY_SIZE(chords); i++) {
		zassert_ok(input_report_key(NULL, chords[i].modifier, 1, true, K_FOREVER));
		zassert_ok(input_report_key(NULL, chords[i].code, 1, true, K_FOREVER));
		zassert_ok(input_report_key(NULL, chords[i].code, 0, true, K_FOREVER));
		zassert_ok(input_report_key(NULL, chords[i].modifier, 0, true, K_FOREVER));
		zassert_str_equal(read_rx(uart), chords[i].bytes, "chord %u+%u", chords[i].modifier,
				  chords[i].code);
	}

	/* A modifier alone and a release produce nothing. */
	zassert_ok(input_report_key(NULL, INPUT_KEY_LEFTSHIFT, 1, true, K_FOREVER));
	zassert_ok(input_report_key(NULL, INPUT_KEY_LEFTSHIFT, 0, true, K_FOREVER));
	zassert_str_equal(read_rx(uart), "");
}

/* Before a fatal error the work queue draws the output. */
ZTEST(display_console, test_1_deferred_draw)
{
	uint32_t before;

	zassert_true(display_console_ready(), "console not attached");
	k_sleep(SETTLE);

	before = fake_display_writes();
	write_str("deferred\n");
	zassert_equal(fake_display_writes(), before, "line drawn before the flush delay");

	k_sleep(SETTLE);
	zassert_true(fake_display_writes() > before, "line never drawn");
}

/* Runs last: the logging panic hook makes every completed line draw at once. */
ZTEST(display_console, test_2_panic_draw)
{
	uint32_t before;

	k_sleep(SETTLE);
	LOG_PANIC();

	before = fake_display_writes();
	write_str("partial");
	zassert_equal(fake_display_writes(), before, "incomplete line drawn");

	write_str(" line\n");
	zassert_true(fake_display_writes() > before, "line not drawn before the write returned");
}

ZTEST_SUITE(display_console, NULL, NULL, NULL, NULL, NULL);
```

## src/fake_display.c
```c
/*
 * SPDX-FileCopyrightText: 2026 Muhammad Waleed Badar
 * SPDX-License-Identifier: Apache-2.0
 */

#define DT_DRV_COMPAT vnd_display_fake

#include <errno.h>

#include <zephyr/device.h>
#include <zephyr/drivers/display.h>
#include <zephyr/sys/atomic.h>
#include <zephyr/sys/util.h>

#include "fake_display.h"

static atomic_t fake_display_write_count;

static const enum display_pixel_format fake_display_formats[] = {
	PIXEL_FORMAT_RGB_565, PIXEL_FORMAT_RGB_888, PIXEL_FORMAT_ARGB_8888,
	PIXEL_FORMAT_L_8,     PIXEL_FORMAT_MONO01,  PIXEL_FORMAT_MONO10,
};

#define FAKE_DISPLAY_FORMAT fake_display_formats[DT_INST_ENUM_IDX(0, pixel_format)]
#define FAKE_DISPLAY_VTILED DT_INST_PROP(0, mono_vtiled)

/* Bytes a write of the given size takes in the configured format. */
static size_t fake_display_buf_size(uint16_t w, uint16_t h)
{
	switch (FAKE_DISPLAY_FORMAT) {
	case PIXEL_FORMAT_RGB_565:
		return (size_t)w * h * 2U;
	case PIXEL_FORMAT_RGB_888:
		return (size_t)w * h * 3U;
	case PIXEL_FORMAT_ARGB_8888:
		return (size_t)w * h * 4U;
	case PIXEL_FORMAT_L_8:
		return (size_t)w * h;
	default:
		return FAKE_DISPLAY_VTILED ? (size_t)w * DIV_ROUND_UP(h, 8U)
					   : DIV_ROUND_UP(w, 8U) * h;
	}
}

uint32_t fake_display_writes(void)
{
	return (uint32_t)atomic_get(&fake_display_write_count);
}

static int fake_display_write(const struct device *dev, const uint16_t x, const uint16_t y,
			      const struct display_buffer_descriptor *desc, const void *buf)
{
	ARG_UNUSED(dev);
	ARG_UNUSED(y);
	ARG_UNUSED(buf);

	if (DT_INST_PROP(0, x_alignment_width) &&
	    (x != 0U || desc->width != DT_INST_PROP(0, width))) {
		return -ENOTSUP;
	}

	if (desc->buf_size < fake_display_buf_size(desc->width, desc->height)) {
		return -EINVAL;
	}

	atomic_inc(&fake_display_write_count);

	return 0;
}

static int fake_display_blanking(const struct device *dev)
{
	ARG_UNUSED(dev);

	return 0;
}

static void fake_display_get_capabilities(const struct device *dev,
					  struct display_capabilities *caps)
{
	ARG_UNUSED(dev);

	*caps = (struct display_capabilities){
		.x_resolution = DT_INST_PROP(0, width),
		.y_resolution = DT_INST_PROP(0, height),
		.supported_pixel_formats = FAKE_DISPLAY_FORMAT,
		.current_pixel_format = FAKE_DISPLAY_FORMAT,
		.screen_info =
			(DT_INST_PROP(0, x_alignment_width) ? SCREEN_INFO_X_ALIGNMENT_WIDTH : 0) |
			(FAKE_DISPLAY_VTILED ? SCREEN_INFO_MONO_VTILED : 0),
	};
}

static int fake_display_set_pixel_format(const struct device *dev,
					 const enum display_pixel_format pixel_format)
{
	ARG_UNUSED(dev);

	return (pixel_format == FAKE_DISPLAY_FORMAT) ? 0 : -ENOTSUP;
}

static DEVICE_API(display, fake_display_api) = {
	.blanking_on = fake_display_blanking,
	.blanking_off = fake_display_blanking,
	.write = fake_display_write,
	.get_capabilities = fake_display_get_capabilities,
	.set_pixel_format = fake_display_set_pixel_format,
};

DEVICE_DT_INST_DEFINE(0, NULL, NULL, NULL, NULL, POST_KERNEL, CONFIG_DISPLAY_INIT_PRIORITY,
		      &fake_display_api);
```

## src/fake_display.h
```c
/*
 * SPDX-FileCopyrightText: 2026 Muhammad Waleed Badar
 * SPDX-License-Identifier: Apache-2.0
 */

#ifndef FAKE_DISPLAY_H_
#define FAKE_DISPLAY_H_

#include <stdint.h>

/* Number of display_write() calls the fake display has received. */
uint32_t fake_display_writes(void);

#endif /* FAKE_DISPLAY_H_ */
```
