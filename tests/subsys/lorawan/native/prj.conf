## CMakeLists.txt
```
# Copyright (c) 2026 Embeint Inc
# SPDX-License-Identifier: Apache-2.0

cmake_minimum_required(VERSION 3.28.0)
find_package(Zephyr REQUIRED HINTS $ENV{ZEPHYR_BASE})
project(lorawan_native)

target_sources(app PRIVATE
  src/network_server.c
  src/test_common.c
  src/test_join.c
  src/test_uplink.c
  src/test_downlink.c
)

if(CONFIG_TEST_LORAWAN_NATIVE_REGION_EU868)
  target_sources(app PRIVATE src/region/test_region_eu868.c)
endif()
```

## Kconfig
```
# Copyright (c) 2026 Embeint Inc
# SPDX-License-Identifier: Apache-2.0

source "Kconfig.zephyr"

choice TEST_LORAWAN_NATIVE_REGION
	prompt "LoRaWAN native test region"
	default TEST_LORAWAN_NATIVE_REGION_EU868

config TEST_LORAWAN_NATIVE_REGION_EU868
	bool "EU868"
	depends on LORAWAN_REGION_EU868

endchoice
```

## prj.conf
```kconfig
# Copyright (c) 2026 Embeint Inc
# SPDX-License-Identifier: Apache-2.0

CONFIG_LORA=y
CONFIG_LORAWAN=y
CONFIG_LORAWAN_REGION_EU868=y
CONFIG_ZTEST=y
```

## src/network_server.h
```c
/*
 * Copyright (c) 2026 Embeint Inc
 *
 * SPDX-License-Identifier: Apache-2.0
 */

#ifndef TESTS_SUBSYS_LORAWAN_NATIVE_NETWORK_SERVER_H_
#define TESTS_SUBSYS_LORAWAN_NATIVE_NETWORK_SERVER_H_

#include <stdbool.h>
#include <stddef.h>
#include <stdint.h>

#include <zephyr/lorawan/lorawan.h>

enum network_server_invalid_join_response {
	NETWORK_SERVER_INVALID_JOIN_RESPONSE_NONE,
	NETWORK_SERVER_INVALID_JOIN_RESPONSE_WRONG_MHDR,
	NETWORK_SERVER_INVALID_JOIN_RESPONSE_UNSUPPORTED_MAJOR,
	NETWORK_SERVER_INVALID_JOIN_RESPONSE_EMPTY,
	NETWORK_SERVER_INVALID_JOIN_RESPONSE_SHORT,
	NETWORK_SERVER_INVALID_JOIN_RESPONSE_INTERMEDIATE,
	NETWORK_SERVER_INVALID_JOIN_RESPONSE_OVERSIZE,
	NETWORK_SERVER_INVALID_JOIN_RESPONSE_BAD_CIPHERTEXT,
	NETWORK_SERVER_INVALID_JOIN_RESPONSE_BAD_MIC,
	NETWORK_SERVER_INVALID_JOIN_RESPONSE_INVALID_RX1_OFFSET,
	NETWORK_SERVER_INVALID_JOIN_RESPONSE_INVALID_RX2_DATARATE,
};

enum network_server_invalid_downlink {
	NETWORK_SERVER_INVALID_DOWNLINK_NONE,
	NETWORK_SERVER_INVALID_DOWNLINK_WRONG_MHDR,
	NETWORK_SERVER_INVALID_DOWNLINK_UNSUPPORTED_MAJOR,
	NETWORK_SERVER_INVALID_DOWNLINK_SHORT,
	NETWORK_SERVER_INVALID_DOWNLINK_WRONG_DEV_ADDR,
	NETWORK_SERVER_INVALID_DOWNLINK_BAD_MIC,
	NETWORK_SERVER_INVALID_DOWNLINK_BAD_FOPTS_LEN,
};

/**
 * @brief Get the OTAA configuration used by the test network server.
 *
 * @return LoRaWAN join configuration.
 */
struct lorawan_join_config network_server_join_config(void);

/** @brief Get the known LoRaWAN 1.0.x vector OTAA configuration. */
struct lorawan_join_config network_server_vector_join_config(void);

/** @brief Prepare the known LoRaWAN 1.0.x vector join exchange. */
void network_server_prepare_vector_join(void);

/** @brief Prepare the known LoRaWAN 1.0.x vector application uplink. */
void network_server_prepare_vector_uplink(void);

/**
 * @brief Prepare the server to return a join-accept.
 *
 * @param rx_window Receive window in which to return the join-accept.
 */
void network_server_prepare_join(uint32_t rx_window);

/**
 * @brief Prepare the server to return a join-accept with a specific RxDelay.
 *
 * @param rx_delay Receive delay in seconds.
 */
void network_server_prepare_join_with_rx_delay(uint8_t rx_delay);

/**
 * @brief Prepare the server to return an invalid join-accept in RX1.
 *
 * A valid join-accept is returned in RX2.
 */
void network_server_prepare_invalid_join_response(void);

/**
 * @brief Prepare the server to return an invalid join-accept in both RX windows.
 *
 * @param response The invalid response to return.
 */
void network_server_prepare_invalid_join_responses(
	enum network_server_invalid_join_response response);

/**
 * @brief Prepare the server to return a join-accept containing a CFList.
 *
 * @param rx_window Receive window in which to return the join-accept.
 */
void network_server_prepare_join_with_cflist(uint32_t rx_window);

/**
 * @brief Prepare the server to return a join-accept with an all-zero CFList.
 *
 * Every CFList frequency slot is zero, which disables those channels.
 *
 * @param rx_window Receive window in which to return the join-accept.
 */
void network_server_prepare_join_with_empty_cflist(uint32_t rx_window);

/** @brief Prepare the server to ignore receive windows for a join request. */
void network_server_prepare_join_no_response(void);

/**
 * @brief Prepare the server to ignore receive windows for an application uplink.
 *
 * @param type Expected LoRaWAN message type.
 * @param port Expected application port.
 * @param payload Expected plaintext payload.
 * @param payload_len Length of the expected payload.
 */
void network_server_prepare_uplink_no_response(enum lorawan_message_type type, uint8_t port,
					       const uint8_t *payload, size_t payload_len);

/** @brief Prepare the server to expect an uplink acknowledging a confirmed downlink. */
void network_server_prepare_uplink_ack(uint8_t port, const uint8_t *payload, size_t payload_len);

/**
 * @brief Prepare an application downlink for the specified receive window.
 *
 * @param rx_window Receive window in which to return the downlink.
 * @param port Application port.
 * @param payload Plaintext application payload.
 * @param payload_len Length of @p payload.
 */
void network_server_prepare_downlink(uint32_t rx_window, uint8_t port, const uint8_t *payload,
				     size_t payload_len);

/** @brief Prepare an application downlink with the data-pending flag set. */
void network_server_prepare_data_pending_downlink(uint32_t rx_window, uint8_t port,
						  const uint8_t *payload, size_t payload_len);

/** @brief Prepare a confirmed application downlink for the specified receive window. */
void network_server_prepare_confirmed_downlink(uint32_t rx_window, uint8_t port,
					       const uint8_t *payload, size_t payload_len);

/**
 * @brief Prepare a downlink without ACK in response to a confirmed uplink.
 *
 * The downlink is returned only after the first transmission, so later
 * transmission attempts of the confirmed uplink receive nothing.
 *
 * @param rx_window Receive window of the first transmission in which to return
 *                  the downlink.
 * @param confirmed Whether the downlink is a confirmed data frame.
 * @param port Application port, used for both the uplink and the downlink.
 * @param payload Plaintext application payload.
 * @param payload_len Length of @p payload.
 */
void network_server_prepare_unacked_downlink(uint32_t rx_window, bool confirmed, uint8_t port,
					     const uint8_t *payload, size_t payload_len);

/**
 * @brief Prepare an invalid downlink in RX1.
 *
 * @param response Invalid downlink variant to return.
 * @param port Application port.
 * @param payload Plaintext application payload.
 * @param payload_len Length of @p payload.
 */
void network_server_prepare_invalid_downlink(enum network_server_invalid_downlink response,
					     uint8_t port, const uint8_t *payload,
					     size_t payload_len);

/**
 * @brief Prepare the server to acknowledge a confirmed uplink.
 *
 * @param tx_attempt Transmission attempt on which to return the acknowledgment.
 * @param port Expected application port.
 * @param payload Expected plaintext payload.
 * @param payload_len Length of the expected payload.
 */
void network_server_prepare_ack(uint32_t tx_attempt, uint8_t port, const uint8_t *payload,
				size_t payload_len);

/**
 * @brief Require the next transmission to use a specific frequency.
 *
 * By default, transmissions are expected on one of the EU868 default
 * channels.
 *
 * @param frequency Expected transmission frequency in Hz.
 */
void network_server_expect_tx_frequency(uint32_t frequency);

/**
 * @brief Require the next application uplink to use a specific datarate.
 *
 * @param datarate Expected LoRaWAN datarate.
 */
void network_server_expect_uplink_datarate(enum lorawan_datarate datarate);

/** @brief Require RX1 to open at the specified delay after transmission. */
void network_server_expect_rx_delay(uint8_t delay_seconds);

/**
 * @brief Get the uptime at which a transmission completed.
 *
 * @param tx_attempt Transmission attempt, starting at 1.
 *
 * @return Uptime in milliseconds.
 */
int64_t network_server_tx_time(uint32_t tx_attempt);

#endif /* TESTS_SUBSYS_LORAWAN_NATIVE_NETWORK_SERVER_H_ */
```

## src/test_common.c
```c
/*
 * Copyright (c) 2026 Embeint Inc
 *
 * SPDX-License-Identifier: Apache-2.0
 */

#include "network_server.h"
#include "test_common.h"
#include "region/test_region.h"

#include <zephyr/drivers/lora/lora_fake.h>
#include <zephyr/kernel.h>
#include <zephyr/lorawan/lorawan.h>
#include <zephyr/ztest.h>

uint8_t app_payload[] = {0xde, 0xad, 0xbe, 0xef};

void lorawan_native_before(void *fixture)
{
	ARG_UNUSED(fixture);

	zassert_ok(lorawan_set_region(test_region_get()->id));
	zassert_ok(lorawan_start());
}

void lorawan_native_after(void *fixture)
{
	ARG_UNUSED(fixture);

	lorawan_stop();
}

void run_successful_join(uint32_t rx_window)
{
	struct lorawan_join_config join_config = network_server_join_config();

	network_server_prepare_join(rx_window);
	zassert_ok(lorawan_join(&join_config));

	zassert_equal(fake_lora_send_async_fake.call_count, 1U);
	zassert_equal(fake_lora_recv_fake.call_count, rx_window);
	zassert_equal(fake_lora_config_fake.call_count, rx_window + 1U);
}

void prepare_send_test(void)
{
	zassert_ok(lorawan_set_conf_msg_tries(1U));
	run_successful_join(1U);
}

/*
 * After a confirmed uplink without ACK, LoRaWAN L2 1.0.4 section 4.3.1.3
 * requires RETRANSMIT_TIMEOUT to elapse after RECEIVE_DELAY2 before any
 * following uplink, whether or not RX2 was opened.
 */
void assert_retransmit_timeout(int64_t tx_time, int64_t next_time)
{
	int64_t elapsed = next_time - tx_time;

	zassert_true(elapsed >= TEST_RX2_DELAY_MS + TEST_RETRANSMIT_TIMEOUT_MIN_MS,
		     "Next uplink allowed %lld ms after TX", elapsed);
	zassert_true(elapsed <= TEST_RX2_DELAY_MS + TEST_RETRANSMIT_TIMEOUT_MAX_MS +
					k_ticks_to_ms_ceil64(1),
		     "Next uplink allowed %lld ms after TX", elapsed);
}

ZTEST(lorawan_native_common, test_errors_before_start)
{
	uint8_t dev_eui[8] = {0};
	uint8_t join_eui[8] = {0};
	uint8_t nwk_key[16] = {0};
	struct lorawan_join_config join_config = {
		.mode = LORAWAN_ACT_OTAA,
		.dev_eui = dev_eui,
		.otaa = {.join_eui = join_eui, .nwk_key = nwk_key},
	};
	uint16_t channels_mask = UINT16_MAX;

	zassert_equal(lorawan_join(&join_config), -EPERM);
	zassert_equal(lorawan_send(APP_PORT, NULL, 0U, LORAWAN_MSG_UNCONFIRMED), -EPERM);
	zassert_equal(lorawan_set_datarate(LORAWAN_DR_5), -EPERM);
	zassert_equal(lorawan_set_conf_msg_tries(1U), -EPERM);
	zassert_equal(lorawan_set_channels_mask(&channels_mask, 1U), -EPERM);
	zassert_equal(lorawan_request_link_check(false), -EPERM);
}

ZTEST_SUITE(lorawan_native_common, NULL, NULL, NULL, NULL, NULL);
```

## src/test_common.h
```c
/*
 * Copyright (c) 2026 Embeint Inc
 *
 * SPDX-License-Identifier: Apache-2.0
 */

#ifndef TESTS_SUBSYS_LORAWAN_NATIVE_TEST_COMMON_H_
#define TESTS_SUBSYS_LORAWAN_NATIVE_TEST_COMMON_H_

#include <stdint.h>

#define APP_PORT 1U

/* RX2 opens RECEIVE_DELAY2 after TX completion with the fixture's RxDelay of 1 s */
#define TEST_RX2_DELAY_MS 2000

/* RETRANSMIT_TIMEOUT is a random delay of 1 to 3 s */
#define TEST_RETRANSMIT_TIMEOUT_MIN_MS 1000
#define TEST_RETRANSMIT_TIMEOUT_MAX_MS 3000

extern uint8_t app_payload[4];

void lorawan_native_before(void *fixture);
void lorawan_native_after(void *fixture);
void run_successful_join(uint32_t rx_window);
void prepare_send_test(void);
void assert_retransmit_timeout(int64_t tx_time, int64_t next_time);

#endif /* TESTS_SUBSYS_LORAWAN_NATIVE_TEST_COMMON_H_ */
```

## src/test_downlink.c
```c
/*
 * Copyright (c) 2026 Embeint Inc
 *
 * SPDX-License-Identifier: Apache-2.0
 */

#include "network_server.h"
#include "test_common.h"

#include <string.h>

#include <zephyr/drivers/lora/lora_fake.h>
#include <zephyr/kernel.h>
#include <zephyr/lorawan/lorawan.h>
#include <zephyr/ztest.h>

static K_SEM_DEFINE(downlink_received, 0, 1);
static uint8_t received_downlink[sizeof(app_payload)];
static uint8_t received_downlink_port;
static uint8_t received_downlink_flags;
static int16_t received_downlink_rssi;
static int8_t received_downlink_snr;
static uint8_t received_downlink_len;

static void application_downlink_callback(uint8_t port, uint8_t flags, int16_t rssi, int8_t snr,
					  uint8_t len, const uint8_t *data)
{
	received_downlink_port = port;
	received_downlink_flags = flags;
	received_downlink_rssi = rssi;
	received_downlink_snr = snr;
	received_downlink_len = len;
	if (len > 0U) {
		memcpy(received_downlink, data, len);
	}
	k_sem_give(&downlink_received);
}

static struct lorawan_downlink_cb application_downlink_cb = {
	.port = APP_PORT,
	.cb = application_downlink_callback,
};

static void prepare_application_downlink_callback(void)
{
	k_sem_reset(&downlink_received);
	received_downlink_len = 0U;
	lorawan_register_downlink_callback(&application_downlink_cb);
}

static void assert_application_downlink_received(uint8_t expected_flags)
{
	zassert_ok(k_sem_take(&downlink_received, K_SECONDS(1)));
	zassert_equal(received_downlink_port, APP_PORT);
	zassert_equal(received_downlink_flags, expected_flags);
	zassert_equal(received_downlink_rssi, -42);
	zassert_equal(received_downlink_snr, 7);
	zassert_equal(received_downlink_len, sizeof(app_payload));
	zassert_mem_equal(received_downlink, app_payload, sizeof(app_payload));
}

ZTEST(lorawan_native_downlink, test_receive_application_rx1)
{
	prepare_send_test();
	prepare_application_downlink_callback();
	network_server_prepare_downlink(1U, APP_PORT, app_payload, sizeof(app_payload));

	zassert_ok(
		lorawan_send(APP_PORT, app_payload, sizeof(app_payload), LORAWAN_MSG_UNCONFIRMED));
	assert_application_downlink_received(0U);
	zassert_equal(fake_lora_recv_fake.call_count, 1U);
}

ZTEST(lorawan_native_downlink, test_receive_application_rx2)
{
	prepare_send_test();
	prepare_application_downlink_callback();
	network_server_prepare_downlink(2U, APP_PORT, app_payload, sizeof(app_payload));

	zassert_ok(
		lorawan_send(APP_PORT, app_payload, sizeof(app_payload), LORAWAN_MSG_UNCONFIRMED));
	assert_application_downlink_received(0U);
	zassert_equal(fake_lora_recv_fake.call_count, 2U);
}

ZTEST(lorawan_native_downlink, test_receive_application_data_pending)
{
	prepare_send_test();
	prepare_application_downlink_callback();
	network_server_prepare_data_pending_downlink(1U, APP_PORT, app_payload,
						    sizeof(app_payload));

	zassert_ok(
		lorawan_send(APP_PORT, app_payload, sizeof(app_payload), LORAWAN_MSG_UNCONFIRMED));
	assert_application_downlink_received(LORAWAN_DATA_PENDING);
}

ZTEST(lorawan_native_downlink, test_acknowledge_confirmed_downlink)
{
	prepare_send_test();
	prepare_application_downlink_callback();
	network_server_prepare_confirmed_downlink(1U, APP_PORT, app_payload, sizeof(app_payload));

	zassert_ok(
		lorawan_send(APP_PORT, app_payload, sizeof(app_payload), LORAWAN_MSG_UNCONFIRMED));
	assert_application_downlink_received(0U);

	/* A confirmed server downlink must set ACK on the next uplink. */
	network_server_prepare_uplink_ack(APP_PORT, app_payload, sizeof(app_payload));
	zassert_ok(
		lorawan_send(APP_PORT, app_payload, sizeof(app_payload), LORAWAN_MSG_UNCONFIRMED));
	zassert_equal(fake_lora_send_async_fake.call_count, 1U);
	zassert_equal(fake_lora_recv_fake.call_count, 2U);
}

ZTEST(lorawan_native_downlink, test_acknowledge_confirmed_downlink_after_retry)
{
	prepare_send_test();
	zassert_ok(lorawan_set_conf_msg_tries(2U));
	prepare_application_downlink_callback();
	network_server_prepare_unacked_downlink(1U, true, APP_PORT, app_payload,
						sizeof(app_payload));

	/* The retransmission reuses the frame built before the confirmed downlink */
	zassert_equal(
		lorawan_send(APP_PORT, app_payload, sizeof(app_payload), LORAWAN_MSG_CONFIRMED),
		-ETIMEDOUT);
	assert_application_downlink_received(0U);
	zassert_equal(fake_lora_send_async_fake.call_count, 2U);
	zassert_equal(fake_lora_recv_fake.call_count, 3U);

	/* That retransmission did not carry the ACK, so the next uplink must */
	network_server_prepare_uplink_ack(APP_PORT, app_payload, sizeof(app_payload));
	zassert_ok(
		lorawan_send(APP_PORT, app_payload, sizeof(app_payload), LORAWAN_MSG_UNCONFIRMED));
	zassert_equal(fake_lora_send_async_fake.call_count, 1U);
}

ZTEST(lorawan_native_downlink, test_invalid_application_downlinks_rejected)
{
	static const enum network_server_invalid_downlink invalid_downlinks[] = {
		NETWORK_SERVER_INVALID_DOWNLINK_WRONG_MHDR,
		NETWORK_SERVER_INVALID_DOWNLINK_UNSUPPORTED_MAJOR,
		NETWORK_SERVER_INVALID_DOWNLINK_SHORT,
		NETWORK_SERVER_INVALID_DOWNLINK_WRONG_DEV_ADDR,
		NETWORK_SERVER_INVALID_DOWNLINK_BAD_MIC,
		NETWORK_SERVER_INVALID_DOWNLINK_BAD_FOPTS_LEN,
	};

	prepare_send_test();
	prepare_application_downlink_callback();
	for (size_t i = 0U; i < ARRAY_SIZE(invalid_downlinks); i++) {
		k_sem_reset(&downlink_received);
		network_server_prepare_invalid_downlink(invalid_downlinks[i], APP_PORT, app_payload,
							sizeof(app_payload));

		zassert_ok(lorawan_send(APP_PORT, app_payload, sizeof(app_payload),
					LORAWAN_MSG_UNCONFIRMED));
		zassert_equal(k_sem_take(&downlink_received, K_MSEC(50)), -EAGAIN);
		zassert_equal(fake_lora_recv_fake.call_count, 2U);
	}
}

ZTEST_SUITE(lorawan_native_downlink, NULL, NULL, lorawan_native_before, lorawan_native_after, NULL);
```

## src/test_join.c
```c
/*
 * Copyright (c) 2026 Embeint Inc
 *
 * SPDX-License-Identifier: Apache-2.0
 */

#include "network_server.h"
#include "test_common.h"
#include "region/test_region.h"

#include <zephyr/drivers/lora/lora_fake.h>
#include <zephyr/lorawan/lorawan.h>
#include <zephyr/ztest.h>

static uint8_t vector_app_payload[] = {
	0x81, 0x05, 0x00, 0x0a, 0x14, 0x03, 0x3e, 0x00, 0x00, 0x00, 0x00,
	0x00, 0x00, 0x0e, 0x7e, 0x09, 0x42, 0x0a, 0x8c, 0x00, 0x00,
};

static void
assert_invalid_join_response_rejected(enum network_server_invalid_join_response response)
{
	struct lorawan_join_config join_config = network_server_join_config();

	network_server_prepare_invalid_join_responses(response);
	zassert_equal(lorawan_join(&join_config), -ETIMEDOUT);
	zassert_equal(fake_lora_send_async_fake.call_count, 1U);
	zassert_equal(fake_lora_recv_fake.call_count, 2U);
	zassert_equal(fake_lora_config_fake.call_count, 3U);
}

ZTEST(lorawan_native_join, test_accept_rx1)
{
	run_successful_join(1U);
}

ZTEST(lorawan_native_join, test_accept_rx2)
{
	run_successful_join(2U);
}

ZTEST(lorawan_native_join, test_accept_rx_delay)
{
	struct lorawan_join_config join_config = network_server_join_config();

	network_server_prepare_join_with_rx_delay(3U);
	zassert_ok(lorawan_join(&join_config));

	network_server_prepare_uplink_no_response(LORAWAN_MSG_UNCONFIRMED, APP_PORT, app_payload,
						  sizeof(app_payload));
	network_server_expect_rx_delay(3U);
	zassert_ok(
		lorawan_send(APP_PORT, app_payload, sizeof(app_payload), LORAWAN_MSG_UNCONFIRMED));
}

ZTEST(lorawan_native_join, test_lorawan_1_0_x_vector)
{
	struct lorawan_join_config join_config = network_server_vector_join_config();

	if (!test_region_get()->has_1_0_x_vector) {
		ztest_test_skip();
	}

	lorawan_enable_adr(true);
	network_server_prepare_vector_join();
	zassert_ok(lorawan_join(&join_config));
	zassert_equal(fake_lora_send_async_fake.call_count, 1U);
	zassert_equal(fake_lora_recv_fake.call_count, 1U);

	/* The hardcoded uplink verifies the derived AppSKey and FNwkSIntKey. */
	network_server_prepare_vector_uplink();
	zassert_ok(lorawan_send(2U, vector_app_payload, sizeof(vector_app_payload),
				LORAWAN_MSG_UNCONFIRMED));

	lorawan_enable_adr(false);
}

ZTEST(lorawan_native_join, test_invalid_response)
{
	struct lorawan_join_config join_config = network_server_join_config();

	network_server_prepare_invalid_join_response();
	zassert_ok(lorawan_join(&join_config));

	zassert_equal(fake_lora_send_async_fake.call_count, 1U);
	zassert_equal(fake_lora_recv_fake.call_count, 2U);
	zassert_equal(fake_lora_config_fake.call_count, 3U);
}

ZTEST(lorawan_native_join, test_invalid_responses_rejected)
{
	static const enum network_server_invalid_join_response invalid_responses[] = {
		NETWORK_SERVER_INVALID_JOIN_RESPONSE_WRONG_MHDR,
		NETWORK_SERVER_INVALID_JOIN_RESPONSE_UNSUPPORTED_MAJOR,
		NETWORK_SERVER_INVALID_JOIN_RESPONSE_EMPTY,
		NETWORK_SERVER_INVALID_JOIN_RESPONSE_SHORT,
		NETWORK_SERVER_INVALID_JOIN_RESPONSE_INTERMEDIATE,
		NETWORK_SERVER_INVALID_JOIN_RESPONSE_OVERSIZE,
		NETWORK_SERVER_INVALID_JOIN_RESPONSE_BAD_CIPHERTEXT,
		NETWORK_SERVER_INVALID_JOIN_RESPONSE_BAD_MIC,
		NETWORK_SERVER_INVALID_JOIN_RESPONSE_INVALID_RX1_OFFSET,
		NETWORK_SERVER_INVALID_JOIN_RESPONSE_INVALID_RX2_DATARATE,
	};

	for (size_t i = 0U; i < ARRAY_SIZE(invalid_responses); i++) {
		assert_invalid_join_response_rejected(invalid_responses[i]);
	}
}

ZTEST(lorawan_native_join, test_accept_with_cflist)
{
	struct lorawan_join_config join_config = network_server_join_config();
	const struct test_region *region = test_region_get();
	uint16_t channel_mask = BIT(region->cflist_first_channel_idx);

	if (region->cflist_frequency_count == 0U) {
		ztest_test_skip();
	}

	network_server_prepare_join_with_cflist(1U);
	zassert_ok(lorawan_join(&join_config));

	zassert_equal(fake_lora_send_async_fake.call_count, 1U);
	zassert_equal(fake_lora_recv_fake.call_count, 1U);
	zassert_equal(fake_lora_config_fake.call_count, 2U);

	/* Request stack to use the first CFLIST channel */
	zassert_ok(lorawan_set_channels_mask(&channel_mask, 1U));
	network_server_prepare_uplink_no_response(LORAWAN_MSG_UNCONFIRMED, APP_PORT, app_payload,
						  sizeof(app_payload));
	network_server_expect_tx_frequency(region->cflist_frequencies[0]);

	zassert_ok(
		lorawan_send(APP_PORT, app_payload, sizeof(app_payload), LORAWAN_MSG_UNCONFIRMED));

	zassert_equal(fake_lora_send_async_fake.call_count, 1U);

	channel_mask = UINT16_MAX;
	zassert_ok(lorawan_set_channels_mask(&channel_mask, 1U));
}

ZTEST(lorawan_native_join, test_no_response)
{
	struct lorawan_join_config join_config = network_server_join_config();

	network_server_prepare_join_no_response();
	zassert_equal(lorawan_join(&join_config), -ETIMEDOUT);
	zassert_equal(fake_lora_send_async_fake.call_count, 1U);
	zassert_equal(fake_lora_recv_fake.call_count, 2U);
}

ZTEST(lorawan_native_join, test_failed_rejoin_leaves_network)
{
	struct lorawan_join_config join_config = network_server_join_config();

	run_successful_join(1U);

	network_server_prepare_join_no_response();
	zassert_equal(lorawan_join(&join_config), -ETIMEDOUT);

	zassert_equal(
		lorawan_send(APP_PORT, app_payload, sizeof(app_payload), LORAWAN_MSG_UNCONFIRMED),
		-ENETDOWN);
	zassert_equal(lorawan_request_link_check(true), -ENETDOWN);
	zassert_equal(fake_lora_send_async_fake.call_count, 1U);
}

ZTEST(lorawan_native_join, test_rejoin_clears_pending_ack)
{
	prepare_send_test();

	/* A confirmed downlink leaves an ACK pending for the next uplink */
	network_server_prepare_confirmed_downlink(1U, APP_PORT, app_payload, sizeof(app_payload));
	zassert_ok(
		lorawan_send(APP_PORT, app_payload, sizeof(app_payload), LORAWAN_MSG_UNCONFIRMED));

	/* The ACK belongs to the previous session and must not be sent in the new one */
	run_successful_join(1U);
	network_server_prepare_uplink_no_response(LORAWAN_MSG_UNCONFIRMED, APP_PORT, app_payload,
						  sizeof(app_payload));
	zassert_ok(
		lorawan_send(APP_PORT, app_payload, sizeof(app_payload), LORAWAN_MSG_UNCONFIRMED));
	zassert_equal(fake_lora_send_async_fake.call_count, 1U);
}

ZTEST(lorawan_native_join, test_rejoin_clears_cflist_channels)
{
	struct lorawan_join_config join_config = network_server_join_config();
	const struct test_region *region = test_region_get();
	uint16_t channel_mask = BIT(region->cflist_first_channel_idx);

	if (region->cflist_frequency_count == 0U) {
		ztest_test_skip();
	}

	network_server_prepare_join_with_cflist(1U);
	zassert_ok(lorawan_join(&join_config));

	/* The second session's CFList disables every slot added by the first */
	network_server_prepare_join_with_empty_cflist(1U);
	zassert_ok(lorawan_join(&join_config));

	/* Selecting only a disabled slot leaves no channel to transmit on */
	zassert_ok(lorawan_set_channels_mask(&channel_mask, 1U));
	network_server_prepare_uplink_no_response(LORAWAN_MSG_UNCONFIRMED, APP_PORT, app_payload,
						  sizeof(app_payload));
	zassert_equal(
		lorawan_send(APP_PORT, app_payload, sizeof(app_payload), LORAWAN_MSG_UNCONFIRMED),
		-ENOENT);
	zassert_equal(fake_lora_send_async_fake.call_count, 0U);

	channel_mask = UINT16_MAX;
	zassert_ok(lorawan_set_channels_mask(&channel_mask, 1U));
}

ZTEST_SUITE(lorawan_native_join, NULL, NULL, lorawan_native_before, lorawan_native_after, NULL);
```

## src/test_uplink.c
```c
/*
 * Copyright (c) 2026 Embeint Inc
 *
 * SPDX-License-Identifier: Apache-2.0
 */

#include "network_server.h"
#include "test_common.h"
#include "region/test_region.h"

#include <zephyr/drivers/lora/lora_fake.h>
#include <zephyr/kernel.h>
#include <zephyr/lorawan/lorawan.h>
#include <zephyr/ztest.h>

ZTEST(lorawan_native_uplink, test_send_unconfirmed)
{
	prepare_send_test();
	network_server_prepare_uplink_no_response(LORAWAN_MSG_UNCONFIRMED, APP_PORT, app_payload,
						  sizeof(app_payload));

	zassert_ok(
		lorawan_send(APP_PORT, app_payload, sizeof(app_payload), LORAWAN_MSG_UNCONFIRMED));
	zassert_equal(fake_lora_send_async_fake.call_count, 1U);
	zassert_equal(fake_lora_recv_fake.call_count, 2U);
	zassert_equal(fake_lora_config_fake.call_count, 3U);

	/* The server fixture expects FCntUp=1 and derives its MIC and ciphertext from it. */
	network_server_prepare_uplink_no_response(LORAWAN_MSG_UNCONFIRMED, APP_PORT, app_payload,
						  sizeof(app_payload));
	zassert_ok(
		lorawan_send(APP_PORT, app_payload, sizeof(app_payload), LORAWAN_MSG_UNCONFIRMED));
	zassert_equal(fake_lora_send_async_fake.call_count, 1U);
	zassert_equal(fake_lora_recv_fake.call_count, 2U);
	zassert_equal(fake_lora_config_fake.call_count, 3U);
}

ZTEST(lorawan_native_uplink, test_send_invalid_message_type)
{
	prepare_send_test();

	zassert_equal(lorawan_send(APP_PORT, app_payload, sizeof(app_payload),
				   (enum lorawan_message_type)2),
		      -EINVAL);
	zassert_equal(fake_lora_send_async_fake.call_count, 1U);
}

ZTEST(lorawan_native_uplink, test_api_returns_error_before_join)
{
	zassert_equal(
		lorawan_send(APP_PORT, app_payload, sizeof(app_payload), LORAWAN_MSG_UNCONFIRMED),
		-ENETDOWN);
	zassert_equal(lorawan_request_link_check(true), -ENETDOWN);
}

ZTEST(lorawan_native_uplink, test_set_datarate_before_join)
{
	enum lorawan_datarate datarate = test_region_get()->test_datarate;

	zassert_ok(lorawan_set_datarate(datarate));
	run_successful_join(1U);

	network_server_prepare_uplink_no_response(LORAWAN_MSG_UNCONFIRMED, APP_PORT, app_payload,
						  sizeof(app_payload));
	network_server_expect_uplink_datarate(datarate);

	zassert_ok(
		lorawan_send(APP_PORT, app_payload, sizeof(app_payload), LORAWAN_MSG_UNCONFIRMED));
}

ZTEST(lorawan_native_uplink, test_set_datarate_after_join)
{
	enum lorawan_datarate datarate = test_region_get()->test_datarate;

	run_successful_join(1U);
	zassert_ok(lorawan_set_datarate(datarate));

	network_server_prepare_uplink_no_response(LORAWAN_MSG_UNCONFIRMED, APP_PORT, app_payload,
						  sizeof(app_payload));
	network_server_expect_uplink_datarate(datarate);

	zassert_ok(
		lorawan_send(APP_PORT, app_payload, sizeof(app_payload), LORAWAN_MSG_UNCONFIRMED));
}

ZTEST(lorawan_native_uplink, test_send_confirmed_acked)
{
	prepare_send_test();
	network_server_prepare_ack(1U, APP_PORT, app_payload, sizeof(app_payload));

	zassert_ok(lorawan_send(APP_PORT, app_payload, sizeof(app_payload), LORAWAN_MSG_CONFIRMED));
	zassert_equal(fake_lora_send_async_fake.call_count, 1U);
	zassert_equal(fake_lora_recv_fake.call_count, 1U);
	zassert_equal(fake_lora_config_fake.call_count, 2U);

	/* No RETRANSMIT_TIMEOUT is required once the ACK has been received */
	zassert_true(k_uptime_get() - network_server_tx_time(1U) < TEST_RX2_DELAY_MS);
}

ZTEST(lorawan_native_uplink, test_send_confirmed_not_acked)
{
	prepare_send_test();
	network_server_prepare_uplink_no_response(LORAWAN_MSG_CONFIRMED, APP_PORT, app_payload,
						  sizeof(app_payload));

	zassert_equal(
		lorawan_send(APP_PORT, app_payload, sizeof(app_payload), LORAWAN_MSG_CONFIRMED),
		-ETIMEDOUT);
	zassert_equal(fake_lora_send_async_fake.call_count, 1U);
	zassert_equal(fake_lora_recv_fake.call_count, 2U);
	zassert_equal(fake_lora_config_fake.call_count, 3U);
	assert_retransmit_timeout(network_server_tx_time(1U), k_uptime_get());
}

ZTEST(lorawan_native_uplink, test_send_confirmed_downlink_without_ack)
{
	prepare_send_test();
	network_server_prepare_unacked_downlink(1U, false, APP_PORT, app_payload,
						sizeof(app_payload));

	/* A valid downlink without ACK closes RX2 but does not acknowledge the uplink */
	zassert_equal(
		lorawan_send(APP_PORT, app_payload, sizeof(app_payload), LORAWAN_MSG_CONFIRMED),
		-ETIMEDOUT);
	zassert_equal(fake_lora_send_async_fake.call_count, 1U);
	zassert_equal(fake_lora_recv_fake.call_count, 1U);
	zassert_equal(fake_lora_config_fake.call_count, 2U);

	/* RETRANSMIT_TIMEOUT still counts from RX2, even though RX2 was not opened */
	assert_retransmit_timeout(network_server_tx_time(1U), k_uptime_get());
}

ZTEST(lorawan_native_uplink, test_send_confirmed_two_tries_downlink_without_ack)
{
	prepare_send_test();
	zassert_ok(lorawan_set_conf_msg_tries(2U));
	network_server_prepare_unacked_downlink(1U, false, APP_PORT, app_payload,
						sizeof(app_payload));

	zassert_equal(
		lorawan_send(APP_PORT, app_payload, sizeof(app_payload), LORAWAN_MSG_CONFIRMED),
		-ETIMEDOUT);
	zassert_equal(fake_lora_send_async_fake.call_count, 2U);
	zassert_equal(fake_lora_recv_fake.call_count, 3U);
	zassert_equal(fake_lora_config_fake.call_count, 5U);
	assert_retransmit_timeout(network_server_tx_time(1U), network_server_tx_time(2U));
	assert_retransmit_timeout(network_server_tx_time(2U), k_uptime_get());
}

ZTEST(lorawan_native_uplink, test_send_confirmed_two_tries_acked_on_first)
{
	prepare_send_test();
	zassert_ok(lorawan_set_conf_msg_tries(2U));
	network_server_prepare_ack(1U, APP_PORT, app_payload, sizeof(app_payload));

	zassert_ok(lorawan_send(APP_PORT, app_payload, sizeof(app_payload), LORAWAN_MSG_CONFIRMED));
	zassert_equal(fake_lora_send_async_fake.call_count, 1U);
	zassert_equal(fake_lora_recv_fake.call_count, 1U);
	zassert_equal(fake_lora_config_fake.call_count, 2U);
}

ZTEST(lorawan_native_uplink, test_send_confirmed_two_tries_acked_on_second)
{
	prepare_send_test();
	zassert_ok(lorawan_set_conf_msg_tries(2U));
	network_server_prepare_ack(2U, APP_PORT, app_payload, sizeof(app_payload));

	zassert_ok(lorawan_send(APP_PORT, app_payload, sizeof(app_payload), LORAWAN_MSG_CONFIRMED));
	zassert_equal(fake_lora_send_async_fake.call_count, 2U);
	zassert_equal(fake_lora_recv_fake.call_count, 3U);
	zassert_equal(fake_lora_config_fake.call_count, 5U);
	assert_retransmit_timeout(network_server_tx_time(1U), network_server_tx_time(2U));
}

ZTEST(lorawan_native_uplink, test_send_confirmed_two_tries_not_acked)
{
	prepare_send_test();
	zassert_ok(lorawan_set_conf_msg_tries(2U));
	network_server_prepare_uplink_no_response(LORAWAN_MSG_CONFIRMED, APP_PORT, app_payload,
						  sizeof(app_payload));

	zassert_equal(
		lorawan_send(APP_PORT, app_payload, sizeof(app_payload), LORAWAN_MSG_CONFIRMED),
		-ETIMEDOUT);
	zassert_equal(fake_lora_send_async_fake.call_count, 2U);
	zassert_equal(fake_lora_recv_fake.call_count, 4U);
	zassert_equal(fake_lora_config_fake.call_count, 6U);
	assert_retransmit_timeout(network_server_tx_time(1U), network_server_tx_time(2U));
	assert_retransmit_timeout(network_server_tx_time(2U), k_uptime_get());
}

ZTEST(lorawan_native_uplink, test_api_returns_error_before_start)
{
	uint8_t dev_eui[8] = {0};
	uint8_t join_eui[8] = {0};
	uint8_t nwk_key[16] = {0};
	struct lorawan_join_config join_config = {
		.mode = LORAWAN_ACT_OTAA,
		.dev_eui = dev_eui,
		.otaa = {.join_eui = join_eui, .nwk_key = nwk_key},
	};
	uint16_t channels_mask = UINT16_MAX;

	lorawan_stop();
	zassert_equal(lorawan_join(&join_config), -EPERM);
	zassert_equal(lorawan_send(APP_PORT, NULL, 0U, LORAWAN_MSG_UNCONFIRMED), -EPERM);
	zassert_equal(lorawan_set_datarate(LORAWAN_DR_5), -EPERM);
	zassert_equal(lorawan_set_conf_msg_tries(1U), -EPERM);
	zassert_equal(lorawan_set_channels_mask(&channels_mask, 1U), -EPERM);
	zassert_equal(lorawan_request_link_check(false), -EPERM);
}

ZTEST_SUITE(lorawan_native_uplink, NULL, NULL, lorawan_native_before, lorawan_native_after, NULL);
```
