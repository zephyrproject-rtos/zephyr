/**
 * Copyright (c) 2026, Basalte bv
 * SPDX-License-Identifier: Apache-2.0
 */

/ {
	bbram0: bbram {
		compatible = "zephyr,bbram-emul";
		size = <0xff>;
		status = "okay";
	};
};

test_nvmem0: &bbram0 {};

#include "common.dtsi"
