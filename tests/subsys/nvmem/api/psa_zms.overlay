/**
 * SPDX-FileCopyrightText: Copyright The Zephyr Project Contributors
 * SPDX-FileCopyrightText: Copyright (c) 2026, Basalte bv
 * SPDX-License-Identifier: Apache-2.0
 */

/ {
	chosen {
		zephyr,secure-storage-its-partition = &storage_partition;
	};
};
