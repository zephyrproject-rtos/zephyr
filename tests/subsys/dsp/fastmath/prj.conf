## CMakeLists.txt
```
# Copyright (c) 2026 James Roy <rruuaanng@gmail.com>
# SPDX-License-Identifier: Apache-2.0

cmake_minimum_required(VERSION 3.20.0)
find_package(Zephyr REQUIRED HINTS $ENV{ZEPHYR_BASE})
project(zdsp_conversions)

target_sources(app PRIVATE src/main.c)
```

## prj.conf
```kconfig
CONFIG_ZTEST=y
CONFIG_REQUIRES_FULL_LIBC=y
CONFIG_DSP=y
CONFIG_CMSIS_DSP=y
CONFIG_CMSIS_DSP_FASTMATH=y
CONFIG_DSP_BACKEND_CMSIS=y
```

## src/main.c
```c
/* Copyright (c) 2026 James Roy <rruuaanng@gmail.com>
 * SPDX-License-Identifier: Apache-2.0
 */

#include <zephyr/dsp/fastmath.h>
#include <zephyr/ztest.h>
#include <string.h>
#include <stdlib.h>

ZTEST(zdsp_fastmath, test_sine_cosine)
{
	float32_t f32 = 0.0f;
	q15_t q15 = 0x0;
	q31_t q31 = 0x0;
	q31_t x = (q31_t)0x0f5c28f0; /* 0.119999997 */

	/* Sine */
	f32 = zdsp_sin_f32(0.119999997f);
	q15 = zdsp_sin_q15(x);
	q31 = zdsp_sin_q31(x);
	zassert_within(f32, 0.119711f, 1e-8f);
	zassert_equal(q15, (q15_t)0x73e0);
	zassert_equal(q31, (q31_t)0x579ed29e);

	/* Cosine */
	f32 = zdsp_cos_f32(0.119999997f);
	q15 = zdsp_cos_q15(x);
	q31 = zdsp_cos_q31(x);
	zassert_within(f32, 0.992796f, 1e-8f);
	zassert_equal(q15, (q15_t)0xffffc9a0);
	zassert_equal(q31, (q31_t)0x5d4e66c0);
}

ZTEST_SUITE(zdsp_fastmath, NULL, NULL, NULL, NULL, NULL);
```
