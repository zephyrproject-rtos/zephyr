## CMakeLists.txt
```
# SPDX-License-Identifier: Apache-2.0

cmake_minimum_required(VERSION 3.28.0)
find_package(Zephyr REQUIRED HINTS $ENV{ZEPHYR_BASE})
project(dsp_conversions)

target_sources(app PRIVATE
  src/q7.c
  src/q15.c
  src/q31.c
  src/f32.c
  src/f64.c
  )

target_include_directories(app PRIVATE ${ZEPHYR_BASE}/tests/lib/cmsis_dsp)
```

## prj.conf
```kconfig
CONFIG_ZTEST=y
CONFIG_DSP=y
CONFIG_DSP_BACKEND_CMSIS=y
CONFIG_CMSIS_DSP=y
CONFIG_CMSIS_DSP_SUPPORT=y
CONFIG_REQUIRES_FLOAT_PRINTF=y
```

## src/f32.c
```c
/*
 * Copyright (C) 2024 OWL Services LLC. All rights reserved.
 *
 * SPDX-License-Identifier: Apache-2.0
 */

#include <stdlib.h>

#include <zephyr/ztest.h>
#include <zephyr/kernel.h>
#include <zephyr/dsp/dsp.h>
#include <zephyr/dsp/utils.h>

#include "common/test_common.h"

#define DEFINE_MULTIPLE_TEST_CASES(constructor, variant, array)                                    \
	FOR_EACH_IDX_FIXED_ARG(constructor, (), variant, array)

#define RE_DEFINE_TEST_VARIANT3(...) DEFINE_TEST_VARIANT3(__VA_ARGS__)

#define DEFINE_SHIFT_F32_CASE(n, args, func)                                                       \
	RE_DEFINE_TEST_VARIANT3(shift_f32, func, n, __DEBRACKET args)

#define TEST_CASES_SHIFT_F32_TO_Q7 (-1.0F, 0, -128), (1.0F, 0, 127), (1.0F, 7, 1), (-1.0F, 7, -1)

#define TEST_CASES_SHIFT_F32_TO_Q15                                                                \
	(-1.0F, 0, -32768), (1.0F, 0, 32767), (1.0F, 15, 1), (-1.0F, 15, -1)

#define TEST_CASES_SHIFT_F32_TO_Q31                                                                \
	(-1.0F, 0, -2147483648), (1.0F, 0, 2147483647), (1.0F, 31, 1), (-1.0F, 31, -1)

static void test_shift_f32_to_q7(const float32_t data, const uint32_t shift,
				 const DSP_DATA q31_t expected)
{
	q7_t shifted_data = zdsp_f32_to_q7_shift(data, shift);

	zassert_equal(shifted_data, expected,
		      "Conversion failed: %f shifted by %d = %d (expected %d)", (double)data, shift,
		      shifted_data, expected);
}

static void test_shift_f32_to_q15(const float32_t data, const uint32_t shift,
				  const DSP_DATA q31_t expected)
{
	q15_t shifted_data = zdsp_f32_to_q15_shift(data, shift);

	zassert_equal(shifted_data, expected,
		      "Conversion failed: %f shifted by %d = %d (expected %d)", (double)data, shift,
		      shifted_data, expected);
}

static void test_shift_f32_to_q31(const float32_t data, const uint32_t shift,
				  const DSP_DATA q31_t expected)
{
	q31_t shifted_data = zdsp_f32_to_q31_shift(data, shift);

	zassert_equal(shifted_data, expected,
		      "Conversion failed: %f shifted by %d = %d (expected %d)", (double)data, shift,
		      shifted_data, expected);
}

DEFINE_MULTIPLE_TEST_CASES(DEFINE_SHIFT_F32_CASE, shift_f32_to_q7, TEST_CASES_SHIFT_F32_TO_Q7)
DEFINE_MULTIPLE_TEST_CASES(DEFINE_SHIFT_F32_CASE, shift_f32_to_q15, TEST_CASES_SHIFT_F32_TO_Q15)
DEFINE_MULTIPLE_TEST_CASES(DEFINE_SHIFT_F32_CASE, shift_f32_to_q31, TEST_CASES_SHIFT_F32_TO_Q31)

ZTEST_SUITE(shift_f32, NULL, NULL, NULL, NULL, NULL);
```

## src/f64.c
```c
/*
 * Copyright (C) 2024 OWL Services LLC. All rights reserved.
 *
 * SPDX-License-Identifier: Apache-2.0
 */

#include <stdlib.h>

#include <zephyr/ztest.h>
#include <zephyr/kernel.h>
#include <zephyr/dsp/dsp.h>
#include <zephyr/dsp/utils.h>

#include "common/test_common.h"

#define DEFINE_MULTIPLE_TEST_CASES(constructor, variant, array)                                    \
	FOR_EACH_IDX_FIXED_ARG(constructor, (), variant, array)

#define RE_DEFINE_TEST_VARIANT3(...) DEFINE_TEST_VARIANT3(__VA_ARGS__)

#define DEFINE_SHIFT_F64_CASE(n, args, func)                                                       \
	RE_DEFINE_TEST_VARIANT3(shift_f64, func, n, __DEBRACKET args)

#define TEST_CASES_SHIFT_F64_TO_Q7 (-1.0, 0, -128), (1.0, 0, 127), (1.0, 7, 1), (-1.0, 7, -1)

#define TEST_CASES_SHIFT_F64_TO_Q15 (-1.0, 0, -32768), (1.0, 0, 32767), (1.0, 15, 1), (-1.0, 15, -1)

#define TEST_CASES_SHIFT_F64_TO_Q31                                                                \
	(-1.0, 0, INT32_MIN), (1.0, 0, INT32_MAX), (1.0, 31, 1), (-1.0, 31, -1)

static void test_shift_f64_to_q7(const float64_t data, const uint32_t shift,
				 const DSP_DATA q7_t expected)
{
	const q7_t shifted_data = zdsp_f64_to_q7_shift(data, shift);

	zassert_equal(shifted_data, expected,
		      "Conversion failed: %f shifted by %d = %d (expected %d)", data, shift,
		      shifted_data, expected);
}

static void test_shift_f64_to_q15(const float64_t data, const uint32_t shift,
				  const DSP_DATA q15_t expected)
{
	const q15_t shifted_data = zdsp_f64_to_q15_shift(data, shift);

	zassert_equal(shifted_data, expected,
		      "Conversion failed: %f shifted by %d = %d (expected %d)", (double)data, shift,
		      shifted_data, expected);
}

static void test_shift_f64_to_q31(const float64_t data, const uint32_t shift,
				  const DSP_DATA q31_t expected)
{
	const q31_t shifted_data = zdsp_f64_to_q31_shift(data, shift);

	zassert_equal(shifted_data, expected,
		      "Conversion failed: %f shifted by %d = %d (expected %d)", (double)data, shift,
		      shifted_data, expected);
}

DEFINE_MULTIPLE_TEST_CASES(DEFINE_SHIFT_F64_CASE, shift_f64_to_q7, TEST_CASES_SHIFT_F64_TO_Q7)
DEFINE_MULTIPLE_TEST_CASES(DEFINE_SHIFT_F64_CASE, shift_f64_to_q15, TEST_CASES_SHIFT_F64_TO_Q15)
DEFINE_MULTIPLE_TEST_CASES(DEFINE_SHIFT_F64_CASE, shift_f64_to_q31, TEST_CASES_SHIFT_F64_TO_Q31)

ZTEST_SUITE(shift_f64, NULL, NULL, NULL, NULL, NULL);
```

## src/q15.c
```c
/*
 * Copyright (C) 2024 OWL Services LLC. All rights reserved.
 *
 * SPDX-License-Identifier: Apache-2.0
 */

#include <stdlib.h>

#include <zephyr/ztest.h>
#include <zephyr/kernel.h>
#include <zephyr/dsp/dsp.h>
#include <zephyr/dsp/utils.h>

#include <common/test_common.h>

#define DEFINE_MULTIPLE_TEST_CASES(constructor, variant, array)                                    \
	FOR_EACH_IDX_FIXED_ARG(constructor, (), variant, array)

#define RE_DEFINE_TEST_VARIANT3(...) DEFINE_TEST_VARIANT3(__VA_ARGS__)

#define DEFINE_SHIFT_Q15_CASE(n, args, func)                                                       \
	RE_DEFINE_TEST_VARIANT3(shift_q15, func, n, __DEBRACKET args)

#define TEST_CORNER_CASES_SHIFT_Q15_TO_F32                                                         \
	(-32768, 0, -1.0F), (32767, 0, 0.999969482421875F), (32767, 15, 32767.0F),                 \
		(-32768, 15, -32768.0F)

#define TEST_CORNER_CASES_SHIFT_Q15_TO_F64                                                         \
	(-32768, 0, -1), (32767, 0, 0.999969482421875), (32767, 15, 32767.0), (-32768, 15, -32768.0)

static void test_shift_q15_to_f32(const q15_t data, const uint32_t shift, const float32_t expected)
{
	const float32_t shifted_data = zdsp_q15_to_f32_shift(data, shift);

	zassert_equal(shifted_data, expected,
		      "Conversion failed: 0x%08x shifted by %d = %f (expected %f)", data, shift,
		      (double)shifted_data, (double)expected);
}

static void test_shift_q15_to_f64(const q15_t data, const uint32_t shift, const float64_t expected)
{
	const float64_t shifted_data = zdsp_q15_to_f64_shift(data, shift);

	zassert_equal(shifted_data, expected,
		      "Conversion failed: 0x%08x shifted by %d = %f (expected %f)", data, shift,
		      shifted_data, expected);
}

DEFINE_MULTIPLE_TEST_CASES(DEFINE_SHIFT_Q15_CASE, shift_q15_to_f32,
			   TEST_CORNER_CASES_SHIFT_Q15_TO_F32)
DEFINE_MULTIPLE_TEST_CASES(DEFINE_SHIFT_Q15_CASE, shift_q15_to_f64,
			   TEST_CORNER_CASES_SHIFT_Q15_TO_F64)

ZTEST_SUITE(shift_q15, NULL, NULL, NULL, NULL, NULL);
```

## src/q31.c
```c
/*
 * Copyright (C) 2024 OWL Services LLC. All rights reserved.
 *
 * SPDX-License-Identifier: Apache-2.0
 */

#include <stdlib.h>

#include <zephyr/ztest.h>
#include <zephyr/kernel.h>
#include <zephyr/dsp/dsp.h>
#include <zephyr/dsp/utils.h>

#include "common/test_common.h"

#define DEFINE_MULTIPLE_TEST_CASES(constructor, variant, array)                                    \
	FOR_EACH_IDX_FIXED_ARG(constructor, (), variant, array)

#define RE_DEFINE_TEST_VARIANT3(...) DEFINE_TEST_VARIANT3(__VA_ARGS__)

#define DEFINE_SHIFT_Q31_CASE(n, args, func)                                                       \
	RE_DEFINE_TEST_VARIANT3(shift_q31, func, n, __DEBRACKET args)

#define TEST_CORNER_CASES_SHIFT_Q31_TO_F32                                                         \
	(2147483647, 0, 1.0F), (-2147483648, 0, -1.0F), (-2147483648, 31, -2147483648.0F),         \
		(2147483647, 31, 2147483647.0F)

#define TEST_CORNER_CASES_SHIFT_Q31_TO_F64                                                         \
	(2147483647, 0, 0.9999999995343387), (-2147483648, 0, -1.0),                               \
		(-2147483648, 31, -2147483648.0), (2147483647, 31, 2147483647.0)

static void test_shift_q31_to_f32(const q31_t data, const uint32_t shift, const float32_t expected)
{
	const float32_t shifted_data = zdsp_q31_to_f32_shift(data, shift);

	zassert_equal(shifted_data, expected,
		      "Conversion failed: 0x%08x shifted by %d = %f (expected %f)", data, shift,
		      (double)shifted_data, (double)expected);
}

static void test_shift_q31_to_f64(const q31_t data, const uint32_t shift, const float64_t expected)
{
	const float64_t shifted_data = zdsp_q31_to_f64_shift(data, shift);

	zassert_equal(shifted_data, expected,
		      "Conversion failed: 0x%08x shifted by %d = %f (expected %f)", data, shift,
		      shifted_data, expected);
}

DEFINE_MULTIPLE_TEST_CASES(DEFINE_SHIFT_Q31_CASE, shift_q31_to_f32,
			   TEST_CORNER_CASES_SHIFT_Q31_TO_F32)
DEFINE_MULTIPLE_TEST_CASES(DEFINE_SHIFT_Q31_CASE, shift_q31_to_f64,
			   TEST_CORNER_CASES_SHIFT_Q31_TO_F64)

ZTEST_SUITE(shift_q31, NULL, NULL, NULL, NULL, NULL);
```

## src/q7.c
```c
/*
 * Copyright (C) 2024 OWL Services LLC. All rights reserved.
 *
 * SPDX-License-Identifier: Apache-2.0
 */

#include <stdlib.h>

#include <zephyr/ztest.h>
#include <zephyr/kernel.h>
#include <zephyr/dsp/dsp.h>
#include <zephyr/dsp/utils.h>

#include "common/test_common.h"

#define DEFINE_MULTIPLE_TEST_CASES(constructor, variant, array)                                    \
	FOR_EACH_IDX_FIXED_ARG(constructor, (), variant, array)

#define RE_DEFINE_TEST_VARIANT3(...) DEFINE_TEST_VARIANT3(__VA_ARGS__)

#define DEFINE_SHIFT_Q7_CASE(n, args, func)                                                        \
	RE_DEFINE_TEST_VARIANT3(shift_q7, func, n, __DEBRACKET args)

#define TEST_CORNER_CASES_SHIFT_Q7_TO_F32                                                          \
	(-128, 0, -1.0F), (127, 0, 0.9921875F), (127, 7, 127.0F), (-128, 7, -128.0F)

#define TEST_CORNER_CASES_SHIFT_Q7_TO_F64                                                          \
	(-128, 0, -1.0), (127, 0, 0.9921875), (127, 7, 127.0), (-128, 7, -128.0)

static void test_shift_q7_to_f32(const q7_t data, const uint32_t shift, const float32_t expected)
{
	const float32_t shifted_data = zdsp_q7_to_f32_shift(data, shift);

	zassert_equal(shifted_data, expected,
		      "Conversion failed: 0x%08x shifted by %d = %f (expected %f)", data, shift,
		      (double)shifted_data, (double)expected);
}

static void test_shift_q7_to_f64(const q7_t data, const uint32_t shift, const float64_t expected)
{
	const float64_t shifted_data = zdsp_q7_to_f64_shift(data, shift);

	zassert_equal(shifted_data, expected,
		      "Conversion failed: 0x%08x shifted by %d = %f (expected %f)", data, shift,
		      shifted_data, expected);
}

DEFINE_MULTIPLE_TEST_CASES(DEFINE_SHIFT_Q7_CASE, shift_q7_to_f32, TEST_CORNER_CASES_SHIFT_Q7_TO_F32)
DEFINE_MULTIPLE_TEST_CASES(DEFINE_SHIFT_Q7_CASE, shift_q7_to_f64, TEST_CORNER_CASES_SHIFT_Q7_TO_F64)

ZTEST_SUITE(shift_q7, NULL, NULL, NULL, NULL, NULL);
```
