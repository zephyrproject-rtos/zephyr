## CMakeLists.txt
```
# SPDX-FileCopyrightText: Copyright The Zephyr Project Contributors
# SPDX-License-Identifier: Apache-2.0

cmake_minimum_required(VERSION 3.20.0)
find_package(Zephyr REQUIRED HINTS $ENV{ZEPHYR_BASE})
project(zdsp_transform)

target_sources(app PRIVATE
  src/cfft_f32.c
  src/cfft_q15.c
  src/cfft_q31.c
  src/rfft_f32.c
  src/rfft_q15.c
  src/rfft_q31.c
  )

target_sources_ifdef(CONFIG_CMSIS_DSP_FLOAT16 app PRIVATE
  src/cfft_f16.c
  src/rfft_f16.c
  )

target_include_directories(app PRIVATE ${ZEPHYR_BASE}/tests/lib/cmsis_dsp)

if(COMPILER STREQUAL arcmwdt)
  get_property(Z_ARC_DSP_OPTIONS GLOBAL PROPERTY z_arc_dsp_options)
  target_compile_options(app PRIVATE ${Z_ARC_DSP_OPTIONS})
endif()
```

## prj.conf
```kconfig
CONFIG_ZTEST=y
CONFIG_REQUIRES_FULL_LIBC=y
CONFIG_DSP=y
CONFIG_CMSIS_DSP=y
CONFIG_DSP_BACKEND_CMSIS=y
```

## src/cfft_f16.c
```c
/*
 * SPDX-FileCopyrightText: Copyright The Zephyr Project Contributors
 *
 * SPDX-License-Identifier: Apache-2.0
 */

#include <zephyr/dsp/dsp.h>
#include <zephyr/ztest.h>
#include <zephyr/kernel.h>
#include <stdlib.h>
#include <string.h>
#include <math.h>
#include "common/test_common.h"

#define TEST_PI                 3.14159265358979323846f
/*
 * Half precision carries an 11 bit significand, so the round trip is checked against a much
 * looser SNR threshold than the f32 transform. A correct transform stays far above this; a
 * broken one (wrong scaling/ordering) collapses to near 0 dB.
 */
#define SNR_ERROR_THRESH        ((float32_t)30)
/* Absolute tolerance on a spectrum whose bins are bounded by fft_len. */
#define BIN_ABS_THRESH(fft_len) (5.0e-2f * (float32_t)(fft_len))

/* Build a deterministic, bounded interleaved complex signal of @p fft_len samples. */
static void build_signal(float16_t *buf, uint16_t fft_len)
{
	for (uint16_t n = 0; n < fft_len; n++) {
		float32_t t = (float32_t)n / (float32_t)fft_len;

		buf[2 * n] = (float16_t)(0.4f * sinf(2.0f * TEST_PI * 3.0f * t) +
					 0.2f * cosf(2.0f * TEST_PI * 7.0f * t));
		buf[2 * n + 1] = (float16_t)(0.3f * sinf(2.0f * TEST_PI * 5.0f * t));
	}
}

/*
 * Forward FFT of a DC (constant real) signal must place the whole signal energy in bin 0
 * (== fft_len, since the forward float transform is unscaled) and leave all other bins at
 * zero.
 */
static void test_zdsp_cfft_f16_dc(uint16_t fft_len)
{
	struct zdsp_cfft_instance_f16 inst;
	float16_t *buf;

	buf = malloc(2 * fft_len * sizeof(float16_t));
	zassert_not_null(buf, ASSERT_MSG_BUFFER_ALLOC_FAILED);

	for (uint16_t n = 0; n < fft_len; n++) {
		buf[2 * n] = (float16_t)1.0f;
		buf[2 * n + 1] = (float16_t)0.0f;
	}

	zassert_equal(zdsp_cfft_init_f16(&inst, fft_len), ZDSP_TRANSFORM_STATUS_OK,
		      ASSERT_MSG_INCORRECT_COMP_RESULT);
	zdsp_cfft_f16(&inst, buf, 0, 1);

	zassert_within((float32_t)buf[0], (float32_t)fft_len, BIN_ABS_THRESH(fft_len),
		       "DC bin (real) incorrect");
	zassert_within((float32_t)buf[1], 0.0f, BIN_ABS_THRESH(fft_len), "DC bin (imag) incorrect");
	for (uint16_t k = 1; k < fft_len; k++) {
		zassert_within((float32_t)buf[2 * k], 0.0f, BIN_ABS_THRESH(fft_len),
			       "non-DC bin (real) not zero");
		zassert_within((float32_t)buf[2 * k + 1], 0.0f, BIN_ABS_THRESH(fft_len),
			       "non-DC bin (imag) not zero");
	}

	free(buf);
}

/*
 * A single complex exponential at bin @c k produces a single non-zero spectral bin. The
 * argmax of the magnitude spectrum must therefore be exactly @c k. This check is
 * independent of any scaling.
 */
static void test_zdsp_cfft_f16_tone(uint16_t fft_len)
{
	struct zdsp_cfft_instance_f16 inst;
	const uint16_t k = 3;
	float16_t *buf;
	float32_t max_mag2 = -1.0f;
	uint16_t max_bin = 0;

	buf = malloc(2 * fft_len * sizeof(float16_t));
	zassert_not_null(buf, ASSERT_MSG_BUFFER_ALLOC_FAILED);

	for (uint16_t n = 0; n < fft_len; n++) {
		float32_t phase = 2.0f * TEST_PI * k * n / fft_len;

		buf[2 * n] = (float16_t)(0.5f * cosf(phase));
		buf[2 * n + 1] = (float16_t)(0.5f * sinf(phase));
	}

	zassert_equal(zdsp_cfft_init_f16(&inst, fft_len), ZDSP_TRANSFORM_STATUS_OK,
		      ASSERT_MSG_INCORRECT_COMP_RESULT);
	zdsp_cfft_f16(&inst, buf, 0, 1);

	for (uint16_t m = 0; m < fft_len; m++) {
		float32_t re = (float32_t)buf[2 * m];
		float32_t im = (float32_t)buf[2 * m + 1];
		float32_t mag2 = re * re + im * im;

		if (mag2 > max_mag2) {
			max_mag2 = mag2;
			max_bin = m;
		}
	}

	zassert_equal(max_bin, k, "spectral peak in wrong bin (got %u, expected %u)", max_bin, k);

	free(buf);
}

/*
 * Forward transform followed by the inverse transform must reconstruct the original
 * signal: the float inverse transform is normalized by 1/fft_len.
 */
static void test_zdsp_cfft_f16_roundtrip(uint16_t fft_len)
{
	struct zdsp_cfft_instance_f16 inst;
	size_t len = 2 * fft_len;
	float16_t *buf;
	float16_t *ref;

	buf = malloc(len * sizeof(float16_t));
	ref = malloc(len * sizeof(float16_t));
	zassert_not_null(buf, ASSERT_MSG_BUFFER_ALLOC_FAILED);
	zassert_not_null(ref, ASSERT_MSG_BUFFER_ALLOC_FAILED);

	build_signal(ref, fft_len);
	memcpy(buf, ref, len * sizeof(float16_t));

	zassert_equal(zdsp_cfft_init_f16(&inst, fft_len), ZDSP_TRANSFORM_STATUS_OK,
		      ASSERT_MSG_INCORRECT_COMP_RESULT);
	zdsp_cfft_f16(&inst, buf, 0, 1); /* forward */
	zdsp_cfft_f16(&inst, buf, 1, 1); /* inverse (normalized by 1/fft_len) */

	zassert_true(test_snr_error_f16(len, buf, ref, SNR_ERROR_THRESH),
		     ASSERT_MSG_SNR_LIMIT_EXCEED);

	free(buf);
	free(ref);
}

#define DEFINE_CFFT_F16_TESTS(len)                                                                 \
	ZTEST(transform_cfft_f16, test_dc_##len)                                                   \
	{                                                                                          \
		test_zdsp_cfft_f16_dc(len);                                                        \
	}                                                                                          \
	ZTEST(transform_cfft_f16, test_tone_##len)                                                 \
	{                                                                                          \
		test_zdsp_cfft_f16_tone(len);                                                      \
	}                                                                                          \
	ZTEST(transform_cfft_f16, test_roundtrip_##len)                                            \
	{                                                                                          \
		test_zdsp_cfft_f16_roundtrip(len);                                                 \
	}

DEFINE_CFFT_F16_TESTS(16)
DEFINE_CFFT_F16_TESTS(32)
DEFINE_CFFT_F16_TESTS(64)
DEFINE_CFFT_F16_TESTS(128)

ZTEST_SUITE(transform_cfft_f16, NULL, NULL, NULL, NULL, NULL);
```

## src/cfft_f32.c
```c
/*
 * SPDX-FileCopyrightText: Copyright The Zephyr Project Contributors
 *
 * SPDX-License-Identifier: Apache-2.0
 */

#include <zephyr/dsp/dsp.h>
#include <zephyr/ztest.h>
#include <zephyr/kernel.h>
#include <stdlib.h>
#include <string.h>
#include <math.h>
#include "common/test_common.h"

#define TEST_PI          3.14159265358979323846f
#define SNR_ERROR_THRESH ((float32_t)100)

/* Build a deterministic, bounded interleaved complex signal of @p fft_len samples. */
static void build_signal(float32_t *buf, uint16_t fft_len)
{
	for (uint16_t n = 0; n < fft_len; n++) {
		float32_t t = (float32_t)n / (float32_t)fft_len;

		buf[2 * n] = 0.4f * sinf(2.0f * TEST_PI * 3.0f * t) +
			     0.2f * cosf(2.0f * TEST_PI * 7.0f * t);
		buf[2 * n + 1] = 0.3f * sinf(2.0f * TEST_PI * 5.0f * t);
	}
}

/*
 * Forward FFT of a DC (constant real) signal must place the whole signal energy in bin 0
 * (== fft_len, since the forward float transform is unscaled) and leave all other bins at
 * zero.
 */
static void test_zdsp_cfft_f32_dc(uint16_t fft_len)
{
	struct zdsp_cfft_instance_f32 inst;
	float32_t *buf;

	buf = malloc(2 * fft_len * sizeof(float32_t));
	zassert_not_null(buf, ASSERT_MSG_BUFFER_ALLOC_FAILED);

	for (uint16_t n = 0; n < fft_len; n++) {
		buf[2 * n] = 1.0f;
		buf[2 * n + 1] = 0.0f;
	}

	zassert_equal(zdsp_cfft_init_f32(&inst, fft_len), ZDSP_TRANSFORM_STATUS_OK,
		      ASSERT_MSG_INCORRECT_COMP_RESULT);
	zdsp_cfft_f32(&inst, buf, 0, 1);

	zassert_within(buf[0], (float32_t)fft_len, 1.0e-2f * fft_len, "DC bin (real) incorrect");
	zassert_within(buf[1], 0.0f, 1.0e-2f * fft_len, "DC bin (imag) incorrect");
	for (uint16_t k = 1; k < fft_len; k++) {
		zassert_within(buf[2 * k], 0.0f, 1.0e-2f * fft_len, "non-DC bin (real) not zero");
		zassert_within(buf[2 * k + 1], 0.0f, 1.0e-2f * fft_len,
			       "non-DC bin (imag) not zero");
	}

	free(buf);
}

/*
 * A single complex exponential at bin @c k produces a single non-zero spectral bin. The
 * argmax of the magnitude spectrum must therefore be exactly @c k. This check is
 * independent of any scaling.
 */
static void test_zdsp_cfft_f32_tone(uint16_t fft_len)
{
	struct zdsp_cfft_instance_f32 inst;
	const uint16_t k = 3;
	float32_t *buf;
	float32_t max_mag2 = -1.0f;
	uint16_t max_bin = 0;

	buf = malloc(2 * fft_len * sizeof(float32_t));
	zassert_not_null(buf, ASSERT_MSG_BUFFER_ALLOC_FAILED);

	for (uint16_t n = 0; n < fft_len; n++) {
		float32_t phase = 2.0f * TEST_PI * k * n / fft_len;

		buf[2 * n] = 0.5f * cosf(phase);
		buf[2 * n + 1] = 0.5f * sinf(phase);
	}

	zassert_equal(zdsp_cfft_init_f32(&inst, fft_len), ZDSP_TRANSFORM_STATUS_OK,
		      ASSERT_MSG_INCORRECT_COMP_RESULT);
	zdsp_cfft_f32(&inst, buf, 0, 1);

	for (uint16_t m = 0; m < fft_len; m++) {
		float32_t mag2 = buf[2 * m] * buf[2 * m] + buf[2 * m + 1] * buf[2 * m + 1];

		if (mag2 > max_mag2) {
			max_mag2 = mag2;
			max_bin = m;
		}
	}

	zassert_equal(max_bin, k, "spectral peak in wrong bin (got %u, expected %u)", max_bin, k);

	free(buf);
}

/*
 * Forward transform followed by the inverse transform must reconstruct the original
 * signal: the float inverse transform is normalized by 1/fft_len.
 */
static void test_zdsp_cfft_f32_roundtrip(uint16_t fft_len)
{
	struct zdsp_cfft_instance_f32 inst;
	size_t len = 2 * fft_len;
	float32_t *buf;
	float32_t *ref;

	buf = malloc(len * sizeof(float32_t));
	ref = malloc(len * sizeof(float32_t));
	zassert_not_null(buf, ASSERT_MSG_BUFFER_ALLOC_FAILED);
	zassert_not_null(ref, ASSERT_MSG_BUFFER_ALLOC_FAILED);

	build_signal(ref, fft_len);
	memcpy(buf, ref, len * sizeof(float32_t));

	zassert_equal(zdsp_cfft_init_f32(&inst, fft_len), ZDSP_TRANSFORM_STATUS_OK,
		      ASSERT_MSG_INCORRECT_COMP_RESULT);
	zdsp_cfft_f32(&inst, buf, 0, 1); /* forward */
	zdsp_cfft_f32(&inst, buf, 1, 1); /* inverse (normalized by 1/fft_len) */

	zassert_true(test_snr_error_f32(len, buf, ref, SNR_ERROR_THRESH),
		     ASSERT_MSG_SNR_LIMIT_EXCEED);

	free(buf);
	free(ref);
}

#define DEFINE_CFFT_F32_TESTS(len)                                                                 \
	ZTEST(transform_cfft_f32, test_dc_##len)                                                   \
	{                                                                                          \
		test_zdsp_cfft_f32_dc(len);                                                        \
	}                                                                                          \
	ZTEST(transform_cfft_f32, test_tone_##len)                                                 \
	{                                                                                          \
		test_zdsp_cfft_f32_tone(len);                                                      \
	}                                                                                          \
	ZTEST(transform_cfft_f32, test_roundtrip_##len)                                            \
	{                                                                                          \
		test_zdsp_cfft_f32_roundtrip(len);                                                 \
	}

DEFINE_CFFT_F32_TESTS(16)
DEFINE_CFFT_F32_TESTS(32)
DEFINE_CFFT_F32_TESTS(64)
DEFINE_CFFT_F32_TESTS(128)

ZTEST_SUITE(transform_cfft_f32, NULL, NULL, NULL, NULL, NULL);
```

## src/cfft_q15.c
```c
/*
 * SPDX-FileCopyrightText: Copyright The Zephyr Project Contributors
 *
 * SPDX-License-Identifier: Apache-2.0
 */

#include <zephyr/dsp/dsp.h>
#include <zephyr/dsp/utils.h>
#include <zephyr/ztest.h>
#include <zephyr/kernel.h>
#include <stdlib.h>
#include <string.h>
#include <math.h>
#include <stdint.h>
#include "common/test_common.h"

#define TEST_PI          3.14159265358979323846f
/*
 * The Q15 transform is computed in fixed point with per-stage downscaling, so a moderate
 * SNR threshold is used when cross-checking against the (trusted) f32 transform. A correct
 * transform comfortably exceeds this; a broken one (wrong scaling/ordering) collapses to
 * near 0 dB.
 */
#define SNR_ERROR_THRESH ((float32_t)20)
#define DC_ABS_THRESH    ((q15_t)200)

/*
 * A DC (constant real) input must, after the 1/fft_len forward scaling, leave bin 0 equal
 * to the input value and all other bins near zero.
 */
static void test_zdsp_cfft_q15_dc(uint16_t fft_len)
{
	struct zdsp_cfft_instance_q15 inst;
	const q15_t dc = 0x4000; /* 0.5 in Q1.15 */
	q15_t *buf;

	buf = malloc(2 * fft_len * sizeof(q15_t));
	zassert_not_null(buf, ASSERT_MSG_BUFFER_ALLOC_FAILED);

	for (uint16_t n = 0; n < fft_len; n++) {
		buf[2 * n] = dc;
		buf[2 * n + 1] = 0;
	}

	zassert_equal(zdsp_cfft_init_q15(&inst, fft_len), ZDSP_TRANSFORM_STATUS_OK,
		      ASSERT_MSG_INCORRECT_COMP_RESULT);
	zdsp_cfft_q15(&inst, buf, 0, 1);

	zassert_within(buf[0], dc, DC_ABS_THRESH, "DC bin (real) incorrect");
	zassert_within(buf[1], 0, DC_ABS_THRESH, "DC bin (imag) incorrect");
	for (uint16_t k = 1; k < fft_len; k++) {
		zassert_within(buf[2 * k], 0, DC_ABS_THRESH, "non-DC bin (real) not zero");
		zassert_within(buf[2 * k + 1], 0, DC_ABS_THRESH, "non-DC bin (imag) not zero");
	}

	free(buf);
}

/*
 * A single complex exponential at bin @c k produces a single non-zero bin. The argmax of
 * the magnitude spectrum must be exactly @c k, independent of fixed-point scaling.
 */
static void test_zdsp_cfft_q15_tone(uint16_t fft_len)
{
	struct zdsp_cfft_instance_q15 inst;
	const uint16_t k = 2;
	q15_t *buf;
	int64_t max_mag2 = -1;
	uint16_t max_bin = 0;

	buf = malloc(2 * fft_len * sizeof(q15_t));
	zassert_not_null(buf, ASSERT_MSG_BUFFER_ALLOC_FAILED);

	for (uint16_t n = 0; n < fft_len; n++) {
		float32_t phase = 2.0f * TEST_PI * k * n / fft_len;

		buf[2 * n] = zdsp_f32_to_q15_shift(0.4f * cosf(phase), 0);
		buf[2 * n + 1] = zdsp_f32_to_q15_shift(0.4f * sinf(phase), 0);
	}

	zassert_equal(zdsp_cfft_init_q15(&inst, fft_len), ZDSP_TRANSFORM_STATUS_OK,
		      ASSERT_MSG_INCORRECT_COMP_RESULT);
	zdsp_cfft_q15(&inst, buf, 0, 1);

	for (uint16_t m = 0; m < fft_len; m++) {
		int64_t re = buf[2 * m];
		int64_t im = buf[2 * m + 1];
		int64_t mag2 = re * re + im * im;

		if (mag2 > max_mag2) {
			max_mag2 = mag2;
			max_bin = m;
		}
	}

	zassert_equal(max_bin, k, "spectral peak in wrong bin (got %u, expected %u)", max_bin, k);

	free(buf);
}

/*
 * Cross-check the Q15 forward transform against the f32 transform on the same signal. The
 * Q15 forward transform is downscaled by 1/fft_len, so the f32 reference is divided by
 * fft_len before comparison.
 */
static void test_zdsp_cfft_q15_vs_f32(uint16_t fft_len)
{
	struct zdsp_cfft_instance_q15 inst_q15;
	struct zdsp_cfft_instance_f32 inst_f32;
	size_t len = 2 * fft_len;
	q15_t *qbuf;
	float32_t *fbuf;
	float32_t *qout;
	float32_t *ref;

	qbuf = malloc(len * sizeof(q15_t));
	fbuf = malloc(len * sizeof(float32_t));
	qout = malloc(len * sizeof(float32_t));
	ref = malloc(len * sizeof(float32_t));
	zassert_not_null(qbuf, ASSERT_MSG_BUFFER_ALLOC_FAILED);
	zassert_not_null(fbuf, ASSERT_MSG_BUFFER_ALLOC_FAILED);
	zassert_not_null(qout, ASSERT_MSG_BUFFER_ALLOC_FAILED);
	zassert_not_null(ref, ASSERT_MSG_BUFFER_ALLOC_FAILED);

	for (uint16_t n = 0; n < fft_len; n++) {
		float32_t t = (float32_t)n / (float32_t)fft_len;
		float32_t re = 0.3f * sinf(2.0f * TEST_PI * 3.0f * t) +
			       0.1f * cosf(2.0f * TEST_PI * 6.0f * t);
		float32_t im = 0.2f * sinf(2.0f * TEST_PI * 4.0f * t);

		fbuf[2 * n] = re;
		fbuf[2 * n + 1] = im;
		qbuf[2 * n] = zdsp_f32_to_q15_shift(re, 0);
		qbuf[2 * n + 1] = zdsp_f32_to_q15_shift(im, 0);
	}

	zassert_equal(zdsp_cfft_init_q15(&inst_q15, fft_len), ZDSP_TRANSFORM_STATUS_OK,
		      ASSERT_MSG_INCORRECT_COMP_RESULT);
	zassert_equal(zdsp_cfft_init_f32(&inst_f32, fft_len), ZDSP_TRANSFORM_STATUS_OK,
		      ASSERT_MSG_INCORRECT_COMP_RESULT);

	zdsp_cfft_q15(&inst_q15, qbuf, 0, 1);
	zdsp_cfft_f32(&inst_f32, fbuf, 0, 1);

	for (size_t i = 0; i < len; i++) {
		qout[i] = (float32_t)qbuf[i] / 32768.0f;
		ref[i] = fbuf[i] / (float32_t)fft_len;
	}

	zassert_true(test_snr_error_f32(len, qout, ref, SNR_ERROR_THRESH),
		     ASSERT_MSG_SNR_LIMIT_EXCEED);

	free(qbuf);
	free(fbuf);
	free(qout);
	free(ref);
}

#define DEFINE_CFFT_Q15_TESTS(len)                                                                 \
	ZTEST(transform_cfft_q15, test_dc_##len)                                                   \
	{                                                                                          \
		test_zdsp_cfft_q15_dc(len);                                                        \
	}                                                                                          \
	ZTEST(transform_cfft_q15, test_tone_##len)                                                 \
	{                                                                                          \
		test_zdsp_cfft_q15_tone(len);                                                      \
	}                                                                                          \
	ZTEST(transform_cfft_q15, test_vs_f32_##len)                                               \
	{                                                                                          \
		test_zdsp_cfft_q15_vs_f32(len);                                                    \
	}

DEFINE_CFFT_Q15_TESTS(16)
DEFINE_CFFT_Q15_TESTS(32)
DEFINE_CFFT_Q15_TESTS(64)
DEFINE_CFFT_Q15_TESTS(128)

ZTEST_SUITE(transform_cfft_q15, NULL, NULL, NULL, NULL, NULL);
```

## src/cfft_q31.c
```c
/*
 * SPDX-FileCopyrightText: Copyright The Zephyr Project Contributors
 *
 * SPDX-License-Identifier: Apache-2.0
 */

#include <zephyr/dsp/dsp.h>
#include <zephyr/dsp/utils.h>
#include <zephyr/ztest.h>
#include <zephyr/kernel.h>
#include <stdlib.h>
#include <string.h>
#include <math.h>
#include <stdint.h>
#include "common/test_common.h"

#define TEST_PI          3.14159265358979323846f
/*
 * The Q31 transform is computed in fixed point with per-stage downscaling, so a moderate
 * SNR threshold is used when cross-checking against the (trusted) f32 transform. A correct
 * transform comfortably exceeds this; a broken one (wrong scaling/ordering) collapses to
 * near 0 dB.
 */
#define SNR_ERROR_THRESH ((float32_t)60)
/* Same relative tolerance as the Q15 test: 200 LSB at the Q15 scale. */
#define DC_ABS_THRESH    ((q31_t)(200 * 65536))

/*
 * A DC (constant real) input must, after the 1/fft_len forward scaling, leave bin 0 equal
 * to the input value and all other bins near zero.
 */
static void test_zdsp_cfft_q31_dc(uint16_t fft_len)
{
	struct zdsp_cfft_instance_q31 inst;
	const q31_t dc = 0x40000000; /* 0.5 in Q1.31 */
	q31_t *buf;

	buf = malloc(2 * fft_len * sizeof(q31_t));
	zassert_not_null(buf, ASSERT_MSG_BUFFER_ALLOC_FAILED);

	for (uint16_t n = 0; n < fft_len; n++) {
		buf[2 * n] = dc;
		buf[2 * n + 1] = 0;
	}

	zassert_equal(zdsp_cfft_init_q31(&inst, fft_len), ZDSP_TRANSFORM_STATUS_OK,
		      ASSERT_MSG_INCORRECT_COMP_RESULT);
	zdsp_cfft_q31(&inst, buf, 0, 1);

	zassert_within(buf[0], dc, DC_ABS_THRESH, "DC bin (real) incorrect");
	zassert_within(buf[1], 0, DC_ABS_THRESH, "DC bin (imag) incorrect");
	for (uint16_t k = 1; k < fft_len; k++) {
		zassert_within(buf[2 * k], 0, DC_ABS_THRESH, "non-DC bin (real) not zero");
		zassert_within(buf[2 * k + 1], 0, DC_ABS_THRESH, "non-DC bin (imag) not zero");
	}

	free(buf);
}

/*
 * A single complex exponential at bin @c k produces a single non-zero bin. The argmax of
 * the magnitude spectrum must be exactly @c k, independent of fixed-point scaling.
 */
static void test_zdsp_cfft_q31_tone(uint16_t fft_len)
{
	struct zdsp_cfft_instance_q31 inst;
	const uint16_t k = 2;
	q31_t *buf;
	uint64_t max_mag2 = 0;
	uint16_t max_bin = 0;

	buf = malloc(2 * fft_len * sizeof(q31_t));
	zassert_not_null(buf, ASSERT_MSG_BUFFER_ALLOC_FAILED);

	for (uint16_t n = 0; n < fft_len; n++) {
		float32_t phase = 2.0f * TEST_PI * k * n / fft_len;

		buf[2 * n] = zdsp_f32_to_q31_shift(0.4f * cosf(phase), 0);
		buf[2 * n + 1] = zdsp_f32_to_q31_shift(0.4f * sinf(phase), 0);
	}

	zassert_equal(zdsp_cfft_init_q31(&inst, fft_len), ZDSP_TRANSFORM_STATUS_OK,
		      ASSERT_MSG_INCORRECT_COMP_RESULT);
	zdsp_cfft_q31(&inst, buf, 0, 1);

	/* Squares of two Q31 values sum to at most 2^63, so accumulate unsigned. */
	for (uint16_t m = 0; m < fft_len; m++) {
		int64_t re = buf[2 * m];
		int64_t im = buf[2 * m + 1];
		uint64_t mag2 = (uint64_t)(re * re) + (uint64_t)(im * im);

		if (mag2 > max_mag2) {
			max_mag2 = mag2;
			max_bin = m;
		}
	}

	zassert_equal(max_bin, k, "spectral peak in wrong bin (got %u, expected %u)", max_bin, k);

	free(buf);
}

/*
 * Cross-check the Q31 forward transform against the f32 transform on the same signal. The
 * Q31 forward transform is downscaled by 1/fft_len, so the f32 reference is divided by
 * fft_len before comparison.
 */
static void test_zdsp_cfft_q31_vs_f32(uint16_t fft_len)
{
	struct zdsp_cfft_instance_q31 inst_q31;
	struct zdsp_cfft_instance_f32 inst_f32;
	size_t len = 2 * fft_len;
	q31_t *qbuf;
	float32_t *fbuf;
	float32_t *qout;
	float32_t *ref;

	qbuf = malloc(len * sizeof(q31_t));
	fbuf = malloc(len * sizeof(float32_t));
	qout = malloc(len * sizeof(float32_t));
	ref = malloc(len * sizeof(float32_t));
	zassert_not_null(qbuf, ASSERT_MSG_BUFFER_ALLOC_FAILED);
	zassert_not_null(fbuf, ASSERT_MSG_BUFFER_ALLOC_FAILED);
	zassert_not_null(qout, ASSERT_MSG_BUFFER_ALLOC_FAILED);
	zassert_not_null(ref, ASSERT_MSG_BUFFER_ALLOC_FAILED);

	for (uint16_t n = 0; n < fft_len; n++) {
		float32_t t = (float32_t)n / (float32_t)fft_len;
		float32_t re = 0.3f * sinf(2.0f * TEST_PI * 3.0f * t) +
			       0.1f * cosf(2.0f * TEST_PI * 6.0f * t);
		float32_t im = 0.2f * sinf(2.0f * TEST_PI * 4.0f * t);

		fbuf[2 * n] = re;
		fbuf[2 * n + 1] = im;
		qbuf[2 * n] = zdsp_f32_to_q31_shift(re, 0);
		qbuf[2 * n + 1] = zdsp_f32_to_q31_shift(im, 0);
	}

	zassert_equal(zdsp_cfft_init_q31(&inst_q31, fft_len), ZDSP_TRANSFORM_STATUS_OK,
		      ASSERT_MSG_INCORRECT_COMP_RESULT);
	zassert_equal(zdsp_cfft_init_f32(&inst_f32, fft_len), ZDSP_TRANSFORM_STATUS_OK,
		      ASSERT_MSG_INCORRECT_COMP_RESULT);

	zdsp_cfft_q31(&inst_q31, qbuf, 0, 1);
	zdsp_cfft_f32(&inst_f32, fbuf, 0, 1);

	for (size_t i = 0; i < len; i++) {
		qout[i] = (float32_t)qbuf[i] / 2147483648.0f;
		ref[i] = fbuf[i] / (float32_t)fft_len;
	}

	zassert_true(test_snr_error_f32(len, qout, ref, SNR_ERROR_THRESH),
		     ASSERT_MSG_SNR_LIMIT_EXCEED);

	free(qbuf);
	free(fbuf);
	free(qout);
	free(ref);
}

/*
 * Forward transform followed by the inverse transform returns the input downscaled by
 * 1/fft_len: the inverse is normalized like the f32 one, but it is applied to a spectrum the
 * forward transform has already downscaled by 1/fft_len.
 */
static void test_zdsp_cfft_q31_roundtrip(uint16_t fft_len)
{
	struct zdsp_cfft_instance_q31 inst;
	size_t len = 2 * fft_len;
	q31_t *buf;
	float32_t *out;
	float32_t *ref;

	buf = malloc(len * sizeof(q31_t));
	out = malloc(len * sizeof(float32_t));
	ref = malloc(len * sizeof(float32_t));
	zassert_not_null(buf, ASSERT_MSG_BUFFER_ALLOC_FAILED);
	zassert_not_null(out, ASSERT_MSG_BUFFER_ALLOC_FAILED);
	zassert_not_null(ref, ASSERT_MSG_BUFFER_ALLOC_FAILED);

	for (uint16_t n = 0; n < fft_len; n++) {
		float32_t t = (float32_t)n / (float32_t)fft_len;
		float32_t re = 0.3f * sinf(2.0f * TEST_PI * 3.0f * t) +
			       0.1f * cosf(2.0f * TEST_PI * 6.0f * t);
		float32_t im = 0.2f * sinf(2.0f * TEST_PI * 4.0f * t);

		buf[2 * n] = zdsp_f32_to_q31_shift(re, 0);
		buf[2 * n + 1] = zdsp_f32_to_q31_shift(im, 0);
	}
	for (size_t i = 0; i < len; i++) {
		ref[i] = (float32_t)buf[i] / 2147483648.0f;
	}

	zassert_equal(zdsp_cfft_init_q31(&inst, fft_len), ZDSP_TRANSFORM_STATUS_OK,
		      ASSERT_MSG_INCORRECT_COMP_RESULT);

	zdsp_cfft_q31(&inst, buf, 0, 1);
	zdsp_cfft_q31(&inst, buf, 1, 1);

	for (size_t i = 0; i < len; i++) {
		out[i] = (float32_t)buf[i] * (float32_t)fft_len / 2147483648.0f;
	}

	zassert_true(test_snr_error_f32(len, out, ref, SNR_ERROR_THRESH),
		     ASSERT_MSG_SNR_LIMIT_EXCEED);

	free(buf);
	free(out);
	free(ref);
}

#define DEFINE_CFFT_Q31_TESTS(len)                                                                 \
	ZTEST(transform_cfft_q31, test_dc_##len)                                                   \
	{                                                                                          \
		test_zdsp_cfft_q31_dc(len);                                                        \
	}                                                                                          \
	ZTEST(transform_cfft_q31, test_tone_##len)                                                 \
	{                                                                                          \
		test_zdsp_cfft_q31_tone(len);                                                      \
	}                                                                                          \
	ZTEST(transform_cfft_q31, test_vs_f32_##len)                                               \
	{                                                                                          \
		test_zdsp_cfft_q31_vs_f32(len);                                                    \
	}                                                                                          \
	ZTEST(transform_cfft_q31, test_roundtrip_##len)                                            \
	{                                                                                          \
		test_zdsp_cfft_q31_roundtrip(len);                                                 \
	}

DEFINE_CFFT_Q31_TESTS(16)
DEFINE_CFFT_Q31_TESTS(32)
DEFINE_CFFT_Q31_TESTS(64)
DEFINE_CFFT_Q31_TESTS(128)

ZTEST_SUITE(transform_cfft_q31, NULL, NULL, NULL, NULL, NULL);
```

## src/rfft_f16.c
```c
/*
 * SPDX-FileCopyrightText: Copyright The Zephyr Project Contributors
 *
 * SPDX-License-Identifier: Apache-2.0
 */

#include <zephyr/dsp/dsp.h>
#include <zephyr/ztest.h>
#include <zephyr/kernel.h>
#include <stdlib.h>
#include <string.h>
#include <math.h>
#include "common/test_common.h"

#define TEST_PI                 3.14159265358979323846f
/*
 * Half precision carries an 11 bit significand, so the round trip is checked against a much
 * looser SNR threshold than the f32 transform. A correct transform stays far above this; a
 * broken one (wrong scaling/ordering) collapses to near 0 dB.
 */
#define SNR_ERROR_THRESH        ((float32_t)30)
/* Absolute tolerance on a spectrum whose bins are bounded by fft_len. */
#define BIN_ABS_THRESH(fft_len) (5.0e-2f * (float32_t)(fft_len))

static void build_signal(float16_t *buf, uint16_t fft_len)
{
	for (uint16_t n = 0; n < fft_len; n++) {
		float32_t t = (float32_t)n / (float32_t)fft_len;

		buf[n] = (float16_t)(0.4f * sinf(2.0f * TEST_PI * 3.0f * t) +
				     0.2f * cosf(2.0f * TEST_PI * 9.0f * t) +
				     0.1f * sinf(2.0f * TEST_PI * 13.0f * t));
	}
}

/*
 * Forward real FFT of a DC (constant) signal: the packed output stores the DC term in
 * element 0 and the Nyquist term in element 1. Only the DC term is non-zero (== fft_len,
 * the float forward transform is unscaled).
 */
static void test_zdsp_rfft_fast_f16_dc(uint16_t fft_len)
{
	struct zdsp_rfft_fast_instance_f16 inst;
	float16_t *in;
	float16_t *out;

	in = malloc(fft_len * sizeof(float16_t));
	out = calloc(fft_len + 2, sizeof(float16_t));
	zassert_not_null(in, ASSERT_MSG_BUFFER_ALLOC_FAILED);
	zassert_not_null(out, ASSERT_MSG_BUFFER_ALLOC_FAILED);

	for (uint16_t n = 0; n < fft_len; n++) {
		in[n] = (float16_t)1.0f;
	}

	zassert_equal(zdsp_rfft_fast_init_f16(&inst, fft_len), ZDSP_TRANSFORM_STATUS_OK,
		      ASSERT_MSG_INCORRECT_COMP_RESULT);
	zdsp_rfft_fast_f16(&inst, in, out, 0);

	zassert_within((float32_t)out[0], (float32_t)fft_len, BIN_ABS_THRESH(fft_len),
		       "DC term incorrect");
	zassert_within((float32_t)out[1], 0.0f, BIN_ABS_THRESH(fft_len), "Nyquist term not zero");
	for (uint16_t k = 2; k < fft_len; k++) {
		zassert_within((float32_t)out[k], 0.0f, BIN_ABS_THRESH(fft_len),
			       "non-DC bin not zero");
	}

	free(in);
	free(out);
}

/*
 * Forward transform followed by inverse transform reconstructs the original signal (the
 * float inverse real FFT is normalized by 1/fft_len). The transform functions modify their
 * input buffers, so working copies are used.
 */
static void test_zdsp_rfft_fast_f16_roundtrip(uint16_t fft_len)
{
	struct zdsp_rfft_fast_instance_f16 inst;
	float16_t *sig;
	float16_t *work;
	float16_t *spec;
	float16_t *recon;

	sig = malloc(fft_len * sizeof(float16_t));
	work = malloc(fft_len * sizeof(float16_t));
	spec = calloc(fft_len + 2, sizeof(float16_t));
	recon = malloc(fft_len * sizeof(float16_t));
	zassert_not_null(sig, ASSERT_MSG_BUFFER_ALLOC_FAILED);
	zassert_not_null(work, ASSERT_MSG_BUFFER_ALLOC_FAILED);
	zassert_not_null(spec, ASSERT_MSG_BUFFER_ALLOC_FAILED);
	zassert_not_null(recon, ASSERT_MSG_BUFFER_ALLOC_FAILED);

	build_signal(sig, fft_len);
	memcpy(work, sig, fft_len * sizeof(float16_t));

	zassert_equal(zdsp_rfft_fast_init_f16(&inst, fft_len), ZDSP_TRANSFORM_STATUS_OK,
		      ASSERT_MSG_INCORRECT_COMP_RESULT);
	zdsp_rfft_fast_f16(&inst, work, spec, 0);  /* forward */
	zdsp_rfft_fast_f16(&inst, spec, recon, 1); /* inverse (normalized by 1/fft_len) */

	zassert_true(test_snr_error_f16(fft_len, recon, sig, SNR_ERROR_THRESH),
		     ASSERT_MSG_SNR_LIMIT_EXCEED);

	free(sig);
	free(work);
	free(spec);
	free(recon);
}

#define DEFINE_RFFT_F16_TESTS(len)                                                                 \
	ZTEST(transform_rfft_f16, test_dc_##len)                                                   \
	{                                                                                          \
		test_zdsp_rfft_fast_f16_dc(len);                                                   \
	}                                                                                          \
	ZTEST(transform_rfft_f16, test_roundtrip_##len)                                            \
	{                                                                                          \
		test_zdsp_rfft_fast_f16_roundtrip(len);                                            \
	}

DEFINE_RFFT_F16_TESTS(32)
DEFINE_RFFT_F16_TESTS(64)
DEFINE_RFFT_F16_TESTS(128)
DEFINE_RFFT_F16_TESTS(256)

ZTEST_SUITE(transform_rfft_f16, NULL, NULL, NULL, NULL, NULL);
```

## src/rfft_f32.c
```c
/*
 * SPDX-FileCopyrightText: Copyright The Zephyr Project Contributors
 *
 * SPDX-License-Identifier: Apache-2.0
 */

#include <zephyr/dsp/dsp.h>
#include <zephyr/ztest.h>
#include <zephyr/kernel.h>
#include <stdlib.h>
#include <string.h>
#include <math.h>
#include "common/test_common.h"

#define TEST_PI          3.14159265358979323846f
#define SNR_ERROR_THRESH ((float32_t)100)

static void build_signal(float32_t *buf, uint16_t fft_len)
{
	for (uint16_t n = 0; n < fft_len; n++) {
		float32_t t = (float32_t)n / (float32_t)fft_len;

		buf[n] = 0.4f * sinf(2.0f * TEST_PI * 3.0f * t) +
			 0.2f * cosf(2.0f * TEST_PI * 9.0f * t) +
			 0.1f * sinf(2.0f * TEST_PI * 13.0f * t);
	}
}

/*
 * Forward real FFT of a DC (constant) signal: the packed output stores the DC term in
 * element 0 and the Nyquist term in element 1. Only the DC term is non-zero (== fft_len,
 * the float forward transform is unscaled).
 */
static void test_zdsp_rfft_fast_f32_dc(uint16_t fft_len)
{
	struct zdsp_rfft_fast_instance_f32 inst;
	float32_t *in;
	float32_t *out;

	in = malloc(fft_len * sizeof(float32_t));
	out = calloc(fft_len + 2, sizeof(float32_t));
	zassert_not_null(in, ASSERT_MSG_BUFFER_ALLOC_FAILED);
	zassert_not_null(out, ASSERT_MSG_BUFFER_ALLOC_FAILED);

	for (uint16_t n = 0; n < fft_len; n++) {
		in[n] = 1.0f;
	}

	zassert_equal(zdsp_rfft_fast_init_f32(&inst, fft_len), ZDSP_TRANSFORM_STATUS_OK,
		      ASSERT_MSG_INCORRECT_COMP_RESULT);
	zdsp_rfft_fast_f32(&inst, in, out, 0);

	zassert_within(out[0], (float32_t)fft_len, 1.0e-2f * fft_len, "DC term incorrect");
	zassert_within(out[1], 0.0f, 1.0e-2f * fft_len, "Nyquist term not zero");
	for (uint16_t k = 2; k < fft_len; k++) {
		zassert_within(out[k], 0.0f, 1.0e-2f * fft_len, "non-DC bin not zero");
	}

	free(in);
	free(out);
}

/*
 * Forward transform followed by inverse transform reconstructs the original signal (the
 * float inverse real FFT is normalized by 1/fft_len). The transform functions modify their
 * input buffers, so working copies are used.
 */
static void test_zdsp_rfft_fast_f32_roundtrip(uint16_t fft_len)
{
	struct zdsp_rfft_fast_instance_f32 inst;
	float32_t *sig;
	float32_t *work;
	float32_t *spec;
	float32_t *recon;

	sig = malloc(fft_len * sizeof(float32_t));
	work = malloc(fft_len * sizeof(float32_t));
	spec = calloc(fft_len + 2, sizeof(float32_t));
	recon = malloc(fft_len * sizeof(float32_t));
	zassert_not_null(sig, ASSERT_MSG_BUFFER_ALLOC_FAILED);
	zassert_not_null(work, ASSERT_MSG_BUFFER_ALLOC_FAILED);
	zassert_not_null(spec, ASSERT_MSG_BUFFER_ALLOC_FAILED);
	zassert_not_null(recon, ASSERT_MSG_BUFFER_ALLOC_FAILED);

	build_signal(sig, fft_len);
	memcpy(work, sig, fft_len * sizeof(float32_t));

	zassert_equal(zdsp_rfft_fast_init_f32(&inst, fft_len), ZDSP_TRANSFORM_STATUS_OK,
		      ASSERT_MSG_INCORRECT_COMP_RESULT);
	zdsp_rfft_fast_f32(&inst, work, spec, 0);  /* forward */
	zdsp_rfft_fast_f32(&inst, spec, recon, 1); /* inverse (normalized by 1/fft_len) */

	zassert_true(test_snr_error_f32(fft_len, recon, sig, SNR_ERROR_THRESH),
		     ASSERT_MSG_SNR_LIMIT_EXCEED);

	free(sig);
	free(work);
	free(spec);
	free(recon);
}

#define DEFINE_RFFT_F32_TESTS(len)                                                                 \
	ZTEST(transform_rfft_f32, test_dc_##len)                                                   \
	{                                                                                          \
		test_zdsp_rfft_fast_f32_dc(len);                                                   \
	}                                                                                          \
	ZTEST(transform_rfft_f32, test_roundtrip_##len)                                            \
	{                                                                                          \
		test_zdsp_rfft_fast_f32_roundtrip(len);                                            \
	}

DEFINE_RFFT_F32_TESTS(32)
DEFINE_RFFT_F32_TESTS(64)
DEFINE_RFFT_F32_TESTS(128)
DEFINE_RFFT_F32_TESTS(256)

ZTEST_SUITE(transform_rfft_f32, NULL, NULL, NULL, NULL, NULL);
```

## src/rfft_q15.c
```c
/*
 * SPDX-FileCopyrightText: Copyright The Zephyr Project Contributors
 *
 * SPDX-License-Identifier: Apache-2.0
 */

#include <zephyr/dsp/dsp.h>
#include <zephyr/dsp/utils.h>
#include <zephyr/ztest.h>
#include <zephyr/kernel.h>
#include <stdlib.h>
#include <string.h>
#include <math.h>
#include <stdint.h>
#include "common/test_common.h"

#define TEST_PI          3.14159265358979323846f
/*
 * The Q15 transform is computed in fixed point with per-stage downscaling, so a moderate
 * SNR threshold is used when cross-checking against the (trusted) f32 transform. A correct
 * transform comfortably exceeds this; a broken one (wrong scaling/ordering) collapses to
 * near 0 dB.
 */
#define SNR_ERROR_THRESH ((float32_t)20)
/*
 * A round trip divides the signal by fft_len, leaving it log2(fft_len) bits closer to the
 * quantization floor: about 7 significant bits at fft_len 256, which yields 20 dB.
 */
#define ROUNDTRIP_SNR_ERROR_THRESH ((float32_t)15)

/*
 * The Q15 real FFT does not use the packed layout of the float transform: bins 0 to
 * fft_len/2 hold the non-redundant half of the spectrum, and the scalar implementation
 * additionally writes the conjugate-symmetric upper half, so the output buffer must always
 * be 2*fft_len Q15 values wide. Only the non-redundant half is inspected here, as that is
 * all the MVE implementation writes. The input buffer is modified by the transform.
 */

/* A DC (constant) input concentrates all energy in bin 0. */
static void test_zdsp_rfft_q15_dc(uint16_t fft_len)
{
	struct zdsp_rfft_instance_q15 inst;
	q15_t *in;
	q15_t *out;
	int64_t max_mag2 = -1;
	uint16_t max_bin = 0;

	in = malloc(fft_len * sizeof(q15_t));
	out = malloc(2 * fft_len * sizeof(q15_t));
	zassert_not_null(in, ASSERT_MSG_BUFFER_ALLOC_FAILED);
	zassert_not_null(out, ASSERT_MSG_BUFFER_ALLOC_FAILED);

	for (uint16_t n = 0; n < fft_len; n++) {
		in[n] = 0x4000; /* 0.5 in Q1.15 */
	}

	zassert_equal(zdsp_rfft_init_q15(&inst, fft_len, 0, 1), ZDSP_TRANSFORM_STATUS_OK,
		      ASSERT_MSG_INCORRECT_COMP_RESULT);
	zdsp_rfft_q15(&inst, in, out);

	/* Bins 0 to fft_len / 2 are the non-redundant half of the spectrum */
	for (uint16_t m = 0; m <= fft_len / 2; m++) {
		int64_t re = out[2 * m];
		int64_t im = out[2 * m + 1];
		int64_t mag2 = re * re + im * im;

		if (mag2 > max_mag2) {
			max_mag2 = mag2;
			max_bin = m;
		}
	}

	zassert_equal(max_bin, 0, "DC energy not in bin 0 (got bin %u)", max_bin);
	zassert_true(out[0] > 0, "DC bin should be positive");

	free(in);
	free(out);
}

/*
 * A real cosine at bin @c k places its energy at bins k and fft_len-k. Restricting the
 * search to the first half [1, fft_len/2], the magnitude peak must be exactly bin k.
 */
static void test_zdsp_rfft_q15_tone(uint16_t fft_len)
{
	struct zdsp_rfft_instance_q15 inst;
	const uint16_t k = 3;
	q15_t *in;
	q15_t *out;
	int64_t max_mag2 = -1;
	uint16_t max_bin = 0;

	in = malloc(fft_len * sizeof(q15_t));
	out = malloc(2 * fft_len * sizeof(q15_t));
	zassert_not_null(in, ASSERT_MSG_BUFFER_ALLOC_FAILED);
	zassert_not_null(out, ASSERT_MSG_BUFFER_ALLOC_FAILED);

	for (uint16_t n = 0; n < fft_len; n++) {
		in[n] = zdsp_f32_to_q15_shift(0.5f * cosf(2.0f * TEST_PI * k * n / fft_len), 0);
	}

	zassert_equal(zdsp_rfft_init_q15(&inst, fft_len, 0, 1), ZDSP_TRANSFORM_STATUS_OK,
		      ASSERT_MSG_INCORRECT_COMP_RESULT);
	zdsp_rfft_q15(&inst, in, out);

	for (uint16_t m = 1; m <= fft_len / 2; m++) {
		int64_t re = out[2 * m];
		int64_t im = out[2 * m + 1];
		int64_t mag2 = re * re + im * im;

		if (mag2 > max_mag2) {
			max_mag2 = mag2;
			max_bin = m;
		}
	}

	zassert_equal(max_bin, k, "spectral peak in wrong bin (got %u, expected %u)", max_bin, k);

	free(in);
	free(out);
}

/*
 * Cross-check the Q15 forward transform against the f32 transform on the same signal. The
 * Q15 forward transform is downscaled by 1/fft_len, so the f32 reference is divided by
 * fft_len before comparison. The two transforms use different output layouts, so both are
 * unpacked into bins 0 to fft_len/2 as interleaved {real, imag} pairs: the f32 transform
 * packs the real DC term in element 0 and the real Nyquist term in element 1, while the
 * Q15 transform stores bin m at elements 2*m and 2*m+1.
 */
static void test_zdsp_rfft_q15_vs_f32(uint16_t fft_len)
{
	struct zdsp_rfft_instance_q15 inst_q15;
	struct zdsp_rfft_fast_instance_f32 inst_f32;
	/* Bins 0 to fft_len/2 inclusive, as interleaved {real, imag} pairs. */
	size_t len = fft_len + 2;
	q15_t *qin;
	q15_t *qspec;
	float32_t *fin;
	float32_t *fspec;
	float32_t *qout;
	float32_t *ref;

	qin = malloc(fft_len * sizeof(q15_t));
	qspec = malloc(2 * fft_len * sizeof(q15_t));
	fin = malloc(fft_len * sizeof(float32_t));
	fspec = calloc(fft_len + 2, sizeof(float32_t));
	qout = malloc(len * sizeof(float32_t));
	ref = malloc(len * sizeof(float32_t));
	zassert_not_null(qin, ASSERT_MSG_BUFFER_ALLOC_FAILED);
	zassert_not_null(qspec, ASSERT_MSG_BUFFER_ALLOC_FAILED);
	zassert_not_null(fin, ASSERT_MSG_BUFFER_ALLOC_FAILED);
	zassert_not_null(fspec, ASSERT_MSG_BUFFER_ALLOC_FAILED);
	zassert_not_null(qout, ASSERT_MSG_BUFFER_ALLOC_FAILED);
	zassert_not_null(ref, ASSERT_MSG_BUFFER_ALLOC_FAILED);

	for (uint16_t n = 0; n < fft_len; n++) {
		float32_t t = (float32_t)n / (float32_t)fft_len;
		/* The DC term keeps bins 0 and fft_len/2 out of the noise. */
		float32_t x = 0.25f + 0.4f * sinf(2.0f * TEST_PI * 3.0f * t) +
			      0.2f * cosf(2.0f * TEST_PI * 9.0f * t);

		fin[n] = x;
		qin[n] = zdsp_f32_to_q15_shift(x, 0);
	}

	zassert_equal(zdsp_rfft_init_q15(&inst_q15, fft_len, 0, 1), ZDSP_TRANSFORM_STATUS_OK,
		      ASSERT_MSG_INCORRECT_COMP_RESULT);
	zassert_equal(zdsp_rfft_fast_init_f32(&inst_f32, fft_len), ZDSP_TRANSFORM_STATUS_OK,
		      ASSERT_MSG_INCORRECT_COMP_RESULT);

	zdsp_rfft_q15(&inst_q15, qin, qspec);
	zdsp_rfft_fast_f32(&inst_f32, fin, fspec, 0);

	for (size_t i = 0; i < len; i++) {
		qout[i] = (float32_t)qspec[i] / 32768.0f;
	}

	/* DC and Nyquist are real; the f32 transform packs them into elements 0 and 1. */
	ref[0] = fspec[0] / (float32_t)fft_len;
	ref[1] = 0.0f;
	ref[fft_len] = fspec[1] / (float32_t)fft_len;
	ref[fft_len + 1] = 0.0f;
	for (size_t i = 2; i < fft_len; i++) {
		ref[i] = fspec[i] / (float32_t)fft_len;
	}

	zassert_true(test_snr_error_f32(len, qout, ref, SNR_ERROR_THRESH),
		     ASSERT_MSG_SNR_LIMIT_EXCEED);

	free(qin);
	free(qspec);
	free(fin);
	free(fspec);
	free(qout);
	free(ref);
}

/*
 * Forward transform followed by the inverse transform returns the input downscaled by
 * 1/fft_len: the inverse is normalized like the f32 one, but it is applied to a spectrum the
 * forward transform has already downscaled by 1/fft_len.
 */
static void test_zdsp_rfft_q15_roundtrip(uint16_t fft_len)
{
	struct zdsp_rfft_instance_q15 fwd;
	struct zdsp_rfft_instance_q15 inv;
	q15_t *in;
	q15_t *spec;
	q15_t *recon;
	float32_t *out;
	float32_t *ref;

	in = malloc(fft_len * sizeof(q15_t));
	spec = malloc(2 * fft_len * sizeof(q15_t));
	recon = malloc(fft_len * sizeof(q15_t));
	out = malloc(fft_len * sizeof(float32_t));
	ref = malloc(fft_len * sizeof(float32_t));
	zassert_not_null(in, ASSERT_MSG_BUFFER_ALLOC_FAILED);
	zassert_not_null(spec, ASSERT_MSG_BUFFER_ALLOC_FAILED);
	zassert_not_null(recon, ASSERT_MSG_BUFFER_ALLOC_FAILED);
	zassert_not_null(out, ASSERT_MSG_BUFFER_ALLOC_FAILED);
	zassert_not_null(ref, ASSERT_MSG_BUFFER_ALLOC_FAILED);

	for (uint16_t n = 0; n < fft_len; n++) {
		float32_t t = (float32_t)n / (float32_t)fft_len;
		float32_t x = 0.25f + 0.4f * sinf(2.0f * TEST_PI * 3.0f * t) +
			      0.2f * cosf(2.0f * TEST_PI * 9.0f * t);

		in[n] = zdsp_f32_to_q15_shift(x, 0);
		ref[n] = (float32_t)in[n] / 32768.0f;
	}

	zassert_equal(zdsp_rfft_init_q15(&fwd, fft_len, 0, 1), ZDSP_TRANSFORM_STATUS_OK,
		      ASSERT_MSG_INCORRECT_COMP_RESULT);
	zassert_equal(zdsp_rfft_init_q15(&inv, fft_len, 1, 1), ZDSP_TRANSFORM_STATUS_OK,
		      ASSERT_MSG_INCORRECT_COMP_RESULT);

	zdsp_rfft_q15(&fwd, in, spec);
	zdsp_rfft_q15(&inv, spec, recon);

	for (uint16_t n = 0; n < fft_len; n++) {
		out[n] = (float32_t)recon[n] * (float32_t)fft_len / 32768.0f;
	}

	zassert_true(test_snr_error_f32(fft_len, out, ref, ROUNDTRIP_SNR_ERROR_THRESH),
		     ASSERT_MSG_SNR_LIMIT_EXCEED);

	free(in);
	free(spec);
	free(recon);
	free(out);
	free(ref);
}

#define DEFINE_RFFT_Q15_TESTS(len)                                                                 \
	ZTEST(transform_rfft_q15, test_dc_##len)                                                   \
	{                                                                                          \
		test_zdsp_rfft_q15_dc(len);                                                        \
	}                                                                                          \
	ZTEST(transform_rfft_q15, test_tone_##len)                                                 \
	{                                                                                          \
		test_zdsp_rfft_q15_tone(len);                                                      \
	}                                                                                          \
	ZTEST(transform_rfft_q15, test_vs_f32_##len)                                               \
	{                                                                                          \
		test_zdsp_rfft_q15_vs_f32(len);                                                    \
	}                                                                                          \
	ZTEST(transform_rfft_q15, test_roundtrip_##len)                                            \
	{                                                                                          \
		test_zdsp_rfft_q15_roundtrip(len);                                                 \
	}

DEFINE_RFFT_Q15_TESTS(32)
DEFINE_RFFT_Q15_TESTS(64)
DEFINE_RFFT_Q15_TESTS(128)
DEFINE_RFFT_Q15_TESTS(256)

ZTEST_SUITE(transform_rfft_q15, NULL, NULL, NULL, NULL, NULL);
```
