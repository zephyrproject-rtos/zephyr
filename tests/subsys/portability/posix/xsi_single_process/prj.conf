## CMakeLists.txt
```
# SPDX-License-Identifier: Apache-2.0

cmake_minimum_required(VERSION 3.28.0)
find_package(Zephyr REQUIRED HINTS $ENV{ZEPHYR_BASE})
project(xsi_single_process)

FILE(GLOB app_sources src/*.c)

target_sources(app PRIVATE ${app_sources})

target_compile_options(app PRIVATE -U_POSIX_C_SOURCE -D_POSIX_C_SOURCE=200809L)
target_compile_options(app PRIVATE -U_XOPEN_SOURCE -D_XOPEN_SOURCE=700)
target_include_directories(app PRIVATE ${ZEPHYR_BASE}/subsys/portability/posix/options)
```

## prj.conf
```kconfig
CONFIG_ZTEST=y

CONFIG_POSIX_AEP_CHOICE_BASE=y
CONFIG_XSI_SINGLE_PROCESS=y
```

## src/main.c
```c
/*
 * Copyright (c) 2025 Tenstorrent AI ULC
 *
 * SPDX-License-Identifier: Apache-2.0
 */

#include <zephyr/ztest.h>

ZTEST_SUITE(xsi_single_process, NULL, NULL, NULL, NULL, NULL);
```

## src/gettimeofday.c
```c
/*
 * Copyright (c) 2018 Intel Corporation
 * Copyright (c) 2023, Meta
 *
 * SPDX-License-Identifier: Apache-2.0
 */

#include <posix_clock.h>

#include <sys/time.h>
#include <time.h>
#include <unistd.h>

#include <zephyr/ztest.h>

ZTEST(xsi_single_process, test_gettimeofday)
{
	struct timeval tv;
	struct timespec ts;
	struct timespec rts;

	if (false) {
		/* undefined behaviour */
		errno = 0;
		zassert_equal(gettimeofday(NULL, NULL), -1);
		zassert_equal(errno, EINVAL);
	}

	/* Validate gettimeofday API */
	zassert_ok(gettimeofday(&tv, NULL));
	zassert_ok(clock_gettime(CLOCK_REALTIME, &rts));

	/* TESTPOINT: Check if time obtained from
	 * gettimeofday is same or more than obtained
	 * from clock_gettime
	 */
	tv_to_ts(&tv, &ts);
	zassert_true(tp_ge(&rts, &ts));
}
```

## src/putenv.c
```c
/*
 * Copyright (c) 2025 Tenstorrent AI ULC
 *
 * SPDX-License-Identifier: Apache-2.0
 */
#include <errno.h>
#include <stdlib.h>

#include <zephyr/ztest.h>

/* declare locally until #97855 is merged, as some C libraries do not declare it in stdlib.h */
int putenv(char *s);

ZTEST(xsi_single_process, test_putenv)
{
	/* putenv() does not copy the string, so the buffer must outlive this test */
	static char buf[64];

	{
		/* degenerate cases */
		static const char *const cases[] = {
			NULL, "", "=", "abc", "42", "=abc",
			/*
			 * Note:
			 * There are many poorly-formatted environment variable names and values
			 * that are invalid (from the perspective of a POSIX shell), but still
			 * accepted by setenv() and subsequently putenv().
			 *
			 * See also tests/posix/single_process/src/env.c
			 * See also subsys/portability/posix/shell/env.c:101
			 */
		};

		ARRAY_FOR_EACH(cases, i) {
			char *s;

			if (cases[i] == NULL) {
				s = NULL;
			} else {
				strncpy(buf, cases[i], sizeof(buf));
				buf[sizeof(buf) - 1] = '\0';
				s = buf;
			}

			errno = 0;
			zexpect_equal(-1, putenv(s), "putenv(%s) unexpectedly succeeded", s);
			zexpect_not_equal(0, errno, "putenv(%s) did not set errno", s);
		}
	}

	{
		/* valid cases */
		static const char *const cases[] = {
			"FOO=bar",
		};

		ARRAY_FOR_EACH(cases, i) {
			strncpy(buf, cases[i], sizeof(buf));
			buf[sizeof(buf) - 1] = '\0';

			zexpect_ok(putenv(buf), "putenv(%s) failed: %d", buf, errno);
		}
	}
}
```
