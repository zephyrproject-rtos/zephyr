## CMakeLists.txt
```
# SPDX-License-Identifier: Apache-2.0

cmake_minimum_required(VERSION 3.28.0)
find_package(Zephyr REQUIRED HINTS $ENV{ZEPHYR_BASE})
project(posix_spinlocks)

target_sources(app PRIVATE src/main.c)

target_compile_options(app PRIVATE -U_POSIX_C_SOURCE -D_POSIX_C_SOURCE=200809L)
```

## prj.conf
```kconfig
CONFIG_POSIX_API=y
CONFIG_ZTEST=y

CONFIG_POSIX_AEP_CHOICE_BASE=y
CONFIG_POSIX_SPIN_LOCKS=y
```

## src/main.c
```c
/*
 * Copyright (c) 2023, Meta
 *
 * SPDX-License-Identifier: Apache-2.0
 */

#include <pthread.h>

#include <zephyr/ztest.h>
#include <zephyr/sys/util.h>

ZTEST(posix_spinlocks, test_spin_init_destroy)
{
	pthread_spinlock_t lock;

	zassert_equal(pthread_spin_init(NULL, PTHREAD_PROCESS_PRIVATE), EINVAL,
		      "pthread_spin_init() did not return EINVAL with NULL lock pointer");
	zassert_equal(pthread_spin_init(&lock, 42), EINVAL,
		      "pthread_spin_init() did not return EINVAL with invalid pshared");
	zassert_equal(pthread_spin_destroy(NULL), EINVAL,
		      "pthread_spin_destroy() did not return EINVAL with NULL lock pointer");

	zassert_ok(pthread_spin_init(&lock, PTHREAD_PROCESS_PRIVATE), "pthread_spin_init() failed");
	zassert_ok(pthread_spin_destroy(&lock), "pthread_spin_destroy() failed");
}

ZTEST(posix_spinlocks, test_spin_descriptor_leak)
{
	pthread_spinlock_t lock[CONFIG_MAX_PTHREAD_SPINLOCK_COUNT];

	for (size_t j = 0; j < 2; ++j) {
		for (size_t i = 0; i < ARRAY_SIZE(lock); ++i) {
			zassert_ok(pthread_spin_init(&lock[i], PTHREAD_PROCESS_PRIVATE),
				   "failed to initialize spinlock %zu (rep %zu)", i, j);
		}

		zassert_equal(pthread_spin_init(&lock[CONFIG_MAX_PTHREAD_SPINLOCK_COUNT],
						PTHREAD_PROCESS_PRIVATE),
			      ENOMEM,
			      "should not be able to initialize more than "
			      "CONFIG_MAX_PTHREAD_SPINLOCK_COUNT spinlocks");

		for (size_t i = 0; i < ARRAY_SIZE(lock); ++i) {
			zassert_ok(pthread_spin_destroy(&lock[i]),
				   "failed to destroy spinlock %zu (rep %zu)", i, j);
		}
	}
}

ZTEST(posix_spinlocks, test_spin_lock_unlock)
{
	pthread_spinlock_t lock;

	zassert_equal(pthread_spin_lock(NULL), EINVAL,
		      "pthread_spin_lock() did not return EINVAL with NULL lock pointer");
	zassert_equal(pthread_spin_trylock(NULL), EINVAL,
		      "pthread_spin_lock() did not return EINVAL with NULL lock pointer");
	zassert_equal(pthread_spin_unlock(NULL), EINVAL,
		      "pthread_spin_lock() did not return EINVAL with NULL lock pointer");

	zassert_ok(pthread_spin_init(&lock, PTHREAD_PROCESS_PRIVATE), "pthread_spin_init() failed");

	zassert_ok(pthread_spin_lock(&lock), "pthread_spin_lock() failed");
	zassert_ok(pthread_spin_unlock(&lock), "pthread_spin_lock() failed");

	zassert_ok(pthread_spin_trylock(&lock), "pthread_spin_trylock() failed");
	zassert_ok(pthread_spin_unlock(&lock), "pthread_spin_unlock() failed");

	zassert_ok(pthread_spin_destroy(&lock), "pthread_spin_destroy() failed");
	zassert_equal(lock, (pthread_spinlock_t)-1,
		      "pthread_spin_destroy() did not invalidate lock handle");
	zassert_equal(pthread_spin_destroy(&lock), EINVAL,
		      "pthread_spin_destroy() on destroyed lock did not return EINVAL");
	zassert_equal(pthread_spin_lock(&lock), EINVAL,
		      "pthread_spin_lock() on destroyed lock did not return EINVAL");
	zassert_equal(pthread_spin_trylock(&lock), EINVAL,
		      "pthread_spin_trylock() on destroyed lock did not return EINVAL");
	zassert_equal(pthread_spin_unlock(&lock), EINVAL,
		      "pthread_spin_unlock() on destroyed lock did not return EINVAL");
}

ZTEST(posix_spinlocks, test_spin_destroyed_handle_invalidation)
{
	pthread_spinlock_t lock1;
	pthread_spinlock_t lock2;

	zassert_ok(pthread_spin_init(&lock1, PTHREAD_PROCESS_PRIVATE));
	zassert_ok(pthread_spin_destroy(&lock1));

	/* Reallocating the recycled pool slot with a new lock must not revive lock1 */
	zassert_ok(pthread_spin_init(&lock2, PTHREAD_PROCESS_PRIVATE));

	zassert_equal(pthread_spin_lock(&lock1), EINVAL,
		      "stale destroyed handle unexpectedly accessed reallocated slot");
	zassert_equal(pthread_spin_trylock(&lock1), EINVAL,
		      "stale destroyed handle unexpectedly trylocked reallocated slot");
	zassert_equal(pthread_spin_unlock(&lock1), EINVAL,
		      "stale destroyed handle unexpectedly unlocked reallocated slot");
	zassert_equal(pthread_spin_destroy(&lock1), EINVAL,
		      "stale destroyed handle unexpectedly destroyed reallocated slot");

	zassert_ok(pthread_spin_destroy(&lock2));
}

ZTEST_SUITE(posix_spinlocks, NULL, NULL, NULL, NULL, NULL);
```
