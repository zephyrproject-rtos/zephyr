## CMakeLists.txt
```
# Copyright (c) Qualcomm Technologies, Inc. and/or its subsidiaries.
# SPDX-License-Identifier: Apache-2.0

cmake_minimum_required(VERSION 3.28.0)
find_package(Zephyr REQUIRED HINTS $ENV{ZEPHYR_BASE})
project(pthread_static_init)

target_sources(app PRIVATE src/main.cpp)
```

## prj.conf
```kconfig
# Copyright (c) Qualcomm Technologies, Inc. and/or its subsidiaries.
# SPDX-License-Identifier: Apache-2.0

CONFIG_CPP=y
CONFIG_STD_CPP17=y
CONFIG_ZTEST=y
CONFIG_POSIX_SYSTEM_INTERFACES=y
CONFIG_POSIX_THREADS=y
CONFIG_POSIX_RW_LOCKS=y
```

## src/main.cpp
```c
/*
 * Copyright (c) Qualcomm Technologies, Inc. and/or its subsidiaries.
 *
 * SPDX-License-Identifier: Apache-2.0
 */

#include <zephyr/posix/pthread.h>
#include <zephyr/ztest.h>

/* List initialization also occurs in C++ library synchronization objects. */
ZTEST(pthread_static_init, test_mutex)
{
	pthread_mutex_t mutex{PTHREAD_MUTEX_INITIALIZER};

	zassert_ok(pthread_mutex_lock(&mutex));
	zassert_ok(pthread_mutex_unlock(&mutex));
	zassert_ok(pthread_mutex_destroy(&mutex));
}

ZTEST(pthread_static_init, test_condvar)
{
	pthread_cond_t condvar{PTHREAD_COND_INITIALIZER};

	zassert_ok(pthread_cond_signal(&condvar));
	zassert_ok(pthread_cond_broadcast(&condvar));
	zassert_ok(pthread_cond_destroy(&condvar));
}

ZTEST(pthread_static_init, test_rwlock)
{
	pthread_rwlock_t rwlock{PTHREAD_RWLOCK_INITIALIZER};

	/* The macro must compile in C++; this implementation still needs explicit init. */
	zassert_ok(pthread_rwlock_init(&rwlock, NULL));

	zassert_ok(pthread_rwlock_rdlock(&rwlock));
	zassert_ok(pthread_rwlock_unlock(&rwlock));
	zassert_ok(pthread_rwlock_wrlock(&rwlock));
	zassert_ok(pthread_rwlock_unlock(&rwlock));
	zassert_ok(pthread_rwlock_destroy(&rwlock));
}

ZTEST_SUITE(pthread_static_init, NULL, NULL, NULL, NULL, NULL);
```
