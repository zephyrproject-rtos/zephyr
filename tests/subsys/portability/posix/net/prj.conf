## CMakeLists.txt
```
# SPDX-License-Identifier: Apache-2.0

cmake_minimum_required(VERSION 3.28.0)
find_package(Zephyr REQUIRED HINTS $ENV{ZEPHYR_BASE})
project(posix_net)

FILE(GLOB app_sources src/*.c)

target_sources(app PRIVATE ${app_sources})

target_compile_options(app PRIVATE -U_POSIX_C_SOURCE -D_POSIX_C_SOURCE=200809L)
```

## prj.conf
```kconfig
CONFIG_ZTEST=y
CONFIG_NET_TEST=y
CONFIG_TEST_RANDOM_GENERATOR=y

CONFIG_POSIX_AEP_CHOICE_NETAPP=y
CONFIG_POSIX_NETWORKING=y
CONFIG_NETWORKING=y
```

## src/main.c
```c
/*
 * Copyright (c) 2024, Friedt Professional Engineering Services, Inc
 *
 * SPDX-License-Identifier: Apache-2.0
 */

#include <zephyr/ztest.h>

ZTEST_SUITE(net, NULL, NULL, NULL, NULL, NULL);
```

## src/gethostname.c
```c
/*
 * Copyright (c) 2025 Tenstorrent AI ULC
 *
 * SPDX-License-Identifier: Apache-2.0
 */

#include <unistd.h>
#include <errno.h>
#include <string.h>

#include <zephyr/ztest.h>
#include <zephyr/net/hostname.h>

ZTEST(net, test_gethostname)
{
	char hostname[CONFIG_NET_HOSTNAME_MAX_LEN + 1];
	int ret;

	ret = gethostname(hostname, sizeof(hostname));
	zassert_equal(ret, 0, "gethostname() failed: %d", ret);

	zassert_equal(strcmp(hostname, CONFIG_NET_HOSTNAME), 0,
		      "gethostname() returned unexpected hostname: %s", hostname);
}

ZTEST(net, test_gethostname_buffer_too_small)
{
	char small_hostname[2];
	int ret;

	ret = gethostname(small_hostname, sizeof(small_hostname));

	/* POSIX allows either truncation or error when buffer is too small.
	 * Zephyr's current implementation truncates (which is POSIX-compliant).
	 */
	if (ret == -1) {
		/* Implementation returns error - verify errno */
		zassert_equal(errno, ENAMETOOLONG, "Expected ENAMETOOLONG, got %d", errno);
	} else {
		/* Implementation truncates - verify it succeeded */
		zassert_equal(ret, 0, "gethostname() should return 0 on truncation");
		/* Note: strncpy used in implementation may not null-terminate when truncated,
		 * so we cannot reliably verify null-termination
		 */
	}
}

ZTEST(net, test_gethostname_zero_length)
{
	char hostname[CONFIG_NET_HOSTNAME_MAX_LEN + 1];
	int ret;

	ret = gethostname(hostname, 0);

	/* With zero length buffer, the implementation uses strncpy(buf, p, 0)
	 * which copies nothing and returns success. POSIX allows this behavior.
	 */
	if (ret == -1) {
		/* Strict implementation - verify errno */
		zassert_equal(errno, EINVAL, "Expected EINVAL, got %d", errno);
	} else {
		/* Lenient implementation - accepts success */
		zassert_equal(ret, 0, "gethostname() returned unexpected value: %d", ret);
	}
}

ZTEST(net, test_hostname_max_len_consistency)
{
	/* Verify that CONFIG_NET_HOSTNAME_MAX_LEN is properly defined and > 0 */
	zassert_true(CONFIG_NET_HOSTNAME_MAX_LEN > 0,
		     "CONFIG_NET_HOSTNAME_MAX_LEN must be positive");

	/* Verify it can hold at least the configured hostname */
	zassert_true(CONFIG_NET_HOSTNAME_MAX_LEN >= strlen(CONFIG_NET_HOSTNAME),
		     "CONFIG_NET_HOSTNAME_MAX_LEN too small for CONFIG_NET_HOSTNAME");

#ifdef CONFIG_POSIX_HOST_NAME_MAX
	/* If POSIX is enabled, verify consistency */
	zassert_true(CONFIG_POSIX_HOST_NAME_MAX >= CONFIG_NET_HOSTNAME_MAX_LEN,
		     "POSIX_HOST_NAME_MAX should be >= NET_HOSTNAME_MAX_LEN");
#endif
}

#ifdef CONFIG_NET_HOSTNAME_DYNAMIC
ZTEST(net, test_gethostname_dynamic_update)
{
	char hostname[CONFIG_NET_HOSTNAME_MAX_LEN + 1];
	char original_hostname[CONFIG_NET_HOSTNAME_MAX_LEN + 1];
	char test_hostname[] = "test-dynamic";
	int ret;

	/* Get original hostname */
	ret = gethostname(original_hostname, sizeof(original_hostname));
	zassert_equal(ret, 0, "Failed to get original hostname");

	/* Set new hostname */
	ret = net_hostname_set(test_hostname, strlen(test_hostname));
	zassert_equal(ret, 0, "Failed to set hostname");

	/* Verify hostname changed */
	ret = gethostname(hostname, sizeof(hostname));
	zassert_equal(ret, 0, "Failed to get hostname after update");
	zassert_equal(strcmp(hostname, test_hostname), 0,
		      "Hostname not updated correctly");

	/* Restore original hostname */
	ret = net_hostname_set(original_hostname, strlen(original_hostname));
	zassert_equal(ret, 0, "Failed to restore original hostname");
}
#endif /* CONFIG_NET_HOSTNAME_DYNAMIC */

#ifdef CONFIG_NET_HOSTNAME_UNIQUE_UPDATE
ZTEST(net, test_gethostname_with_unique_update)
{
	char hostname[CONFIG_NET_HOSTNAME_MAX_LEN + 1];
	int ret;

	/* This test validates that gethostname works when NET_HOSTNAME_UNIQUE_UPDATE is enabled */
	ret = gethostname(hostname, sizeof(hostname));
	zassert_equal(ret, 0, "gethostname() failed with NET_HOSTNAME_UNIQUE_UPDATE enabled");

	/* Hostname should contain the configured name possibly with unique suffix */
	zassert_true(strlen(hostname) > 0, "Hostname should not be empty");
	zassert_true(strlen(hostname) <= CONFIG_NET_HOSTNAME_MAX_LEN,
		     "Hostname length exceeds maximum");
}
#endif /* CONFIG_NET_HOSTNAME_UNIQUE_UPDATE */
```

## src/if.c
```c
/*
 * Copyright (c) 2024, Friedt Professional Engineering Services, Inc
 *
 * SPDX-License-Identifier: Apache-2.0
 */

#include <zephyr/logging/log.h>
#include <zephyr/net/net_if.h>
#include <zephyr/posix/net/if.h>
#include <zephyr/sys/util.h>
#include <zephyr/ztest.h>

ZTEST(net, test_if_indextoname)
{
	char *name;
	size_t n = 0;
	struct net_if *iface;
	char a[IF_NAMESIZE];
	char b[IF_NAMESIZE];

	NET_IFACE_COUNT(&n);
	TC_PRINT("%zu interfaces\n", n);
	for (size_t i = 0; i < n; i++) {
		memset(a, 0, sizeof(a));
		memset(b, 0, sizeof(b));
		name = if_indextoname(i + 1, a);
		zassert_equal(name, a);
		TC_PRINT("interface %zu: %s\n", i + 1, name);
		iface = net_if_get_by_index(i + 1);
		zassert_not_null(iface);
		zassert_true(net_if_get_name(iface, b, IF_NAMESIZE) >= 0);
		zassert_mem_equal(a, b, IF_NAMESIZE);
	}
}

ZTEST(net, test_if_freenameindex)
{
	if_freenameindex(NULL);
	if_freenameindex(if_nameindex());
}

ZTEST(net, test_if_nameindex)
{
	size_t n = 0;
	struct if_nameindex *ni;

	NET_IFACE_COUNT(&n);
	TC_PRINT("%zu interfaces\n", n);

	ni = if_nameindex();
	if (ni == NULL) {
		zassert_equal(errno, ENOBUFS);
		return;
	}

	for (size_t i = 0; i < n; i++) {
		zassert_equal(i + 1, ni[i].if_index);
		zassert_not_null(ni[i].if_name);
		TC_PRINT("interface %zu: %s\n", i + 1, ni[i].if_name);
		zassert_equal(0, ni[n].if_index);
		zassert_is_null(ni[n].if_name);
	}

	if_freenameindex(ni);
}

ZTEST(net, test_if_nametoindex)
{
	size_t n = 0;
	char buf[IF_NAMESIZE];

	NET_IFACE_COUNT(&n);
	TC_PRINT("%zu interfaces\n", n);
	for (size_t i = 0; i < n; i++) {
		memset(buf, 0, sizeof(buf));
		zassert_not_null(if_indextoname(i + 1, buf));
		TC_PRINT("interface %zu: %s\n", i + 1, buf);
		zassert_equal(i + 1, if_nametoindex(buf));
	}
}
```

## src/inet_addr.c
```c
/*
 * Copyright (c) 2024, Friedt Professional Engineering Services, Inc
 *
 * SPDX-License-Identifier: Apache-2.0
 */

#include <stdint.h>

#include <arpa/inet.h>
#include <netinet/in.h>
#include <zephyr/sys/util.h>
#include <zephyr/ztest.h>

ZTEST(net, test_inet_addr)
{
	in_addr_t ret;
	static const struct parm {
		const char *in;
		int out;
	} parms[] = {
	/* expect failure */
#ifndef CONFIG_NATIVE_LIBC
		{NULL, (uint32_t)-1}, /* this value will segfault using the host libc */
#endif
		{".", (uint32_t)-1},
		{"..", (uint32_t)-1},
		{"...", (uint32_t)-1},
		{"-1.-2.-3.-4", (uint32_t)-1},
		{"256.65536.4294967296.18446744073709551616", (uint32_t)-1},
		{"a.b.c.d", (uint32_t)-1},
		{"0.0.0.1234", (uint32_t)-1},
		{"0.0.0.12a", (uint32_t)-1},
		{" 1.2.3.4", (uint32_t)-1},

		/* expect success */
		{"0.0.0.0", htonl(0)},
		{"000.00.0.0", htonl(0)},
		{"127.0.0.1", htonl(0x7f000001)},
		{"1.2.3.4", htonl(0x01020304)},
		{"1.2.3.4    ", htonl(0x01020304)},
		{"0.0.0.123 a", htonl(0x0000007b)},
		{"255.255.255.255", htonl(0xffffffffU)},
	};

	ARRAY_FOR_EACH_PTR(parms, p) {
		ret = inet_addr(p->in);
		zexpect_equal(ret, p->out, "inet_addr(%s) failed. expect: %d actual: %d", p->in,
			      p->out, ret);
	}
}
```

## src/inet_ntoa.c
```c
/*
 * Copyright (c) 2024, Friedt Professional Engineering Services, Inc
 *
 * SPDX-License-Identifier: Apache-2.0
 */

#include <zephyr/posix/arpa/inet.h>
#include <zephyr/posix/netinet/in.h>

#include <zephyr/ztest.h>

ZTEST(net, test_inet_ntoa)
{
	struct in_addr in;

	in.s_addr = htonl(0x7f000001);
	zassert_mem_equal(inet_ntoa(in), "127.0.0.1", strlen("127.0.0.1") + 1);

	in.s_addr = htonl(0);
	zassert_mem_equal(inet_ntoa(in), "0.0.0.0", strlen("0.0.0.0") + 1);

	in.s_addr = htonl(0xffffffffU);
	zassert_mem_equal(inet_ntoa(in), "255.255.255.255", strlen("255.255.255.255") + 1);
}
```
