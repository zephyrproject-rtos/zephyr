## CMakeLists.txt
```
# SPDX-License-Identifier: Apache-2.0

cmake_minimum_required(VERSION 3.20.0)
find_package(Zephyr REQUIRED HINTS $ENV{ZEPHYR_BASE})
project(posix_system_database)

file(GLOB app_sources src/*.c)
target_sources(app PRIVATE ${app_sources})

target_compile_options(app PRIVATE -U_POSIX_C_SOURCE -D_POSIX_C_SOURCE=200809L)
```

## prj.conf
```kconfig
CONFIG_POSIX_API=y
CONFIG_ZTEST=y
```

## src/grp.c
```c
/*
 * Copyright (c) 2024 Meta Platforms
 *
 * SPDX-License-Identifier: Apache-2.0
 */

#include <errno.h>
#include <grp.h>

#include <zephyr/ztest.h>

ZTEST(grp, test_grp_stubs)
{
	struct group grp;
	struct group *result = &grp;

	zassert_equal(getgrnam_r(NULL, NULL, NULL, 42, NULL), ENOSYS);
	zassert_equal(getgrgid_r(42, NULL, NULL, 42, NULL), ENOSYS);

	zassert_equal(getgrnam_r(NULL, NULL, NULL, 42, &result), ENOSYS);
	zassert_is_null(result);

	result = &grp;
	zassert_equal(getgrgid_r(42, NULL, NULL, 42, &result), ENOSYS);
	zassert_is_null(result);
}

ZTEST_SUITE(grp, NULL, NULL, NULL, NULL, NULL);
```

## src/pwd.c
```c
/*
 * Copyright (c) 2024 Meta Platforms
 *
 * SPDX-License-Identifier: Apache-2.0
 */

#include <errno.h>
#include <pwd.h>

#include <zephyr/ztest.h>

ZTEST(pwd, test_pwd_stubs)
{
	struct passwd pwd;
	struct passwd *result = &pwd;

	zassert_equal(getpwnam_r(NULL, NULL, NULL, 42, NULL), ENOSYS);
	zassert_equal(getpwuid_r(42, NULL, NULL, 42, NULL), ENOSYS);

	zassert_equal(getpwnam_r(NULL, NULL, NULL, 42, &result), ENOSYS);
	zassert_is_null(result);

	result = &pwd;
	zassert_equal(getpwuid_r(42, NULL, NULL, 42, &result), ENOSYS);
	zassert_is_null(result);
}

ZTEST_SUITE(pwd, NULL, NULL, NULL, NULL, NULL);
```
