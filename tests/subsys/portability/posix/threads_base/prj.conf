## CMakeLists.txt
```
# SPDX-License-Identifier: Apache-2.0

cmake_minimum_required(VERSION 3.28.0)
find_package(Zephyr REQUIRED HINTS $ENV{ZEPHYR_BASE})
project(posix_threads_base)

FILE(GLOB app_sources src/*.c)
zephyr_include_directories(${ZEPHYR_BASE}/lib/posix)

target_sources(app PRIVATE ${app_sources})

target_compile_options(app PRIVATE -U_POSIX_C_SOURCE -D_POSIX_C_SOURCE=200809L)
target_include_directories(app PRIVATE ${ZEPHYR_BASE}/lib/posix/options)
```

## prj.conf
```kconfig
CONFIG_ZTEST=y
CONFIG_POSIX_API=y
CONFIG_POSIX_THREADS=y
CONFIG_PTHREAD_CREATE_BARRIER=y

CONFIG_POSIX_THREAD_THREADS_MAX=6
CONFIG_HEAP_MEM_POOL_SIZE=4096
CONFIG_THREAD_NAME=y
CONFIG_DYNAMIC_THREAD=y
CONFIG_THREAD_STACK_INFO=y
CONFIG_POSIX_THREAD_KEYS_MAX=512
CONFIG_TEST_EXTRA_STACK_SIZE=4096

# for sched_get_priority_min(), sched_get_priority_max() used in threads
CONFIG_POSIX_PRIORITY_SCHEDULING=y
CONFIG_POSIX_MESSAGE_PASSING=y
CONFIG_POSIX_REALTIME_SIGNALS=y
```

## src/main.c
```c
/*
 * Copyright (c) 2024 Meta Platforms
 *
 * SPDX-License-Identifier: Apache-2.0
 */

#include <zephyr/ztest.h>

/* Individual suites are registered in their respective .c files */
```

## src/cond.c
```c
/*
 * Copyright (c) 2022 Meta
 *
 * SPDX-License-Identifier: Apache-2.0
 */

#include <pthread.h>

#include <zephyr/ztest.h>

/**
 * @brief Test to demonstrate limited condition variable resources
 *
 * @details Exactly CONFIG_MAX_PTHREAD_COND_COUNT can be in use at once.
 */
ZTEST(cond, test_cond_resource_exhausted)
{
	size_t i;
	pthread_cond_t m[CONFIG_MAX_PTHREAD_COND_COUNT + 1];

	for (i = 0; i < CONFIG_MAX_PTHREAD_COND_COUNT; ++i) {
		zassert_ok(pthread_cond_init(&m[i], NULL), "failed to init cond %zu", i);
	}

	/* try to initialize one more than CONFIG_MAX_PTHREAD_COND_COUNT */
	zassert_equal(i, CONFIG_MAX_PTHREAD_COND_COUNT);
	zassert_not_equal(0, pthread_cond_init(&m[i], NULL), "should not have initialized cond %zu",
			  i);

	for (; i > 0; --i) {
		zassert_ok(pthread_cond_destroy(&m[i - 1]), "failed to destroy cond %zu", i - 1);
	}
}

/**
 * @brief Test to that there are no condition variable resource leaks
 *
 * @details Demonstrate that condition variables may be used over and over again.
 */
ZTEST(cond, test_cond_resource_leak)
{
	pthread_cond_t cond;

	for (size_t i = 0; i < 2 * CONFIG_MAX_PTHREAD_COND_COUNT; ++i) {
		zassert_ok(pthread_cond_init(&cond, NULL), "failed to init cond %zu", i);
		zassert_ok(pthread_cond_destroy(&cond), "failed to destroy cond %zu", i);
	}
}

ZTEST(cond, test_pthread_condattr)
{
	pthread_condattr_t att = {0};

	zassert_ok(pthread_condattr_init(&att));

	zassert_ok(pthread_condattr_destroy(&att));
}

/**
 * @brief Test pthread_cond_init() with a pre-existing initialized attribute.
 */
ZTEST(cond, test_cond_init_existing_initialized_condattr)
{
	pthread_cond_t cond;
	pthread_condattr_t att = {0};

	zassert_ok(pthread_condattr_init(&att));
	zassert_ok(pthread_cond_init(&cond, &att), "pthread_cond_init failed with valid attr");

	/* Clean up */
	zassert_ok(pthread_cond_destroy(&cond));
	zassert_ok(pthread_condattr_destroy(&att));
}

/**
 * @brief Test pthread_cond_broadcast call with a statically initialized pthread_cond_t,
 *        i.e. PTHREAD_COND_INITIALIZER assigned.
 */
ZTEST(cond, test_cond_broadcast_static_init_pthread_cond_t)
{
	pthread_cond_t cond = PTHREAD_COND_INITIALIZER; /* is considered statically initialized */

	zassert_ok(pthread_cond_broadcast(&cond));
	zassert_ok(pthread_cond_destroy(&cond));
}

/**
 * @brief Test pthread_cond_signal call with a statically initialized pthread_cond_t,
 *        i.e. PTHREAD_COND_INITIALIZER assigned.
 */
ZTEST(cond, test_cond_signal_static_init_pthread_cond_t)
{
	pthread_cond_t cond = PTHREAD_COND_INITIALIZER; /* is considered statically initialized */

	zassert_ok(pthread_cond_signal(&cond));
	zassert_ok(pthread_cond_destroy(&cond));
}

struct static_cond_test_data {
	pthread_cond_t *cond;
	pthread_mutex_t *mutex;
	struct k_sem started_sem;
	bool signaled;
};

static void *static_cond_waiter(void *arg)
{
	struct static_cond_test_data *data = arg;

	zassert_ok(pthread_mutex_lock(data->mutex));
	k_sem_give(&data->started_sem);
	while (data->signaled == false) {
		zassert_ok(pthread_cond_wait(data->cond, data->mutex));
	}
	zassert_ok(pthread_mutex_unlock(data->mutex));

	return NULL;
}

/**
 * @brief Test concurrent wait and signal with statically initialized condvar
 *
 * @details A PTHREAD_COND_INITIALIZER condvar must auto-initialize on first use
 *          and reliably wake up waiters across concurrent threads, exercising
 *          the serialized lazy-init path in to_posix_cond().
 */
ZTEST(cond, test_cond_static_initializer_multithread)
{
	if (!IS_ENABLED(CONFIG_DYNAMIC_THREAD)) {
		/* skip test if dynamic thread creation is not configured */
		ztest_test_skip();
		return;
	}

	static pthread_cond_t cond = PTHREAD_COND_INITIALIZER;
	static pthread_mutex_t mutex = PTHREAD_MUTEX_INITIALIZER;
	struct static_cond_test_data data = {
		.cond = &cond,
		.mutex = &mutex,
		.signaled = false,
	};
	pthread_t th;

	k_sem_init(&data.started_sem, 0, 1);

	zassert_ok(pthread_create(&th, NULL, static_cond_waiter, &data));

	/* Wait until waiter thread has acquired mutex and is ready */
	zassert_ok(k_sem_take(&data.started_sem, K_FOREVER));

	/*
	 * Acquire mutex: because waiter acquired mutex before giving started_sem,
	 * we only acquire the mutex once waiter has atomically released it inside
	 * pthread_cond_wait().
	 */
	zassert_ok(pthread_mutex_lock(&mutex));
	data.signaled = true;
	zassert_ok(pthread_cond_signal(&cond));
	zassert_ok(pthread_mutex_unlock(&mutex));

	zassert_ok(pthread_join(th, NULL));

	zassert_ok(pthread_cond_destroy(&cond));
	zassert_ok(pthread_mutex_destroy(&mutex));
}

#define NUM_COND_CONTENDERS 4

struct cond_contender_data {
	pthread_cond_t *cond;
	struct k_sem *start_sem;
};

static void *cond_contender_thread(void *arg)
{
	struct cond_contender_data *data = arg;

	/* Wait for start signal so all threads release concurrently */
	k_sem_take(data->start_sem, K_FOREVER);

	/* Contend on lazy initialization of the static condition variable */
	zassert_ok(pthread_cond_signal(data->cond));

	return NULL;
}

/**
 * @brief Test concurrent first-use contention on a static condition variable
 *
 * @details Multiple threads concurrently invoke pthread_cond_signal() on the
 *          same uninitialized PTHREAD_COND_INITIALIZER variable without prior
 *          mutex synchronization. Verifies that exactly one pool slot is allocated
 *          and no pool slots are leaked under contention.
 */
ZTEST(cond, test_cond_static_initializer_contention)
{
	if (!IS_ENABLED(CONFIG_DYNAMIC_THREAD)) {
		ztest_test_skip();
		return;
	}

	static pthread_cond_t race_cond = PTHREAD_COND_INITIALIZER;
	pthread_cond_t extra_conds[CONFIG_MAX_PTHREAD_COND_COUNT];
	struct k_sem start_sem;
	pthread_t threads[NUM_COND_CONTENDERS];
	struct cond_contender_data data = {
		.cond = &race_cond,
		.start_sem = &start_sem,
	};
	int i;

	k_sem_init(&start_sem, 0, NUM_COND_CONTENDERS);

	for (i = 0; i < NUM_COND_CONTENDERS; ++i) {
		zassert_ok(pthread_create(&threads[i], NULL, cond_contender_thread, &data));
	}

	/* Release all contenders simultaneously */
	for (i = 0; i < NUM_COND_CONTENDERS; ++i) {
		k_sem_give(&start_sem);
	}

	for (i = 0; i < NUM_COND_CONTENDERS; ++i) {
		zassert_ok(pthread_join(threads[i], NULL));
	}

	/*
	 * Verify no slots were leaked: exactly 1 slot should be in use by race_cond.
	 * We should be able to allocate all remaining (CONFIG_MAX_PTHREAD_COND_COUNT - 1)
	 * condition variables successfully without pool exhaustion.
	 */
	for (i = 0; i < CONFIG_MAX_PTHREAD_COND_COUNT - 1; ++i) {
		zassert_ok(pthread_cond_init(&extra_conds[i], NULL));
	}

	/* Clean up all condition variables */
	for (i = 0; i < CONFIG_MAX_PTHREAD_COND_COUNT - 1; ++i) {
		zassert_ok(pthread_cond_destroy(&extra_conds[i]));
	}

	zassert_ok(pthread_cond_destroy(&race_cond));
}

ZTEST_SUITE(cond, NULL, NULL, NULL, NULL, NULL);
```

## src/key.c
```c
/*
 * Copyright (c) 2018 Intel Corporation
 *
 * SPDX-License-Identifier: Apache-2.0
 */

#include <limits.h>
#include <pthread.h>

#include <zephyr/kernel.h>
#include <zephyr/sys/util.h>
#include <zephyr/ztest.h>

#define N_THR 2
#define N_KEY  2
#define BUFFSZ 48

static pthread_key_t key;
static pthread_key_t keys[N_KEY];
static pthread_once_t key_once = PTHREAD_ONCE_INIT;
static pthread_once_t keys_once = PTHREAD_ONCE_INIT;

static void *thread_top(void *p1)
{
	void *value;
	char *buffer[BUFFSZ];

	value = k_malloc(sizeof(buffer));
	zassert_not_null(value, "thread could not allocate storage");
	zassert_ok(pthread_setspecific(key, value), "pthread_setspecific failed");
	zassert_equal(pthread_getspecific(key), value, "set and retrieved values are different");
	k_free(value);

	return NULL;
}

static void *thread_func(void *p1)
{
	void *value;
	char *buffer[BUFFSZ];

	value = k_malloc(sizeof(buffer));
	zassert_not_null(value, "thread could not allocate storage");
	for (int i = 0; i < N_KEY; i++) {
		zassert_ok(pthread_setspecific(keys[i], value), "pthread_setspecific failed");
		zassert_equal(pthread_getspecific(keys[i]), value,
			      "set and retrieved values are different");
	}
	k_free(value);
	return NULL;
}

static void make_key(void)
{
	zassert_ok(pthread_key_create(&key, NULL), "insufficient memory to create key");
}

static void make_keys(void)
{
	for (int i = 0; i < N_KEY; i++) {
		zassert_ok(pthread_key_create(&keys[i], NULL),
			   "insufficient memory to create keys");
	}
}

/**
 * @brief Test to demonstrate pthread_key APIs usage
 *
 * @details The tests spawn a thread which uses pthread_once() to
 * create a key via pthread_key_create() API. It then sets the
 * thread-specific value to the key using pthread_setspecific() and
 * gets it back using pthread_getspecific and asserts that they
 * are equal. It then deletes the key using pthread_key_delete().
 * Both the sub-tests do the above, but one with multiple threads
 * using the same key and the other with a single thread using
 * multiple keys.
 */

ZTEST(key, test_key_1toN_thread)
{
	void *retval;
	pthread_t newthread[N_THR];

	zassert_ok(pthread_once(&key_once, make_key), "attempt to create key failed");

	/* Different threads set different values to same key */

	for (int i = 0; i < N_THR; i++) {
		zassert_ok(pthread_create(&newthread[i], NULL, thread_top, NULL),
			   "attempt to create thread %d failed", i);
	}

	for (int i = 0; i < N_THR; i++) {
		zassert_ok(pthread_join(newthread[i], &retval), "failed to join thread %d", i);
	}

	zassert_ok(pthread_key_delete(key), "attempt to delete key failed");
}

ZTEST(key, test_key_Nto1_thread)
{
	pthread_t newthread;

	zassert_ok(pthread_once(&keys_once, make_keys), "attempt to create keys failed");

	/* Single thread associates its value with different keys */

	zassert_ok(pthread_create(&newthread, NULL, thread_func, NULL),
		   "attempt to create thread failed");

	zassert_ok(pthread_join(newthread, NULL), "failed to join thread");

	for (int i = 0; i < N_KEY; i++) {
		zassert_ok(pthread_key_delete(keys[i]), "attempt to delete keys[%d] failed", i);
	}
}

ZTEST(key, test_key_resource_leak)
{
	pthread_key_t key;

	for (size_t i = 0; i < CONFIG_POSIX_THREAD_KEYS_MAX; ++i) {
		zassert_ok(pthread_key_create(&key, NULL), "failed to create key %zu", i);
		zassert_ok(pthread_key_delete(key), "failed to delete key %zu", i);
	}
}

ZTEST(key, test_correct_key_is_deleted)
{
	pthread_key_t key;
	size_t j = CONFIG_POSIX_THREAD_KEYS_MAX - 1;
	pthread_key_t keys[CONFIG_POSIX_THREAD_KEYS_MAX];

	for (size_t i = 0; i < ARRAY_SIZE(keys); ++i) {
		zassert_ok(pthread_key_create(&keys[i], NULL), "failed to create key %zu", i);
	}

	key = keys[j];
	zassert_ok(pthread_key_delete(keys[j]));
	zassert_ok(pthread_key_create(&keys[j], NULL), "failed to create key %zu", j);

	zassert_equal(key, keys[j], "deleted key %x instead of key %x", keys[j], key);

	for (size_t i = 0; i < ARRAY_SIZE(keys); ++i) {
		zassert_ok(pthread_key_delete(keys[i]), "failed to delete key %zu", i);
	}
}

static void *setspecific_thread(void *count)
{
	int value = 42;
	int *alloc_count = count;

	while (1) {
		pthread_key_t key;

		zassert_ok(pthread_key_create(&key, NULL), "failed to create key");
		if (pthread_setspecific(key, &value) == ENOMEM) {
			break;
		};
		*alloc_count += 1;
	}

	return NULL;
}

ZTEST(key, test_thread_specific_data_deallocation)
{
	pthread_t thread;
	static int alloc_count_t0;
	static int alloc_count_t1;

	zassert_ok(pthread_create(&thread, NULL, setspecific_thread, &alloc_count_t0),
		"attempt to create thread failed");
	zassert_ok(pthread_join(thread, NULL), "failed to join thread");
	printk("first thread allocated %d keys", alloc_count_t0);

	zassert_ok(pthread_create(&thread, NULL, setspecific_thread, &alloc_count_t1),
		"attempt to create thread failed");
	zassert_ok(pthread_join(thread, NULL), "failed to join thread");
	printk("second thread allocated %d keys", alloc_count_t1);

	zassert_equal(alloc_count_t0, alloc_count_t1,
		"failed to deallocate thread specific data");
}

static struct k_sem sem_worker_ready;
static struct k_sem sem_key_deleted;
static bool dtor_executed;

static void dtor_active_thread(void *arg)
{
	ARG_UNUSED(arg);
	dtor_executed = true;
}

static void *key_delete_worker(void *arg)
{
	pthread_key_t *key = arg;
	int val = 0x1234;

	zassert_ok(pthread_setspecific(*key, &val),
		   "failed to set thread-specific data");

	/* Signal that data has been bound to the key */
	k_sem_give(&sem_worker_ready);

	/* Wait until key deletion completes before exiting */
	k_sem_take(&sem_key_deleted, K_FOREVER);

	return NULL;
}

/**
 * @brief Verify pthread_key_delete() on key bound to active thread.
 *
 * Verifies that deleting a key while a thread holds thread-specific data
 * unlinks the key from the thread's internal list, suppresses destructor
 * invocation at thread exit per IEEE 1003.1, and does not cause double-free
 * or memory corruption.
 */
ZTEST(key, test_key_delete_active_thread)
{
	pthread_t thread;
	pthread_key_t key;

	dtor_executed = false;
	k_sem_init(&sem_worker_ready, 0, 1);
	k_sem_init(&sem_key_deleted, 0, 1);

	zassert_ok(pthread_key_create(&key, dtor_active_thread),
		   "failed to create key");

	zassert_ok(pthread_create(&thread, NULL, key_delete_worker, &key),
		   "failed to create worker thread");

	/* Wait deterministically for worker thread to bind data */
	k_sem_take(&sem_worker_ready, K_FOREVER);

	/* Delete key while worker thread is still alive and blocked */
	zassert_ok(pthread_key_delete(key), "failed to delete key");

	/* Release worker thread to exit and finalize */
	k_sem_give(&sem_key_deleted);

	/* Wait for worker thread to exit and finalize */
	zassert_ok(pthread_join(thread, NULL), "failed to join worker thread");

	/* Per IEEE 1003.1, destructor must not be called for deleted keys */
	zassert_false(dtor_executed, "destructor was executed for deleted key");
}

#ifndef PTHREAD_DESTRUCTOR_ITERATIONS
#define PTHREAD_DESTRUCTOR_ITERATIONS _POSIX_THREAD_DESTRUCTOR_ITERATIONS
#endif

#define N_DTOR_KEY (PTHREAD_DESTRUCTOR_ITERATIONS + 2)

static pthread_key_t dtor_keys[N_DTOR_KEY];
static atomic_t dtor_calls;

static void dtor_count(void *arg)
{
	ARG_UNUSED(arg);
	atomic_inc(&dtor_calls);
}

static void *set_all_dtor_keys(void *arg)
{
	ARG_UNUSED(arg);

	for (size_t i = 0; i < N_DTOR_KEY; i++) {
		zassert_ok(pthread_setspecific(dtor_keys[i], &dtor_keys[i]));
	}

	return NULL;
}

/**
 * @brief Verify every key's destructor runs when a thread holds more keys than
 * PTHREAD_DESTRUCTOR_ITERATIONS.
 */
ZTEST(key, test_destructor_called_for_every_key)
{
	pthread_t thread;

	atomic_set(&dtor_calls, 0);
	for (size_t i = 0; i < N_DTOR_KEY; i++) {
		zassert_ok(pthread_key_create(&dtor_keys[i], dtor_count));
	}

	zassert_ok(pthread_create(&thread, NULL, set_all_dtor_keys, NULL));
	zassert_ok(pthread_join(thread, NULL));

	zassert_equal(atomic_get(&dtor_calls), N_DTOR_KEY);

	for (size_t i = 0; i < N_DTOR_KEY; i++) {
		zassert_ok(pthread_key_delete(dtor_keys[i]));
	}
}

static pthread_key_t resetting_key;

static void dtor_resetting(void *arg)
{
	atomic_inc(&dtor_calls);
	(void)pthread_setspecific(resetting_key, arg);
}

static void *set_resetting_key(void *arg)
{
	ARG_UNUSED(arg);

	zassert_ok(pthread_setspecific(resetting_key, &resetting_key));

	return NULL;
}

/**
 * @brief Verify a destructor that keeps setting a value stops after
 * PTHREAD_DESTRUCTOR_ITERATIONS passes.
 */
ZTEST(key, test_destructor_iterations_bounded)
{
	pthread_t thread;

	atomic_set(&dtor_calls, 0);
	zassert_ok(pthread_key_create(&resetting_key, dtor_resetting));

	zassert_ok(pthread_create(&thread, NULL, set_resetting_key, NULL));
	zassert_ok(pthread_join(thread, NULL));

	zassert_equal(atomic_get(&dtor_calls), PTHREAD_DESTRUCTOR_ITERATIONS);

	zassert_ok(pthread_key_delete(resetting_key));
}

static void before(void *arg)
{
	ARG_UNUSED(arg);

	if (!IS_ENABLED(CONFIG_DYNAMIC_THREAD)) {
		/* skip redundant testing if there is no thread pool / heap allocation */
		ztest_test_skip();
	}
}

ZTEST_SUITE(key, NULL, NULL, before, NULL, NULL);
```

## src/mutex.c
```c
/*
 * Copyright (c) 2018 Intel Corporation
 *
 * SPDX-License-Identifier: Apache-2.0
 */

#include <errno.h>
#include <pthread.h>
#include <time.h>

#include <zephyr/sys/util.h>
#include <zephyr/ztest.h>

#define SLEEP_MS 100

static pthread_mutex_t mutex;

static void *normal_mutex_entry(void *p1)
{
	int i, rc;

	/* Sleep for maximum 300 ms as main thread is sleeping for 100 ms */

	for (i = 0; i < 3; i++) {
		rc = pthread_mutex_trylock(&mutex);
		if (rc == 0) {
			break;
		}
		k_msleep(SLEEP_MS);
	}

	zassert_false(rc, "try lock failed");
	TC_PRINT("mutex lock is taken\n");
	zassert_false(pthread_mutex_unlock(&mutex), "mutex unlock is failed");
	return NULL;
}

static void *recursive_mutex_entry(void *p1)
{
	zassert_false(pthread_mutex_lock(&mutex), "mutex is not taken");
	zassert_false(pthread_mutex_lock(&mutex), "mutex is not taken 2nd time"); /* NOSONAR */
	TC_PRINT("recursive mutex lock is taken\n");
	zassert_false(pthread_mutex_unlock(&mutex), "mutex is not unlocked");
	zassert_false(pthread_mutex_unlock(&mutex), "mutex is not unlocked");
	return NULL;
}

static void test_mutex_common(int type, void *(*entry)(void *arg))
{
	pthread_t th;
	int protocol;
	int actual_type;
	pthread_mutexattr_t mut_attr;
	struct sched_param schedparam;

	schedparam.sched_priority = 2;

	zassert_ok(pthread_mutexattr_init(&mut_attr));
	zassert_ok(pthread_mutexattr_settype(&mut_attr, type), "setting mutex type is failed");
	zassert_ok(pthread_mutex_init(&mutex, &mut_attr), "mutex initialization is failed");

	zassert_ok(pthread_mutexattr_gettype(&mut_attr, &actual_type),
		   "reading mutex type is failed");
	zassert_not_ok(pthread_mutexattr_getprotocol(NULL, &protocol));
	zassert_not_ok(pthread_mutexattr_getprotocol(&mut_attr, NULL));
	zassert_not_ok(pthread_mutexattr_getprotocol(NULL, NULL));

	zassert_not_ok(pthread_mutexattr_setprotocol(&mut_attr, PTHREAD_PRIO_INHERIT));
	zassert_not_ok(pthread_mutexattr_setprotocol(&mut_attr, PTHREAD_PRIO_PROTECT));
	zassert_ok(pthread_mutexattr_setprotocol(&mut_attr, PTHREAD_PRIO_NONE));
	zassert_ok(pthread_mutexattr_getprotocol(&mut_attr, &protocol),
		   "reading mutex protocol is failed");
	zassert_ok(pthread_mutexattr_destroy(&mut_attr));

	zassert_ok(pthread_mutex_lock(&mutex));

	zassert_equal(actual_type, type, "mutex type is not normal");
	zassert_equal(protocol, PTHREAD_PRIO_NONE, "mutex protocol is not prio_none");

	zassert_ok(pthread_create(&th, NULL, entry, NULL));

	k_msleep(SLEEP_MS);
	zassert_ok(pthread_mutex_unlock(&mutex));

	zassert_ok(pthread_join(th, NULL));
	zassert_ok(pthread_mutex_destroy(&mutex), "Destroying mutex is failed");
}

ZTEST(mutex, test_mutex_prioceiling_stubs)
{
#ifdef CONFIG_POSIX_THREAD_PRIO_PROTECT
	zassert_equal(pthread_mutex_getprioceiling(NULL, NULL), ENOSYS);
	zassert_equal(pthread_mutex_setprioceiling(NULL, 0, NULL), ENOSYS);
	zassert_equal(pthread_mutexattr_getprioceiling(NULL, NULL), ENOSYS);
	zassert_equal(pthread_mutexattr_setprioceiling(NULL, 0), ENOSYS);
#else
	ztest_test_skip();
#endif /* CONFIG_POSIX_THREAD_PRIO_PROTECT */
}

/**
 * @brief Test to demonstrate PTHREAD_MUTEX_NORMAL
 *
 * @details Mutex type is setup as normal. pthread_mutex_trylock
 *	    and pthread_mutex_lock are tested with mutex type being
 *	    normal.
 */
ZTEST(mutex, test_mutex_normal)
{
	test_mutex_common(PTHREAD_MUTEX_NORMAL, normal_mutex_entry);
}

/**
 * @brief Test to demonstrate PTHREAD_MUTEX_RECURSIVE
 *
 * @details Mutex type is setup as recursive. mutex will be locked
 *	    twice and unlocked for the same number of time.
 *
 */
ZTEST(mutex, test_mutex_recursive)
{
	test_mutex_common(PTHREAD_MUTEX_RECURSIVE, recursive_mutex_entry);
}

/**
 * @brief Test to demonstrate limited mutex resources
 *
 * @details Exactly CONFIG_MAX_PTHREAD_MUTEX_COUNT can be in use at once.
 */
ZTEST(mutex, test_mutex_resource_exhausted)
{
	size_t i;
	pthread_mutex_t m[CONFIG_MAX_PTHREAD_MUTEX_COUNT + 1];

	for (i = 0; i < CONFIG_MAX_PTHREAD_MUTEX_COUNT; ++i) {
		zassert_ok(pthread_mutex_init(&m[i], NULL), "failed to init mutex %zu", i);
	}

	/* try to initialize one more than CONFIG_MAX_PTHREAD_MUTEX_COUNT */
	zassert_equal(i, CONFIG_MAX_PTHREAD_MUTEX_COUNT);
	zassert_not_equal(0, pthread_mutex_init(&m[i], NULL),
			  "should not have initialized mutex %zu", i);

	for (; i > 0; --i) {
		zassert_ok(pthread_mutex_destroy(&m[i - 1]), "failed to destroy mutex %zu", i - 1);
	}
}

/**
 * @brief Test to that there are no mutex resource leaks
 *
 * @details Demonstrate that mutexes may be used over and over again.
 */
ZTEST(mutex, test_mutex_resource_leak)
{
	pthread_mutex_t m;

	for (size_t i = 0; i < 2 * CONFIG_MAX_PTHREAD_MUTEX_COUNT; ++i) {
		zassert_ok(pthread_mutex_init(&m, NULL), "failed to init mutex %zu", i);
		zassert_ok(pthread_mutex_destroy(&m), "failed to destroy mutex %zu", i);
	}
}

#define TIMEDLOCK_TIMEOUT_MS       200
#define TIMEDLOCK_TIMEOUT_DELAY_MS 100

BUILD_ASSERT(TIMEDLOCK_TIMEOUT_DELAY_MS >= 100, "TIMEDLOCK_TIMEOUT_DELAY_MS too small");
BUILD_ASSERT(TIMEDLOCK_TIMEOUT_MS >= 2 * TIMEDLOCK_TIMEOUT_DELAY_MS,
	     "TIMEDLOCK_TIMEOUT_MS too small");

static void timespec_add_ms(struct timespec *ts, uint32_t ms)
{
	bool oflow;

	ts->tv_nsec += ms * NSEC_PER_MSEC;
	oflow = ts->tv_nsec >= NSEC_PER_SEC;
	ts->tv_sec += oflow;
	ts->tv_nsec -= oflow * NSEC_PER_SEC;
}

static void *test_mutex_timedlock_fn(void *arg)
{
	struct timespec time_point;
	pthread_mutex_t *mtx = (pthread_mutex_t *)arg;
	int ret;

	zassume_ok(clock_gettime(CLOCK_REALTIME, &time_point));
	timespec_add_ms(&time_point, TIMEDLOCK_TIMEOUT_MS);

	ret = pthread_mutex_timedlock(mtx, &time_point);
	if (ret == 0) {
		(void)pthread_mutex_unlock(mtx);
	}

	return INT_TO_POINTER(ret);
}

/** @brief Test to verify @ref pthread_mutex_timedlock returns ETIMEDOUT */
ZTEST(mutex, test_mutex_timedlock)
{
	void *ret;
	pthread_t th;

	zassert_ok(pthread_mutex_init(&mutex, NULL));

	printk("Expecting timedlock with timeout of %d ms to fail\n", TIMEDLOCK_TIMEOUT_MS);
	zassert_ok(pthread_mutex_lock(&mutex));
	zassert_ok(pthread_create(&th, NULL, test_mutex_timedlock_fn, &mutex));
	zassert_ok(pthread_join(th, &ret));
	/* ensure timeout occurs */
	zassert_equal(ETIMEDOUT, POINTER_TO_INT(ret));

	printk("Expecting timedlock with timeout of %d ms to succeed after 100ms\n",
	       TIMEDLOCK_TIMEOUT_MS);
	zassert_ok(pthread_create(&th, NULL, test_mutex_timedlock_fn, &mutex));
	/* unlock before timeout expires */
	k_msleep(TIMEDLOCK_TIMEOUT_DELAY_MS);
	zassert_ok(pthread_mutex_unlock(&mutex));
	zassert_ok(pthread_join(th, &ret));
	/* ensure lock is successful, in spite of delay  */
	zassert_ok(POINTER_TO_INT(ret));

	zassert_ok(pthread_mutex_destroy(&mutex));
}

static void *static_init_contender(void *arg)
{
	pthread_mutex_t *m = arg;

	/* The main thread holds the mutex, so a non-blocking lock must fail. */
	zassert_equal(EBUSY, pthread_mutex_trylock(m));
	return NULL;
}

/**
 * @brief Verify a statically-initialized mutex works without pthread_mutex_init()
 *
 * @details A PTHREAD_MUTEX_INITIALIZER mutex must auto-initialize on first use
 *          and provide mutual exclusion, exercising the lazy-init path in
 *          to_posix_mutex().
 */
ZTEST(mutex, test_mutex_static_initializer)
{
	static pthread_mutex_t m = PTHREAD_MUTEX_INITIALIZER;
	pthread_t th;

	/* First lock triggers auto-initialization. */
	zassert_ok(pthread_mutex_lock(&m));

	/* A second thread must observe the mutex as held. */
	zassert_ok(pthread_create(&th, NULL, static_init_contender, &m));
	zassert_ok(pthread_join(th, NULL));

	zassert_ok(pthread_mutex_unlock(&m));

	/* Usable again after being released. */
	zassert_ok(pthread_mutex_lock(&m));
	zassert_ok(pthread_mutex_unlock(&m));

	zassert_ok(pthread_mutex_destroy(&m));
}

/**
 * @brief Verify a statically-initialized mutex reuses a slot with default type
 *
 * @details Destroying a recursive mutex must reset the pool slot's type. A
 *          subsequently auto-initialized static mutex reusing that slot must
 *          behave as PTHREAD_MUTEX_DEFAULT (non-recursive).
 */
ZTEST(mutex, test_mutex_static_initializer_after_destroy)
{
	static pthread_mutex_t m_static = PTHREAD_MUTEX_INITIALIZER;
	pthread_mutexattr_t attr;
	pthread_mutex_t m_rec;

	zassert_ok(pthread_mutexattr_init(&attr));
	zassert_ok(pthread_mutexattr_settype(&attr, PTHREAD_MUTEX_RECURSIVE));
	zassert_ok(pthread_mutex_init(&m_rec, &attr));
	zassert_ok(pthread_mutexattr_destroy(&attr));

	/* Lock twice and unlock twice to verify recursive behavior */
	zassert_ok(pthread_mutex_lock(&m_rec));
	zassert_ok(pthread_mutex_lock(&m_rec));
	zassert_ok(pthread_mutex_unlock(&m_rec));
	zassert_ok(pthread_mutex_unlock(&m_rec));

	/* Destroy recursive mutex to return slot to pool */
	zassert_ok(pthread_mutex_destroy(&m_rec));

	/* Lock statically-initialized mutex, which reclaims the pool slot */
	zassert_ok(pthread_mutex_lock(&m_static));

	/* Relocking from the same thread must return EBUSY, not succeed */
	zassert_equal(EBUSY, pthread_mutex_trylock(&m_static),
		      "static mutex inherited recursive type from destroyed slot");

	zassert_ok(pthread_mutex_unlock(&m_static));
	zassert_ok(pthread_mutex_destroy(&m_static));
}

static void before(void *arg)
{
	ARG_UNUSED(arg);

	if (!IS_ENABLED(CONFIG_DYNAMIC_THREAD)) {
		/* skip redundant testing if there is no thread pool / heap allocation */
		ztest_test_skip();
	}
}

ZTEST_SUITE(mutex, NULL, NULL, before, NULL, NULL);
```

## src/pthread.c
```c
/*
 * Copyright (c) 2018-2023 Intel Corporation
 *
 * SPDX-License-Identifier: Apache-2.0
 */

#include <pthread.h>
#include <semaphore.h>
#include <time.h>

#include <zephyr/sys/util.h>
#include <zephyr/ztest.h>

#define DETACH_THR_ID 2

#define N_THR_E    3
#define N_THR_T    4
#define BOUNCES    64
#define ONE_SECOND 1

/* Macros to test invalid states */
#define PTHREAD_CANCEL_INVALID -1
#define SCHED_INVALID          -1
#define PRIO_INVALID           -1
#define PTHREAD_INVALID        -1

static void *thread_top_exec(void *p1);
static void *thread_top_term(void *p1);

static pthread_mutex_t lock = PTHREAD_MUTEX_INITIALIZER;
static pthread_cond_t cvar0 = PTHREAD_COND_INITIALIZER;
static pthread_cond_t cvar1 = PTHREAD_COND_INITIALIZER;
static pthread_barrier_t barrier;

static sem_t main_sem;

static int bounce_failed;
static int bounce_done[N_THR_E];

static int curr_bounce_thread;

static int barrier_failed;
static int barrier_done[N_THR_E];
static int barrier_return[N_THR_E];

/* First phase bounces execution between two threads using a condition
 * variable, continuously testing that no other thread is mucking with
 * the protected state.  This ends with all threads going back to
 * sleep on the condition variable and being woken by main() for the
 * second phase.
 *
 * Second phase simply lines up all the threads on a barrier, verifies
 * that none run until the last one enters, and that all run after the
 * exit.
 *
 * Test success is signaled to main() using a traditional semaphore.
 */

static void *thread_top_exec(void *p1)
{
	int i, j, id = (int)POINTER_TO_INT(p1);
	int policy;
	struct sched_param schedparam;

	pthread_getschedparam(pthread_self(), &policy, &schedparam);
	printk("Thread %d starting with scheduling policy %d & priority %d\n", id, policy,
	       schedparam.sched_priority);
	/* Try a double-lock here to exercise the failing case of
	 * trylock.  We don't support RECURSIVE locks, so this is
	 * guaranteed to fail.
	 */
	pthread_mutex_lock(&lock);

	if (!pthread_mutex_trylock(&lock)) { /* NOSONAR */
		printk("pthread_mutex_trylock inexplicably succeeded\n");
		bounce_failed = 1;
	}

	pthread_mutex_unlock(&lock);

	for (i = 0; i < BOUNCES; i++) {

		pthread_mutex_lock(&lock);

		/* Wait for the current owner to signal us, unless we
		 * are the very first thread, in which case we need to
		 * wait a bit to be sure the other threads get
		 * scheduled and wait on cvar0.
		 */
		if (!(id == 0 && i == 0)) {
			zassert_equal(0, pthread_cond_wait(&cvar0, &lock), "");
		} else {
			pthread_mutex_unlock(&lock);
			usleep(USEC_PER_MSEC * 500U);
			pthread_mutex_lock(&lock);
		}

		/* Claim ownership, then try really hard to give someone
		 * else a shot at hitting this if they are racing.
		 */
		curr_bounce_thread = id;
		for (j = 0; j < 1000; j++) {
			if (curr_bounce_thread != id) {
				printk("Racing bounce threads\n");
				bounce_failed = 1;
				sem_post(&main_sem);
				pthread_mutex_unlock(&lock);
				return NULL;
			}
			sched_yield();
		}

		/* Next one's turn, go back to the top and wait.  */
		pthread_cond_signal(&cvar0);
		pthread_mutex_unlock(&lock);
	}

	/* Signal we are complete to main(), then let it wake us up.  Note
	 * that we are using the same mutex with both cvar0 and cvar1,
	 * which is non-standard but kosher per POSIX (and it works fine
	 * in our implementation
	 */
	pthread_mutex_lock(&lock);
	bounce_done[id] = 1;
	sem_post(&main_sem);
	pthread_cond_wait(&cvar1, &lock);
	pthread_mutex_unlock(&lock);

	/* Now just wait on the barrier.  Make sure no one else finished
	 * before we wait on it, then signal that we're done
	 */
	for (i = 0; i < N_THR_E; i++) {
		if (barrier_done[i]) {
			printk("Barrier exited early\n");
			barrier_failed = 1;
			sem_post(&main_sem);
		}
	}
	barrier_return[id] = pthread_barrier_wait(&barrier);
	barrier_done[id] = 1;
	sem_post(&main_sem);
	pthread_exit(p1);

	return NULL;
}

static void *timedjoin_thread(void *p1)
{
	int sleep_duration_ms = POINTER_TO_INT(p1);

	usleep(USEC_PER_MSEC * sleep_duration_ms);
	return NULL;
}

static int bounce_test_done(void)
{
	int i;

	if (bounce_failed) {
		return 1;
	}

	for (i = 0; i < N_THR_E; i++) {
		if (!bounce_done[i]) {
			return 0;
		}
	}

	return 1;
}

static int barrier_test_done(void)
{
	int i;

	if (barrier_failed) {
		return 1;
	}

	for (i = 0; i < N_THR_E; i++) {
		if (!barrier_done[i]) {
			return 0;
		}
	}

	return 1;
}

static void *thread_top_term(void *p1)
{
	pthread_t self;
	int policy, ret;
	int id = POINTER_TO_INT(p1);
	struct sched_param param, getschedparam;

	param.sched_priority = N_THR_T - id;

	self = pthread_self();

	/* Change priority of thread */
	zassert_false(pthread_setschedparam(self, SCHED_RR, &param),
		      "Unable to set thread priority!");

	zassert_false(pthread_getschedparam(self, &policy, &getschedparam),
		      "Unable to get thread priority!");

	printk("Thread %d starting with a priority of %d\n", id, getschedparam.sched_priority);

	if (id % 2) {
		ret = pthread_setcancelstate(PTHREAD_CANCEL_DISABLE, NULL);
		zassert_false(ret, "Unable to set cancel state!");
	}

	if (id >= DETACH_THR_ID) {
		zassert_ok(pthread_detach(self), "failed to set detach state");
		zassert_equal(pthread_detach(self), EINVAL, "re-detached thread!");
	}

	printk("Cancelling thread %d\n", id);
	pthread_cancel(self);
	printk("Thread %d could not be cancelled\n", id);
	sleep(ONE_SECOND);
	pthread_exit(p1);
	return NULL;
}

/* Test the internal priority conversion functions */
int zephyr_to_posix_priority(int z_prio, int *policy);
int posix_to_zephyr_priority(int priority, int policy);
ZTEST(pthread, test_pthread_priority_conversion)
{
	/*
	 *    ZEPHYR [-CONFIG_NUM_COOP_PRIORITIES, -1]
	 *                       TO
	 * POSIX(FIFO) [0, CONFIG_NUM_COOP_PRIORITIES - 1]
	 */
	for (int z_prio = -CONFIG_NUM_COOP_PRIORITIES, prio = CONFIG_NUM_COOP_PRIORITIES - 1,
		 p_prio, policy;
	     z_prio <= -1; z_prio++, prio--) {
		p_prio = zephyr_to_posix_priority(z_prio, &policy);
		zassert_equal(policy, SCHED_FIFO);
		zassert_equal(p_prio, prio, "%d %d\n", p_prio, prio);
		zassert_equal(z_prio, posix_to_zephyr_priority(p_prio, SCHED_FIFO));
	}

	/*
	 *  ZEPHYR [0, CONFIG_NUM_PREEMPT_PRIORITIES - 1]
	 *                      TO
	 * POSIX(RR) [0, CONFIG_NUM_PREEMPT_PRIORITIES - 1]
	 */
	for (int z_prio = 0, prio = CONFIG_NUM_PREEMPT_PRIORITIES - 1, p_prio, policy;
	     z_prio < CONFIG_NUM_PREEMPT_PRIORITIES; z_prio++, prio--) {
		p_prio = zephyr_to_posix_priority(z_prio, &policy);
		zassert_equal(policy, SCHED_RR);
		zassert_equal(p_prio, prio, "%d %d\n", p_prio, prio);
		zassert_equal(z_prio, posix_to_zephyr_priority(p_prio, SCHED_RR));
	}
}

ZTEST(pthread, test_pthread_execution)
{
	int i, ret;
	pthread_t newthread[N_THR_E];
	void *retval;
	int serial_threads = 0;
	static const char thr_name[] = "thread name";
	char thr_name_buf[CONFIG_THREAD_MAX_NAME_LEN];

	/*
	 * initialize barriers the standard way after deprecating
	 * PTHREAD_BARRIER_DEFINE().
	 */
	zassert_ok(pthread_barrier_init(&barrier, NULL, N_THR_E));

	sem_init(&main_sem, 0, 1);

	/* TESTPOINT: Try getting name of NULL thread (aka uninitialized
	 * thread var).
	 */
	ret = pthread_getname_np(PTHREAD_INVALID, thr_name_buf, sizeof(thr_name_buf));
	zassert_equal(ret, ESRCH, "uninitialized getname!");

	for (i = 0; i < N_THR_E; i++) {
		ret = pthread_create(&newthread[i], NULL, thread_top_exec, INT_TO_POINTER(i));
	}

	/* TESTPOINT: Try setting name of NULL thread (aka uninitialized
	 * thread var).
	 */
	ret = pthread_setname_np(PTHREAD_INVALID, thr_name);
	zassert_equal(ret, ESRCH, "uninitialized setname!");

	/* TESTPOINT: Try getting thread name with no buffer */
	ret = pthread_getname_np(newthread[0], NULL, sizeof(thr_name_buf));
	zassert_equal(ret, EINVAL, "uninitialized getname!");

	/* TESTPOINT: Try setting thread name with no buffer */
	ret = pthread_setname_np(newthread[0], NULL);
	zassert_equal(ret, EINVAL, "uninitialized setname!");

	/* TESTPOINT: Try setting thread name */
	ret = pthread_setname_np(newthread[0], thr_name);
	zassert_false(ret, "Set thread name failed!");

	/* TESTPOINT: Try getting thread name */
	ret = pthread_getname_np(newthread[0], thr_name_buf, sizeof(thr_name_buf));
	zassert_false(ret, "Get thread name failed!");

	/* TESTPOINT: Thread names match */
	ret = strncmp(thr_name, thr_name_buf, MIN(strlen(thr_name), strlen(thr_name_buf)));
	zassert_false(ret, "Thread names don't match!");

	while (!bounce_test_done()) {
		sem_wait(&main_sem);
	}

	/* TESTPOINT: Check if bounce test passes */
	zassert_false(bounce_failed, "Bounce test failed");

	printk("Bounce test OK\n");

	/* Wake up the worker threads */
	pthread_mutex_lock(&lock);
	pthread_cond_broadcast(&cvar1);
	pthread_mutex_unlock(&lock);

	while (!barrier_test_done()) {
		sem_wait(&main_sem);
	}

	/* TESTPOINT: Check if barrier test passes */
	zassert_false(barrier_failed, "Barrier test failed");

	for (i = 0; i < N_THR_E; i++) {
		pthread_join(newthread[i], &retval);
	}

	for (i = 0; i < N_THR_E; i++) {
		if (barrier_return[i] == PTHREAD_BARRIER_SERIAL_THREAD) {
			++serial_threads;
		}
	}

	/* TESTPOINT: Check only one PTHREAD_BARRIER_SERIAL_THREAD returned. */
	zassert_true(serial_threads == 1, "Bungled barrier return value(s)");

	printk("Barrier test OK\n");
}

ZTEST(pthread, test_pthread_termination)
{
	int32_t i, ret;
	pthread_t newthread[N_THR_T] = {0};
	void *retval;

	/* Creating 4 threads */
	for (i = 0; i < N_THR_T; i++) {
		zassert_ok(pthread_create(&newthread[i], NULL, thread_top_term, INT_TO_POINTER(i)));
	}

	/* TESTPOINT: Try setting invalid cancel state to current thread */
	ret = pthread_setcancelstate(PTHREAD_CANCEL_INVALID, NULL);
	zassert_equal(ret, EINVAL, "invalid cancel state set!");

	for (i = 0; i < N_THR_T; i++) {
		if (i < DETACH_THR_ID) {
			zassert_ok(pthread_join(newthread[i], &retval));
		}
	}

	/* TESTPOINT: Test for deadlock */
	ret = pthread_join(pthread_self(), &retval);
	zassert_equal(ret, EDEADLK, "thread joined with self inexplicably!");

	/* TESTPOINT: Try canceling a terminated thread */
	ret = pthread_cancel(newthread[0]);
	zassert_equal(ret, ESRCH, "cancelled a terminated thread!");
}

ZTEST(pthread, test_pthread_tryjoin)
{
	pthread_t th = {0};
	int sleep_duration_ms = 200;
	void *retval;

	/* Creating a thread that exits after 200ms*/
	zassert_ok(pthread_create(&th, NULL, timedjoin_thread, INT_TO_POINTER(sleep_duration_ms)));

	/* Attempting to join, when thread is still running, should fail */
	usleep(USEC_PER_MSEC * sleep_duration_ms / 2);
	zassert_equal(pthread_tryjoin_np(th, &retval), EBUSY);

	/* Sleep so thread will exit */
	usleep(USEC_PER_MSEC * sleep_duration_ms);

	/* Attempting to join without blocking should succeed now */
	zassert_ok(pthread_tryjoin_np(th, &retval));
}

ZTEST(pthread, test_pthread_timedjoin)
{
	pthread_t th = {0};
	int sleep_duration_ms = 200;
	void *ret;
	struct timespec not_done;
	struct timespec done;
	struct timespec invalid[] = {
		{.tv_nsec = -1},
		{.tv_nsec = NSEC_PER_SEC},
	};

	/* setup timespecs when the thread is still running and when it is done */
	clock_gettime(CLOCK_REALTIME, &not_done);
	clock_gettime(CLOCK_REALTIME, &done);
	not_done.tv_nsec += sleep_duration_ms / 2 * NSEC_PER_MSEC;
	done.tv_nsec += sleep_duration_ms * 1.5 * NSEC_PER_MSEC;
	while (not_done.tv_nsec >= NSEC_PER_SEC) {
		not_done.tv_sec++;
		not_done.tv_nsec -= NSEC_PER_SEC;
	}
	while (done.tv_nsec >= NSEC_PER_SEC) {
		done.tv_sec++;
		done.tv_nsec -= NSEC_PER_SEC;
	}

	/* Creating a thread that exits after 200ms*/
	zassert_ok(pthread_create(&th, NULL, timedjoin_thread, INT_TO_POINTER(sleep_duration_ms)));

	/* pthread_timedjoin-np must return EINVAL for invalid struct timespecs */
	zassert_equal(pthread_timedjoin_np(th, &ret, NULL), EINVAL);
	for (size_t i = 0; i < ARRAY_SIZE(invalid); ++i) {
		zassert_equal(pthread_timedjoin_np(th, &ret, &invalid[i]), EINVAL);
	}

	/* Attempting to join with a timeout, when the thread is still running should fail */
	zassert_equal(pthread_timedjoin_np(th, &ret, &not_done), ETIMEDOUT);

	/* Attempting to join with a timeout, when the thread is done, should succeed */
	zassert_ok(pthread_timedjoin_np(th, &ret, &done));
}

static void *create_thread1(void *p1)
{
	/* do nothing */
	return NULL;
}

ZTEST(pthread, test_pthread_descriptor_leak)
{
	pthread_t pthread1;

	/* If we are leaking descriptors, then this loop will never complete */
	for (size_t i = 0; i < CONFIG_POSIX_THREAD_THREADS_MAX * 2; ++i) {
		zassert_ok(pthread_create(&pthread1, NULL, create_thread1, NULL),
			   "unable to create thread %zu", i);
		zassert_ok(pthread_join(pthread1, NULL), "unable to join thread %zu", i);
	}
}

ZTEST(pthread, test_pthread_equal)
{
	zassert_true(pthread_equal(pthread_self(), pthread_self()));
	zassert_false(pthread_equal(pthread_self(), (pthread_t)4242));
}

static void cleanup_handler(void *arg)
{
	bool *boolp = (bool *)arg;

	*boolp = true;
}

static void *test_pthread_cleanup_entry(void *arg)
{
	bool executed[2] = {0};

	pthread_cleanup_push(cleanup_handler, &executed[0]);
	pthread_cleanup_push(cleanup_handler, &executed[1]);
	pthread_cleanup_pop(false);
	pthread_cleanup_pop(true);

	zassert_true(executed[0]);
	zassert_false(executed[1]);

	return NULL;
}

ZTEST(pthread, test_pthread_cleanup)
{
	pthread_t th;

	zassert_ok(pthread_create(&th, NULL, test_pthread_cleanup_entry, NULL));
	zassert_ok(pthread_join(th, NULL));
}

static bool testcancel_ignored;
static bool testcancel_failed;

static void *test_pthread_cancel_fn(void *arg)
{
	zassert_ok(pthread_setcancelstate(PTHREAD_CANCEL_DISABLE, NULL));

	testcancel_ignored = false;

	/* this should be ignored */
	pthread_testcancel();

	testcancel_ignored = true;

	/* this will mark it pending */
	zassert_ok(pthread_cancel(pthread_self()));

	/* enable the thread to be cancelled */
	zassert_ok(pthread_setcancelstate(PTHREAD_CANCEL_ENABLE, NULL));

	testcancel_failed = false;

	/* this should terminate the thread */
	pthread_testcancel();

	testcancel_failed = true;

	return NULL;
}

ZTEST(pthread, test_pthread_testcancel)
{
	pthread_t th;

	zassert_ok(pthread_create(&th, NULL, test_pthread_cancel_fn, NULL));
	zassert_ok(pthread_join(th, NULL));
	zassert_true(testcancel_ignored);
	zassert_false(testcancel_failed);
}

static void *test_pthread_setschedprio_fn(void *arg)
{
	int policy;
	int prio = 0;
	struct sched_param param;
	pthread_t self = pthread_self();

	zassert_equal(pthread_setschedprio(self, PRIO_INVALID), EINVAL, "EINVAL was expected");
	zassert_equal(pthread_setschedprio(PTHREAD_INVALID, prio), ESRCH, "ESRCH was expected");

	zassert_ok(pthread_setschedprio(self, prio));
	param.sched_priority = ~prio;
	zassert_ok(pthread_getschedparam(self, &policy, &param));
	zassert_equal(param.sched_priority, prio, "Priority unchanged");

	return NULL;
}

ZTEST(pthread, test_pthread_setschedprio)
{
	pthread_t th;

	zassert_ok(pthread_create(&th, NULL, test_pthread_setschedprio_fn, NULL));
	zassert_ok(pthread_join(th, NULL));
}

static int cleanup_order[2];
static int cleanup_calls;

static void cleanup_record(void *arg)
{
	cleanup_order[cleanup_calls++] = POINTER_TO_INT(arg);
}

static void *cleanup_on_exit_fn(void *arg)
{
	ARG_UNUSED(arg);

	pthread_cleanup_push(cleanup_record, INT_TO_POINTER(1));
	pthread_cleanup_push(cleanup_record, INT_TO_POINTER(2));
	pthread_exit(NULL);
	pthread_cleanup_pop(0);
	pthread_cleanup_pop(0);

	return NULL;
}

ZTEST(pthread, test_pthread_cleanup_on_exit)
{
	pthread_t th;

	cleanup_calls = 0;
	zassert_ok(pthread_create(&th, NULL, cleanup_on_exit_fn, NULL));
	zassert_ok(pthread_join(th, NULL));

	/* handlers still pushed at pthread_exit() run in reverse push order */
	zassert_equal(cleanup_calls, 2);
	zassert_equal(cleanup_order[0], 2);
	zassert_equal(cleanup_order[1], 1);
}

static void before(void *arg)
{
	ARG_UNUSED(arg);

	if (!IS_ENABLED(CONFIG_DYNAMIC_THREAD)) {
		/* skip redundant testing if there is no thread pool / heap allocation */
		ztest_test_skip();
	}
}

ZTEST_SUITE(pthread, NULL, NULL, before, NULL, NULL);
```

## src/pthread_kthread.c
```c
/*
 * Copyright (c) 2018-2023 Intel Corporation
 * Copyright (c) 2026 Göthel Software
 *
 * SPDX-License-Identifier: Apache-2.0
 */

#include <pthread.h>

#include <zephyr/kernel.h>
#include <zephyr/sys/util.h>
#include <zephyr/ztest.h>

extern k_tid_t pthread_to_zephyr_thread(pthread_t pth);

#define STACKSIZE 2000
static K_THREAD_STACK_DEFINE(kthread__stack, STACKSIZE);

static pthread_t pthread_thread2;
static struct k_thread *kthread_thread2;

static void *pthread_entry(void *arg)
{
	k_tid_t kself = k_current_get();

	ARG_UNUSED(arg);
	zassert_not_null(kself);

	pthread_t pself = pthread_self();

	zassert_not_equal(0, pself);
	pthread_thread2 = pself;

	k_tid_t kself2 = pthread_to_zephyr_thread(pself);

	zassert_equal_ptr(kself, kself2);
	return NULL;
}

static void kthread_entry(void)
{
	k_tid_t kself = k_current_get();

	zassert_not_null(kself);
	kthread_thread2 = kself;

	pthread_t pself = pthread_self();

	zassert_not_equal(0, pself);

	k_tid_t kself2 = pthread_to_zephyr_thread(pself);

	zassert_equal_ptr(kself, kself2);
}

ZTEST(pthread_kthread, test_pthread_kthread_self)
{
	k_tid_t kself = k_current_get();

	zassert_not_null(kself);

	pthread_t pself = pthread_self();

	zassert_not_equal(0, pself);

	k_tid_t kself2 = pthread_to_zephyr_thread(pself);

	zassert_equal_ptr(kself, kself2);
}

ZTEST(pthread_kthread, test_pthread_kthread_coop)
{
	pthread_t pthread_thread;
	struct k_thread kthread_thread;

	zassert_ok(pthread_create(&pthread_thread, NULL, &pthread_entry, NULL));

	k_thread_create(&kthread_thread, kthread__stack, STACKSIZE, (k_thread_entry_t)kthread_entry,
			NULL, NULL, NULL, K_PRIO_COOP(7), 0, K_NO_WAIT);

	zassert_ok(pthread_join(pthread_thread, NULL));
	zassert_equal(pthread_thread, pthread_thread2);

	zassert_ok(k_thread_join(&kthread_thread, K_FOREVER));
	zassert_equal_ptr(&kthread_thread, kthread_thread2);
}

static void before(void *arg)
{
	ARG_UNUSED(arg);

	if (!IS_ENABLED(CONFIG_DYNAMIC_THREAD)) {
		/* skip redundant testing if there is no thread pool / heap allocation */
		ztest_test_skip();
	}
}

ZTEST_SUITE(pthread_kthread, NULL, NULL, before, NULL, NULL);
```

## src/pthread_once.c
```c
/*
 * Copyright (c) 2026 Göthel Software
 *
 * SPDX-License-Identifier: Apache-2.0
 */

#include <pthread.h>

#include <zephyr/kernel.h>
#include <zephyr/sys/util.h>
#include <zephyr/ztest.h>
#include <zephyr/sys/atomic.h>
#include <zephyr/sys/atomic_types.h>

/* #define DEBUG_OUTPUT 1 */

#ifdef DEBUG_OUTPUT

#define dbg_PRINT(fmt, ...)                                                                        \
	{                                                                                          \
		char name[20];                                                                     \
                                                                                                   \
		pthread_getname_np(pthread_self(), name, sizeof(name));                            \
		fputs(name, stderr);                                                               \
		fputs(": ", stderr);                                                               \
		fprintf(stderr, (fmt)__VA_OPT__(,) __VA_ARGS__);                                   \
		fflush(stderr);                                                                    \
	}

#else

#define dbg_PRINT(fmt, ...)

#endif

#define ONCE_INIT_VALUE 0
static atomic_t once_value = ATOMIC_INIT(0);
static const atomic_val_t once_init_value = ONCE_INIT_VALUE;
static pthread_once_t once_control2 = PTHREAD_ONCE_INIT;

static void InitFunc(void)
{
	atomic_val_t o = atomic_get(&once_value);
	(void)o;
	dbg_PRINT("XXXX %ld -> %ld ...\n", o, o + 1);

	/* trigger race condition in pthread_once if not waiting for init-func completion. */
	k_yield();

	atomic_inc(&once_value);
	dbg_PRINT("XXXX %ld -> %ld done\n", o, o + 1);
}

ZTEST(pthread_once, test_0_single)
{
	pthread_setname_np(pthread_self(), "thread_M");
	atomic_set(&once_value, 0);
	static pthread_once_t once_control = PTHREAD_ONCE_INIT;

	/* 1st call */
	zassert_ok(pthread_once(&once_control, &InitFunc));
	zassert_equal(once_init_value + 1, atomic_get(&once_value));

	/* 2nd call */
	zassert_ok(pthread_once(&once_control, &InitFunc));
	zassert_equal(once_init_value + 1, atomic_get(&once_value));
}

ZTEST(pthread_once, test_1_badvalue)
{
	pthread_setname_np(pthread_self(), "thread_M");
	atomic_set(&once_value, 0);
	static pthread_once_t once_control = {99}; /* bad value */

	zassert_equal(EINVAL, pthread_once(&once_control, &InitFunc));
}

#define MY_MIN(a, b)    ((a) < (b) ? (a) : (b))
#define MY_THREAD_COUNT (MY_MIN(CONFIG_POSIX_THREAD_THREADS_MAX, CONFIG_MAX_PTHREAD_COND_COUNT) - 2)
static pthread_mutex_t m_tstart = PTHREAD_MUTEX_INITIALIZER;
static pthread_cond_t cv_tstart;
static pthread_cond_t cv_run[MY_THREAD_COUNT];

static void *AThread(void *arg)
{
	int *id_temp = (int *)arg;
	const int id = *id_temp;

	/* save handling of arg lifecycle */
	zassert_ok(pthread_mutex_lock(&m_tstart));
	{
		char name[20];

		snprintf(name, 20, "thread_%02d", id);
		pthread_setname_np(pthread_self(), name);
	}
	zassert_ok(pthread_cond_signal(&cv_tstart));

	/* post thread creation test launch */
	zassert_ok(pthread_cond_wait(&cv_run[id], &m_tstart));
	zassert_ok(pthread_mutex_unlock(&m_tstart) /* NOSONAR */);
	dbg_PRINT("begin\n");

	/* warm up scheduler */
	for (int i = 0; i < 4; ++i) {
		k_yield();
	}
	zassert_ok(pthread_once(&once_control2, &InitFunc));
	const atomic_val_t v = atomic_get(&once_value);

	zassert_equal(once_init_value + 1, v);

	dbg_PRINT("end\n");
	return NULL;
}

ZTEST(pthread_once, test_2_parallel)
{
	pthread_t threads[MY_THREAD_COUNT];

	pthread_setname_np(pthread_self(), "thread_M");
	pthread_cond_init(&cv_tstart, NULL);
	for (int i = 0; i < MY_THREAD_COUNT; ++i) {
		pthread_cond_init(&cv_run[i], NULL);
	}
	atomic_set(&once_value, 0);
	dbg_PRINT("begin\n");

	zassert_ok(pthread_mutex_lock(&m_tstart));
	for (int i = 0; i < MY_THREAD_COUNT; ++i) {
		/* save handling of arg lifecycle */
		zassert_ok(pthread_create(&threads[i], NULL, &AThread, &i));
		zassert_ok(pthread_cond_wait(&cv_tstart, &m_tstart));
	}
	for (int i = 0; i < MY_THREAD_COUNT; ++i) {
		zassert_ok(pthread_cond_signal(&cv_run[i]));
	}
	dbg_PRINT("run\n");
	zassert_ok(pthread_mutex_unlock(&m_tstart) /* NOSONAR */);

	for (int i = 0; i < MY_THREAD_COUNT; ++i) {
		zassert_ok(pthread_join(threads[i], NULL));
	}
	pthread_cond_destroy(&cv_tstart);
	for (int i = 0; i < MY_THREAD_COUNT; ++i) {
		pthread_cond_destroy(&cv_run[i]);
	}
	const atomic_val_t v = atomic_get(&once_value);

	dbg_PRINT("once_value %ld\n", v);
	zassert_equal(once_init_value + 1, v);
	dbg_PRINT("end\n");
}

static void before(void *arg)
{
	ARG_UNUSED(arg);
	dbg_PRINT("CONFIG_POSIX_THREAD_THREADS_MAX %d\n", CONFIG_POSIX_THREAD_THREADS_MAX);
	dbg_PRINT("CONFIG_MAX_PTHREAD_COND_COUNT %d\n", CONFIG_MAX_PTHREAD_COND_COUNT);
	dbg_PRINT("MY_THREAD_COUNT %d\n", MY_THREAD_COUNT);

	dbg_PRINT("CONFIG_SMP %d\n", IS_ENABLED(CONFIG_SMP));
	dbg_PRINT("CONFIG_MULTITHREADING %d\n", IS_ENABLED(CONFIG_MULTITHREADING));
	dbg_PRINT("CONFIG_TIMESLICE_PER_THREAD %d\n", IS_ENABLED(CONFIG_TIMESLICE_PER_THREAD));
	dbg_PRINT("CONFIG_SYS_CLOCK_TICKS_PER_SEC %d\n", CONFIG_SYS_CLOCK_TICKS_PER_SEC);
	dbg_PRINT("CONFIG_SCHED_DEADLINE %d\n", IS_ENABLED(CONFIG_SCHED_DEADLINE));

	if (!IS_ENABLED(CONFIG_DYNAMIC_THREAD)) {
		/* skip redundant testing if there is no thread pool / heap allocation */
		ztest_test_skip();
	}
}

ZTEST_SUITE(pthread_once, NULL, NULL, before, NULL, NULL);
```
