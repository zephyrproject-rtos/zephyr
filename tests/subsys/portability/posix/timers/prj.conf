## CMakeLists.txt
```
# SPDX-License-Identifier: Apache-2.0

cmake_minimum_required(VERSION 3.28.0)
find_package(Zephyr REQUIRED HINTS $ENV{ZEPHYR_BASE})
project(posix_timers)

FILE(GLOB app_sources src/*.c)

target_sources(app PRIVATE ${app_sources})

target_compile_options(app PRIVATE -U_POSIX_C_SOURCE -D_POSIX_C_SOURCE=200809L)
target_include_directories(app PRIVATE ${ZEPHYR_BASE}/subsys/portability/posix/options)
```

## Kconfig
```
# Copyright (c) 2023, Meta
# SPDX-License-Identifier: Apache-2.0

# Options specific to clock.c / test_realtime

config TEST_CLOCK_RT_ITERATIONS
	int "Number of iterations to check clock_gettime() reliability"
	range 10 100
	default 20
	help
	  This option is specific to posix_apis.test_realtime in clock.c

config TEST_CLOCK_RT_SLEEP_MS
	int "Time to sleep between iterations in milliseconds"
	range 50 1000
	default 100
	help
	  This option is specific to posix_apis.test_realtime in clock.c

config TEST_CLOCK_RT_ERROR_MS
	int "Maximum overshoot (error) in milliseconds"
	range 10 500
	default 10
	help
	  This option is specific to posix_apis.test_realtime in clock.c

source "Kconfig.zephyr"
```

## prj.conf
```kconfig
CONFIG_ZTEST=y

CONFIG_POSIX_AEP_CHOICE_PSE51=y
CONFIG_POSIX_MULTI_PROCESS=y
CONFIG_POSIX_TIMERS=y

# Needed for timer_create() when using SIGEV_THREAD
CONFIG_DYNAMIC_THREAD=y
CONFIG_DYNAMIC_THREAD_POOL_SIZE=1
CONFIG_THREAD_STACK_INFO=y
```

## src/clock.c
```c
/*
 * Copyright (c) 2018 Intel Corporation
 * Copyright (c) 2023, Meta
 *
 * SPDX-License-Identifier: Apache-2.0
 */

/* for tp_ge(), tp_diff() */
#include <posix_clock.h>

#include <sys/time.h>
#include <time.h>
#include <unistd.h>

#include <zephyr/ztest.h>
#include <zephyr/logging/log.h>

#define SLEEP_SECONDS 1
#define CLOCK_INVALID -1

LOG_MODULE_REGISTER(clock_test, LOG_LEVEL_DBG);

/* Set a particular time.  In this case, the output of: `date +%s -d 2018-01-01T15:45:01Z` */
static const struct timespec ref_ts = {1514821501, NSEC_PER_SEC / 2U};

static const clockid_t clocks[] = {
	CLOCK_MONOTONIC,
	CLOCK_REALTIME,
};

static const bool settable[] = {
	false,
	true,
};

ZTEST(posix_timers, test_clock_gettime)
{
	struct timespec ts;

	/* ensure argument validation is performed */
	errno = 0;
	zassert_equal(clock_gettime(CLOCK_INVALID, &ts), -1);
	zassert_equal(errno, EINVAL);

	if (false) {
		/* undefined behaviour */
		errno = 0;
		zassert_equal(clock_gettime(clocks[0], NULL), -1);
		zassert_equal(errno, EINVAL);
	}

	/* verify that we can call clock_gettime() on supported clocks */
	ARRAY_FOR_EACH(clocks, i) {
		ts = (struct timespec){-1, -1};
		zassert_ok(clock_gettime(clocks[i], &ts));
		zassert_not_equal(ts.tv_sec, -1);
		zassert_not_equal(ts.tv_nsec, -1);
	}
}

ZTEST(posix_timers, test_clock_settime)
{
	int64_t diff_ns;
	struct timespec ts = {0};

	BUILD_ASSERT(ARRAY_SIZE(settable) == ARRAY_SIZE(clocks));

	/* ensure argument validation is performed */
	errno = 0;
	zassert_equal(clock_settime(CLOCK_INVALID, &ts), -1);
	zassert_equal(errno, EINVAL);

	if (false) {
		/* undefined behaviour */
		errno = 0;
		zassert_equal(clock_settime(CLOCK_REALTIME, NULL), -1);
		zassert_equal(errno, EINVAL);
	}

	/* verify nanoseconds */
	errno = 0;
	ts = (struct timespec){0, NSEC_PER_SEC};
	zassert_equal(clock_settime(CLOCK_REALTIME, &ts), -1);
	zassert_equal(errno, EINVAL);
	errno = 0;
	ts = (struct timespec){0, -1};
	zassert_equal(clock_settime(CLOCK_REALTIME, &ts), -1);
	zassert_equal(errno, EINVAL);

	ARRAY_FOR_EACH(clocks, i) {
		if (!settable[i]) {
			/* should fail attempting to set unsettable clocks */
			errno = 0;
			zassert_equal(clock_settime(clocks[i], &ts), -1);
			zassert_equal(errno, EINVAL);
			continue;
		}

		zassert_ok(clock_settime(clocks[i], &ref_ts));

		/* read-back the time */
		zassert_ok(clock_gettime(clocks[i], &ts));
		/* dt should be >= 0, but definitely <= 1s */
		diff_ns = tp_diff(&ts, &ref_ts);
		zassert_true(diff_ns >= 0 && diff_ns <= NSEC_PER_SEC);
	}
}

ZTEST(posix_timers, test_realtime)
{
	struct timespec then, now;
	/*
	 * For calculating cumulative moving average
	 * Note: we do not want to assert any individual samples due to scheduler noise.
	 * The CMA filters out the noise so we can make an assertion (on average).
	 * https://en.wikipedia.org/wiki/Moving_average#Cumulative_moving_average
	 */
	int64_t cma_prev = 0;
	int64_t cma;
	int64_t x_i;
	/* lower and uppoer boundary for assertion */
	int64_t lo = CONFIG_TEST_CLOCK_RT_SLEEP_MS;
	int64_t hi = CONFIG_TEST_CLOCK_RT_SLEEP_MS + CONFIG_TEST_CLOCK_RT_ERROR_MS;
	/* lower and upper watermark */
	int64_t lo_wm = INT64_MAX;
	int64_t hi_wm = INT64_MIN;

	/* Loop n times, sleeping a little bit for each */
	(void)clock_gettime(CLOCK_REALTIME, &then);
	for (int i = 0; i < CONFIG_TEST_CLOCK_RT_ITERATIONS; ++i) {

		zassert_ok(k_usleep(USEC_PER_MSEC * CONFIG_TEST_CLOCK_RT_SLEEP_MS));
		(void)clock_gettime(CLOCK_REALTIME, &now);

		/* Make the delta milliseconds. */
		x_i = tp_diff(&now, &then) / NSEC_PER_MSEC;
		then = now;

		if (x_i < lo_wm) {
			/* update low watermark */
			lo_wm = x_i;
		}

		if (x_i > hi_wm) {
			/* update high watermark */
			hi_wm = x_i;
		}

		/* compute cumulative running average */
		cma = (x_i + i * cma_prev) / (i + 1);
		cma_prev = cma;
	}

	LOG_INF("n: %d, sleep: %d, margin: %d, lo: %lld, avg: %lld, hi: %lld",
		CONFIG_TEST_CLOCK_RT_ITERATIONS, CONFIG_TEST_CLOCK_RT_SLEEP_MS,
		CONFIG_TEST_CLOCK_RT_ERROR_MS, lo_wm, cma, hi_wm);
	zassert_between_inclusive(cma, lo, hi);
}

ZTEST(posix_timers, test_clock_getcpuclockid)
{
	int ret = 0;
	clockid_t clock_id = CLOCK_INVALID;

	ret = clock_getcpuclockid((pid_t)0, &clock_id);
	zassert_equal(ret, 0, "POSIX clock_getcpuclock id failed");
	zassert_equal(clock_id, CLOCK_PROCESS_CPUTIME_ID, "POSIX clock_getcpuclock id failed");

	ret = clock_getcpuclockid((pid_t)2482, &clock_id);
	zassert_equal(ret, EPERM, "POSIX clock_getcpuclock id failed");
}

ZTEST(posix_timers, test_clock_getres)
{
	int ret;
	struct timespec res;
	const struct timespec one_ns = {
		.tv_sec = 0,
		.tv_nsec = 1,
	};

	struct arg {
		clockid_t clock_id;
		struct timespec *res;
		int expect;
	};

	const struct arg args[] = {
		/* permuting over "invalid" inputs */
		{CLOCK_INVALID, NULL, -1},
		{CLOCK_INVALID, &res, -1},
		{CLOCK_REALTIME, NULL, 0},
		{CLOCK_MONOTONIC, NULL, 0},
		{CLOCK_PROCESS_CPUTIME_ID, NULL, 0},

		/* all valid inputs */
		{CLOCK_REALTIME, &res, 0},
		{CLOCK_MONOTONIC, &res, 0},
		{CLOCK_PROCESS_CPUTIME_ID, &res, 0},
	};

	ARRAY_FOR_EACH_PTR(args, arg) {
		errno = 0;
		res = (struct timespec){0};
		ret = clock_getres(arg->clock_id, arg->res);
		zassert_equal(ret, arg->expect);
		if (ret != 0) {
			zassert_equal(errno, EINVAL);
			continue;
		}
		if (arg->res != NULL) {
			zassert_true(tp_ge(arg->res, &one_ns));
		}
	}
}
```

## src/nanosleep.c
```c
/*
 * Copyright (c) 2018 Friedt Professional Engineering Services, Inc
 *
 * SPDX-License-Identifier: Apache-2.0
 */

#include <errno.h>
#include <stdint.h>
#include <time.h>

#include <zephyr/sys/clock.h>
#include <zephyr/ztest.h>

#define SELECT_NANOSLEEP       1
#define SELECT_CLOCK_NANOSLEEP 0

void common_lower_bound_check(int selection, clockid_t clock_id, int flags, const uint32_t s,
			      uint32_t ns);
int select_nanosleep(int selection, clockid_t clock_id, int flags, const struct timespec *rqtp,
		     struct timespec *rmtp);

static void common_errors(int selection, clockid_t clock_id, int flags)
{
	const int exp_err = (selection == SELECT_NANOSLEEP) ? -1 : EINVAL;
	struct timespec rem = {};
	struct timespec req = {};

	/*
	 * invalid parameters
	 */
	errno = 0;
	zassert_equal(select_nanosleep(selection, clock_id, flags, NULL, NULL), exp_err);
	if (selection == SELECT_NANOSLEEP) {
		zassert_equal(errno, EFAULT);
	} else {
		zassert_equal(errno, 0, "clock_nanosleep modified errno");
	}

	/* NULL request */
	errno = 0;
	zassert_equal(select_nanosleep(selection, clock_id, flags, NULL, &rem), exp_err);
	if (selection == SELECT_NANOSLEEP) {
		zassert_equal(errno, EFAULT);
	} else {
		zassert_equal(errno, 0, "clock_nanosleep modified errno");
	}
	/* Expect rem to be the same when function returns */
	zassert_equal(rem.tv_sec, 0, "actual: %d expected: %d", (int)rem.tv_sec, 0);
	zassert_equal(rem.tv_nsec, 0, "actual: %d expected: %d", (int)rem.tv_nsec, 0);

	/* negative times */
	errno = 0;
	req = (struct timespec){.tv_sec = -1, .tv_nsec = 0};
	zassert_equal(select_nanosleep(selection, clock_id, flags, &req, NULL), exp_err);
	if (selection == SELECT_NANOSLEEP) {
		zassert_equal(errno, EINVAL);
	} else {
		zassert_equal(errno, 0, "clock_nanosleep modified errno");
	}

	errno = 0;
	req = (struct timespec){.tv_sec = 0, .tv_nsec = -1};
	zassert_equal(select_nanosleep(selection, clock_id, flags, &req, NULL), exp_err);
	if (selection == SELECT_NANOSLEEP) {
		zassert_equal(errno, EINVAL);
	} else {
		zassert_equal(errno, 0, "clock_nanosleep modified errno");
	}

	errno = 0;
	req = (struct timespec){.tv_sec = -1, .tv_nsec = -1};
	zassert_equal(select_nanosleep(selection, clock_id, flags, &req, NULL), exp_err);
	if (selection == SELECT_NANOSLEEP) {
		zassert_equal(errno, EINVAL);
	} else {
		zassert_equal(errno, 0, "clock_nanosleep modified errno");
	}

	/* nanoseconds too high */
	errno = 0;
	req = (struct timespec){.tv_sec = 0, .tv_nsec = 1000000000};
	zassert_equal(select_nanosleep(selection, clock_id, flags, &req, NULL), exp_err);
	if (selection == SELECT_NANOSLEEP) {
		zassert_equal(errno, EINVAL);
	} else {
		zassert_equal(errno, 0, "clock_nanosleep modified errno");
	}

	/*
	 * Valid parameters
	 */
	errno = 0;

	/* Happy path, plus make sure the const input is unmodified */
	req = (struct timespec){.tv_sec = 1, .tv_nsec = 1};
	zassert_equal(select_nanosleep(selection, clock_id, flags, &req, NULL), 0);
	zassert_equal(errno, 0);
	zassert_equal(req.tv_sec, 1);
	zassert_equal(req.tv_nsec, 1);

	/* Sleep for 0.0 s. Expect req & rem to be the same when function returns */
	zassert_equal(select_nanosleep(selection, clock_id, flags, &req, &rem), 0);
	zassert_equal(errno, 0);
	zassert_equal(rem.tv_sec, 0, "actual: %d expected: %d", (int)rem.tv_sec, 0);
	zassert_equal(rem.tv_nsec, 0, "actual: %d expected: %d", (int)rem.tv_nsec, 0);

	/*
	 * req and rem point to the same timespec
	 *
	 * Normative spec says they may be the same.
	 * Expect rem to be zero after returning.
	 */
	req = (struct timespec){.tv_sec = 0, .tv_nsec = 1};
	zassert_equal(select_nanosleep(selection, clock_id, flags, &req, &req), 0);
	zassert_equal(errno, 0);
	zassert_equal(req.tv_sec, 0, "actual: %d expected: %d", (int)req.tv_sec, 0);
	zassert_equal(req.tv_nsec, 0, "actual: %d expected: %d", (int)req.tv_nsec, 0);
}

ZTEST(posix_timers, test_nanosleep_errors_errno)
{
	common_errors(SELECT_NANOSLEEP, CLOCK_REALTIME, 0);
}

ZTEST(posix_timers, test_clock_nanosleep_errors_errno)
{
	struct timespec rem = {};
	struct timespec req = {};

	common_errors(SELECT_CLOCK_NANOSLEEP, CLOCK_MONOTONIC, TIMER_ABSTIME);

	/* Absolute timeout in the past. */
	clock_gettime(CLOCK_MONOTONIC, &req);
	zassert_equal(clock_nanosleep(CLOCK_MONOTONIC, TIMER_ABSTIME, &req, &rem), 0);
	zassert_equal(rem.tv_sec, 0, "actual: %d expected: %d", (int)rem.tv_sec, 0);
	zassert_equal(rem.tv_nsec, 0, "actual: %d expected: %d", (int)rem.tv_nsec, 0);

	/* Absolute timeout in the past relative to the realtime clock. */
	clock_gettime(CLOCK_REALTIME, &req);
	zassert_equal(clock_nanosleep(CLOCK_REALTIME, TIMER_ABSTIME, &req, &rem), 0);
	zassert_equal(rem.tv_sec, 0, "actual: %d expected: %d", (int)rem.tv_sec, 0);
	zassert_equal(rem.tv_nsec, 0, "actual: %d expected: %d", (int)rem.tv_nsec, 0);
}

ZTEST(posix_timers, test_nanosleep_execution)
{
	/* sleep for 1ns */
	common_lower_bound_check(SELECT_NANOSLEEP, 0, 0, 0, 1);

	/* sleep for 1us + 1ns */
	common_lower_bound_check(SELECT_NANOSLEEP, 0, 0, 0, 1001);

	/* sleep for 500000000ns */
	common_lower_bound_check(SELECT_NANOSLEEP, 0, 0, 0, 500000000);

	/* sleep for 1s */
	common_lower_bound_check(SELECT_NANOSLEEP, 0, 0, 1, 0);

	/* sleep for 1s + 1ns */
	common_lower_bound_check(SELECT_NANOSLEEP, 0, 0, 1, 1);

	/* sleep for 1s + 1us + 1ns */
	common_lower_bound_check(SELECT_NANOSLEEP, 0, 0, 1, 1001);
}
```

## src/nanosleep_common.c
```c
/*
 * Copyright (c) 2018 Friedt Professional Engineering Services, Inc
 *
 * SPDX-License-Identifier: Apache-2.0
 */

#include <errno.h>
#include <stdint.h>
#include <time.h>

#include <zephyr/sys/clock.h>
#include <zephyr/ztest.h>

#define SELECT_NANOSLEEP       1
#define SELECT_CLOCK_NANOSLEEP 0

static inline uint64_t cycle_get_64(void)
{
	if (IS_ENABLED(CONFIG_TIMER_HAS_64BIT_CYCLE_COUNTER)) {
		return k_cycle_get_64();
	} else {
		return k_cycle_get_32();
	}
}

int select_nanosleep(int selection, clockid_t clock_id, int flags, const struct timespec *rqtp,
		     struct timespec *rmtp)
{
	if (selection == SELECT_NANOSLEEP) {
		return nanosleep(rqtp, rmtp);
	}
	return clock_nanosleep(clock_id, flags, rqtp, rmtp);
}

/**
 * @brief Check that a call to nanosleep has yielded execution for some minimum time.
 *
 * Check that the actual time slept is >= the total time specified by @p s (in seconds) and
 * @p ns (in nanoseconds).
 *
 * @note The time specified by @p s and @p ns is assumed to be absolute (i.e. a time-point)
 * when @p selection is set to @ref SELECT_CLOCK_NANOSLEEP. The time is assumed to be relative
 * when @p selection is set to @ref SELECT_NANOSLEEP.
 *
 * @param selection Either @ref SELECT_CLOCK_NANOSLEEP or @ref SELECT_NANOSLEEP
 * @param clock_id The clock to test (e.g. @ref CLOCK_MONOTONIC or @ref CLOCK_REALTIME)
 * @param flags Flags to pass to @ref clock_nanosleep
 * @param s Partial lower bound for yielded time (in seconds)
 * @param ns Partial lower bound for yielded time (in nanoseconds)
 */
void common_lower_bound_check(int selection, clockid_t clock_id, int flags, const uint32_t s,
			      uint32_t ns)
{
	int r;
	uint64_t actual_ns = 0;
	uint64_t exp_ns;
	uint64_t now;
	uint64_t then;
	struct timespec rem = {0, 0};
	struct timespec req = {s, ns};

	errno = 0;
	then = cycle_get_64();
	r = select_nanosleep(selection, clock_id, flags, &req, &rem);
	now = cycle_get_64();

	zassert_equal(r, 0, "actual: %d expected: %d", r, 0);
	zassert_equal(errno, 0, "actual: %d expected: %d", errno, 0);
	zassert_equal(req.tv_sec, s, "actual: %lld expected: %d", (long long)req.tv_sec, s);
	zassert_equal(req.tv_nsec, ns, "actual: %lld expected: %d", (long long)req.tv_nsec, ns);
	zassert_equal(rem.tv_sec, 0, "actual: %lld expected: %d", (long long)rem.tv_sec, 0);
	zassert_equal(rem.tv_nsec, 0, "actual: %lld expected: %d", (long long)rem.tv_nsec, 0);

	switch (selection) {
	case SELECT_NANOSLEEP:
		/* exp_ns and actual_ns are relative (i.e. durations) */
		actual_ns = k_cyc_to_ns_ceil64(now + then);
		break;
	case SELECT_CLOCK_NANOSLEEP:
		/* exp_ns and actual_ns are absolute (i.e. time-points) */
		actual_ns = k_cyc_to_ns_ceil64(now);
		break;
	default:
		zassert_unreachable();
		break;
	}

	exp_ns = (uint64_t)s * NSEC_PER_SEC + ns;
	/* round up to the nearest microsecond for k_busy_wait() */
	exp_ns = DIV_ROUND_UP(exp_ns, NSEC_PER_USEC) * NSEC_PER_USEC;

/* The comparison may be incorrect if counter wrap happened. In case of ARC HSDK platforms
 * we have high counter clock frequency (500MHz or 1GHz) so counter wrap quite likely to
 * happen if we wait long enough. As in some test cases we wait more than 1 second, there
 * are significant chances to get false-positive assertion.
 * TODO: switch test for k_cycle_get_64 usage where available.
 */
#if !defined(CONFIG_SOC_ARC_HSDK) && !defined(CONFIG_SOC_ARC_HSDK4XD)
	/* lower bounds check */
	zassert_true(actual_ns >= exp_ns, "actual: %llu expected: %llu", actual_ns, exp_ns);
#endif

	/* TODO: Upper bounds check when hr timers are available */
}
```

## src/timer.c
```c
/*
 * Copyright (c) 2018 Intel Corporation
 *
 * SPDX-License-Identifier: Apache-2.0
 */

#include <signal.h>
#include <time.h>
#include <unistd.h>

#include <zephyr/ztest.h>
#include <zephyr/logging/log.h>

#define SECS_TO_SLEEP  2
#define DURATION_SECS  1
#define DURATION_NSECS 0
#define PERIOD_SECS    0
#define PERIOD_NSECS   100000000

#define TEST_SIGNAL_VAL SIGTSTP

LOG_MODULE_REGISTER(timer_test);

static int exp_count;
static timer_t timerid = -1;

void handler(union sigval val)
{
	++exp_count;
	LOG_DBG("Handler Signal value %d for %d times", val.sival_int, exp_count);
	zassert_equal(val.sival_int, TEST_SIGNAL_VAL);
}

void test_timer(clockid_t clock_id, int sigev_notify)
{
	struct sigevent sig = {0};
	struct itimerspec value, ovalue;
	struct timespec ts, te;
	int64_t nsecs_elapsed, secs_elapsed;

	exp_count = 0;
	sig.sigev_notify = sigev_notify;
	sig.sigev_notify_function = handler;
	sig.sigev_value.sival_int = TEST_SIGNAL_VAL;

	/*TESTPOINT: Check if timer is created successfully*/
	zassert_ok(timer_create(clock_id, &sig, &timerid));

	value.it_value.tv_sec = DURATION_SECS;
	value.it_value.tv_nsec = DURATION_NSECS;
	value.it_interval.tv_sec = PERIOD_SECS;
	value.it_interval.tv_nsec = PERIOD_NSECS;
	zassert_ok(timer_settime(timerid, 0, &value, &ovalue));
	usleep(100 * USEC_PER_MSEC);
	/*TESTPOINT: Check if timer has started successfully*/
	zassert_ok(timer_gettime(timerid, &value));

	LOG_DBG("Timer fires every %d secs and  %d nsecs", (int)value.it_interval.tv_sec,
		(int)value.it_interval.tv_nsec);
	LOG_DBG("Time remaining to fire %d secs and  %d nsecs", (int)value.it_value.tv_sec,
		(int)value.it_value.tv_nsec);

	clock_gettime(clock_id, &ts);
	sleep(SECS_TO_SLEEP);
	clock_gettime(clock_id, &te);

	if (te.tv_nsec >= ts.tv_nsec) {
		secs_elapsed = te.tv_sec - ts.tv_sec;
		nsecs_elapsed = te.tv_nsec - ts.tv_nsec;
	} else {
		nsecs_elapsed = NSEC_PER_SEC + te.tv_nsec - ts.tv_nsec;
		secs_elapsed = (te.tv_sec - ts.tv_sec - 1);
	}

	uint64_t elapsed = secs_elapsed * NSEC_PER_SEC + nsecs_elapsed;
	uint64_t first_sig = value.it_value.tv_sec * NSEC_PER_SEC + value.it_value.tv_nsec;
	uint64_t sig_interval = value.it_interval.tv_sec * NSEC_PER_SEC + value.it_interval.tv_nsec;
	int expected_signal_count = (elapsed - first_sig) / sig_interval + 1;

	/*TESTPOINT: Check if POSIX timer test passed*/
	zassert_within(exp_count, expected_signal_count, 1, "POSIX timer test has failed %i != %i",
		       exp_count, expected_signal_count);
}

ZTEST(posix_timers, test_CLOCK_REALTIME__SIGEV_SIGNAL)
{
	test_timer(CLOCK_REALTIME, SIGEV_SIGNAL);
}

ZTEST(posix_timers, test_CLOCK_REALTIME__SIGEV_THREAD)
{
	test_timer(CLOCK_REALTIME, SIGEV_THREAD);
}

ZTEST(posix_timers, test_CLOCK_MONOTONIC__SIGEV_SIGNAL)
{
	test_timer(CLOCK_MONOTONIC, SIGEV_SIGNAL);
}

ZTEST(posix_timers, test_CLOCK_MONOTONIC__SIGEV_THREAD)
{
	test_timer(CLOCK_MONOTONIC, SIGEV_THREAD);
}

ZTEST(posix_timers, test_timer_overrun)
{
	struct sigevent sig = {0};
	struct itimerspec value;

	sig.sigev_notify = SIGEV_NONE;

	zassert_ok(timer_create(CLOCK_MONOTONIC, &sig, &timerid));

	/*Set the timer to expire every 500 milliseconds*/
	value.it_interval.tv_sec = 0;
	value.it_interval.tv_nsec = 500000000;
	value.it_value.tv_sec = 0;
	value.it_value.tv_nsec = 500000000;
	zassert_ok(timer_settime(timerid, 0, &value, NULL));
	k_sleep(K_MSEC(2500));

	zassert_equal(timer_getoverrun(timerid), 4, "Number of overruns is incorrect");
}

ZTEST(posix_timers, test_one_shot__SIGEV_SIGNAL)
{
	struct sigevent sig = {0};
	struct itimerspec value;

	exp_count = 0;
	sig.sigev_notify = SIGEV_SIGNAL;
	sig.sigev_notify_function = handler;
	sig.sigev_value.sival_int = TEST_SIGNAL_VAL;

	zassert_ok(timer_create(CLOCK_MONOTONIC, &sig, &timerid));

	/*Set the timer to expire only once*/
	value.it_interval.tv_sec = 0;
	value.it_interval.tv_nsec = 0;
	value.it_value.tv_sec = 0;
	value.it_value.tv_nsec = 100 * NSEC_PER_MSEC;
	zassert_ok(timer_settime(timerid, 0, &value, NULL));
	k_sleep(K_MSEC(300));

	zassert_equal(exp_count, 1, "Number of expiry is incorrect");
}

ZTEST(posix_timers, test_TIMER_ABSTIME_reference_clock)
{
	struct sigevent sig = {0};
	struct itimerspec value;
	struct timespec now;

	exp_count = 0;
	sig.sigev_notify = SIGEV_SIGNAL;
	sig.sigev_notify_function = handler;
	sig.sigev_value.sival_int = TEST_SIGNAL_VAL;

	zassert_ok(timer_create(CLOCK_MONOTONIC, &sig, &timerid));

	/*Set a 2-second relative timer to prime k_timer_remaining_get()*/
	value.it_interval.tv_sec = 0;
	value.it_interval.tv_nsec = 0;
	value.it_value.tv_sec = 2;
	value.it_value.tv_nsec = 0;
	zassert_ok(timer_settime(timerid, 0, &value, NULL));

	/*Re-arm immediately with TIMER_ABSTIME for now + 200 ms*/
	zassert_ok(clock_gettime(CLOCK_MONOTONIC, &now));
	value.it_interval.tv_sec = 0;
	value.it_interval.tv_nsec = 0;
	value.it_value.tv_sec = now.tv_sec;
	value.it_value.tv_nsec = now.tv_nsec + 200 * NSEC_PER_MSEC;
	if (value.it_value.tv_nsec >= NSEC_PER_SEC) {
		value.it_value.tv_sec++;
		value.it_value.tv_nsec -= NSEC_PER_SEC;
	}
	zassert_ok(timer_settime(timerid, TIMER_ABSTIME, &value, NULL));

	/*Verify the timer has not fired before the absolute expiry*/
	k_sleep(K_MSEC(100));
	zassert_equal(exp_count, 0, "TIMER_ABSTIME fired too early");

	/*Verify the timer fired after the absolute expiry*/
	k_sleep(K_MSEC(300));
	zassert_equal(exp_count, 1, "TIMER_ABSTIME fired %d times, expected 1", exp_count);
}

ZTEST(posix_timers, test_TIMER_ABSTIME_large_timeout)
{
	struct sigevent sig = {0};
	struct itimerspec value;
	struct timespec ref, orig;

	exp_count = 0;
	sig.sigev_notify = SIGEV_SIGNAL;
	sig.sigev_notify_function = handler;
	sig.sigev_value.sival_int = TEST_SIGNAL_VAL;

	zassert_ok(timer_create(CLOCK_REALTIME, &sig, &timerid));

	/*
	 * TIMER_ABSTIME at a large CLOCK_REALTIME value with a 5 s offset.
	 * Guards two timeout conversion bugs on 32-bit time_t toolchains:
	 * - uint32 truncation: storing absolute milliseconds in a uint32_t
	 *   instead of the relative wait from timespec_to_timeoutms()
	 * - time_t overflow: tv_sec * NSEC_PER_SEC wraps in 32-bit math
	 *   unless widened to int64_t before scaling (needs a multi-second
	 *   offset; same-second offsets cancel in the subtraction)
	 * After 2 s the timer must still be pending; after 5.5 s it must
	 * have fired once.
	 */
	zassert_ok(clock_gettime(CLOCK_REALTIME, &orig));
	ref.tv_sec = 1700000000;
	ref.tv_nsec = 0;
	zassert_ok(clock_settime(CLOCK_REALTIME, &ref));

	/* Set TIMER_ABSTIME to ref + 5 s */
	value.it_interval.tv_sec = 0;
	value.it_interval.tv_nsec = 0;
	value.it_value.tv_sec = ref.tv_sec + 5;
	value.it_value.tv_nsec = 0;
	zassert_ok(timer_settime(timerid, TIMER_ABSTIME, &value, NULL));
	zassert_ok(clock_settime(CLOCK_REALTIME, &orig));

	/* A broken build fires early; a correct 5 s timeout has not fired yet */
	k_sleep(K_MSEC(2000));
	zassert_equal(exp_count, 0, "TIMER_ABSTIME fired too early: tv_sec overflow not widened");

	/* A correct build fires exactly once at the 5 s absolute expiry */
	k_sleep(K_MSEC(3500));
	zassert_equal(exp_count, 1, "TIMER_ABSTIME fired %d times, expected 1", exp_count);
}

static atomic_t in_handler;
static atomic_t handler_calls;

static void busy_handler(union sigval val)
{
	ARG_UNUSED(val);

	atomic_set(&in_handler, 1);
	atomic_inc(&handler_calls);
	k_busy_wait(USEC_PER_MSEC);
	atomic_set(&in_handler, 0);
}

ZTEST(posix_timers, test_timer_delete_waits_for_handler)
{
	struct sigevent sig = {
		.sigev_notify = SIGEV_SIGNAL,
		.sigev_notify_function = busy_handler,
	};
	struct itimerspec value = {
		.it_value.tv_nsec = NSEC_PER_MSEC,
		.it_interval.tv_nsec = NSEC_PER_MSEC,
	};
	atomic_val_t calls;
	int64_t end;

	if (!IS_ENABLED(CONFIG_SMP) || (arch_num_cpus() < 2)) {
		ztest_test_skip();
	}

	for (int i = 0; i < 10; i++) {
		zassert_ok(timer_create(CLOCK_MONOTONIC, &sig, &timerid));
		zassert_ok(timer_settime(timerid, 0, &value, NULL));

		/* Delete the timer while its expiry function runs on another CPU. */
		end = k_uptime_get() + 100;
		while ((atomic_get(&in_handler) == 0) && (k_uptime_get() < end)) {
		}

		zassert_ok(timer_delete(timerid));
		timerid = -1;

		zassert_equal(atomic_get(&in_handler), 0,
			      "expiry function still running after timer_delete()");
	}

	calls = atomic_get(&handler_calls);
	k_msleep(20);
	zassert_equal(atomic_get(&handler_calls), calls,
		      "expiry function called after timer_delete()");
}

static void after(void *arg)
{
	ARG_UNUSED(arg);

	if (timerid != -1) {
		(void)timer_delete(timerid);
		timerid = -1;
	}
}

ZTEST_SUITE(posix_timers, NULL, NULL, NULL, after, NULL);
```
