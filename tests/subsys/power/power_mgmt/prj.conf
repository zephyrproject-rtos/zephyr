## CMakeLists.txt
```
# Copyright (c) 2020 Intel Corporation.
# SPDX-License-Identifier: Apache-2.0

cmake_minimum_required(VERSION 3.13.1)
find_package(Zephyr REQUIRED HINTS $ENV{ZEPHYR_BASE})
project(power_management_test)

target_sources(app PRIVATE src/dummy_driver.c)
if(${TEST_INTERFACES})
	target_sources(app PRIVATE src/pm_interfaces.c)
else()
	target_sources(app PRIVATE src/main.c)
endif()

target_include_directories(app PRIVATE
	${ZEPHYR_BASE}/kernel/include
	${ZEPHYR_BASE}/arch/${ARCH}/include
	${ZEPHYR_BASE}/subsys/power/policy)
```

## Kconfig
```
# Copyright (c) 2020 Intel Corporation.
# SPDX-License-Identifier: Apache-2.0

config SUBPOWER_TEST
	bool
	default y
	help
	  Hidden option enabling LPS_0 power state regardless of hardware
	  support. This ensures that power management hooks used in this
	  test to profile idle thread will be executed.

# Include Zephyr's Kconfig.
source "Kconfig"
```

## prj.conf
```kconfig
CONFIG_ZTEST=y
CONFIG_PM=y
CONFIG_PM_DEVICE=y
CONFIG_PM_POLICY_APP=y
CONFIG_MP_NUM_CPUS=1
```

## interface_prj.conf
```kconfig
CONFIG_ZTEST=y
CONFIG_PM=y
CONFIG_PM_DEVICE=y
CONFIG_PM_DEVICE_IDLE=y
CONFIG_PM_POLICY_APP=y
CONFIG_MP_NUM_CPUS=1
CONFIG_PM_DEBUG=y
```

## src/main.c
```c
/*
 * Copyright (c) 2020 Intel Corporation.
 *
 * SPDX-License-Identifier: Apache-2.0
 */

#include <sys/printk.h>
#include <zephyr.h>
#include <zephyr/types.h>
#include <ztest.h>
#include <ksched.h>
#include <kernel.h>
#include <power/power.h>
#include "dummy_driver.h"

#define SLEEP_MSEC 100
#define SLEEP_TIMEOUT K_MSEC(SLEEP_MSEC)

/* for checking power suspend and resume order between system and devices */
static bool enter_low_power;
static bool deep_sleep;
static bool notify_app_entry;
static bool notify_app_exit;
static bool set_pm;
static bool leave_idle;
static bool idle_entered;
/* 1: test low power case, 2: test deep sleep case */
static int in_case;

static const struct device *dev;
static struct dummy_driver_api *api;
/*
 * Weak power hook functions. Used on systems that have not implemented
 * power management.
 */
__weak void pm_power_state_set(struct pm_state_info info)
{
	/* at this point, notify_pm_state_entry() implemented in
	 * this file has been called and set_pm should have been set
	 */
	zassert_true(set_pm == true,
		     "Notification to enter suspend was not sent to the App");

	/* this function is called after devices enter low power state */
	uint32_t device_power_state;
	/* at this point, devices have been deactivated */
	device_get_power_state(dev, &device_power_state);
	zassert_false(device_power_state == DEVICE_PM_ACTIVE_STATE, NULL);

	/* this function is called when system entering low power state, so
	 * parameter state should not be PM_STATE_ACTIVE
	 */
	zassert_false(info.state == PM_STATE_ACTIVE,
		      "Entering low power state with a wrong parameter");
}

__weak void pm_power_state_exit_post_ops(struct pm_state_info info)
{
	/* pm_system_suspend is entered with irq locked
	 * unlock irq before leave pm_system_suspend
	 */
	irq_unlock(0);
}

/* Our PM policy handler */
struct pm_state_info pm_policy_next_state(int ticks)
{
	struct pm_state_info info = {};

	/* make sure this is idle thread */
	zassert_true(z_is_idle_thread_object(_current), NULL);
	zassert_true(ticks == _kernel.idle, NULL);
	idle_entered = true;

	if (enter_low_power) {
		enter_low_power = false;
		notify_app_entry = true;
		info.state = PM_STATE_RUNTIME_IDLE;
	} else if (deep_sleep) {
		deep_sleep = false;
		notify_app_entry = true;
		info.state = PM_STATE_SUSPEND_TO_RAM;
	} else {
		/* only test pm_policy_next_state()
		 * no PM operation done
		 */
		info.state = PM_STATE_ACTIVE;
	}
	return info;
}

/* implement in application, called by idle thread */
static void notify_pm_state_entry(enum pm_state state)
{
	uint32_t device_power_state;

	/* enter suspend */
	zassert_true(notify_app_entry == true,
		     "Notification to enter suspend was not sent to the App");
	zassert_true(z_is_idle_thread_object(_current), NULL);
	if (in_case == 1)
		zassert_equal(state, PM_STATE_RUNTIME_IDLE, NULL);
	if (in_case == 2)
		zassert_equal(state, PM_STATE_SUSPEND_TO_RAM, NULL);

	/* at this point, devices should not be active */
	device_get_power_state(dev, &device_power_state);
	zassert_false(device_power_state == DEVICE_PM_ACTIVE_STATE, NULL);
	set_pm = true;
	notify_app_exit = true;
}

/* implement in application, called by idle thread */
static void notify_pm_state_exit(enum pm_state state)
{
	uint32_t device_power_state;

	/* leave suspend */
	zassert_true(notify_app_exit == true,
		     "Notification to leave suspend was not sent to the App");
	zassert_true(z_is_idle_thread_object(_current), NULL);
	if (in_case == 1)
		zassert_equal(state, PM_STATE_RUNTIME_IDLE, NULL);
	if (in_case == 2)
		zassert_equal(state, PM_STATE_SUSPEND_TO_RAM, NULL);

	/* at this point, devices are active again*/
	device_get_power_state(dev, &device_power_state);
	zassert_equal(device_power_state, DEVICE_PM_ACTIVE_STATE, NULL);
	leave_idle = true;

}

/*
 * @brief test power idle
 *
 * @details
 *  - The global idle routine executes when no other work is available
 *  - The idle routine provide a timeout parameter to the suspend routine
 *    indicating the amount of time guaranteed to expire before the next
 *    timeout, pm_policy_next_state() handle this parameter.
 *  - In this case, pm_policy_next_sate() return PM_STATE_ACTIVE,
 *    so there is no low power operation happen.
 *
 * @see pm_policy_next_state()
 *
 * @ingroup power_tests
 */
void test_power_idle(void)
{
	TC_PRINT("give way to idle thread\n");
	k_sleep(SLEEP_TIMEOUT);
	zassert_true(idle_entered, "Never entered idle thread");
}

/*
 * @brief test power state transition
 *
 * @details
 *  - The system support control of power state ordering between
 *    subsystems and devices
 *  - The application can control system power state transitions in idle thread
 *    through pm_notify_pm_state_entry and pm_notify_pm_state_exit
 *
 * @see pm_notify_pm_state_entry(), pm_notify_pm_state_exit()
 *
 * @ingroup power_tests
 */
void test_power_state_trans(void)
{
	in_case = 1;
	enter_low_power = true;
	/* give way to idle thread */
	k_sleep(SLEEP_TIMEOUT);
	zassert_true(leave_idle, NULL);

	in_case = 2;
	deep_sleep = true;
	/* give way to idle thread */
	k_sleep(SLEEP_TIMEOUT);
	zassert_true(leave_idle, NULL);
	in_case = 0;
}

/*
 * @brief notification between system and device
 *
 * @details
 *  - device driver notify its power state change by device_pm_get and
 *    device_pm_put
 *  - system inform device system power state change through device interface
 *    device_pm_control
 *
 * @see device_pm_get(), device_pm_put(), device_set_power_state(),
 *      device_get_power_state()
 *
 * @ingroup power_tests
 */
void test_power_state_notification(void)
{
	uint32_t device_power_state;

	device_get_power_state(dev, &device_power_state);
	zassert_equal(device_power_state, DEVICE_PM_ACTIVE_STATE, NULL);

	api->close(dev);
	device_get_power_state(dev, &device_power_state);
	zassert_equal(device_power_state, DEVICE_PM_SUSPEND_STATE, NULL);
	/* reopen device as it will be closed in teardown */
	api->open(dev);
}

void test_setup(void)
{
	int ret;

	dev = device_get_binding(DUMMY_DRIVER_NAME);
	api = (struct dummy_driver_api *)dev->api;
	ret = api->open(dev);
	zassert_true(ret == 0, "Fail to open device");
}

void test_teardown(void)
{
	api->close(dev);
}

void test_main(void)
{
	struct pm_notifier notifier = {
		.state_entry = notify_pm_state_entry,
		.state_exit = notify_pm_state_exit,
	};

	pm_notifier_register(&notifier);

	ztest_test_suite(power_management_test,
			 ztest_1cpu_unit_test(test_power_idle),
			 ztest_unit_test_setup_teardown(test_power_state_trans,
							test_setup,
							test_teardown),
			 ztest_unit_test_setup_teardown(
						test_power_state_notification,
						test_setup,
						test_teardown));
	ztest_run_test_suite(power_management_test);
	pm_notifier_unregister(&notifier);
}
```

## src/dummy_driver.c
```c
/*
 * Copyright (c) 2020 Intel Corporation
 *
 * SPDX-License-Identifier: Apache-2.0
 */

#include <sys/printk.h>
#include <zephyr/types.h>
#include "dummy_driver.h"

static uint32_t device_power_state;

static int dummy_open(const struct device *dev)
{
	return device_pm_get_sync(dev);
}

static int dummy_close(const struct device *dev)
{
	return device_pm_put_sync(dev);
}

static uint32_t dummy_get_power_state(const struct device *dev)
{
	return device_power_state;
}

static int dummy_suspend(const struct device *dev)
{
	device_power_state = DEVICE_PM_SUSPEND_STATE;
	return 0;
}

static int dummy_resume_from_suspend(const struct device *dev)
{
	device_power_state = DEVICE_PM_ACTIVE_STATE;
	return 0;
}

static int dummy_device_pm_ctrl(const struct device *dev,
				uint32_t ctrl_command,
				uint32_t *state, device_pm_cb cb, void *arg)
{
	int ret = 0;

	switch (ctrl_command) {
	case DEVICE_PM_SET_POWER_STATE:
		if (*state == DEVICE_PM_ACTIVE_STATE) {
			ret = dummy_resume_from_suspend(dev);
		} else {
			ret = dummy_suspend(dev);
		}
		break;
	case DEVICE_PM_GET_POWER_STATE:
		*state = dummy_get_power_state(dev);
		break;
	default:
		ret = -EINVAL;

	}

	if (cb) {
		cb(dev, ret, state, arg);
	}

	return ret;
}

static const struct dummy_driver_api funcs = {
	.open = dummy_open,
	.close = dummy_close,
};

int dummy_init(const struct device *dev)
{
	device_pm_enable(dev);
	return 0;
}

DEVICE_DEFINE(dummy_driver, DUMMY_DRIVER_NAME, &dummy_init,
		    dummy_device_pm_ctrl, NULL, NULL, APPLICATION,
		    CONFIG_KERNEL_INIT_PRIORITY_DEFAULT, &funcs);
```

## src/dummy_driver.h
```c
/*
 * Copyright (c) 2020 Intel Corporation.
 *
 * SPDX-License-Identifier: Apache-2.0
 */

#include <zephyr.h>
#include <device.h>
#define DUMMY_DRIVER_NAME	"dummy_driver"

typedef int (*dummy_api_open_t)(const struct device *dev);

typedef int (*dummy_api_close_t)(const struct device *dev);

struct dummy_driver_api {
	dummy_api_open_t open;
	dummy_api_close_t close;
	dummy_api_close_t busy;
	dummy_api_close_t low_power_times;
	dummy_api_close_t pm_disable;
};
```

## src/pm_interfaces.c
```c
/*
 * Copyright (c) 2021 Intel Corporation.
 *
 * SPDX-License-Identifier: Apache-2.0
 */

#include <sys/printk.h>
#include <zephyr.h>
#include <zephyr/types.h>
#include <ztest.h>
#include <ksched.h>
#include <kernel.h>
#include <power/power.h>
#include "pm_policy.h"
#include "dummy_driver.h"

#define SLEEP_MSEC 100
#define SLEEP_TIMEOUT K_MSEC(SLEEP_MSEC)
static bool enter_low_power;
static bool enter_deep;
static const struct device *dev;
static struct dummy_driver_api *api;

const char * const z_pm_core_devices[] = {"dummy_driver", NULL};

/* Our PM policy handler */
struct pm_state_info pm_policy_next_state(int ticks)
{
	struct pm_state_info info;
	/* make sure this is idle thread */
	zassert_true(z_is_idle_thread_object(_current), NULL);
	zassert_true(ticks == _kernel.idle, NULL);

	if (enter_low_power) {
		enter_low_power = false;
		info.state = PM_STATE_RUNTIME_IDLE;
	} else if (enter_deep) {
		enter_deep = false;
		info.state = PM_STATE_SUSPEND_TO_RAM;
	} else {
		info.state = PM_STATE_ACTIVE;
	}
	return info;
}

/*
 * @brief test power state transition
 *
 * @details if some device can not to be suspended, the suspend process
 * will abort.
 *
 * @ingroup power_tests
 */
void test_device_cannot_suspend(void)
{
	int count, count1;

	struct pm_state_info info;
	/* system enter low power state
	 * the dummy device enter low power state once
	 */
	count = api->low_power_times(dev);
	enter_low_power = true;
	/* give way to idle thread */
	k_sleep(SLEEP_TIMEOUT);
	count1 = api->low_power_times(dev);
	zassert_true((count1 - count) == 1, NULL);
	pm_dump_debug_info();

	api->busy(dev);
	/* with a device busy, system cannot enter low power state*/
	enter_low_power = true;
	k_sleep(SLEEP_TIMEOUT);
	count = api->low_power_times(dev);
	zassert_equal(count, count1, NULL);
	pm_dump_debug_info();

	enter_low_power = false;
	enter_deep = true;
	k_sleep(SLEEP_TIMEOUT);
	count = api->low_power_times(dev);
	zassert_equal(count, count1, NULL);

	/* even with pm_power_state_force() */
	info.state = PM_STATE_SUSPEND_TO_RAM;
	pm_power_state_force(info);
	count = api->low_power_times(dev);
	zassert_equal(count, count1, NULL);

	/* since system never enter low power state, no harm done to
	 * call the resume function
	 */
	pm_system_resume();
}

void test_setup(void)
{

	dev = device_get_binding(DUMMY_DRIVER_NAME);
	api = (struct dummy_driver_api *)dev->api;
	api->open(dev);
}

void test_teardown(void)
{
	api->close(dev);
}

void test_suspend_device(void)
{
	int ret;
	uint32_t device_power_state;

	api->busy(dev);
	/* can't suspend a busy device */
	ret = pm_suspend_devices();
	zassert_equal(ret, -EBUSY, NULL);
	device_get_power_state(dev, &device_power_state);
	zassert_not_equal(device_power_state, DEVICE_PM_SUSPEND_STATE, NULL);
	/* then force suspend devices */
	ret = pm_force_suspend_devices();
	zassert_equal(ret, 0, NULL);
	device_get_power_state(dev, &device_power_state);
	zassert_equal(device_power_state, DEVICE_PM_FORCE_SUSPEND_STATE, NULL);
	pm_resume_devices();
}

#define DEVICE_PM_UNKNOWN_STATE 0xFF
void test_device_pm_state_str(void)
{
	int ret;

	ret = strcmp(device_pm_state_str(DEVICE_PM_ACTIVE_STATE), "active");
	zassert_true(ret == 0, NULL);

	ret = strcmp(device_pm_state_str(DEVICE_PM_LOW_POWER_STATE),
			"low power");
	zassert_true(ret == 0, NULL);
	ret = strcmp(device_pm_state_str(DEVICE_PM_SUSPEND_STATE), "suspend");
	zassert_true(ret == 0, NULL);
	ret = strcmp(device_pm_state_str(DEVICE_PM_FORCE_SUSPEND_STATE),
			"force suspend");
	zassert_true(ret == 0, NULL);
	ret = strcmp(device_pm_state_str(DEVICE_PM_OFF_STATE), "off");
	zassert_true(ret == 0, NULL);

	ret = strcmp(device_pm_state_str(DEVICE_PM_UNKNOWN_STATE), "");
	zassert_true(ret == 0, NULL);
}

void test_device_pm_disable(void)
{
	api->pm_disable(dev);
	zassert_equal(dev->pm->enable, false, NULL);
}

void test_main(void)
{
	ztest_test_suite(power_management_test,
			 ztest_unit_test_setup_teardown(test_suspend_device,
							test_setup,
							test_teardown),
			 ztest_unit_test_setup_teardown(test_device_cannot_suspend,
							test_setup,
							test_teardown),
			 ztest_unit_test(test_device_pm_disable),
			 ztest_unit_test(test_device_pm_state_str));
	ztest_run_test_suite(power_management_test);
}
```
