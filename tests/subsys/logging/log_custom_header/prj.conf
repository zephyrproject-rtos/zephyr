## CMakeLists.txt
```
# SPDX-License-Identifier: Apache-2.0

cmake_minimum_required(VERSION 3.28.0)
find_package(Zephyr REQUIRED HINTS $ENV{ZEPHYR_BASE})
project(log_custom_header)

FILE(GLOB app_sources src/*.c)
target_sources(app PRIVATE ${app_sources})

zephyr_include_directories(src)
```

## prj.conf
```kconfig
CONFIG_ZTEST=y
CONFIG_LOG=y
CONFIG_LOG_OUTPUT=y
CONFIG_LOG_PRINTK=n
CONFIG_LOG_CUSTOM_HEADER=y
CONFIG_LOG_MODE_IMMEDIATE=y
CONFIG_LOG_FUNC_NAME_PREFIX_DBG=n
```

## src/log_custom_header.c
```c
/*
 * Copyright (c) 2018 Nordic Semiconductor
 *
 * SPDX-License-Identifier: Apache-2.0
 */

/**
 * @file
 * @brief Test Custom Log Header
 */

#include <zephyr/kernel.h>
#include <zephyr/toolchain.h>
#include <zephyr/ztest.h>
#include <zephyr/logging/log_backend.h>
#include <zephyr/logging/log_ctrl.h>
#include <zephyr/logging/log.h>

LOG_MODULE_REGISTER(test, LOG_LEVEL_DBG);

static uint32_t count;
static char output[512];

static int cbprintf_callback(int c, void *ctx)
{
	char **p = ctx;
	**p = c;
	(*p)++;
	return c;
}

static void backend_process(const struct log_backend *const backend, union log_msg_generic *msg)
{
	char *pstr = output;
	size_t len;
	uint8_t *p = log_msg_get_package(&msg->log, &len);

	int slen = cbpprintf(cbprintf_callback, &pstr, p);

	output[slen] = '\0';

	count += 1;
}

static const struct log_backend_api backend_api = {
	.process = backend_process,
};

LOG_BACKEND_DEFINE(backend, backend_api, false);

/**
 * @brief Verify a user-supplied custom log prefix is prepended to messages.
 *
 * @details
 * Logs at each severity level through a backend that renders the message
 * package and confirms every rendered line is prefixed with the custom log
 * header (CUSTOM_LOG_PREFIX) ahead of the formatted text and arguments. This
 * validates that a custom header configured by the user is included in the
 * formatted log message.
 *
 * Test steps:
 * - Emit LOG_DBG/LOG_INF/LOG_WRN/LOG_ERR messages with format arguments.
 * - Process the log after each call so the backend renders the message.
 * - Assert the processed count and that each output carries the custom prefix.
 *
 * Expected result:
 * - Each rendered message begins with CUSTOM_LOG_PREFIX followed by the
 *   formatted text and arguments.
 *
 * @see log_msg_get_package()
 * @ingroup logging_tests
 * @verifies ZEP-SRS-11-3
 */
ZTEST(log_custom_header, test_macro_prefix)
{
	zassert_equal(count, 0);

	LOG_DBG("DBG %d", 0);
	LOG_PROCESS();
	zassert_equal(count, 1);
	zassert_mem_equal(output, CUSTOM_LOG_PREFIX "DBG 0", strlen(output));

	LOG_INF("INF %s", "foo");
	LOG_PROCESS();
	zassert_equal(count, 2);
	zassert_mem_equal(output, CUSTOM_LOG_PREFIX "INF foo", strlen(output));

	LOG_WRN("WRN %x", 0xff);
	LOG_PROCESS();
	zassert_equal(count, 3);
	zassert_mem_equal(output, CUSTOM_LOG_PREFIX "WRN ff", strlen(output));

	LOG_ERR("ERR %d %d %d", 1, 2, 3);
	LOG_PROCESS();
	zassert_equal(count, 4);
	zassert_mem_equal(output, CUSTOM_LOG_PREFIX "ERR 1 2 3", strlen(output));
}

static void *setup(void)
{
	log_init();
	return NULL;
}

static void before(void *notused)
{
	count = 0;
	output[0] = '\0';

	log_backend_enable(&backend, NULL, LOG_LEVEL_DBG);
}

static void after(void *notused)
{
	log_backend_disable(&backend);
}

ZTEST_SUITE(log_custom_header, NULL, setup, before, after, NULL);
```

## src/zephyr_custom_log.h
```c
/*
 * Copyright (c) 2022 Google, Inc.
 *
 * SPDX-License-Identifier: Apache-2.0
 */

#ifndef __ZEPHYR_CUSTOM_LOG_H__
#define __ZEPHYR_CUSTOM_LOG_H__

#define CUSTOM_LOG_PREFIX "[CUSTOM_PREFIX]"

#undef LOG_DBG
#undef LOG_INF
#undef LOG_WRN
#undef LOG_ERROR

#define LOG_DBG(...) Z_LOG(LOG_LEVEL_DBG, CUSTOM_LOG_PREFIX __VA_ARGS__)
#define LOG_INF(...) Z_LOG(LOG_LEVEL_INF, CUSTOM_LOG_PREFIX __VA_ARGS__)
#define LOG_WRN(...) Z_LOG(LOG_LEVEL_WRN, CUSTOM_LOG_PREFIX __VA_ARGS__)
#define LOG_ERROR(...) Z_LOG(LOG_LEVEL_ERR, CUSTOM_LOG_PREFIX __VA_ARGS__)

#endif /* __ZEPHYR_CUSTOM_LOG_H__ */
```
