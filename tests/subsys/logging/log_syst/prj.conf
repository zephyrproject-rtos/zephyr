## CMakeLists.txt
```
# SPDX-License-Identifier: Apache-2.0

cmake_minimum_required(VERSION 3.28.0)
find_package(Zephyr REQUIRED HINTS $ENV{ZEPHYR_BASE})
project(log_syst)

zephyr_include_directories(
${ZEPHYR_BASE}/tests/subsys/logging/log_syst/src
)

FILE(GLOB app_sources src/*.c)
target_sources(app PRIVATE ${app_sources})
```

## Kconfig
```
# SPDX-License-Identifier: Apache-2.0
# Copyright (c) 2022 Intel Corporation

config LOG_BACKEND_MOCK
	bool "MOCK backend"
	help
	  When enabled MOCK backend is used for logging. It is
	  used to capture the output buffer used for validation of
	  log messages. It will not output any logs.

if LOG_BACKEND_MOCK

backend = MOCK
backend-str = mock
source "subsys/logging/Kconfig.template.log_format_config"

endif # LOG_BACKEND_MOCK

# Include Zephyr's Kconfig.
source "Kconfig.zephyr"
```

## prj.conf
```kconfig
CONFIG_LOG=y
CONFIG_ASSERT=n
CONFIG_ZTEST=y
CONFIG_LOG_BACKEND_MOCK=y
CONFIG_LOG_OUTPUT=y
CONFIG_SOC_LOG_LEVEL_OFF=y
CONFIG_ARCH_LOG_LEVEL_OFF=y
CONFIG_KERNEL_LOG_LEVEL_OFF=y
CONFIG_LOG_RUNTIME_FILTERING=n
CONFIG_LOG_FUNC_NAME_PREFIX_DBG=n

# Use immediate mode so all messages are being
# printed. Under deferred mode, there may be
# dropped messages as there are quite a number of
# messages to be printed.
CONFIG_LOG_MODE_IMMEDIATE=y

# Need bigger stack for immediate mode
CONFIG_MAIN_STACK_SIZE=4096
CONFIG_ZTEST_STACK_SIZE=2048
```

## src/main.c
```c
/*
 * Copyright (c) 2022 Intel Corporation
 *
 * SPDX-License-Identifier: Apache-2.0
 */

/**
 * @file
 * @brief Test log message
 */

#include <zephyr/kernel.h>
#include <zephyr/logging/log.h>
#include "mock_backend.h"
#include <zephyr/sys/printk.h>
#include <zephyr/logging/log_backend.h>
#include <zephyr/logging/log_backend_std.h>
#include <zephyr/logging/log_ctrl.h>
#include <zephyr/logging/log_output.h>
#include <zephyr/tc_util.h>
#include <stdbool.h>
#include <zephyr/ztest.h>
#include <stdlib.h>

/** Hex string corresponding to "Debug message example, %d, %d, %d", 1, 2, 3.
 * PAYLOAD_MULTIPLE_ARGS defines the expected payload
 * in SYST format when multiple arguments are passed to log API.
 */
#define PAYLOAD_MULTIPLE_ARGS "4465627567206D657373616765206578616D706C652C2025642C2025642C20256"\
	"400010000000200000003000000"

LOG_BACKEND_DEFINE(log_backend_mock, mock_log_backend_api, false);

#define LOG_MODULE_NAME test
LOG_MODULE_REGISTER(LOG_MODULE_NAME, LOG_LEVEL_DBG);

/**
 * @brief Verify the correct format processing function is selected for the active output format.
 *
 * @details
 * The log output subsystem resolves the rendering function for a given output
 * format from an internal function-pointer table. This test confirms that when
 * MIPI SyS-T output is enabled the SyS-T processing function is selected, and
 * otherwise the plain text processing function is selected, ensuring log
 * messages are rendered into the configured machine-parseable format.
 *
 * Test steps:
 * - Query the format function for the active output type via log_format_func_t_get().
 * - Compare the returned pointer against the expected SyS-T or text processor.
 *
 * Expected result:
 * - The returned function pointer matches the processor for the active format.
 *
 * @see log_format_func_t_get()
 * @ingroup logging_tests
 * @verifies ZEP-SRS-11-2
 * @verifies ZEP-SRS-11-3
 * @verifies ZEP-SRS-11-16
 */
ZTEST(log_syst, test_log_syst_format_table_selection)
{
#ifdef CONFIG_LOG_MIPI_SYST_ENABLE
	uint32_t test_log_type_syst = LOG_OUTPUT_SYST;

	log_format_func_t test_log_output_func = log_format_func_t_get(test_log_type_syst);

	zassert_equal_ptr(test_log_output_func, log_output_msg_syst_process,
					"Correct Function pointer for SYST log\n"
					"format was not selected %p vs %p",
					test_log_output_func, log_output_msg_syst_process);

#elif CONFIG_LOG_BACKEND_MOCK_OUTPUT_DEFAULT == LOG_OUTPUT_TEXT

	uint32_t test_log_type_text = LOG_OUTPUT_TEXT;
	log_format_func_t test_log_output_func = log_format_func_t_get(test_log_type_text);

	zassert_equal_ptr(test_log_output_func, log_output_msg_process,
						"Function pointer for TEXT log format was not selected");

#endif

}

#ifdef CONFIG_LOG_MIPI_SYST_ENABLE

const char *type = "72";
const char *optional_flags = "0A";
const char *module_id = "00";

#ifdef CONFIG_64BIT
#define SUB_TYPE "0C"
#else
#define SUB_TYPE "0B"
#endif

/**
 * @brief Verify a single-argument log message is rendered into the expected SyS-T payload.
 *
 * @details
 * Emits a debug message with one integer argument and validates that the mock
 * backend captures a MIPI SyS-T encoded record whose type, flags, module id,
 * sub-type and payload match the expected hex sequence. This confirms log
 * content is rendered into the structured, machine-parseable SyS-T format for
 * post processing.
 *
 * Test steps:
 * - Emit a debug log with a formatted string and one integer argument.
 * - Validate the captured SyS-T message fields and payload against expected values.
 *
 * Expected result:
 * - The captured SyS-T record matches the expected encoded message and argument.
 *
 * @see validate_msg()
 * @ingroup logging_tests
 * @verifies ZEP-SRS-11-2
 * @verifies ZEP-SRS-11-3
 * @verifies ZEP-SRS-11-16
 */
ZTEST(log_syst, test_log_syst_data)
{
	LOG_DBG("Debug message example, %d", 1);

	const char *sub_type = SUB_TYPE;
	const char *payload =
	"4465627567206D657373616765206578616D706C652C2025640001000000";

	validate_msg(type, optional_flags, module_id, sub_type, payload);
}

/**
 * @brief Verify a multi-argument log message is rendered into the expected SyS-T payload.
 *
 * @details
 * Emits a debug message with several integer arguments and validates that the
 * mock backend captures a MIPI SyS-T encoded record with the expected payload.
 * This exercises printf-style rendering of multiple arguments into the
 * machine-parseable SyS-T output used for post processing.
 *
 * Test steps:
 * - Emit a debug log with a formatted string and multiple integer arguments.
 * - Validate the captured SyS-T message fields and payload against expected values.
 *
 * Expected result:
 * - The captured SyS-T record matches the expected encoded message and arguments.
 *
 * @see validate_msg()
 * @ingroup logging_tests
 * @verifies ZEP-SRS-11-2
 * @verifies ZEP-SRS-11-3
 * @verifies ZEP-SRS-11-16
 */
ZTEST(log_syst, test_log_syst_data_multiple_args)
{
	LOG_DBG("Debug message example, %d, %d, %d", 1, 2, 3);

	const char *sub_type = SUB_TYPE;
	char *payload = PAYLOAD_MULTIPLE_ARGS;

	validate_msg(type, optional_flags, module_id, sub_type, payload);
}

/**
 * @brief Verify a floating-point log message is rendered into the expected SyS-T payload.
 *
 * @details
 * Emits a debug message with a floating-point argument and validates that the
 * mock backend captures a MIPI SyS-T encoded record with the expected payload.
 * This confirms printf-style rendering of floating-point arguments into the
 * machine-parseable SyS-T output used for post processing.
 *
 * Test steps:
 * - Emit a debug log with a formatted string and a floating-point argument.
 * - Validate the captured SyS-T message fields and payload against expected values.
 *
 * Expected result:
 * - The captured SyS-T record matches the expected encoded message and float value.
 *
 * @see validate_msg()
 * @ingroup logging_tests
 * @verifies ZEP-SRS-11-2
 * @verifies ZEP-SRS-11-3
 * @verifies ZEP-SRS-11-16
 */
ZTEST(log_syst, test_log_syst_float_data)
{
	LOG_DBG("Debug message example, %f", 1.223);

	const char *sub_type = SUB_TYPE;
	const char *payload =
	"4465627567206D657373616765206578616D706C652C20256600C520B0726891F33F";

	validate_msg(type, optional_flags, module_id, sub_type, payload);
}

#else

/**
 * @brief Verify single-argument SyS-T rendering is skipped when SyS-T support is disabled.
 *
 * @details
 * When MIPI SyS-T output is not enabled in the build the SyS-T payload cannot
 * be produced, so this test is reported as skipped rather than failing. This
 * keeps the SyS-T post-processing checks contingent on the configured format.
 *
 * Test steps:
 * - Mark the test as skipped because SyS-T support is not enabled.
 *
 * Expected result:
 * - The test is reported as skipped.
 *
 * @see ztest_test_skip()
 * @ingroup logging_tests
 */
ZTEST(log_syst, test_log_syst_data)
{
	ztest_test_skip();
}

/**
 * @brief Verify multi-argument SyS-T rendering is skipped when SyS-T support is disabled.
 *
 * @details
 * When MIPI SyS-T output is not enabled in the build the SyS-T payload cannot
 * be produced, so this test is reported as skipped rather than failing. This
 * keeps the SyS-T post-processing checks contingent on the configured format.
 *
 * Test steps:
 * - Mark the test as skipped because SyS-T support is not enabled.
 *
 * Expected result:
 * - The test is reported as skipped.
 *
 * @see ztest_test_skip()
 * @ingroup logging_tests
 */
ZTEST(log_syst, test_log_syst_data_multiple_args)
{
	ztest_test_skip();
}

/**
 * @brief Verify floating-point SyS-T rendering is skipped when SyS-T support is disabled.
 *
 * @details
 * When MIPI SyS-T output is not enabled in the build the SyS-T payload cannot
 * be produced, so this test is reported as skipped rather than failing. This
 * keeps the SyS-T post-processing checks contingent on the configured format.
 *
 * Test steps:
 * - Mark the test as skipped because SyS-T support is not enabled.
 *
 * Expected result:
 * - The test is reported as skipped.
 *
 * @see ztest_test_skip()
 * @ingroup logging_tests
 */
ZTEST(log_syst, test_log_syst_float_data)
{
	ztest_test_skip();
}

#endif
/* test case main entry */

static void before(void *unused)
{
	const struct log_backend *backend;

	for (int i = 0; i < log_backend_count_get(); i++) {
		backend = log_backend_get(i);
		if (backend == &log_backend_mock) {
			log_backend_enable(backend, NULL, 4);
		} else {
			log_backend_disable(backend);
		}
	}
}

static void after(void *unused)
{
	const struct log_backend *backend;

	for (int i = 0; i < log_backend_count_get(); i++) {
		backend = log_backend_get(i);
		if (backend == &log_backend_mock) {
			log_backend_disable(backend);
		} else {
			log_backend_enable(backend, backend->cb->ctx, 4);
		}
	}
}

ZTEST_SUITE(log_syst, NULL, NULL, before, after, NULL);
```

## src/mock_backend.c
```c
/*
 * Copyright (c) 2022 Intel Corporation
 *
 * SPDX-License-Identifier: Apache-2.0
 */

#include "mock_backend.h"
#include <zephyr/ztest.h>
#include <zephyr/logging/log_core.h>
#include <zephyr/logging/log_backend_std.h>
#include <stdlib.h>

static uint32_t log_format_current = CONFIG_LOG_BACKEND_MOCK_OUTPUT_DEFAULT;

static uint8_t mock_output_buf[1];
uint8_t test_output_buf[256];
int pos_in_buf;

/**
 * @brief This function takes in the characters and copies
 * them in the temporary buffer.
 *
 * @return No. of characters copied to the temporary buffer.
 */
static int char_out(uint8_t *data, size_t length, void *ctx)
{
	ARG_UNUSED(ctx);
	size_t output_length = length;

	while (length > 0) {
		test_output_buf[pos_in_buf] = *data;
		pos_in_buf++;
		data++;
		length--;

		zassert_not_equal(pos_in_buf, sizeof(test_output_buf)-1,
				  "Increase the size of test_output_buf");
	}
	return output_length;
}

LOG_OUTPUT_DEFINE(log_output_mock, char_out, mock_output_buf, sizeof(mock_output_buf));

static void process(const struct log_backend *const backend,
		union log_msg_generic *msg)
{
	uint32_t flags = log_backend_std_get_flags();

	log_format_func_t log_output_func = log_format_func_t_get(log_format_current);

	log_output_func(&log_output_mock, &msg->log, flags);
}

bool is_kth_bit_set(int n, int k)
{
	return ((n & (1 << (k - 1))) != 0);
}

void validate_msg(const char *type, const char *optional_flags,
		  const char *module_id, const char *sub_type,
		  const char *payload)
{
	const char *raw_data_str = "SYS-T RAW DATA: ";
	const char *output_str = test_output_buf;
	const char *syst_format_headers[4] = {type, optional_flags, module_id, sub_type};
	const char *syst_headers_name[4] = {"type", "optional_flags", "module_id", "sub_type"};

	/* Validate "SYS-T RAW DATA: " prefix in the output_str */
	zassert_mem_equal(raw_data_str, output_str, strlen(raw_data_str),
			  "Incorrect Format comparison");

	output_str += strlen(raw_data_str);

	/* Validate the headers in the SYS-T data format */
	for (int i = 0; i < ARRAY_SIZE(syst_format_headers); i++) {
		zassert_mem_equal(output_str, syst_format_headers[i],
				  strlen(syst_format_headers[i]),
				  "Incorrect Comparison of %s", syst_headers_name[i]);

		output_str = output_str+2;
	}

	/* After the headers the output_str will contain the content of optional flags.
	 * Optional flags are contained in 1st byte of data in output_str. There are 4 bits
	 * reserved for Optional flags. 1st bit = Location, 2nd Bit = payload length
	 * 3rd bit = Sys-t Checksum, 4th bit = Sys-t Timestamp. Support for validating the
	 * content based on optional flags is not supported, hence the corresponding
	 * characters are skipped. skip_bytes array contains the number of hex characters
	 * to skip in the output_str.
	 */
	size_t skip_bytes[5] = {0, 18, 4, 8, 16};

	for (int i = 1; i < ARRAY_SIZE(skip_bytes); i++) {
		if (is_kth_bit_set(strtol(optional_flags, 0, 16), i)) {
			output_str += skip_bytes[i];
		}
	}

	zassert_mem_equal(output_str, payload, strlen(payload),
			  "Incorrect Comparison of payload");

	memset(test_output_buf, 0, sizeof(test_output_buf));
	pos_in_buf = 0;
}

static int format_set(const struct log_backend *const backend, uint32_t log_type)
{
	log_format_current = log_type;
	return 0;
}

static void mock_init(struct log_backend const *const backend)
{

}

static void panic(struct log_backend const *const backend)
{

}

const struct log_backend_api mock_log_backend_api = {
	.process = process,
	.init = mock_init,
	.format_set = format_set,
	.panic = panic
};
```

## src/mock_backend.h
```c
/*
 * Copyright (c) 2022 Intel Corporation
 *
 * SPDX-License-Identifier: Apache-2.0
 */

#ifndef SRC_MOCK_BACKEND_H__
#define SRC_MOCK_BACKEND_H__

#include <zephyr/logging/log_backend.h>

#ifdef __cplusplus
extern "C" {
#endif

extern const struct log_backend_api mock_log_backend_api;
struct mock_log_backend {
	bool panic;
};

/**
 * @brief This function validates the log message.
 *
 * @param type Field in message header to indicate the type of SyS-T message.
 * @param optional_flags Optional Flags in message header.
 * @param module_id ModuleID in a Message Header distinguish between multiple
 *					instances of the same Origin.
 * @param sub_type Enumerated types for representing the sub-type of a Message.
 * @param payload The content of the Message.
 */
void validate_msg(const char *type, const char *optional_flags,
		  const char *module_id, const char *sub_type,
		  const char *payload);

#define MOCK_LOG_BACKEND_DEFINE(name, autostart) \
	static struct mock_log_backend name##_mock; \
	LOG_BACKEND_DEFINE(name, mock_log_backend_api, autostart, &name##_mock)

#ifdef __cplusplus
}
#endif

#endif /* SRC_MOCK_BACKEND_H__ */
```
