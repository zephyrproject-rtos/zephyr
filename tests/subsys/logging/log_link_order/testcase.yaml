## tests/subsys/logging/log_link_order/testcase.yaml
```yaml
tests:
  logging.log_link_order:
    integration_platforms:
      - native_sim
    tags:
      - log_links
      - logging
    filter: not CONFIG_LOG_MODE_IMMEDIATE
```

## tests/subsys/logging/log_links/testcase.yaml
```yaml
tests:
  logging.log_links:
    integration_platforms:
      - native_sim/native
    tags:
      - log_links
      - logging
    filter: not CONFIG_LOG_MODE_IMMEDIATE
```

## tests/subsys/logging/log_list/testcase.yaml
```yaml
common:
  integration_platforms:
    - native_posix

tests:
  logging.log_list:
    tags: log_list logging
```

## tests/subsys/logging/log_msg/testcase.yaml
```yaml
common:
  platform_type:
    - qemu
    - native
  tags:
    - log_api
    - logging
  integration_platforms:
    - native_posix
  filter: not CONFIG_LOG_ALWAYS_RUNTIME
tests:
  logging.message:
    extra_configs:
      - CONFIG_CBPRINTF_COMPLETE=y

  logging.message.no_overflow:
    extra_configs:
      - CONFIG_LOG_MODE_OVERFLOW=n

  logging.message.64b_timestamp:
    extra_configs:
      - CONFIG_CBPRINTF_COMPLETE=y
      - CONFIG_LOG_TIMESTAMP_64BIT=y

  logging.message.fp:
    extra_configs:
      - CONFIG_CBPRINTF_COMPLETE=y
      - CONFIG_CBPRINTF_FP_SUPPORT=y

  logging.message.fp_64b_timestamp:
    extra_configs:
      - CONFIG_CBPRINTF_COMPLETE=y
      - CONFIG_CBPRINTF_FP_SUPPORT=y
      - CONFIG_LOG_TIMESTAMP_64BIT=y
```

## tests/subsys/logging/log_msg2/testcase.yaml
```yaml
common:
  filter: CONFIG_QEMU_TARGET or CONFIG_BOARD_NATIVE_POSIX
  tags: log_api logging
  # FIXME: qemu_arc_hs6x excluded, see #38041
  platform_exclude: qemu_arc_hs6x
  integration_platforms:
    - native_posix
tests:
  logging.log_msg2:
    extra_configs:
      - CONFIG_CBPRINTF_COMPLETE=y

  logging.log_msg2_no_overflow:
    extra_configs:
      - CONFIG_LOG_MODE_OVERFLOW=n

  logging.log_msg2_64b_timestamp:
    # FIXME: see #39978
    platform_exclude: qemu_cortex_a9
    extra_configs:
      - CONFIG_CBPRINTF_COMPLETE=y
      - CONFIG_LOG_TIMESTAMP_64BIT=y

  logging.log_msg2_fp:
    extra_configs:
      - CONFIG_CBPRINTF_COMPLETE=y
      - CONFIG_CBPRINTF_FP_SUPPORT=y

  logging.log_msg2_fp_64b_timestamp:
    # FIXME: see #39978
    platform_exclude: qemu_cortex_a9
    extra_configs:
      - CONFIG_CBPRINTF_COMPLETE=y
      - CONFIG_CBPRINTF_FP_SUPPORT=y
      - CONFIG_LOG_TIMESTAMP_64BIT=y
```

## tests/subsys/logging/log_multidomain/testcase.yaml
```yaml
tests:
  logging.log_multidomain:
    tags: log_core logging log_multidomain
    platform_exclude: nucleo_l053r8 nucleo_f030r8
      stm32f0_disco native_posix native_posix_64 nrf52_bsim
      qemu_riscv64
```

## tests/subsys/logging/log_output/Kconfig
```kconfig
# Copyright (c) 2021 Nordic Semiconductor ASA
# Copyright (c) 2024 Intel Corporation
#
# SPDX-License-Identifier: Apache-2.0

config LOG_INFO_COLOR_GREEN
	default y if LOG_BACKEND_SHOW_COLOR

config LOG_DBG_COLOR_BLUE
	default y if LOG_BACKEND_SHOW_COLOR

source "Kconfig.zephyr"
```

## tests/subsys/logging/log_output/testcase.yaml
```yaml
common:
  integration_platforms:
    - native_sim

tests:
  logging.output:
    tags:
      - log_output
      - logging
    extra_configs:
      - CONFIG_LOG_TIMESTAMP_64BIT=n
  logging.output.ts64:
    tags:
      - log_output
      - logging
    extra_configs:
      - CONFIG_LOG_TIMESTAMP_64BIT=y
  logging.output.ts64.date:
    tags:
      - log_output
      - logging
    extra_configs:
      - CONFIG_LOG_TIMESTAMP_64BIT=y
      - CONFIG_LOG_OUTPUT_FORMAT_DATE_TIMESTAMP=y
  logging.output.ts64.date.fulllibc:
    tags:
      - log_output
      - logging
    extra_configs:
      - CONFIG_LOG_TIMESTAMP_64BIT=y
      - CONFIG_LOG_OUTPUT_FORMAT_DATE_TIMESTAMP=y
      - CONFIG_REQUIRES_FULL_LIBC=y
    filter: CONFIG_FULL_LIBC_SUPPORTED
  logging.output.ts64.iso8601:
    tags:
      - log_output
      - logging
    extra_configs:
      - CONFIG_LOG_TIMESTAMP_64BIT=y
      - CONFIG_LOG_OUTPUT_FORMAT_ISO8601_TIMESTAMP=y
  logging.output.ts64.iso8601.fulllibc:
    tags:
      - log_output
      - logging
    extra_configs:
      - CONFIG_LOG_TIMESTAMP_64BIT=y
      - CONFIG_LOG_OUTPUT_FORMAT_ISO8601_TIMESTAMP=y
      - CONFIG_REQUIRES_FULL_LIBC=y
    filter: CONFIG_FULL_LIBC_SUPPORTED
  logging.output.thread_id:
    tags:
      - log_output
      - logging
    extra_configs:
      - CONFIG_LOG_THREAD_ID_PREFIX=y
```

## tests/subsys/logging/log_output_net/testcase.yaml
```yaml
common:
  depends_on: netif
  integration_platforms:
    - native_sim

tests:
  logging.output.net:
    tags:
      - log_output
      - logging
    extra_configs:
      - CONFIG_LOG_TIMESTAMP_64BIT=n
  logging.output.net.ts64:
    tags:
      - log_output
      - logging
    extra_configs:
      - CONFIG_LOG_TIMESTAMP_64BIT=y
  logging.output.net.fulllibc:
    tags:
      - log_output
      - logging
    extra_configs:
      - CONFIG_LOG_TIMESTAMP_64BIT=n
      - CONFIG_REQUIRES_FULL_LIBC=y
    filter: CONFIG_FULL_LIBC_SUPPORTED
```

## tests/subsys/logging/log_ratelimited/testcase.yaml
```yaml
common:
  integration_platforms:
    - native_sim
  tags:
    - logging
  platform_allow:
    - native_sim

tests:
  logging.log_ratelimited:
    build_only: true
    extra_configs:
      - CONFIG_LOG_RATELIMIT_INTERVAL_MS=1000
  logging.log_ratelimited.fallback_drop:
    build_only: true
    extra_configs:
      - CONFIG_LOG_RATELIMIT=n
      - CONFIG_LOG_RATELIMIT_FALLBACK_DROP=y
  logging.log_ratelimited.fallback_log:
    build_only: true
    extra_configs:
      - CONFIG_LOG_RATELIMIT=n
      - CONFIG_LOG_RATELIMIT_FALLBACK_LOG=y
```

## tests/subsys/logging/log_stack/testcase.yaml
```yaml
common:
  platform_type:
    - qemu
  tags:
    - log_api
    - logging
  skip: true
  integration_platforms:
    - qemu_x86
tests:
  logging.stack.deferred:
    extra_configs:
      - CONFIG_LOG_MODE_DEFERRED=y
  logging.stack.deferred_no_opt:
    filter: not CONFIG_MIPS
    extra_configs:
      - CONFIG_LOG_MODE_DEFERRED=y
      - CONFIG_NO_OPTIMIZATIONS=y
      - CONFIG_ZTEST_WARN_NO_OPTIMIZATIONS=n
      - CONFIG_IDLE_STACK_SIZE=2048
  logging.stack.immediate:
    extra_configs:
      - CONFIG_LOG_MODE_IMMEDIATE=y
  logging.stack.immediate_no_opt:
    filter: not CONFIG_MIPS
    extra_configs:
      - CONFIG_LOG_MODE_IMMEDIATE=y
      - CONFIG_NO_OPTIMIZATIONS=y
      - CONFIG_ZTEST_WARN_NO_OPTIMIZATIONS=n
      - CONFIG_IDLE_STACK_SIZE=2048
  logging.stack.deferred_cpp:
    extra_configs:
      - CONFIG_LOG_MODE_DEFERRED=y
      - CONFIG_CPP=y
  logging.stack.deferred_cpp_no_opt:
    filter: not CONFIG_MIPS
    extra_configs:
      - CONFIG_LOG_MODE_DEFERRED=y
      - CONFIG_NO_OPTIMIZATIONS=y
      - CONFIG_ZTEST_WARN_NO_OPTIMIZATIONS=n
      - CONFIG_CPP=y
  logging.stack.immediate_cpp:
    extra_configs:
      - CONFIG_LOG_MODE_IMMEDIATE=y
      - CONFIG_CPP=y
  logging.stack.immediate_cpp_no_opt:
    filter: not CONFIG_MIPS
    extra_configs:
      - CONFIG_LOG_MODE_IMMEDIATE=y
      - CONFIG_NO_OPTIMIZATIONS=y
      - CONFIG_ZTEST_WARN_NO_OPTIMIZATIONS=n
      - CONFIG_CPP=y
```

## tests/subsys/logging/log_stress/testcase.yaml
```yaml
common:
  filter: CONFIG_QEMU_TARGET and not CONFIG_SMP
  tags:
    - log_api
    - logging
  integration_platforms:
    - qemu_x86
tests:
  logging.stress.light:
    extra_configs:
      - CONFIG_LOG_MODE_DEFERRED=y
      - CONFIG_LOG_MODE_OVERFLOW=y
  logging.stress.light_no_overflow:
    extra_configs:
      - CONFIG_LOG_MODE_DEFERRED=y
      - CONFIG_LOG_MODE_OVERFLOW=n
  logging.log_stress:
    extra_configs:
      - CONFIG_LOG_MODE_DEFERRED=y
      - CONFIG_LOG_MODE_OVERFLOW=y
      - CONFIG_SYS_CLOCK_TICKS_PER_SEC=100000
    platform_allow:
      - qemu_x86
      - qemu_cortex_a9
      - qemu_x86_64
  logging.stress.no_overflow:
    extra_configs:
      - CONFIG_LOG_MODE_DEFERRED=y
      - CONFIG_LOG_MODE_OVERFLOW=n
      - CONFIG_SYS_CLOCK_TICKS_PER_SEC=100000
    platform_allow:
      - qemu_x86
      - qemu_cortex_a9
      - qemu_x86_64
```

## tests/subsys/logging/log_switch_format/Kconfig
```kconfig
# SPDX-License-Identifier: Apache-2.0
# Copyright (c) 2022 Intel Corporation

config LOG_BACKEND_MOCK
	bool "MOCK backend"
	select LOG_OUTPUT
	help
	  When enabled MOCK backend is used for logging. It is
	  used to capture the output buffer used for validation of
	  log messages. It will not output any logs.

if LOG_BACKEND_MOCK

backend = MOCK
backend-str = mock
source "subsys/logging/Kconfig.template.log_format_config"

endif # LOG_BACKEND_MOCK

config LOG_BACKEND_DEFAULT
	string "DEFAULT backend"
	default "log_backend_mock" if LOG_BACKEND_MOCK
	help
	  Default value for the name of the backend enabled.

# Include Zephyr's Kconfig.
source "Kconfig.zephyr"
```

## tests/subsys/logging/log_switch_format/testcase.yaml
```yaml
common:
  tags:
    - logging
    - mipi-sys-t
  modules:
    - mipi-sys-t
  arch_exclude:
    - mips
    - nios2
    - posix
    - sparc
  filter: not CONFIG_64BIT
tests:
  logging.format.switch.deferred:
    integration_platforms:
      - mps2_an385
      - qemu_x86
    extra_args: OVERLAY_CONFIG=overlay_deferred.conf
    # "CONFIG_FULL_LIBC_SUPPORTED" filter was applied
    # because of following chain of dependencies:
    # LOG_MIPI_SYST_ENABLE=y --> CONFIG_MIPI_SYST_LIB --> \
    # --> REQUIRES_FULL_LIBC
    #
    # Not all compillers announced in Zephyr support a full C library
    filter: CONFIG_FULL_LIBC_SUPPORTED
    extra_configs:
      - CONFIG_REQUIRES_FULL_LIBC=y
  logging.format.switch.immediate:
    extra_args: OVERLAY_CONFIG=overlay_immediate.conf
    integration_platforms:
      - mps2_an385
      - qemu_x86
    filter: CONFIG_FULL_LIBC_SUPPORTED
    extra_configs:
      - CONFIG_REQUIRES_FULL_LIBC=y
  logging.format.switch.custom_output:
    extra_args: OVERLAY_CONFIG=overlay_custom_output.conf
    integration_platforms:
      - mps2_an385
      - qemu_x86
    filter: CONFIG_FULL_LIBC_SUPPORTED
    extra_configs:
      - CONFIG_REQUIRES_FULL_LIBC=y
```

## tests/subsys/logging/log_syst/testcase.yaml
```yaml
common:
  filter: not CONFIG_64BIT
tests:
  logging.log_syst.mipi_syst:
    tags: log_syst logging
    arch_exclude: mips nios2 posix sparc
    # "CONFIG_FULL_LIBC_SUPPORTED" filter was applied
    # because of following chain of dependencies:
    # LOG_MIPI_SYST_ENABLE=y --> CONFIG_MIPI_SYST_LIB --> \
    # --> REQUIRES_FULL_LIBC
    #
    # Not all compilers announced in Zephyr support full libc
    filter: CONFIG_FULL_LIBC_SUPPORTED
    integration_platforms:
      - mps2_an385
      - qemu_x86
      - sam_e70_xplained
    extra_configs:
      - CONFIG_LOG_MIPI_SYST_ENABLE=y
      - CONFIG_LOG_BACKEND_MOCK_OUTPUT_SYST=y
      - CONFIG_REQUIRES_FULL_LIBC=y
  logging.log_syst.text:
    tags: log_syst logging
    arch_exclude: mips nios2 posix sparc
    filter: CONFIG_FULL_LIBC_SUPPORTED
    extra_configs:
      - CONFIG_LOG_MIPI_SYST_ENABLE=n
      - CONFIG_LOG_BACKEND_MOCK_OUTPUT_SYST=n
      - CONFIG_REQUIRES_FULL_LIBC=y
```

## tests/subsys/logging/log_timestamp/testcase.yaml
```yaml
common:
  integration_platforms:
    - native_sim

tests:
  logging.output.default_timestamp:
    tags:
      - log_output
      - logging
      - timestamp
  logging.output.custom_timestamp:
    tags:
      - log_output
      - logging
      - timestamp
    extra_configs:
      - CONFIG_LOG_OUTPUT_FORMAT_CUSTOM_TIMESTAMP=y
```

## tests/subsys/logging/logger-hook/testcase.yaml
```yaml
tests:
  system.logging:
    tags: logger
    harness: console
    harness_config:
      type: multi_line
      regex:
        - "\\[syslogger\\] \\[ERR\\] (.*): SYS LOG ERR is ACTIVE"
        - "\\[syslogger\\] \\[WRN\\] (.*): SYS LOG WRN is ACTIVE"
        - "\\[syslogger\\] \\[INF\\] (.*): SYS LOG INF is ACTIVE"
```

## tests/subsys/lorawan/channels_mask/testcase.yaml
```yaml
tests:
  lorawan.channels_mask.set_channels_mask:
    tags: lorawan
    depends_on: lora
    integration_platforms:
      - b_l072z_lrwan1
```

## tests/subsys/lorawan/clock_sync/boards/native_sim.conf
```kconfig
# SPDX-License-Identifier: Apache-2.0

# Turn off log messages for failed communication with non-existing LoRa PHY
CONFIG_LORA_LOG_LEVEL_OFF=y
```

## tests/subsys/lorawan/clock_sync/testcase.yaml
```yaml
common:
  tags:
    - lorawan
tests:
  lorawan.clock_sync.sim:
    integration_platforms:
      - native_sim
    platform_allow:
      - native_sim
  lorawan.clock_sync.phy:
    depends_on: lora
    filter: CONFIG_ENTROPY_HAS_DRIVER
    timeout: 500
    integration_platforms:
      - nucleo_wl55jc
```

## tests/subsys/lorawan/frag_decoder/testcase.yaml
```yaml
common:
  tags:
    - lorawan
tests:
  lorawan.frag_decoder.semtech:
    platform_allow:
      - native_sim
    extra_configs:
      - CONFIG_LORAWAN_FRAG_TRANSPORT_DECODER_SEMTECH=y
      - CONFIG_NATIVE_EXTRA_CMDLINE_ARGS="seed=1"
  lorawan.frag_decoder.lowmem.high_redundancy:
    platform_allow:
      - native_sim
    extra_configs:
      - CONFIG_LORAWAN_FRAG_TRANSPORT_DECODER_LOWMEM=y
      - CONFIG_LORAWAN_FRAG_TRANSPORT_MAX_REDUNDANCY=80
  lorawan.frag_decoder.lowmem.low_redundancy:
    platform_allow:
      - native_sim
    extra_configs:
      - CONFIG_LORAWAN_FRAG_TRANSPORT_DECODER_LOWMEM=y
      - CONFIG_LORAWAN_FRAG_TRANSPORT_MAX_REDUNDANCY=10
      - CONFIG_NATIVE_EXTRA_CMDLINE_ARGS="seed=1"
```
