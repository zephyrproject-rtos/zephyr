## CMakeLists.txt
```
# SPDX-License-Identifier: Apache-2.0

cmake_minimum_required(VERSION 3.28.0)
find_package(Zephyr REQUIRED HINTS $ENV{ZEPHYR_BASE})
project(log_links)

FILE(GLOB app_sources src/*.c)
target_sources(app PRIVATE ${app_sources})
```

## prj.conf
```kconfig
CONFIG_ZTEST=y
CONFIG_TEST_EXTRA_STACK_SIZE=2048

CONFIG_TEST_LOGGING_DEFAULTS=n
CONFIG_LOG=y
CONFIG_LOG_PRINTK=n
CONFIG_LOG_MULTIDOMAIN=y
CONFIG_HEAP_MEM_POOL_SIZE=1024
CONFIG_LOG_PROCESS_THREAD=n
CONFIG_LOG_MODE_DEFERRED=y
CONFIG_LOG_RUNTIME_FILTERING=y
CONFIG_LOG_BACKEND_UART=n

CONFIG_KERNEL_LOG_LEVEL_OFF=y
CONFIG_SOC_LOG_LEVEL_OFF=y
CONFIG_ARCH_LOG_LEVEL_OFF=y
CONFIG_LOG_PROCESSING_LATENCY_US=10000
CONFIG_SYS_CLOCK_TICKS_PER_SEC=10000
```

## src/main.c
```c
/*
 * Copyright (c) 2021 Nordic Semiconductor
 *
 * SPDX-License-Identifier: Apache-2.0
 */

/**
 * @file
 * @brief Test log links
 *
 */

#include <zephyr/tc_util.h>
#include <zephyr/kernel.h>
#include <zephyr/ztest.h>
#include <zephyr/logging/log_backend.h>
#include <zephyr/logging/log_ctrl.h>
#include <zephyr/logging/log_link.h>
#include <zephyr/logging/log.h>
#include <stdbool.h>

LOG_MODULE_REGISTER(test);

static log_timestamp_t timestamp;

static void process(const struct log_backend *const backend,
			union log_msg_generic *msg)
{

}

static void panic(const struct log_backend *const backend)
{

}

const struct log_backend_api log_backend_test_api = {
	.process = process,
	.panic = panic
};

LOG_BACKEND_DEFINE(backend1, log_backend_test_api, false);

static log_timestamp_t timestamp_get(void)
{
	return timestamp++;
}

static void log_setup(void)
{
	uint8_t offset = 0;
	int err;

	log_init();

	timestamp = 0;
	err = log_set_timestamp_func(timestamp_get, 0);
	zassert_equal(err, 0);

	(void)z_log_links_activate(0xFFFFFFFF, &offset);

	log_backend_enable(&backend1, NULL, LOG_LEVEL_DBG);
}

extern struct log_link_api mock_log_link_api;

LOG_LINK_DEF(mock_link1, mock_log_link_api, 0, NULL);
LOG_LINK_DEF(mock_link2, mock_log_link_api, 512, NULL);
LOG_LINK_DEF(mock_link3, mock_log_link_api, 1024, NULL);

static void check_msg(int exp_timestamp, int line)
{
	union log_msg_generic *msg;
	k_timeout_t t;

	msg = z_log_msg_claim(&t);

	if (exp_timestamp < 0) {
		zassert_equal(msg, NULL, "%d: Unexpected msg", line);
		return;
	}

	zassert_true(msg != NULL, "%d: Unexpected msg", line);
	zassert_equal(msg->log.hdr.timestamp, exp_timestamp, "%d: got:%d, exp:%d",
			line, (int)msg->log.hdr.timestamp, exp_timestamp);

	z_log_msg_free(msg);
}

#define CHECK_MSG(t) check_msg(t, __LINE__)

/**
 * @brief Verify ordering of local and remote-link messages by timestamp.
 *
 * @details
 * Messages may originate locally or arrive via a log link (remote domain). This
 * test commits a local message and then enqueues a remote-link message with a
 * later timestamp, validating that messages are claimed in timestamp order.
 *
 * Test steps:
 * - Allocate and commit a local message (timestamp 0).
 * - Enqueue a remote-link message (timestamp 1).
 * - Claim messages and check their timestamps.
 *
 * Expected result:
 * - Messages are claimed in ascending timestamp order (0, then 1).
 * - No further messages remain.
 *
 * @see z_log_msg_enqueue()
 * @ingroup logging_tests
 */
ZTEST(log_link_order, test_log_only_local)
{
	struct log_msg log2;
	struct log_msg *log1;

	log1 = z_log_msg_alloc(sizeof(struct log_msg) / sizeof(int));
	log1->hdr.desc.type = Z_LOG_MSG_LOG;
	log1->hdr.desc.package_len = 0;
	log1->hdr.desc.data_len = 0;

	/* Commit local message. */
	z_log_msg_commit(log1);

	log2.hdr.desc.type = Z_LOG_MSG_LOG;
	log2.hdr.desc.package_len = 0;
	log2.hdr.desc.data_len = 0;

	log2.hdr.timestamp = timestamp_get();

	z_log_msg_enqueue(&mock_link1, &log2, sizeof(log2));

	CHECK_MSG(0);
	CHECK_MSG(1);
	CHECK_MSG(-1);
}

/**
 * @brief Verify out-of-order remote-link messages sharing the core buffer.
 *
 * @details
 * When a remote-link message arrives later but carries an earlier timestamp,
 * and the link has no dedicated buffer, it shares the core message queue. This
 * test validates that messages are claimed in the order they were committed to
 * the shared queue rather than strictly by timestamp.
 *
 * Test steps:
 * - Take a timestamp for the remote message before the local one.
 * - Commit the local message, then enqueue the earlier-timestamped remote one.
 * - Claim messages and check their timestamps.
 *
 * Expected result:
 * - Messages are claimed in commit order (local first, then remote).
 * - No further messages remain.
 *
 * @see z_log_msg_enqueue()
 * @ingroup logging_tests
 */
ZTEST(log_link_order, test_log_local_unordered)
{
	struct log_msg *log1;
	struct log_msg log2;

	/* Get timestamp for second message before first. Simulate that it is
	 * taken by remote.
	 */
	log_timestamp_t t = timestamp_get();

	log1 = z_log_msg_alloc(sizeof(struct log_msg) / sizeof(int));

	log1->hdr.desc.package_len = 0;
	log1->hdr.desc.data_len = 0;

	/* Commit local message. */
	z_log_msg_commit(log1);

	/* Simulate receiving of remote message. It is enqueued later but with
	 * earlier timestamp.
	 */
	log2.hdr.desc.type = Z_LOG_MSG_LOG;
	log2.hdr.timestamp = t;
	log2.hdr.desc.package_len = 0;
	log2.hdr.desc.data_len = 0;

	z_log_msg_enqueue(&mock_link1, &log2, sizeof(log2));

	CHECK_MSG(1);
	CHECK_MSG(0);
	CHECK_MSG(-1);
}

/**
 * @brief Verify timestamp ordering when a link has a dedicated buffer.
 *
 * @details
 * When a log link has its own dedicated buffer, the processing logic selects the
 * earliest message across the local queue and the link buffers. This test
 * enqueues a remote message with an earlier timestamp to a dedicated-buffer link
 * and validates that messages are reordered and claimed by ascending timestamp.
 *
 * Test steps:
 * - Take an early timestamp for the remote message before committing local.
 * - Commit the local message and enqueue two remote messages to a dedicated
 *   buffer link (earlier then later timestamp).
 * - Claim messages and check their timestamps.
 *
 * Expected result:
 * - Messages are claimed in ascending timestamp order (0, 1, 2).
 * - No further messages remain.
 *
 * @see z_log_msg_enqueue()
 * @ingroup logging_tests
 */
ZTEST(log_link_order, test_log_one_remote_ordering)
{
	struct log_msg *log1;
	struct log_msg log2;

	/* Get timestamp for second message before first. Simulate that it is
	 * taken by remote.
	 */
	log_timestamp_t t = timestamp_get();

	log1 = z_log_msg_alloc(sizeof(struct log_msg) / sizeof(int));

	log1->hdr.desc.package_len = 0;
	log1->hdr.desc.data_len = 0;

	/* Commit local message. */
	z_log_msg_commit(log1);

	/* Simulate receiving of remote message. It is enqueued later but with
	 * earlier timestamp. However, it is enqueued to link with dedicated buffer
	 * thus when processing, earliest from the buffers is taken
	 */

	log2.hdr.timestamp = t;
	log2.hdr.desc.type = Z_LOG_MSG_LOG;
	log2.hdr.desc.package_len = 0;
	log2.hdr.desc.data_len = 0;

	/* link2 has dedicated buffer. */
	z_log_msg_enqueue(&mock_link2, &log2, sizeof(log2));

	log2.hdr.timestamp = timestamp_get();
	/* link2 has dedicated buffer. Log another message with the latest timestamp. */
	z_log_msg_enqueue(&mock_link2, &log2, sizeof(log2));

	CHECK_MSG(0);
	CHECK_MSG(1);
	CHECK_MSG(2);
	CHECK_MSG(-1);
}

static void before(void *data)
{
	ARG_UNUSED(data);

	log_setup();
}

ZTEST_SUITE(log_link_order, NULL, NULL, before, NULL, NULL);
```

## src/mock_log_link.c
```c
/*
 * Copyright (c) 2021 Nordic Semiconductor
 *
 * SPDX-License-Identifier: Apache-2.0
 */
#include <string.h>
#include <zephyr/logging/log.h>
#include <zephyr/ztest.h>
#include "mock_log_link.h"

static int initiate(const struct log_link *link, struct log_link_config *configa)
{
	link->ctrl_blk->source_cnt = 1;

	return 0;
}

static int activate(const struct log_link *link)
{
	return 0;
}

static int get_source_name(const struct log_link *link, uint16_t source_id, char *buf,
			   size_t *length)
{
	if (length) {
		*length = 0;
	}

	return 0;
}

static int get_levels(const struct log_link *link, uint16_t source_id, uint8_t *level,
		      uint8_t *runtime_level)
{
	if (level) {
		*level = LOG_LEVEL_INF;
	}
	if (runtime_level) {
		*runtime_level = LOG_LEVEL_INF;
	}

	return 0;
}

static int set_runtime_level(const struct log_link *link, uint16_t source_id, uint8_t level)
{
	return 0;
}

void mock_log_link_add_message(const struct log_link *link, struct log_msg *msg)
{
	size_t msg_len = log_msg_get_total_wlen(msg->hdr.desc) * sizeof(uint32_t);
	struct mock_log_link_ctx *ctx = (struct mock_log_link_ctx *)link->ctx;
	void *dst = &ctx->buf[ctx->buf_index];

	memcpy(dst, msg, msg_len);
	zassert_true(ctx->buf_index + msg_len <= sizeof(ctx->buf), "Buffer overflow");
	zassert_true(ctx->msg_count < ARRAY_SIZE(ctx->msgs), "Message buffer overflow");
	ctx->buf_index += msg_len;
	ctx->msgs[ctx->msg_count++] = (struct log_msg *)dst;

	z_log_msg_remote_notify(link, 1);
}

void mock_log_link_reset(const struct log_link *link)
{
	struct mock_log_link_ctx *ctx = (struct mock_log_link_ctx *)link->ctx;

	ctx->buf_index = 0;
	ctx->msg_count = 0;
	ctx->msg_read_index = 0;
}

static union log_msg_generic *get_msg(const struct log_link *link)
{
	struct mock_log_link_ctx *ctx = (struct mock_log_link_ctx *)link->ctx;

	if (ctx->msg_read_index < ctx->msg_count) {
		struct log_msg *msg = ctx->msgs[ctx->msg_read_index];

		/* Like a real link, mark the message with the domain of this link. */
		msg->hdr.desc.domain = link->ctrl_blk->domain_offset;

		return (union log_msg_generic *)msg;
	}

	return NULL;
}

static void put_msg(const struct log_link *link, union log_msg_generic *msg)
{
	struct mock_log_link_ctx *ctx = (struct mock_log_link_ctx *)link->ctx;

	ctx->msg_read_index++;
}

struct log_link_api mock_log_link_api = {
	.initiate = initiate,
	.activate = activate,
	.get_source_name = get_source_name,
	.get_levels = get_levels,
	.set_runtime_level = set_runtime_level,
	.get_msg = get_msg,
	.put_msg = put_msg,
};
```

## src/mock_log_link.h
```c
/*
 * Copyright (c) 2026 Nordic Semiconductor
 *
 * SPDX-License-Identifier: Apache-2.0
 */

#ifndef MOCK_LOG_LINK_H__
#define MOCK_LOG_LINK_H__

#include <zephyr/logging/log_link.h>

extern struct log_link_api mock_log_link_api;

struct mock_log_link_ctx {
	uint8_t buf[512];
	struct log_msg *msgs[8];
	int msg_count;
	int msg_read_index;
	int buf_index;
	int ready;
};

void mock_log_link_reset(const struct log_link *link);
void mock_log_link_add_message(const struct log_link *link, struct log_msg *msg);

#define MOCK_LOG_LINK_DEFINE(_n)                                                                   \
	static struct mock_log_link_ctx _n##_context;                                              \
	LOG_LINK_DEFINE(_n, mock_log_link_api, &_n##_context)

#endif /* MOCK_LOG_LINK_H__ */
```
