## CMakeLists.txt
```
# SPDX-License-Identifier: Apache-2.0

cmake_minimum_required(VERSION 3.28.0)
find_package(Zephyr REQUIRED HINTS $ENV{ZEPHYR_BASE})
project(log_switch_format)

FILE(GLOB app_sources src/*.c)
target_sources(app PRIVATE ${app_sources})

if(CONFIG_CPP)
  # When building for C++, force C++ compilation
  set_source_files_properties(src/*.c PROPERTIES LANGUAGE CXX)
endif()
```

## Kconfig
```
# SPDX-License-Identifier: Apache-2.0
# Copyright (c) 2022 Intel Corporation

config LOG_BACKEND_MOCK
	bool "MOCK backend"
	select LOG_OUTPUT
	help
	  When enabled MOCK backend is used for logging. It is
	  used to capture the output buffer used for validation of
	  log messages. It will not output any logs.

if LOG_BACKEND_MOCK

backend = MOCK
backend-str = mock
source "subsys/logging/Kconfig.template.log_format_config"

endif # LOG_BACKEND_MOCK

config LOG_BACKEND_DEFAULT
	string "DEFAULT backend"
	default "log_backend_mock" if LOG_BACKEND_MOCK
	help
	  Default value for the name of the backend enabled.

# Include Zephyr's Kconfig.
source "Kconfig.zephyr"
```

## prj.conf
```kconfig
CONFIG_LOG=y
CONFIG_ASSERT=n
CONFIG_ZTEST=y
CONFIG_LOG_MIPI_SYST_ENABLE=y

# If using a different backend such as "ADSP"
# update the following 2 lines.
# Note: If using different platforms, be sure to
# use the correct logging backend.
CONFIG_LOG_PRINTK=n
CONFIG_LOG_BACKEND_MOCK=y
CONFIG_LOG_BACKEND_UART=n
CONFIG_LOG_BACKEND_RTT=n
CONFIG_LOG_BACKEND_NATIVE_POSIX=n
CONFIG_LOG_BACKEND_XTENSA_SIM=n
CONFIG_LOG_BACKEND_MOCK_OUTPUT_SYST=y

CONFIG_SOC_LOG_LEVEL_OFF=y
CONFIG_ARCH_LOG_LEVEL_OFF=y
CONFIG_KERNEL_LOG_LEVEL_OFF=y
CONFIG_LOG_RUNTIME_FILTERING=n
CONFIG_MAIN_THREAD_PRIORITY=5
CONFIG_LOG_FUNC_NAME_PREFIX_DBG=n

# Use immediate mode so all messages are being
# printed. Under deferred mode, there may be
# dropped messages as there are quite a number of
# messages to be printed.
CONFIG_LOG_MODE_IMMEDIATE=y

# Need bigger stack for immediate mode
CONFIG_MAIN_STACK_SIZE=4096

CONFIG_ZTEST_STACK_SIZE=2048
```

## overlay_custom_output.conf
```kconfig
CONFIG_LOG_CUSTOM_FORMAT_SUPPORT=y
```

## overlay_deferred.conf
```kconfig
CONFIG_LOG_MODE_IMMEDIATE=n
CONFIG_LOG_MODE_DEFERRED=y
CONFIG_LOG_BUFFER_SIZE=1024
CONFIG_LOG_PROCESS_THREAD=y
CONFIG_LOG_PROCESS_THREAD_SLEEP_MS=100
CONFIG_LOG_PROCESS_TRIGGER_THRESHOLD=2
CONFIG_LOG_PROCESS_THREAD_STACK_SIZE=4096
CONFIG_LOG_BLOCK_IN_THREAD=y
CONFIG_LOG_BACKEND_UART=n
CONFIG_LOG_BACKEND_MOCK=y
CONFIG_LOG_MIPI_SYST_ENABLE=y
CONFIG_LOG_BACKEND_MOCK_OUTPUT_SYST=y
```

## overlay_immediate.conf
```kconfig
CONFIG_LOG_BACKEND_UART=n
CONFIG_LOG_BACKEND_MOCK=y
CONFIG_LOG_MIPI_SYST_ENABLE=y
CONFIG_LOG_BACKEND_MOCK_OUTPUT_SYST=y
```

## boards/intel_adsp_cavs15.conf
```kconfig
CONFIG_LOG_BACKEND_UART_OUTPUT_SYST=n
CONFIG_LOG_BACKEND_ADSP=y
CONFIG_LOG_BACKEND_ADSP_OUTPUT_SYST=y
```

## src/main.c
```c
/*
 * Copyright (c) 2019 Intel Corporation
 *
 * SPDX-License-Identifier: Apache-2.0
 */

#include <zephyr/kernel.h>
#include <zephyr/logging/log.h>
#include "mock_backend.h"
#include <zephyr/sys/printk.h>

#include <zephyr/logging/log_ctrl.h>
#include <zephyr/logging/log_output.h>
#include <zephyr/logging/log_output_dict.h>
#include <zephyr/logging/log_output_custom.h>
#include <zephyr/ztest.h>

#define LOG_MODULE_NAME log_switch_format
LOG_MODULE_REGISTER(LOG_MODULE_NAME, LOG_LEVEL_ERR);

extern size_t log_format_table_size(void);
K_SEM_DEFINE(my_sem, 0, 1);

void log_msgs(void)
{
	/* standard print */
	LOG_ERR("Error message example.");

#if CONFIG_LOG_MODE_DEFERRED && !(CONFIG_LOG_CUSTOM_FORMAT_SUPPORT)
	/*
	 * When deferred logging is enabled, the work is being performed by
	 * another thread. The semaphore my_sem gives that thread time to process
	 * those messages.
	 */

	k_sem_take(&my_sem, K_FOREVER);
#endif

	/* raw string */
	printk("hello sys-t on board %s\n", CONFIG_BOARD);
}

void test_log_switch_format_success_case(void)
{
	const struct log_backend *backend;
	const char *raw_data_str;
	uint32_t log_type = LOG_OUTPUT_SYST;
	const char *text_raw_data_str = "<err> log_switch_format: Error message example.";
	const char *syst_raw_data_str = "SYS-T RAW DATA: ";

	raw_data_str = syst_raw_data_str;
	log_msgs();
	validate_log_type(raw_data_str, log_type);

	log_type = LOG_OUTPUT_TEXT;
	raw_data_str = text_raw_data_str;
	backend = log_format_set_all_active_backends(log_type);

	zassert_is_null(backend, "Unexpected failure in switching log format");

	log_msgs();
	validate_log_type(raw_data_str, log_type);

	log_type = LOG_OUTPUT_SYST;
	raw_data_str = syst_raw_data_str;
	backend = log_format_set_all_active_backends(log_type);

	zassert_is_null(backend, "Unexpected failure in switching log format");

	log_msgs();
	validate_log_type(raw_data_str, log_type);

	log_type = LOG_OUTPUT_TEXT;
	raw_data_str = text_raw_data_str;
	backend = log_format_set_all_active_backends(log_type);

	zassert_is_null(backend, "Unexpected failure in switching log format");

	log_msgs();
	validate_log_type(raw_data_str, log_type);
}

void test_log_switch_format_set(void)
{
	const char *backend_name;
	const struct log_backend *backend;
	int ret;
	uint32_t log_type;

	log_type = LOG_OUTPUT_TEXT;
	backend_name = "not_exists";

	backend = log_backend_get_by_name(backend_name);
	zassert_is_null(backend, "Backend unexpectedly found");

	ret = log_backend_format_set(backend, log_type);

	zassert_equal(ret, -EINVAL, "Expected -EINVAL, Got %d\n", ret);

	backend_name = CONFIG_LOG_BACKEND_DEFAULT;
	backend = log_backend_get_by_name(backend_name);

	zassert_not_null(backend, "Backend not found");

	log_type = log_format_table_size() + 1;
	ret = log_backend_format_set(backend, log_type);

	zassert_equal(ret, -EINVAL, "Log type not supported, Invalid value returned");
}

void test_log_switch_format_set_all_active_backends(void)
{
	size_t log_type = log_format_table_size() + 1;
	const struct log_backend *backend;

	backend = log_format_set_all_active_backends(log_type);

	zassert_not_null(backend, "Unexpectedly all active backends switched the logging format");

	log_type = LOG_OUTPUT_SYST;
	backend = log_format_set_all_active_backends(log_type);

	zassert_is_null(backend, "Not all active backends have switched logging formats");
}

/* Testcase to verify the entries in function pointer table */
void test_log_switch_format_func_t_get(void)
{
	const log_format_func_t expected_values[] = {
		[LOG_OUTPUT_TEXT] = IS_ENABLED(CONFIG_LOG_OUTPUT) ? log_output_msg_process : NULL,
		[LOG_OUTPUT_SYST] = IS_ENABLED(CONFIG_LOG_MIPI_SYST_ENABLE)
					    ? log_output_msg_syst_process
					    : NULL,
		[LOG_OUTPUT_DICT] = IS_ENABLED(CONFIG_LOG_DICTIONARY_SUPPORT)
					    ? log_dict_output_msg_process
					    : NULL,
		[LOG_OUTPUT_CUSTOM] = IS_ENABLED(CONFIG_LOG_CUSTOM_FORMAT_SUPPORT)
					      ? log_custom_output_msg_process
					      : NULL,
	};

	zassert_equal(log_format_table_size(), ARRAY_SIZE(expected_values),
		      "Update test for expected_values table");

	for (int i = 0; i < ARRAY_SIZE(expected_values); i++) {
		zassert_equal(log_format_func_t_get(i), expected_values[i],
			      "Log Format Not supported");
	}
}

/**
 * @brief Verify log output format can be switched at runtime across active backends.
 *
 * @details
 * Drives the full format-switching flow: it toggles active backends between
 * SyS-T and text output and confirms each emitted message is rendered in the
 * currently selected format, validates error handling for unknown backends and
 * out-of-range format types, confirms switching all active backends at once,
 * and checks the format function-pointer table maps each output type to its
 * renderer. This ensures logs can be produced in a machine-parseable format and
 * that messages are formatted according to the selected output type.
 *
 * Test steps:
 * - Switch all active backends between SyS-T and text and validate each render.
 * - Exercise error returns for invalid backend and unsupported format type.
 * - Switch all active backends and verify the function-pointer table entries.
 *
 * Expected result:
 * - Messages render in the selected format and all format APIs behave as expected.
 *
 * @see log_format_set_all_active_backends()
 * @ingroup logging_tests
 */
ZTEST(log_switch_format, test_log_switch_format)
{
	test_log_switch_format_success_case();
	test_log_switch_format_set();
	test_log_switch_format_set_all_active_backends();
	test_log_switch_format_func_t_get();
}

#if CONFIG_LOG_CUSTOM_FORMAT_SUPPORT || defined(__DOXYGEN__)
void custom_formatting(const struct log_output *output, struct log_msg *msg, uint32_t flags)
{
	uint8_t buffer[] = "Hello world";

	output->func((uint8_t *)buffer, sizeof(buffer), (void *)output);
}

/**
 * @brief Verify the custom output format produces no output when no handler is set.
 *
 * @details
 * Selects the custom output format on the default backend but clears the custom
 * formatting callback. Emitting messages must then produce no rendered output,
 * confirming the custom format path safely handles a NULL handler instead of
 * formatting messages.
 *
 * Test steps:
 * - Set the default backend to the custom output format.
 * - Clear the custom output handler and emit log messages.
 * - Validate that no formatted output is produced.
 *
 * Expected result:
 * - No output is rendered for the custom format with a NULL handler.
 *
 * @see log_custom_output_msg_set()
 * @ingroup logging_tests
 */
ZTEST(log_switch_format, test_log_switch_format_custom_output_handles_null)
{
	const char *backend_name;
	const struct log_backend *backend;

	backend_name = CONFIG_LOG_BACKEND_DEFAULT;
	backend = log_backend_get_by_name(backend_name);

	log_backend_format_set(backend, LOG_OUTPUT_CUSTOM);

	log_custom_output_msg_set(NULL);

	log_msgs();

	validate_log_type("", LOG_OUTPUT_CUSTOM);
}

/**
 * @brief Verify a registered custom output handler is invoked to format messages.
 *
 * @details
 * Selects the custom output format on the default backend and registers a
 * custom formatting callback that emits a fixed string. Emitting messages must
 * then produce that string, confirming the custom format renderer is invoked
 * and its output is captured.
 *
 * Test steps:
 * - Set the default backend to the custom output format.
 * - Register a custom output handler and emit log messages.
 * - Validate that the handler's output is rendered.
 *
 * Expected result:
 * - The custom handler is invoked and its formatted output is produced.
 *
 * @see log_custom_output_msg_set()
 * @ingroup logging_tests
 */
ZTEST(log_switch_format, test_log_switch_format_custom_output_called_when_set)
{
	uint32_t log_type;
	const char *backend_name;
	const char *raw_data_str;
	const char *text_custom_data_str = "Hello world";
	const struct log_backend *backend;

	backend_name = CONFIG_LOG_BACKEND_DEFAULT;
	backend = log_backend_get_by_name(backend_name);

	log_backend_format_set(backend, LOG_OUTPUT_CUSTOM);

	log_custom_output_msg_set(custom_formatting);

	log_msgs();

	log_type = LOG_OUTPUT_CUSTOM;
	raw_data_str = text_custom_data_str;
	validate_log_type(raw_data_str, log_type);
}

/**
 * @brief Verify the custom output format produces no output when left uninitialized.
 *
 * @details
 * Selects the custom output format on the default backend without ever
 * registering a custom formatting callback. Emitting messages must then produce
 * no rendered output, confirming the custom format path does not log when its
 * handler has not been initialized.
 *
 * Test steps:
 * - Set the default backend to the custom output format without a handler.
 * - Emit log messages.
 * - Validate that no formatted output is produced.
 *
 * Expected result:
 * - No output is rendered while the custom format handler is uninitialized.
 *
 * @see log_backend_format_set()
 * @ingroup logging_tests
 */
ZTEST(log_switch_format, test_log_switch_format_does_not_log_when_uninit)
{
	const char *backend_name;
	const struct log_backend *backend;

	backend_name = CONFIG_LOG_BACKEND_DEFAULT;
	backend = log_backend_get_by_name(backend_name);

	log_backend_format_set(backend, LOG_OUTPUT_CUSTOM);

	log_msgs();

	validate_log_type("", LOG_OUTPUT_CUSTOM);
}
#endif

ZTEST_SUITE(log_switch_format, NULL, NULL, NULL, NULL, NULL);
```

## src/mock_backend.c
```c
/*
 * Copyright (c) 2022 Intel Corporation
 *
 * SPDX-License-Identifier: Apache-2.0
 */

#include "mock_backend.h"
#include <zephyr/ztest.h>
#include <zephyr/logging/log_core.h>
#include <zephyr/logging/log_backend_std.h>
#include <stdlib.h>

static uint32_t log_format_current = CONFIG_LOG_BACKEND_MOCK_OUTPUT_DEFAULT;
union log_msg_generic *test_msg;

extern struct k_sem my_sem;
static uint8_t mock_output_buf[1];
uint8_t test_output_buf[256];
int pos_in_buf;

/**
 * @brief This function takes in the characters and copies
 * them in the temporary buffer.
 *
 * @return No. of characters copied to the temporary buffer.
 */
static int char_out(uint8_t *data, size_t length, void *ctx)
{
	ARG_UNUSED(ctx);
	size_t output_length = length;

	while (length > 0) {
		test_output_buf[pos_in_buf] = *data;
		pos_in_buf++;
		if (*data == '\n') {
			k_sem_give(&my_sem);
		}
		data++;
		length--;

		zassert_not_equal(pos_in_buf, sizeof(test_output_buf)-1,
				  "Increase the size of test_output_buf");
	}
	return output_length;
}

LOG_OUTPUT_DEFINE(log_output_mock, char_out, mock_output_buf, sizeof(mock_output_buf));

static void process(const struct log_backend *const backend,
		union log_msg_generic *msg)
{
	uint32_t flags = log_backend_std_get_flags();

	test_msg = msg;

	log_format_func_t log_output_func = log_format_func_t_get(log_format_current);

	log_output_func(&log_output_mock, &msg->log, flags);
}

int remove_timestamp(const char *raw_string, int timestamp_start)
{
	int timestamp_end = timestamp_start;
	int count = 1;

	while (count > 0) {

		char c = raw_string[++timestamp_end];

		if (c == '[') {
			count++;
		} else if (c == '<') {
			count--;
		}
	}
	return timestamp_end;
}

void validate_log_type(const char *raw_data_str, uint32_t log_type)
{
	const char *output_str = test_output_buf;

	if (log_type == LOG_OUTPUT_TEXT) {

		int pos = remove_timestamp(output_str, 0);

		/* Skip comparing Timestamp */
		output_str = output_str+pos;
	}

	/* Validate raw_data_str prefix in the output_str */
	zassert_mem_equal(raw_data_str, output_str, strlen(raw_data_str),
			  "Incorrect Format comparison %s vs %s", output_str, raw_data_str);

	memset(test_output_buf, 0, sizeof(test_output_buf));
	pos_in_buf = 0;
}

static int format_set(const struct log_backend *const backend, uint32_t log_type)
{
	log_format_current = log_type;
	return 0;
}

static void mock_init(struct log_backend const *const backend)
{

}

static void panic(struct log_backend const *const backend)
{

}

const struct log_backend_api mock_log_backend_api = {
	.process = process,
	.init = mock_init,
	.format_set = format_set,
	.panic = panic
};

LOG_BACKEND_DEFINE(log_backend_mock, mock_log_backend_api, true);
```

## src/mock_backend.h
```c
/*
 * Copyright (c) 2022 Intel Corporation
 *
 * SPDX-License-Identifier: Apache-2.0
 */

#ifndef SRC_MOCK_BACKEND_H__
#define SRC_MOCK_BACKEND_H__

#include <zephyr/logging/log_backend.h>

#ifdef __cplusplus
extern "C" {
#endif

extern const struct log_backend_api mock_log_backend_api;
struct mock_log_backend {
	bool panic;
};

/**
 * @brief This function validates the log message.
 *
 * @param type Field in message header to indicate the type of SyS-T message.
 * @param optional_flags Optional Flags in message header.
 * @param module_id ModuleID in a Message Header distinguish between multiple
 *					instances of the same Origin.
 * @param sub_type Enumerated types for representing the sub-type of a Message.
 * @param payload The content of the Message.
 */
void validate_log_type(const char *raw_data_str, uint32_t log_type);

#define MOCK_LOG_BACKEND_DEFINE(name, autostart) \
	static struct mock_log_backend name##_mock; \
	LOG_BACKEND_DEFINE(name, mock_log_backend_api, autostart, &name##_mock)

#ifdef __cplusplus
}
#endif

#endif /* SRC_MOCK_BACKEND_H__ */
```
