## CMakeLists.txt
```
# Copyright 2026 Arm Limited and/or its affiliates <open-source-office@arm.com>
#
# SPDX-License-Identifier: Apache-2.0

cmake_minimum_required(VERSION 3.20.0)
find_package(Zephyr REQUIRED HINTS $ENV{ZEPHYR_BASE})
project(profiling_perf_events)

if(CONFIG_PROFILING_PERF_EVENTS_SHELL)
  target_sources(app PRIVATE src/shell.c)
else()
  target_sources(app PRIVATE src/arm64.c)
endif()

target_include_directories(app PRIVATE ${ZEPHYR_BASE}/subsys/profiling/perf/event)
```

## prj.conf
```kconfig
# Copyright 2026 Arm Limited and/or its affiliates <open-source-office@arm.com>
#
# SPDX-License-Identifier: Apache-2.0

CONFIG_ZTEST=y
CONFIG_PROFILING=y
CONFIG_PROFILING_PERF_EVENTS=y
```

## src/main.c
```c
/*
 * Copyright 2026 Arm Limited and/or its affiliates <open-source-office@arm.com>
 *
 * SPDX-License-Identifier: Apache-2.0
 */

#include <errno.h>
#include <zephyr/profiling/perf.h>
#include <zephyr/ztest.h>

ZTEST(perf_events, test_lookup)
{
	struct perf_event_handle event = {
		.token = UINT64_MAX,
		.baseline = UINT64_MAX,
		.final_count = UINT64_MAX,
		.status = -1,
	};

	zassert_ok(perf_event_lookup("cpu0.cycles", &event));
	zassert_not_equal(event.token, 0U);
	zassert_equal(event.baseline, 0U);
	zassert_equal(event.final_count, 0U);
	zassert_equal(event.status, 0);
	zassert_equal(perf_event_lookup("cpu0.unknown", &event), -ENOENT);
	zassert_equal(perf_event_lookup("unknown.cycles", &event), -ENOENT);
	zassert_equal(perf_event_lookup("cycles", &event), -EINVAL);
	zassert_equal(perf_event_lookup(NULL, &event), -EINVAL);
	zassert_equal(perf_event_lookup("cpu0.cycles", NULL), -EINVAL);
}

ZTEST(perf_events, test_snapshot_session)
{
	struct perf_event_handle event;
	struct perf_stat_config config = {
		.events = &event,
		.num_events = 1U,
	};

	zassert_ok(perf_event_lookup("cpu0.cycles", &event));
	zassert_ok(perf_stat_start(&config));
	zassert_equal(perf_stat_start(&config), -EBUSY);
	zassert_ok(perf_stat_stop(&config));
	zassert_equal(event.status, 0);

	zassert_ok(perf_stat_start(&config));
	zassert_ok(perf_stat_stop(&config));
}

ZTEST(perf_events, test_reject_duplicate_event)
{
	struct perf_event_handle events[2];
	struct perf_stat_config config = {
		.events = events,
		.num_events = ARRAY_SIZE(events),
	};

	zassert_ok(perf_event_lookup("cpu0.cycles", &events[0]));
	events[1] = events[0];
	zassert_equal(perf_stat_start(&config), -EINVAL);
}

ZTEST(perf_events, test_validate_config_and_active_identity)
{
	struct perf_event_handle event;
	struct perf_stat_config config = {
		.events = &event,
		.num_events = 1U,
	};
	struct perf_stat_config other_config = config;
	struct perf_event_handle invalid_event = {0};
	struct perf_stat_config invalid_config = {
		.events = &invalid_event,
		.num_events = 1U,
	};

	zassert_equal(perf_stat_start(NULL), -EINVAL);
	zassert_equal(perf_stat_start(&invalid_config), -EINVAL);
	zassert_ok(perf_event_lookup("cpu0.cycles", &event));
	zassert_ok(perf_stat_start(&config));
	zassert_equal(perf_stat_stop(&other_config), -EINVAL);
	zassert_ok(perf_stat_stop(&config));
	zassert_equal(perf_stat_stop(&config), -EINVAL);
}

ZTEST_SUITE(perf_events, NULL, NULL, NULL, NULL, NULL);
```

## src/arm64.c
```c
/*
 * Copyright 2026 Arm Limited and/or its affiliates <open-source-office@arm.com>
 *
 * SPDX-License-Identifier: Apache-2.0
 */

#include <errno.h>
#include <string.h>
#include <zephyr/arch/perf_counter.h>
#include <zephyr/kernel.h>
#include <zephyr/arch/arm64/lib_helpers.h>
#include <zephyr/profiling/perf.h>
#include <zephyr/profiling/perf_provider.h>
#include <zephyr/sys/barrier.h>
#include <zephyr/ztest.h>

#include "internal.h"

static struct perf_event_handle handles[CONFIG_PROFILING_PERF_EVENTS_MAX_EVENTS];
static struct perf_stat_config config = {.events = handles};
static struct k_thread helper_thread;
K_THREAD_STACK_DEFINE(helper_stack, 2048);

struct helper_job {
	void (*function)(void *argument);
	void *argument;
};

static void helper_entry(void *arg, void *unused1, void *unused2)
{
	struct helper_job *job = arg;

	ARG_UNUSED(unused1);
	ARG_UNUSED(unused2);
	job->function(job->argument);
}

static void on_cpu(uint32_t cpu, void (*function)(void *argument), void *argument)
{
	struct helper_job job = {.function = function, .argument = argument};

	k_thread_create(&helper_thread, helper_stack, K_THREAD_STACK_SIZEOF(helper_stack),
			helper_entry, &job, NULL, NULL, K_HIGHEST_THREAD_PRIO, 0U, K_FOREVER);
#ifdef CONFIG_SMP
	zassert_ok(k_thread_cpu_pin(&helper_thread, (int)cpu));
#else
	ARG_UNUSED(cpu);
#endif
	k_thread_start(&helper_thread);
	zassert_ok(k_thread_join(&helper_thread, K_FOREVER));
}

static void increment(void *arg)
{
	uint32_t count = *(uint32_t *)arg;

	for (uint32_t i = 0U; i < count; i++) {
		__asm__ volatile("msr pmswinc_el0, %0" : : "r"(1UL) : "memory");
	}
	barrier_isync_fence_full();
}

static void overflow(void *arg)
{
	ARG_UNUSED(arg);
	unsigned int key = irq_lock();
	uint32_t count = 3U;

	write_pmselr_el0(0U);
	barrier_isync_fence_full();
	write_pmxevcntr_el0(UINT32_MAX - 1U);
	barrier_isync_fence_full();
	increment(&count);
	irq_unlock(key);
}

static void check_disabled(void *arg)
{
	ARG_UNUSED(arg);
	zassert_equal(read_pmcr_el0() & PMCR_E, 0U);
	zassert_equal(read_pmcntenset_el0(), 0U);
}

static void check_group(void *arg)
{
	ARG_UNUSED(arg);
	zassert_equal(read_pmcntenset_el0() & 3U, 3U, "Both prepared counters must be enabled");
	zassert_not_equal(read_pmcr_el0() & PMCR_E, 0U);
}

static void select_event(size_t index, const char *name)
{
	zassert_ok(perf_event_lookup(name, &handles[index]), "Unavailable event: %s", name);
}

static void recovery(uint32_t cpu)
{
	char name[32];
	uint32_t count = 13U + cpu;
	int length = snprintk(name, sizeof(name), "cpu%u.SW_INCR", cpu);

	zassert_true(length > 0 && (size_t)length < sizeof(name));
	config.num_events = 1U;
	select_event(0U, name);

	zassert_ok(perf_stat_start(&config));
	on_cpu(cpu, increment, &count);
	zassert_ok(perf_stat_stop(&config));
	zassert_ok(handles[0].status);
	zassert_equal(handles[0].final_count - handles[0].baseline, count);
}

ZTEST(perf_arm64, test_cycles)
{
	config.num_events = 1U;
	select_event(0U, "cpu0.CPU_CYCLES");
	zassert_ok(perf_stat_start(&config));
	k_busy_wait(100U);
	zassert_ok(perf_stat_stop(&config));
	zassert_ok(handles[0].status);
	zassert_true(handles[0].final_count > handles[0].baseline);
	recovery(0U);
}

ZTEST(perf_arm64, test_group_enable)
{
	uint32_t count = 23U;

	config.num_events = 2U;
	select_event(0U, "cpu0.SW_INCR");
	select_event(1U, "cpu0.CPU_CYCLES");
	zassert_ok(perf_stat_start(&config));
	on_cpu(0U, check_group, NULL);
	on_cpu(0U, increment, &count);
	zassert_ok(perf_stat_stop(&config));
	for (size_t i = 0U; i < config.num_events; i++) {
		zassert_ok(handles[i].status);
	}
	zassert_equal(handles[0].final_count - handles[0].baseline, count);
	zassert_true(handles[1].final_count > handles[1].baseline);
}

ZTEST(perf_arm64, test_lookup_validation)
{
	struct perf_event_handle event = {
		.token = UINT64_MAX,
		.baseline = UINT64_MAX,
		.final_count = UINT64_MAX,
		.status = -1,
	};

	zassert_ok(perf_event_lookup("cpu0.CPU_CYCLES", &event));
	zassert_not_equal(event.token, 0U);
	zassert_equal(event.baseline, 0U);
	zassert_equal(event.final_count, 0U);
	zassert_ok(event.status);
	zassert_equal(perf_event_lookup("cpu0.unknown", &event), -ENOENT);
	zassert_equal(perf_event_lookup("unknown.CPU_CYCLES", &event), -ENOENT);
	zassert_equal(perf_event_lookup("CPU_CYCLES", &event), -EINVAL);
	zassert_equal(perf_event_lookup(NULL, &event), -EINVAL);
	zassert_equal(perf_event_lookup("cpu0.CPU_CYCLES", NULL), -EINVAL);
}

ZTEST(perf_arm64, test_duplicate_event)
{
	config.num_events = 2U;
	select_event(0U, "cpu0.CPU_CYCLES");
	handles[1] = handles[0];
	zassert_equal(perf_stat_start(&config), -EINVAL);
	recovery(0U);
}

ZTEST(perf_arm64, test_config_and_session_identity)
{
	struct perf_stat_config other_config;
	struct perf_event_handle invalid_event = {0};
	struct perf_stat_config invalid_config = {.events = &invalid_event, .num_events = 1U};

	zassert_equal(perf_stat_start(NULL), -EINVAL);
	zassert_equal(perf_stat_start(&invalid_config), -EINVAL);
	config.num_events = 1U;
	select_event(0U, "cpu0.CPU_CYCLES");
	other_config = config;
	zassert_ok(perf_stat_start(&config));
	zassert_equal(perf_stat_start(&config), -EBUSY);
	zassert_equal(perf_stat_stop(&other_config), -EINVAL);
	zassert_ok(perf_stat_stop(&config));
	zassert_equal(perf_stat_stop(&config), -EINVAL);
	recovery(0U);
}

ZTEST(perf_arm64, test_record_excludes_stat)
{
	int ret;

	config.num_events = 1U;
	select_event(0U, "cpu0.CPU_CYCLES");
	zassert_ok(z_perf_session_claim(PERF_SESSION_RECORD));
	ret = perf_stat_start(&config);
	z_perf_session_release(PERF_SESSION_RECORD);
	zassert_equal(ret, -EBUSY);
	recovery(0U);
}

ZTEST(perf_arm64, test_overflow)
{
	config.num_events = 1U;
	select_event(0U, "cpu0.SW_INCR");
	zassert_ok(perf_stat_start(&config));
	on_cpu(0U, overflow, NULL);
	zassert_ok(perf_stat_stop(&config));
	zassert_equal(handles[0].status, -EOVERFLOW);
	recovery(0U);
}

static void start_session(void *arg)
{
	*(int *)arg = perf_stat_start(&config);
}

static void stop_session(void *arg)
{
	*(int *)arg = perf_stat_stop(&config);
}

ZTEST(perf_arm64, test_cpu_isolation_and_caller_migration)
{
	uint32_t num_cpus = arch_num_cpus();
	int ret;

	zassert_true(num_cpus <= ARRAY_SIZE(handles));
	config.num_events = num_cpus;
	for (uint32_t cpu = 0U; cpu < num_cpus; cpu++) {
		char name[32];
		int length = snprintk(name, sizeof(name), "cpu%u.SW_INCR", cpu);

		zassert_true(length > 0 && (size_t)length < sizeof(name));
		select_event(cpu, name);
	}
	on_cpu(0U, start_session, &ret);
	zassert_ok(ret);
	for (uint32_t cpu = 0U; cpu < num_cpus; cpu++) {
		uint32_t count = 17U * (cpu + 1U);

		on_cpu(cpu, increment, &count);
	}
	on_cpu(num_cpus - 1U, stop_session, &ret);
	zassert_ok(ret);
	for (uint32_t cpu = 0U; cpu < num_cpus; cpu++) {
		zassert_ok(handles[cpu].status);
		zassert_equal(handles[cpu].final_count - handles[cpu].baseline, 17U * (cpu + 1U));
	}
}

#ifdef CONFIG_SMP
struct busy_workload {
	struct k_sem ready;
	atomic_t release;
	atomic_t timed_out;
	bool scheduler_locked;
};

static void busy_entry(void *arg, void *unused1, void *unused2)
{
	struct busy_workload *workload = arg;
	k_timepoint_t end = sys_timepoint_calc(K_SECONDS(2));

	ARG_UNUSED(unused1);
	ARG_UNUSED(unused2);
	if (workload->scheduler_locked) {
		k_sched_lock();
	}
	k_sem_give(&workload->ready);
	while (atomic_get(&workload->release) == 0) {
		if (sys_timepoint_expired(end)) {
			atomic_set(&workload->timed_out, 1);
			break;
		}
	}
	if (workload->scheduler_locked) {
		k_sched_unlock();
	}
}

static void exercise_busy_cpu(void *arg)
{
	static K_THREAD_STACK_DEFINE(busy_stack, 2048);

	static struct k_thread busy_thread;
	struct busy_workload workload = {.scheduler_locked = *(bool *)arg};
	int priority = workload.scheduler_locked ? K_PRIO_PREEMPT(0) : K_PRIO_COOP(0);
	int ret;

	zassert_ok(k_sem_init(&workload.ready, 0U, 1U));
	k_thread_create(&busy_thread, busy_stack, K_THREAD_STACK_SIZEOF(busy_stack), busy_entry,
			&workload, NULL, NULL, priority, 0U, K_FOREVER);
	zassert_ok(k_thread_cpu_pin(&busy_thread, 1));
	k_thread_start(&busy_thread);
	ret = k_sem_take(&workload.ready, K_SECONDS(1));
	config.num_events = 1U;
	/* Repeated lookup, prepare, start and stop must all interrupt the workload. */
	for (size_t i = 0U; ret == 0 && i < 4U; i++) {
		ret = perf_event_lookup("cpu1.SW_INCR", &handles[0]);
		if (ret == 0) {
			ret = perf_stat_start(&config);
		}
		if (ret == 0) {
			ret = perf_stat_stop(&config);
		}
		if (ret == 0) {
			ret = handles[0].status;
		}
	}
	/* Release and join before asserting, including when a request failed. */
	atomic_set(&workload.release, 1);
	zassert_ok(k_thread_join(&busy_thread, K_SECONDS(3)));
	zassert_ok(ret);
	zassert_equal(atomic_get(&workload.timed_out), 0,
		      "PMU requests waited for the target workload to yield");
}

ZTEST(perf_arm64, test_remote_cooperative_workload)
{
	bool scheduler_locked = false;

	on_cpu(0U, exercise_busy_cpu, &scheduler_locked);
}

ZTEST(perf_arm64, test_remote_scheduler_locked_workload)
{
	bool scheduler_locked = true;

	on_cpu(0U, exercise_busy_cpu, &scheduler_locked);
}
#endif

static char event_names[32][48];
static size_t event_name_count;

static int save_event(const char *name, const char *description, void *user_data)
{
	ARG_UNUSED(description);
	ARG_UNUSED(user_data);
	zassert_true(event_name_count < ARRAY_SIZE(event_names));
	int ret = snprintk(event_names[event_name_count], sizeof(event_names[0]), "cpu0.%s", name);

	zassert_true(ret > 0 && (size_t)ret < sizeof(event_names[0]));
	event_name_count++;
	return 0;
}

static void get_capacity(void *arg)
{
	zassert_ok(perf_counter_init());
	*(uint32_t *)arg = MIN(perf_counter_num_counters(), CONFIG_PMU_MAX_COUNTERS);
}

struct event_catalog {
	struct perf_counter_event_info events[32];
	uint32_t count;
	uint32_t position;
	k_tid_t caller;
	bool stop_after_one;
};

static void read_catalog(void *arg)
{
	struct event_catalog *catalog = arg;

	catalog->count = perf_counter_num_events();
	zassert_true(catalog->count <= ARRAY_SIZE(catalog->events));
	for (uint32_t i = 0U; i < catalog->count; i++) {
		zassert_ok(perf_counter_event_get(i, &catalog->events[i]));
	}
}

static int compare_event(const char *name, const char *description, void *user_data)
{
	struct event_catalog *catalog = user_data;
	const char *expected;

	zassert_equal(k_current_get(), catalog->caller, "Callback changed execution context");
	zassert_true(catalog->position < catalog->count);
	expected = catalog->events[catalog->position++].name;
	zassert_str_equal(description, expected);
	zassert_str_equal(name, expected);
	return catalog->stop_after_one ? -EIO : 0;
}

ZTEST(perf_arm64, test_backend_catalog)
{
	struct event_catalog catalog = {.caller = k_current_get()};

	for (uint32_t cpu = 0U; cpu < arch_num_cpus(); cpu++) {
		char provider[16];
		int length = snprintk(provider, sizeof(provider), "cpu%u", cpu);

		zassert_true(length > 0 && (size_t)length < sizeof(provider));
		on_cpu(cpu, read_catalog, &catalog);
		catalog.position = 0U;
		zassert_ok(z_perf_provider_event_list(provider, compare_event, &catalog));
		zassert_equal(catalog.position, catalog.count);
		for (uint32_t i = 0U; i < catalog.count; i++) {
			const char *name = catalog.events[i].name;
			struct perf_event_handle event;
			char canonical[64];

			length = snprintk(canonical, sizeof(canonical), "%s.%s", provider, name);
			zassert_true(length > 0 && (size_t)length < sizeof(canonical));
			zassert_ok(perf_event_lookup(canonical, &event));
		}
	}
}

ZTEST(perf_arm64, test_list_callback_error)
{
	struct event_catalog catalog = {
		.caller = k_current_get(),
		.stop_after_one = true,
	};

	on_cpu(0U, read_catalog, &catalog);
	zassert_equal(z_perf_provider_event_list("cpu0", compare_event, &catalog), -EIO);
	zassert_equal(catalog.position, 1U);
	recovery(0U);
}

ZTEST(perf_arm64, test_discovery_during_session)
{
	struct event_catalog catalog = {.caller = k_current_get()};
	struct perf_event_handle event;
	uint32_t count = 19U;

	config.num_events = 1U;
	select_event(0U, "cpu0.SW_INCR");
	zassert_ok(perf_stat_start(&config));
	on_cpu(0U, increment, &count);
	on_cpu(0U, read_catalog, &catalog);
	zassert_ok(z_perf_provider_event_list("cpu0", compare_event, &catalog));
	zassert_equal(catalog.position, catalog.count);
	zassert_ok(perf_event_lookup("cpu0.CPU_CYCLES", &event));
	on_cpu(0U, increment, &count);
	zassert_ok(perf_stat_stop(&config));
	zassert_ok(handles[0].status);
	zassert_equal(handles[0].final_count - handles[0].baseline, 2U * count);
}

ZTEST(perf_arm64, test_capacity_cleanup)
{
	uint32_t capacity;
	size_t offset = IS_ENABLED(CONFIG_SMP) ? 1U : 0U;

	event_name_count = 0U;
	zassert_ok(z_perf_provider_event_list("cpu0", save_event, NULL));
	on_cpu(0U, get_capacity, &capacity);
	zassert_true(event_name_count > capacity);
	config.num_events = offset + capacity + 1U;
	zassert_true(config.num_events <= ARRAY_SIZE(handles));
	if (IS_ENABLED(CONFIG_SMP)) {
		/* Prepare another CPU before exhausting CPU0's counter slots. */
		select_event(0U, "cpu1.SW_INCR");
	}
	for (size_t i = 0U; i <= capacity; i++) {
		select_event(offset + i, event_names[i]);
	}
	zassert_equal(perf_stat_start(&config), -ENOSPC);
	on_cpu(0U, check_disabled, NULL);
	if (IS_ENABLED(CONFIG_SMP)) {
		on_cpu(1U, check_disabled, NULL);
	}
	recovery(0U);
	if (IS_ENABLED(CONFIG_SMP)) {
		recovery(1U);
	}
}

static void after(void *fixture)
{
	ARG_UNUSED(fixture);
	/* Release an active session if an assertion interrupted the test. */
	z_perf_session_release(PERF_SESSION_RECORD);
	(void)perf_stat_stop(&config);
}

ZTEST_SUITE(perf_arm64, NULL, NULL, NULL, after, NULL);
```

## src/shell.c
```c
/*
 * Copyright 2026 Arm Limited and/or its affiliates <open-source-office@arm.com>
 *
 * SPDX-License-Identifier: Apache-2.0
 */

#include <errno.h>
#include <stdint.h>
#include <stdlib.h>
#include <string.h>
#include <zephyr/kernel.h>
#include <zephyr/shell/shell.h>
#include <zephyr/shell/shell_dummy.h>
#include <zephyr/ztest.h>

#include "internal.h"

static const char *execute_command_with_timeout(const char *command, int expected_ret,
					       const char *expected_output, k_timeout_t timeout)
{
	const struct shell *sh = shell_backend_dummy_get_ptr();
	k_timepoint_t end = sys_timepoint_calc(timeout);
	const char *output;
	size_t output_size;
	int ret;

	for (;;) {
		shell_backend_dummy_clear_output(sh);
		ret = shell_execute_cmd(sh, command);
		if (ret != -EINPROGRESS || sys_timepoint_expired(end)) {
			break;
		}
		/* The session can be released before the recording work returns. */
		k_msleep(1);
	}
	zassert_equal(ret, expected_ret, "%s returned %d, expected %d", command, ret, expected_ret);
	output = shell_backend_dummy_get_output(sh, &output_size);
	if (expected_output != NULL) {
		zassert_not_null(strstr(output, expected_output), "%s: missing '%s' in '%s'",
				 command, expected_output, output);
	}
	return output;
}

static const char *execute_command(const char *command, int expected_ret,
				   const char *expected_output)
{
	return execute_command_with_timeout(command, expected_ret, expected_output, K_NO_WAIT);
}

static void check_stat_result(const char *command)
{
	const char *header = "Perf buffer type: stat, version: 1";
	const char *expected_name = "cpu0.CPU_CYCLES";
	const char *output = execute_command(command, 0, header);
	const char *result = strstr(output, header) + strlen(header);
	const char *name;
	char *end;

	errno = 0;
	(void)strtoull(result, &end, 10);
	zassert_true(end != result && errno == 0, "Invalid stat result: %s", output);
	name = end + strspn(end, " \t\r\n");
	zassert_equal(strcspn(name, " \t\r\n"), strlen(expected_name));
	zassert_mem_equal(name, expected_name, strlen(expected_name));
}

static void check_info(bool retained_result)
{
	if (retained_result) {
		execute_command("perf info", 0, "Perf buffer: stat");
	} else if (IS_ENABLED(CONFIG_PROFILING_PERF)) {
		execute_command("perf info", 0, "Perf buf: 0/");
	} else {
		execute_command("perf info", 0, "Perf buffer: empty");
	}
}

static void check_empty_buffer(void)
{
	const char *expected = IS_ENABLED(CONFIG_PROFILING_PERF) ?
		"Perf buf length 0" : "Perf buffer empty";

	execute_command("perf printbuf", 0, expected);
}

static void wait_for_session_stop(void)
{
	zassert_true(WAIT_FOR(!z_perf_session_is_active(), 2 * USEC_PER_SEC, k_msleep(1)),
		     "Perf session did not stop");
}

static void *shell_setup(void)
{
	const struct shell *sh = shell_backend_dummy_get_ptr();

	WAIT_FOR(shell_ready(sh), 20000, k_msleep(1));
	zassert_true(shell_ready(sh), "Timed out waiting for dummy shell backend");
	return NULL;
}

static void shell_after(void *fixture)
{
	const struct shell *sh = shell_backend_dummy_get_ptr();

	ARG_UNUSED(fixture);
	/* Stop stat sessions and let real recordings finish after a failed assertion. */
	(void)shell_execute_cmd(sh, "perf stat stop");
	if (IS_ENABLED(CONFIG_PROFILING_PERF)) {
		wait_for_session_stop();
	} else {
		z_perf_session_release(PERF_SESSION_RECORD);
	}
	execute_command_with_timeout("perf clear", 0, "Perf buffer cleared", K_SECONDS(2));
}

ZTEST(perf_events_shell, test_discovery)
{
	execute_command("perf list", 0, "cpu0 : CPU performance counters");
	execute_command("perf list cpu0", 0, "cpu0.CPU_CYCLES : CPU_CYCLES");
	execute_command("perf list missing", -ENOENT, "Provider not found: missing");
}

ZTEST(perf_events_shell, test_invalid_arguments)
{
	execute_command("perf stat stop", -EINVAL, NULL);
	execute_command("perf stat start -x cpu0.CPU_CYCLES", -EINVAL, NULL);
	execute_command("perf stat start -e cpu0.missing", -ENOENT,
			"Event not found: cpu0.missing");
	execute_command("perf stat start -e cpu0.CPU_CYCLES -e cpu0.CPU_CYCLES", -EINVAL, NULL);
	check_info(false);
	execute_command("perf stat start -e cpu0.CPU_CYCLES", 0, "Perf stat started");
	execute_command("perf stat stop", 0, "cpu0.CPU_CYCLES");
}

ZTEST(perf_events_shell, test_result_retention)
{
	execute_command("perf stat start -e cpu0.CPU_CYCLES", 0, "Perf stat started");
	check_stat_result("perf stat stop");
	check_info(true);
	check_stat_result("perf printbuf");
	check_info(false);
	check_empty_buffer();

	execute_command("perf stat start -e cpu0.CPU_CYCLES", 0, "Perf stat started");
	execute_command("perf stat stop", 0, "cpu0.CPU_CYCLES");
	execute_command("perf clear", 0, "Perf buffer cleared");
	check_info(false);
	check_empty_buffer();
}

ZTEST(perf_events_shell, test_active_session)
{
	execute_command("perf stat start -e cpu0.CPU_CYCLES", 0, "Perf stat started");
	execute_command("perf info", 0, "Perf is running");
	execute_command("perf stat start -e cpu0.CPU_CYCLES", -EBUSY, "Perf is running");
	execute_command("perf printbuf", -EINPROGRESS, "Perf is running");
	execute_command("perf clear", -EINPROGRESS, "Perf is running");
	execute_command("perf stat stop", 0, "cpu0.CPU_CYCLES");
	check_info(true);
	execute_command("perf stat start -e cpu0.CPU_CYCLES", 0, "Perf stat started");
	check_info(false);
	execute_command("perf stat stop", 0, "cpu0.CPU_CYCLES");
}

ZTEST(perf_events_shell, test_record_excludes_stat)
{
	if (IS_ENABLED(CONFIG_PROFILING_PERF)) {
		execute_command("perf record 200 10", 0, "Enabled perf");
	} else {
		zassert_ok(z_perf_session_claim(PERF_SESSION_RECORD));
	}
	execute_command("perf stat start -e cpu0.CPU_CYCLES", -EBUSY, "Perf is running");
	if (IS_ENABLED(CONFIG_PROFILING_PERF)) {
		wait_for_session_stop();
	} else {
		z_perf_session_release(PERF_SESSION_RECORD);
	}
	execute_command("perf stat start -e cpu0.CPU_CYCLES", 0, "Perf stat started");
	execute_command("perf stat stop", 0, "cpu0.CPU_CYCLES");
}

#if defined(CONFIG_PROFILING_PERF)
ZTEST(perf_events_shell, test_stat_excludes_record)
{
	execute_command("perf stat start -e cpu0.CPU_CYCLES", 0, "Perf stat started");
	execute_command("perf record 200 10", -EINPROGRESS, "Perf is running");
	check_stat_result("perf stat stop");
}

ZTEST(perf_events_shell, test_record_replaces_stat_result)
{
	const char *header = "Perf buf length ";
	const char *output;
	const char *result;
	char *end;
	uint64_t length;

	execute_command("perf stat start -e cpu0.CPU_CYCLES", 0, "Perf stat started");
	check_stat_result("perf stat stop");
	execute_command("perf record 200 10", 0, "Enabled perf");
	zassert_false(z_perf_stat_shell_has_result(), "Recording retained the old stat result");
	wait_for_session_stop();
	output = execute_command("perf info", 0, "Perf buf: ");
	zassert_is_null(strstr(output, "Perf buffer: stat"));
	output = execute_command_with_timeout("perf printbuf", 0, header, K_SECONDS(2));
	zassert_is_null(strstr(output, "Perf buffer type: stat"));
	result = strstr(output, header) + strlen(header);
	errno = 0;
	length = strtoull(result, &end, 10);
	zassert_true(end != result && errno == 0, "Invalid recording result: %s", output);
	zassert_true(length > 0U, "Recording buffer is empty");
	check_empty_buffer();
}
#endif

ZTEST_SUITE(perf_events_shell, NULL, shell_setup, NULL, shell_after, NULL);
```
