/*
 * Copyright (c) 2026 BayLibre SAS
 * SPDX-License-Identifier: Apache-2.0
 */

#include <zephyr/dt-bindings/gpio/gpio.h>

/ {
	led_1: led_1 {
		compatible = "zephyr,fake-leds";

		fake-led {
			label = "Fake LED 1";
		};
	};
};
