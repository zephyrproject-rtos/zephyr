/*
 * SPDX-FileCopyrightText: Copyright (c) 2026 Linumiz
 * SPDX-License-Identifier: Apache-2.0
 */

/ {
	rc_nec0: rc-nec-0 {
		compatible = "zephyr,rc-loopback";
		tx-echo;
		status = "okay";
	};
};
