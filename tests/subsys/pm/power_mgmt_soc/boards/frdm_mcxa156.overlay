/*
 * Copyright 2025 NXP
 *
 * SPDX-License-Identifier: Apache-2.0
 */

&ostimer0 {
	status = "disabled";
};

&systick {
	status = "okay";
};

&lptmr0 {
	clock-frequency = <16384>;
	timer-mode-sel = <0>;
	status = "okay";
};
