/*
 * Copyright (c) 2024 Analog Devices, Inc.
 *
 * SPDX-License-Identifier: Apache-2.0
 */

/ {
	chosen {
		zephyr,system-timer-companion = &rtc_counter;
	};
};

&rtc_counter {
	status = "okay";
	wakeup-source;
};
