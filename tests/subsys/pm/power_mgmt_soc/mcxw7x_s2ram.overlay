/*
 * SPDX-FileCopyrightText: Copyright 2026 NXP
 * SPDX-License-Identifier: Apache-2.0
 */

&powerdown {
	status = "okay";
};

&cpu0 {
	cpu-power-states = <&powerdown>;
};

/delete-node/ &stcm0;

&stcm {
	stcm0: system-memory@10000 {
		compatible = "mmio-sram";
		reg = <0x10000 DT_SIZE_K(32)>;
	};
};
