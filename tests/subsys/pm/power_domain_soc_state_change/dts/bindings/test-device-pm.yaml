## tests/subsys/pm/power_domain_soc_state_change/dts/bindings/test-device-pm.yaml
```yaml
# Copyright 2025 NXP
# SPDX-License-Identifier: Apache-2.0

include: [base.yaml, pm.yaml]

description: |
    This binding provides resources required to build and run the
    tests/subsys/pm/power_domain_soc_state_change test in Zephyr.

compatible: "test-device-pm"
```

## tests/subsys/pm/power_domain_soc_state_change/testcase.yaml
```yaml
# Copyright 2025 NXP
# SPDX-License-Identifier: Apache-2.0

tests:
  pm.power_domain_soc_state_change:
    platform_allow:
      - native_sim
    integration_platforms:
      - native_sim
    tags: pm
```

## tests/subsys/pm/power_mgmt/testcase.yaml
```yaml
common:
  platform_allow: native_sim
  tags: pm
tests:
  pm.system: {}
  pm.system.no.device.pm:
    extra_args:
      - EXTRA_CONF_FILE="no-device-pm.conf"
```

## tests/subsys/pm/power_mgmt_soc/boards/apollo510_evb.conf
```kconfig
CONFIG_PM_DEVICE_SYSTEM_MANAGED=y

CONFIG_SYS_CLOCK_HW_CYCLES_PER_SEC=900
CONFIG_SYS_CLOCK_TICKS_PER_SEC=28

CONFIG_SYS_HEAP_AUTO=n
CONFIG_COMMON_LIBC_MALLOC=n
CONFIG_COREMARK=y
```

## tests/subsys/pm/power_mgmt_soc/boards/ek_ra8p1_r7ka8p1kflcac_cm85.conf
```kconfig
# Copyright (c) 2025 Renesas Electronics Corporation
# SPDX-License-Identifier: Apache-2.0

CONFIG_PM_STATS=n
```

## tests/subsys/pm/power_mgmt_soc/boards/frdm_ke17z.conf
```kconfig
# Copyright 2025 NXP
#
# SPDX-License-Identifier: Apache-2.0

# Keep LPTMR as wake/idle timer via counter API
CONFIG_COUNTER=y
CONFIG_COUNTER_MCUX_LPTMR=y
CONFIG_COUNTER_MCUX_LPTMR_ALARM=y
CONFIG_PM_PREWAKEUP_CONV_MODE_CEIL=y
CONFIG_CORTEX_M_SYSTICK_STOP_IN_LPM=y
# Disable LPUART ISR support to prevent it
# from interfering with PM tests
CONFIG_UART_MCUX_LPUART_ISR_SUPPORT=n
CONFIG_UART_CONSOLE_INPUT_EXPIRED=n
```

## tests/subsys/pm/power_mgmt_soc/boards/frdm_mcxa153.conf
```kconfig
# Copyright 2025 NXP
#
# SPDX-License-Identifier: Apache-2.0

CONFIG_PM_PREWAKEUP_CONV_MODE_CEIL=y
CONFIG_COUNTER=y
CONFIG_COUNTER_MCUX_LPTMR_ALARM=y
```

## tests/subsys/pm/power_mgmt_soc/boards/frdm_mcxc242.conf
```kconfig
# Copyright 2025 NXP
#
# SPDX-License-Identifier: Apache-2.0

# Keep LPTMR as wake/idle timer via counter API
CONFIG_COUNTER=y
CONFIG_COUNTER_MCUX_LPTMR=y
CONFIG_COUNTER_MCUX_LPTMR_ALARM=y
CONFIG_PM_PREWAKEUP_CONV_MODE_CEIL=y
CONFIG_CORTEX_M_SYSTICK_RESET_BY_LPM=y
```

## tests/subsys/pm/power_mgmt_soc/boards/frdm_mcxe247.conf
```kconfig
# Copyright 2026 NXP
#
# SPDX-License-Identifier: Apache-2.0

CONFIG_PM_PREWAKEUP_CONV_MODE_CEIL=y
```

## tests/subsys/pm/power_mgmt_soc/boards/frdm_mcxn236.conf
```kconfig
# Copyright 2025 NXP
#
# SPDX-License-Identifier: Apache-2.0

CONFIG_PM_PREWAKEUP_CONV_MODE_CEIL=y
CONFIG_COUNTER=y
CONFIG_CORTEX_M_SYSTICK_RESET_BY_LPM=y
```

## tests/subsys/pm/power_mgmt_soc/boards/max32655evkit_max32655_m4.conf
```kconfig
# Copyright (c) 2024-2026 Analog Devices, Inc.
#
# SPDX-License-Identifier: Apache-2.0
#

CONFIG_COUNTER=y
CONFIG_PM_DEVICE=y
```

## tests/subsys/pm/power_mgmt_soc/boards/max32657evkit_max32657_ns.conf
```kconfig
# Copyright (c) 2025 Analog Devices, Inc.
#
# SPDX-License-Identifier: Apache-2.0
#

CONFIG_COUNTER=y
```

## tests/subsys/pm/power_mgmt_soc/boards/max32658evkit_max32658.conf
```kconfig
# Copyright (c) 2026 Analog Devices, Inc.
#
# SPDX-License-Identifier: Apache-2.0
#

CONFIG_COUNTER=y
CONFIG_PM_DEVICE=y
CONFIG_PM_DEVICE_RUNTIME=y
```

## tests/subsys/pm/power_mgmt_soc/boards/max32690evkit_max32690_m4.conf
```kconfig
# Copyright (c) 2024-2026 Analog Devices, Inc.
#
# SPDX-License-Identifier: Apache-2.0
#

CONFIG_COUNTER=y
CONFIG_LOG_MODE_DEFERRED=y
CONFIG_LOG_PROCESS_THREAD=y
CONFIG_PM_DEVICE=y
CONFIG_PM_DEVICE_RUNTIME=y
```

## tests/subsys/pm/power_mgmt_soc/testcase.yaml
```yaml
tests:
  pm.soc:
    platform_allow:
      - cc26x2r1_launchxl
      - cc1352r1_launchxl
      - mec15xxevb_assy6853
      - mec1501modular_assy6885
      - nucleo_f429zi
      - nucleo_wb55rg
      - nucleo_l476rg
      - twr_ke18f
      - mimxrt595_evk/mimxrt595s/cm33
      - rd_rw612_bga
      - frdm_ke17z
      - frdm_ke17z512
      - xg29_rb4412a
      - bg29_rb4420a
      - max32690evkit/max32690/m4
      - max32655evkit/max32655/m4
      - max32655fthr/max32655/m4
      - max32657evkit/max32657
      - max32657evkit/max32657/ns
      - imx95_evk/mimx9596/m7
      - ek_ra8m1
      - ek_ra8d1
      - mck_ra8t1
      - ek_ra8p1/r7ka8p1kflcac/cm85
    tags: pm
    integration_platforms:
      - mec15xxevb_assy6853
```

## tests/subsys/pm/power_residency_time/boards/frdm_rw612.conf
```kconfig
#
# Copyright 2026 NXP
#
# SPDX-License-Identifier: Apache-2.0
#
CONFIG_TEST_PM_MEASURE=y
CONFIG_TEST_PM_STATE_SUSTAIN_DURATION=10
```

## tests/subsys/pm/power_residency_time/boards/rd_rw612_bga.conf
```kconfig
#
# Copyright 2025 NXP
#
# SPDX-License-Identifier: Apache-2.0
#
CONFIG_ENABLE_PM_MEASURE=y
```

## tests/subsys/pm/power_residency_time/testcase.yaml
```yaml
# Copyright (c) 2025 Intel Corporation
# SPDX-License-Identifier: Apache-2.0

common:
  harness: power
  harness_config:
    fixture: pm_probe
    pytest_dut_scope: session
    power_measurements:
      elements_to_trim: 100
      min_peak_distance: 40
      min_peak_height: 0.008
      peak_padding: 40
      measurement_duration: 8
      num_of_transitions: 6
      expected_rms_values: [56.0, 4.0, 4.0, 1.4, 1.4, 0.26, 91]
      tolerance_percentage: 10

tests:
  pm.power_residency_time:
    platform_allow:
      - stm32l562e_dk
    tags:
      - pm

  pm.power_residency_time.pm_device:
    platform_allow:
      - stm32l562e_dk
    tags:
      - pm
    extra_args:
      - CONFIG_PM_DEVICE=y

  pm.power_residency_time.pm_device_runtime:
    platform_allow:
      - stm32l562e_dk
    tags:
      - pm
    extra_args:
      - CONFIG_PM_DEVICE=y
      - CONFIG_PM_DEVICE_RUNTIME=y

  pm.power_residency_time.pm_device_system_managed:
    platform_allow:
      - stm32l562e_dk
    tags:
      - pm
    extra_args:
      - CONFIG_PM_DEVICE=y
      - CONFIG_PM_DEVICE_SYSTEM_MANAGED=y
```

## tests/subsys/pm/power_states/testcase.yaml
```yaml
# Copyright (c) 2025 Intel Corporation
# SPDX-License-Identifier: Apache-2.0

tests:
  pm.power_states:
    platform_allow:
      - stm32l562e_dk
    tags:
      - pm
    harness: power
    harness_config:
      pytest_dut_scope: session
      measurements:
        - name: "power states"
          measurement_time: 6
          num_of_transitions: 4
          rms: [56.0, 4.0, 1.3, 0.26, 140]

  pm.power_states.pm_device:
    platform_allow:
      - stm32l562e_dk
    tags:
      - pm
    extra_args:
      - CONFIG_PM_DEVICE=y
    harness: power
    harness_config:
      pytest_dut_scope: session
      measurements:
        - name: "power states"
          measurement_time: 6
          num_of_transitions: 4
          rms: [56.0, 4.0, 1.3, 0.26, 140]

  pm.power_states.pm_device_runtime:
    platform_allow:
      - stm32l562e_dk
    tags:
      - pm
    extra_args:
      - CONFIG_PM_DEVICE=y
      - CONFIG_PM_DEVICE_RUNTIME=y
    harness: power
    harness_config:
      pytest_dut_scope: session
      measurements:
        - name: "power states"
          measurement_time: 6
          num_of_transitions: 4
          rms: [56.0, 4.0, 1.3, 0.26, 140]

  pm.power_states.pm_device_system_managed:
    platform_allow:
      - stm32l562e_dk
    tags:
      - pm
    extra_args:
      - CONFIG_PM_DEVICE=y
      - CONFIG_PM_DEVICE_SYSTEM_MANAGED=y
    harness: power
    harness_config:
      pytest_dut_scope: session
      measurements:
        - name: "power states"
          measurement_time: 6
          num_of_transitions: 4
          rms: [56.0, 4.0, 1.3, 0.26, 140]
```

## tests/subsys/pm/power_states_api/Kconfig
```kconfig
# Copyright (c) 2023 Intel Corporation
# SPDX-License-Identifier: Apache-2.0

menu "Zephyr"
source "Kconfig.zephyr"
endmenu

config TEST_PROVIDE_PM_HOOKS
	bool "Provide PM hooks for test purposes"
	default y
	select HAS_PM
```

## tests/subsys/pm/power_states_api/dts/bindings/test-device-pm.yaml
```yaml
# Copyright (c) 2024 Intel Corporation.
# SPDX-License-Identifier: Apache-2.0

include: [base.yaml, pm.yaml]

description: |
  This binding provides resources required to build and run the
  tests/subsys/pm/power_states_api test in Zephyr.

compatible: "test-device-pm"
```

## tests/subsys/pm/power_states_api/dts/bindings/test-power-states-api.yaml
```yaml
# Copyright (c) 2020, Intel Corporation
# SPDX-License-Identifier: Apache-2.0

description: |
    This binding provides resources required to build and run the
    tests/subsys/power/power_states_api test in Zephyr.

compatible: "test-power-states-api"

properties:
    cpu-power-states:
       type: phandles
       required: false
       description: List of power management states supported by this cpu.
```

## tests/subsys/pm/power_wakeup_timer/testcase.yaml
```yaml
# Copyright (c) 2025 Intel Corporation
# SPDX-License-Identifier: Apache-2.0

common:
  harness: power
  harness_config:
    fixture: pm_probe
    pytest_dut_scope: session
    power_measurements:
      elements_to_trim: 100
      min_peak_distance: 40
      min_peak_height: 0.008
      peak_padding: 40
      measurement_duration: 2
      num_of_transitions: 1
      expected_rms_values: [0.26, 140]
      tolerance_percentage: 10

tests:
  pm.power_wakeup_timer:
    platform_allow:
      - stm32l562e_dk
    tags:
      - pm

  pm.power_wakeup_timer.pm_device:
    platform_allow:
      - stm32l562e_dk
    tags:
      - pm
    extra_args:
      - CONFIG_PM_DEVICE=y
```
