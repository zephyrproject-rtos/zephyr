## tests/subsys/pm/device_dependencies/testcase.yaml
```yaml
tests:
  pm-device-dependencies.dts:
    tags: power
    platform_allow: native_posix
```

## tests/subsys/pm/device_driver_init/testcase.yaml
```yaml
common:
  platform_allow:
    - native_posix
  tags:
    - pm
tests:
  pm.device_driver_init: {}
  pm.device_driver_init.pm:
    extra_configs:
      - CONFIG_PM_DEVICE=y
      - CONFIG_PM_DEVICE_POWER_DOMAIN=y
  pm.device_driver_init.pm_device_runtime:
    extra_configs:
      - CONFIG_PM_DEVICE=y
      - CONFIG_PM_DEVICE_POWER_DOMAIN=y
      - CONFIG_PM_DEVICE_RUNTIME=y
```

## tests/subsys/pm/device_power_domains/dts/bindings/test-device-pm.yaml
```yaml
# Copyright (c) 2023, CSIRO
# SPDX-License-Identifier: Apache-2.0

include: [base.yaml, pm.yaml]

description: |
  This binding provides resources required to build and run the
  tests/subsys/pm/device_power_domains test in Zephyr.

compatible: "test-device-pm"

properties:
  alternate-domain:
    type: phandle
    description: Secondary domain the driver uses.
```

## tests/subsys/pm/device_power_domains/testcase.yaml
```yaml
tests:
  pm.power_domain.device:
    tags:
      - pm
    platform_allow:
      - native_sim
    integration_platforms:
      - native_sim
```

## tests/subsys/pm/device_runtime/testcase.yaml
```yaml
tests:
  subsys.pm.device_pm:
    # arch_irq_unlock(0) can't work correctly on these arch
    arch_exclude: arc xtensa
    tags: power
```

## tests/subsys/pm/device_runtime_api/Kconfig
```kconfig
# Copyright 2024 Nordic Semiconductor ASA
#
# SPDX-License-Identifier: Apache-2.0

source "Kconfig.zephyr"

config TEST_PM_DEVICE_ISR_SAFE
	bool "Use ISR safe PM for the test"
```

## tests/subsys/pm/device_runtime_api/dts/bindings/test-device-pm.yaml
```yaml
# Copyright (c) 2023, CSIRO
# SPDX-License-Identifier: Apache-2.0

include: [base.yaml, pm.yaml]

description: |
  This binding provides resources required to build and run the
  tests/subsys/pm/device_runtime_api test in Zephyr.

compatible: "test-device-pm"
```

## tests/subsys/pm/device_runtime_api/testcase.yaml
```yaml
common:
  tags: pm

tests:
  pm.device_runtime.api:
    platform_allow:
    - native_sim
  pm.device_runtime.isr_safe.api:
    platform_allow:
    - native_sim
    extra_configs:
    - CONFIG_TEST_PM_DEVICE_ISR_SAFE=y
```

## tests/subsys/pm/device_runtime_stress/testcase.yaml
```yaml
common:
  tags: pm

tests:
  pm.device_runtime.stress:
    platform_allow:
      - qemu_x86
```

## tests/subsys/pm/device_system_managed_smp/dts/bindings/intel,x86_64.yaml
```yaml
# SPDX-License-Identifier: Apache-2.0

description: |
    Intel x86_64 CPU. Local test binding so that cpu-power-states can be
    assigned to the qemu_x86_64 CPUs.

compatible: "intel,x86_64"

include: cpu.yaml
```

## tests/subsys/pm/device_system_managed_smp/dts/bindings/test-device-pm.yaml
```yaml
# SPDX-License-Identifier: Apache-2.0

description: |
    This binding provides resources required to build and run the
    tests/subsys/pm/device_system_managed_smp test in Zephyr.

compatible: "test-device-pm"
```

## tests/subsys/pm/device_system_managed_smp/testcase.yaml
```yaml
tests:
  pm.device_system_managed.smp:
    platform_allow: qemu_x86_64
    tags: pm
```

## tests/subsys/pm/device_wakeup_api/testcase.yaml
```yaml
tests:
  pm.device-wakeup-api.dts:
    tags: pm
    platform_allow:
      - native_sim
```

## tests/subsys/pm/device_wakeup_state/dts/bindings/test-device-wakeup-state.yaml
```yaml
#
# Copyright (c) 2021 Basalte bv
#
# SPDX-License-Identifier: Apache-2.0
#

description: |
    This binding provides resources required to build and run the
    tests/subsys/pm/device_wakeup_state test in Zephyr.

compatible: "test-device-wakeup-state"

include: "base.yaml"
```

## tests/subsys/pm/device_wakeup_state/testcase.yaml
```yaml
tests:
  pm-device-wakeup-state.dts:
    tags: power
    platform_allow: native_posix
```

## tests/subsys/pm/event_device/testcase.yaml
```yaml
# Copyright (c) 2025 Nordic Semiconductor ASA
# SPDX-License-Identifier: Apache-2.0

tests:
  pm.event_device:
    tags: pm_event_device
    harness: ztest
    platform_allow:
      - native_sim/native
      - native_sim/native/64
```

## tests/subsys/pm/event_domain/testcase.yaml
```yaml
# Copyright (c) 2025 Nordic Semiconductor ASA
# SPDX-License-Identifier: Apache-2.0

tests:
  pm.event_domain:
    tags: pm_event_domain
    harness: ztest
    platform_allow:
      - native_sim
      - native_sim_64
```

## tests/subsys/pm/evtc/testcase.yaml
```yaml
# Copyright (c) 2024 Nordic Semiconductor ASA
# SPDX-License-Identifier: Apache-2.0

tests:
  pm.evtc:
    tags: pm_evtc
    harness: ztest
    platform_allow:
      - native_sim
```

## tests/subsys/pm/pm_sleep/Kconfig
```kconfig
# Copyright (c) 2026 Rithic Chellaram Hariharan
# SPDX-License-Identifier: Apache-2.0

menu "Zephyr"
source "Kconfig.zephyr"
endmenu

config TEST_PROVIDE_PM_HOOKS
	bool "Provide PM hooks for test purposes"
	default y
	select HAS_PM

config APP_HAVE_RETAINING_STATE
	bool "Devicetree declares a context-retaining power state"
	default y
	help
	  Set to n for the scenario whose devicetree declares only a soft-off
	  state, so that both helpers are expected to fail with -ENOTSUP.
```

## tests/subsys/pm/pm_sleep/testcase.yaml
```yaml
common:
  platform_allow: native_sim
  tags: pm
tests:
  pm.sleep: {}
  pm.sleep.no_retaining:
    extra_args:
      - DTC_OVERLAY_FILE="dts/soft_off_only.overlay"
    extra_configs:
      - CONFIG_APP_HAVE_RETAINING_STATE=n
```

## tests/subsys/pm/policy_api/testcase.yaml
```yaml
# Copyright (c) 2021 Nordic Semiconductor ASA.
# SPDX-License-Identifier: Apache-2.0

common:
  tags: pm
  platform_allow: native_posix native_posix_64
  integration_platforms:
    - native_posix
tests:
  pm.policy.api.app:
    extra_configs:
      - CONFIG_PM_POLICY_CUSTOM=y
```

## tests/subsys/pm/power_domain/Kconfig
```kconfig
# Copyright 2025 NXP
#
# SPDX-License-Identifier: Apache-2.0

source "Kconfig.zephyr"

config TEST_PM_DEVICE_ISR_SAFE
	bool "Use ISR safe PM for the test"
```

## tests/subsys/pm/power_domain/dts/bindings/test-device-pm.yaml
```yaml
# Copyright (c) 2021, Intel Corporation
# SPDX-License-Identifier: Apache-2.0

include: [base.yaml, pm.yaml]

description: |
    This binding provides resources required to build and run the
    tests/subsys/pm/power_domain test in Zephyr.

compatible: "test-device-pm"
```

## tests/subsys/pm/power_domain/testcase.yaml
```yaml
tests:
  pm.power_domain:
    platform_allow:
      - native_sim
    integration_platforms:
      - native_sim
    tags: pm
  pm.power_doamin.isr_safe:
    platform_allow:
      - native_sim
    integration_platforms:
      - native_sim
    extra_configs:
      - CONFIG_TEST_PM_DEVICE_ISR_SAFE=y
    tags: pm
```
