## tests/subsys/pm/wakeup_external_interrupt/controller/testcase.yaml
```yaml
tests:
  pm.wakeup_external_interrupt.controller:
    platform_allow:
      - stm32l562e_dk
    tags:
      - shell
      - gpio
    harness: pytest
    harness_config:
      pytest_dut_scope: session
```

## tests/subsys/pm/wakeup_external_interrupt/target_board/testcase.yaml
```yaml
tests:
  pm.wakeup_external_interrupt.target_board:
    platform_allow:
      - stm32l562e_dk
    tags:
      - pm
      - gpio
    harness: pytest
    harness_config:
      pytest_dut_scope: session
      pytest_args: [--controller=<path_to_controller>,
                    --power-monitor=<path_to_power_monitor>,
                    --expected_values=<path_to>/stm32l562e_dk.yaml]
  pm.wakeup_external_interrupt.target_board.pm_device:
    platform_allow:
      - stm32l562e_dk
    tags:
      - pm
      - gpio
    extra_args:
      - CONFIG_PM_DEVICE=y
    harness: pytest
    harness_config:
      pytest_dut_scope: session
      pytest_args: [--controller=<path_to_controller>,
                    --power-monitor=<path_to_power_monitor>,
                    --expected_values=<path_to>/stm32l562e_dk.yaml]
```

## tests/subsys/pmci/mctp/i2c_gpio/testcase.yaml
```yaml
tests:
  pmci.mctp.i2c_gpio.ping_pong:
    platform_allow:
      - npcx4m8f_evb
    tags:
      - mctp
      - uart
    harness_config:
      fixture: i2c_gpio_loopback
```

## tests/subsys/pmci/mctp/i3c/testcase.yaml
```yaml
tests:
  pmci.mctp.i3c.ping_pong:
    platform_allow:
      - npcx4m8f_evb
    tags:
      - mctp
      - i3c
    harness_config:
      fixture: i3c_loopback
```

## tests/subsys/portability/cmsis_rtos_v1/testcase.yaml
```yaml
tests:
  portability.cmsis_rtos_v1:
    platform_key:
      - arch
      - simulation
    tags: cmsis_rtos
    min_ram: 32
    min_flash: 34
    extra_configs:
      - CONFIG_CLOCK_CONTROL_NRF=n
    integration_platforms:
      - native_sim
  portability.cmsis_rtos_v1.legacy:
    platform_key:
      - arch
      - simulation
    tags: cmsis_rtos
    min_ram: 32
    min_flash: 34
    extra_configs:
      - CONFIG_CLOCK_CONTROL_NRF=y
      - CONFIG_DEPRECATION_TEST=y
    integration_platforms:
      - native_sim
```

## tests/subsys/portability/cmsis_rtos_v2/testcase.yaml
```yaml
tests:
  portability.cmsis_rtos_v2:
    platform_exclude: m2gl025_miv
    tags: cmsis_rtos
    min_ram: 32
    min_flash: 34
    integration_platforms:
      - native_sim
```

## tests/subsys/portability/freertos/testcase.yaml
```yaml
tests:
  portability.freertos:
    platform_key:
      - arch
      - simulation
    tags: cmsis_rtos
    min_ram: 32
    min_flash: 34
    integration_platforms:
      - native_sim
    platform_exclude:
      # 64-bit not supported yet
      - qemu_leon3/leon3
      - qemu_x86/atom
```

## tests/subsys/portability/posix/common/Kconfig
```kconfig
# Copyright (c) 2023, Meta
# SPDX-License-Identifier: Apache-2.0

# Options specific to clock.c / test_realtime

config TEST_CLOCK_RT_ITERATIONS
	int "Number of iterations to check clock_gettime() reliability"
	range 10 100
	default 20
	help
	  This option is specific to posix_apis.test_realtime in clock.c

config TEST_CLOCK_RT_SLEEP_MS
	int "Time to sleep between iterations in milliseconds"
	range 50 1000
	default 100
	help
	  This option is specific to posix_apis.test_realtime in clock.c

config TEST_CLOCK_RT_ERROR_MS
	int "Maximum overshoot (error) in milliseconds"
	range 10 500
	default 10
	help
	  This option is specific to posix_apis.test_realtime in clock.c

config TEST_SEM_N_LOOPS
	int "Number of loops in semaphore test"
	range 16 1024
	default 32
	help
	  This option is specific to semaphore.test_named_semaphore in semaphore.c

source "Kconfig.zephyr"
```

## tests/subsys/portability/posix/net/testcase.yaml
```yaml
common:
  depends_on: netif
  min_ram: 16
  tags:
    - iface
    - net
    - posix
  # dependent on netif support
  integration_platforms:
    - mps2/an385
    - qemu_x86
  # Building with the host libC links to if_*() from the host libc which causes the test to crash
  # immediately.
  filter: not CONFIG_NATIVE_LIBC
tests:
  portability.posix.net:
    extra_configs:
      - CONFIG_COMMON_LIBC_MALLOC_ARENA_SIZE=256
  portability.posix.net.armclang_std_libc:
    toolchain_allow: armclang
    extra_configs:
      - CONFIG_ARMCLANG_STD_LIBC=y
  portability.posix.net.arcmwdtlib:
    toolchain_allow: arcmwdt
    extra_configs:
      - CONFIG_ARCMWDT_LIBC=y
  portability.posix.net.minimal:
    extra_configs:
      - CONFIG_MINIMAL_LIBC=y
      - CONFIG_COMMON_LIBC_MALLOC_ARENA_SIZE=256
  portability.posix.net.newlib:
    filter: TOOLCHAIN_HAS_NEWLIB == 1
    extra_configs:
      - CONFIG_NEWLIB_LIBC=y
  portability.posix.net.picolibc:
    tags: picolibc
    filter: CONFIG_PICOLIBC_SUPPORTED
    extra_configs:
      - CONFIG_PICOLIBC=y
  portability.posix.net.hostname.dynamic:
    extra_configs:
      - CONFIG_NET_HOSTNAME_ENABLE=y
      - CONFIG_NET_HOSTNAME_DYNAMIC=y
  portability.posix.net.hostname.unique:
    extra_configs:
      - CONFIG_NET_HOSTNAME_ENABLE=y
      - CONFIG_NET_HOSTNAME_UNIQUE=y
      - CONFIG_NET_HOSTNAME_UNIQUE_UPDATE=y
  portability.posix.net.hostname.dynamic.minimal_libc:
    extra_configs:
      - CONFIG_MINIMAL_LIBC=y
      - CONFIG_NET_HOSTNAME_ENABLE=y
      - CONFIG_NET_HOSTNAME_DYNAMIC=y
  portability.posix.net.hostname.unique_update:
    extra_configs:
      - CONFIG_POSIX_API=y
      - CONFIG_NET_HOSTNAME_UNIQUE_UPDATE=y
      - CONFIG_NET_HOSTNAME_UNIQUE=y
```

## tests/subsys/portability/posix/single_process/testcase.yaml
```yaml
common:
  filter: not CONFIG_NATIVE_LIBC
  tags:
    - posix
    - single_process
  # 1 tier0 platform per supported architecture
  platform_key:
    - arch
    - simulation
  integration_platforms:
    - qemu_riscv64
  min_flash: 64
  min_ram: 32
tests:
  portability.posix.single_process:
    extra_configs:
      - CONFIG_COMMON_LIBC_MALLOC_ARENA_SIZE=256
  portability.posix.single_process.armclang_std_libc:
    toolchain_allow: armclang
    extra_configs:
      - CONFIG_ARMCLANG_STD_LIBC=y
  portability.posix.single_process.arcmwdtlib:
    toolchain_allow: arcmwdt
    extra_configs:
      - CONFIG_ARCMWDT_LIBC=y
  portability.posix.single_process.minimal:
    extra_configs:
      - CONFIG_MINIMAL_LIBC=y
      - CONFIG_COMMON_LIBC_MALLOC_ARENA_SIZE=256
  portability.posix.single_process.newlib:
    filter: TOOLCHAIN_HAS_NEWLIB == 1
    extra_configs:
      - CONFIG_NEWLIB_LIBC=y
  portability.posix.single_process.picolibc:
    tags: picolibc
    filter: CONFIG_PICOLIBC_SUPPORTED
    extra_configs:
      - CONFIG_PICOLIBC=y
```

## tests/subsys/portability/posix/threads_base/testcase.yaml
```yaml
common:
  tags: posix
  min_ram: 64
  timeout: 240
  platform_key:
    - arch
    - simulation
  filter: not CONFIG_NATIVE_LIBC
tests:
  posix.threads_base:
    filter: CONFIG_ARCH_POSIX
    platform_allow:
      - native_sim
      - native_sim/native/64
    integration_platforms:
      - native_sim
    extra_configs:
      - CONFIG_POSIX_THREADS=y
  posix.threads_base.tls:
    platform_exclude:
      - intel_ehl_crb
    filter: CONFIG_ARCH_HAS_THREAD_LOCAL_STORAGE and CONFIG_TOOLCHAIN_SUPPORTS_THREAD_LOCAL_STORAGE
    extra_configs:
      - CONFIG_NEWLIB_LIBC=n
      - CONFIG_THREAD_LOCAL_STORAGE=y
  posix.threads_base.tls.newlib:
    platform_exclude:
      - intel_ehl_crb
      - lpcxpresso55s06
    filter:
      TOOLCHAIN_HAS_NEWLIB == 1 and CONFIG_ARCH_HAS_THREAD_LOCAL_STORAGE and
      CONFIG_TOOLCHAIN_SUPPORTS_THREAD_LOCAL_STORAGE
    extra_configs:
      - CONFIG_NEWLIB_LIBC=y
      - CONFIG_THREAD_LOCAL_STORAGE=y
  posix.threads_base.dynamic_stack:
    extra_configs:
      - CONFIG_DYNAMIC_THREAD=y
      - CONFIG_THREAD_STACK_INFO=y
      - CONFIG_HEAP_MEM_POOL_SIZE=16384
      - CONFIG_POSIX_THREAD_KEYS_MAX=2048
      - CONFIG_TEST_EXTRA_STACK_SIZE=16384
  posix.threads_base.static_stack:
    extra_configs:
      - CONFIG_DYNAMIC_THREAD=n
      - CONFIG_THREAD_STACK_INFO=n
```

## tests/subsys/portability/posix/timers/testcase.yaml
```yaml
common:
  filter: not CONFIG_NATIVE_LIBC
  tags:
    - posix
    - timers
  # 1 tier0 platform per supported architecture
  platform_key:
    - arch
    - simulation
  min_flash: 64
  min_ram: 32
tests:
  portability.posix.timers: {}
  portability.posix.timers.minimal:
    extra_configs:
      - CONFIG_MINIMAL_LIBC=y
  portability.posix.timers.newlib:
    filter: TOOLCHAIN_HAS_NEWLIB == 1
    extra_configs:
      - CONFIG_NEWLIB_LIBC=y
  portability.posix.timers.picolibc:
    tags: picolibc
    filter: CONFIG_PICOLIBC_SUPPORTED
    extra_configs:
      - CONFIG_PICOLIBC=y
```

## tests/subsys/power/power_mgmt/Kconfig
```kconfig
# Copyright (c) 2020 Intel Corporation.
# SPDX-License-Identifier: Apache-2.0

config SUBPOWER_TEST
	bool
	default y
	select HAS_POWER_STATE_SLEEP_1
	help
	  Hidden option enabling LPS_0 power state regardless of hardware
	  support. This ensures that power management hooks used in this
	  test to profile idle thread will be executed.

# Include Zephyr's Kconfig.
source "Kconfig"
```

## tests/subsys/power/power_mgmt/testcase.yaml
```yaml
tests:
  subsys.power.device_pm:
    ## arch_irq_unlock(0) can't work correctly on these arch
    arch_exclude: arc xtensa
    ## When TICKLESS_IDLE enable, some of these platforms don't
    ## provide a timer driver.  Other platforms are excluded because
    ## they lack some other required feature.
    platform_exclude: rv32m1_vega_ri5cy rv32m1_vega_zero_riscy litex_vexriscv nrf5340dk_nrf5340_cpunet
    filter: CONFIG_PM
    integration_platforms:
      - qemu_x86
      - mps2_an385
    tags: power
  subsys.power.interface:
    arch_exclude: arc xtensa
    platform_exclude: rv32m1_vega_ri5cy rv32m1_vega_zero_riscy litex_vexriscv qemu_cortex_m0
    extra_configs:
      - CONFIG_MAIN_STACK_SIZE=2048
    extra_args: CONF_FILE=interface_prj.conf TEST_INTERFACES=1
    filter: CONFIG_PM
    tags: power
```

## tests/subsys/power/power_mgmt_soc/testcase.yaml
```yaml
tests:
  subsys.power.pm_soc:
    platform_allow: cc26x2r1_launchxl cc1352r1_launchxl mec15xxevb_assy6853 mec1501modular_assy6885
       nucleo_wb55rg nucleo_l476rg
    tags: power
```

## tests/subsys/power/qos/testcase.yaml
```yaml
common:
  tags: power

tests:
  subsys.power.qos:
    platform_allow:
      - qemu_cortex_m3
    integration_platforms:
      - qemu_cortex_m3
```

## tests/subsys/random/rng/testcase.yaml
```yaml
common:
  tags:
    - crypto
    - random
    - security
tests:
  crypto.rng:
    min_ram: 16
    integration_platforms:
      - qemu_x86
  crypto.rng.random_sw_systimer:
    extra_args: CONF_FILE=prj_sw_random_systimer.conf
    integration_platforms:
      - qemu_x86
  crypto.rng.random_hw_xoshiro:
    extra_args: CONF_FILE=prj_hw_random_xoshiro.conf
    filter: CONFIG_ENTROPY_HAS_DRIVER
    min_ram: 16
    integration_platforms:
      - native_sim
  crypto.rng.random_ctr_drbg:
    extra_args: CONF_FILE=prj_ctr_drbg.conf
    filter: CONFIG_ENTROPY_HAS_DRIVER
    min_ram: 16
    integration_platforms:
      - native_sim
  drivers.rng.random_psa_crypto:
    filter: CONFIG_BUILD_WITH_TFM
    arch_exclude: posix
    extra_args:
      - DTC_OVERLAY_FILE=./entropy_psa_crypto.overlay
      - CONF_FILE=prj_hw_random_psa_crypto.conf
    tags:
      - psa-crypto
    integration_platforms:
      - nrf5340dk/nrf5340/cpuapp/ns
```

## tests/subsys/retention/testcase.yaml
```yaml
tests:
  retention.build_all:
    platform_allow:
      - nucleo_f746zg
    tags: retention
```

## tests/subsys/rtio/rtio_api/testcase.yaml
```yaml
common:
  # renode causes timeouts unfortunately
  # xtensa dc233 (with mmu) has a TLB exception for unclear reasons
  platform_exclude: m2gl025_miv m5stack_core2 hifive1 qemu_xtensa_dc233c
  platform_key:
    - arch
    - simulation
tests:
  rtio.api:
    filter: not CONFIG_ARCH_HAS_USERSPACE
    tags: rtio
    integration_platforms:
      - native_sim
  rtio.api.submit_sem:
    filter: not CONFIG_ARCH_HAS_USERSPACE
    tags: rtio
    extra_configs:
      - CONFIG_RTIO_SUBMIT_SEM=y
    integration_platforms:
      - native_sim
  rtio.api.userspace:
    filter: CONFIG_ARCH_HAS_USERSPACE
    extra_configs:
      - CONFIG_USERSPACE=y
    arch_exclude:
      - posix
    tags:
      - rtio
      - userspace
    integration_platforms:
      - qemu_x86
  rtio.api.userspace.submit_sem:
    filter: CONFIG_ARCH_HAS_USERSPACE
    extra_configs:
      - CONFIG_USERSPACE=y
      - CONFIG_RTIO_SUBMIT_SEM=y
    arch_exclude:
      - posix
    tags:
      - rtio
      - userspace
    integration_platforms:
      - qemu_x86
```

## tests/subsys/rtio/rtio_i2c/dts/bindings/zephyr,blocking-emul.yaml
```yaml
# Copyright (c) 2024 Google LLC
# SPDX-License-Identifier: Apache-2.0

description: |
  A generic blocking target device used for testing async RTIO APIs

compatible: "zephyr,blocking-emul"

include: i2c-device.yaml
```

## tests/subsys/rtio/rtio_i2c/testcase.yaml
```yaml
# Copyright (c) 2024 Google LLC
# SPDX-License-Identifier: Apache-2.0

tests:
  rtio.i2c:
    platform_allow: native_sim
    tags: rtio
```

## tests/subsys/rtio/rtio_i3c/dts/bindings/zephyr,blocking-emul-i3c.yaml
```yaml
# Copyright (c) 2026 Meta Platforms
# SPDX-License-Identifier: Apache-2.0

description: |
  I3C peripheral emulator used by the subsys/rtio rtio_i3c test.
  Sits on a zephyr,i3c-emul bus and forwards xfers / do_ccc to
  FFF-wrapped fakes so tests can intercept and assert on the
  driver-supplied messages.

compatible: "zephyr,blocking-emul-i3c"

include: [i3c-device.yaml]

properties:
  bcr:
    type: int
    default: 0x20

  dcr:
    type: int
    default: 0x6c
```

## tests/subsys/scsi/scsi_ufs/Kconfig
```kconfig
# Copyright (c) 2025 Advanced Micro Devices, Inc.
# SPDX-License-Identifier: Apache-2.0

mainmenu "SCSI UFS test"

config TEST_SCSI_UFS_RW
	bool "SCSI UFS RW Tests (DANGEROUS)"
	help
	  To perform Writing to UFS device as part of SCSI RW Tests.
	  This will overwrite existing data on UFS device.

source "Kconfig.zephyr"
```

## tests/subsys/scsi/scsi_ufs/testcase.yaml
```yaml
common:
  depends_on:
    - scsi
  tags:
    - scsi
    - ufs
  filter: dt_alias_exists("ufs0")
tests:
  scsi.ufs.scsi_basic:
    depends_on: ufshc
  scsi.ufs.scsi_rw:
    depends_on: ufshc
    extra_configs:
      - CONFIG_TEST_SCSI_UFS_RW=y
```
