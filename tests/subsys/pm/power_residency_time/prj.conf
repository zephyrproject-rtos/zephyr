## CMakeLists.txt
```
# Copyright (c) 2025 Intel Corporation
# SPDX-License-Identifier: Apache-2.0

cmake_minimum_required(VERSION 3.28.0)
find_package(Zephyr REQUIRED HINTS $ENV{ZEPHYR_BASE})
project(power_residency_time)

FILE(GLOB app_sources src/*.c)
target_sources(app PRIVATE ${app_sources})
```

## prj.conf
```kconfig
# Copyright (c) 2024 Intel Corporation
# SPDX-License-Identifier: Apache-2.0

CONFIG_PM=y
```

## boards/frdm_rw612.conf
```kconfig
#
# Copyright 2026 NXP
#
# SPDX-License-Identifier: Apache-2.0
#
CONFIG_TEST_PM_MEASURE=y
CONFIG_TEST_PM_STATE_SUSTAIN_DURATION=10
```

## boards/rd_rw612_bga.conf
```kconfig
#
# Copyright 2026 NXP
#
# SPDX-License-Identifier: Apache-2.0
#
CONFIG_TEST_PM_MEASURE=y
```

## boards/frdm_rw612.overlay
```dts
/*
 * Copyright 2025 NXP
 *
 * SPDX-License-Identifier: Apache-2.0
 */

stop0: &standby {
	status = "okay";
};

stop1: &standby {
	status = "okay";
};

stop2: &standby {
	status = "okay";
};
```

## boards/stm32l562e_dk.overlay
```dts
/*
 * Copyright (c) 2025 Intel Corporation
 *
 * SPDX-License-Identifier: Apache-2.0
 */

&stop0 {
	compatible = "zephyr,power-state";
	power-state-name = "suspend-to-idle";
	substate-id = <1>;
	min-residency-us = <500000>;
};

&stop1 {
	compatible = "zephyr,power-state";
	power-state-name = "suspend-to-idle";
	substate-id = <2>;
	min-residency-us = <1000000>;
};

&stop2 {
	compatible = "zephyr,power-state";
	power-state-name = "suspend-to-idle";
	substate-id = <3>;
	min-residency-us = <1500000>;
};
```

## src/main.c
```c
/*
 * Copyright (c) 2025 Intel Corporation
 *
 * SPDX-License-Identifier: Apache-2.0
 */

#include <zephyr/kernel.h>
#include <zephyr/devicetree.h>

#define DIFF_RESIDENCY_TIME_STATE_0 600
#define DIFF_RESIDENCY_TIME_STATE_1 600
#define DIFF_RESIDENCY_TIME_STATE_2 600

#define PM_STATE0_NODE \
	COND_CODE_1(DT_NODE_EXISTS(DT_NODELABEL(stop0)), (DT_NODELABEL(stop0)), \
		     (DT_NODELABEL(idle)))
#define PM_STATE1_NODE \
	COND_CODE_1(DT_NODE_EXISTS(DT_NODELABEL(stop1)), (DT_NODELABEL(stop1)), \
		     (DT_NODELABEL(suspend)))
#define PM_STATE2_NODE \
	COND_CODE_1(DT_NODE_EXISTS(DT_NODELABEL(stop2)), (DT_NODELABEL(stop2)), \
		     (DT_NODELABEL(standby)))

int main(void)
{

	int stop0_min_residency_time = DT_PROP(PM_STATE0_NODE, min_residency_us);
	int stop1_min_residency_time = DT_PROP(PM_STATE1_NODE, min_residency_us);
	int stop2_min_residency_time = DT_PROP(PM_STATE2_NODE, min_residency_us);

	while (1) {
		printk("\nSleep time < min_residency_time of state 0\n");
		k_usleep(stop0_min_residency_time - DIFF_RESIDENCY_TIME_STATE_0);
		printk("\nSleep time = min_residency_time of state 0\n");
		k_usleep(stop0_min_residency_time);
		printk("\nSleep time < min_residency_time of state 1\n");
		k_usleep(stop1_min_residency_time - DIFF_RESIDENCY_TIME_STATE_1);
		printk("\nSleep time = min_residency_time of state 1\n");
		k_usleep(stop1_min_residency_time);
		printk("\nSleep time < min_residency_time of state 2\n");
		k_usleep(stop2_min_residency_time - DIFF_RESIDENCY_TIME_STATE_2);
		printk("\nSleep time = min_residency_time of state 2\n");
		k_usleep(stop2_min_residency_time);
#ifdef CONFIG_TEST_PM_MEASURE
		k_msleep(CONFIG_TEST_PM_STATE_SUSTAIN_DURATION * 1000);
#endif
		printk("\nWakeup.\n");

		/**
		 * Keeping alive loop
		 */
		while (1) {
			arch_nop();
		}
	}
	return 0;
}
```
