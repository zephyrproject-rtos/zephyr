## CMakeLists.txt
```
# SPDX-FileCopyrightText: Copyright (c) 2026 Infineon Technologies AG,
# or an affiliate of Infineon Technologies AG. All rights reserved.
#
# SPDX-License-Identifier: Apache-2.0

cmake_minimum_required(VERSION 3.28.0)
find_package(Zephyr REQUIRED HINTS $ENV{ZEPHYR_BASE})
project(system_timer_lpm_test)

target_sources(app PRIVATE src/main.c)
```

## prj.conf
```kconfig
# SPDX-FileCopyrightText: Copyright (c) 2026 Infineon Technologies AG,
# or an affiliate of Infineon Technologies AG. All rights reserved.
#
# SPDX-License-Identifier: Apache-2.0

CONFIG_ZTEST=y

# Tickless PM is required for the system timer to hand off to its low-power
# companion. The companion choice is provided by the board/SoC defconfig.
CONFIG_PM=y
CONFIG_TICKLESS_KERNEL=y
```

## boards/nucleo_l152re.conf
```kconfig
# SPDX-FileCopyrightText: Copyright The Zephyr Project Contributors
# SPDX-License-Identifier: Apache-2.0

CONFIG_IDLE_STACK_SIZE=512
```

## app.overlay
```dts
/*
 * SPDX-FileCopyrightText: Copyright (c) 2026 Infineon Technologies AG,
 * or an affiliate of Infineon Technologies AG. All rights reserved.
 *
 * SPDX-License-Identifier: Apache-2.0
 */

/ {
	zephyr,user {
		/* Default sleep durations (ms) for the timekeeping test.
		 * Override per board with boards/<board>.overlay to cover the
		 * durations that best exercise that platform's companion timer.
		 */
		sleep-durations-ms = <50 250 1500 3000>;
	};
};
```

## boards/nucleo_f103rb.overlay
```dts
/*
 * Copyright (c) 2026 STMicroelectronics
 *
 * SPDX-License-Identifier: Apache-2.0
 */

/ {
	zephyr,user {
		/* The STM32F1 RTC companion has a one-second tick. */
		sleep-durations-ms = <50 250 2000 3000>;
	};
};
```

## boards/nucleo_l152re.overlay
```dts
/*
 * Copyright (c) 2026 STMicroelectronics
 *
 * SPDX-License-Identifier: Apache-2.0
 */

/ {
	zephyr,user {
		/* The STM32L1 RTC companion has a one-second tick. */
		sleep-durations-ms = <50 250 2000 3000>;
	};
};
```

## boards/nucleo_n657x0_q_stm32n657xx_sb.overlay
```dts
/*
 * SPDX-FileCopyrightText: Copyright The Zephyr Project Contributors
 * SPDX-License-Identifier: Apache-2.0
 */

/ {
	zephyr,user {
		sleep-durations-ms = <50 250 1500 3000>;
	};
};
```

## src/main.c
```c
/*
 * SPDX-FileCopyrightText: Copyright (c) 2026 Infineon Technologies AG,
 * or an affiliate of Infineon Technologies AG. All rights reserved.
 *
 * SPDX-License-Identifier: Apache-2.0
 */

/**
 * @file
 * @brief System timer low-power companion tests.
 *
 * Validate CONFIG_SYSTEM_TIMER_LPM_COMPANION_*: keeping time while the system
 * timer is stopped in a low-power state. Uses the public PM API only, so it
 * runs on any vendor's companion (Counter- or hook-based).
 */

#include <zephyr/devicetree.h>
#include <zephyr/kernel.h>
#include <zephyr/ztest.h>
#include <zephyr/pm/pm.h>
#include <zephyr/pm/state.h>
#include <zephyr/sys/atomic.h>

/* Sleep durations (ms) from the zephyr,user "sleep-durations-ms" property.
 * Default in app.overlay; override per board via boards/<board>.overlay.
 */
#define SLEEP_DURATIONS_NODE DT_PATH(zephyr_user)

BUILD_ASSERT(DT_NODE_HAS_PROP(SLEEP_DURATIONS_NODE, sleep_durations_ms),
	     "define sleep-durations-ms on the zephyr,user node (see app.overlay)");

static const uint32_t sleep_durations_ms[] = DT_PROP(SLEEP_DURATIONS_NODE, sleep_durations_ms);

/* Allowed k_msleep() overshoot; derived from PM-state exit latencies at runtime. */
static uint32_t overshoot_tolerance_ms;

/* Shortest sleep (ms) that should trigger a low-power entry: the shallowest PM
 * state's min_residency + exit_latency (see policy_default.c). Runtime-derived.
 */
static uint32_t lpm_threshold_ms;

static atomic_t lpm_entries;
static atomic_t lpm_exits;

/* Deadline of the sleep in progress, less the tick the kernel may still owe and
 * the exit latency PM wakes early by, and the entries that began before it.
 */
#define LPM_DUE_GUARD_TICKS 2
static uint32_t lpm_due_guard_ticks;
static volatile int64_t lpm_due_ticks;
static atomic_t lpm_entries_before_due;

static void lpm_state_entry(enum pm_state state)
{
	ARG_UNUSED(state);
	if (k_uptime_ticks() < lpm_due_ticks) {
		atomic_inc(&lpm_entries_before_due);
	}
	atomic_inc(&lpm_entries);
}

static void lpm_state_exit(enum pm_state state)
{
	ARG_UNUSED(state);
	atomic_inc(&lpm_exits);
}

static struct pm_notifier lpm_notifier = {
	.state_entry = lpm_state_entry,
	.state_exit = lpm_state_exit,
};

static void reset_counters(void)
{
	atomic_clear(&lpm_entries);
	atomic_clear(&lpm_exits);
	atomic_clear(&lpm_entries_before_due);
}

/*
 * @brief Timekeeping stays accurate across low-power sleeps.
 *
 * Elapsed uptime must be at least the request (never early) and overshoot by no
 * more than the exit latency, proving the companion kept time while the system
 * timer was stopped. Entry count: none below the threshold, exactly one before
 * the sleep is due above it. Skipped if nothing reached a low-power state.
 */
ZTEST(system_timer_lpm, test_timekeeping_accuracy)
{
	const size_t count = ARRAY_SIZE(sleep_durations_ms);
	int64_t elapsed[ARRAY_SIZE(sleep_durations_ms)];
	int32_t before_due[ARRAY_SIZE(sleep_durations_ms)];
	int32_t entries[ARRAY_SIZE(sleep_durations_ms)];
	int32_t exits[ARRAY_SIZE(sleep_durations_ms)];
	int32_t total_wakeups = 0;

	for (size_t i = 0; i < count; i++) {
		int64_t start;

		reset_counters();
		start = k_uptime_get();
		lpm_due_ticks = k_uptime_ticks() +
				k_ms_to_ticks_ceil32(sleep_durations_ms[i]) - lpm_due_guard_ticks;
		k_msleep(sleep_durations_ms[i]);
		elapsed[i] = k_uptime_get() - start;
		entries[i] = (int32_t)atomic_get(&lpm_entries);
		exits[i] = (int32_t)atomic_get(&lpm_exits);
		before_due[i] = (int32_t)atomic_get(&lpm_entries_before_due);
	}

	for (size_t i = 0; i < count; i++) {
		uint32_t requested = sleep_durations_ms[i];
		uint32_t guard_ms = k_ticks_to_ms_ceil32(2) + 2U;
		bool below = (requested + guard_ms <= lpm_threshold_ms);
		bool above = (requested >= lpm_threshold_ms + guard_ms);

		if (below) {
			TC_PRINT("requested %u ms, elapsed %lld ms, wakeups %d "
				 "(expected 0)\n",
				 requested, elapsed[i], entries[i]);
		} else if (above) {
			TC_PRINT("requested %u ms, elapsed %lld ms, wakeups %d, %d before due "
				 "(expected 1)\n",
				 requested, elapsed[i], entries[i], before_due[i]);
		} else {
			TC_PRINT("requested %u ms, elapsed %lld ms, wakeups %d "
				 "(near %u ms threshold)\n",
				 requested, elapsed[i], entries[i], lpm_threshold_ms);
		}

		zassert_true(elapsed[i] >= (int64_t)requested - 1,
			     "woke early: requested %u ms, elapsed %lld ms", requested, elapsed[i]);
		zassert_true(elapsed[i] <= (int64_t)requested + overshoot_tolerance_ms,
			     "overshoot too large: requested %u ms, elapsed %lld ms "
			     "(tolerance %u ms)",
			     requested, elapsed[i], overshoot_tolerance_ms);
		zassert_equal(entries[i], exits[i],
			      "unbalanced transitions on %u ms sleep: %d entries, "
			      "%d exits",
			      requested, entries[i], exits[i]);

		/* The kernel may split the sleep, finishing the tick it still owed in a
		 * second entry at the deadline.
		 */
		if (below) {
			zassert_equal(entries[i], 0,
				      "%u ms sleep made %d low-power entries, "
				      "expected none",
				      requested, entries[i]);
		} else if (above) {
			zassert_equal(before_due[i], 1,
				      "%u ms sleep made %d low-power entries before it was "
				      "due, expected exactly 1",
				      requested, before_due[i]);
			zassert_true(entries[i] - before_due[i] <= 1,
				     "%u ms sleep made %d low-power entries after it was "
				     "due, expected at most 1",
				     requested, entries[i] - before_due[i]);
		}

		total_wakeups += entries[i];
	}

	if (total_wakeups == 0) {
		TC_PRINT("companion never engaged (no sleep reached a low-power "
			 "state); skipping\n");
		ztest_test_skip();
	}
}

static void *setup(void)
{
	const struct pm_state_info *states;
	uint8_t count;
	uint32_t deepest_exit_latency_us = 0U;
	uint32_t shallowest_residency_us = UINT32_MAX;
	uint32_t shallowest_exit_latency_us = 0U;

	count = pm_state_cpu_get_all(0U, &states);
	zassert_true(count > 0, "no PM states defined for CPU 0");

	/* pm_state_cpu_get_all() returns devicetree order, not sorted by depth. */
	for (uint8_t i = 0; i < count; i++) {
		if (states[i].exit_latency_us > deepest_exit_latency_us) {
			deepest_exit_latency_us = states[i].exit_latency_us;
		}
		if (states[i].min_residency_us < shallowest_residency_us) {
			shallowest_residency_us = states[i].min_residency_us;
			shallowest_exit_latency_us = states[i].exit_latency_us;
		}
	}

	/* Overshoot budget: deepest exit latency + two ticks + small margin. */
	overshoot_tolerance_ms = (deepest_exit_latency_us / 1000U) + k_ticks_to_ms_ceil32(2) + 5U;

	/* The shallowest state (lowest residency) sets the entry threshold. */
	lpm_threshold_ms =
		DIV_ROUND_UP(shallowest_residency_us + shallowest_exit_latency_us, 1000U);

	/* PM brings the wake forward by the exit latency, so a split sleep's second
	 * entry starts that far ahead of the deadline.
	 */
	lpm_due_guard_ticks = LPM_DUE_GUARD_TICKS + k_us_to_ticks_ceil32(deepest_exit_latency_us);

	TC_PRINT("PM states %u, overshoot tolerance %u ms, low-power entry "
		 "threshold %u ms\n",
		 count, overshoot_tolerance_ms, lpm_threshold_ms);

	pm_notifier_register(&lpm_notifier);

	return NULL;
}

static void teardown(void *fixture)
{
	ARG_UNUSED(fixture);

	(void)pm_notifier_unregister(&lpm_notifier);
}

ZTEST_SUITE(system_timer_lpm, NULL, setup, NULL, NULL, teardown);
```
