## tests/subsys/dfu/img_util/testcase.yaml
```yaml
common:
  platform_allow:
    - nrf52840dk/nrf52840
    - native_sim
    - native_sim/native/64
  integration_platforms:
    - native_sim
tests:
  dfu.image_util:
    tags: dfu_image_util
  dfu.image_util.progressive:
    extra_args: EXTRA_CONF_FILE=progressively_overlay.conf
    tags: dfu_image_util
```

## tests/subsys/dfu/mcuboot/testcase.yaml
```yaml
tests:
  dfu.mcuboot:
    platform_allow:
      - nrf52840dk/nrf52840
      - native_posix/native
      - native_posix/native/64
      - native_sim/native
      - native_sim/native/64
    tags: dfu_mcuboot
    integration_platforms:
      - nrf52840dk/nrf52840
```

## tests/subsys/dfu/mcuboot_multi/testcase.yaml
```yaml
tests:
  dfu.mcuboot.multiimage:
    platform_allow:
      - nrf52840dk/nrf52840
      - native_sim
      - native_sim/native/64
    tags: dfu_mcuboot
    integration_platforms:
      - native_sim
```

## tests/subsys/display/cfb/basic/Kconfig
```kconfig
# Copyright (c) 2024 TOKITA Hiroshi
# SPDX-License-Identifier: Apache-2.0

config TEST_MSB_FIRST_FONT
	bool "Use MSB_FIRST font"

config TEST_TRANSFER_BUF_SIZE
	int "transfer buffer size"
	default 0

config TEST_COMMAND_BUF_SIZE
	int "command buffer size"
	default 0

source "Kconfig.zephyr"
```

## tests/subsys/display/cfb/basic/testcase.yaml
```yaml
# Copyright (c) 2024 TOKITA Hiroshi
# SPDX-License-Identifier: Apache-2.0

common:
  tags:
    - display
    - drivers
    - cfb
  harness: ztest
  harness_config:
    fixture: display
  platform_allow:
    - native_sim
    - native_sim/native/64
tests:
  display.cfb.basic.mono01.vtiled.msbfirst:
    extra_configs:
      - CONFIG_SDL_DISPLAY_USE_HARDWARE_ACCELERATOR=n
      - CONFIG_SDL_DISPLAY_DEFAULT_PIXEL_FORMAT_MONO01=y
      - CONFIG_SDL_DISPLAY_MONO_VTILED=y
      - CONFIG_SDL_DISPLAY_MONO_MSB_FIRST=y
  display.cfb.basic.mono01.vtiled.lsbfirst:
    extra_configs:
      - CONFIG_SDL_DISPLAY_USE_HARDWARE_ACCELERATOR=n
      - CONFIG_SDL_DISPLAY_DEFAULT_PIXEL_FORMAT_MONO01=y
      - CONFIG_SDL_DISPLAY_MONO_VTILED=y
      - CONFIG_SDL_DISPLAY_MONO_MSB_FIRST=n
  display.cfb.basic.mono01.htiled.msbfirst:
    extra_configs:
      - CONFIG_SDL_DISPLAY_USE_HARDWARE_ACCELERATOR=n
      - CONFIG_SDL_DISPLAY_DEFAULT_PIXEL_FORMAT_MONO01=y
      - CONFIG_SDL_DISPLAY_MONO_VTILED=n
      - CONFIG_SDL_DISPLAY_MONO_MSB_FIRST=y
  display.cfb.basic.mono01.htiled.lsbfirst:
    extra_configs:
      - CONFIG_SDL_DISPLAY_USE_HARDWARE_ACCELERATOR=n
      - CONFIG_SDL_DISPLAY_DEFAULT_PIXEL_FORMAT_MONO01=y
      - CONFIG_SDL_DISPLAY_MONO_VTILED=n
      - CONFIG_SDL_DISPLAY_MONO_MSB_FIRST=n
  display.cfb.basic.mono10.vtiled.msbfirst:
    extra_configs:
      - CONFIG_SDL_DISPLAY_USE_HARDWARE_ACCELERATOR=n
      - CONFIG_SDL_DISPLAY_DEFAULT_PIXEL_FORMAT_MONO10=y
      - CONFIG_SDL_DISPLAY_MONO_VTILED=y
      - CONFIG_SDL_DISPLAY_MONO_MSB_FIRST=y
  display.cfb.basic.mono10.vtiled.lsbfirst:
    extra_configs:
      - CONFIG_SDL_DISPLAY_USE_HARDWARE_ACCELERATOR=n
      - CONFIG_SDL_DISPLAY_DEFAULT_PIXEL_FORMAT_MONO10=y
      - CONFIG_SDL_DISPLAY_MONO_VTILED=y
      - CONFIG_SDL_DISPLAY_MONO_MSB_FIRST=n
  display.cfb.basic.mono10.htiled.msbfirst:
    extra_configs:
      - CONFIG_SDL_DISPLAY_USE_HARDWARE_ACCELERATOR=n
      - CONFIG_SDL_DISPLAY_DEFAULT_PIXEL_FORMAT_MONO10=y
      - CONFIG_SDL_DISPLAY_MONO_VTILED=n
      - CONFIG_SDL_DISPLAY_MONO_MSB_FIRST=y
  display.cfb.basic.mono10.htiled.lsbfirst:
    extra_configs:
      - CONFIG_SDL_DISPLAY_USE_HARDWARE_ACCELERATOR=n
      - CONFIG_SDL_DISPLAY_DEFAULT_PIXEL_FORMAT_MONO10=y
      - CONFIG_SDL_DISPLAY_MONO_VTILED=n
      - CONFIG_SDL_DISPLAY_MONO_MSB_FIRST=n
```

## tests/subsys/display/cfb/fonts/Kconfig
```kconfig
# Copyright (c) 2024 TOKITA Hiroshi
# SPDX-License-Identifier: Apache-2.0

mainmenu "CFB Fonts Test"

source "Kconfig.zephyr"

config TEST_MSB_FIRST_FONT
	bool "Use MSB_FIRST font"
```

## tests/subsys/display/cfb/fonts/testcase.yaml
```yaml
# Copyright (c) 2024 TOKITA Hiroshi
# SPDX-License-Identifier: Apache-2.0

common:
  tags:
    - display
    - drivers
    - cfb
  harness: ztest
  harness_config:
    fixture: display
  platform_allow:
    - native_sim
    - native_sim/native/64
tests:
  display.cfb.fonts.vtiled.msbfirst_font:
    extra_configs:
      - CONFIG_SDL_DISPLAY_DEFAULT_PIXEL_FORMAT_MONO10=y
      - CONFIG_SDL_DISPLAY_USE_HARDWARE_ACCELERATOR=n
      - CONFIG_SDL_DISPLAY_MONO_VTILED=y
      - CONFIG_TEST_MSB_FIRST_FONT=y
  display.cfb.fonts.vtiled.lsbfirst_font:
    extra_configs:
      - CONFIG_SDL_DISPLAY_DEFAULT_PIXEL_FORMAT_MONO10=y
      - CONFIG_SDL_DISPLAY_USE_HARDWARE_ACCELERATOR=n
      - CONFIG_SDL_DISPLAY_MONO_VTILED=y
      - CONFIG_TEST_MSB_FIRST_FONT=n
  display.cfb.fonts.htiled.msbfirst_font:
    extra_configs:
      - CONFIG_SDL_DISPLAY_DEFAULT_PIXEL_FORMAT_MONO10=y
      - CONFIG_SDL_DISPLAY_USE_HARDWARE_ACCELERATOR=n
      - CONFIG_SDL_DISPLAY_MONO_VTILED=n
      - CONFIG_TEST_MSB_FIRST_FONT=y
  display.cfb.fonts.htiled.lsbfirst_font:
    extra_configs:
      - CONFIG_SDL_DISPLAY_DEFAULT_PIXEL_FORMAT_MONO10=y
      - CONFIG_SDL_DISPLAY_USE_HARDWARE_ACCELERATOR=n
      - CONFIG_SDL_DISPLAY_MONO_VTILED=n
      - CONFIG_TEST_MSB_FIRST_FONT=n
```

## tests/subsys/dsp/basicmath/testcase.yaml
```yaml
tests:
  zdsp.basicmath:
    filter: TOOLCHAIN_HAS_NEWLIB == 1 or CONFIG_ARCH_POSIX
    integration_platforms:
      - frdm_k64f
      - sam_e70_xplained
      - mps2_an521
      - native_posix
    tags: zdsp
    min_flash: 128
    min_ram: 64
  zdsp.basicmath.fpu:
    filter: (CONFIG_CPU_HAS_FPU and TOOLCHAIN_HAS_NEWLIB == 1) or CONFIG_ARCH_POSIX
    integration_platforms:
      - mps2_an521_remote
      - mps3_an547
    tags: zdsp fpu
    extra_configs:
      - CONFIG_FPU=y
    min_flash: 128
    min_ram: 64
  zdsp.basicmath.arcmwdt:
    filter: CONFIG_ISA_ARCV2
    toolchain_allow: arcmwdt
    platform_allow: nsim_em11d
    extra_args: CONF_FILE=prj_arc.conf
```

## tests/subsys/dsp/conversions/testcase.yaml
```yaml
# Copyright (c) 2023 Google LLC
# SPDX-License-Identifier: Apache-2.0
tests:
  zdsp.conversions:
    filter: (CONFIG_CPU_HAS_FPU and TOOLCHAIN_HAS_NEWLIB == 1) or CONFIG_ARCH_POSIX
    tags:
      - zdsp
      - fpu
```

## tests/subsys/dsp/fastmath/testcase.yaml
```yaml
# Copyright (c) 2026 James Roy <rruuaanng@gmail.com>
# SPDX-License-Identifier: Apache-2.0
tests:
  zdsp.fastmath:
    filter: CONFIG_FULL_LIBC_SUPPORTED or CONFIG_ARCH_POSIX
    integration_platforms:
      - native_sim
    tags: zdsp
    min_flash: 128
    min_ram: 64
```

## tests/subsys/dsp/macros/testcase.yaml
```yaml
tests:
  zdsp.macros:
    integration_platforms:
      - native_sim
    tags: zdsp
    min_flash: 64
    min_ram: 32
```

## tests/subsys/dsp/print_format/testcase.yaml
```yaml
# Copyright (c) 2023 Google LLC
# SPDX-License-Identifier: Apache-2.0
tests:
  zdsp.print_format:
    filter: TOOLCHAIN_HAS_NEWLIB == 1 or CONFIG_ARCH_POSIX
    tags: zdsp
    min_flash: 128
    min_ram: 64
```

## tests/subsys/ebpf/maps/testcase.yaml
```yaml
# SPDX-FileCopyrightText: Copyright 2026 NXP
# SPDX-License-Identifier: Apache-2.0

common:
  platform_allow:
    - native_sim
    - qemu_cortex_m3
    - qemu_x86
  tags: ebpf
tests:
  ebpf.maps:
    tags: ebpf
```

## tests/subsys/edac/ibecc/testcase.yaml
```yaml
common:
  arch_allow: x86
  platform_allow: ehl_crb
  tags: edac ibecc
tests:
  edac.ibecc.production:
    extra_configs:
      - CONFIG_EDAC_ERROR_INJECT=n
      - CONFIG_EDAC_LOG_LEVEL_DBG=y
  edac.ibecc.injection:
    extra_configs:
      - CONFIG_EDAC_ERROR_INJECT=y
  edac.ibecc.injection.user:
    extra_configs:
      - CONFIG_EDAC_ERROR_INJECT=y
      - CONFIG_TEST_USERSPACE=y
```

## tests/subsys/edac/ibecc_cov/testcase.yaml
```yaml
common:
  arch_allow: x86
  platform_allow: ehl_crb
  tags: ibecc ibecc_cov
tests:
  edac.ibecc.coverage:
    extra_args: EXTRA_CFLAGS=-DEMULATE_SKU=0
  edac.ibecc.coverage_sku:
    extra_args: EXTRA_CFLAGS=-DEMULATE_SKU=0x45148086
  edac.ibecc.coverage_sku_en:
    extra_args: EXTRA_CPPFLAGS=-DEMULATE_SKU=0x45148086 EXTRA_CFLAGS=-DIBECC_ENABLED=1
```

## tests/subsys/emul/testcase.yaml
```yaml
tests:
  emul.emul:
    tags: emul
    platform_allow:
      - native_posix/native
      - native_sim/native
    integration_platforms:
      - native_sim/native
```

## tests/subsys/factory_data/testcase.yaml
```yaml
tests:
  system.factory_data.fcb:
    platform_allow: >
      native_posix
      native_posix_64
      nrf52840dk_nrf52840
    tags: factory_data
    extra_args: OVERLAY_CONFIG=fcb.conf
  system.factory_data.lv:
    platform_allow: >
      native_posix
      native_posix_64
      nrf52840dk_nrf52840
    tags: factory_data
    extra_args: CONFIG_FACTORY_DATA_LV=y
  system.factory_data.dummy:
    platform_allow: >
      nrf52840dk_nrf52840
    tags: factory_data
    extra_args: CONFIG_FACTORY_DATA_DUMMY=y
    build_only: true
```

## tests/subsys/fpga_bridges/boards/intel_socfpga_agilex5_socdk.conf
```kconfig
# Copyright (c) 2024, Intel Corporation.
# SPDX-License-Identifier: Apache-2.0

# FPGA Bridge
CONFIG_FPGA_BRIDGE_AGILEX=y

# Misc
CONFIG_HEAP_MEM_POOL_SIZE=16384

#SiP SVC Service
CONFIG_ARM_SIP_SVC_DRIVER=y
CONFIG_ARM_SIP_SVC_SUBSYS=y
CONFIG_ARM_SIP_SVC_SUBSYS_SINGLY_OPEN=y
```

## tests/subsys/fpga_manager/testcase.yaml
```yaml
common:
  depends_on: fpga
  tags: subsys fpga_manager
tests:
  subsys.fpga_manager.fpga_manager_intel:
    harness: ztest
    harness_config:
      fixture: fixture_fpga_manager
    filter: dt_alias_exists("fpga_config")
    tags: fpga_manager
    min_ram: 32
    integration_platforms:
      - mimxrt1064_evk
```

## tests/subsys/fs/automount/testcase.yaml
```yaml
tests:
  filesystem.automount:
    platform_allow: nrf52840dk_nrf52840 native_posix native_posix_64
    tags: filesystem automount
    timeout: 180
```

## tests/subsys/fs/ext2/Kconfig
```kconfig
# SPDX-License-Identifier: Apache-2.0
# Copyright (c) 2023 Antmicro

mainmenu "Ext2 tests"

source "Kconfig.zephyr"

config APP_TEST_BIG
	bool "Make tests with larger file systems"
```

## tests/subsys/fs/ext2/testcase.yaml
```yaml
common:
  tags: filesystem
tests:
  filesystem.ext2.default:
    platform_allow:
      - native_sim
      - native_sim/native/64
      - hifive_unmatched/fu740/s7
      - hifive_unmatched/fu740/u74
      - bl5340_dvk/nrf5340/cpuapp
    integration_platforms:
      - native_sim
    extra_args:
      - EXTRA_DTC_OVERLAY_FILE="ramdisk_small.overlay"

  filesystem.ext2.big:
    platform_allow:
      - native_sim
      - native_sim/native/64
    extra_args:
      - CONF_FILE=prj_big.conf
      - EXTRA_DTC_OVERLAY_FILE="ramdisk_big.overlay"

  filesystem.ext2.sdcard:
    simulation_exclude:
      - renode
    platform_allow:
      - hifive_unmatched/fu740/s7
      - hifive_unmatched/fu740/u74
      - bl5340_dvk/nrf5340/cpuapp
      - mck_ra8t1
      - ek_ra8m1
      - ek_ra8d1
      - ek_ra8p1/r7ka8p1kflcac/cm85
      - mck_ra8t2/r7ka8t2lfecac/cm85
      - ek_ra8p1/r7ka8p1kflcac/cm33
      - ek_ra8d2/r7ka8d2kflcac/cm85
      - ek_ra8m2/r7ka8m2jflcac/cm85
    extra_args:
      - CONF_FILE=prj_sdcard.conf
      - platform:ek_ra8m1/r7fa8m1ahecbd:SHIELD=pmod_sd
      - platform:ek_ra8d1/r7fa8d1bhecbd:SHIELD=pmod_sd
      - platform:ek_ra8p1/r7ka8p1kflcac/cm85:SHIELD=pmod_sd
      - platform:ek_ra8p1/r7ka8p1kflcac/cm33:SHIELD=pmod_sd
    extra_configs:
      - platform:ek_ra8m1/r7fa8m1ahecbd:CONFIG_EXT2_DISK_STARTING_SECTOR=0
      - platform:ek_ra8d1/r7fa8d1bhecbd:CONFIG_EXT2_DISK_STARTING_SECTOR=0
      - platform:ek_ra8p1/r7ka8p1kflcac/cm85:CONFIG_EXT2_DISK_STARTING_SECTOR=0
      - platform:ek_ra8p1/r7ka8p1kflcac/cm33:CONFIG_EXT2_DISK_STARTING_SECTOR=0
      - platform:ek_ra8d2/r7ka8d2kflcac/cm85:CONFIG_EXT2_DISK_STARTING_SECTOR=0
      - platform:ek_ra8m2/r7ka8m2jflcac/cm85:CONFIG_EXT2_DISK_STARTING_SECTOR=0
      - platform:mck_ra8t1/r7fa8t1ahecbd:CONFIG_EXT2_DISK_STARTING_SECTOR=0
      - platform:mck_ra8t2/r7ka8t2lfecac/cm85:CONFIG_EXT2_DISK_STARTING_SECTOR=0

  filesystem.ext2.flash:
    platform_allow:
      - native_sim
      - native_sim/native/64
    extra_args: CONF_FILE=prj_flash.conf
```

## tests/subsys/fs/fat_fs_api/boards/ek_ra8m1.conf
```kconfig
CONFIG_MAIN_STACK_SIZE=4096
CONFIG_DISK_DRIVER_RAM=n
CONFIG_DISK_DRIVER_FLASH=n
CONFIG_FS_FATFS_HAS_RTC=n
```
