## CMakeLists.txt
```
# SPDX-License-Identifier: Apache-2.0

cmake_minimum_required(VERSION 3.20.0)
find_package(Zephyr REQUIRED HINTS $ENV{ZEPHYR_BASE})
project(shell_mount_partition)

target_sources(app PRIVATE src/main.c)
```

## prj.conf
```kconfig
CONFIG_FLASH=y
CONFIG_FLASH_MAP=y
CONFIG_FILE_SYSTEM=y
CONFIG_FILE_SYSTEM_LITTLEFS=y
CONFIG_FILE_SYSTEM_SHELL=y
CONFIG_FILE_SYSTEM_SHELL_MOUNT_COMMAND=y
CONFIG_HEAP_MEM_POOL_SIZE=1024
CONFIG_LOG=y
CONFIG_SHELL=y
CONFIG_SHELL_BACKEND_SERIAL=n
CONFIG_SHELL_BACKEND_DUMMY=y
CONFIG_SHELL_CMD_BUFF_SIZE=90
CONFIG_MAIN_STACK_SIZE=2048
CONFIG_ZTEST=y
CONFIG_ZTEST_STACK_SIZE=4096
```

## flash_partitions.overlay
```dts
/*
 * Copyright (c) 2026 Hongquan Li
 *
 * SPDX-License-Identifier: Apache-2.0
 */

&flash0 {
	partitions {
		test_partition: partition@100000 {
			compatible = "zephyr,mapped-partition";
			reg = <0x00100000 0x00040000>;
			label = "test-partition";
		};
	};
};
```

## src/main.c
```c
/**
 * Copyright (c) 2026 Hongquan Li
 *
 * SPDX-License-Identifier: Apache-2.0
 */

#include <zephyr/ztest.h>
#include <zephyr/shell/shell.h>

static void test_shell_exec(const char *line, int result)
{
	int ret;

	ret = shell_execute_cmd(NULL, line);

	TC_PRINT("shell_execute_cmd(%s): %d\n", line, ret);

	zassert_true(ret == result, "%s", line);
}

ZTEST(shell_mount_partition, test_littlefs_mount_bad_label)
{
	test_shell_exec("fs mount littlefs /littlefs nonexistent", -ENOENT);
}

ZTEST(shell_mount_partition, test_littlefs_mount_partition)
{
	test_shell_exec("fs mount littlefs /littlefs test-partition", 0);
}

ZTEST(shell_mount_partition, test_littlefs_mount_repeat_busy)
{
	test_shell_exec("fs mount littlefs /littlefs2", -EBUSY);
}

ZTEST_SUITE(shell_mount_partition, NULL, NULL, NULL, NULL, NULL);
```
