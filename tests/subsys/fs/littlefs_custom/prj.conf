## CMakeLists.txt
```
# SPDX-License-Identifier: Apache-2.0

cmake_minimum_required(VERSION 3.20.0)
find_package(Zephyr REQUIRED HINTS $ENV{ZEPHYR_BASE})
project(littlefs_custom)

# LittleFS opens files for RW by default if no flags given and crashes,
# instead of returning error when attempting to perform operation that
# a file has not been opened for.
target_compile_definitions(app PRIVATE
		BYPASS_FS_OPEN_FLAGS_LFS_ASSERT_CRASH
		BYPASS_FS_OPEN_FLAGS_LFS_RW_IS_DEFAULT
)

FILE(GLOB app_sources src/*.c)
target_sources(app PRIVATE ${app_sources})
```

## prj.conf
```kconfig
CONFIG_FILE_SYSTEM=y
CONFIG_FILE_SYSTEM_LITTLEFS=y
CONFIG_FILE_SYSTEM_SHELL=y
CONFIG_SHELL=y

CONFIG_MAIN_STACK_SIZE=4096
CONFIG_HEAP_MEM_POOL_SIZE=1024

CONFIG_ZTEST=y
CONFIG_ZTEST_STACKSIZE=4096
```

## src/main.c
```c
/*
 * Copyright (c) 2021 SILA Embedded Solutions GmbH <office@embedded-solutions.at>
 *
 * SPDX-License-Identifier: Apache-2.0
 */

#include <string.h>
#include <ztest.h>
#include "test_littlefs_custom.h"

void test_main(void)
{
	ztest_test_suite(littlefs_custom_test,
			 ztest_unit_test(test_custom_opendir)
			 );
	ztest_run_test_suite(littlefs_custom_test);
}
```

## src/ram_disk.c
```c
/*
 * Copyright (c) 2021 SILA Embedded Solutions GmbH <office@embedded-solutions.at>
 *
 * SPDX-License-Identifier: Apache-2.0
 */

#include <string.h>
#include "ram_disk.h"

#define RAM_DISK_BLOCK_SIZE 4096

static uint8_t ram_disk_storage[16*RAM_DISK_BLOCK_SIZE];
static uintptr_t ram_disk_context;

int ram_disk_read(const struct lfs_config *c, lfs_block_t block, lfs_off_t off,
	void *buffer, lfs_size_t size)
{
	size_t complete_offset = block * c->block_size + off;

	if (complete_offset + size > sizeof(ram_disk_storage)) {
		return LFS_ERR_NOSPC;
	}

	memcpy(buffer, ram_disk_storage + complete_offset, size);

	return LFS_ERR_OK;
}

int ram_disk_program(const struct lfs_config *c, lfs_block_t block, lfs_off_t off,
	const void *buffer, lfs_size_t size)
{
	size_t complete_offset = block * c->block_size + off;

	if (complete_offset + size > sizeof(ram_disk_storage)) {
		return LFS_ERR_NOSPC;
	}

	memcpy(ram_disk_storage + complete_offset, buffer, size);

	return LFS_ERR_OK;
}

int ram_disk_erase(const struct lfs_config *c, lfs_block_t block)
{
	size_t complete_offset = block * c->block_size;

	if (complete_offset + c->block_size > sizeof(ram_disk_storage)) {
		return LFS_ERR_NOSPC;
	}

	memset(ram_disk_storage + complete_offset, 0, c->block_size);

	return LFS_ERR_OK;
}

int ram_disk_sync(const struct lfs_config *c)
{
	return LFS_ERR_OK;
}

int ram_disk_open(void **context, uintptr_t area_id)
{
	ram_disk_context = area_id;
	*context = &ram_disk_context;
	return 0;
}

void ram_disk_close(void *context)
{
}

size_t ram_disk_get_block_size(void *context)
{
	return RAM_DISK_BLOCK_SIZE;
}

size_t ram_disk_get_size(void *context)
{
	return sizeof(ram_disk_storage);
}
```

## src/ram_disk.h
```c
/*
 * Copyright (c) 2021 SILA Embedded Solutions GmbH <office@embedded-solutions.at>
 *
 * SPDX-License-Identifier: Apache-2.0
 */

#ifndef _ZEPHYR_TESTS_SUBSYS_FS_LITTLEFS_CUSTOM_RAM_DISK_H_
#define  _ZEPHYR_TESTS_SUBSYS_FS_LITTLEFS_CUSTOM_RAM_DISK_H_

#include <stddef.h>
#include <fs/littlefs.h>

int ram_disk_read(const struct lfs_config *c, lfs_block_t block, lfs_off_t off,
	void *buffer, lfs_size_t size);
int ram_disk_program(const struct lfs_config *c, lfs_block_t block, lfs_off_t off,
	const void *buffer, lfs_size_t size);
int ram_disk_erase(const struct lfs_config *c, lfs_block_t block);
int ram_disk_sync(const struct lfs_config *c);
int ram_disk_open(void **context, uintptr_t area_id);
void ram_disk_close(void *context);
size_t ram_disk_get_block_size(void *context);
size_t ram_disk_get_size(void *context);

#endif /* _ZEPHYR_TESTS_SUBSYS_FS_LITTLEFS_CUSTOM_RAM_DISK_H_ */
```

## src/test_littlefs_custom.c
```c
/*
 * Copyright (c) 2021 SILA Embedded Solutions GmbH <office@embedded-solutions.at>
 *
 * SPDX-License-Identifier: Apache-2.0
 */

#include <zephyr.h>
#include <string.h>
#include <errno.h>
#include <sys/__assert.h>
#include <ztest.h>
#include <fs/fs.h>
#include <fs/fs_sys.h>
#include <fs/littlefs.h>
#include "test_littlefs_custom.h"
#include "ram_disk.h"

#define FS_MNT_POINT_RAM_DISK "/ram"

FS_LITTLEFS_DECLARE_CUSTOM_CONFIG_CUSTOM_OPS(ram_disk,
	CONFIG_FS_LITTLEFS_READ_SIZE, CONFIG_FS_LITTLEFS_PROG_SIZE,
	CONFIG_FS_LITTLEFS_CACHE_SIZE, CONFIG_FS_LITTLEFS_LOOKAHEAD_SIZE,
	ram_disk_read, ram_disk_program, ram_disk_erase, ram_disk_sync,
	ram_disk_open, ram_disk_close,
	ram_disk_get_block_size, ram_disk_get_size);

struct fs_mount_t fs_ram_disk_mnt = {
	.type = FS_LITTLEFS,
	.fs_data = &ram_disk,
	.storage_dev = 0,
	.mnt_point = FS_MNT_POINT_RAM_DISK,
};

void test_custom_opendir(void)
{
	int ret;
	struct fs_dir_t directory;

	ret = fs_mount(&fs_ram_disk_mnt);
	zassert_equal(ret, 0, "failed to mount lfs");

	fs_dir_t_init(&directory);
	ret = fs_opendir(&directory, fs_ram_disk_mnt.mnt_point);
	zassert_equal(ret, 0, "failed to open directory of mount point");

	ret = fs_unmount(&fs_ram_disk_mnt);
	zassert_equal(ret, 0, "failed to unmount lfs");
}
```

## src/test_littlefs_custom.h
```c
/*
 * Copyright (c) 2021 SILA Embedded Solutions GmbH <office@embedded-solutions.at>
 *
 * SPDX-License-Identifier: Apache-2.0
 */

#ifndef _ZEPHYR_TESTS_SUBSYS_FS_LITTLEFS_CUSTOM_TEST_LITTLEFS_AUTOMOUNT_H_
#define  _ZEPHYR_TESTS_SUBSYS_FS_LITTLEFS_CUSTOM_TEST_LITTLEFS_AUTOMOUNT_H_

void test_custom_opendir(void);

#endif /* _ZEPHYR_TESTS_SUBSYS_FS_LITTLEFS_CUSTOM_TEST_LITTLEFS_AUTOMOUNT_H_ */
```
