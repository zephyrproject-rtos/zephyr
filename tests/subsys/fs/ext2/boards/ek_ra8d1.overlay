/*
 * Copyright (c) 2024 Renesas Electronics Corporation
 * SPDX-License-Identifier: Apache-2.0
 */

&sdhc1 {
	interrupt-names = "accs", "card", "dma-req";
	interrupts = <94 12>, <95 12>, <96 12>;
	status = "okay";

	sdmmc {
		partition {
			compatible = "fixed-partitions";
			#address-cells = <1>;
			#size_cells = <1>;
			slot1_partition: partition@0 {
				reg = <0x00000000 0x800000>;
			};
		};
	};
};
