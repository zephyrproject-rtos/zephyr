/*
 * Copyright (c) 2022 Antmicro
 *
 * SPDX-License-Identifier: Apache-2.0
 */

&flashcontroller0 {
	reg = <0x00000000 DT_SIZE_M(128)>;
};

&flash0 {
	reg = <0x00000000 DT_SIZE_M(128)>;
	partitions {
		compatible = "fixed-partitions";
		#address-cells = <1>;
		#size-cells = <1>;

		small_partition: partition@0 {
			label = "small";
			reg = <0x00000000 0x08000000>;
		};
	};
};
