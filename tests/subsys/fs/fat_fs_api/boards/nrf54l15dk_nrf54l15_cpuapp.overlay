/*
 * Copyright (c) 2026 Nordic Semiconductor ASA
 * SPDX-License-Identifier: Apache-2.0
 */

/ {
	test_disk: msc_disk0 {
		compatible = "zephyr,flash-disk";
		partition = <&slot1_partition>;
		disk-name = "NOR";
		cache-size = <4096>;
	};
};
