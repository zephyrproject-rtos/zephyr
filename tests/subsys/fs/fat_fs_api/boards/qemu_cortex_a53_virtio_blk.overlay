/*
 * SPDX-FileCopyrightText: Copyright (c) 2026 Process Mission
 * SPDX-License-Identifier: Apache-2.0
 */

&virtio_mmio4 {
	status = "okay";

	virtio_blk: virtio-blk {
		compatible = "virtio,blk";
		disk-name = "VIRTIOBLK0";
		status = "okay";
	};
};
