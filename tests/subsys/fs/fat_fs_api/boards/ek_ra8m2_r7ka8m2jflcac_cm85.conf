## tests/subsys/fs/fat_fs_api/boards/ek_ra8m2_r7ka8m2jflcac_cm85.conf
```kconfig
# Copyright (c) 2025 Renesas Electronics Corporation
# SPDX-License-Identifier: Apache-2.0

CONFIG_MAIN_STACK_SIZE=4096
CONFIG_DISK_DRIVER_RAM=n
CONFIG_DISK_DRIVER_FLASH=n
CONFIG_FS_FATFS_HAS_RTC=n
```

## tests/subsys/fs/fat_fs_api/testcase.yaml
```yaml
common:
  tags:
    - filesystem
    - fatfs
  modules:
    - fatfs
tests:
  filesystem.fat.api:
    platform_allow:
      - native_sim
  filesystem.fat.api.lfn:
    extra_args: CONF_FILE="prj_lfn.conf"
    platform_allow:
      - native_sim
  filesystem.fat.api.mmc:
    extra_args: CONF_FILE="prj_mmc.conf"
    filter: dt_compat_enabled("zephyr,mmc-disk")
  filesystem.fat.api.sdmmc:
    extra_args: CONF_FILE="prj_sdmmc.conf"
    filter: dt_compat_enabled("zephyr,sdmmc-disk")
  filesystem.fat.ram.api:
    platform_allow:
      - native_sim
      - frdm_mcxa156
      - frdm_mcxn236
      - frdm_mcxn947/mcxn947/cpu0
      - frdm_mcxw71
      - frdm_rw612
      - lpcxpresso55s06
      - lpcxpresso55s28
      - lpcxpresso55s36
      - lpcxpresso55s69/lpc55s69/cpu0
      - mimxrt1020_evk
      - mimxrt1024_evk
      - mimxrt1040_evk
      - mimxrt1050_evk/mimxrt1052/hyperflash
      - mimxrt1060_evk/mimxrt1062/qspi
      - mimxrt1064_evk
      - mimxrt1160_evk/mimxrt1166/cm7
      - mimxrt1170_evk/mimxrt1176/cm7
      - mimxrt1180_evk/mimxrt1189/cm33
      - mimxrt595_evk/mimxrt595s/cm33
      - mimxrt685_evk/mimxrt685s/cm33
    integration_platforms:
      - native_sim
    extra_args:
      - CONF_FILE="prj_ram.conf"
      - EXTRA_DTC_OVERLAY_FILE="ramdisk.overlay"
  filesystem.fat.api.reentrant:
    platform_allow:
      - native_sim
    extra_configs:
      - CONFIG_FS_FATFS_REENTRANT=y
      - CONFIG_MULTITHREADING=y
```

## tests/subsys/fs/fat_fs_dual_drive/testcase.yaml
```yaml
tests:
  filesystem.fat.dual_drive:
    platform_allow:
      - qemu_x86
      - native_sim
      - qemu_leon3
      - qemu_riscv/qemu_virt_riscv/rv32
      - qemu_riscv/qemu_virt_riscv/rv64
    tags: filesystem
    integration_platforms:
      - native_sim
```

## tests/subsys/fs/fcb/boards/nucleo_h743zi.conf
```kconfig
# SPDX-FileCopyrightText: Copyright The Zephyr Project Contributors
# SPDX-License-Identifier: Apache-2.0

CONFIG_ARM_MPU=n
CONFIG_MAIN_STACK_SIZE=4096
CONFIG_SYSTEM_WORKQUEUE_STACK_SIZE=4096
```

## tests/subsys/fs/fcb/boards/nucleo_h743zi_stm32h743xx.conf
```kconfig
CONFIG_ARM_MPU=n
CONFIG_MAIN_STACK_SIZE=4096
CONFIG_SYSTEM_WORKQUEUE_STACK_SIZE=4096
```

## tests/subsys/fs/fcb/testcase.yaml
```yaml
tests:
  filesystem.fcb:
    platform_allow:
      - nrf52840dk/nrf52840
      - nrf52dk/nrf52832
      - nrf51dk/nrf51822
      - native_sim
      - native_sim/native/64
      - mr_canhubk3
    tags: flash_circural_buffer
    integration_platforms:
      - native_sim
  filesystem.fcb.no_erase:
    platform_allow:
      - nrf54l09pdk/nrf54l09/cpuapp
      - nrf54l15dk/nrf54l15/cpuapp
      - nrf54l20pdk/nrf54l20/cpuapp
      - ophelia4ev/nrf54l15/cpuapp
      - native_sim
    integration_platforms:
      - nrf54l09pdk/nrf54l09/cpuapp
      - native_sim
  filesystem.fcb.native_sim.no_erase:
    extra_args: CONFIG_FLASH_SIMULATOR_EXPLICIT_ERASE=n
    platform_allow: native_sim
  filesystem.fcb.fixed_endmarker:
    platform_allow:
      - nrf52840dk/nrf52840
      - nrf52dk/nrf52832
      - nrf51dk/nrf51822
      - native_sim
      - native_sim/native/64
      - mr_canhubk3
    tags: flash_circural_buffer
    integration_platforms:
      - native_sim
    extra_args: CONFIG_FCB_ALLOW_FIXED_ENDMARKER=y
  filesystem.fcb.native_sim.fcb_0x00:
    extra_args: DTC_OVERLAY_FILE=boards/native_sim_ev_0x00.overlay
    platform_allow: native_sim
  filesystem.fcb.qemu_x86.fcb_0x00:
    extra_args: DTC_OVERLAY_FILE=boards/qemu_x86_ev_0x00.overlay
    platform_allow: qemu_x86
```

## tests/subsys/fs/fs_api/testcase.yaml
```yaml
tests:
  filesystem.api:
    tags:
      - fdtable
      - filesystem
    integration_platforms:
      - native_sim
```

## tests/subsys/fs/lib_link/testcase.yaml
```yaml
tests:
  filesystem.lib_link:
    tags:
      - fdtable
      - filesystem
    integration_platforms:
      - native_sim
```

## tests/subsys/fs/littlefs/Kconfig
```kconfig
# SPDX-License-Identifier: Apache-2.0
# Copyright (c) 2020 Nordic Semiconductor ASA

mainmenu "littlefs core functionality test"

source "Kconfig.zephyr"

config APP_TEST_CUSTOM
	bool "Select to test additional custom filesystem configurations"
```

## tests/subsys/fs/littlefs/boards/ek_ra8d2_r7ka8d2kflcac_cm85.conf
```kconfig
# Copyright (c) 2026 Renesas Electronics Corporation
# SPDX-License-Identifier: Apache-2.0

CONFIG_FS_LITTLEFS_PROG_SIZE=128
CONFIG_FS_LITTLEFS_CACHE_SIZE=128
CONFIG_HEAP_MEM_POOL_SIZE=2048
```

## tests/subsys/fs/littlefs/boards/nrf52840dk_nrf52840.conf
```kconfig
#
# Copyright (c) 2019 Peter Bigot Consulting, LLC
# Copyright (c) 2019 Nordic Semiconductor ASA
#
# SPDX-License-Identifier: Apache-2.0
#

CONFIG_NORDIC_QSPI_NOR=y
CONFIG_NORDIC_QSPI_NOR_FLASH_LAYOUT_PAGE_SIZE=4096
```

## tests/subsys/fs/littlefs/testcase.yaml
```yaml
common:
  tags:
    - filesystem
    - littlefs
  platform_allow:
    - nrf52840dk/nrf52840
    - native_sim
    - native_sim/native/64
    - mr_canhubk3
    - frdm_mcxn947/mcxn947/cpu0
    - frdm_rw612
    - mimxrt1010_evk
    - mimxrt1015_evk
    - mimxrt1040_evk
    - mimxrt1050_evk/mimxrt1052/hyperflash
    - mimxrt1060_evk/mimxrt1062/qspi
    - mimxrt1170_evk/mimxrt1176/cm7
    - mimxrt1180_evk/mimxrt1189/cm33
    - mimxrt595_evk/mimxrt595s/cm33
    - mimxrt685_evk/mimxrt685s/cm33
  integration_platforms:
    - native_sim
  modules:
    - littlefs
tests:
  filesystem.littlefs.default:
    timeout: 60
    platform_allow:
      - nrf54l15dk/nrf54l15/cpuapp
      - ophelia4ev/nrf54l15/cpuapp
      - s32z2xxdc2/s32z270/rtu0
      - s32z2xxdc2/s32z270/rtu1
      - s32z2xxdc2@D/s32z270/rtu0
      - s32z2xxdc2@D/s32z270/rtu1
      - frdm_mcxa156
      - frdm_mcxn236
      - frdm_mcxw71
      - lpcxpresso55s06
      - lpcxpresso55s16
      - lpcxpresso55s28
      - lpcxpresso55s36
      - lpcxpresso55s69/lpc55s69/cpu0
  filesystem.littlefs.custom:
    timeout: 180
    extra_configs:
      - CONFIG_APP_TEST_CUSTOM=y
      - CONFIG_FS_LITTLEFS_FC_HEAP_SIZE=16384
```

## tests/subsys/fs/littlefs_automount/testcase.yaml
```yaml
common:
    tags: filesystem
    platform_allow: native_posix native_posix_64

tests:
  filesystem.littlefs_automount:
    timeout: 60
```

## tests/subsys/fs/littlefs_custom/testcase.yaml
```yaml
common:
    tags: filesystem
    platform_allow: native_posix native_posix_64

tests:
  filesystem.littlefs_custom:
    timeout: 60
```

## tests/subsys/fs/multi-fs/testcase.yaml
```yaml
common:
  tags:
    - littlefs
    - fatfs
    - filesystem
  modules:
    - fatfs
    - littlefs
tests:
  filesystem.multifs:
    extra_args:
      - EXTRA_DTC_OVERLAY_FILE="ramdisk.overlay"
    platform_allow:
      - native_sim
      - qemu_x86
    integration_platforms:
      - native_sim
  filesystem.fs_shell:
    extra_args:
      - CONF_FILE="prj_fs_shell.conf"
      - EXTRA_DTC_OVERLAY_FILE="ramdisk.overlay"
    platform_allow:
      - native_sim
      - qemu_x86
    integration_platforms:
      - native_sim
```

## tests/subsys/fs/native_mount/testcase.yaml
```yaml
common:
  tags:
    - filesystem
    - native_mount
  platform_allow:
    - native_sim
    - native_sim/native/64
  integration_platforms:
    - native_sim
tests:
  filesystem.native_mount.default: {}
```

## tests/subsys/fs/nffs_fs_api/basic/testcase.yaml
```yaml
common:
  tags: nffs filesystem
tests:
  filesystem.nffs.basic:
    extra_args: TEST=basic
    platform_whitelist: qemu_x86 nrf52840_pca10056
    timeout: 500
```

## tests/subsys/fs/nffs_fs_api/cache/testcase.yaml
```yaml
common:
  tags: nffs filesystem
tests:
  filesystem.nffs.cache:
    extra_args: TEST=cache
    extra_configs:
      - CONFIG_FS_NFFS_NUM_CACHE_BLOCKS=64
      - CONFIG_FS_NFFS_NUM_CACHE_INODES=4
    platform_whitelist: qemu_x86 nrf52840_pca10056
```

## tests/subsys/fs/nffs_fs_api/large/testcase.yaml
```yaml
common:
  tags: nffs filesystem
tests:
  filesystem.nffs.large:
    extra_args: TEST=large
    platform_whitelist: qemu_x86 nrf52840_pca10056
```

## tests/subsys/fs/nffs_fs_api/performance/testcase.yaml
```yaml
common:
  tags: nffs filesystem
tests:
  filesystem.nffs.performance:
    extra_args: TEST=performance
    platform_whitelist: qemu_x86 nrf52840_pca10056
```

## tests/subsys/fs/nffs_fs_api/testcase.yaml
```yaml
common:
  tags: nffs filesystem
tests:
  filesystem.nffs.basic:
    extra_args: TEST=basic
    platform_whitelist: qemu_x86
  filesystem.nffs.cache:
    extra_args: TEST=cache
    extra_configs:
      - CONFIG_FS_NFFS_NUM_CACHE_BLOCKS=64
      - CONFIG_FS_NFFS_NUM_CACHE_INODES=4
    platform_whitelist: qemu_x86
  filesystem.nffs.large:
    extra_args: TEST=large
    platform_whitelist: qemu_x86
  filesystem.nffs.performance:
    extra_args: TEST=performance
    platform_whitelist: qemu_x86
```
