## CMakeLists.txt
```
# SPDX-License-Identifier: Apache-2.0

cmake_minimum_required(VERSION 3.28.0)
find_package(Zephyr REQUIRED HINTS $ENV{ZEPHYR_BASE})
project(native_mount)

file(GLOB app_sources src/*.c)

target_sources(app PRIVATE
  ${app_sources}
  ../common/test_fs_util.c
  ../common/test_fs_open_flags.c
  ../common/test_fs_dirops.c
  ../common/test_fs_basic.c
)

file(MAKE_DIRECTORY ${CMAKE_CURRENT_BINARY_DIR}/test_fs)

target_compile_definitions(app PRIVATE
  TEST_FS_DIR="${CMAKE_CURRENT_BINARY_DIR}/test_fs"
)
```

## prj.conf
```kconfig
CONFIG_FILE_SYSTEM=y
CONFIG_FILE_SYSTEM_MKFS=y
CONFIG_FILE_SYSTEM_NATIVE_MOUNT=y
CONFIG_MAIN_STACK_SIZE=4096

CONFIG_LOG=y
CONFIG_FS_LOG_LEVEL_DBG=y

CONFIG_ZTEST=y
CONFIG_ZTEST_STACK_SIZE=4096
```

## src/main.c
```c
/*
 * Copyright (c) 2025 Golioth, Inc.
 * Copyright (c) 2025 Marcin Niestroj
 *
 * SPDX-License-Identifier: Apache-2.0
 */

#include <zephyr/ztest.h>

ZTEST_SUITE(native_mount, NULL, NULL, NULL, NULL, NULL);
```

## src/mount.c
```c
/*
 * Copyright (c) 2025 Golioth, Inc.
 * Copyright (c) 2025 Marcin Niestroj
 *
 * SPDX-License-Identifier: Apache-2.0
 */

#include <string.h>
#include <stdio.h>
#include <stdlib.h>
#include <zephyr/fs/fs.h>

#include <zephyr/logging/log.h>
LOG_MODULE_REGISTER(mount);

#include "mount.h"

struct fs_mount_t test_mp = {
	.type = FS_NATIVE_MOUNT,
	.mnt_point = "/test_fs",
	.fs_data = TEST_FS_DIR,
	.storage_dev = NULL,
};

static int fs_rm_child(const char *path, struct fs_dir_t *dp)
{
	struct fs_dirent entry;
	char *path_child;
	size_t path_child_len;
	int err;

	err = fs_readdir(dp, &entry);
	if (err) {
		LOG_ERR("Failed to readdir during rm: %d", err);
		return err;
	}

	if (entry.name[0] == '\0') {
		return -EAGAIN;
	}

	path_child_len = strlen(path) + strlen(entry.name) + sizeof("/");

	path_child = malloc(path_child_len);
	if (!path_child) {
		return -ENOMEM;
	}

	snprintf(path_child, path_child_len, "%s/%s", path, entry.name);

	if (entry.type == FS_DIR_ENTRY_DIR) {
		err = fs_rm_all(path_child);
		if (err) {
			goto free_child_path;
		}
	}

	LOG_INF("Unlinking %s", path_child);

	err = fs_unlink(path_child);

free_child_path:
	free(path_child);

	return err;
}

int fs_rm_all(const char *path)
{
	struct fs_dir_t dp = {};
	int err = 0;

	LOG_INF("rm all %s", path);

	err = fs_opendir(&dp, path);
	if (err) {
		LOG_ERR("opendir failed: %d", err);
		return err;
	}

	while (err == 0) {
		err = fs_rm_child(path, &dp);
	}

	return fs_closedir(&dp);
}
```

## src/mount.h
```c
/*
 * Copyright (c) 2025 Golioth, Inc.
 * Copyright (c) 2025 Marcin Niestroj
 *
 * SPDX-License-Identifier: Apache-2.0
 */

#ifndef __FS_MOUNT_H__
#define __FS_MOUNT_H__

#include <zephyr/fs/fs.h>

extern struct fs_mount_t test_mp;

int fs_rm_all(const char *path);

#endif /* __FS_MOUNT_H__ */
```

## src/test_native_mount_basic.c
```c
/*
 * Copyright (c) 2025 Golioth, Inc.
 * Copyright (c) 2025 Marcin Niestroj
 *
 * SPDX-License-Identifier: Apache-2.0
 */

#include <string.h>
#include <zephyr/ztest.h>
#include <zephyr/fs/fs.h>

#include "mount.h"

void test_fs_basic(void);

struct fs_mount_t *fs_basic_test_mp = &test_mp;

ZTEST(native_mount, test_native_mount_basic)
{
	zassert_equal(fs_mount(&test_mp), 0, "mount failed");
	zassert_equal(fs_rm_all(test_mp.mnt_point), 0, "rm all failed");
	zassert_equal(fs_unmount(&test_mp), 0, "unmount small failed");

	/* Common basic tests.
	 * (File system is mounted and unmounted during that test.)
	 */
	test_fs_basic();
}
```

## src/test_native_mount_dirops.c
```c
/*
 * Copyright (c) 2025 Golioth, Inc.
 * Copyright (c) 2025 Marcin Niestroj
 *
 * SPDX-License-Identifier: Apache-2.0
 */

#include <string.h>
#include <stdlib.h>
#include <zephyr/ztest.h>
#include <zephyr/fs/fs.h>

#include "mount.h"

void test_fs_dirops(void);

/* Mount structure needed by test_fs_basic tests. */
struct fs_mount_t *fs_dirops_test_mp = &test_mp;

ZTEST(native_mount, test_native_mount_dirops)
{
	zassert_equal(fs_mount(&test_mp), 0, "mount failed");
	zassert_equal(fs_rm_all(test_mp.mnt_point), 0, "rm all failed");
	zassert_equal(fs_unmount(&test_mp), 0, "unmount small failed");

	/* Common dirops tests.
	 * (File system is mounted and unmounted during that test.)
	 */
	test_fs_dirops();
}
```

## src/test_native_mount_open_flags.c
```c
/*
 * Copyright (c) 2025 Golioth, Inc.
 * Copyright (c) 2025 Marcin Niestroj
 *
 * SPDX-License-Identifier: Apache-2.0
 */

#include <zephyr/ztest.h>

#include "mount.h"

void test_fs_open_flags(void);
/* Expected by test_fs_open_flags() */
const char *test_fs_open_flags_file_path = "/test_fs/the_file";

static void mount(struct fs_mount_t *mp)
{
	TC_PRINT("Mount %s\n", mp->mnt_point);

	zassert_equal(fs_mount(mp), 0, "Failed to %s partition", "mount");
}

static void unmount(struct fs_mount_t *mp)
{
	TC_PRINT("Unmounting %s\n", mp->mnt_point);

	zassert_equal(fs_unmount(mp), 0, "Failed to %s partition", "unmount");
}

static void cleanup(struct fs_mount_t *mp)
{
	TC_PRINT("Clean %s\n", mp->mnt_point);

	zassert_equal(fs_rm_all(mp->mnt_point), TC_PASS, "Failed to %s partition", "clean");
}

ZTEST(native_mount, test_native_mount_open_flags)

{
	/* Using smallest partition for this tests as they do not write
	 * a lot of data, basically they just check flags.
	 */
	struct fs_mount_t *mp = &test_mp;

	mp->flags = 0;
	mount(mp);
	cleanup(mp);

	test_fs_open_flags();

	unmount(mp);
}
```
