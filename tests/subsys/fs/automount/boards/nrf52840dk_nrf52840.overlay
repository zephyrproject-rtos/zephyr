/*
 * Copyright (c) 2020 Nordic Semiconductor ASA
 *
 * SPDX-License-Identifier: Apache-2.0
 */

/delete-node/ &storage_partition;
/delete-node/ &scratch_partition;

&flash0 {
	partitions {
		compatible = "fixed-partitions";
		#address-cells = <1>;
		#size-cells = <1>;

		storage_partition: partition@f8000 {
			label = "storage";
			reg = <0x000f8000 0x00004000>;
		};
		storage1_partition: partition@fc000 {
			label = "storage1";
			reg = <0x000fc000 0x00004000>;
		};
	};
};
