/*
 * Copyright (c) 2020 Nordic Semiconductor ASA
 *
 * SPDX-License-Identifier: Apache-2.0
 */

/delete-node/ &storage_partition;
/delete-node/ &scratch_partition;

&flash0 {
	partitions {
		compatible = "fixed-partitions";
		#address-cells = <1>;
		#size-cells = <1>;

		storage_partition: partition@de000 {
			mount-point = "/lfs0";
			mount-type = "LittleFS";
			label = "storage";
			reg = <0x000de000 0x00010000>;
		};
		storage1_partition: partition@1de000 {
			mount-point = "/lfs1";
			mount-type = "LittleFS";
			label = "storage1";
			reg = <0x001de000 0x00010000>;
		};
	};
};
