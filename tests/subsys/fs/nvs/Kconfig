## tests/subsys/fs/nvs/Kconfig
```kconfig
# Copyright 2025 NXP
# SPDX-License-Identifier: Apache-2.0

mainmenu "NVS test configuration"

config TEST_NVS_SIMULATOR
	bool "Enable NVS tests designed to be run using a flash-simulator"
	default y if BOARD_QEMU_X86 || ARCH_POSIX || BOARD_MPS2_AN385
	help
	  If y, enables NVS tests designed to be run using a flash-simulator,
	  which provide functionality for flash property customization
	  and emulating errors in flash operation in parallel to
	  the regular flash API.
	  The tests must be run only on qemu_x86, mps2_an385, or native_sim target.

source "Kconfig.zephyr"
```

## tests/subsys/fs/nvs/testcase.yaml
```yaml
common:
  tags: nvs
tests:
  filesystem.nvs:
    platform_allow:
      - qemu_x86
      - mps2/an385
  filesystem.nvs.0x00:
    extra_args: DTC_OVERLAY_FILE=boards/qemu_x86_ev_0x00.overlay
    platform_allow: qemu_x86
  filesystem.nvs.sim.no_erase:
    extra_args: CONFIG_FLASH_SIMULATOR_EXPLICIT_ERASE=n
    platform_allow: qemu_x86
  filesystem.nvs.cache:
    extra_args:
      - CONFIG_NVS_LOOKUP_CACHE=y
      - CONFIG_NVS_LOOKUP_CACHE_SIZE=64
    platform_allow: native_sim
  filesystem.nvs.data_crc:
    extra_args:
      - CONFIG_NVS_DATA_CRC=y
    platform_allow:
      - native_sim
      - qemu_x86
  filesystem.nvs.data_crc_cache:
    extra_args:
      - CONFIG_NVS_DATA_CRC=y
      - CONFIG_NVS_LOOKUP_CACHE=y
      - CONFIG_NVS_LOOKUP_CACHE_SIZE=64
    platform_allow: native_sim
```

## tests/subsys/fs/rpmsgfs/boards/mr_navq95b_mimx9596_m7.conf
```kconfig
#
# Copyright 2026 NXP
#
# SPDX-License-Identifier: Apache-2.0
#

CONFIG_OPENAMP_WITH_DCACHE=y
CONFIG_UART_CONSOLE=y
CONFIG_ARM_SCMI=y
CONFIG_IPM=y
CONFIG_IPM_MBOX=y
CONFIG_MBOX_NXP_IMX_MU=y
CONFIG_MBOX_INIT_PRIORITY=0
CONFIG_OPENAMP_RSC_TABLE=y
CONFIG_OPENAMP_COPY_RSC_TABLE=y

CONFIG_OPENAMP=y
CONFIG_OPENAMP_RSC_TABLE_NUM_RPMSG_BUFF=8
CONFIG_OPENAMP_RSC_TABLE=y
CONFIG_OPENAMP_MASTER=n
```

## tests/subsys/fs/zms/testcase.yaml
```yaml
common:
  tags: zms
tests:
  filesystem.zms:
    platform_allow:
      - qemu_x86
  filesystem.zms.0x00:
    extra_args: DTC_OVERLAY_FILE=boards/qemu_x86_ev_0x00.overlay
    platform_allow: qemu_x86
  filesystem.zms.sim.no_erase:
    extra_configs:
      - CONFIG_FLASH_SIMULATOR_EXPLICIT_ERASE=n
    platform_allow: qemu_x86
  filesystem.zms.sim.corrupt_close:
    extra_configs:
      - CONFIG_FLASH_SIMULATOR_EXPLICIT_ERASE=y
      - CONFIG_FLASH_SIMULATOR_DOUBLE_WRITES=y
    platform_allow: qemu_x86
  filesystem.zms.cache:
    extra_configs:
      - CONFIG_ZMS_LOOKUP_CACHE=y
      - CONFIG_ZMS_LOOKUP_CACHE_SIZE=64
    platform_allow: native_sim
  filesystem.zms.data_crc:
    extra_configs:
      - CONFIG_ZMS_DATA_CRC=y
    platform_allow:
      - native_sim
      - qemu_x86
  filesystem.zms.no_double_write:
    extra_configs:
      - CONFIG_ZMS_NO_DOUBLE_WRITE=y
    platform_allow:
      - native_sim
      - qemu_x86
  filesystem.zms.no_double_write_cache:
    extra_configs:
      - CONFIG_ZMS_NO_DOUBLE_WRITE=y
      - CONFIG_ZMS_LOOKUP_CACHE=y
      - CONFIG_ZMS_LOOKUP_CACHE_SIZE=64
    platform_allow:
      - native_sim
      - qemu_x86
  filesystem.zms.id_64bit:
    extra_configs:
      - CONFIG_ZMS_ID_64BIT=y
      - CONFIG_ZMS_LOOKUP_CACHE=y
      - CONFIG_ZMS_LOOKUP_CACHE_SIZE=64
    platform_allow: qemu_x86
```

## tests/subsys/gnss/rtk/rtcm3/testcase.yaml
```yaml
# Copyright (c) 2025 Croxel Inc.
# Copyright (c) 2025 CogniPilot Foundation
# SPDX-License-Identifier: Apache-2.0

tests:
  gnss.rtk.decoder.rtcm3:
    tags: rtk
    platform_allow:
      - native_sim
```

## tests/subsys/hps_bridges/testcase.yaml
```yaml
# Copyright (c) 2023, Intel Corporation.
# SPDX-License-Identifier: Apache-2.0

tests:
  hps.hps_bridge.ztest:
    build_only: true
    platform_allow: intel_socfpga_agilex_socdk  intel_socfpga_agilex5_socdk
    integration_platforms:
      - intel_socfpga_agilex_socdk
      - intel_socfpga_agilex5_socdk
    tags: hps_bridges
```

## tests/subsys/input/api/testcase.yaml
```yaml
# SPDX-License-Identifier: Apache-2.0

common:
  tags:
    - input
  integration_platforms:
    - native_sim
tests:
  input.api.thread:
    extra_configs:
      - CONFIG_INPUT_MODE_THREAD=y
      # There is a check to see if it is no longer able to push more
      # messages into a full queue. When these is another CPU consuming
      # messages, the queue would not be full at that point. A new message
      # can be pushed into the queue and thus failing the "full queue"
      # check. So limit this to 1 CPU only so this check's assumption
      # can be fulfilled.
      - CONFIG_MP_MAX_NUM_CPUS=1
  input.api.synchronous:
    extra_configs:
      - CONFIG_INPUT_MODE_SYNCHRONOUS=y
```

## tests/subsys/input/input_longpress/testcase.yaml
```yaml
# SPDX-License-Identifier: Apache-2.0

tests:
  input.input_longpress:
    platform_allow: native_posix native_posix_64
    tags: drivers input
    integration_platforms:
      - native_posix
```

## tests/subsys/input/input_shell/testcase.yaml
```yaml
# SPDX-License-Identifier: Apache-2.0

tests:
  input.input_shell:
    tags: input
    platform_allow:
      - native_posix
      - native_posix_64
    harness: console
    harness_config:
      type: multi_line
      regex:
        - "I: input event: dev=NULL             SYN type= 1 code=  2 value=0"
        - "I: input event: dev=NULL             SYN type= 1 code=  2 value=1"
```

## tests/subsys/input/kbd_matrix_state_dump/Kconfig
```kconfig
# Copyright 2023 Google LLC
# SPDX-License-Identifier: Apache-2.0

config INPUT_KBD_MATRIX
	default y

source "Kconfig.zephyr"
```

## tests/subsys/input/kbd_matrix_state_dump/testcase.yaml
```yaml
# SPDX-License-Identifier: Apache-2.0

common:
  tags: input
  platform_allow:
    - native_posix
    - native_posix/native/64
    - native_sim
    - native_sim/native/64
  integration_platforms:
    - native_sim
  harness: console
tests:
  input.kbd_matrix_state_dump:
    harness_config:
      type: multi_line
      regex:
        - "I: kbd-matrix state \\[01 -- -- --\\] \\(1\\)"
        - "I: kbd-matrix state \\[11 -- -- --\\] \\(2\\)"
        - "I: kbd-matrix state \\[11 02 -- --\\] \\(3\\)"
        - "I: kbd-matrix state \\[11 02 04 --\\] \\(4\\)"
        - "I: kbd-matrix state \\[10 02 04 --\\] \\(3\\)"
        - "I: kbd-matrix state \\[-- 02 04 --\\] \\(2\\)"
        - "I: kbd-matrix state \\[-- -- 04 --\\] \\(1\\)"
        - "I: kbd-matrix state \\[-- -- -- --\\] \\(0\\)"
        - "I: kbd-matrix state \\[-- -- -- 08\\] \\(1\\)"
        - "I: kbd-matrix state \\[-- -- -- --\\] \\(0\\)"
        - "I: kbd-matrix key-mask \\[11 02 04 08\\] \\(5\\)"
  input.kbd_matrix_state_dump_16_bit_rows:
    extra_configs:
      - CONFIG_INPUT_KBD_MATRIX_16_BIT_ROW=y
    harness_config:
      type: multi_line
      regex:
        - "I: kbd-matrix state \\[0001 ---- ---- ----\\] \\(1\\)"
        - "I: kbd-matrix state \\[0011 ---- ---- ----\\] \\(2\\)"
        - "I: kbd-matrix state \\[0011 0002 ---- ----\\] \\(3\\)"
        - "I: kbd-matrix state \\[0011 0002 0004 ----\\] \\(4\\)"
        - "I: kbd-matrix state \\[0010 0002 0004 ----\\] \\(3\\)"
        - "I: kbd-matrix state \\[---- 0002 0004 ----\\] \\(2\\)"
        - "I: kbd-matrix state \\[---- ---- 0004 ----\\] \\(1\\)"
        - "I: kbd-matrix state \\[---- ---- ---- ----\\] \\(0\\)"
        - "I: kbd-matrix state \\[---- ---- ---- 0008\\] \\(1\\)"
        - "I: kbd-matrix state \\[---- ---- ---- ----\\] \\(0\\)"
        - "I: kbd-matrix state \\[1000 ---- ---- ----\\] \\(1\\)"
        - "I: kbd-matrix state \\[---- ---- ---- ----\\] \\(0\\)"
        - "I: kbd-matrix key-mask \\[1011 0002 0004 0008\\] \\(6\\)"
```

## tests/subsys/input/longpress/testcase.yaml
```yaml
# SPDX-License-Identifier: Apache-2.0

tests:
  input.input_longpress:
    platform_allow:
      - native_sim
      - native_sim/native/64
    tags:
      - drivers
      - input
    integration_platforms:
      - native_sim
```

## tests/subsys/input/shell/testcase.yaml
```yaml
# SPDX-License-Identifier: Apache-2.0

tests:
  input.input_shell:
    tags: input
    platform_allow:
      - native_posix/native
      - native_posix/native/64
      - native_sim/native
      - native_sim/native/64
    integration_platforms:
      - native_sim/native
    harness: console
    harness_config:
      type: multi_line
      regex:
        - "I: input event: dev=NULL             SYN type= 1 code=  2 value=0"
        - "I: input event: dev=NULL             SYN type= 1 code=  2 value=1"
```

## tests/subsys/ipc/bitpool/testcase.yaml
```yaml
tests:
  ipc.icmsg_bitpool:
    integration_platforms:
      - native_sim
    timeout: 120
```

## tests/subsys/ipc/icmsg/Kconfig.sysbuild
```kconfig
# Copyright 2023 Nordic Semiconductor ASA
#
# SPDX-License-Identifier: Apache-2.0

source "share/sysbuild/Kconfig"

config REMOTE_BOARD
	string "The board used for remote target"
	default "nrf5340dk/nrf5340/cpunet" if $(BOARD) = "nrf5340dk"
	default "nrf5340bsim/nrf5340/cpunet" if $(BOARD) = "nrf5340bsim"
	default "nrf54h20dk/nrf54h20/cpuppr" if BOARD_NRF54H20DK_NRF54H20_CPUAPP
	default "nrf54l15dk/nrf54l15/cpuflpr" if $(BOARD) = "nrf54l15dk"
	default "nrf54lm20dk/nrf54lm20a/cpuflpr" if $(BOARD) = "nrf54lm20dk"
	default "stm32h747i_disco/stm32h747xx/m4" if $(BOARD) = "stm32h747i_disco"
```

## tests/subsys/ipc/icmsg_buf/testcase.yaml
```yaml
tests:
  subsys.ipc.icmsg_buf:
    integration_platforms:
      - nrf5340dk_nrf5340_cpuapp
    platform_exclude: qemu_malta ast1030_evb
```

## tests/subsys/ipc/ipc_msg_service/dts/bindings/ipc-service-backend.yaml
```yaml
#
# Copyright (c) 2021 Carlo Caione <ccaione@baylibre.com>
# Copyright (c) 2025 Intel Corporation
#
# SPDX-License-Identifier: Apache-2.0
#

description: Backend binding to test the IPC message service

compatible: "ipc-msg-service-backend"

properties:
  offset:
    type: int
    required: true
    description: offset to add
```

## tests/subsys/ipc/ipc_msg_service/testcase.yaml
```yaml
#
# Copyright 2021 Carlo Caione 2021 <ccaione@baylibre.com>
# Copyright 2025 Intel Corporation
#
# SPDX-License-Identifier: Apache-2.0
#

tests:
  ipc.ipc_msg_service:
    tags: ipc_msg_service
    harness: ztest
    platform_allow: qemu_cortex_a53
```

## tests/subsys/ipc/ipc_service/dts/bindings/ipc-service-backend.yaml
```yaml
#
# Copyright (c) 2021 Carlo Caione <ccaione@baylibre.com>
#
# SPDX-License-Identifier: Apache-2.0
#

description: Backend binding to test the IPC service

compatible: "ipc-service-backend"

properties:
  offset:
    type: int
    required: true
    description: offset to add
```

## tests/subsys/ipc/ipc_service/testcase.yaml
```yaml
# Copyright 2021 Carlo Caione 2021 <ccaione@baylibre.com>
# SPDX-License-Identifier: Apache-2.0

tests:
  ipc.ipc_service:
    tags: ipc_service
    harness: ztest
    platform_allow: qemu_cortex_a53
```

## tests/subsys/ipc/ipc_service_api/Kconfig
```kconfig
# Copyright (c) 2026 Nordic Semiconductor ASA
# SPDX-License-Identifier: Apache-2.0

source "Kconfig.zephyr"

menu "IPC service API test options"

config IPC_SERVICE_API_TEST_DEREGISTER
	bool "Test ipc_service_deregister_endpoint()"
	default y if IPC_SERVICE_BACKEND_ICBMSG
	help
	  Run the endpoint deregistration test case.

config IPC_SERVICE_API_TEST_PRIORITY
	bool "Test endpoint priorities"
	default y if IPC_SERVICE_BACKEND_ICBMSG
	help
	  Run the endpoint priority test case.

config IPC_SERVICE_API_TEST_SECOND_ENDPOINT
	bool "Test second endpoint"
	default y if IPC_SERVICE_BACKEND_ICBMSG || IPC_SERVICE_BACKEND_RPMSG
	help
	  Run the second endpoint test case.

config IPC_SERVICE_API_TEST_ISR_SEND
	bool "Test send from interrupt context"
	default y if IPC_SERVICE_BACKEND_ICBMSG
	help
	  Run test cases that call ipc_service_send() and ipc_service_send_nocopy()
	  from a k_timer expiry handler (interrupt context).

endmenu
```

## tests/subsys/ipc/ipc_service_api/boards/nrf5340dk_nrf5340_cpuapp_static_vrings.conf
```kconfig
CONFIG_SOC_NRF53_CPUNET_ENABLE=y
CONFIG_HEAP_MEM_POOL_SIZE=4096
CONFIG_OPENAMP=y
CONFIG_OPENAMP_SLAVE=n
```

## tests/subsys/ipc/ipc_service_api/remote/Kconfig
```kconfig
# Copyright (c) 2026 Nordic Semiconductor ASA
# SPDX-License-Identifier: Apache-2.0

rsource "../Kconfig"
```

## tests/subsys/ipc/ipc_service_backend/testcase.yaml
```yaml
common:
  tags:
    - ipc
  platform_allow:
    - native_sim
  harness: ztest
tests:
  subsys.ipc.ipc_service_backend.serial:
    extra_configs:
      - CONFIG_SERIAL=y
      - CONFIG_UART_INTERRUPT_DRIVEN=y
      - CONFIG_EMUL=y
      - CONFIG_IPC_SERVICE_BACKEND_SERIAL_CRC=y
    extra_dtc_overlay_files:
      - serial.overlay
```

## tests/subsys/ipc/ipc_service_benchmark/Kconfig
```kconfig
source "Kconfig.zephyr"

config TEST_MULTI_ENDPOINT
	bool
	default y if IPC_SERVICE_BACKEND_ICBMSG

config TEST_NO_COPY
	bool "Test no-copy API"
	depends on IPC_SERVICE_BACKEND_ICBMSG
```
