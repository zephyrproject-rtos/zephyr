## CMakeLists.txt
```
# SPDX-License-Identifier: Apache-2.0

cmake_minimum_required(VERSION 3.13.1)
if(BOARD STREQUAL nrf52840_pca10056)
    set(CONF_FILE nrf5x.conf)
endif()

include($ENV{ZEPHYR_BASE}/cmake/app/boilerplate.cmake NO_POLICY_SCOPE)
project(basic)

if(BOARD STREQUAL qemu_x86)
    zephyr_compile_definitions(
        -DTEST_FLASH_OFFSET=0
    )
elseif(BOARD STREQUAL nrf52840_pca10056)
    zephyr_compile_definitions(
        -DTEST_FLASH_OFFSET=0x20000
    )
endif()

if(NOT TEST)
    target_compile_definitions(app PRIVATE
        -DTEST_basic
	)
else()
    target_compile_definitions(app PRIVATE
        -DTEST_${TEST}
	)
endif()


zephyr_include_directories(../common)
FILE(GLOB app_sources ../common/*.c src/*.c)

if(CONFIG_QEMU_TARGET)
    list(APPEND app_sources ../ram_backend/test_ram_backend.c)
endif()

target_sources(app PRIVATE ${app_sources})
```

## prj.conf
```kconfig
CONFIG_TEST_FLASH_DRIVERS=y
CONFIG_FILE_SYSTEM_NFFS=y
CONFIG_FILE_SYSTEM=y
CONFIG_LOG=y
CONFIG_FLASH_PAGE_LAYOUT=y
CONFIG_FLASH=y
CONFIG_FS_NFFS_FLASH_DEV_NAME="ram_flash_test_drv"
CONFIG_FS_NFFS_NUM_BLOCKS=1024
CONFIG_FS_NFFS_NUM_CACHE_BLOCKS=1
CONFIG_FS_NFFS_NUM_CACHE_INODES=1
CONFIG_FS_NFFS_NUM_DIRS=4
CONFIG_FS_NFFS_NUM_FILES=4
CONFIG_FS_NFFS_NUM_INODES=1024
CONFIG_HEAP_MEM_POOL_SIZE=1024
CONFIG_MAIN_STACK_SIZE=1024
CONFIG_NFFS_FILESYSTEM_MAX_AREAS=12
CONFIG_ZTEST_STACKSIZE=2048
CONFIG_ZTEST=y
CONFIG_LOG=y

CONFIG_SYS_TIMEOUT_LEGACY_API=n
```

## nrf5x.conf
```kconfig
CONFIG_ZTEST=y
CONFIG_ZTEST_STACKSIZE=2048
CONFIG_MAIN_STACK_SIZE=1024
CONFIG_HEAP_MEM_POOL_SIZE=1024

CONFIG_FLASH=y
CONFIG_SOC_FLASH_NRF_RADIO_SYNC=y
CONFIG_MPU_ALLOW_FLASH_WRITE=y

CONFIG_FILE_SYSTEM=y
CONFIG_LOG=y
CONFIG_FILE_SYSTEM_NFFS=y
CONFIG_FS_NFFS_FLASH_DEV_NAME="NRF_FLASH_DRV_NAME"
CONFIG_FS_NFFS_NUM_FILES=4
CONFIG_FS_NFFS_NUM_DIRS=4
CONFIG_FS_NFFS_NUM_INODES=1024
CONFIG_FS_NFFS_NUM_BLOCKS=1024
CONFIG_FS_NFFS_NUM_CACHE_INODES=1
CONFIG_FS_NFFS_NUM_CACHE_BLOCKS=1
CONFIG_FILE_SYSTEM_NFFS=y
CONFIG_NFFS_FILESYSTEM_MAX_AREAS=12
```

## src/main.c
```c
/*
 * Copyright (c) 2017 Codecoup
 *
 * SPDX-License-Identifier: Apache-2.0
 */

#include <nffs/nffs.h>
#include "test_nffs.h"

void test_main(void)
{
	ztest_test_suite(nffs_fs_basic_test,
		ztest_unit_test_setup_teardown(test_fs_mount,
					       test_setup, test_teardown),
		ztest_unit_test_setup_teardown(test_unlink,
					       test_setup, test_teardown),
		ztest_unit_test_setup_teardown(test_mkdir,
					       test_setup, test_teardown),
		ztest_unit_test_setup_teardown(test_rename,
					       test_setup, test_teardown),
		ztest_unit_test_setup_teardown(test_append,
					       test_setup, test_teardown),
		ztest_unit_test_setup_teardown(test_read,
					       test_setup, test_teardown),
		ztest_unit_test_setup_teardown(test_open,
					       test_setup, test_teardown),
		ztest_unit_test_setup_teardown(test_overwrite_one,
					       test_setup, test_teardown),
		ztest_unit_test_setup_teardown(test_overwrite_two,
					       test_setup, test_teardown),
		ztest_unit_test_setup_teardown(test_overwrite_three,
					       test_setup, test_teardown),
		ztest_unit_test_setup_teardown(test_overwrite_many,
					       test_setup, test_teardown),
		ztest_unit_test_setup_teardown(test_long_filename,
					       test_setup, test_teardown),
		ztest_unit_test_setup_teardown(test_large_write,
					       test_setup, test_teardown),
		ztest_unit_test_setup_teardown(test_many_children,
					       test_setup, test_teardown),
		ztest_unit_test_setup_teardown(test_gc,
					       test_setup, test_teardown),
		ztest_unit_test_setup_teardown(test_wear_level,
					       test_setup, test_teardown),
		ztest_unit_test_setup_teardown(test_corrupt_scratch,
					       test_setup, test_teardown),
		ztest_unit_test_setup_teardown(test_incomplete_block,
					       test_setup, test_teardown),
		ztest_unit_test_setup_teardown(test_corrupt_block,
					       test_setup, test_teardown),
		ztest_unit_test_setup_teardown(test_lost_found,
					       test_setup, test_teardown),
		ztest_unit_test_setup_teardown(test_readdir,
					       test_setup, test_teardown),
		ztest_unit_test_setup_teardown(test_split_file,
					       test_setup, test_teardown),
		ztest_unit_test_setup_teardown(test_gc_on_oom,
					       test_setup, test_teardown));
	ztest_run_test_suite(nffs_fs_basic_test);
}
```
