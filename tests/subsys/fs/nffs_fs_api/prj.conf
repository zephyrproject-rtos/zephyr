## CMakeLists.txt
```
if(BOARD STREQUAL nrf51_pca10028)
    set(CONF_FILE nrf5x.conf)
elseif(BOARD STREQUAL nrf52_pca10040)
    set(CONF_FILE nrf5x.conf)
elseif(BOARD STREQUAL nrf52840_pca10056)
    set(CONF_FILE nrf5x.conf)
endif()

include($ENV{ZEPHYR_BASE}/cmake/app/boilerplate.cmake NO_POLICY_SCOPE)
project(NONE)

if(BOARD STREQUAL qemu_x86)
    zephyr_compile_definitions(
        -DTEST_FLASH_OFFSET=0
	-DFLASH_AREA_STORAGE_OFFSET=0
	-DFLASH_AREA_STORAGE_SIZE=1048576
    )
elseif(BOARD STREQUAL nrf51_pca10028)
    zephyr_compile_definitions(
        -DTEST_FLASH_OFFSET=0x20000
    )
elseif(BOARD STREQUAL nrf52_pca10040)
    zephyr_compile_definitions(
        -DTEST_FLASH_OFFSET=0x20000
    )
elseif(BOARD STREQUAL nrf52840_pca10056)
    zephyr_compile_definitions(
        -DTEST_FLASH_OFFSET=0x20000
    )
endif()

if(NOT TEST)
    target_compile_definitions(app PRIVATE
        -DTEST_basic
	)
else()
    target_compile_definitions(app PRIVATE
        -DTEST_${TEST}
	)
endif()


target_link_libraries(app NFFS)
FILE(GLOB app_sources src/*.c)
target_sources(app PRIVATE ${app_sources})
```

## prj.conf
```kconfig
CONFIG_FILE_SYSTEM_NFFS=y
CONFIG_FILE_SYSTEM=y
CONFIG_FLASH_PAGE_LAYOUT=y
CONFIG_FLASH=y
CONFIG_FS_NFFS_FLASH_DEV_NAME="ram_flash_test_drv"
CONFIG_FS_NFFS_NUM_BLOCKS=1024
CONFIG_FS_NFFS_NUM_CACHE_BLOCKS=1
CONFIG_FS_NFFS_NUM_CACHE_INODES=1
CONFIG_FS_NFFS_NUM_DIRS=4
CONFIG_FS_NFFS_NUM_FILES=4
CONFIG_FS_NFFS_NUM_INODES=1024
CONFIG_HEAP_MEM_POOL_SIZE=1024
CONFIG_MAIN_STACK_SIZE=1024
CONFIG_NFFS_FILESYSTEM_MAX_AREAS=12
CONFIG_ZTEST_STACKSIZE=2048
CONFIG_ZTEST=y
```

## nrf5x.conf
```kconfig
CONFIG_ZTEST=y
CONFIG_ZTEST_STACKSIZE=2048
CONFIG_MAIN_STACK_SIZE=1024
CONFIG_HEAP_MEM_POOL_SIZE=1024

CONFIG_FLASH=y
CONFIG_SOC_FLASH_NRF5=y
CONFIG_SOC_FLASH_NRF5_RADIO_SYNC=y
CONFIG_MPU_ALLOW_FLASH_WRITE=y

CONFIG_FILE_SYSTEM=y
CONFIG_FILE_SYSTEM_NFFS=y
CONFIG_FS_NFFS_FLASH_DEV_NAME="NRF5_FLASH_DRV_NAME"
CONFIG_FS_NFFS_NUM_FILES=4
CONFIG_FS_NFFS_NUM_DIRS=4
CONFIG_FS_NFFS_NUM_INODES=1024
CONFIG_FS_NFFS_NUM_BLOCKS=1024
CONFIG_FS_NFFS_NUM_CACHE_INODES=1
CONFIG_FS_NFFS_NUM_CACHE_BLOCKS=1
CONFIG_FILE_SYSTEM_NFFS=y
CONFIG_NFFS_FILESYSTEM_MAX_AREAS=12
```

## prj_cache.conf
```kconfig
CONFIG_ZTEST=y
CONFIG_ZTEST_STACKSIZE=2048
CONFIG_MAIN_STACK_SIZE=1024
CONFIG_HEAP_MEM_POOL_SIZE=1024

CONFIG_FLASH=y
CONFIG_FLASH_PAGE_LAYOUT=y
CONFIG_FILE_SYSTEM=y
CONFIG_FILE_SYSTEM_NFFS=y
CONFIG_FS_NFFS_FLASH_DEV_NAME="ram_flash_test_drv"
CONFIG_FS_NFFS_NUM_FILES=4
CONFIG_FS_NFFS_NUM_DIRS=4
CONFIG_FS_NFFS_NUM_INODES=1024
CONFIG_FS_NFFS_NUM_BLOCKS=1024
CONFIG_FS_NFFS_NUM_CACHE_INODES=4
CONFIG_FS_NFFS_NUM_CACHE_BLOCKS=64
CONFIG_FILE_SYSTEM_NFFS=y
CONFIG_NFFS_FILESYSTEM_MAX_AREAS=12
```

## src/main.c
```c
/*
 * Copyright (c) 2017 Codecoup
 *
 * SPDX-License-Identifier: Apache-2.0
 */

#include <nffs/nffs.h>
#include "test_nffs.h"

#if CONFIG_BOARD_QEMU_X86
static struct nffs_area_desc nffs_selftest_area_descs[] = {
	{ 0x00000000, 16 * 1024 },
	{ 0x00004000, 16 * 1024 },
	{ 0x00008000, 16 * 1024 },
	{ 0x0000c000, 16 * 1024 },
	{ 0x00010000, 64 * 1024 },
	{ 0x00020000, 128 * 1024 },
	{ 0x00040000, 128 * 1024 },
	{ 0x00060000, 128 * 1024 },
	{ 0x00080000, 128 * 1024 },
	{ 0x000a0000, 128 * 1024 },
	{ 0x000c0000, 128 * 1024 },
	{ 0x000e0000, 128 * 1024 },
	{ 0, 0 },
};
#else
static struct nffs_area_desc nffs_selftest_area_descs[] = {
	{ 0x00020000, 2 * 4096 },
	{ 0x00022000, 2 * 4096 },
	{ 0x00024000, 2 * 4096 },
	{ 0x00026000, 2 * 4096 },
	{ 0x00028000, 2 * 4096 },
	{ 0x0002a000, 2 * 4096 },
	{ 0x0002c000, 2 * 4096 },
	{ 0x00030000, 2 * 4096 },
	{ 0x00032000, 2 * 4096 },
	{ 0x00034000, 2 * 4096 },
	{ 0x00036000, 2 * 4096 },
	{ 0x00038000, 2 * 4096 },
	{ 0, 0 },
};
#endif

static struct nffs_area_desc *save_area_descs;

static void test_setup(void)
{
	save_area_descs = nffs_current_area_descs;
	nffs_current_area_descs = nffs_selftest_area_descs;
}

static void test_teardown(void)
{
	nffs_current_area_descs = save_area_descs;
}

void test_main(void)
{
#ifdef TEST_basic
	ztest_test_suite(nffs_fs_basic_test,
		ztest_unit_test_setup_teardown(test_fs_mount,
					       test_setup, test_teardown),
		ztest_unit_test_setup_teardown(test_unlink,
					       test_setup, test_teardown),
		ztest_unit_test_setup_teardown(test_mkdir,
					       test_setup, test_teardown),
		ztest_unit_test_setup_teardown(test_rename,
					       test_setup, test_teardown),
		ztest_unit_test_setup_teardown(test_append,
					       test_setup, test_teardown),
		ztest_unit_test_setup_teardown(test_read,
					       test_setup, test_teardown),
		ztest_unit_test_setup_teardown(test_open,
					       test_setup, test_teardown),
		ztest_unit_test_setup_teardown(test_overwrite_one,
					       test_setup, test_teardown),
		ztest_unit_test_setup_teardown(test_overwrite_two,
					       test_setup, test_teardown),
		ztest_unit_test_setup_teardown(test_overwrite_three,
					       test_setup, test_teardown),
		ztest_unit_test_setup_teardown(test_overwrite_many,
					       test_setup, test_teardown),
		ztest_unit_test_setup_teardown(test_long_filename,
					       test_setup, test_teardown),
		ztest_unit_test_setup_teardown(test_large_write,
					       test_setup, test_teardown),
		ztest_unit_test_setup_teardown(test_many_children,
					       test_setup, test_teardown),
		ztest_unit_test_setup_teardown(test_gc,
					       test_setup, test_teardown),
		ztest_unit_test_setup_teardown(test_wear_level,
					       test_setup, test_teardown),
		ztest_unit_test_setup_teardown(test_corrupt_scratch,
					       test_setup, test_teardown),
		ztest_unit_test_setup_teardown(test_incomplete_block,
					       test_setup, test_teardown),
		ztest_unit_test_setup_teardown(test_corrupt_block,
					       test_setup, test_teardown),
		ztest_unit_test_setup_teardown(test_lost_found,
					       test_setup, test_teardown),
		ztest_unit_test_setup_teardown(test_readdir,
					       test_setup, test_teardown),
		ztest_unit_test_setup_teardown(test_split_file,
					       test_setup, test_teardown),
		ztest_unit_test_setup_teardown(test_gc_on_oom,
					       test_setup, test_teardown));
	ztest_run_test_suite(nffs_fs_basic_test);
#endif

#ifdef TEST_large
	ztest_test_suite(nffs_fs_large_test,
		ztest_unit_test_setup_teardown(test_fs_mount,
					       test_setup, test_teardown),
		ztest_unit_test_setup_teardown(test_large_unlink,
					       test_setup, test_teardown),
		ztest_unit_test_setup_teardown(test_large_system,
					       test_setup, test_teardown));
	ztest_run_test_suite(nffs_fs_large_test);
#endif

#ifdef TEST_cache
	ztest_test_suite(nffs_fs_cache_test,
		ztest_unit_test_setup_teardown(test_fs_mount,
					       test_setup, test_teardown),
		ztest_unit_test_setup_teardown(test_cache_large_file,
					       test_setup, test_teardown));
	ztest_run_test_suite(nffs_fs_cache_test);
#endif

#ifdef TEST_performance
	ztest_test_suite(nffs_fs_performace_test,
		ztest_unit_test_setup_teardown(test_fs_mount,
					       test_setup, test_teardown),
		ztest_unit_test_setup_teardown(test_performance,
					       test_setup, test_teardown));
	ztest_run_test_suite(nffs_fs_performace_test);
#endif
}
```

## src/nffs_test_utils.c
```c
/*
 * Licensed to the Apache Software Foundation (ASF) under one
 * or more contributor license agreements.  See the NOTICE file
 * distributed with this work for additional information
 * regarding copyright ownership.  The ASF licenses this file
 * to you under the Apache License, Version 2.0 (the
 * "License"); you may not use this file except in compliance
 * with the License.  You may obtain a copy of the License at
 *
 *  http://www.apache.org/licenses/LICENSE-2.0
 *
 * Unless required by applicable law or agreed to in writing,
 * software distributed under the License is distributed on an
 * "AS IS" BASIS, WITHOUT WARRANTIES OR CONDITIONS OF ANY
 * KIND, either express or implied.  See the License for the
 * specific language governing permissions and limitations
 * under the License.
 */

/*
 * SPDX-License-Identifier: Apache-2.0
 */

#include <stdio.h>
#include <stdint.h>
#include <string.h>
#include <fs.h>
#include <nffs/queue.h>
#include <nffs/nffs.h>
#include <nffs/os.h>
#include <flash.h>
#include <ztest_assert.h>
#include "nffs_test_utils.h"

/*
 * This should fit the largest area used in test (128K).
 */
#define AREA_BUF_MAX_SIZE (128 * 1024)
static u8_t area_buf[AREA_BUF_MAX_SIZE];

#define NFFS_TEST_BUF_SIZE (24 * 1024)
u8_t nffs_test_buf[NFFS_TEST_BUF_SIZE];

void nffs_test_util_overwrite_data(u8_t *data, u32_t data_len,
				   u32_t addr)
{
	struct device *dev;
	struct flash_pages_info info;
	off_t off;

	dev = device_get_binding(CONFIG_FS_NFFS_FLASH_DEV_NAME);
	flash_get_page_info_by_offs(dev, addr, &info);

	nffs_os_flash_read(0, info.start_offset, area_buf, info.size);

	/*
	 * To make this simpler, assume we always overwrite within sector
	 *  boundary (which is the case here).
	 */
	off = addr - info.start_offset;
	memcpy(&area_buf[off], data, data_len);

	nffs_os_flash_erase(0, info.start_offset, info.size);
	nffs_os_flash_write(0, info.start_offset, area_buf, info.size);
}

void nffs_test_util_assert_ent_name(struct fs_dirent *fs_dirent,
				    const char *expected_name)
{
	zassert_equal(strcmp(fs_dirent->name, expected_name), 0, NULL);
}

void nffs_test_util_assert_file_len(struct nffs_file *file, u32_t expected)
{
	u32_t len;
	int rc;

	rc = nffs_inode_data_len(file->nf_inode_entry, &len);
	zassert_equal(rc, 0, NULL);
	zassert_equal(len, expected, NULL);
}

void nffs_test_util_assert_cache_is_sane(const char *filename)
{
	struct nffs_cache_inode *cache_inode;
	struct nffs_cache_block *cache_block;
	struct nffs_file *file;
	struct fs_file_t fs_file;
	u32_t cache_start;
	u32_t cache_end;
	u32_t block_end;
	int rc;

	rc = fs_open(&fs_file, filename);
	zassert_equal(rc, 0, NULL);

	file = fs_file.filep;
	rc = nffs_cache_inode_ensure(&cache_inode, file->nf_inode_entry);
	zassert_equal(rc, 0, NULL);

	nffs_cache_inode_range(cache_inode, &cache_start, &cache_end);

	if (TAILQ_EMPTY(&cache_inode->nci_block_list)) {
		zassert_equal(cache_start, 0, NULL);
		zassert_equal(cache_end, 0, NULL);
	} else {
		block_end = 0;  /* Pacify gcc. */
		TAILQ_FOREACH(cache_block, &cache_inode->nci_block_list,
			      ncb_link) {
			if (cache_block ==
					TAILQ_FIRST(&cache_inode->nci_block_list)) {
				zassert_equal(cache_block->ncb_file_offset,
						cache_start, NULL);
			} else {
				/* Ensure no gap between this block and its
				 * predecessor.
				 */
				zassert_equal(cache_block->ncb_file_offset,
						block_end, NULL);
			}

			block_end = cache_block->ncb_file_offset +
					cache_block->ncb_block.nb_data_len;
			if (cache_block == TAILQ_LAST(&cache_inode->nci_block_list,
					nffs_cache_block_list)) {
				zassert_equal(block_end, cache_end, NULL);
			}
		}
	}

	rc = fs_close(&fs_file);
	zassert_equal(rc, 0, NULL);
}

void
nffs_test_util_assert_contents(const char *filename, const char *contents,
			       int contents_len)
{
	struct fs_file_t file;
	u32_t bytes_read;
	void *buf;
	int rc;

	rc = fs_open(&file, filename);
	zassert_equal(rc, 0, NULL);

	zassert_true(contents_len <= AREA_BUF_MAX_SIZE, "contents too large");
	buf = area_buf;

	bytes_read = fs_read(&file, buf, contents_len);
	zassert_equal(bytes_read, contents_len, NULL);
	zassert_equal(memcmp(buf, contents, contents_len), 0, NULL);

	rc = fs_close(&file);
	zassert_equal(rc, 0, NULL);

	nffs_test_util_assert_cache_is_sane(filename);
}

int nffs_test_util_block_count(const char *filename)
{
	struct nffs_hash_entry *entry;
	struct nffs_block block;
	struct nffs_file *file;
	struct fs_file_t fs_file;
	int count;
	int rc;

	rc = fs_open(&fs_file, filename);
	zassert_equal(rc, 0, NULL);

	file = fs_file.filep;
	count = 0;
	entry = file->nf_inode_entry->nie_last_block_entry;
	while (entry != NULL) {
		count++;
		rc = nffs_block_from_hash_entry(&block, entry);
		zassert_equal(rc, 0, NULL);
		zassert_not_equal(block.nb_prev, entry, NULL);
		entry = block.nb_prev;
	}

	rc = fs_close(&fs_file);
	zassert_equal(rc, 0, NULL);

	return count;
}

void nffs_test_util_assert_block_count(const char *filename, int expected_count)
{
	int actual_count;

	actual_count = nffs_test_util_block_count(filename);
	zassert_equal(actual_count, expected_count, NULL);
}

void nffs_test_util_assert_cache_range(const char *filename,
				       u32_t expected_cache_start,
				       u32_t expected_cache_end)
{
	struct nffs_cache_inode *cache_inode;
	struct nffs_file *file;
	struct fs_file_t fs_file;
	u32_t cache_start;
	u32_t cache_end;
	int rc;

	rc = fs_open(&fs_file, filename);
	zassert_equal(rc, 0, NULL);

	file = fs_file.filep;
	rc = nffs_cache_inode_ensure(&cache_inode, file->nf_inode_entry);
	zassert_equal(rc, 0, NULL);

	nffs_cache_inode_range(cache_inode, &cache_start, &cache_end);
	zassert_equal(cache_start, expected_cache_start, NULL);
	zassert_equal(cache_end, expected_cache_end, NULL);

	rc = fs_close(&fs_file);
	zassert_equal(rc, 0, NULL);

	nffs_test_util_assert_cache_is_sane(filename);
}

void nffs_test_util_create_file_blocks(const char *filename,
				       const struct nffs_test_block_desc *blocks,
				       int num_blocks)
{
	struct fs_file_t file;
	u32_t total_len;
	u32_t offset;
	char *buf;
	int num_writes;
	int rc;
	int i;

	/* We do not have 'truncate' flag in fs_open, so unlink here instead */
	fs_unlink(filename);

	rc = fs_open(&file, filename);
	zassert_equal(rc, 0, NULL);

	total_len = 0;
	if (num_blocks <= 0) {
		num_writes = 1;
	} else {
		num_writes = num_blocks;
	}
	for (i = 0; i < num_writes; i++) {
		rc = fs_write(&file, blocks[i].data, blocks[i].data_len);
		zassert_equal(rc, blocks[i].data_len, NULL);

		total_len += blocks[i].data_len;
	}

	rc = fs_close(&file);
	zassert_equal(rc, 0, NULL);

	zassert_true(total_len <= AREA_BUF_MAX_SIZE, "contents too large");
	buf = area_buf;

	offset = 0;
	for (i = 0; i < num_writes; i++) {
		memcpy(buf + offset, blocks[i].data, blocks[i].data_len);
		offset += blocks[i].data_len;
	}
	zassert_equal(offset, total_len, NULL);

	nffs_test_util_assert_contents(filename, buf, total_len);
	if (num_blocks > 0) {
		nffs_test_util_assert_block_count(filename, num_blocks);
	}
}

void nffs_test_util_create_file(const char *filename, const char *contents,
				int contents_len)
{
	struct nffs_test_block_desc block;

	block.data = contents;
	block.data_len = contents_len;

	nffs_test_util_create_file_blocks(filename, &block, 0);
}

void nffs_test_util_append_file(const char *filename, const char *contents,
				int contents_len)
{
	struct fs_file_t file;
	int rc;

	rc = fs_open(&file, filename);
	zassert_equal(rc, 0, NULL);

	rc = fs_seek(&file, 0, FS_SEEK_END);
	zassert_equal(rc, 0, NULL);

	rc = fs_write(&file, contents, contents_len);
	zassert_equal(rc, contents_len, NULL);

	rc = fs_close(&file);
	zassert_equal(rc, 0, NULL);
}

void nffs_test_copy_area(const struct nffs_area_desc *from,
			 const struct nffs_area_desc *to)
{
	int rc;
	void *buf;

	zassert_equal(from->nad_length, to->nad_length, NULL);

	zassert_true(from->nad_length <= AREA_BUF_MAX_SIZE, "area too large");
	buf = area_buf;

	rc = nffs_os_flash_read(from->nad_flash_id, from->nad_offset, buf,
			from->nad_length);
	zassert_equal(rc, 0, NULL);

	rc = nffs_os_flash_erase(from->nad_flash_id, to->nad_offset,
			to->nad_length);
	zassert_equal(rc, 0, NULL);

	rc = nffs_os_flash_write(to->nad_flash_id, to->nad_offset, buf,
			to->nad_length);
	zassert_equal(rc, 0, NULL);
}

void nffs_test_util_create_subtree(const char *parent_path,
				   const struct nffs_test_file_desc *elem)
{
	char *path;
	int rc;
	int i;

	if (parent_path == NULL) {
		path = k_malloc(1);
		zassert_not_null(path, NULL);
		path[0] = '\0';
	} else {
		path = k_malloc(strlen(parent_path) + strlen(elem->filename) + 2);
		zassert_not_null(path, NULL);

		sprintf(path, "%s/%s", parent_path, elem->filename);
	}

	if (elem->is_dir) {
		if ((parent_path != NULL) &&
				(strlen(parent_path) > strlen(NFFS_MNTP))) {
			rc = fs_mkdir(path);
			zassert_equal(rc, 0, NULL);
		}

		if (elem->children != NULL) {
			for (i = 0; elem->children[i].filename != NULL; i++) {
				nffs_test_util_create_subtree(path,
						elem->children + i);
			}
		}
	} else {
		nffs_test_util_create_file(path, elem->contents,
				elem->contents_len);
	}

	k_free(path);
}

void nffs_test_util_create_tree(const struct nffs_test_file_desc *root_dir)
{
	nffs_test_util_create_subtree(NFFS_MNTP, root_dir);
}

#define NFFS_TEST_TOUCHED_ARR_SZ     (16 * 64)
/*#define NFFS_TEST_TOUCHED_ARR_SZ     (16 * 1024)*/
struct nffs_hash_entry
*nffs_test_touched_entries[NFFS_TEST_TOUCHED_ARR_SZ];
int nffs_test_num_touched_entries;

/* Recursively descend directory structure */
void nffs_test_assert_file(const struct nffs_test_file_desc *file,
			   struct nffs_inode_entry *inode_entry,
			   const char *path)
{
	const struct nffs_test_file_desc *child_file;
	struct nffs_inode inode;
	struct nffs_inode_entry *child_inode_entry;
	char *child_path, *abs_path;
	int child_filename_len;
	int path_len;
	int rc;

	/*
	 * track of hash entries that have been examined
	 */
	zassert_true(nffs_test_num_touched_entries < NFFS_TEST_TOUCHED_ARR_SZ,
		     NULL);
	nffs_test_touched_entries[nffs_test_num_touched_entries] =
			&inode_entry->nie_hash_entry;
	nffs_test_num_touched_entries++;

	path_len = strlen(path);

	rc = nffs_inode_from_entry(&inode, inode_entry);
	zassert_equal(rc, 0, NULL);

	/* recursively examine each child of directory */
	if (nffs_hash_id_is_dir(inode_entry->nie_hash_entry.nhe_id)) {
		for (child_file = file->children;
				child_file != NULL && child_file->filename != NULL;
				child_file++) {

			/*
			 * Construct full pathname for file
			 * Not null terminated
			 */
			child_filename_len = strlen(child_file->filename);
			child_path = k_malloc(path_len + child_filename_len + 2);
			zassert_not_null(child_path, NULL);
			memcpy(child_path, path, path_len);
			child_path[path_len] = '/';
			memcpy(child_path + path_len + 1, child_file->filename,
			       child_filename_len);
			child_path[path_len + 1 + child_filename_len] = '\0';

			/*
			 * Verify child inode can be found using full pathname
			 */
			rc = nffs_path_find_inode_entry(child_path,
					&child_inode_entry);
			zassert_equal(rc, 0, NULL);

			nffs_test_assert_file(child_file, child_inode_entry,
					      child_path);

			k_free(child_path);
		}
	} else {
		abs_path = k_malloc(strlen(NFFS_MNTP) + path_len + 2);
		sprintf(abs_path, "%s%s", NFFS_MNTP, path);
		nffs_test_util_assert_contents(abs_path, file->contents,
				file->contents_len);
		k_free(abs_path);
	}
}

void nffs_test_assert_branch_touched(struct nffs_inode_entry *inode_entry)
{
	struct nffs_inode_entry *child;
	int i;

	if (inode_entry == nffs_lost_found_dir) {
		return;
	}

	for (i = 0; i < nffs_test_num_touched_entries; i++) {
		if (nffs_test_touched_entries[i] == &inode_entry->nie_hash_entry) {
			break;
		}
	}
	zassert_true(i < nffs_test_num_touched_entries, NULL);
	nffs_test_touched_entries[i] = NULL;

	if (nffs_hash_id_is_dir(inode_entry->nie_hash_entry.nhe_id)) {
		SLIST_FOREACH(child, &inode_entry->nie_child_list,
				nie_sibling_next) {
			nffs_test_assert_branch_touched(child);
		}
	}
}

void nffs_test_assert_child_inode_present(struct nffs_inode_entry *child)
{
	const struct nffs_inode_entry *inode_entry;
	const struct nffs_inode_entry *parent;
	struct nffs_inode inode;
	int rc;

	/*
	 * Successfully read inode data from flash
	 */
	rc = nffs_inode_from_entry(&inode, child);
	zassert_equal(rc, 0, NULL);

	/*
	 * Validate parent
	 */
	parent = inode.ni_parent;
	zassert_not_null(parent, NULL);
	zassert_true(nffs_hash_id_is_dir(parent->nie_hash_entry.nhe_id), NULL);

	/*
	 * Make sure inode is in parents child list
	 */
	SLIST_FOREACH(inode_entry, &parent->nie_child_list, nie_sibling_next) {
		if (inode_entry == child) {
			return;
		}
	}

	zassert_true(0, NULL);
}

void nffs_test_assert_block_present(struct nffs_hash_entry *block_entry)
{
	const struct nffs_inode_entry *inode_entry;
	struct nffs_hash_entry *cur;
	struct nffs_block block;
	int rc;

	/*
	 * Successfully read block data from flash
	 */
	rc = nffs_block_from_hash_entry(&block, block_entry);
	zassert_equal(rc, 0, NULL);

	/*
	 * Validate owning inode
	 */
	inode_entry = block.nb_inode_entry;
	zassert_not_null(inode_entry, NULL);
	zassert_true(nffs_hash_id_is_file(inode_entry->nie_hash_entry.nhe_id),
		     NULL);

	/*
	 * Validate that block is in owning inode's block chain
	 */
	cur = inode_entry->nie_last_block_entry;
	while (cur != NULL) {
		if (cur == block_entry) {
			return;
		}

		rc = nffs_block_from_hash_entry(&block, cur);
		zassert_equal(rc, 0, NULL);
		cur = block.nb_prev;
	}

	zassert_true(0, NULL);
}

/*
 * Recursively verify that the children of each directory are sorted
 * on the directory children linked list by filename length
 */
void nffs_test_assert_children_sorted(struct nffs_inode_entry *inode_entry)
{
	struct nffs_inode_entry *child_entry;
	struct nffs_inode_entry *prev_entry;
	struct nffs_inode child_inode;
	struct nffs_inode prev_inode;
	int cmp;
	int rc;

	prev_entry = NULL;
	SLIST_FOREACH(child_entry, &inode_entry->nie_child_list,
		      nie_sibling_next) {
		rc = nffs_inode_from_entry(&child_inode, child_entry);
		zassert_equal(rc, 0, NULL);

		if (prev_entry != NULL) {
			rc = nffs_inode_from_entry(&prev_inode, prev_entry);
			zassert_equal(rc, 0, NULL);

			rc = nffs_inode_filename_cmp_flash(&prev_inode,
					&child_inode, &cmp);
			zassert_equal(rc, 0, NULL);
			zassert_true(cmp < 0, NULL);
		}

		if (nffs_hash_id_is_dir(child_entry->nie_hash_entry.nhe_id)) {
			nffs_test_assert_children_sorted(child_entry);
		}

		prev_entry = child_entry;
	}
}

void nffs_test_assert_system_once(const struct nffs_test_file_desc *root_dir)
{
	struct nffs_inode_entry *inode_entry;
	struct nffs_hash_entry *entry;
	struct nffs_hash_entry *next;
	int i;

	nffs_test_num_touched_entries = 0;
	nffs_test_assert_file(root_dir, nffs_root_dir, "");
	nffs_test_assert_branch_touched(nffs_root_dir);

	/* Ensure no orphaned inodes or blocks. */
	NFFS_HASH_FOREACH(entry, i, next) {
		zassert_true(entry->nhe_flash_loc != NFFS_FLASH_LOC_NONE, NULL);
		if (nffs_hash_id_is_inode(entry->nhe_id)) {
			inode_entry = (void *)entry;
			zassert_equal(inode_entry->nie_refcnt, 1, NULL);
			if (entry->nhe_id == NFFS_ID_ROOT_DIR) {
				zassert_true(inode_entry == nffs_root_dir,
						NULL);
			} else {
				nffs_test_assert_child_inode_present(inode_entry);
			}
		} else {
			nffs_test_assert_block_present(entry);
		}
	}

	/* Ensure proper sorting. */
	nffs_test_assert_children_sorted(nffs_root_dir);
}

void nffs_test_assert_system(const struct nffs_test_file_desc *root_dir,
			     const struct nffs_area_desc *area_descs)
{
	int rc;

	/* Ensure files are as specified, and that there are no other files or
	 * orphaned inodes / blocks.
	 */
	nffs_test_assert_system_once(root_dir);

	/* Force a garbage collection cycle. */
	rc = nffs_gc(NULL);
	zassert_equal(rc, 0, NULL);

	/* Ensure file system is still as expected. */
	nffs_test_assert_system_once(root_dir);

	/* Clear cached data and restore from flash (i.e, simulate a reboot). */
	rc = nffs_misc_reset();
	zassert_equal(rc, 0, NULL);
	rc = nffs_restore_full(area_descs);
	zassert_equal(rc, 0, NULL);

	/* Ensure file system is still as expected. */
	nffs_test_assert_system_once(root_dir);
}

void nffs_test_assert_area_seqs(int seq1, int count1, int seq2, int count2)
{
	struct nffs_disk_area disk_area;
	int cur1;
	int cur2;
	int rc;
	int i;

	cur1 = 0;
	cur2 = 0;

	for (i = 0; i < nffs_num_areas; i++) {
		rc = nffs_flash_read(i, 0, &disk_area, sizeof(disk_area));
		zassert_equal(rc, 0, NULL);
		zassert_true(nffs_area_magic_is_set(&disk_area), NULL);
		zassert_equal(disk_area.nda_gc_seq, nffs_areas[i].na_gc_seq,
			      NULL);
		if (i == nffs_scratch_area_idx) {
			zassert_equal(disk_area.nda_id, NFFS_AREA_ID_NONE,
					NULL);
		}

		if (nffs_areas[i].na_gc_seq == seq1) {
			cur1++;
		} else if (nffs_areas[i].na_gc_seq == seq2) {
			cur2++;
		} else {
			zassert_true(0, NULL);
		}
	}

	zassert_equal(cur1, count1, NULL);
	zassert_equal(cur2, count2, NULL);
}
```

## src/nffs_test_utils.h
```c
/*
 * Licensed to the Apache Software Foundation (ASF) under one
 * or more contributor license agreements.  See the NOTICE file
 * distributed with this work for additional information
 * regarding copyright ownership.  The ASF licenses this file
 * to you under the Apache License, Version 2.0 (the
 * "License"); you may not use this file except in compliance
 * with the License.  You may obtain a copy of the License at
 *
 *  http://www.apache.org/licenses/LICENSE-2.0
 *
 * Unless required by applicable law or agreed to in writing,
 * software distributed under the License is distributed on an
 * "AS IS" BASIS, WITHOUT WARRANTIES OR CONDITIONS OF ANY
 * KIND, either express or implied.  See the License for the
 * specific language governing permissions and limitations
 * under the License.
 */

/*
 * SPDX-License-Identifier: Apache-2.0
 */

#ifndef H_NFFS_TEST_UTILS_
#define H_NFFS_TEST_UTILS_

#include <zephyr/types.h>

#ifdef __cplusplus
extern "C" {
#endif

#define NFFS_MNTP	"/nffs"

extern struct nffs_area_desc *nffs_default_area_descs;

struct nffs_test_block_desc {
	const char *data;
	int data_len;
};

struct nffs_test_file_desc {
	const char *filename;
	int is_dir;
	const char *contents;
	int contents_len;
	struct nffs_test_file_desc *children;
};

int nffs_test_num_touched_entries;

extern int flash_native_memset(u32_t offset, uint8_t c, u32_t len);
extern u8_t nffs_test_buf[];

void nffs_test_util_overwrite_data(u8_t *data, u32_t data_len, u32_t addr);
void nffs_test_util_assert_ent_name(struct fs_dirent *dirent,
				    const char *expected_name);
void nffs_test_util_assert_file_len(struct nffs_file *file, u32_t expected);
void nffs_test_util_assert_cache_is_sane(const char *filename);
void nffs_test_util_assert_contents(const char *filename,
				    const char *contents, int contents_len);
int nffs_test_util_block_count(const char *filename);
void nffs_test_util_assert_block_count(const char *filename,
				       int expected_count);
void nffs_test_util_assert_cache_range(const char *filename,
				       u32_t expected_cache_start,
				       u32_t expected_cache_end);
void nffs_test_util_create_file_blocks(const char *filename,
				       const struct nffs_test_block_desc *blocks,
				       int num_blocks);
void nffs_test_util_create_file(const char *filename, const char *contents,
				int contents_len);
void nffs_test_util_append_file(const char *filename, const char *contents,
				int contents_len);
void nffs_test_copy_area(const struct nffs_area_desc *from,
			 const struct nffs_area_desc *to);
void nffs_test_util_create_subtree(const char *parent_path,
				   const struct nffs_test_file_desc *elem);
void nffs_test_util_create_tree(const struct nffs_test_file_desc *root_dir);

/*
 * Recursively descend directory structure
 */
void nffs_test_assert_file(const struct nffs_test_file_desc *file,
			   struct nffs_inode_entry *inode_entry,
			   const char *path);
void nffs_test_assert_branch_touched(struct nffs_inode_entry *inode_entry);
void nffs_test_assert_child_inode_present(struct nffs_inode_entry *child);
void nffs_test_assert_block_present(struct nffs_hash_entry *block_entry);
/*
 * Recursively verify that the children of each directory are sorted
 * on the directory children linked list by filename length
 */
void nffs_test_assert_children_sorted(struct nffs_inode_entry *inode_entry);
void nffs_test_assert_system_once(const struct nffs_test_file_desc *root_dir);
void nffs_test_assert_system(const struct nffs_test_file_desc *root_dir,
			     const struct nffs_area_desc *area_descs);
void nffs_test_assert_area_seqs(int seq1, int count1, int seq2, int count2);

#ifdef __cplusplus
}
#endif

#endif /* H_NFFS_TEST_UTILS_ */
```

## src/test_append.c
```c
/*
 * Licensed to the Apache Software Foundation (ASF) under one
 * or more contributor license agreements.  See the NOTICE &file
 * distributed with this work for additional information
 * regarding copyright ownership.  The ASF licenses this file
 * to you under the Apache License, Version 2.0 (the
 * "License"); you may not use this file except in compliance
 * with the License.  You may obtain a copy of the License at
 *
 *  http://www.apache.org/licenses/LICENSE-2.0
 *
 * Unless required by applicable law or agreed to in writing,
 * software distributed under the License is distributed on an
 * "AS IS" BASIS, WITHOUT WARRANTIES OR CONDITIONS OF ANY
 * KIND, either express or implied.  See the License for the
 * specific language governing permissions and limitations
 * under the License.
 */

/*
 * SPDX-License-Identifier: Apache-2.0
 */

#include <stdint.h>
#include <nffs/nffs.h>
#include <fs.h>
#include "nffs_test_utils.h"
#include <ztest_assert.h>

void test_append(void)
{
	struct fs_file_t file;
	struct nffs_file *nffs_file;
	struct fs_dirent info;
	char c;
	int rc;
	int i;

	static const struct nffs_area_desc area_descs_append[] = {
		{ 0x00000000 + TEST_FLASH_OFFSET, 128 * 1024 },
		{ 0x00020000 + TEST_FLASH_OFFSET, 128 * 1024 },
		{ 0, 0 },
	};

	rc = nffs_format_full(area_descs_append);
	zassert_equal(rc, 0, "cannot format to nffs");

	rc = fs_open(&file, NFFS_MNTP"/myfile.txt");
	zassert_equal(rc, 0, "cannot open file");
	nffs_file = file.filep;
	nffs_test_util_assert_file_len(nffs_file, 0);
	zassert_equal(fs_tell(&file), 0, "invalid file length");

	rc = fs_write(&file, "abcdefgh", 8);
	nffs_test_util_assert_file_len(nffs_file, 8);
	zassert_equal(fs_tell(&file), 8, "invalid file size");
	rc = fs_close(&file);
	zassert_equal(rc, 0, "cannot close file");

	nffs_test_util_assert_contents(NFFS_MNTP"/myfile.txt", "abcdefgh", 8);
	rc = fs_open(&file, NFFS_MNTP"/myfile.txt");
	zassert_equal(rc, 0, "cannot open file");
	rc = fs_seek(&file, 0, FS_SEEK_END);
	zassert_equal(rc, 0, "cannot seek file");
	nffs_test_util_assert_file_len(nffs_file, 8);
	zassert_equal(fs_tell(&file), 8, "invalid file length");

	/*
	 * File position should always be at the end of a file after an append.
	 * Seek to the middle prior to writing to test this.
	 */
	rc = fs_seek(&file, 2, FS_SEEK_SET);
	zassert_equal(rc, 0, "cannot set position");
	nffs_test_util_assert_file_len(nffs_file, 8);
	zassert_equal(fs_tell(&file), 2, "invalid file length");

	rc = fs_seek(&file, 0, FS_SEEK_END);
	zassert_equal(rc, 0, "cannot seek file");
	rc = fs_write(&file, "ijklmnop", 8);
	nffs_test_util_assert_file_len(nffs_file, 16);
	zassert_equal(fs_tell(&file), 16, "invalid file length");
	rc = fs_write(&file, "qrstuvwx", 8);
	nffs_test_util_assert_file_len(nffs_file, 24);
	zassert_equal(fs_tell(&file), 24, "invalid file length");
	rc = fs_close(&file);
	zassert_equal(rc, 0, "cannot close file");

	nffs_test_util_assert_contents(NFFS_MNTP"/myfile.txt",
						"abcdefghijklmnopqrstuvwx", 24);

	rc = fs_mkdir(NFFS_MNTP"/mydir");
	zassert_equal(rc, 0, "cannot create directory");
	rc = fs_open(&file, NFFS_MNTP"/mydir/gaga.txt");
	zassert_equal(rc, 0, "cannot open file");

	/*** Repeated appends to a large file. */
	for (i = 0; i < 1000; i++) {
		fs_stat(NFFS_MNTP"/mydir/gaga.txt", &info);
		zassert_equal(info.size, i, "file lengths not matching");

		c = '0' + i % 10;
		rc = fs_write(&file, &c, 1);
	}

	rc = fs_close(&file);
	zassert_equal(rc, 0, "cannot close file");

	nffs_test_util_assert_contents(NFFS_MNTP"/mydir/gaga.txt",
	"01234567890123456789012345678901234567890123456789" /* 1 */
	"01234567890123456789012345678901234567890123456789" /* 2 */
	"01234567890123456789012345678901234567890123456789" /* 3 */
	"01234567890123456789012345678901234567890123456789" /* 4 */
	"01234567890123456789012345678901234567890123456789" /* 5 */
	"01234567890123456789012345678901234567890123456789" /* 6 */
	"01234567890123456789012345678901234567890123456789" /* 7 */
	"01234567890123456789012345678901234567890123456789" /* 8 */
	"01234567890123456789012345678901234567890123456789" /* 9 */
	"01234567890123456789012345678901234567890123456789" /* 10 */
	"01234567890123456789012345678901234567890123456789" /* 11 */
	"01234567890123456789012345678901234567890123456789" /* 12 */
	"01234567890123456789012345678901234567890123456789" /* 13 */
	"01234567890123456789012345678901234567890123456789" /* 14 */
	"01234567890123456789012345678901234567890123456789" /* 15 */
	"01234567890123456789012345678901234567890123456789" /* 16 */
	"01234567890123456789012345678901234567890123456789" /* 17 */
	"01234567890123456789012345678901234567890123456789" /* 18 */
	"01234567890123456789012345678901234567890123456789" /* 19 */
	"01234567890123456789012345678901234567890123456789" /* 20 */
	,
	1000);

	struct nffs_test_file_desc *expected_system =
		(struct nffs_test_file_desc[]) { {
			.filename = "",
			.is_dir = 1,
			.children = (struct nffs_test_file_desc[]) { {
				.filename = "myfile.txt",
				.contents = "abcdefghijklmnopqrstuvwx",
				.contents_len = 24,
			}, {
				.filename = "mydir",
				.is_dir = 1,
				.children = (struct nffs_test_file_desc[]) { {
					.filename = "gaga.txt",
					.contents =
					"01234567890123456789012345678901234567890123456789"
					"01234567890123456789012345678901234567890123456789"
					"01234567890123456789012345678901234567890123456789"
					"01234567890123456789012345678901234567890123456789"
					"01234567890123456789012345678901234567890123456789"
					"01234567890123456789012345678901234567890123456789"
					"01234567890123456789012345678901234567890123456789"
					"01234567890123456789012345678901234567890123456789"
					"01234567890123456789012345678901234567890123456789"
					"01234567890123456789012345678901234567890123456789"
					"01234567890123456789012345678901234567890123456789"
					"01234567890123456789012345678901234567890123456789"
					"01234567890123456789012345678901234567890123456789"
					"01234567890123456789012345678901234567890123456789"
					"01234567890123456789012345678901234567890123456789"
					"01234567890123456789012345678901234567890123456789"
					"01234567890123456789012345678901234567890123456789"
					"01234567890123456789012345678901234567890123456789"
					"01234567890123456789012345678901234567890123456789"
					"01234567890123456789012345678901234567890123456789"
					,
					.contents_len = 1000,
				}, {
					.filename = NULL,
				} },
			}, {
				.filename = NULL,
			} },
		} };
	nffs_test_assert_system(expected_system, nffs_current_area_descs);
}
```

## src/test_cache_large_file.c
```c
/*
 * Licensed to the Apache Software Foundation (ASF) under one
 * or more contributor license agreements.  See the NOTICE file
 * distributed with this work for additional information
 * regarding copyright ownership.  The ASF licenses this file
 * to you under the Apache License, Version 2.0 (the
 * "License"); you may not use this file except in compliance
 * with the License.  You may obtain a copy of the License at
 *
 *  http://www.apache.org/licenses/LICENSE-2.0
 *
 * Unless required by applicable law or agreed to in writing,
 * software distributed under the License is distributed on an
 * "AS IS" BASIS, WITHOUT WARRANTIES OR CONDITIONS OF ANY
 * KIND, either express or implied.  See the License for the
 * specific language governing permissions and limitations
 * under the License.
 */

/*
 * SPDX-License-Identifier: Apache-2.0
 */

#include <stdint.h>
#include <nffs/nffs.h>
#include <fs.h>
#include "nffs_test_utils.h"
#include <ztest_assert.h>

void test_cache_large_file(void)
{
	struct fs_file_t file;
	u8_t b;
	int rc;

	/*** Setup. */
	rc = nffs_format_full(nffs_current_area_descs);
	zassert_equal(rc, 0, "canot format nffs");

	nffs_test_util_create_file(NFFS_MNTP"/myfile.txt", nffs_test_buf,
						NFFS_BLOCK_MAX_DATA_SZ_MAX * 5);
	nffs_cache_clear();

	/* Opening a file should not cause any blocks to get cached. */
	rc = fs_open(&file, NFFS_MNTP"/myfile.txt");
	zassert_equal(rc, 0, "cannot open file");
	nffs_test_util_assert_cache_range(NFFS_MNTP"/myfile.txt", 0, 0);

	/* Cache first block. */
	rc = fs_seek(&file, nffs_block_max_data_sz * 0, FS_SEEK_SET);
	zassert_equal(rc, 0, "cannot set pos in file");
	rc = fs_read(&file, &b, 1);
	zassert_equal(rc, 1, "cannot read file");
	nffs_test_util_assert_cache_range(NFFS_MNTP"/myfile.txt",
						nffs_block_max_data_sz * 0,
						nffs_block_max_data_sz * 1);

	/* Cache second block. */
	rc = fs_seek(&file, nffs_block_max_data_sz * 1, FS_SEEK_SET);
	zassert_equal(rc, 0, "cannot set pos in file");
	rc = fs_read(&file, &b, 1);
	zassert_equal(rc, 1, "cannot read file");
	nffs_test_util_assert_cache_range(NFFS_MNTP"/myfile.txt",
						nffs_block_max_data_sz * 0,
						nffs_block_max_data_sz * 2);


	/* Cache fourth block; prior cache should get erased. */
	rc = fs_seek(&file, nffs_block_max_data_sz * 3, FS_SEEK_SET);
	zassert_equal(rc, 0, "cannot set pos in file");
	rc = fs_read(&file, &b, 1);
	zassert_equal(rc, 1, "cannot read file");
	nffs_test_util_assert_cache_range(NFFS_MNTP"/myfile.txt",
						nffs_block_max_data_sz * 3,
						nffs_block_max_data_sz * 4);

	/* Cache second and third blocks. */
	rc = fs_seek(&file, nffs_block_max_data_sz * 1, FS_SEEK_SET);
	zassert_equal(rc, 0, "cannot set pos in file");
	rc = fs_read(&file, &b, 1);
	zassert_equal(rc, 1, "cannot read file");
	nffs_test_util_assert_cache_range(NFFS_MNTP"/myfile.txt",
						nffs_block_max_data_sz * 1,
						nffs_block_max_data_sz * 4);

	/* Cache fifth block. */
	rc = fs_seek(&file, nffs_block_max_data_sz * 4, FS_SEEK_SET);
	zassert_equal(rc, 0, "cannot set pos in file");
	rc = fs_read(&file, &b, 1);
	zassert_equal(rc, 1, "cannot read file");
	nffs_test_util_assert_cache_range(NFFS_MNTP"/myfile.txt",
						nffs_block_max_data_sz * 1,
						nffs_block_max_data_sz * 5);

	rc = fs_close(&file);
	zassert_equal(rc, 0, "cannot close file");
}
```

## src/test_corrupt_block.c
```c
/*
 * Licensed to the Apache Software Foundation (ASF) under one
 * or more contributor license agreements.  See the NOTICE file
 * distributed with this work for additional information
 * regarding copyright ownership.  The ASF licenses this file
 * to you under the Apache License, Version 2.0 (the
 * "License"); you may not use this file except in compliance
 * with the License.  You may obtain a copy of the License at
 *
 *  http://www.apache.org/licenses/LICENSE-2.0
 *
 * Unless required by applicable law or agreed to in writing,
 * software distributed under the License is distributed on an
 * "AS IS" BASIS, WITHOUT WARRANTIES OR CONDITIONS OF ANY
 * KIND, either express or implied.  See the License for the
 * specific language governing permissions and limitations
 * under the License.
 */

/*
 * SPDX-License-Identifier: Apache-2.0
 */

#include <stdint.h>
#include <nffs/nffs.h>
#include <nffs/os.h>
#include <fs.h>
#include "nffs_test_utils.h"
#include <ztest.h>
#include <ztest_assert.h>

static u8_t data1[] = {0x43};

void test_corrupt_block(void)
{
	struct fs_file_t fs_file;
	struct nffs_file *file;
	struct nffs_block block;
	u32_t flash_offset;
	u32_t area_offset;
	u8_t area_idx;
	u8_t off;    /* offset to corrupt */
	int rc;
	struct nffs_disk_block ndb;

	/* Setup. */
	rc = nffs_format_full(nffs_current_area_descs);
	zassert_equal(rc, 0, NULL);

	rc = fs_mkdir(NFFS_MNTP"/mydir");
	zassert_equal(rc, 0, "cannot create directory");

	nffs_test_util_create_file(NFFS_MNTP"/mydir/a", "aaaa", 4);
	nffs_test_util_create_file(NFFS_MNTP"/mydir/b", "bbbb", 4);
	nffs_test_util_create_file(NFFS_MNTP"/mydir/c", "cccc", 4);

	/* Add a second block to the 'b' file. */
	nffs_test_util_append_file(NFFS_MNTP"/mydir/b", "1234", 4);

	/* Corrupt the 'b' file; overwrite the second block's magic number. */
	rc = fs_open(&fs_file, NFFS_MNTP"/mydir/b");
	zassert_equal(rc, 0, "cannot open file");

	file = fs_file.nffs_fp;
	rc = nffs_block_from_hash_entry(&block,
				file->nf_inode_entry->nie_last_block_entry);
	zassert_equal(rc, 0, "block from hash entry error");

	nffs_flash_loc_expand(block.nb_hash_entry->nhe_flash_loc, &area_idx,
								&area_offset);
	flash_offset = nffs_areas[area_idx].na_offset + area_offset;

	/*
	 * Overwriting the reserved16 field should invalidate the CRC
	 */
	off = (char *)&ndb.reserved16 - (char *)&ndb;
	nffs_test_util_overwrite_data(data1, sizeof(data1), flash_offset + off);

	zassert_equal(rc, 0, "flash native memset error");

	/*
	 * Write a fourth file. This file should get restored even though the
	 * previous object has an invalid magic number.
	 */
	nffs_test_util_create_file(NFFS_MNTP"/mydir/d", "dddd", 4);

	rc = nffs_misc_reset();
	zassert_equal(rc, 0, "cannot reset nffs");
	rc = nffs_restore_full(nffs_current_area_descs);
	zassert_equal(rc, 0, "cannot detect nffs");

	/*
	 * The entire second block should be removed; the file should only
	 * contain the first block.
	 */
	struct nffs_test_file_desc *expected_system =
	(struct nffs_test_file_desc[]) { {
		.filename = "",
		.is_dir = 1,
		.children = (struct nffs_test_file_desc[]) { {
			.filename = "mydir",
			.is_dir = 1,
			.children = (struct nffs_test_file_desc[]) { {
				.filename = "a",
				.contents = "aaaa",
				.contents_len = 4,
			}, {
				.filename = "c",
				.contents = "cccc",
				.contents_len = 4,
			}, {
				.filename = "d",
				.contents = "dddd",
				.contents_len = 4,
			}, {
				.filename = NULL,
			} },
		}, {
			.filename = NULL,
		} },
	} };

	nffs_test_assert_system(expected_system, nffs_current_area_descs);
}
```

## src/test_corrupt_scratch.c
```c
/*
 * Licensed to the Apache Software Foundation (ASF) under one
 * or more contributor license agreements.  See the NOTICE file
 * distributed with this work for additional information
 * regarding copyright ownership.  The ASF licenses this file
 * to you under the Apache License, Version 2.0 (the
 * "License"); you may not use this file except in compliance
 * with the License.  You may obtain a copy of the License at
 *
 *  http://www.apache.org/licenses/LICENSE-2.0
 *
 * Unless required by applicable law or agreed to in writing,
 * software distributed under the License is distributed on an
 * "AS IS" BASIS, WITHOUT WARRANTIES OR CONDITIONS OF ANY
 * KIND, either express or implied.  See the License for the
 * specific language governing permissions and limitations
 * under the License.
 */

/*
 * SPDX-License-Identifier: Apache-2.0
 */

#include <stdint.h>
#include <nffs/nffs.h>
#include <fs.h>
#include "nffs_test_utils.h"
#include <ztest.h>
#include <ztest_assert.h>

void test_corrupt_scratch(void)
{
	int non_scratch_id;
	int scratch_id;
	int rc;

	static const struct nffs_area_desc area_descs_two[] = {
		{ 0x00020000, 128 * 1024 },
		{ 0x00040000, 128 * 1024 },
		{ 0, 0 },
	};
	nffs_current_area_descs = (struct nffs_area_desc *)area_descs_two;

	/*** Setup. */
	rc = nffs_format_full(area_descs_two);
	zassert_equal(rc, 0, "cannot format file");

	nffs_test_util_create_file("/myfile.txt", "contents", 8);

	/* Copy the current contents of the non-scratch area to the scratch area.
	 * This will make the scratch area look like it only partially
	 * participated in a garbage collection cycle.
	 */
	scratch_id = nffs_scratch_area_idx;
	non_scratch_id = scratch_id ^ 1;
	nffs_test_copy_area(area_descs_two + non_scratch_id,
					area_descs_two + nffs_scratch_area_idx);

	/* Add some more data to the non-scratch area. */
	rc = fs_mkdir("/mydir");
	zassert_equal(rc, 0, "cannot create directory");

	/*
	 * Ensure the file system is successfully detected and valid, despite
	 * corruption.
	 */

	rc = nffs_misc_reset();
	zassert_equal(rc, 0, "cannot reset nffs");

	rc = nffs_restore_full(area_descs_two);
	zassert_equal(rc, 0, "cannot detect nffs");

	zassert_equal(nffs_scratch_area_idx, scratch_id,
		      "scratch index not matching");

	struct nffs_test_file_desc *expected_system =
		(struct nffs_test_file_desc[]) { {
			.filename = "",
			.is_dir = 1,
			.children = (struct nffs_test_file_desc[]) { {
				.filename = "mydir",
				.is_dir = 1,
			}, {
				.filename = "myfile.txt",
				.contents = "contents",
				.contents_len = 8,
			}, {
				.filename = NULL,
			} },
		} };

	nffs_test_assert_system(expected_system, area_descs_two);
}
```

## src/test_gc.c
```c
/*
 * Licensed to the Apache Software Foundation (ASF) under one
 * or more contributor license agreements.  See the NOTICE file
 * distributed with this work for additional information
 * regarding copyright ownership.  The ASF licenses this file
 * to you under the Apache License, Version 2.0 (the
 * "License"); you may not use this file except in compliance
 * with the License.  You may obtain a copy of the License at
 *
 *  http://www.apache.org/licenses/LICENSE-2.0
 *
 * Unless required by applicable law or agreed to in writing,
 * software distributed under the License is distributed on an
 * "AS IS" BASIS, WITHOUT WARRANTIES OR CONDITIONS OF ANY
 * KIND, either express or implied.  See the License for the
 * specific language governing permissions and limitations
 * under the License.
 */

/*
 * SPDX-License-Identifier: Apache-2.0
 */

#include <stdint.h>
#include <nffs/nffs.h>
#include <fs.h>
#include "nffs_test_utils.h"
#include <ztest.h>
#include <ztest_assert.h>

void test_gc(void)
{
	int rc;

	static const struct nffs_area_desc area_descs_two[] = {
		{ 0x00000000 + TEST_FLASH_OFFSET, 128 * 1024 },
		{ 0x00020000 + TEST_FLASH_OFFSET, 128 * 1024 },
		{ 0, 0 },
	};

	struct nffs_test_block_desc blocks[8] = { {
		.data = "1",
		.data_len = 1,
	}, {
		.data = "2",
		.data_len = 1,
	}, {
		.data = "3",
		.data_len = 1,
	}, {
		.data = "4",
		.data_len = 1,
	}, {
		.data = "5",
		.data_len = 1,
	}, {
		.data = "6",
		.data_len = 1,
	}, {
		.data = "7",
		.data_len = 1,
	}, {
		.data = "8",
		.data_len = 1,
	} };


	rc = nffs_format_full(area_descs_two);
	zassert_equal(rc, 0, "cannot format nffs");

	nffs_test_util_create_file_blocks("/myfile.txt", blocks, 8);

	nffs_gc(NULL);

	nffs_test_util_assert_block_count("/myfile.txt", 1);
}
```

## src/test_gc_on_oom.c
```c
/*
 * Licensed to the Apache Software Foundation (ASF) under one
 * or more contributor license agreements.  See the NOTICE file
 * distributed with this work for additional information
 * regarding copyright ownership.  The ASF licenses this file
 * to you under the Apache License, Version 2.0 (the
 * "License"); you may not use this file except in compliance
 * with the License.  You may obtain a copy of the License at
 *
 *  http://www.apache.org/licenses/LICENSE-2.0
 *
 * Unless required by applicable law or agreed to in writing,
 * software distributed under the License is distributed on an
 * "AS IS" BASIS, WITHOUT WARRANTIES OR CONDITIONS OF ANY
 * KIND, either express or implied.  See the License for the
 * specific language governing permissions and limitations
 * under the License.
 */

/*
 * SPDX-License-Identifier: Apache-2.0
 */

#include <stdint.h>
#include <nffs/nffs.h>
#include <fs.h>
#include "nffs_test_utils.h"
#include <ztest.h>
#include <ztest_assert.h>

extern struct k_mem_slab nffs_block_entry_pool;

void test_gc_on_oom(void)
{
	int rc;

	/*** Setup. */
	/* Ensure all areas are the same size. */
	static const struct nffs_area_desc area_descs_two[] = {
		{ 0x00000000 + TEST_FLASH_OFFSET, 16 * 1024 },
		{ 0x00004000 + TEST_FLASH_OFFSET, 16 * 1024 },
		{ 0x00008000 + TEST_FLASH_OFFSET, 16 * 1024 },
		{ 0, 0 },
	};

	rc = nffs_format_full(area_descs_two);
	zassert_equal(rc, 0, "cannot format nffs");

	/* Leak block entries until only four are left. */
	/*
	 * XXX: This is ridiculous.  Need to fix nffs configuration so that the
	 * caller passes a config object rather than writing to a global
	 * variable.
	 */
	while (k_mem_slab_num_free_get(&nffs_block_entry_pool) != 4) {
		nffs_block_entry_alloc();
	}

	/*** Write 4 data blocks. */
	struct nffs_test_block_desc blocks[4] = { {
		.data = "1",
		.data_len = 1,
	}, {
		.data = "2",
		.data_len = 1,
	}, {
		.data = "3",
		.data_len = 1,
	}, {
		.data = "4",
		.data_len = 1,
	} };

	nffs_test_util_create_file_blocks("/myfile.txt", blocks, 4);

	zassert_equal(k_mem_slab_num_free_get(&nffs_block_entry_pool), 0,
							"file blocks problem");

	/* Attempt another one-byte write.  This should trigger a garbage
	 * collection cycle, resulting in the four blocks being collated.  The
	 * fifth write consumes an additional block, resulting in 2 out of 4
	 * blocks in use.
	 */
	nffs_test_util_append_file("/myfile.txt", "5", 1);

	zassert_equal(k_mem_slab_num_free_get(&nffs_block_entry_pool), 2,
							"file blocks problem");

	struct nffs_test_file_desc *expected_system =
		(struct nffs_test_file_desc[]) { {
			.filename = "",
			.is_dir = 1,
			.children = (struct nffs_test_file_desc[]) { {
				.filename = "myfile.txt",
				.contents = "12345",
				.contents_len = 5,
			}, {
				.filename = NULL,
			} },
		} };

	nffs_test_assert_system(expected_system, area_descs_two);
}
```
