/*
 * Copyright 2025 NXP
 *
 * SPDX-License-Identifier: Apache-2.0
 */

/delete-node/ &storage_partition;

&flash0 {
	partitions {
		small_partition: partition@1D800 {
			label = "small";
			reg = <0x0001D800 DT_SIZE_K(128)>;
		};
	};
};
