/*
 * Copyright 2025 NXP
 *
 * SPDX-License-Identifier: Apache-2.0
 */

/delete-node/ &storage_partition;

&w25q32jvwj0 {
	partitions {
		small_partition: partition@3f0000 {
			label = "small";
			reg = <0x003f0000 DT_SIZE_K(64)>;
		};
	};
};
