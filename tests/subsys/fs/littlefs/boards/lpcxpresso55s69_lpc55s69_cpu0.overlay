/*
 * Copyright 2025 NXP
 *
 * SPDX-License-Identifier: Apache-2.0
 */

/delete-node/ &storage_partition;

&flash0 {
	partitions {
		small_partition: partition@75800 {
			reg = <0x00075800 DT_SIZE_K(128)>;
			label = "small";
		};
	};
};
