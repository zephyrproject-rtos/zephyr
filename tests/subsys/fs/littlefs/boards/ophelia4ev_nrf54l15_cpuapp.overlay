/*
 * Copyright (c) 2025 Würth Elektronik eiSos GmbH & Co. KG
 *
 * SPDX-License-Identifier: Apache-2.0
 */

/delete-node/ &slot1_partition;

&cpuapp_rram {
	partitions {
		compatible = "fixed-partitions";
		#address-cells = <1>;
		#size-cells = <1>;

		small_partition: partition@b6000 {
			reg = <0x000b6000 0x00010000>;
			label = "small";
		};
	};
};
