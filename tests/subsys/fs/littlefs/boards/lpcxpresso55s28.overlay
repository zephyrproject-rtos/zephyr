/*
 * Copyright 2025 NXP
 *
 * SPDX-License-Identifier: Apache-2.0
 */

/delete-node/ &storage_partition;

&flash0 {
	partitions {
		small_partition: partition@5D000 {
			label = "small";
			reg = <0x0005D000 DT_SIZE_K(128)>;
		};
	};
};
