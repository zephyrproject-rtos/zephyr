/*
 * Copyright (c) 2024 Nordic Semiconductor ASA
 * Copyright (c) 2025 Ezurio LLC
 *
 * SPDX-License-Identifier: Apache-2.0
 */

/delete-node/ &slot0_ns_partition;
/delete-node/ &slot1_partition;
/delete-node/ &slot1_ns_partition;

&cpuapp_rram {
	partitions {
		compatible = "fixed-partitions";
		#address-cells = <1>;
		#size-cells = <1>;

		small_partition: partition@67000 {
			label = "small";
			reg = <0x00067000 0x00010000>;
		};
	};
};
