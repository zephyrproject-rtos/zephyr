## CMakeLists.txt
```
# SPDX-License-Identifier: Apache-2.0

cmake_minimum_required(VERSION 3.28.0)
find_package(Zephyr REQUIRED HINTS $ENV{ZEPHYR_BASE})
project(fs_api)

FILE(GLOB app_sources src/*.c)
target_sources(app PRIVATE ${app_sources})
```

## prj.conf
```kconfig
CONFIG_FILE_SYSTEM=y
CONFIG_ZTEST=y
CONFIG_FILE_SYSTEM_UTILS=y
CONFIG_HEAP_MEM_POOL_SIZE=4096
```

## app.overlay
```dts
// SPDX-License-Identifier: Apache-2.0

/ {
	test_disk: disk {
		compatible = "zephyr,fstab,fatfs";
		mount-point = "/TEST:";
	};
};
```

## src/main.c
```c
/*
 * Copyright (c) 2016 Intel Corporation.
 *
 * SPDX-License-Identifier: Apache-2.0
 */

#include "test_fs.h"

/**
 * @brief Test file system interface implemented in kernel
 *
 * @defgroup filesystem File System
 *
 * @ingroup all_test
 * @{
 * @}
 */

static void fs_setup(void)
{
	fs_register(TEST_FS_1, &temp_fs);
}

static void dummy_teardown(void)
{
	return;
}

static void dummy_setup(void)
{
	return;
}

static void fs_teardown(void)
{
	fs_unregister(TEST_FS_1, &temp_fs);
}

/**
 * @brief Common file system operations through a general interface
 *
 * @details After register file system:
 *            - mount
 *            - statvfs
 *            - mkdir
 *            - opendir
 *            - readdir
 *            - closedir
 *            - open
 *            - write
 *            - read
 *            - lseek
 *            - tell
 *            - truncate
 *            - sync
 *            - close
 *            - rename
 *            - stat
 *            - unlink
 *            - unmount
 *            - unregister file system
 *          the order of test cases is critical, one case depend on the
 *          case before it.
 *
 * @ingroup filesystem
 *
 */
void test_main(void)
{
	ztest_test_suite(fat_fs_basic_test,
			 ztest_unit_test(test_fs_register),
			 ztest_unit_test_setup_teardown(test_mount,
							fs_setup,
							dummy_teardown),
			 ztest_unit_test(test_fs_file_t_init),
			 ztest_unit_test(test_fs_dir_t_init),
			 ztest_unit_test(test_file_statvfs),
			 ztest_unit_test(test_mkdir),
			 ztest_unit_test(test_opendir),
			 ztest_unit_test(test_closedir),
			 ztest_unit_test(test_opendir_closedir),
			 ztest_unit_test(test_lsdir),
			 ztest_unit_test(test_file_open),
			 ztest_unit_test(test_file_write),
			 ztest_unit_test(test_file_read),
			 ztest_unit_test(test_file_seek),
			 ztest_unit_test(test_file_truncate),
			 ztest_unit_test(test_file_close),
			 ztest_unit_test(test_file_sync),
			 ztest_unit_test(test_file_rename),
			 ztest_unit_test(test_file_stat),
			 ztest_unit_test(test_file_unlink),
			 ztest_unit_test(test_unmount),
			 ztest_unit_test_setup_teardown(test_mount_flags,
							dummy_setup,
							fs_teardown)
			 );
	ztest_run_test_suite(fat_fs_basic_test);
}
```

## src/test_fs.c
```c
/*
 * Copyright (c) 2020 Intel Corporation.
 *
 * SPDX-License-Identifier: Apache-2.0
 */

#include <stdio.h>
#include <string.h>
#include <zephyr/kernel.h>
#include <zephyr/types.h>
#include <errno.h>
#include <zephyr/init.h>
#include <zephyr/fs/fs.h>
#include <zephyr/fs/fs_sys.h>
#include <zephyr/sys/__assert.h>
#include "test_fs.h"

#define BUF_LEN 128
static char buffer[BUF_LEN];
static char *read_pos = buffer;
static char *cur = buffer;
static int file_length;
static struct fs_mount_t *mp[FS_TYPE_EXTERNAL_BASE];
static bool nospace;
static int opendir_result;

static
int temp_open(struct fs_file_t *zfp, const char *file_name, fs_mode_t flags)
{
	if (zfp == NULL || file_name == NULL) {
		return -EINVAL;
	}

	if (zfp->filep) {
		if (strcmp(zfp->filep, file_name) == 0) {
			/* file has been opened */
			return -EEXIST;
		}
	}

	if (!(flags & FS_O_MASK)) {
		return -EINVAL;
	}

	zfp->filep = (char *)file_name;
	return 0;
}

static int temp_close(struct fs_file_t *zfp)
{
	if (zfp == NULL) {
		return -EINVAL;
	}

	if (zfp->filep) {
		zfp->filep = NULL;
	} else {
		return -EIO;
	}

	return 0;
}

static int temp_unlink(struct fs_mount_t *mountp, const char *path)
{
	if (mountp == NULL || path == NULL) {
		return -EINVAL;
	}

	if (strcmp(mountp->mnt_point, path) == 0) {
		return -EPERM;
	}
	return 0;
}

static int temp_rename(struct fs_mount_t *mountp, const char *from,
			const char *to)
{
	if (mountp == NULL || from == NULL || to == NULL) {
		return -EINVAL;
	}

	if (strcmp(to, TEST_FILE_EX) == 0) {
		return -EINVAL;
	}
	return 0;
}

static ssize_t temp_read(struct fs_file_t *zfp, void *ptr, size_t size)
{
	unsigned int br;

	if (zfp == NULL || ptr == NULL) {
		return -EINVAL;
	}

	br = size;
	if (read_pos - buffer + br > file_length) {
		br = file_length - (read_pos - buffer);
	}
	memcpy(ptr, read_pos, br);
	read_pos += br;
	cur = read_pos;

	return br;
}

static ssize_t temp_write(struct fs_file_t *zfp, const void *ptr, size_t size)
{
	unsigned int bw;

	if (zfp == NULL || ptr == NULL) {
		return -EINVAL;
	}

	if (nospace) {
		return -ENOSPC;
	}

	bw = size;
	if (file_length + bw >  BUF_LEN) {
		bw = BUF_LEN - file_length;
		nospace = true;
	}

	memcpy(buffer + file_length, ptr, bw);
	file_length += bw;
	cur = buffer + file_length;

	return bw;
}

static int temp_seek(struct fs_file_t *zfp, off_t offset, int whence)
{

	if (!zfp) {
		return -EINVAL;
	}

	switch (whence) {
	case FS_SEEK_SET:
		cur = buffer + offset;
		break;
	case FS_SEEK_CUR:
		cur += offset;
		break;
	case FS_SEEK_END:
		cur = buffer + file_length + offset;
		break;
	default:
		return -EINVAL;
	}

	if ((cur < buffer) || (cur > buffer + file_length)) {
		return -EINVAL;
	}

	return 0;
}

static off_t temp_tell(struct fs_file_t *zfp)
{
	if (!zfp) {
		return -EINVAL;
	}

	if (nospace) {
		return -ENOSPC;
	}

	return cur - buffer;
}

static int temp_truncate(struct fs_file_t *zfp, off_t length)
{
	if (!zfp) {
		return -EINVAL;
	}

	if (length > BUF_LEN) {
		return -EINVAL;
	}
	file_length = length;
	return 0;
}

static int temp_sync(struct fs_file_t *zfp)
{
	if (!zfp) {
		return -EINVAL;
	}

	if (nospace) {
		return -ENOSPC;
	}

	return 0;
}

static int temp_mkdir(struct fs_mount_t *mountp, const char *path)
{
	if (mountp == NULL || path == NULL) {
		return -EINVAL;
	}

	if (strcmp(mountp->mnt_point, path) == 0) {
		return -EPERM;
	}
	return 0;
}

void mock_opendir_result(int ret)
{
	opendir_result = ret;
}

static int temp_opendir(struct fs_dir_t *zdp, const char *path)
{
	if (zdp == NULL || path == NULL) {
		return -EINVAL;
	}

	if (opendir_result) {
		return opendir_result;
	}

	zdp->dirp = (char *)path;
	return 0;
}

static int i;
static int temp_readdir(struct fs_dir_t *zdp, struct fs_dirent *entry)
{
	if (!zdp) {
		return -EINVAL;
	}

	if (!entry) {
		return -ENOENT;
	}

	switch (i) {
	case 0:
		strcpy(entry->name, ".");
		entry->type = FS_DIR_ENTRY_DIR;
		i++;
		break;
	case 1:
		strcpy(entry->name, "testdir");
		entry->type = FS_DIR_ENTRY_DIR;
		i++;
		break;
	case 2:
		strcpy(entry->name, "test.txt");
		entry->type = FS_DIR_ENTRY_FILE;
		i++;
		break;
	case 3:
		strcpy(entry->name, "..");
		entry->type = FS_DIR_ENTRY_DIR;
		i++;
		break;
	default:
		strcpy(entry->name, "\0");
		i = 0;
		break;
	}
	return 0;
}

static int temp_closedir(struct fs_dir_t *zdp)
{
	if (!zdp) {
		return -EINVAL;
	}

	if (!(zdp->dirp)) {
		return -EIO;
	}
	zdp->dirp = NULL;
	return 0;
}

static int temp_stat(struct fs_mount_t *mountp,
		      const char *path, struct fs_dirent *entry)
{
	if (mountp == NULL || path == NULL || entry == NULL) {
		return -EINVAL;
	}

	return 0;
}

static int temp_statvfs(struct fs_mount_t *mountp,
			 const char *path, struct fs_statvfs *stat)
{
	if (mountp == NULL || path == NULL || stat == NULL) {
		return -EINVAL;
	}

	memset(stat, 0, sizeof(struct fs_statvfs));
	stat->f_bsize = 512;
	return 0;
}

#if defined(CONFIG_FILE_SYSTEM_GETATTR)
static int temp_getattr(struct fs_mount_t *mountp, const char *path, struct fs_attr *attr)
{
	if (mountp == NULL || path == NULL || attr == NULL) {
		return -EINVAL;
	}

	attr->mask = FS_ATTR_MTIME;
	attr->mtime = TEST_MTIME;

	return 0;
}
#endif /* CONFIG_FILE_SYSTEM_GETATTR */

static int temp_mount(struct fs_mount_t *mountp)
{
	if (mountp == NULL) {
		return -EINVAL;
	}

	size_t len = strlen(mountp->mnt_point);

	if (mountp->mnt_point[len - 1] != ':') {
		return -EINVAL;
	}
	mp[mountp->type] = mountp;
	return 0;
}

static int temp_unmount(struct fs_mount_t *mountp)
{
	if (mountp == NULL) {
		return -EINVAL;
	}

	if (mp[mountp->type] == NULL) {
		return -EINVAL;
	}
	mp[mountp->type] = NULL;
	return 0;
}

/* File system interface */
struct fs_file_system_t temp_fs = {
	.open = temp_open,
	.close = temp_close,
	.read = temp_read,
	.write = temp_write,
	.lseek = temp_seek,
	.tell = temp_tell,
	.truncate = temp_truncate,
	.sync = temp_sync,
	.opendir = temp_opendir,
	.readdir = temp_readdir,
	.closedir = temp_closedir,
	.mount = temp_mount,
	.unmount = temp_unmount,
	.unlink = temp_unlink,
	.rename = temp_rename,
	.mkdir = temp_mkdir,
	.stat = temp_stat,
	.statvfs = temp_statvfs,
#if defined(CONFIG_FILE_SYSTEM_GETATTR)
	.getattr = temp_getattr,
#endif
};
```

## src/test_fs.h
```c
/*
 * Copyright (c) 2020 Intel Corporation.
 *
 * SPDX-License-Identifier: Apache-2.0
 */

#ifndef __TEST_FS_H__
#define __TEST_FS_H__

#include <zephyr/kernel.h>
#include <zephyr/ztest.h>
#include <zephyr/fs/fs.h>
#include <zephyr/fs/fs_sys.h>

#define TEST_FS_MNTP	"/NAND:"
#define TEST_FILE	TEST_FS_MNTP"/testfile.txt"
#define TEST_FILE_RN	TEST_FS_MNTP"/testfile_renamed.txt"
#define TEST_FILE_EX	TEST_FS_MNTP"/testfile_exist.txt"
#define TEST_DIR	TEST_FS_MNTP"/testdir"
#define TEST_DIR_FILE	TEST_FS_MNTP"/testdir/testfile.txt"
#define TEST_MTIME      1234

/* kernel only reserve two slots for specific file system.
 * By disable that two file systems, test cases can make
 * use of that slots to register a file systems for test
 */
#define TEST_FS_1 FS_FATFS
#define TEST_FS_2 FS_LITTLEFS

extern struct fs_file_system_t temp_fs;

struct test_fs_data {
	int reserve;
};

void mock_opendir_result(int ret);
#endif
```

## src/test_fs_dt.c
```c
/*
 * Copyright (c) 2025 James Roy <rruuaanng@outlook.com>
 *
 * SPDX-License-Identifier: Apache-2.0
 */

#define DT_DRV_COMPAT zephyr_fstab_fatfs
#include "test_fs.h"

#define TEST_NODELABEL DT_NODELABEL(test_disk)

ZTEST(test_fs_dt_api, test_dt_api_mount_point)
{
	const char *mnt_point1, *mnt_point2;

	mnt_point1 = FSTAB_ENTRY_DT_MOUNT_POINT(TEST_NODELABEL);
	zassert_str_equal(mnt_point1, "/TEST:");

	mnt_point2 = FSTAB_ENTRY_DT_INST_MOUNT_POINT(0);
	zassert_str_equal(mnt_point2, "/TEST:");
}

ZTEST_SUITE(test_fs_dt_api, NULL, NULL, NULL, NULL, NULL);
```

## src/test_fs_getattr.c
```c
/*
 * Copyright (c) 2026 Rishav Chakraborty
 *
 * SPDX-License-Identifier: Apache-2.0
 */

#include "test_fs.h"

#if defined(CONFIG_FILE_SYSTEM_GETATTR)

static struct test_fs_data test_data;
static struct fs_mount_t test_fs_mnt = {
	.type = TEST_FS_1,
	.mnt_point = TEST_FS_MNTP,
	.fs_data = &test_data,
};

static void *fs_getattr_setup(void)
{
	fs_register(TEST_FS_1, &temp_fs);
	fs_mount(&test_fs_mnt);

	return NULL;
}

static void fs_getattr_teardown(void *fixture)
{
	fs_unmount(&test_fs_mnt);
	fs_unregister(TEST_FS_1, &temp_fs);
}

ZTEST(fs_api_getattr, test_fs_getattr)
{
	struct fs_attr attr;
	int ret;

	ret = fs_getattr(TEST_FILE, &attr);
	zassert_equal(ret, 0, "fs_getattr failed (%d)", ret);
	zassert_equal(attr.mask, FS_ATTR_MTIME, "Wrong attribute mask 0x%x", attr.mask);
	zassert_equal(attr.mtime, TEST_MTIME, "Wrong mtime %lld", (long long)attr.mtime);

	ret = fs_getattr(NULL, &attr);
	zassert_equal(ret, -EINVAL, "NULL path (%d)", ret);

	ret = fs_getattr("relative/path", &attr);
	zassert_equal(ret, -EINVAL, "Relative path (%d)", ret);

	ret = fs_getattr(TEST_FILE, NULL);
	zassert_equal(ret, -EINVAL, "NULL attr (%d)", ret);
}

ZTEST_SUITE(fs_api_getattr, NULL, fs_getattr_setup, NULL, NULL, fs_getattr_teardown);
#endif /* CONFIG_FILE_SYSTEM_GETATTR */
```

## src/test_fs_mount_flags.c
```c
/*
 * Copyright (c) 2020 Nordic Semiconductor ASA
 *
 * SPDX-License-Identifier: Apache-2.0
 */

#include <zephyr/ztest.h>
#include "test_fs.h"

static struct test_fs_data test_data;

static struct fs_mount_t mp = {
		.type = TEST_FS_1,
		.mnt_point = TEST_FS_MNTP,
		.fs_data = &test_data,
};

void test_mount_flags(void)
{
	int ret = 0;
	struct fs_file_t fs;

	fs_file_t_init(&fs);

	/* Format volume and add some files/dirs to check read-only flag */
	mp.flags = 0;
	TC_PRINT("Mount to prepare tests\n");
	ret = fs_mount(&mp);
	zassert_equal(ret, 0, "Expected success (%d)", ret);
	TC_PRINT("Create some file\n");
	ret = fs_open(&fs, TEST_FS_MNTP"/some", FS_O_CREATE);
	zassert_equal(ret, 0, "Expected success fs_open(FS_O_CREATE) (%d)",
		      ret);
	ret = fs_close(&fs);
	zassert_equal(ret, 0, "Expected fs_close success (%d)", ret);
	TC_PRINT("Create other directory\n");
	ret = fs_mkdir(TEST_FS_MNTP"/other");
	zassert_equal(ret, 0, "Expected fs_mkdir success (%d)", ret);
	ret = fs_unmount(&mp);
	zassert_equal(ret, 0, "Expected fs_umount success (%d)", ret);

	/* Check fs operation on volume mounted with FS_MOUNT_FLAG_READ_ONLY */
	mp.flags = FS_MOUNT_FLAG_READ_ONLY;
	TC_PRINT("Mount as read-only\n");
	ret = fs_mount(&mp);
	zassert_equal(ret, 0, "Expected fs_mount success (%d)", ret);

	/* Attempt creating new file */
	ret = fs_open(&fs, TEST_FS_MNTP"/nosome", FS_O_CREATE);
	zassert_equal(ret, -EROFS, "Expected EROFS got %d", ret);
	ret = fs_mkdir(TEST_FS_MNTP"/another");
	zassert_equal(ret, -EROFS, "Expected EROFS got %d", ret);
	ret = fs_rename(TEST_FS_MNTP"/some", TEST_FS_MNTP"/nosome");
	zassert_equal(ret, -EROFS, "Expected EROFS got %d", ret);
	ret = fs_unlink(TEST_FS_MNTP"/some");
	zassert_equal(ret, -EROFS, "Expected EROFS got %d", ret);
	ret = fs_open(&fs, TEST_FS_MNTP"/other", FS_O_CREATE);
	zassert_equal(ret, -EROFS, "Expected EROFS got %d", ret);
	ret = fs_open(&fs, TEST_FS_MNTP"/some", FS_O_RDWR);
	zassert_equal(ret, -EROFS, "Expected EROFS got %d", ret);
	ret = fs_open(&fs, TEST_FS_MNTP"/some", FS_O_READ);
	zassert_equal(ret, 0, "Expected fs_open(FS_O_READ) success (%d)", ret);
	ret = fs_close(&fs);
	zassert_equal(ret, 0, "Expected fs_close success (%d)", ret);
	ret = fs_unmount(&mp);
	zassert_equal(ret, 0, "Expected fs_unmount success (%d)", ret);
}
```

## src/test_fs_mount_fs_data.c
```c
/*
 * Copyright (c) 2026 Dhruv Menon <dhruvmenon1104@gmail.com>
 * SPDX-License-Identifier: Apache-2.0
 */

#include "test_fs.h"

#define MNT_SHORT_A "/dup_a"
#define MNT_SHORT_B "/dup_b"
#define MNT_LONG    "/dup_longer_c"

static int dup_mount(struct fs_mount_t *mountp)
{
	ARG_UNUSED(mountp);
	return 0;
}

static int dup_unmount(struct fs_mount_t *mountp)
{
	ARG_UNUSED(mountp);
	return 0;
}

static const struct fs_file_system_t dup_fs = {
	.mount = dup_mount,
	.unmount = dup_unmount,
};

static struct test_fs_data shared_data;
static struct test_fs_data other_data;

static struct fs_mount_t mnt_short_a_shared = {
		.type = TEST_FS_1,
		.mnt_point = MNT_SHORT_A,
		.fs_data = &shared_data,
};

static struct fs_mount_t mnt_short_b_shared = {
		.type = TEST_FS_1,
		.mnt_point = MNT_SHORT_B,
		.fs_data = &shared_data,
};

static struct fs_mount_t mnt_long_shared = {
		.type = TEST_FS_1,
		.mnt_point = MNT_LONG,
		.fs_data = &shared_data,
};

static struct fs_mount_t mnt_long_other = {
		.type = TEST_FS_1,
		.mnt_point = MNT_LONG,
		.fs_data = &other_data,
};

/* fs_data is intentionally left NULL on the two mount points below. */
static struct fs_mount_t mnt_short_a_null = {
		.type = TEST_FS_1,
		.mnt_point = MNT_SHORT_A,
};

static struct fs_mount_t mnt_long_null = {
		.type = TEST_FS_1,
		.mnt_point = MNT_LONG,
};

/**
 * @brief Sharing one fs_data between two mount points must be rejected
 *
 * @details
 * Covers both mount point length relations, in both directions, because the
 * duplicate detection must not be gated on the mount point lengths.
 *
 * @ingroup filesystem_api
 */
ZTEST(fs_api_mount_fs_data, test_duplicate_fs_data_rejected)
{
	int ret;

	zassert_ok(fs_mount(&mnt_short_a_shared), "failed to mount %s", MNT_SHORT_A);

	/* Mount point of equal length to the mounted one. */
	ret = fs_mount(&mnt_short_b_shared);
	zassert_equal(ret, -EBUSY,
		      "duplicate fs_data accepted for an equal length mount point (%d)", ret);

	/* Mount point longer than the mounted one. */
	ret = fs_mount(&mnt_long_shared);
	zassert_equal(ret, -EBUSY,
		      "duplicate fs_data accepted for a longer mount point (%d)", ret);

	zassert_ok(fs_unmount(&mnt_short_a_shared), "failed to unmount %s", MNT_SHORT_A);

	/* Same collision the other way round, so that the incoming mount point
	 * is shorter than the mounted one.
	 */
	zassert_ok(fs_mount(&mnt_long_shared), "failed to mount %s", MNT_LONG);

	ret = fs_mount(&mnt_short_a_shared);
	zassert_equal(ret, -EBUSY,
		      "duplicate fs_data accepted for a shorter mount point (%d)", ret);

	zassert_ok(fs_unmount(&mnt_long_shared), "failed to unmount %s", MNT_LONG);
}

/**
 * @brief Mount points with distinct fs_data must both be accepted
 *
 * @ingroup filesystem_api
 */
ZTEST(fs_api_mount_fs_data, test_distinct_fs_data_accepted)
{
	zassert_ok(fs_mount(&mnt_short_a_shared), "failed to mount %s", MNT_SHORT_A);
	zassert_ok(fs_mount(&mnt_long_other), "failed to mount %s alongside %s", MNT_LONG,
		   MNT_SHORT_A);

	zassert_ok(fs_unmount(&mnt_long_other), "failed to unmount %s", MNT_LONG);
	zassert_ok(fs_unmount(&mnt_short_a_shared), "failed to unmount %s", MNT_SHORT_A);
}

/**
 * @brief One fs_data may be reused once the previous mount point released it
 *
 * @details
 * The duplicate detection has to reject concurrent owners only; reusing an
 * instance after unmounting has to keep working.
 *
 * @ingroup filesystem_api
 */
ZTEST(fs_api_mount_fs_data, test_fs_data_reuse_after_unmount)
{
	zassert_ok(fs_mount(&mnt_short_a_shared), "failed to mount %s", MNT_SHORT_A);
	zassert_ok(fs_unmount(&mnt_short_a_shared), "failed to unmount %s", MNT_SHORT_A);

	zassert_ok(fs_mount(&mnt_long_shared), "failed to reuse fs_data for %s", MNT_LONG);
	zassert_ok(fs_unmount(&mnt_long_shared), "failed to unmount %s", MNT_LONG);
}

/**
 * @brief A NULL fs_data must not be treated as a duplicate
 *
 * @details
 * File systems such as ext2 allocate their private state inside their own
 * mount handler, so they reach the duplicate check with fs_data still NULL.
 * Two such mount points share no state and must both be accepted.
 *
 * @ingroup filesystem_api
 */
ZTEST(fs_api_mount_fs_data, test_null_fs_data_accepted)
{
	zassert_ok(fs_mount(&mnt_short_a_null), "failed to mount %s with NULL fs_data",
		   MNT_SHORT_A);
	zassert_ok(fs_mount(&mnt_long_null), "NULL fs_data treated as a duplicate for %s",
		   MNT_LONG);

	zassert_ok(fs_unmount(&mnt_long_null), "failed to unmount %s", MNT_LONG);
	zassert_ok(fs_unmount(&mnt_short_a_null), "failed to unmount %s", MNT_SHORT_A);
}

static void *mount_fs_data_setup(void)
{
	zassert_ok(fs_register(TEST_FS_1, &dup_fs), "failed to register test file system");
	return NULL;
}

/* A failing assertion aborts the test in progress, so anything it had already
 * mounted would stay on the mount list and leak into the tests that follow.
 * Drop every mount point after each test to keep the failures isolated.
 */
static void mount_fs_data_after(void *fixture)
{
	static struct fs_mount_t *const all_mnts[] = {
		&mnt_short_a_shared, &mnt_short_b_shared, &mnt_long_shared,
		&mnt_long_other,     &mnt_short_a_null,   &mnt_long_null,
	};

	ARG_UNUSED(fixture);

	ARRAY_FOR_EACH(all_mnts, i) {
		(void)fs_unmount(all_mnts[i]);
	}
}

static void mount_fs_data_teardown(void *fixture)
{
	ARG_UNUSED(fixture);
	(void)fs_unregister(TEST_FS_1, &dup_fs);
}

ZTEST_SUITE(fs_api_mount_fs_data, NULL, mount_fs_data_setup, NULL, mount_fs_data_after,
	    mount_fs_data_teardown);
```

## src/test_fs_normalize_path.c
```c
/*
 * SPDX-FileCopyrightText: Copyright The Zephyr Project Contributors
 * SPDX-License-Identifier: Apache-2.0
 */

#include "test_fs.h"
#include <string.h>

struct normalize_case {
	const char *path;
	const char *expected;
};

typedef const char *invalid_path_t;

ZTEST_DEFINE_PARAM_VALUES(invalid_paths, invalid_path_t,
			  NULL,
			  "",
			  "relative/path",
			  "NAND:/foo");

ZTEST_DEFINE_PARAM_VALUES(normalize_cases, struct normalize_case,
			  {"/NAND:", "/NAND:"},
			  {"/NAND:/", "/NAND:"},
			  {"/NAND://foo///bar/", "/NAND:/foo/bar"},
			  {"/NAND:/./foo/./.", "/NAND:/foo"},
			  {"/NAND:/some/path/../here/and/.././my.txt", "/NAND:/some/here/my.txt"},
			  {"/NAND:/..", "/"},
			  {"/NAND:/foo/../..", "/"},
			  {"/..", "/"},
			  {"/", "/"},
			  {"/NAND:/sub/../x", "/NAND:/x"});

ZTEST_P(fs_api_normalize_path, test_normalize_path_invalid)
{
	const char *path = ZTEST_GET_PARAM(invalid_path_t);
	char buf[32];
	int ret;

	ret = fs_normalize_path(path, buf, sizeof(buf));
	zassert_equal(ret, -EINVAL, "\"%s\" should be rejected (%d)", path, ret);
}

ZTEST_P(fs_api_normalize_path, test_normalize_path)
{
	const struct normalize_case *tc = ZTEST_GET_PARAM_PTR(struct normalize_case);
	char buf[64];
	int ret;

	ret = fs_normalize_path(tc->path, buf, sizeof(buf));
	zassert_equal(ret, 0, "\"%s\" should normalize (%d)", tc->path, ret);
	zassert_str_equal(buf, tc->expected, "\"%s\" became \"%s\"", tc->path, buf);
}

ZTEST(fs_api_normalize_path, test_normalize_path_invalid_buffer)
{
	char buf[32];
	int ret;

	ret = fs_normalize_path("/NAND:/foo", NULL, sizeof(buf));
	zassert_equal(ret, -EINVAL, "NULL output buffer should be rejected (%d)", ret);

	ret = fs_normalize_path("/NAND:/foo", buf, 0);
	zassert_equal(ret, -EINVAL, "zero-length output buffer should be rejected (%d)", ret);
}

ZTEST(fs_api_normalize_path, test_normalize_path_buffer_too_small)
{
	char buf[16];
	int ret;

	ret = fs_normalize_path("/NAND:/foo", buf, strlen("/NAND:/foo"));
	zassert_equal(ret, -ENAMETOOLONG, "undersized buffer should be rejected (%d)", ret);

	ret = fs_normalize_path("/NAND:/foo", buf, strlen("/NAND:/foo") + 1);
	zassert_equal(ret, 0, "exactly-sized buffer should succeed (%d)", ret);
	zassert_str_equal(buf, "/NAND:/foo", "unexpected result");

	ret = fs_normalize_path("/NAND:/..", buf, 1);
	zassert_equal(ret, -ENAMETOOLONG, "no room for \"/\" should be rejected (%d)", ret);

	/* The check is per segment, so a prefix a later ".." pops is charged for */
	ret = fs_normalize_path("/a/..", buf, sizeof("/"));
	zassert_equal(ret, -ENAMETOOLONG, "a prefix that does not fit should be rejected (%d)",
		      ret);
}

ZTEST(fs_api_normalize_path, test_normalize_path_in_place)
{
	char buf[64];
	int ret;

	strcpy(buf, "/NAND:/some/path/../here/and/.././my.txt");

	ret = fs_normalize_path(buf, buf, sizeof(buf));

	zassert_equal(ret, 0, "unexpected error (%d)", ret);
	zassert_str_equal(buf, "/NAND:/some/here/my.txt", "unexpected result");
}

ZTEST_SUITE(fs_api_normalize_path, NULL, NULL, NULL, NULL, NULL);

ZTEST_INSTANTIATE_TEST_SUITE_P(all, fs_api_normalize_path, test_normalize_path_invalid,
			       invalid_paths);
ZTEST_INSTANTIATE_TEST_SUITE_P(all, fs_api_normalize_path, test_normalize_path,
			       normalize_cases);
```

## src/test_fs_utils.c
```c
/*
 * Copyright (c) 2026 Rishav Chakraborty.
 *
 * SPDX-License-Identifier: Apache-2.0
 */

#include "test_fs.h"
#include <string.h>

static struct test_fs_data test_data;
static struct fs_mount_t test_fs_mnt_1 = {
	.type = TEST_FS_1,
	.mnt_point = TEST_FS_MNTP,
	.fs_data = &test_data,
};

struct fs_utils_ent {
	sys_dnode_t node;
	struct fs_dirent ent;
};

/* list of directory entries */
static sys_dlist_t fs_utils_ent_list = SYS_DLIST_STATIC_INIT(&fs_utils_ent_list);

static struct fs_file_system_t fs_utils_fs;

static int fs_utils_stat(struct fs_mount_t *mountp, const char *path, struct fs_dirent *entry)
{
	struct fs_utils_ent *itr;
	sys_dnode_t *node;

	if (mountp == NULL || path == NULL || entry == NULL) {
		return -EINVAL;
	}

	SYS_DLIST_FOR_EACH_NODE(&fs_utils_ent_list, node) {
		itr = CONTAINER_OF(node, struct fs_utils_ent, node);
		if (strcmp(itr->ent.name, path) == 0) {
			*entry = itr->ent;
			return 0;
		}
	}

	return -ENOENT;
}

static int fs_utils_mkdir(struct fs_mount_t *mountp, const char *path)
{
	struct fs_utils_ent *e;
	struct fs_dirent ent;

	if (mountp == NULL || path == NULL) {
		return -EINVAL;
	}

	if (strcmp(mountp->mnt_point, path) == 0) {
		return -EPERM;
	}

	if (fs_utils_stat(mountp, path, &ent) == 0) {
		return -EEXIST;
	}

	if (strlen(path) >= sizeof(ent.name)) {
		return -ENAMETOOLONG;
	}

	e = k_malloc(sizeof(*e));
	if (e == NULL) {
		return -ENOMEM;
	}

	e->ent.type = FS_DIR_ENTRY_DIR;
	e->ent.size = 0;
	strcpy(e->ent.name, path);
	sys_dlist_append(&fs_utils_ent_list, &e->node);

	return 0;
}

/**
 * @brief Test fs_mkdir_p() creating nested directories
 */
ZTEST(fs_utils, test_fs_mkdir_p)
{
	struct fs_dirent ent;
	int rc = fs_mkdir_p(TEST_FS_MNTP "/a/b/c");

	TC_PRINT("\nfs_mkdir_p tests:%d\n", rc);
	zassert_equal(rc, 0);
	zassert_equal(fs_stat(TEST_FS_MNTP "/a", &ent), 0, "a does not exist");
	zassert_equal(fs_stat(TEST_FS_MNTP "/a/b", &ent), 0, "a/b does not exist");
	zassert_equal(fs_stat(TEST_FS_MNTP "/a/b/c", &ent), 0, "a/b/c does not exist");
}

/**
 * @brief Test fs_mkdir_p() on a directory that already exists
 */
ZTEST(fs_utils, test_fs_mkdir_p_idempotent)
{
	struct fs_dirent ent;

	zassert_equal(fs_mkdir_p(TEST_FS_MNTP "/a"), 0);
	zassert_equal(fs_mkdir_p(TEST_FS_MNTP "/a"), 0, "second call failed");
	zassert_equal(fs_stat(TEST_FS_MNTP "/a", &ent), 0, "a does not exist");
}

/**
 * @brief Test fs_mkdir_p() argument validation
 */
ZTEST(fs_utils, test_fs_mkdir_p_invalid_args)
{
	zassert_equal(fs_mkdir_p(NULL), -EINVAL);
	zassert_equal(fs_mkdir_p("a/b"), -EINVAL, "path is not absolute");
}

/**
 * @brief Test fs_mkdir_p() on the VFS root, which always exists
 */
ZTEST(fs_utils, test_fs_mkdir_p_root)
{
	zassert_equal(fs_mkdir_p("/"), 0);
}

/**
 * @brief Test fs_mkdir_p() with a path that does not fit in the internal buffer
 */
ZTEST(fs_utils, test_fs_mkdir_p_name_too_long)
{
	char path[CONFIG_FILE_SYSTEM_UTILS_MAX_PATH_LEN + 1];

	memset(path, 'a', sizeof(path) - 1);
	path[0] = '/';
	path[sizeof(path) - 1] = '\0';

	zassert_equal(fs_mkdir_p(path), -ENAMETOOLONG);
}

static void *fs_utils_setup(void)
{
	fs_utils_fs = temp_fs;
	fs_utils_fs.mkdir = fs_utils_mkdir;
	fs_utils_fs.stat = fs_utils_stat;
	fs_register(TEST_FS_1, &fs_utils_fs);
	fs_mount(&test_fs_mnt_1);
	return NULL;
}

static void fs_utils_reset(void *fixture)
{
	sys_dnode_t *node;

	while ((node = sys_dlist_get(&fs_utils_ent_list)) != NULL) {
		k_free(CONTAINER_OF(node, struct fs_utils_ent, node));
	}
}

static void fs_utils_teardown(void *fixture)
{
	fs_utils_reset(fixture);

	fs_unmount(&test_fs_mnt_1);
	fs_unregister(TEST_FS_1, &fs_utils_fs);
}

ZTEST_SUITE(fs_utils, NULL, fs_utils_setup, fs_utils_reset, NULL, fs_utils_teardown);
```

## src/test_multi_fs.c
```c
/*
 * Copyright (c) 2020 Intel Corporation.
 *
 * SPDX-License-Identifier: Apache-2.0
 */

#include "test_fs.h"
/* amount of file system */
#define NUM_FS 2
#define TEST_FS_NAND1 "/NAND:"
#define TEST_FS_NAND2 "/MMCBLOCK:"

static struct test_fs_data test_data_1;
static struct test_fs_data test_data_2;

static struct fs_mount_t test_fs_mnt_1 = {
		.type = TEST_FS_1,
		.mnt_point = TEST_FS_NAND1,
		.fs_data = &test_data_1,
};

static struct fs_mount_t test_fs_mnt_2 = {
		.type = TEST_FS_2,
		.mnt_point = TEST_FS_NAND2,
		.fs_data = &test_data_2,
};

static int test_fs_init(void)
{
	if (fs_register(TEST_FS_1, &temp_fs)) {
		return -EINVAL;
	}

	/* Attempt to re-register a file system */
	if (fs_register(TEST_FS_1, &temp_fs) != -EALREADY) {
		return -EINVAL;
	}

	if (fs_mount(&test_fs_mnt_1)) {
		return -EINVAL;
	}

	if (fs_register(TEST_FS_2, &temp_fs)) {
		return -EINVAL;
	}

	if (fs_mount(&test_fs_mnt_2)) {
		return -EINVAL;
	}

	return 0;
}

static int test_fs_readmount(void)
{
	int ret;
	int mnt_nbr = 0;
	const char *mnt_name;

	do {
		ret = fs_readmount(&mnt_nbr, &mnt_name);
		if (ret < 0) {
			break;
		}


	} while (true);

	if (mnt_nbr == NUM_FS) {
		return 0;
	}

	return TC_FAIL;
}

static int test_fs_deinit(void)
{
	/* NULL parameter */
	if (fs_unregister(TEST_FS_1, NULL) == 0) {
		return -EINVAL;
	}

	if (fs_unregister(TEST_FS_1, &temp_fs)) {
		return -EINVAL;
	}

	if (fs_unmount(&test_fs_mnt_1)) {
		return -EINVAL;
	}

	if (fs_unregister(TEST_FS_2, &temp_fs)) {
		return -EINVAL;
	}

	if (fs_unmount(&test_fs_mnt_2)) {
		return -EINVAL;
	}
	return 0;
}

static int test_fs_external(void)
{
	/* There is no way to statically determine whether a file
	 * system is unsupported, but  */
	if (fs_register(FS_TYPE_EXTERNAL_BASE, &temp_fs) != -ENOSPC) {
		return TC_FAIL;
	}

	if (fs_unregister(FS_TYPE_EXTERNAL_BASE, &temp_fs) != -EINVAL) {
		return TC_FAIL;
	}

	return 0;
}

/**
 * @brief Multi file systems register and unregister
 *
 * @details
 *  Register and unregister two file systems to test the system support
 *  multiple file system simultaneously
 *
 *@addtogroup filesystem_api
 *@{
 */

/**
 * @brief Register and unregister file system implementations
 *
 * @verifies ZEP-SRS-17-20
 */
ZTEST(fs_api_register_mount, test_fs_register)
{
	zassert_true(test_fs_init() == 0, "Failed to register filesystems");
	zassert_true(test_fs_readmount() == 0, "Failed to readmount");
	zassert_true(test_fs_external() == 0, "Supported other file system");
	zassert_true(test_fs_deinit() == 0, "Failed to unregister filesystems");
}

/**
 * @}
 */
```
