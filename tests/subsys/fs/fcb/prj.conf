## CMakeLists.txt
```
# SPDX-License-Identifier: Apache-2.0

cmake_minimum_required(VERSION 3.28.0)
find_package(Zephyr REQUIRED HINTS $ENV{ZEPHYR_BASE})
project(fs_fcb)

FILE(GLOB app_sources src/*.c)
if(NOT CONFIG_FCB_ALLOW_FIXED_ENDMARKER)
  list(REMOVE_ITEM "src/fcb_test_crc_disabled_after_enabled.c")
endif()
target_sources(app PRIVATE ${app_sources})
target_include_directories(app PRIVATE ${ZEPHYR_BASE}/subsys/fs/fcb)
```

## prj.conf
```kconfig
CONFIG_ZTEST=y
CONFIG_STDOUT_CONSOLE=y
CONFIG_FLASH=y
CONFIG_FLASH_MAP=y
CONFIG_FCB=y
CONFIG_FCB_ALLOW_FIXED_ENDMARKER=y
```

## prj_native_posix.conf
```kconfig
CONFIG_ZTEST=y
CONFIG_STDOUT_CONSOLE=y
CONFIG_FLASH=y
CONFIG_FLASH_PAGE_LAYOUT=y
CONFIG_FLASH_MAP=y
CONFIG_FCB=y
CONFIG_SYS_TIMEOUT_LEGACY_API=n
```

## prj_native_posix_64.conf
```kconfig
CONFIG_ZTEST=y
CONFIG_STDOUT_CONSOLE=y
CONFIG_FLASH=y
CONFIG_FLASH_PAGE_LAYOUT=y
CONFIG_FLASH_MAP=y
CONFIG_FCB=y
CONFIG_FCB_ALLOW_FIXED_ENDMARKER=y
CONFIG_ZTEST_NEW_API=y
```

## prj_nucleo_h743zi.conf
```kconfig
# General Zephyr configurations
CONFIG_ZTEST=y
CONFIG_STDOUT_CONSOLE=y
CONFIG_FLASH=y
CONFIG_FLASH_PAGE_LAYOUT=y
CONFIG_FLASH_MAP=y
CONFIG_ARM_MPU=n
CONFIG_FCB=y
CONFIG_FCB_ALLOW_FIXED_ENDMARKER=y
CONFIG_MAIN_STACK_SIZE=4096
CONFIG_SYSTEM_WORKQUEUE_STACK_SIZE=4096
CONFIG_ZTEST_NEW_API=y
```

## prj_qemu_x86.conf
```kconfig
CONFIG_ZTEST=y
CONFIG_STDOUT_CONSOLE=y
CONFIG_FLASH=y
CONFIG_FLASH_PAGE_LAYOUT=y
CONFIG_FLASH_MAP=y
CONFIG_FCB=y
CONFIG_FCB_ALLOW_FIXED_ENDMARKER=y
CONFIG_FLASH_SIMULATOR_UNALIGNED_READ=y
CONFIG_ZTEST_NEW_API=y
```

## boards/nrf52dk_nrf52832.conf
```kconfig
CONFIG_ARM_MPU=n
CONFIG_SOC_FLASH_NRF_EMULATE_ONE_BYTE_WRITE_ACCESS=y
```

## boards/nucleo_h743zi.conf
```kconfig
# SPDX-FileCopyrightText: Copyright The Zephyr Project Contributors
# SPDX-License-Identifier: Apache-2.0

CONFIG_ARM_MPU=n
CONFIG_MAIN_STACK_SIZE=4096
CONFIG_SYSTEM_WORKQUEUE_STACK_SIZE=4096
```

## boards/mr_canhubk3.overlay
```dts
/*
 * Copyright 2023 NXP
 *
 * SPDX-License-Identifier: Apache-2.0
 */

/*
 * Currently there's no support for mcuboot, so create a partition for this test.
 */
&mx25l6433f {
	partitions {
		slot1_partition: partition@100000 {
			reg = <0x100000 0x100000>;
		};
	};
};
```

## boards/native_posix_ev_0x00.overlay
```dts
/*
 * Copyright (c) 2020 Nordic Semiconductor ASA
 *
 * SPDX-License-Identifier: Apache-2.0
 */

&flashcontroller0 {
	erase-value = < 0x00 >;
};

&flash0 {
	write-block-size = <1>;
};
```

## boards/native_sim_ev_0x00.overlay
```dts
/*
 * Copyright (c) 2020 Nordic Semiconductor ASA
 *
 * SPDX-License-Identifier: Apache-2.0
 */

&flashcontroller0 {
	erase-value = <0x00>;
};

&flash0 {
	write-block-size = <1>;
};
```

## boards/nucleo_h743zi.overlay
```dts
/*
 * SPDX-FileCopyrightText: Copyright The Zephyr Project Contributors
 * SPDX-License-Identifier: Apache-2.0
 */

&flash0 {
	partitions {
		ranges;
		#address-cells = <1>;
		#size-cells = <1>;

		slot1_partition: partition@80000 {
			compatible = "zephyr,mapped-partition";
			reg = <0x00080000 0x00080000>;
			label = "image-1";
		};
	};
};
```

## boards/qemu_x86.overlay
```dts
/*
 * Copyright (c) Nordic Semiconductor ASA
 *
 *SPDX-License-Identifier: Apache-2.0
 */

&flash_sim0 {
	write-block-size = <1>;
};
```

## boards/qemu_x86_ev_0x00.overlay
```dts
/*
 * Copyright (c) 2020 Nordic Semiconductor ASA
 *
 * SPDX-License-Identifier: Apache-2.0
 */

&sim_flash {
	erase-value = <0x00>;
};

&flash_sim0 {
	write-block-size = <1>;
};
```

## src/main.c
```c
/*
 * Copyright (c) 2017-2023 Nordic Semiconductor ASA
 * Copyright (c) 2015 Runtime Inc
 *
 * SPDX-License-Identifier: Apache-2.0
 */

#include <stdio.h>
#include <string.h>

#include "fcb_test.h"
#include <zephyr/storage/flash_map.h>
#include <zephyr/drivers/flash.h>
#include <zephyr/device.h>

struct fcb test_fcb = {0};
#if defined(CONFIG_FCB_ALLOW_FIXED_ENDMARKER)
struct fcb test_fcb_crc_disabled = { .f_flags = FCB_FLAGS_CRC_DISABLED };
#endif

uint8_t fcb_test_erase_value;

#if defined(CONFIG_SOC_SERIES_STM32H7X)
	#define SECTOR_SIZE 0x20000 /* 128K */
#else
	#define SECTOR_SIZE 0x4000 /* 16K */
#endif

/* Sectors for FCB are defined far from application code
 * area. This test suite is the non bootable application so 1. image slot is
 * suitable for it.
 */
struct flash_sector test_fcb_sector[] = {
	[0] = {
		.fs_off = 0,
		.fs_size = SECTOR_SIZE
	},
	[1] = {
		.fs_off = SECTOR_SIZE,
		.fs_size = SECTOR_SIZE
	},
	[2] = {
		.fs_off = 2 * SECTOR_SIZE,
		.fs_size = SECTOR_SIZE
	},
	[3] = {
		.fs_off = 3 * SECTOR_SIZE,
		.fs_size = SECTOR_SIZE
	}
};


void test_fcb_wipe(void)
{
	int i;
	int rc;
	const struct flash_area *fap;

	rc = flash_area_open(TEST_FCB_FLASH_AREA_ID, &fap);
	zassert_true(rc == 0, "flash area open call failure");

	for (i = 0; i < ARRAY_SIZE(test_fcb_sector); i++) {
		rc = flash_area_flatten(fap, test_fcb_sector[i].fs_off,
				      test_fcb_sector[i].fs_size);
		zassert_true(rc == 0, "erase call failure");
	}
}

int fcb_test_empty_walk_cb(struct fcb_entry_ctx *entry_ctx, void *arg)
{
	zassert_unreachable("fcb_test_empty_walk_cb");
	return 0;
}

uint8_t fcb_test_append_data(int msg_len, int off)
{
	return (msg_len ^ off);
}

int fcb_test_data_walk_cb(struct fcb_entry_ctx *entry_ctx, void *arg)
{
	uint16_t len;
	uint8_t test_data[128];
	int rc;
	int i;
	int *var_cnt = (int *)arg;

	len = entry_ctx->loc.fe_data_len;

	zassert_true(len == *var_cnt, "");

	rc = flash_area_read(entry_ctx->fap,
			     FCB_ENTRY_FA_DATA_OFF(entry_ctx->loc),
			     test_data, len);
	zassert_true(rc == 0, "read call failure");

	for (i = 0; i < len; i++) {
		zassert_true(test_data[i] == fcb_test_append_data(len, i),
		"fcb_test_append_data redout misrepresentation");
	}
	(*var_cnt)++;
	return 0;
}

int fcb_test_cnt_elems_cb(struct fcb_entry_ctx *entry_ctx, void *arg)
{
	struct append_arg *aa = (struct append_arg *)arg;
	int idx;

	idx = entry_ctx->loc.fe_sector - &test_fcb_sector[0];
	aa->elem_cnts[idx]++;
	return 0;
}

void fcb_tc_pretest(int sectors, struct fcb *_fcb)
{
	int rc = 0;

	test_fcb_wipe();
	_fcb->f_erase_value = fcb_test_erase_value;
	_fcb->f_sector_cnt = sectors;
	_fcb->f_sectors = test_fcb_sector; /* XXX */

	rc = 0;
	rc = fcb_init(TEST_FCB_FLASH_AREA_ID, _fcb);
	if (rc != 0) {
		printf("%s rc == %xm, %d\n", __func__, rc, rc);
		zassert_true(rc == 0, "fbc initialization failure");
	}
}

static void fcb_pretest_2_sectors(void *data)
{
	fcb_tc_pretest(2, &test_fcb);
}

static void fcb_pretest_4_sectors(void *data)
{
	fcb_tc_pretest(4, &test_fcb);
}

static void fcb_pretest_crc_disabled(void *data)
{
#if defined(CONFIG_FCB_ALLOW_FIXED_ENDMARKER)
	fcb_tc_pretest(2, &test_fcb_crc_disabled);
#else
	ztest_test_skip();
#endif
}

/*
 * This actually is not a test; the function gets erase value from flash
 * parameters, of the flash device that is used by tests, and stores it in
 * global fcb_test_erase_value.
 */
ZTEST(fcb_test_without_set, test_get_flash_erase_value)
{
	const struct flash_area *fa;
	const struct flash_parameters *fp;
	const struct device *dev;
	int rc = 0;

	rc = flash_area_open(TEST_FCB_FLASH_AREA_ID, &fa);
	zassert_equal(rc, 0, "Failed top open flash area");

	dev = fa->fa_dev;
	flash_area_close(fa);

	zassert_true(dev != NULL, "Failed to obtain device");

	fp = flash_get_parameters(dev);
	zassert_true(fp != NULL, "Failed to get flash device parameters");

	fcb_test_erase_value = fp->erase_value;
}

ZTEST_SUITE(fcb_test_without_set, NULL, NULL, NULL, NULL, NULL);
ZTEST_SUITE(fcb_test_with_2sectors_set, NULL, NULL, fcb_pretest_2_sectors, NULL, NULL);
ZTEST_SUITE(fcb_test_with_4sectors_set, NULL, NULL, fcb_pretest_4_sectors, NULL, NULL);

ZTEST_SUITE(fcb_test_crc_disabled, NULL, NULL, fcb_pretest_crc_disabled, NULL, NULL);
```

## src/fcb_test.h
```c
/*
 * Copyright (c) 2017-2023 Nordic Semiconductor ASA
 * Copyright (c) 2015 Runtime Inc
 *
 * SPDX-License-Identifier: Apache-2.0
 */

#ifndef _FCB_TEST_H
#define _FCB_TEST_H

#include <stdio.h>
#include <string.h>
#include <zephyr/ztest.h>

#include <zephyr/fs/fcb.h>
#include <fcb_priv.h>
#include <errno.h>

#ifdef __cplusplus
extern "C" {
#endif

#define TEST_FCB_FLASH_AREA		slot1_partition
#define TEST_FCB_FLASH_AREA_ID		PARTITION_ID(TEST_FCB_FLASH_AREA)

extern struct fcb test_fcb;
#if defined(CONFIG_FCB_ALLOW_FIXED_ENDMARKER)
extern struct fcb test_fcb_crc_disabled;
#endif

extern struct flash_sector test_fcb_sector[];

extern uint8_t fcb_test_erase_value;

struct append_arg {
	int *elem_cnts;
};

void test_fcb_wipe(void);
int fcb_test_empty_walk_cb(struct fcb_entry_ctx *entry_ctx, void *arg);
uint8_t fcb_test_append_data(int msg_len, int off);
int fcb_test_data_walk_cb(struct fcb_entry_ctx *entry_ctx, void *arg);
int fcb_test_cnt_elems_cb(struct fcb_entry_ctx *entry_ctx, void *arg);

#ifdef __cplusplus
}
#endif
#endif /* _FCB_TEST_H */
```

## src/fcb_test_append.c
```c
/*
 * Copyright (c) 2017-2023 Nordic Semiconductor ASA
 * Copyright (c) 2015 Runtime Inc
 *
 * SPDX-License-Identifier: Apache-2.0
 */

#include "fcb_test.h"

static void test_fcb_append(struct fcb *_fcb)
{
	int rc;
	struct fcb_entry loc;
	uint8_t test_data[128];
	int i;
	int j;
	int var_cnt;

	uint8_t align;
	size_t write_len;
	align = fcb_get_align(_fcb);

	for (i = 0; i < sizeof(test_data); i++) {
		for (j = 0; j < i; j++) {
			test_data[j] = fcb_test_append_data(i, j);
		}
		write_len = ROUND_UP(i, align);
		memset(test_data + i, 0, write_len - i);
		rc = fcb_append(_fcb, i, &loc);
		zassert_true(rc == 0, "fcb_append call failure");
		rc = flash_area_write(_fcb->fap, FCB_ENTRY_FA_DATA_OFF(loc),
				      test_data, write_len);
		zassert_true(rc == 0, "flash_area_write call failure");
		rc = fcb_append_finish(_fcb, &loc);
		zassert_true(rc == 0, "fcb_append_finish call failure");
	}

	var_cnt = 0;
	rc = fcb_walk(_fcb, 0, fcb_test_data_walk_cb, &var_cnt);
	zassert_true(rc == 0, "fcb_walk call failure");
	zassert_true(var_cnt == sizeof(test_data),
		     "fetched data size not match to wrote data size");
}

ZTEST(fcb_test_with_2sectors_set, test_fcb_append_2sectors)
{
	test_fcb_append(&test_fcb);
}

ZTEST(fcb_test_crc_disabled, test_fcb_append_crc_disabled)
{
	test_fcb_append(&test_fcb_crc_disabled);
}
```

## src/fcb_test_append_fill.c
```c
/*
 * Copyright (c) 2017 Nordic Semiconductor ASA
 * Copyright (c) 2015 Runtime Inc
 *
 * SPDX-License-Identifier: Apache-2.0
 */

#include "fcb_test.h"

ZTEST(fcb_test_with_2sectors_set, test_fcb_append_fill)
{
	struct fcb *fcb;
	int rc;
	int i;
	struct fcb_entry loc;
	uint8_t test_data[128];
	int elem_cnts[2] = {0, 0};
	int aa_together_cnts[2];
	struct append_arg aa_together = {
		.elem_cnts = aa_together_cnts
	};
	int aa_separate_cnts[2];
	struct append_arg aa_separate = {
		.elem_cnts = aa_separate_cnts
	};

	fcb = &test_fcb;

	for (i = 0; i < sizeof(test_data); i++) {
		test_data[i] = fcb_test_append_data(sizeof(test_data), i);
	}

	while (1) {
		rc = fcb_append(fcb, sizeof(test_data), &loc);
		if (rc == -ENOSPC) {
			break;
		}
		if (loc.fe_sector == &test_fcb_sector[0]) {
			elem_cnts[0]++;
		} else if (loc.fe_sector == &test_fcb_sector[1]) {
			elem_cnts[1]++;
		} else {
			zassert_true(0,
				     "unexpected flash area of appended loc");
		}

		rc = flash_area_write(fcb->fap, FCB_ENTRY_FA_DATA_OFF(loc),
				      test_data, sizeof(test_data));
		zassert_true(rc == 0, "flash_area_write call failure");

		rc = fcb_append_finish(fcb, &loc);
		zassert_true(rc == 0, "fcb_append_finish call failure");
	}
	zassert_true(elem_cnts[0] > 0,
		     "appended count should be greater than zero");
	zassert_true(elem_cnts[0] == elem_cnts[1],
		     "appended counts should equal to each other");

	(void)memset(&aa_together_cnts, 0, sizeof(aa_together_cnts));
	rc = fcb_walk(fcb, NULL, fcb_test_cnt_elems_cb, &aa_together);
	zassert_true(rc == 0, "fcb_walk call failure");
	zassert_true(aa_together.elem_cnts[0] == elem_cnts[0],
		     "fcb_walk: elements count read different than expected");
	zassert_true(aa_together.elem_cnts[1] == elem_cnts[1],
		     "fcb_walk: elements count read different than expected");

	(void)memset(&aa_separate_cnts, 0, sizeof(aa_separate_cnts));
	rc = fcb_walk(fcb, &test_fcb_sector[0], fcb_test_cnt_elems_cb,
	  &aa_separate);
	zassert_true(rc == 0, "fcb_walk call failure");
	rc = fcb_walk(fcb, &test_fcb_sector[1], fcb_test_cnt_elems_cb,
	  &aa_separate);
	zassert_true(rc == 0, "fcb_walk call failure");
	zassert_true(aa_separate.elem_cnts[0] == elem_cnts[0],
		     "fcb_walk: elements count read different than expected");
	zassert_true(aa_separate.elem_cnts[1] == elem_cnts[1],
		     "fcb_walk: elements count read different than expected");
}
```

## src/fcb_test_append_too_big.c
```c
/*
 * Copyright (c) 2017-2023 Nordic Semiconductor ASA
 * Copyright (c) 2015 Runtime Inc
 *
 * SPDX-License-Identifier: Apache-2.0
 */

#include "fcb_test.h"

ZTEST(fcb_test_with_2sectors_set, test_fcb_append_too_big)
{
		struct fcb *fcb;
		int rc;
		int overhead;
		uint32_t len;
		struct fcb_entry elem_loc;
		const uint8_t max_length_field_len = 2;

		fcb = &test_fcb;

		/*
		 * An entry in the FCB has the following structure:
		 * | fcb_disk_area | length | data | CRC |
		 *
		 * The length is encoded in 1-2 bytes. All these entries
		 * have to abide flash alignment constraints.
		 *
		 * Thus, the max element which fits inside sector is
		 * (M / fcb->f_align) * fcb->f_align, where / is integer
		 * division and M = sector size - O, with O being the sum
		 * of all overhead elements' lengths in flash, i.e.
		 *
		 * O = fcb_len_in_flash(fcb, FCB_CRC_SZ)
		 *    + fcb_len_in_flash(fcb, max_length_field_len)
		 *    + fcb_len_in_flash(fcb, sizeof(struct fcb_disk_area))
		 */
		len = MIN(FCB_MAX_LEN
			     + fcb_len_in_flash(fcb, sizeof(struct fcb_disk_area))
			     + fcb_len_in_flash(fcb, FCB_CRC_SZ)
			     + fcb_len_in_flash(fcb, max_length_field_len)
			, fcb->f_active.fe_sector->fs_size);


		rc = fcb_append(fcb, len, &elem_loc);
		zassert_true(rc != 0,
			     "fcb_append call should fail for too big entry");

		len--;
		rc = fcb_append(fcb, len, &elem_loc);
		zassert_true(rc != 0,
			     "fcb_append call should fail for too big entry");

		len -=  fcb_len_in_flash(fcb, sizeof(struct fcb_disk_area));
		rc = fcb_append(fcb, len, &elem_loc);
		zassert_true(rc != 0,
			     "fcb_append call should fail for too big entry");

		overhead = fcb_len_in_flash(fcb, sizeof(struct fcb_disk_area))
			   + fcb_len_in_flash(fcb, max_length_field_len)
			   + fcb_len_in_flash(fcb, FCB_CRC_SZ);

		len = MIN(FCB_MAX_LEN, fcb->f_active.fe_sector->fs_size - overhead);
		len = fcb->f_align * (len / fcb->f_align);

		rc = fcb_append(fcb, len, &elem_loc);
		zassert_true(rc == 0, "fcb_append call failure");

		rc = fcb_append_finish(fcb, &elem_loc);
		zassert_true(rc == 0, "fcb_append call failure");

		rc = fcb_elem_info(fcb, &elem_loc);
		zassert_true(rc == 0, "fcb_elem_info call failure");
		zassert_true(elem_loc.fe_data_len == len,
		"entry length fetched should match length of appended entry");
}
```

## src/fcb_test_crc_disabled_after_enabled.c
```c
/*
 * Copyright (c) 2023 Nordic Semiconductor ASA
 *
 * SPDX-License-Identifier: Apache-2.0
 */

#include "fcb_test.h"

static void fcb_pretest_crc_disabled_after_enabled(void)
{
	int rc;
	struct fcb_entry loc;
	uint8_t test_data[128];
	int i;
	int j;
	int var_cnt;

	for (i = 0; i < sizeof(test_data); i++) {
		for (j = 0; j < i; j++) {
			test_data[j] = fcb_test_append_data(i, j);
		}
		rc = fcb_append(&test_fcb, i, &loc);
		zassert_true(rc == 0, "fcb_append call failure");
		rc = flash_area_write(test_fcb.fap, FCB_ENTRY_FA_DATA_OFF(loc),
				      test_data, i);
		zassert_true(rc == 0, "flash_area_write call failure");
		rc = fcb_append_finish(&test_fcb, &loc);
		zassert_true(rc == 0, "fcb_append_finish call failure");
	}

	test_fcb_crc_disabled.f_erase_value = test_fcb.f_erase_value;
	test_fcb_crc_disabled.f_sector_cnt = test_fcb.f_sector_cnt;
	test_fcb_crc_disabled.f_sectors = test_fcb.f_sectors;

	rc = fcb_init(TEST_FCB_FLASH_AREA_ID, &test_fcb_crc_disabled);
	if (rc != 0) {
		printf("%s rc == %xm, %d\n", __func__, rc, rc);
		zassert_true(rc == 0, "fbc initialization failure");
	}

	var_cnt = 0;
	rc = fcb_walk(&test_fcb_crc_disabled, 0, fcb_test_data_walk_cb, &var_cnt);
	zassert_true(rc == 0, "fcb_walk call failure");
	printk("var_cnt: %d", var_cnt);
	zassert_true(var_cnt == sizeof(test_data),
		     "fetched data size not match to wrote data size");
}


ZTEST(fcb_test_with_2sectors_set, test_fcb_crc_disabled_after_enabled)
{
	fcb_pretest_crc_disabled_after_enabled();
}
```

## src/fcb_test_empty_walk.c
```c
/*
 * Copyright (c) 2017 Nordic Semiconductor ASA
 * Copyright (c) 2015 Runtime Inc
 *
 * SPDX-License-Identifier: Apache-2.0
 */

#include "fcb_test.h"

ZTEST(fcb_test_with_2sectors_set, test_fcb_empty_walk)
{
	int rc;
	struct fcb *fcb;

	fcb = &test_fcb;

	rc = fcb_walk(fcb, 0, fcb_test_empty_walk_cb, NULL);
	zassert_true(rc == 0, "fcb_walk call failure");
}
```

## src/fcb_test_init.c
```c
/*
 * Copyright (c) 2017 - 2020 Nordic Semiconductor ASA
 * Copyright (c) 2015 Runtime Inc
 *
 * SPDX-License-Identifier: Apache-2.0
 */

#include "fcb_test.h"

ZTEST(fcb_test_without_set, test_fcb_init)
{
	int rc;
	struct fcb *fcb;

	fcb = &test_fcb;
	(void)memset(fcb, 0, sizeof(*fcb));
	fcb->f_erase_value = fcb_test_erase_value;

	rc = fcb_init(TEST_FCB_FLASH_AREA_ID, fcb);
	zassert_true(rc == -EINVAL, "fcb_init call should fail");

	fcb->f_sectors = test_fcb_sector;

	rc = fcb_init(TEST_FCB_FLASH_AREA_ID, fcb);
	zassert_true(rc == -EINVAL, "fcb_init call should fail");

	fcb->f_sector_cnt = 2U;
	fcb->f_magic = 0x12345678;
	rc = fcb_init(TEST_FCB_FLASH_AREA_ID, fcb);
	zassert_true(rc == -ENOMSG, "fcb_init call should fail");

	fcb->f_magic = 0U;
	rc = fcb_init(TEST_FCB_FLASH_AREA_ID, fcb);
	zassert_true(rc == 0,  "fcb_init call failure");
}
```

## src/fcb_test_last_of_n.c
```c
/*
 * Copyright (c) 2017 Nordic Semiconductor ASA
 * Copyright (c) 2015 Runtime Inc
 *
 * SPDX-License-Identifier: Apache-2.0
 */

#include "fcb_test.h"

ZTEST(fcb_test_with_4sectors_set, test_fcb_last_of_n)
{
	const uint8_t ENTRIES = 5U;
	struct fcb *fcb;
	int rc;
	struct fcb_entry loc;
	struct fcb_entry areas[ENTRIES];
	uint8_t test_data[128] = {0};
	uint8_t i;

	fcb = &test_fcb;
	fcb->f_scratch_cnt = 1U;

	/* No fcbs available */
	rc = fcb_offset_last_n(fcb, 1, &loc);
	zassert_true(rc != 0, "No fcbs available");

	/*
	 * Add some fcbs.
	 */
	for (i = 0U; i < ENTRIES; i++) {
		rc = fcb_append(fcb, sizeof(test_data), &loc);
		if (rc == -ENOSPC) {
			break;
		}

		rc = flash_area_write(fcb->fap, FCB_ENTRY_FA_DATA_OFF(loc),
				      test_data, sizeof(test_data));
		zassert_true(rc == 0, "flash_area_write call failure");

		rc = fcb_append_finish(fcb, &loc);
		zassert_true(rc == 0, "fcb_append_finish call failure");

		areas[i] = loc;
	}

	/* last entry */
	rc = fcb_offset_last_n(fcb, 1, &loc);
	zassert_true(rc == 0, "fcb_offset_last_n call failure");
	zassert_true(areas[4].fe_sector == loc.fe_sector &&
		     areas[4].fe_data_off == loc.fe_data_off &&
		     areas[4].fe_data_len == loc.fe_data_len,
		     "fcb_offset_last_n: fetched wrong n-th location");

	/* somewhere in the middle */
	rc = fcb_offset_last_n(fcb, 3, &loc);
	zassert_true(rc == 0, "fcb_offset_last_n call failure");
	zassert_true(areas[2].fe_sector == loc.fe_sector &&
		     areas[2].fe_data_off == loc.fe_data_off &&
		     areas[2].fe_data_len == loc.fe_data_len,
		     "fcb_offset_last_n: fetched wrong n-th location");

	/* first entry */
	rc = fcb_offset_last_n(fcb, 5, &loc);
	zassert_true(rc == 0, "fcb_offset_last_n call failure");
	zassert_true(areas[0].fe_sector == loc.fe_sector &&
		     areas[0].fe_data_off == loc.fe_data_off &&
		     areas[0].fe_data_len == loc.fe_data_len,
		     "fcb_offset_last_n: fetched wrong n-th location");

	/* after last valid entry, returns the first one like for 5 */
	rc = fcb_offset_last_n(fcb, 6, &loc);
	zassert_true(rc == 0, "fcb_offset_last_n call failure");
	zassert_true(areas[0].fe_sector == loc.fe_sector &&
		     areas[0].fe_data_off == loc.fe_data_off &&
		     areas[0].fe_data_len == loc.fe_data_len,
		     "fcb_offset_last_n: fetched wrong n-th location");
}
```

## src/fcb_test_len.c
```c
/*
 * Copyright (c) 2017-2020 Nordic Semiconductor ASA
 * Copyright (c) 2015 Runtime Inc
 *
 * SPDX-License-Identifier: Apache-2.0
 */

#include "fcb_test.h"

ZTEST(fcb_test_with_2sectors_set, test_fcb_len)
{
	uint8_t buf[3];
	uint16_t len;
	uint16_t len2;
	int rc;
	int rc2;
	struct fcb fcb = { .f_erase_value = fcb_test_erase_value };



	for (len = 0U; len < FCB_MAX_LEN; len++) {
		rc = fcb_put_len(&fcb, buf, len);
		zassert_true(rc == 1 || rc == 2, "fcb_put_len call failure");

		rc2 = fcb_get_len(&fcb, buf, &len2);
		zassert_true(rc2 == rc, "fcb_get_len call failure");

		zassert_true(len == len2, "fcb_get_len call failure");
	}
}
```

## src/fcb_test_multiple_scratch.c
```c
/*
 * Copyright (c) 2017 Nordic Semiconductor ASA
 * Copyright (c) 2015 Runtime Inc
 *
 * SPDX-License-Identifier: Apache-2.0
 */

#include "fcb_test.h"

ZTEST(fcb_test_with_4sectors_set, test_fcb_multi_scratch)
{
	struct fcb *fcb;
	int rc;
	struct fcb_entry loc;
	uint8_t test_data[128] = {0};
	int elem_cnts[4];
	int idx;
	int cnts[4];
	struct append_arg aa_arg = {
		.elem_cnts = cnts
	};

	fcb = &test_fcb;
	fcb->f_scratch_cnt = 1U;

	/*
	 * Now fill up everything. We should be able to get 3 of the sectors
	 * full.
	 */
	(void)memset(elem_cnts, 0, sizeof(elem_cnts));
	while (1) {
		rc = fcb_append(fcb, sizeof(test_data), &loc);
		if (rc == -ENOSPC) {
			break;
		}
		idx = loc.fe_sector - &test_fcb_sector[0];
		elem_cnts[idx]++;

		rc = flash_area_write(fcb->fap, FCB_ENTRY_FA_DATA_OFF(loc),
				      test_data, sizeof(test_data));
		zassert_true(rc == 0, "flash_area_write call failure");

		rc = fcb_append_finish(fcb, &loc);
		zassert_true(rc == 0, "fcb_append_finish call failure");
	}

	zassert_true(elem_cnts[0] > 0, "unexpected entry number was appended");
	zassert_true(elem_cnts[0] == elem_cnts[1] &&
		     elem_cnts[0] == elem_cnts[2],
		     "unexpected entry number was appended");
	zassert_true(elem_cnts[3] == 0, "unexpected entry number was appended");

	/*
	 * Ask to use scratch block, then fill it up.
	 */
	rc = fcb_append_to_scratch(fcb);
	zassert_true(rc == 0, "fcb_append_to_scratch call failure");

	while (1) {
		rc = fcb_append(fcb, sizeof(test_data), &loc);
		if (rc == -ENOSPC) {
			break;
		}
		idx = loc.fe_sector - &test_fcb_sector[0];
		elem_cnts[idx]++;

		rc = flash_area_write(fcb->fap, FCB_ENTRY_FA_DATA_OFF(loc),
				      test_data, sizeof(test_data));
		zassert_true(rc == 0, "flash_area_write call failure");

		rc = fcb_append_finish(fcb, &loc);
		zassert_true(rc == 0, "fcb_append_finish call failure");
	}
	zassert_true(elem_cnts[3] == elem_cnts[0],
		     "unexpected entry number was appended");

	/*
	 * Rotate
	 */
	rc = fcb_rotate(fcb);
	zassert_true(rc == 0, "fcb_rotate call failure");

	(void)memset(&cnts, 0, sizeof(cnts));
	rc = fcb_walk(fcb, NULL, fcb_test_cnt_elems_cb, &aa_arg);
	zassert_true(rc == 0, "fcb_walk call failure");

	zassert_true(cnts[0] == 0, "unexpected entry count");
	zassert_true(cnts[1] > 0, "unexpected entry count");
	zassert_true(cnts[1] == cnts[2] && cnts[1] == cnts[3],
		     "unexpected entry count");

	rc = fcb_append_to_scratch(fcb);
	zassert_true(rc == 0, "fcb_append_to_scratch call failure");
	rc = fcb_append_to_scratch(fcb);
	zassert_true(rc != 0, "fcb_append_to_scratch call should fail");
}
```

## src/fcb_test_reset.c
```c
/*
 * Copyright (c) 2017 Nordic Semiconductor ASA
 * Copyright (c) 2015 Runtime Inc
 *
 * SPDX-License-Identifier: Apache-2.0
 */

#include "fcb_test.h"

ZTEST(fcb_test_with_2sectors_set, test_fcb_reset)
{
	struct fcb *fcb;
	int rc;
	int i;
	struct fcb_entry loc;
	uint8_t test_data[128];
	int var_cnt;
	uint8_t align;
	size_t write_len;

	fcb = &test_fcb;
	align = fcb_get_align(fcb);

	var_cnt = 0;
	rc = fcb_walk(fcb, 0, fcb_test_data_walk_cb, &var_cnt);
	zassert_true(rc == 0, "fcb_walk call failure");
	zassert_true(var_cnt == 0,
		     "fcb_walk: elements count read different than expected");

	rc = fcb_append(fcb, 32, &loc);
	zassert_true(rc == 0, "fcb_append call failure");

	/*
	 * No ready ones yet. CRC should not match.
	 */
	var_cnt = 0;
	rc = fcb_walk(fcb, 0, fcb_test_data_walk_cb, &var_cnt);
	zassert_true(rc == 0, "fcb_walk call failure");
	zassert_true(var_cnt == 0,
		     "fcb_walk: elements count read different than expected");

	for (i = 0; i < sizeof(test_data); i++) {
		test_data[i] = fcb_test_append_data(32, i);
	}
	write_len = ROUND_UP(32, align);
	memset(test_data + 32, 0, write_len - 32);
	rc = flash_area_write(fcb->fap, FCB_ENTRY_FA_DATA_OFF(loc), test_data,
			      write_len);
	zassert_true(rc == 0, "flash_area_write call failure");

	rc = fcb_append_finish(fcb, &loc);
	zassert_true(rc == 0, "fcb_append_finish call failure");

	/*
	 * one entry
	 */
	var_cnt = 32;
	rc = fcb_walk(fcb, 0, fcb_test_data_walk_cb, &var_cnt);
	zassert_true(rc == 0, "fcb_walk call failure");
	zassert_true(var_cnt == 33,
		     "fcb_walk: elements count read different than expected");

	/*
	 * Pretend reset
	 */
	(void)memset(fcb, 0, sizeof(*fcb));
	fcb->f_sector_cnt = 2U;
	fcb->f_sectors = test_fcb_sector;

	rc = fcb_init(TEST_FCB_FLASH_AREA_ID, fcb);
	zassert_true(rc == 0, "fcb_init call failure");

	var_cnt = 32;
	rc = fcb_walk(fcb, 0, fcb_test_data_walk_cb, &var_cnt);
	zassert_true(rc == 0, "fcb_walk call failure");
	zassert_true(var_cnt == 33,
		     "fcb_walk: elements count read different than expected");

	rc = fcb_append(fcb, 33, &loc);
	zassert_true(rc == 0, "fcb_append call failure");

	for (i = 0; i < sizeof(test_data); i++) {
		test_data[i] = fcb_test_append_data(33, i);
	}
	write_len = ROUND_UP(33, align);
	memset(test_data + 33, 0, write_len - 33);
	rc = flash_area_write(fcb->fap, FCB_ENTRY_FA_DATA_OFF(loc), test_data,
			      write_len);
	zassert_true(rc == 0, "flash_area_write call failure");

	rc = fcb_append_finish(fcb, &loc);
	zassert_true(rc == 0, "fcb_append_finish call failure");

	var_cnt = 32;
	rc = fcb_walk(fcb, 0, fcb_test_data_walk_cb, &var_cnt);
	zassert_true(rc == 0, "fcb_walk call failure");
	zassert_true(var_cnt == 34,
		     "fcb_walk: elements count read different than expected");

	/*
	 * Add partial one, make sure that we survive reset then.
	 */
	rc = fcb_append(fcb, 34, &loc);
	zassert_true(rc == 0, "fcb_append call failure");

	(void)memset(fcb, 0, sizeof(*fcb));
	fcb->f_sector_cnt = 2U;
	fcb->f_sectors = test_fcb_sector;

	rc = fcb_init(TEST_FCB_FLASH_AREA_ID, fcb);
	zassert_true(rc == 0, "fcb_init call failure");

	/*
	 * Walk should skip that.
	 */
	var_cnt = 32;
	rc = fcb_walk(fcb, 0, fcb_test_data_walk_cb, &var_cnt);
	zassert_true(rc == 0, "fcb_walk call failure");
	zassert_true(var_cnt == 34,
		     "fcb_walk: elements count read different than expected");

	/* Add a 3rd one, should go behind corrupt entry */
	rc = fcb_append(fcb, 34, &loc);
	zassert_true(rc == 0, "fcb_append call failure");

	for (i = 0; i < sizeof(test_data); i++) {
		test_data[i] = fcb_test_append_data(34, i);
	}
	write_len = ROUND_UP(34, align);
	memset(test_data + 34, 0, write_len - 34);
	rc = flash_area_write(fcb->fap, FCB_ENTRY_FA_DATA_OFF(loc), test_data,
			      write_len);
	zassert_true(rc == 0, "flash_area_write call failure");

	rc = fcb_append_finish(fcb, &loc);
	zassert_true(rc == 0, "fcb_append_finish call failure");

	/*
	 * Walk should skip corrupt entry, but report the next one.
	 */
	var_cnt = 32;
	rc = fcb_walk(fcb, 0, fcb_test_data_walk_cb, &var_cnt);
	zassert_true(rc == 0, "fcb_walk call failure");
	zassert_true(var_cnt == 35,
		     "fcb_walk: elements count read different than expected");
}
```

## src/fcb_test_rotate.c
```c
/*
 * Copyright (c) 2017 Nordic Semiconductor ASA
 * Copyright (c) 2015 Runtime Inc
 *
 * SPDX-License-Identifier: Apache-2.0
 */

#include "fcb_test.h"

ZTEST(fcb_test_with_2sectors_set, test_fcb_rotate)
{
	struct fcb *fcb;
	int rc;
	int old_id;
	struct fcb_entry loc;
	uint8_t test_data[128] = {0};
	int elem_cnts[2] = {0, 0};
	int cnts[2];
	struct append_arg aa_arg = {
		.elem_cnts = cnts
	};

	fcb = &test_fcb;

	old_id = fcb->f_active_id;
	rc = fcb_rotate(fcb);
	zassert_true(rc == 0, "fcb_rotate call failure");
	zassert_true(fcb->f_active_id == old_id + 1,
		     "flash location id should increased");

	/*
	 * Now fill up the
	 */
	while (1) {
		rc = fcb_append(fcb, sizeof(test_data), &loc);
		if (rc == -ENOSPC) {
			break;
		}
		if (loc.fe_sector == &test_fcb_sector[0]) {
			elem_cnts[0]++;
		} else if (loc.fe_sector == &test_fcb_sector[1]) {
			elem_cnts[1]++;
		} else {
			zassert_true(0,
				     "unexpected flash area of appended loc");
		}

		rc = flash_area_write(fcb->fap, FCB_ENTRY_FA_DATA_OFF(loc),
				      test_data, sizeof(test_data));
		zassert_true(rc == 0, "flash_area_write call failure");

		rc = fcb_append_finish(fcb, &loc);
		zassert_true(rc == 0, "fcb_append_finish call failure");
	}
	zassert_true(elem_cnts[0] > 0 && elem_cnts[0] == elem_cnts[1],
		     "unexpected entry number was appended");

	old_id = fcb->f_active_id;
	rc = fcb_rotate(fcb);
	zassert_true(rc == 0, "fcb_rotate call failure");
	zassert_true(fcb->f_active_id == old_id,
		     "flash location should be kept");

	(void)memset(cnts, 0, sizeof(cnts));
	rc = fcb_walk(fcb, NULL, fcb_test_cnt_elems_cb, &aa_arg);
	zassert_true(rc == 0, "fcb_walk call failure");
	zassert_true(aa_arg.elem_cnts[0] == elem_cnts[0] ||
		     aa_arg.elem_cnts[1] == elem_cnts[1],
		     "fcb_walk: entry count got different than expected");
	zassert_true(aa_arg.elem_cnts[0] == 0 || aa_arg.elem_cnts[1] == 0,
		     "fcb_walk: entry count got different than expected");

	/*
	 * One sector is full. The other one should have one entry in it.
	 */
	rc = fcb_append(fcb, sizeof(test_data), &loc);
	zassert_true(rc == 0, "fcb_append call failure");

	rc = flash_area_write(fcb->fap, FCB_ENTRY_FA_DATA_OFF(loc), test_data,
			      sizeof(test_data));
	zassert_true(rc == 0, "flash_area_write call failure");

	rc = fcb_append_finish(fcb, &loc);
	zassert_true(rc == 0, "fcb_append_finish call failure");

	old_id = fcb->f_active_id;
	rc = fcb_rotate(fcb);
	zassert_true(rc == 0, "fcb_rotate call failure");
	zassert_true(fcb->f_active_id == old_id,
		     "flash location should be kept");

	(void)memset(cnts, 0, sizeof(cnts));
	rc = fcb_walk(fcb, NULL, fcb_test_cnt_elems_cb, &aa_arg);
	zassert_true(rc == 0, "fcb_walk call failure");
	zassert_true(aa_arg.elem_cnts[0] == 1 || aa_arg.elem_cnts[1] == 1,
		     "fcb_walk: entry count got different than expected");
	zassert_true(aa_arg.elem_cnts[0] == 0 || aa_arg.elem_cnts[1] == 0,
		     "fcb_walk: entry count got different than expected");
}
```
