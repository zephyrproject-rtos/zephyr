## CMakeLists.txt
```
# SPDX-License-Identifier: Apache-2.0

cmake_minimum_required(VERSION 3.28.0)
find_package(Zephyr REQUIRED HINTS $ENV{ZEPHYR_BASE})
project(fs_lib_link)

FILE(GLOB app_sources src/*.c)
target_sources(app PRIVATE ${app_sources})
```

## prj.conf
```kconfig
CONFIG_FILE_SYSTEM_LIB_LINK=y
CONFIG_FAT_FILESYSTEM_ELM=y
CONFIG_FILE_SYSTEM_LITTLEFS=y
CONFIG_FILE_SYSTEM_EXT2=y
CONFIG_ZTEST=y
```

## app.overlay
```dts
/*
 * Copyright (c) 2023 Nordic Semiconductor ASA
 *
 * SPDX-License-Identifier: Apache-2.0
 */

/ {
	ramdisk0 {
		compatible = "zephyr,ram-disk";
		disk-name = "RAM";
		sector-size = <512>;
		sector-count = <80>;
	};
};
```

## src/main.c
```c
/*
 * Copyright (c) 2025 Embeint Inc
 *
 * SPDX-License-Identifier: Apache-2.0
 */

#include <zephyr/ztest.h>

#include <ff.h>
#include <lfs.h>

ZTEST_SUITE(lib_link, NULL, NULL, NULL, NULL, NULL);

ZTEST(lib_link, test_fs_libraries_linked)
{
	/*
	 * The primary assertion of this test is the build itself: with only
	 * CONFIG_FILE_SYSTEM_LIB_LINK enabled (no CONFIG_FILE_SYSTEM), the
	 * underlying file system libraries must compile and link. Referencing
	 * an API symbol from the libraries meant for direct application use
	 * additionally forces the linker to resolve them, so the libraries
	 * cannot be silently garbage-collected out of the image.
	 */
	zassert_not_null(f_mount, "FAT library not linked");
	zassert_not_null(lfs_mount, "littlefs library not linked");
}
```
