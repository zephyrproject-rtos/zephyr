/*
 * SPDX-FileCopyrightText: Copyright The Zephyr Project Contributors
 * SPDX-License-Identifier: Apache-2.0
 */

/ {
	fake_can: fake_can {
		compatible = "zephyr,fake-can";
		status = "okay";
	};
};
