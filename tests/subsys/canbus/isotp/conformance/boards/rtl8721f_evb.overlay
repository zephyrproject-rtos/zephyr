/*
 * Copyright (c) 2025 Realtek Semiconductor Corp.
 *
 * SPDX-License-Identifier: Apache-2.0
 */

/ {
	chosen {
		zephyr,canbus = &can0;
	};
};

&can0 {
	pinctrl-0 = <&can0_default>;
	pinctrl-names = "default";
	status = "okay";
};
