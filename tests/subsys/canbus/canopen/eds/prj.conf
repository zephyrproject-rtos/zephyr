## CMakeLists.txt
```
# SPDX-FileCopyrightText: Copyright (c) 2026 Linumiz
#
# SPDX-License-Identifier: Apache-2.0

cmake_minimum_required(VERSION 3.28.0)
find_package(Zephyr REQUIRED HINTS $ENV{ZEPHYR_BASE})
project(canopen_eds)

if(CONFIG_TEST_OD_FROM_EDS)
  canopen_od_from_eds(app ${CMAKE_CURRENT_SOURCE_DIR}/test.eds test_od)
  target_sources(app PRIVATE src/od_eds.c)
else()
  target_sources(app PRIVATE src/od_c.c)
endif()

target_sources(app PRIVATE src/main.c)
target_include_directories(app PRIVATE ${ZEPHYR_BASE}/subsys/canbus/canopen)
```

## Kconfig
```
# SPDX-FileCopyrightText: Copyright (c) 2026 Linumiz
#
# SPDX-License-Identifier: Apache-2.0

config TEST_OD_FROM_EDS
	bool "Generate the object dictionary from test.eds"

source "Kconfig.zephyr"
```

## prj.conf
```kconfig
CONFIG_ZTEST=y
CONFIG_CAN=y
CONFIG_CANOPEN=y
CONFIG_CANOPEN_DOMAIN=y
CONFIG_CANOPEN_EDS=y
CONFIG_CANOPEN_EDS_NODE_CONFIG="test_cfg"
CONFIG_CANOPEN_EDS_VENDOR_NAME="Zephyr test"
CONFIG_CANOPEN_EDS_BITRATES="125 500"
CONFIG_CANOPEN_DEVICE_TYPE=0x00020191
CONFIG_CANOPEN_PRODUCT_CODE=0x42
CONFIG_CANOPEN_REVISION_NUMBER=0x00010002
CONFIG_CANOPEN_DEVICE_NAME="EDS test"
CONFIG_CANOPEN_HW_VERSION="1.0"
CONFIG_CANOPEN_HEARTBEAT_PRODUCER_MS=500
CONFIG_CANOPEN_TPDO_COUNT=2
CONFIG_CANOPEN_RPDO_COUNT=2
CONFIG_CANOPEN_PDO_MAPPED_MAX=4
CONFIG_CANOPEN_EMCY_HISTORY_SIZE=2
CONFIG_CANOPEN_HB_CONSUMER_COUNT=2
```

## src/main.c
```c
/*
 * SPDX-FileCopyrightText: Copyright (c) 2026 Linumiz
 *
 * SPDX-License-Identifier: Apache-2.0
 */

#include <zephyr/canbus/canopen.h>
#include <zephyr/sys/printk.h>
#include <zephyr/ztest.h>

#include "canopen_internal.h"

extern const struct canopen_node_config test_cfg;

static void scan_entry(struct canopen_node *node, uint16_t index, uint8_t sub,
		       const struct canopen_od_ref *ref)
{
	uint8_t buf[CONFIG_CANOPEN_SDO_BUFFER_SIZE];
	size_t len = 0U;

	if (((ref->attr & CANOPEN_OD_ATTR_READ) != 0U) && (ref->type != CANOPEN_OD_TYPE_DOMAIN)) {
		zassert_equal(canopen_od_read_wire(ref, buf, sizeof(buf), &len),
			      CANOPEN_SDO_ABORT_NONE, "%04x sub %u", index, sub);
	}

	printk("OD %04x %02x %02x %02x ", index, sub, ref->type, ref->attr);
	for (size_t i = 0U; i < len; i++) {
		printk("%02x", buf[i]);
	}
	printk("\n");
}

ZTEST(canopen_eds, test_scan)
{
	static struct canopen_node node;
	struct canopen_od_ref ref;
	uint32_t abort;

	zassert_ok(canopen_node_init(&node, &test_cfg));

	for (uint32_t index = 0x1000U; index <= UINT16_MAX; index++) {
		for (uint32_t sub = 0U; sub <= UINT8_MAX; sub++) {
			abort = canopen_od_find(&node, index, sub, &ref);
			if (abort == CANOPEN_SDO_ABORT_NO_OBJECT) {
				break;
			}

			if (abort == CANOPEN_SDO_ABORT_NO_DATA) {
				printk("OD %04x %02x nodata\n", index, sub);
			} else if (abort == CANOPEN_SDO_ABORT_NONE) {
				scan_entry(&node, index, sub, &ref);
			}
		}
	}

	printk("OD end\n");
}

ZTEST_SUITE(canopen_eds, NULL, NULL, NULL, NULL, NULL);
```

## src/od_c.c
```c
/*
 * SPDX-FileCopyrightText: Copyright (c) 2026 Linumiz
 *
 * SPDX-License-Identifier: Apache-2.0
 */

#include <zephyr/canbus/canopen.h>
#include <zephyr/drivers/can.h>

static bool flag = true;
static int16_t temperature = -273;
static uint64_t energy = 0x0123456789ABCDEFULL;
static float gain = 1.5f;
static char label[12] = "zephyr";
static uint8_t key[4] = {0xDEU, 0xADU, 0xBEU, 0xEFU};
static uint32_t limits[3] = {10U, 20U, 30U};
static uint8_t mode = 3U;
static uint32_t position = 0xFFFFFFFFU;
static struct {
	uint16_t speed;
	int8_t offset;
} motor = {
	.speed = 1500U,
	.offset = -5,
};

static uint32_t log_read(const struct canopen_od_entry *entry, size_t offset, uint8_t *buf,
			 size_t *len, void *user_data)
{
	ARG_UNUSED(entry);
	ARG_UNUSED(offset);
	ARG_UNUSED(buf);
	ARG_UNUSED(user_data);

	*len = 0U;

	return CANOPEN_SDO_ABORT_NONE;
}

static const struct canopen_od_domain event_log = {
	.read = log_read,
};

CANOPEN_OD_DEFINE(test_od,
	CANOPEN_OD_VAR(0x2000, CANOPEN_OD_TYPE_BOOLEAN, CANOPEN_OD_RW | CANOPEN_OD_ATTR_PERSIST,
		       flag),
	CANOPEN_OD_VAR(0x2001, CANOPEN_OD_TYPE_INTEGER16, CANOPEN_OD_RO | CANOPEN_OD_ATTR_TPDO,
		       temperature),
	CANOPEN_OD_VAR(0x2002, CANOPEN_OD_TYPE_UNSIGNED64, CANOPEN_OD_CONST, energy),
	CANOPEN_OD_VAR(0x2003, CANOPEN_OD_TYPE_REAL32, CANOPEN_OD_WO | CANOPEN_OD_ATTR_RPDO, gain),
	CANOPEN_OD_VAR(0x2004, CANOPEN_OD_TYPE_VISIBLE_STRING, CANOPEN_OD_RW, label),
	CANOPEN_OD_VAR(0x2005, CANOPEN_OD_TYPE_OCTET_STRING, CANOPEN_OD_RO, key),
	CANOPEN_OD_ARRAY(0x2100, CANOPEN_OD_TYPE_UNSIGNED32,
			 CANOPEN_OD_RW | CANOPEN_OD_ATTR_TPDO | CANOPEN_OD_ATTR_RPDO, limits),
	CANOPEN_OD_RECORD(0x2200,
		CANOPEN_OD_SUB(1U, CANOPEN_OD_TYPE_UNSIGNED8, CANOPEN_OD_RW, mode),
		CANOPEN_OD_SUB(4U, CANOPEN_OD_TYPE_UNSIGNED32, CANOPEN_OD_RO | CANOPEN_OD_ATTR_TPDO,
			       position)),
	CANOPEN_OD_RECORD(0x2300,
		CANOPEN_OD_SUB(1U, CANOPEN_OD_TYPE_UNSIGNED16, CANOPEN_OD_RW, motor.speed),
		CANOPEN_OD_SUB(2U, CANOPEN_OD_TYPE_INTEGER8, CANOPEN_OD_RW, motor.offset)),
	CANOPEN_OD_DOMAIN(0x5600, CANOPEN_OD_RO, event_log, NULL),
	CANOPEN_OD_VAR(0x6000, CANOPEN_OD_TYPE_UNSIGNED8, CANOPEN_OD_RO | CANOPEN_OD_ATTR_TPDO,
		       mode));

static const uint32_t tpdo1_map[] = {
	CANOPEN_PDO_MAP(0x2001, 0, 16),
	CANOPEN_PDO_MAP(0x2200, 4, 32),
};

static const uint32_t rpdo2_map[] = {
	CANOPEN_PDO_MAP(0x0005, 0, 8),
	CANOPEN_PDO_MAP(0x2003, 0, 32),
};

static const struct canopen_pdo_config test_tpdo[] = {
	{
		.map = tpdo1_map,
		.map_count = ARRAY_SIZE(tpdo1_map),
		.transmission_type = 1U,
		.sync_start = 2U,
	},
	{
		.cob_id = CANOPEN_PDO_COB_ID_INVALID,
		.transmission_type = CANOPEN_PDO_TYPE_EVENT,
		.inhibit_time = 100U,
		.event_timer = 250U,
	},
	{
		.cob_id = 0x40000000U | 0x3A2U,
		.transmission_type = CANOPEN_PDO_TYPE_EVENT,
	},
	{
		.transmission_type = CANOPEN_PDO_TYPE_EVENT,
	},
	{
		.cob_id = 0x40000000U | 0x4A2U,
		.transmission_type = 0xFFU,
	},
};

static const struct canopen_pdo_config test_rpdo[] = {
	{
		.transmission_type = CANOPEN_PDO_TYPE_EVENT,
	},
	{
		.map = rpdo2_map,
		.map_count = ARRAY_SIZE(rpdo2_map),
		.transmission_type = 0U,
		.event_timer = 50U,
	},
};

static const uint32_t test_hb_consumer[] = {
	(0x05U << 16) | 1000U,
	0U,
	(0x07U << 16) | 2000U,
};

const struct canopen_node_config test_cfg = {
	.can = DEVICE_DT_GET(DT_CHOSEN(zephyr_canbus)),
	.od = &test_od,
	.tpdo = test_tpdo,
	.tpdo_count = ARRAY_SIZE(test_tpdo),
	.rpdo = test_rpdo,
	.rpdo_count = ARRAY_SIZE(test_rpdo),
	.hb_consumer = test_hb_consumer,
	.hb_consumer_count = ARRAY_SIZE(test_hb_consumer),
	.serial_number = 0x12345678U,
	.node_id = 0x22,
};
```

## src/od_eds.c
```c
/*
 * SPDX-FileCopyrightText: Copyright (c) 2026 Linumiz
 *
 * SPDX-License-Identifier: Apache-2.0
 */

#include <zephyr/canbus/canopen.h>
#include <zephyr/drivers/can.h>

#include "test_od.h"

static uint32_t image_write(const struct canopen_od_entry *entry, size_t offset,
			    const uint8_t *buf, size_t len, size_t size, bool last, void *user_data)
{
	ARG_UNUSED(entry);
	ARG_UNUSED(offset);
	ARG_UNUSED(buf);
	ARG_UNUSED(len);
	ARG_UNUSED(size);
	ARG_UNUSED(last);
	ARG_UNUSED(user_data);

	return CANOPEN_SDO_ABORT_NONE;
}

static uint32_t image_read(const struct canopen_od_entry *entry, size_t offset, uint8_t *buf,
			   size_t *len, void *user_data)
{
	ARG_UNUSED(entry);
	ARG_UNUSED(offset);
	ARG_UNUSED(buf);
	ARG_UNUSED(user_data);

	*len = 0U;

	return CANOPEN_SDO_ABORT_NONE;
}

const struct canopen_od_domain x5600_firmware_image = {
	.read = image_read,
	.write = image_write,
};

const struct canopen_node_config test_cfg = {
	.can = DEVICE_DT_GET(DT_CHOSEN(zephyr_canbus)),
	.od = &test_od,
	.tpdo = TEST_OD_TPDO,
	.tpdo_count = TEST_OD_TPDO_COUNT,
	.rpdo = TEST_OD_RPDO,
	.rpdo_count = TEST_OD_RPDO_COUNT,
	.hb_consumer = TEST_OD_HB_CONSUMER,
	.hb_consumer_count = TEST_OD_HB_CONSUMER_COUNT,
	.serial_number = TEST_OD_SERIAL_NUMBER,
	.node_id = 0x22,
};
```
