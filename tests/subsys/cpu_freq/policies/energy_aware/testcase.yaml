## tests/subsys/cpu_freq/policies/energy_aware/testcase.yaml
```yaml
common:
  tags: cpu_freq

tests:
  cpu_freq.energy_aware.soc:
    extra_dtc_overlay_files:
      - pstate-stub.overlay
    platform_allow:
      - qemu_cortex_m3
    integration_platforms:
      - qemu_cortex_m3
    extra_configs:
      - CONFIG_CPU_FREQ_PSTATE_SET_STUB=y

  cpu_freq.energy_aware.slow:
    extra_dtc_overlay_files:
      - pstate-stub.overlay
    platform_allow:
      - qemu_cortex_m3
    integration_platforms:
      - qemu_cortex_m3
    extra_configs:
      - CONFIG_CPU_FREQ_PSTATE_SET_STUB=y
      - CONFIG_CPU_FREQ_POLICY_ENERGY_AWARE_DEADLINE_US=2000

  cpu_freq.energy_aware.mid:
    extra_dtc_overlay_files:
      - pstate-stub.overlay
    platform_allow:
      - qemu_cortex_m3
    integration_platforms:
      - qemu_cortex_m3
    extra_configs:
      - CONFIG_CPU_FREQ_PSTATE_SET_STUB=y
      - CONFIG_CPU_FREQ_POLICY_ENERGY_AWARE_DEADLINE_US=500

  cpu_freq.energy_aware.miss:
    extra_dtc_overlay_files:
      - pstate-stub.overlay
    platform_allow:
      - qemu_cortex_m3
    integration_platforms:
      - qemu_cortex_m3
    extra_configs:
      - CONFIG_CPU_FREQ_PSTATE_SET_STUB=y
      - CONFIG_CPU_FREQ_POLICY_ENERGY_AWARE_DEADLINE_US=50
```

## tests/subsys/cpu_freq/policies/on_demand/boards/nrf54h20dk_nrf54h20_cpuapp.conf
```kconfig
# Clock control is used to apply DVFS oppoint to the
# NRF_IRON_HSFLL_LOCAL clock which is the CPU clock
CONFIG_CLOCK_CONTROL=y
# Ensure CPU clock is initialized to its lowest oppoint
# on boot.
CONFIG_CLOCK_CONTROL_NRF_IRON_HSFLL_LOCAL_REQ_LOW_FREQ=y
```

## tests/subsys/cpu_freq/policies/on_demand/testcase.yaml
```yaml
tests:
  subsys.cpu_freq.policies.on_demand:
    platform_allow:
      - native_sim
      - native_sim/native/64
    tags: cpu_freq
    integration_platforms:
      - native_sim
      - native_sim/native/64
```

## tests/subsys/cpu_workload/estimator/testcase.yaml
```yaml
common:
  tags: cpu_workload

tests:
  subsys.cpu_workload.estimator:
    platform_allow:
      - qemu_cortex_m3
    integration_platforms:
      - qemu_cortex_m3
```

## tests/subsys/crc/testcase.yaml
```yaml
tests:
  subsys.crc:
    depends_on: crc
    tags:
      - subsys
      - crc
    harness: ztest
```

## tests/subsys/debug/assert_custom_header/testcase.yaml
```yaml
common:
  integration_platforms:
    - native_sim
  platform_allow:
    - native_sim
    - native_sim/native/64
    - qemu_x86
    - qemu_cortex_m3

tests:
  debug.assert_custom_header:
    tags:
      - assert_custom_header
      - assert
```

## tests/subsys/debug/coredump/testcase.yaml
```yaml
tests:
  debug.coredump.logging_backend:
    tags: coredump
    ignore_faults: true
    ignore_qemu_crash: true
    filter: CONFIG_ARCH_SUPPORTS_COREDUMP
    platform_exclude: acrn_ehl_crb
    arch_exclude:
      - posix
    integration_platforms:
      - qemu_x86
    harness: console
    harness_config:
      type: multi_line
      regex:
        - "Coredump: (.*)"
        - ">>> ZEPHYR FATAL ERROR "
        - "E: #CD:BEGIN#"
        - "E: #CD:5([aA])45([0-9a-fA-F]+)"
        - "E: #CD:41([0-9a-fA-F]+)"
        - "E: #CD:4([dD])([0-9a-fA-F]+)"
        - "E: #CD:4([dD])([0-9a-fA-F]+)"
        - "E: #CD:END#"
        - "k_sys_fatal_error_handler"
  debug.coredump.logging_backend.userspace:
    tags: coredump
    ignore_faults: true
    ignore_qemu_crash: true
    filter: CONFIG_ARCH_SUPPORTS_COREDUMP and CONFIG_ARCH_HAS_USERSPACE
    extra_configs:
      - CONFIG_TEST_USERSPACE=y
    integration_platforms:
      - qemu_x86
    platform_allow:
      - qemu_riscv32
      - qemu_riscv64
      - qemu_x86
      - qemu_x86_64
      - qemu_xtensa/dc233c/mmu
    harness: console
    harness_config:
      type: multi_line
      regex:
        - "Coredump: (.*)"
        - ">>> ZEPHYR FATAL ERROR "
        - "E: #CD:BEGIN#"
        - "E: #CD:5([aA])45([0-9a-fA-F]+)"
        - "E: #CD:41([0-9a-fA-F]+)"
        - "E: #CD:4([dD])([0-9a-fA-F]+)"
        - "E: #CD:4([dD])([0-9a-fA-F]+)"
        - "E: #CD:4([dD])([0-9a-fA-F]+)"
        - "E: #CD:END#"
        - "k_sys_fatal_error_handler"
```

## tests/subsys/debug/coredump_app_dump/Kconfig
```kconfig
# Copyright (c) 2026 Advanced Micro Devices, Inc.
#
# SPDX-License-Identifier: Apache-2.0

mainmenu "coredump_app_dump test"
source "Kconfig.zephyr"
```

## tests/subsys/debug/coredump_app_dump/testcase.yaml
```yaml
tests:
  debug.coredump.app_dump:
    tags:
      - coredump
      - debug
    platform_allow:
      - qemu_x86
      - qemu_x86_64
      - qemu_cortex_m3
      - versalnet_apu
      - versalnet_apu/amd_versalnet_apu/smp
    ignore_faults: true
    ignore_qemu_crash: true
    timeout: 300
    integration_platforms:
      - qemu_x86
      - qemu_cortex_m3
    harness: ztest
    harness_config:
      type: one_line
      regex:
        - "SUITE PASS"
```

## tests/subsys/debug/coredump_backends/testcase.yaml
```yaml
common:
  tags: coredump
  ignore_faults: true
  ignore_qemu_crash: true
  arch_exclude:
    - posix
  integration_platforms:
    - qemu_x86
tests:
  debug.coredump.backends.logging:
    filter: CONFIG_ARCH_SUPPORTS_COREDUMP
    platform_exclude: acrn_ehl_crb
    extra_configs:
      - CONFIG_TEST_STORED_COREDUMP=n
  debug.coredump.backends.flash:
    filter: CONFIG_ARCH_SUPPORTS_COREDUMP
    extra_args: CONF_FILE=prj_flash_partition.conf
    extra_configs:
      - CONFIG_TEST_STORED_COREDUMP=y
    platform_allow:
      - qemu_x86
      - esp32_devkitc_wroom/esp32/procpu
      - esp32_devkitc_wrover/esp32/procpu
      - esp32s2_saola
      - esp32s3_devkitm/esp32s3/procpu
      - esp32c3_devkitm
  debug.coredump.backends.other:
    filter: CONFIG_ARCH_SUPPORTS_COREDUMP
    extra_args: CONF_FILE=prj_backend_other.conf
    extra_configs:
      - CONFIG_TEST_STORED_COREDUMP=y
    platform_exclude: acrn_ehl_crb
```

## tests/subsys/debug/coredump_memory/testcase.yaml
```yaml
tests:
  coredump.memory.custom:
    tags: ignore_faults ignore_qemu_crash
    filter: CONFIG_ARCH_SUPPORTS_COREDUMP
    platform_exclude: acrn_ehl_crb
    harness: console
    harness_config:
      type: multi_line
      regex:
        - "E: #CD:BEGIN#"
        - "E: #CD:4([dD])([0-9a-fA-F]+)"
        - "E: #CD:4([dD])([0-9a-fA-F]+)"
        - "E: #CD:4([dD])([0-9a-fA-F]+)"
        - "E: #CD:ababababcdcdcdcdefefefef"
        - "E: #CD:END#"
```

## tests/subsys/debug/coredump_threads/testcase.yaml
```yaml
# Copyright Meta Platforms, Inc. and its affiliates.
# SPDX-License-Identifier: Apache-2.0

common:
  tags:
    - coredump
  ignore_faults: true
  ignore_qemu_crash: true
  integration_platforms:
    - qemu_cortex_m3
    - qemu_riscv32
    - qemu_riscv64
    - qemu_riscv32e
tests:
  debug.coredump.threads:
    platform_exclude:
      # In S-mode ARCH_EXCEPT calls z_riscv_fatal_error() with esf=NULL;
      # arch_coredump_info_dump() returns immediately when esf is NULL so
      # the coredump output is never produced.
      - qemu_riscv64/qemu_virt_riscv64/smode
    filter: CONFIG_DEBUG_COREDUMP_MEMORY_DUMP_THREADS and CONFIG_MP_MAX_NUM_CPUS == 1
    harness: console
    harness_config:
      type: multi_line
      # Verify core dump contains threads metadata section and several
      # memory sections, two for each thread
      regex:
        - "E: #CD:BEGIN#"
        - "E: #CD:5([aA])45([0-9a-fA-F]+)"
        - "E: #CD:41([0-9a-fA-F]+)"
        - "E: #CD:54([0-9a-fA-F]+)"
        - "E: #CD:4([dD])([0-9a-fA-F]+)"
        - "E: #CD:4([dD])([0-9a-fA-F]+)"
        - "E: #CD:4([dD])([0-9a-fA-F]+)"
        - "E: #CD:4([dD])([0-9a-fA-F]+)"
        - "E: #CD:4([dD])([0-9a-fA-F]+)"
        - "E: #CD:4([dD])([0-9a-fA-F]+)"
        - "E: #CD:4([dD])([0-9a-fA-F]+)"
        - "E: #CD:4([dD])([0-9a-fA-F]+)"
        - "E: #CD:4([dD])([0-9a-fA-F]+)"
        - "E: #CD:4([dD])([0-9a-fA-F]+)"
        - "E: #CD:END#"
```

## tests/subsys/debug/cpu_load/testcase.yaml
```yaml
common:
  tags: cpu_load
  arch_allow:
    - arm
    - arm64
    - riscv
  filter: CONFIG_CPU_LOAD
tests:
  debug.cpu_load:
    integration_platforms:
      - mps2/an385
      - qemu_cortex_m3
  debug.cpu_load.counter:
    platform_allow:
      - nrf52840dk/nrf52840
      - nrf54h20dk/nrf54h20/cpuapp
      - qemu_cortex_m3
    integration_platforms:
      - nrf52840dk/nrf52840
      - qemu_cortex_m3
    extra_configs:
      - CONFIG_CPU_LOAD_USE_COUNTER=y
  debug.cpu_load.periodic_report:
    integration_platforms:
      - mps2/an385
      - qemu_cortex_m3
    extra_configs:
      - CONFIG_CPU_LOAD_LOG_PERIODICALLY=50
      - CONFIG_LOG=y
      - CONFIG_TEST_LOGGING_DEFAULTS=n
      - CONFIG_LOG_PRINTK=n
      - CONFIG_LOG_BACKEND_UART=n
      - CONFIG_LOG_MODE_IMMEDIATE=y
```

## tests/subsys/debug/cpu_stats/testcase.yaml
```yaml
common:
  tags: cpu_stats
  filter: CONFIG_CPU_CORTEX_M and not SMP
tests:
  debug.cpu_stats:
    integration_platforms:
      - mps2/an385
  debug.cpu_stats.counter:
    platform_allow:
      - nrf52840dk/nrf52840
    integration_platforms:
      - nrf52840dk/nrf52840
    extra_configs:
      - CONFIG_CPU_STATS_USE_COUNTER=y
  debug.cpu_stats.periodic_report:
    integration_platforms:
      - mps2/an385
    extra_configs:
      - CONFIG_CPU_STATS_LOG_PERIODICALLY=50
      - CONFIG_LOG=y
      - CONFIG_TEST_LOGGING_DEFAULTS=n
      - CONFIG_LOG_PRINTK=n
      - CONFIG_LOG_BACKEND_UART=n
      - CONFIG_LOG_MODE_IMMEDIATE=y
```

## tests/subsys/debug/cs_trace_defmt/testcase.yaml
```yaml
tests:
  debug.cs_trace_defmt:
    tags: debug
    integration_platforms:
      - native_sim
```

## tests/subsys/debug/gdb_server/testcase.yaml
```yaml
tests:
  test:
    build_only: true
    platform_whitelist: qemu_x86
    tags: apps
```

## tests/subsys/debug/gdbstub/testcase.yaml
```yaml
#
# Copyright (c) 2020, 2023 intel Corporation.
#
# SPDX-License-Identifier: Apache-2.0
#

tests:
  # Connect to Zephyr gdbstub and run a simple GDB script
  debug.gdbstub.breakpoints:
    platform_allow: qemu_x86
    harness: pytest
    harness_config:
      pytest_root:
        - "pytest/test_gdbstub.py"
      pytest_args:
        - "--gdb_timeout"
        - "20"
        - "--gdb_script"
        - "test_breakpoints.gdbinit"
        - "--gdb_target_remote"
        - "tcp::5678"
    tags:
      - debug
      - gdbstub
    extra_configs:
      # Make sure the gdbstub port chosen is unique for this test to avoid conflicts
      # when Twister runs tests in parallel on the same host.
      - CONFIG_QEMU_EXTRA_FLAGS="-serial tcp::5678,server"

  # Connect to QEMU gdbstub backend and run the same GDB test script
  # to check it against a reference RDP backend implementation expecting
  # similar behavior as for Zephyr's gdbstub.
  # Use non-default QEMU gdbstub port 1235 for this test to avoid conflicts
  # with some other test on QEMU running in parallel.
  debug.gdbstub_qemu.breakpoints:
    platform_allow: qemu_x86
    harness: pytest
    harness_config:
      pytest_root:
        - "pytest/test_gdbstub.py"
      pytest_args:
        - "--gdb_timeout"
        - "20"
        - "--gdb_script"
        - "test_breakpoints.gdbinit"
        - "--gdb_target_remote"
        - "tcp::1235"
    tags:
      - debug
      - gdbstub
    extra_configs:
      # Turn off Zephyr's gdbstub for this test case.
      - CONFIG_GDBSTUB=n
      - CONFIG_GDBSTUB_SERIAL_BACKEND=n
      # Make sure the gdbstub port chosen is unique for this test to avoid conflicts
      # when Twister runs tests in parallel on the same host.
      - CONFIG_QEMU_EXTRA_FLAGS="-S -gdb tcp::1235"
      # Clear QEMU default 'tcp::1234'
      - CONFIG_QEMU_GDBSERVER_LISTEN_DEV=""
```

## tests/subsys/debug/gdbstub_serial/testcase.yaml
```yaml
#
# Copyright (c) 2023 Intel Corporation.
#
# SPDX-License-Identifier: Apache-2.0
#

common:
  tags:
    - debug
    - gdbstub
  filter: CONFIG_ARCH_HAS_GDBSTUB
  integration_platforms:
    - qemu_x86

tests:
  # The Test Harness consumes log from its Handler as usual.
  # The GDBstub Agent runs in parallel, its log is not parsed only saved by GDB.
  debug.gdbstub_serial.harness_agent_runs:
    platform_allow:
      - qemu_x86
    harness_config:
      agent_class: gdbagent
      agent_options: gdb_breakpoints_basic.gdb
      agent_check_exit_status: false

  # Unsupported modes:
  # - single Harness ignores log from its Handler, but process log from its Agent
  # - single Harness processes both logs from its Handler and Agent simultaneously.
  #

  # The Test Harness consumes log from its Handler as usual.
  # The Debug Harness runs GDBstub Agent and match its patterns there.
  debug.gdbstub_serial.harness_debug_agent_only:
    platform_allow:
      - qemu_x86
    debug_harness: console
    debug_harness_config:
      agent_class: gdbagent
      agent_options: gdb_breakpoints_basic.gdb
      agent_check_exit_status: false
      type: multi_line
      ordered: true
      regex:
        - "arch_gdb_init"
        - "Breakpoint 1 at 0x"
        - "Breakpoint 2 at 0x"
        - "Breakpoint 3 at 0x"
        - "Breakpoint 4 at 0x"
        - "Breakpoint 5 at 0x"
        - "Breakpoint 1, main"
        - "Breakpoint 2, _gdbstub_test_gdb_breakpoints_basic_wrapper "
        - "Breakpoint 3, gdbstub_test_gdb_breakpoints_basic"
        - "TEST_GDB_CMD:Start"
        - "Breakpoint 4, function_1"
        - "Breakpoint 5, function_1_1"
        - "Breakpoint 4, function_1"
        - "(Target disconnected|Remote connection closed)"

  # The Console Harness consumes log from its Handler as usual and match patterns.
  # The Debug Harness runs GDBstub Agent and match its patterns as well.
  debug.gdbstub_serial.harness_debug_agent_both:
    platform_allow:
      - qemu_x86
    debug_harness: console
    debug_harness_config:
      agent_class: gdbagent
      agent_options: gdb_breakpoints_basic.gdb
      agent_check_exit_status: false
      type: multi_line
      ordered: true
      regex:
        - "arch_gdb_init"
        - "Breakpoint 1 at 0x"
        - "Breakpoint 2 at 0x"
        - "Breakpoint 3 at 0x"
        - "Breakpoint 4 at 0x"
        - "Breakpoint 5 at 0x"
        - "Breakpoint 1, main"
        - "Breakpoint 2, _gdbstub_test_gdb_breakpoints_basic_wrapper "
        - "Breakpoint 3, gdbstub_test_gdb_breakpoints_basic"
        - "TEST_GDB_CMD:Start"
        - "Breakpoint 4, function_1"
        - "Breakpoint 5, function_1_1"
        - "Breakpoint 4, function_1"
        - "(Target disconnected|Remote connection closed)"
    harness: console
    harness_config:
      type: multi_line
      ordered: true
      regex:
        - "Booting from ROM"
        - "Booting Zephyr OS build"
        - "TEST_GDB_CMD:Start"
        - "TEST_GDB_CMD:Exit:function_1_1.*res=40"
        - "TEST_GDB_CMD:Exit:function_1.*res=40"
        - "TEST_GDB_CMD:Exit:function_1_1.*res=60"
        - "TEST_GDB_CMD:Exit:function_1.*res=60"
        - "TEST_GDB_CMD:Done"
  #
#
```

## tests/subsys/debug/mipi_stp_decoder/testcase.yaml
```yaml
tests:
  debug.mipi_stp_decoder:
    filter: not CONFIG_BIG_ENDIAN
    tags: stp_decoder
    integration_platforms:
      - native_sim
```

## tests/subsys/debug/symtab/testcase.yaml
```yaml
# SPDX-License-Identifier: Apache-2.0
common:
  platform_allow:
    - qemu_riscv/qemu_virt_riscv/rv32
    - qemu_riscv/qemu_virt_riscv/rv64
    - qemu_cortex_a53
    - qemu_cortex_m3
    - qemu_xtensa/dc233c
  tags:
    - debug
    - symtab

tests:
  debug.symtab: {}
```
