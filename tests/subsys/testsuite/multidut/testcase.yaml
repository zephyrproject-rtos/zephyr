## tests/subsys/testsuite/multidut/testcase.yaml
```yaml
common:
  tags:
    - test_framework
    - pytest
    - shell
    - multidut
  filter: CONFIG_SERIAL and not CONFIG_SMP and dt_chosen_enabled("zephyr,shell-uart")
  min_ram: 40
  platform_type:
    - mcu
    - native
  extra_configs:
    - arch:posix:CONFIG_UART_NATIVE_PTY_0_ON_STDINOUT=y
  integration_platforms:
    - nrf52840dk/nrf52840
  harness: pytest

tests:
  multidut.basic:
    harness_config:
      pytest_root:
        - "pytest/test_multiple_duts.py::test_multidut_check_history"
      required_devices:
        # second device required, with the same platform and application
        - {}

  multidut.fixed_platform:
    harness_config:
      pytest_root:
        - "pytest/test_multiple_duts.py::test_multidut_check_history"
      required_devices:
        # second device fixed to a specific platform
        - platform: nrf52840dk/nrf52840

  multidut.other_application:
    harness_config:
      pytest_root:
        - "pytest/test_multiple_duts.py"
      required_devices:
        # second device required, with a different application
        - application: multidut.basic
    extra_args:
      - CONFIG_BOOT_BANNER_STRING="Banner changed Zephyr OS"
```

## tests/subsys/tracing/testcase.yaml
```yaml
tests:
  tracing.transport:
    tags: tracing_disabled
  tracing.transport.uart:
    extra_args: CONF_FILE="prj_uart.conf"
    filter: CONFIG_UART_CONSOLE
    tags: tracing_uart
  tracing.transport.usb:
    extra_args: CONF_FILE="prj_usb.conf"
    filter: CONFIG_UART_CONSOLE
    tags: tracing_usb
```

## tests/subsys/tracing/tracing_api/testcase.yaml
```yaml
common:
  platform_allow: qemu_x86
  extra_args: CONF_FILE="prj.conf"

tests:
  tracing.transport.uart.async.test:
    tags: tracing_testing
  tracing.transport.uart.sync.test:
    extra_configs:
      - CONFIG_TRACING_SYNC=y
```

## tests/subsys/tracing/tracing_format_module/Kconfig
```kconfig
# Copyright The Zephyr Project Contributors
# SPDX-License-Identifier: Apache-2.0

# Emulate what an out-of-tree module's Kconfig does to register a tracing format:
# point CONFIG_TRACING_FORMAT_HEADER (a promptless string set only via defaults)
# at the format's header. No edits to the Zephyr core tree are required.
config TRACING_FORMAT_HEADER
	default "custom_trace_format.h" if TRACING

source "Kconfig.zephyr"
```

## tests/subsys/tracing/tracing_sys/testcase.yaml
```yaml
tests:
  tracing.tracing_sys.transport.uart:
    platform_allow: qemu_x86 qemu_x86_64
    extra_args: CONF_FILE="prj_uart.conf"
    tags: tracing testing
    harness: pytest
```

## tests/subsys/ufs/testcase.yaml
```yaml
common:
  depends_on: ufs
  tags:
    - subsys
    - ufs
tests:
  ufs.ufs_api:
    harness: ztest
    harness_config:
      fixture: fixture_ufs
    filter: dt_alias_exists("ufs0")
    tags: ufs
```

## tests/subsys/usb/cdc_acm/Kconfig
```kconfig
# SPDX-FileCopyrightText: Copyright The Zephyr Project Contributors
# SPDX-License-Identifier: Apache-2.0

config SYS_CLOCK_TICKS_PER_SEC
	default 1000000 if BOARD_NATIVE_SIM

# Source common USB sample options used to initialize new experimental USB
# device stack. The scope of these options is limited to USB samples in project
# tree, you cannot use them in your own application.
source "samples/subsys/usb/common/Kconfig.sample_usbd"

source "Kconfig.zephyr"
```

## tests/subsys/usb/cdc_ecm/boards/native_sim_64.conf
```kconfig
# SPDX-FileCopyrightText: Copyright 2025 - 2026 NXP
# SPDX-License-Identifier: Apache-2.0

CONFIG_SYS_CLOCK_TICKS_PER_SEC=1000000
```

## tests/subsys/usb/desc_sections/testcase.yaml
```yaml
tests:
  usb.desc_sections:
    pre-filter: subsys_dt_compat_enabled("usb")
    tags: usb desc_sections
```

## tests/subsys/usb/device/testcase.yaml
```yaml
tests:
  usb.device:
    pre-filter: subsys_dt_compat_enabled("usb")
    tags: usb
```

## tests/subsys/usb/device_next/testcase.yaml
```yaml
tests:
  usb.device_next:
    platform_allow:
      - native_sim
      - native_sim/native/64
      - qemu_cortex_m3
    integration_platforms:
      - native_sim
    tags: usb
  usb.device_next.build_all:
    platform_allow:
      - native_sim
      - native_sim/native/64
    integration_platforms:
      - native_sim
    tags: usb
    extra_args:
      - CONF_FILE="build_all.conf"
      - EXTRA_DTC_OVERLAY_FILE="build_all.overlay"
    build_only: true
```

## tests/subsys/usb/host/class_api/testcase.yaml
```yaml
tests:
  usb.host.class_api:
    platform_allow:
      - native_sim
      - native_sim/native/64
      - qemu_cortex_m3
    integration_platforms:
      - native_sim
    tags: usb
  usb.host.class_api.build_all:
    platform_allow:
      - native_sim
      - native_sim/native/64
    integration_platforms:
      - native_sim
    tags: usb
    build_only: true
```

## tests/subsys/usb/host/desc/testcase.yaml
```yaml
tests:
  usb.host.desc:
    platform_allow:
      - native_sim
      - native_sim/native/64
      - qemu_cortex_m3
    integration_platforms:
      - native_sim
    tags: usb
```

## tests/subsys/usb/host/testcase.yaml
```yaml
tests:
  usb.host:
    platform_allow:
      - native_sim
      - native_sim/native/64
    integration_platforms:
      - native_sim
    tags: usb
```

## tests/subsys/usb/os_desc/testcase.yaml
```yaml
tests:
  usb.osdesc:
    platform_allow:
      - native_posix/native
      - native_posix/native/64
      - native_sim/native
      - native_sim/native/64
      - frdm_k64f/mk64f12
    tags:
      - usb
      - osdesc
    integration_platforms:
      - native_sim/native
```

## tests/subsys/usb/uac2/testcase.yaml
```yaml
tests:
  usb.uac2:
    depends_on: usb_device
    tags: usb
    platform_allow:
      - native_sim/native
      - qemu_cortex_m3/ti_lm3s6965
    integration_platforms:
      - native_sim/native
```

## tests/subsys/usb/uvc/testcase.yaml
```yaml
tests:
  usb.uvc:
    tags:
      - usb
      - video
    platform_allow:
      - native_sim/native
      - native_sim/native/64
    integration_platforms:
      - native_sim/native
    extra_args:
      - platform:native_sim/native:SNIPPET="video-sw-generator"
      - platform:native_sim/native/64:SNIPPET="video-sw-generator"
```

## tests/subsys/usb_c/sink/dts/bindings/mock-tcpc.yaml
```yaml
# Copyright 2023 The Chromium OS Authors
# SPDX-License-Identifier: Apache-2.0

description: |
    Mock TypeC Port Controller used for testing

compatible: "mock-tcpc"
```

## tests/subsys/usb_c/sink/dts/bindings/mock-vbus-adc.yaml
```yaml
# Copyright 2023 The Chromium OS Authors
# SPDX-License-Identifier: Apache-2.0

description: |
    Mock VBUS used for testing

compatible: "mock-vbus-adc"
```

## tests/subsys/usb_c/sink/testcase.yaml
```yaml
tests:
  usb_c.sink:
    platform_exclude: qemu_leon3 qemu_malta_be qemu_x86_64 qemu_riscv64_smp
                      qemu_cortex_a53_smp qemu_riscv32_smp
    tags: usb_c
```

## tests/subsys/video/test_pattern/boards/aik_ra8d1.conf
```kconfig
CONFIG_TEST_FRAMES_TOTAL=100
CONFIG_VIDEO_BUFFER_POOL_HEAP_SIZE=33000
CONFIG_VIDEO_BUFFER_POOL_NUM_MAX=1
CONFIG_TEST_FRAME_HEIGHT=64
CONFIG_TEST_FRAME_WIDTH=256
CONFIG_TEST_LAB_THRESHOLD=30
CONFIG_TEST_PATTERN_CTRL=0
```

## tests/subsys/video/test_pattern/boards/native_sim_native_64.conf
```kconfig
CONFIG_VIDEO_BUFFER_POOL_HEAP_SIZE=33000
CONFIG_VIDEO_BUFFER_POOL_NUM_MAX=1
CONFIG_TEST_FRAME_HEIGHT=64
CONFIG_TEST_FRAME_WIDTH=256
CONFIG_TEST_PIXEL_FORMAT="RGBP"
CONFIG_TEST_LAB_THRESHOLD=30
CONFIG_TEST_PATTERN_CTRL=0
```
