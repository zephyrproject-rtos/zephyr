## CMakeLists.txt
```
# SPDX-License-Identifier: Apache-2.0

cmake_minimum_required(VERSION 3.13.1)
include($ENV{ZEPHYR_BASE}/cmake/app/boilerplate.cmake NO_POLICY_SCOPE)
project(stub)

target_sources(app PRIVATE src/main.c)
```

## prj.conf
```kconfig
# Our only mission is to start the ARC in an Arduino platform so we
# can pipe its output to the serial port.
CONFIG_BOOT_BANNER=n
```

## src/main.c
```c
/*
 * Copyright (c) 2012-2014 Wind River Systems, Inc.
 *
 * SPDX-License-Identifier: Apache-2.0
 */

void main(void)
{
	/* Quark: this is an x86 stub to just run ARC; it does nothing
	 * but start the x86 kernel so it will pass messages from the
	 * ARC processor via the IPM module.
	 *
	 * There is a solution planned for the future that will allow
	 * this workaround to be removed (without need to support
	 * backwards compatibility). */
}
```
