## CMakeLists.txt
```
# SPDX-License-Identifier: Apache-2.0

cmake_minimum_required(VERSION 3.28.0)

find_package(Zephyr REQUIRED HINTS $ENV{ZEPHYR_BASE})
project(code_relocation_extmem)

target_sources(app PRIVATE src/main.c src/extmem.c)

# PSRAM is initialized after .bss is zeroed: only NOINIT can be relocated there.
zephyr_code_relocate(FILES src/extmem.c LOCATION EXTMEM_NOINIT)
```

## prj.conf
```kconfig
CONFIG_ZTEST=y
CONFIG_ESP_SPIRAM=y
CONFIG_CODE_DATA_RELOCATION=y
CONFIG_INIT_STACKS=y
CONFIG_THREAD_STACK_INFO=y
```

## src/main.c
```c
/*
 * SPDX-FileCopyrightText: Copyright The Zephyr Project Contributors
 * SPDX-FileCopyrightText: Copyright (c) 2026 Kirill Shypachov
 * SPDX-License-Identifier: Apache-2.0
 */

#include <zephyr/devicetree.h>
#include <zephyr/kernel.h>
#include <zephyr/ztest.h>

#include "extmem.h"

#define EXTMEM_BASE DT_REG_ADDR(DT_NODELABEL(ext_mem))
#define EXTMEM_END  (EXTMEM_BASE + CONFIG_ESP_SPIRAM_SIZE)
#define SRAMHP_BASE DT_REG_ADDR(DT_NODELABEL(sramhp))
#define SRAMHP_END  (SRAMHP_BASE + DT_REG_SIZE(DT_NODELABEL(sramhp)))

#define DEPTH 24

/*
 * Generated by the relocation script for the EXTMEM NOINIT output section.
 * Weak: without the hook in the SoC linker script they stay undefined (NULL)
 * and the test reports it instead of failing to link.
 */
extern char __extmem_noinit_reloc_start[] __attribute__((weak));
extern char __extmem_noinit_reloc_end[] __attribute__((weak));

/* Not relocated: stays with the other .noinit data in SRAM. */
static __noinit uint8_t sram_buf[64];

static struct k_thread worker;
static K_SEM_DEFINE(worker_done, 0, 1);
static volatile uint32_t worker_result;

static bool in_range(const void *p, size_t len, uintptr_t lo, uintptr_t hi)
{
	uintptr_t a = (uintptr_t)p;

	return a >= lo && a + len <= hi;
}

static __noinline uint32_t recurse(uint32_t n)
{
	volatile uint8_t pad[96];
	uint32_t r;

	pad[1] = (uint8_t)n;
	if (n == 0) {
		return 0;
	}
	r = recurse(n - 1);

	/* The volatile reads keep this frame alive across the call. */
	return r + n + pad[1] - pad[1];
}

static void worker_entry(void *a, void *b, void *c)
{
	ARG_UNUSED(a);
	ARG_UNUSED(b);
	ARG_UNUSED(c);

	worker_result = recurse(DEPTH);
	k_sem_give(&worker_done);
}

ZTEST(code_relocation_extmem, test_buffer_in_extmem)
{
	zassert_true(in_range(extmem_buf, sizeof(extmem_buf), EXTMEM_BASE, EXTMEM_END),
		     "extmem_buf at %p, not in EXTMEM [0x%lx, 0x%lx)", (void *)extmem_buf,
		     (unsigned long)EXTMEM_BASE, (unsigned long)EXTMEM_END);
}

ZTEST(code_relocation_extmem, test_stack_in_relocated_section)
{
	zassert_not_null(__extmem_noinit_reloc_start,
			 "CODE_DATA_RELOCATION hook not present in the SoC linker script");
	zassert_true(in_range(extmem_stack, K_THREAD_STACK_SIZEOF(extmem_stack), EXTMEM_BASE,
			      EXTMEM_END),
		     "extmem_stack at %p, not in EXTMEM", (void *)extmem_stack);
	zassert_true((char *)extmem_stack >= __extmem_noinit_reloc_start &&
			     (char *)extmem_stack + K_THREAD_STACK_SIZEOF(extmem_stack) <=
				     __extmem_noinit_reloc_end,
		     "extmem_stack outside [%p, %p)", (void *)__extmem_noinit_reloc_start,
		     (void *)__extmem_noinit_reloc_end);
}

ZTEST(code_relocation_extmem, test_thread_on_extmem_stack)
{
	size_t unused = 0;

	k_thread_create(&worker, extmem_stack, K_THREAD_STACK_SIZEOF(extmem_stack), worker_entry,
			NULL, NULL, NULL, K_PRIO_PREEMPT(1), 0, K_NO_WAIT);
	zassert_ok(k_sem_take(&worker_done, K_SECONDS(2)),
		   "thread on the EXTMEM stack did not finish");
	zassert_equal(worker_result, DEPTH * (DEPTH + 1) / 2, "wrong result %u", worker_result);
	zassert_ok(k_thread_join(&worker, K_SECONDS(1)));
	zassert_ok(k_thread_stack_space_get(&worker, &unused));
	zassert_true(unused <= EXTMEM_STACK_SIZE / 2, "only %zu of %d bytes used",
		     (size_t)EXTMEM_STACK_SIZE - unused, EXTMEM_STACK_SIZE);
}

ZTEST(code_relocation_extmem, test_other_noinit_stays_in_sram)
{
	zassert_true(in_range(sram_buf, sizeof(sram_buf), SRAMHP_BASE, SRAMHP_END),
		     "sram_buf at %p, not in SRAM HP", (void *)sram_buf);
}

ZTEST(code_relocation_extmem, test_buffer_read_write)
{
	for (size_t i = 0; i < sizeof(extmem_buf); i++) {
		extmem_buf[i] = (uint8_t)(i * 7U + 3U);
	}
	for (size_t i = 0; i < sizeof(extmem_buf); i++) {
		zassert_equal(extmem_buf[i], (uint8_t)(i * 7U + 3U), "mismatch at %zu", i);
	}
}

ZTEST_SUITE(code_relocation_extmem, NULL, NULL, NULL, NULL, NULL);
```

## src/extmem.c
```c
/*
 * SPDX-FileCopyrightText: Copyright The Zephyr Project Contributors
 * SPDX-FileCopyrightText: Copyright (c) 2026 Kirill Shypachov
 * SPDX-License-Identifier: Apache-2.0
 */

#include <zephyr/kernel.h>

#include "extmem.h"

/* Both objects of this file are relocated to EXTMEM by CMakeLists.txt. */
__noinit uint8_t extmem_buf[EXTMEM_BUF_SIZE];
K_THREAD_STACK_DEFINE(extmem_stack, EXTMEM_STACK_SIZE);
```

## src/extmem.h
```c
/*
 * SPDX-FileCopyrightText: Copyright The Zephyr Project Contributors
 * SPDX-FileCopyrightText: Copyright (c) 2026 Kirill Shypachov
 * SPDX-License-Identifier: Apache-2.0
 */

#ifndef EXTMEM_H_
#define EXTMEM_H_

#include <zephyr/kernel.h>

#define EXTMEM_BUF_SIZE   1024
#define EXTMEM_STACK_SIZE 4096

extern uint8_t extmem_buf[EXTMEM_BUF_SIZE];
K_THREAD_STACK_DECLARE(extmem_stack, EXTMEM_STACK_SIZE);

#endif /* EXTMEM_H_ */
```
