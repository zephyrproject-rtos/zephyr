## CMakeLists.txt
```
# SPDX-License-Identifier: Apache-2.0

cmake_minimum_required(VERSION 3.28.0)

find_package(Zephyr REQUIRED HINTS $ENV{ZEPHYR_BASE})
project(cache_coex_test)

target_sources(app PRIVATE src/cache_coex.c)
target_sources_ifdef(CONFIG_SMP app PRIVATE src/cache_coex_smp.c)
```

## prj.conf
```kconfig
CONFIG_SOC_FAMILY_ESPRESSIF_SPIRAM=y
CONFIG_HEAP_MEM_POOL_SIZE=98304
CONFIG_FLASH=y
CONFIG_ENTROPY_GENERATOR=y
CONFIG_ZTEST=y
```

## boards/esp32s3_devkitc_esp32s3_procpu.conf
```kconfig
# The esp32s3_devkitc used in CI is the 8MB octal PSRAM variant. Selecting
# octal PSRAM mode also enables octal flash by default, so its MSPI timing
# is tuned and stays reliable at high PSRAM speeds.
CONFIG_SOC_FAMILY_ESPRESSIF_SPIRAM_MODE_OCT=y
```

## src/cache_coex.c
```c
/*
 * Copyright (c) 2021 Espressif Systems (Shanghai) Co., Ltd.
 *
 * SPDX-License-Identifier: Apache-2.0
 */

#include <zephyr/kernel.h>
#include <zephyr/ztest.h>
#include <zephyr/devicetree.h>
#include <zephyr/sys/printk.h>
#include <zephyr/drivers/flash.h>
#include <zephyr/random/random.h>
#include <soc/soc_memory_layout.h>
#include <zephyr/multi_heap/shared_multi_heap.h>

/* definitions used in Flash & RAM operations */
#define SPIRAM_ALLOC_SIZE               (24 * 1024)
#define FLASH_PAGE_TESTED               (1023)
#define FLASH_PAGE_PSRAM_STACK          (1022)
#define FLASH_PAGE_OFFSET               (0)
#define FLASH_BYTE_PATTERN              (0x38)
#define FLASH_READBACK_LEN              (1024)
#define FLASH_ITERATIONS                (10)
#define PSRAM_ITERATIONS                (10)

/* common thread definitions */
#define STACKSIZE 1024
#define PRIORITY 7

/* thread running flash operations on a stack placed in external RAM */
#define PSRAM_STACK_SIZE                (2048)
#define PSRAM_STACK_DATA_LEN            (64)

static const struct device *const flash_dev = DEVICE_DT_GET(DT_CHOSEN(zephyr_flash_controller));
static struct flash_pages_info page_info;
static int *mem;
uint8_t flash_fill_buff[FLASH_READBACK_LEN];
uint8_t flash_read_buff[FLASH_READBACK_LEN];

static uint8_t flash_val = FLASH_BYTE_PATTERN;
static bool buffer_ready;
static bool needs_fill = true;
static bool unfinished_tasks = true;
static struct k_spinlock lock;

struct psram_stack_results {
	bool stack_in_ext_ram;
	int erase_rc;
	int write_rc;
	int read_rc;
	bool data_ok;
};
static struct psram_stack_results psram_stack_result;

struct coex_test_results {
	bool using_ext_ram;
	int flash_cnt;
	bool psram_ok;
};
static struct coex_test_results coex_result;

static void buffer_fill(void)
{
	while (needs_fill) {
		if (!buffer_ready) {
			k_spinlock_key_t key = k_spin_lock(&lock);

			memset(flash_fill_buff, ++flash_val, sizeof(flash_fill_buff));
			buffer_ready = true;
			k_spin_unlock(&lock, key);
		}
		k_usleep(10);
	}
	while (true) {
		k_usleep(1);
	}
}

static void check_flash(void)
{
	int cnt = 0;

	for (size_t i = 0; i < sizeof(flash_read_buff); ++i) {
		if (flash_read_buff[i] == (FLASH_BYTE_PATTERN + FLASH_ITERATIONS)) {
			++cnt;
		}
	}
	coex_result.flash_cnt = cnt;
	unfinished_tasks = false;
}

static int do_erase(off_t offset, size_t size)
{
	int rc;

	rc = flash_erase(flash_dev, offset, size);
	if (rc) {
		TC_ERROR("flash erase has failed\n");
		return rc;
	}

	return rc;
}

static int page_erase(void)
{
	int rc;

	rc = flash_get_page_info_by_idx(flash_dev, FLASH_PAGE_TESTED, &page_info);
	if (rc) {
		return rc;
	}

	rc = do_erase(page_info.start_offset, page_info.size);
	if (rc) {
		return rc;
	}

	return rc;
}

static int page_read(void)
{
	int rc = flash_get_page_info_by_idx(flash_dev, FLASH_PAGE_TESTED, &page_info);

	if (rc) {
		TC_ERROR("could not read flash info\n");
		return rc;
	}
	rc = flash_read(flash_dev,
			page_info.start_offset + FLASH_PAGE_OFFSET,
			flash_read_buff,
			sizeof(flash_read_buff));
	if (rc) {
		TC_ERROR("flash read back has failed\n");
		return rc;
	}

	return 0;
}

static int page_write(void)
{
	int rc = flash_get_page_info_by_idx(flash_dev, FLASH_PAGE_TESTED, &page_info);

	if (rc) {
		TC_ERROR("could not retrieve flash info\n");
		return rc;
	}

	rc = flash_write(flash_dev,
			page_info.start_offset + FLASH_PAGE_OFFSET,
			flash_fill_buff,
			sizeof(flash_fill_buff));
	if (rc) {
		TC_ERROR("could not write to flash\n");
		return rc;
	}

	return 0;
}

static bool do_flashop(void)
{
	int rc = page_write();

	if (rc) {
		return false;
	}

	return true;
}

static void fill_value(int value)
{
	int i;

	/* fills external RAM with given value */
	for (i = 0; i < (SPIRAM_ALLOC_SIZE / sizeof(int)); ++i) {
		mem[i] = value;
	}
}

static bool check_psram(int value)
{
	int *ptr = mem;

	/* checks if external RAM is filled with the expected value */
	for (size_t i = 0; i < (SPIRAM_ALLOC_SIZE / sizeof(int)); ++i) {
		if (*ptr++ != value) {
			return false;
		}
	}
	return true;
}

static void psram_test(void)
{
	uint32_t sleep_ms = 10;
	int rand_val;

	for (size_t i = 0; i < PSRAM_ITERATIONS; ++i) {
		rand_val = (int)sys_rand32_get();
		fill_value(rand_val);
		k_msleep(sleep_ms);
	}
	if (check_psram(rand_val)) {
		coex_result.psram_ok = true;
	} else {
		coex_result.psram_ok = false;
	}
	while (true) {
		k_usleep(1);
	}
}

static void psram_init(void)
{
	mem = shared_multi_heap_aligned_alloc(SMH_REG_ATTR_EXTERNAL, 32, SPIRAM_ALLOC_SIZE);
	if (!mem) {
		TC_ERROR("SPIRAM allocation has failed\n");
	}

	if (!esp_ptr_external_ram(mem)) {
		coex_result.using_ext_ram = false;
		TC_ERROR("allocation is not within specified bounds\n");
		return;
	}

	coex_result.using_ext_ram = true;
	psram_test();
}

static void flash_test(void)
{
	uint32_t sleep_ms = 15;

	for (size_t i = 0; i < FLASH_ITERATIONS; ++i) {
		page_erase();
		if (buffer_ready) {
			k_spinlock_key_t key = k_spin_lock(&lock);

			do_flashop();
			buffer_ready = false;
			k_spin_unlock(&lock, key);
		}
		k_msleep(sleep_ms);
	}
	needs_fill = false;
	page_read();
	check_flash();
	while (true) {
		k_usleep(1);
	}
}

static void flash_init(void)
{
	if (!device_is_ready(flash_dev)) {
		TC_ERROR("flash controller not ready\n");
	}
	flash_test();
}

static void psram_stack_flash_op(void *p1, void *p2, void *p3)
{
	struct flash_pages_info info;
	uint8_t wr[PSRAM_STACK_DATA_LEN] = {0};
	uint8_t rd[PSRAM_STACK_DATA_LEN] = {0};

	ARG_UNUSED(p1);
	ARG_UNUSED(p2);
	ARG_UNUSED(p3);

	psram_stack_result.stack_in_ext_ram = esp_ptr_external_ram(wr);

	psram_stack_result.erase_rc =
		flash_get_page_info_by_idx(flash_dev, FLASH_PAGE_PSRAM_STACK, &info);
	if (psram_stack_result.erase_rc != 0) {
		return;
	}
	for (size_t i = 0; i < sizeof(wr); ++i) {
		wr[i] = (uint8_t)(i ^ 0x5a);
	}

	psram_stack_result.erase_rc = flash_erase(flash_dev, info.start_offset, info.size);
	psram_stack_result.write_rc = flash_write(flash_dev, info.start_offset, wr, sizeof(wr));
	psram_stack_result.read_rc = flash_read(flash_dev, info.start_offset, rd, sizeof(rd));
	psram_stack_result.data_ok = (memcmp(wr, rd, sizeof(wr)) == 0);
}

ZTEST(cache_coex, test_flash_from_psram_stack)
{
	static Z_KERNEL_STACK_DEFINE_IN(psram_stack, PSRAM_STACK_SIZE,
					Z_GENERIC_SECTION(.ext_ram.bss));
	static struct k_thread psram_stack_thread;

	k_thread_create(&psram_stack_thread, psram_stack, K_KERNEL_STACK_SIZEOF(psram_stack),
			psram_stack_flash_op, NULL, NULL, NULL, PRIORITY, 0, K_NO_WAIT);
	zassert_ok(k_thread_join(&psram_stack_thread, K_SECONDS(10)), "flash op did not finish");

	zassert_true(esp_ptr_external_ram(psram_stack), "thread stack is not in external RAM");
	zassert_true(psram_stack_result.stack_in_ext_ram, "thread is not running on external RAM");
	zassert_equal(0, psram_stack_result.erase_rc, "flash erase failed");
	zassert_equal(0, psram_stack_result.write_rc, "flash write failed");
	zassert_equal(0, psram_stack_result.read_rc, "flash read failed");
	zassert_true(psram_stack_result.data_ok, "flash read-back mismatch");
}

ZTEST(cache_coex, test_using_spiram)
{
	zassert_equal(true, coex_result.using_ext_ram, "external RAM is not being used");
}

ZTEST(cache_coex, test_flash_integrity)
{
	zassert_equal(FLASH_READBACK_LEN, coex_result.flash_cnt, "flash integrity test failed");
}

ZTEST(cache_coex, test_ram_integrity)
{
	zassert_equal(true, coex_result.psram_ok, "SPIRAM integrity test failed");
}

void *cache_coex_setup(void)
{
	while (unfinished_tasks) {
		k_usleep(1);
	}

	return NULL;
}

K_THREAD_DEFINE(psram_id, STACKSIZE, psram_init, NULL, NULL, NULL, PRIORITY, 0, 0);
K_THREAD_DEFINE(flash_id, STACKSIZE, flash_init, NULL, NULL, NULL, PRIORITY, 0, 0);
K_THREAD_DEFINE(buffer_id, STACKSIZE, buffer_fill, NULL, NULL, NULL, PRIORITY, 0, 0);

ZTEST_SUITE(cache_coex, NULL, cache_coex_setup, NULL, NULL, NULL);
```

## src/cache_coex_smp.c
```c
/*
 * Copyright (c) 2026 Espressif Systems (Shanghai) Co., Ltd.
 *
 * SPDX-License-Identifier: Apache-2.0
 */

#include <zephyr/kernel.h>
#include <zephyr/ztest.h>
#include <zephyr/drivers/flash.h>
#include <zephyr/multi_heap/shared_multi_heap.h>
#include <soc/soc_memory_layout.h>
#include <string.h>

/* Cross-core cache coexistence: one core erases and writes flash, which
 * suspends the shared cache, while the other core keeps executing code from
 * flash and reading and writing PSRAM through that same cache. Both roles are
 * pinned, then swapped, so the stall protocol is exercised in both directions.
 */

#define SMP_FLASH_PAGE 1022
#define SMP_PSRAM_SIZE (16 * 1024)
#define SMP_PHASE_MS   3000
#define SMP_STACK_SIZE 2048
#define SMP_PRIO       K_PRIO_PREEMPT(6)

static const struct device *const smp_flash_dev = DEVICE_DT_GET(DT_CHOSEN(zephyr_flash_controller));

static uint8_t smp_wbuf[1024];
static uint8_t smp_rbuf[1024];
static uint32_t *smp_psram;

static volatile bool smp_stop;
static volatile uint32_t smp_flash_ops;
static volatile uint32_t smp_flash_errs;
static volatile uint32_t smp_hog_iters;
static volatile uint32_t smp_hog_errs;
static volatile int smp_flash_cpu_seen;
static volatile int smp_hog_cpu_seen;

/* Walked by the hog from flash-resident code. */
static const uint32_t smp_table[1024] = {[0 ... 1023] = 0x9e3779b9};

static uint32_t __attribute__((noinline)) smp_xip_work(uint32_t seed)
{
	uint32_t h = seed;

	for (size_t i = 0; i < ARRAY_SIZE(smp_table); i++) {
		h = (h ^ smp_table[i]) * 16777619u;
		h ^= h >> 13;
	}
	return h;
}

static void smp_hog_fn(void *a, void *b, void *c)
{
	uint32_t ref = smp_xip_work(1);
	uint32_t round = 0;

	smp_hog_cpu_seen = arch_curr_cpu()->id;

	while (!smp_stop) {
		uint32_t v = 0x5a5a0000u + round;

		for (size_t i = 0; i < SMP_PSRAM_SIZE / sizeof(uint32_t); i++) {
			smp_psram[i] = v + i;
		}
		if (smp_xip_work(1) != ref) {
			smp_hog_errs++;
		}
		for (size_t i = 0; i < SMP_PSRAM_SIZE / sizeof(uint32_t); i++) {
			if (smp_psram[i] != v + i) {
				smp_hog_errs++;
				break;
			}
		}
		if (arch_curr_cpu()->id != smp_hog_cpu_seen) {
			smp_hog_errs++;
		}
		smp_hog_iters++;
		round++;
	}
}

static void smp_flasher_fn(void *a, void *b, void *c)
{
	struct flash_pages_info info;
	int rc;

	smp_flash_cpu_seen = arch_curr_cpu()->id;

	rc = flash_get_page_info_by_idx(smp_flash_dev, SMP_FLASH_PAGE, &info);
	if (rc) {
		smp_flash_errs++;
		return;
	}

	for (uint32_t r = 0; !smp_stop; r++) {
		memset(smp_wbuf, (uint8_t)(r + smp_flash_cpu_seen), sizeof(smp_wbuf));
		rc = flash_erase(smp_flash_dev, info.start_offset, info.size);
		if (rc == 0) {
			rc = flash_write(smp_flash_dev, info.start_offset, smp_wbuf,
					 sizeof(smp_wbuf));
		}
		if (rc == 0) {
			rc = flash_read(smp_flash_dev, info.start_offset, smp_rbuf,
					sizeof(smp_rbuf));
		}
		if (rc || memcmp(smp_wbuf, smp_rbuf, sizeof(smp_wbuf))) {
			smp_flash_errs++;
		}
		if (arch_curr_cpu()->id != smp_flash_cpu_seen) {
			smp_flash_errs++;
		}
		smp_flash_ops++;
	}
}

K_THREAD_STACK_DEFINE(smp_hog_stack, SMP_STACK_SIZE);
K_THREAD_STACK_DEFINE(smp_flasher_stack, SMP_STACK_SIZE);
static struct k_thread smp_hog_thread;
static struct k_thread smp_flasher_thread;

static void run_phase(int flash_cpu)
{
	k_tid_t hog, flasher;

	smp_stop = false;
	smp_flash_ops = 0;
	smp_flash_errs = 0;
	smp_hog_iters = 0;
	smp_hog_errs = 0;

	hog = k_thread_create(&smp_hog_thread, smp_hog_stack, K_THREAD_STACK_SIZEOF(smp_hog_stack),
			      smp_hog_fn, NULL, NULL, NULL, SMP_PRIO, 0, K_FOREVER);
	flasher = k_thread_create(&smp_flasher_thread, smp_flasher_stack,
				  K_THREAD_STACK_SIZEOF(smp_flasher_stack), smp_flasher_fn, NULL,
				  NULL, NULL, SMP_PRIO, 0, K_FOREVER);
	zassert_ok(k_thread_cpu_pin(hog, flash_cpu ? 0 : 1), "hog pin failed");
	zassert_ok(k_thread_cpu_pin(flasher, flash_cpu), "flasher pin failed");
	k_thread_start(hog);
	k_thread_start(flasher);

	k_msleep(SMP_PHASE_MS);
	smp_stop = true;
	k_thread_join(flasher, K_FOREVER);
	k_thread_join(hog, K_FOREVER);

	TC_PRINT("flash on cpu%d: flash ops %u errs %u, hog iters %u errs %u\n", flash_cpu,
		 smp_flash_ops, smp_flash_errs, smp_hog_iters, smp_hog_errs);

	zassert_equal(smp_flash_cpu_seen, flash_cpu, "flasher did not run on cpu%d", flash_cpu);
	zassert_equal(smp_hog_cpu_seen, flash_cpu ? 0 : 1, "hog did not run on the other cpu");
	zassert_true(smp_flash_ops > 0, "no flash operation completed");
	zassert_true(smp_hog_iters > 0, "the hog made no progress");
	zassert_equal(smp_flash_errs, 0, "flash integrity errors");
	zassert_equal(smp_hog_errs, 0, "psram or xip integrity errors");
}

ZTEST(cache_coex_smp, test_cross_core_flash_vs_psram)
{
	zassert_true(arch_num_cpus() > 1, "needs two cpus");
	zassert_true(device_is_ready(smp_flash_dev), "flash controller not ready");

	smp_psram = shared_multi_heap_aligned_alloc(SMH_REG_ATTR_EXTERNAL, 32, SMP_PSRAM_SIZE);
	zassert_not_null(smp_psram, "SPIRAM allocation failed");
	zassert_true(esp_ptr_external_ram(smp_psram), "buffer is not in external RAM");

	run_phase(1);
	run_phase(0);

	shared_multi_heap_free(smp_psram);
}

ZTEST_SUITE(cache_coex_smp, NULL, NULL, NULL, NULL, NULL);
```
