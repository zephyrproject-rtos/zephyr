## tests/boards/espressif/wifi/testcase.yaml
```yaml
common:
  integration_platforms:
    - esp32c3_devkitc
tests:
  esp.wifi.sec.none:
    tags: wifi
    filter: CONFIG_WIFI_ESP32
    platform_allow:
      - esp32_devkitc/esp32/procpu
      - esp32s2_devkitc
      - esp32s3_devkitc/esp32s3/procpu
      - esp32c3_devkitc
      - esp8684_devkitm
  esp.wifi.sec.wpa2:
    tags: wifi
    filter: CONFIG_WIFI_ESP32
    extra_configs:
      - CONFIG_WIFI_TEST_AUTH_MODE_WPA2=y
    platform_allow:
      - esp32_devkitc/esp32/procpu
      - esp32s2_devkitc
      - esp32s3_devkitc/esp32s3/procpu
      - esp32c3_devkitc
      - esp8684_devkitm
  esp.wifi.sec.wpa3:
    tags: wifi
    filter: CONFIG_WIFI_ESP32
    extra_configs:
      - CONFIG_WIFI_TEST_AUTH_MODE_WPA3=y
    platform_allow:
      - esp32_devkitc/esp32/procpu
      - esp32s2_devkitc
      - esp32s3_devkitc/esp32s3/procpu
      - esp32c3_devkitc
      - esp8684_devkitm
```

## tests/boards/espressif_esp32/cache_coex/testcase.yaml
```yaml
tests:
  boards.esp32.cache_coex:
    platform_allow:
      - esp32_devkitc_wrover/esp32/procpu
      - esp32s2_saola
      - esp32s3_devkitm/esp32s3/procpu
    tags:
      - spiram
      - spiflash
      - cache
```

## tests/boards/espressif_esp32/mcuboot_sysbuild/testcase.yaml
```yaml
common:
  platform_allow:
    - esp32_devkitc_wrover
    - esp32c3_devkitm
    - esp32s2_saola
    - esp32s3_devkitm
tests:
  tests.boards.espressif.mcuboot:
    sysbuild: true
    harness: console
    harness_config:
      type: one_line
      regex:
        - "Hello World! (.*)"
```

## tests/boards/espressif_esp32/psram/testcase.yaml
```yaml
tests:
  boards.esp32.psram:
    platform_allow:
      - esp32_devkitc_wrover
      - esp32s2_saola
      - esp32s3_devkitm
    tags:
      - spiram
      - cache
```

## tests/boards/espressif_esp32/wifi/Kconfig
```kconfig
# Copyright (c) 2023 Espressif Systems (Shanghai) Co., Ltd.
# SPDX-License-Identifier: Apache-2.0

menu "ESP32 WIFI TEST"

config WIFI_TEST_SSID
	string "Wi-Fi Test SSID"
	default "myssid"
	help
		SSID to connect

config WIFI_TEST_PSK
	string "Wi-Fi PSK"
	default "mypassword"
	help
		Wifi Password

choice WIFI_TEST_AUTH_MODE_SELECT
	prompt "Security Option"
	default WIFI_TEST_AUTH_MODE_NONE

config WIFI_TEST_AUTH_MODE_NONE
	bool "Open Security"
	help
	  Enable for Open Security

config WIFI_TEST_AUTH_MODE_WPA2
	bool "WPA2 Security"
	help
	  Enable for WPA2 Security

config WIFI_TEST_AUTH_MODE_WPA3
	bool "WPA3 Security"
	select ESP_WIFI_ENABLE_WPA3_SAE
	help
		Enable for WPA3 Security

endchoice

endmenu
source "Kconfig.zephyr"
```

## tests/boards/espressif_esp32/wifi/testcase.yaml
```yaml
common:
  platform_allow:
    - esp32_devkitc_wrover
    - esp32c3_devkitm
    - esp32s2_saola
    - esp32s3_devkitm
  depends_on: wifi
tests:
  esp.wifi.sec.none:
    tags: wifi
  esp.wifi.sec.wpa2:
    tags: wifi
    extra_configs:
      - CONFIG_WIFI_TEST_AUTH_MODE_WPA2=y
  esp.wifi.sec.wpa3:
    tags: wifi
    extra_configs:
      - CONFIG_WIFI_TEST_AUTH_MODE_WPA3=y
```

## tests/boards/frdm_k64f/i2c/testcase.yaml
```yaml
tests:
  boards.frdm_k64f.i2c:
    platform_allow: frdm_k64f/mk64f12
    tags: i2c
```

## tests/boards/intel_adsp/cache/testcase.yaml
```yaml
common:
  tags: boards
tests:
  boards.intel_adsp.cache:
    platform_allow: intel_adsp_cavs25
    integration_platforms:
      - intel_adsp_cavs25
```

## tests/boards/intel_adsp/hda/testcase.yaml
```yaml
common:
  platform_allow: intel_adsp_cavs15 intel_adsp_cavs18 intel_adsp_cavs20 intel_adsp_cavs25
  integration_platforms:
    - intel_adsp_cavs25
tests:
  boards.intel_adsp.hda:
    tags: hda dma
  boards.intel_adsp.hda.1cpu:
    tags: hda dma
    extra_configs:
      - CONFIG_MP_MAX_NUM_CPUS=1
```

## tests/boards/intel_adsp/hda_log/Kconfig
```kconfig
# SPDX-License-Identifier: Apache-2.0
# Copyright (c) 2022 Intel Corporation

mainmenu "HDA Log test parameters"

config HDA_LOG_TEST_THREADS
	int "Number of threads to spawn and log with"
	default 5

config HDA_LOG_TEST_ITERATIONS
	int "Number of iterations each thread calls LOG in a loop"
	default 1024

config HDA_LOG_TEST_TIMER
	bool "Concurrent to the threads log in a timer isr"
	default y

config HDA_LOG_TEST_PANIC
	bool "Test a call to log_panic()"
	default y
	depends on !LOG_MODE_DEFERRED

source "Kconfig.zephyr"
```

## tests/boards/intel_adsp/hda_log/testcase.yaml
```yaml
common:
  harness: console
  platform_allow: intel_adsp_cavs25
  integration_platforms:
    - intel_adsp_cavs25
  harness_config:
    type: multi_line
    regex:
      - "TEST:([0-9]){6,7}"
      - "Timeout flush working if shown"
tests:
  boards.intel_adsp.hda_log.simple:
    timeout: 120
    extra_configs:
      - CONFIG_HDA_LOG_TEST_THREADS=1
      - CONFIG_HDA_LOG_TEST_ITERATIONS=1024
      - CONFIG_HDA_LOG_TEST_TIMER=n
      - CONFIG_HDA_LOG_TEST_PANIC=n
  boards.intel_adsp.hda_log:
    timeout: 120
  boards.intel_adsp.hda_log.printk:
    timeout: 120
    extra_configs:
      - CONFIG_LOG_PRINTK=y
  boards.intel_adsp.hda_log.1cpu:
    timeout: 120
    extra_configs:
      - CONFIG_MP_MAX_NUM_CPUS=1
  boards.intel_adsp.hda_log.deferred:
    timeout: 120
    extra_configs:
      - CONFIG_LOG_MODE_DEFERRED=y
```

## tests/boards/intel_adsp/mm/testcase.yaml
```yaml
common:
  tags: boards
tests:
  boards.intel_adsp.mm:
    platform_allow: intel_adsp/cavs25
```

## tests/boards/intel_adsp/smoke/testcase.yaml
```yaml
tests:
  boards.intel_adsp.smoke:
    platform_allow:
      - intel_adsp/cavs25
      - intel_adsp/ace15_mtpm
      - intel_adsp/ace30/ptl
    integration_platforms:
      - intel_adsp/cavs25
      - intel_adsp/ace15_mtpm
      - intel_adsp/ace30/ptl
```

## tests/boards/intel_adsp/ssp/Kconfig
```kconfig
#
# Copyright (c) 2022, Intel
#
# SPDX-License-Identifier: Apache-2.0
#

mainmenu "Dai SSP Test"

source "Kconfig.zephyr"
```

## tests/boards/intel_adsp/ssp/testcase.yaml
```yaml
common:
  tags:
    - dai
    - dma
tests:
  boards.intel_adsp.ssp:
    depends_on:
      - dai
      - dma
    platform_allow: intel_adsp/cavs25
    integration_platforms:
      - intel_adsp/cavs25
```

## tests/boards/intel_s1000_crb/cache/testcase.yaml
```yaml
tests:
  boards.s1000_crb.cache:
    platform_allow: intel_s1000_crb
    tags: boards
```

## tests/boards/intel_s1000_crb/main/testcase.yaml
```yaml
tests:
  boards.s1000_crb.main:
    platform_allow: intel_s1000_crb
    tags: boards
```

## tests/boards/mec15xxevb_assy6853/i2c_api/testcase.yaml
```yaml
tests:
  boards.mec15xxevb_assy6853.i2c:
    depends_on: i2c
    tags:
      - drivers
      - i2c
    filter: dt_compat_enabled("nxp,pca95xx")
    platform_allow: mec15xxevb_assy6853
```

## tests/boards/mec15xxevb_assy6853/qspi/testcase.yaml
```yaml
tests:
  boards.mec15xxevb_assy6853.qspi:
    platform_allow: mec15xxevb_assy6853/mec1501_hsz
    tags:
      - drivers
      - spi
      - qspi
```

## tests/boards/mec172xevb_assy6906/i2c_api/testcase.yaml
```yaml
tests:
  boards.mec172xevb_assy6906.i2c:
    depends_on: i2c
    tags:
      - drivers
      - i2c
    filter: dt_compat_enabled("nxp,pca95xx")
    platform_allow: mec172xevb_assy6906
```

## tests/boards/mec172xevb_assy6906/qspi/testcase.yaml
```yaml
tests:
  boards.mec172xevb_assy6906.qspi:
    platform_allow: mec172xevb_assy6906/mec172x_nsz
    tags:
      - drivers
      - spi
      - qspi
```

## tests/boards/native_posix/cpu_wait/testcase.yaml
```yaml
# Test of the posix_arch k_busy_wait & cpu_hold() functionality
tests:
  boards.native_posix.cpu_wait:
    platform_allow: native_posix native_posix_64
```
