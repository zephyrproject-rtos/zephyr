/*
 * Copyright (c) 2026 Espressif Systems (Shanghai) Co., Ltd.
 * SPDX-License-Identifier: Apache-2.0
 */

&rtc_timer {
	status = "okay";

	/* Configure device as wakeup source */
	wakeup-source;
};
