## CMakeLists.txt
```
# SPDX-FileCopyrightText: Copyright (c) 2026 Espressif Systems (Shanghai) Co., Ltd.
# SPDX-License-Identifier: Apache-2.0

cmake_minimum_required(VERSION 3.28.0)

find_package(Zephyr REQUIRED HINTS $ENV{ZEPHYR_BASE})
project(code_relocation)

target_sources(app PRIVATE src/main.c src/reloc.c)

zephyr_code_relocate(FILES src/reloc.c LOCATION RAM)
zephyr_code_relocate(FILES ${ZEPHYR_BASE}/kernel/sem.c LOCATION RAM_TEXT NOKEEP)
zephyr_code_relocate(FILES ${ZEPHYR_BASE}/subsys/crc/crc32_sw.c
                     FILTER "\\.crc32_ieee$" LOCATION RAM_TEXT)

if(CONFIG_ESP_SPIRAM)
  target_sources(app PRIVATE src/extmem.c)
  zephyr_code_relocate(FILES src/extmem.c LOCATION EXTMEM_NOINIT)
endif()
```

## prj.conf
```kconfig
CONFIG_ZTEST=y
CONFIG_CODE_DATA_RELOCATION=y
CONFIG_CRC=y
```

## psram.conf
```kconfig
CONFIG_ESP_SPIRAM=y
```

## psram.overlay
```dts
/* SPDX-FileCopyrightText: Copyright (c) 2026 Espressif Systems (Shanghai) Co., Ltd.
 * SPDX-License-Identifier: Apache-2.0
 */

&psram0 {
	size = <DT_SIZE_M(2)>;
};
```

## src/main.c
```c
/* SPDX-FileCopyrightText: Copyright (c) 2026 Espressif Systems (Shanghai) Co., Ltd.
 * SPDX-License-Identifier: Apache-2.0
 */

#include <string.h>

#include <zephyr/kernel.h>
#include <zephyr/sys/crc.h>
#include <zephyr/ztest.h>
#include <esp_memory_utils.h>

#include "reloc.h"

extern char __ram_text_reloc_start[];
extern char __ram_text_reloc_end[];
extern char __ram_rodata_reloc_start[];
extern char __ram_rodata_reloc_end[];
extern char __ram_data_reloc_start[];
extern char __ram_data_reloc_end[];
extern char __ram_bss_reloc_start[];
extern char __ram_bss_reloc_end[];
extern char __ram_noinit_reloc_start[];
extern char __ram_noinit_reloc_end[];

#define IN_RELOC(ptr, mem, kind)                                                                   \
	(((uintptr_t)(ptr) >= (uintptr_t)__##mem##_##kind##_reloc_start) &&                        \
	 ((uintptr_t)(ptr) < (uintptr_t)__##mem##_##kind##_reloc_end))

ZTEST(code_relocation, test_ram_text)
{
	uint32_t first;
	uint32_t second;

	zassert_true(esp_ptr_in_iram((void *)reloc_func), "reloc_func not in IRAM: %p",
		     (void *)reloc_func);

	first = reloc_func(5U);
	second = reloc_func(0U);
	zassert_equal(first, 25U + RELOC_DATA_INIT + 5U);
	zassert_equal(second, RELOC_DATA_INIT + 5U);
}

ZTEST(code_relocation, test_ram_text_cache_off)
{
	zassert_equal(reloc_func_no_cache(0U), reloc_func(0U));
}

ZTEST(code_relocation, test_ram_text_filter)
{
	static const uint8_t buf[] = "123456789";

	zassert_true(esp_ptr_in_iram((void *)crc32_ieee), "crc32_ieee not in IRAM: %p",
		     (void *)crc32_ieee);
	zassert_false(esp_ptr_in_iram((void *)crc32_ieee_update),
		      "crc32_ieee_update relocated despite FILTER: %p", (void *)crc32_ieee_update);
	zassert_equal(crc32_ieee(buf, sizeof(buf) - 1U), 0xcbf43926U);
}

ZTEST(code_relocation, test_ram_text_kernel)
{
	struct k_sem sem;

	zassert_true(IN_RELOC(z_impl_k_sem_give, ram, text), "z_impl_k_sem_give not relocated: %p",
		     (void *)z_impl_k_sem_give);

	k_sem_init(&sem, 0U, 1U);
	k_sem_give(&sem);
	zassert_ok(k_sem_take(&sem, K_NO_WAIT));
}

ZTEST(code_relocation, test_ram_data)
{
	zassert_true(IN_RELOC(reloc_rodata, ram, rodata), "reloc_rodata not relocated: %p",
		     (void *)reloc_rodata);
	zassert_true(IN_RELOC(&reloc_data, ram, data), "reloc_data not relocated: %p",
		     (void *)&reloc_data);
	zassert_true(IN_RELOC(&reloc_bss, ram, bss), "reloc_bss not relocated: %p",
		     (void *)&reloc_bss);
	zassert_true(IN_RELOC(&reloc_noinit, ram, noinit), "reloc_noinit not relocated: %p",
		     (void *)&reloc_noinit);
	zassert_equal(reloc_rodata[3], 11U);
}

#if defined(CONFIG_ESP_SPIRAM)
ZTEST(code_relocation, test_extmem_noinit)
{
	zassert_true(esp_ptr_external_ram(ext_buf), "ext_buf not in PSRAM: %p", (void *)ext_buf);

	for (uint32_t i = 0U; i < EXT_BUF_WORDS; i++) {
		ext_buf[i] = i ^ 0xa5a5a5a5U;
	}
	for (uint32_t i = 0U; i < EXT_BUF_WORDS; i++) {
		zassert_equal(ext_buf[i], i ^ 0xa5a5a5a5U, "mismatch at %u", i);
	}
}

ZTEST(code_relocation, test_extmem_rule_kept)
{
	zassert_true(esp_ptr_external_ram(reloc_ext_bss), "reloc_ext_bss not in PSRAM: %p",
		     (void *)reloc_ext_bss);
	zassert_equal(reloc_ext_bss[0], 0U);
}

ZTEST(code_relocation, test_extmem_kernel_objects)
{
	uint8_t *p;
	void *blk;

	p = k_heap_alloc(&ext_heap, EXT_HEAP_SIZE / 2U, K_NO_WAIT);
	zassert_not_null(p, "k_heap_alloc failed");
	zassert_true(esp_ptr_external_ram(p), "heap block not in PSRAM: %p", (void *)p);
	memset(p, 0x5a, EXT_HEAP_SIZE / 2U);
	zassert_equal(p[EXT_HEAP_SIZE / 2U - 1U], 0x5aU);
	k_heap_free(&ext_heap, p);

	zassert_ok(k_mem_slab_alloc(&ext_slab, &blk, K_NO_WAIT));
	zassert_true(esp_ptr_external_ram(blk), "slab block not in PSRAM: %p", blk);
	k_mem_slab_free(&ext_slab, blk);
}
#endif /* CONFIG_ESP_SPIRAM */

static void *code_relocation_setup(void)
{
	zassert_equal(reloc_data, RELOC_DATA_INIT, "reloc_data not initialized");
	zassert_equal(reloc_bss, 0U, "reloc_bss not zeroed");

	return NULL;
}

ZTEST_SUITE(code_relocation, NULL, code_relocation_setup, NULL, NULL, NULL);
```

## src/extmem.c
```c
/* SPDX-FileCopyrightText: Copyright (c) 2026 Espressif Systems (Shanghai) Co., Ltd.
 * SPDX-License-Identifier: Apache-2.0
 */

#include <zephyr/kernel.h>
#include <zephyr/linker/section_tags.h>

#include "reloc.h"

__noinit uint32_t ext_buf[EXT_BUF_WORDS];

K_HEAP_DEFINE(ext_heap, EXT_HEAP_SIZE);
K_MEM_SLAB_DEFINE(ext_slab, EXT_SLAB_BLOCK_SIZE, EXT_SLAB_BLOCKS, 4);
```

## src/reloc.c
```c
/* SPDX-FileCopyrightText: Copyright (c) 2026 Espressif Systems (Shanghai) Co., Ltd.
 * SPDX-License-Identifier: Apache-2.0
 */

#include <zephyr/linker/section_tags.h>
#include <esp_private/cache_utils.h>

#include "reloc.h"

const uint32_t reloc_rodata[4] = {3U, 5U, 7U, 11U};
uint32_t reloc_data = RELOC_DATA_INIT;
uint32_t reloc_bss;
__noinit uint32_t reloc_noinit;

#if defined(CONFIG_ESP_SPIRAM)
Z_GENERIC_SECTION(.ext_ram.bss.reloc) uint8_t reloc_ext_bss[RELOC_EXT_BSS_SIZE];
#endif

uint32_t reloc_func(uint32_t x)
{
	reloc_bss += x;

	return (x * reloc_rodata[x & 3U]) + reloc_data + reloc_bss;
}

uint32_t reloc_func_no_cache(uint32_t x)
{
	uint32_t ret;

	spi_flash_disable_interrupts_caches_and_other_cpu();
	ret = reloc_func(x);
	spi_flash_enable_interrupts_caches_and_other_cpu();

	return ret;
}
```

## src/reloc.h
```c
/* SPDX-FileCopyrightText: Copyright (c) 2026 Espressif Systems (Shanghai) Co., Ltd.
 * SPDX-License-Identifier: Apache-2.0
 */

#ifndef RELOC_H_
#define RELOC_H_

#include <stdint.h>
#include <zephyr/kernel.h>

#define RELOC_DATA_INIT     0x1234U
#define EXT_BUF_WORDS       1024U
#define RELOC_EXT_BSS_SIZE  16U
#define EXT_HEAP_SIZE       4096U
#define EXT_SLAB_BLOCK_SIZE 64U
#define EXT_SLAB_BLOCKS     8U

extern const uint32_t reloc_rodata[4];
extern uint32_t reloc_data;
extern uint32_t reloc_bss;
extern uint32_t reloc_noinit;
extern uint32_t ext_buf[EXT_BUF_WORDS];
extern uint8_t reloc_ext_bss[RELOC_EXT_BSS_SIZE];
extern struct k_heap ext_heap;
extern struct k_mem_slab ext_slab;

uint32_t reloc_func(uint32_t x);
uint32_t reloc_func_no_cache(uint32_t x);

#endif /* RELOC_H_ */
```
