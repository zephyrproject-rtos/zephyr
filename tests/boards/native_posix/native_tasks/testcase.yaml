## tests/boards/native_posix/native_tasks/testcase.yaml
```yaml
tests:
  boards.native_posix.native_tasks:
    arch_allow: posix
  boards.native_posix_64.native_tasks:
    arch_allow: posix
```

## tests/boards/native_posix/rtc/testcase.yaml
```yaml
# Test of the native_posix real timeness and RTC model
tests:
  boards.native_posix.rtc:
    platform_allow: native_posix native_posix_64
    build_only: true
#Note: this test depends too much on not having a high host load to pass.
#      Therefore it should not be run in automated regression
```

## tests/boards/native_sim/cpu_wait/testcase.yaml
```yaml
# Test of the posix_arch k_busy_wait & cpu_hold() functionality
tests:
  boards.native_sim.cpu_wait:
    platform_allow:
      - native_sim
      - native_sim/native/64
    integration_platforms:
      - native_sim
```

## tests/boards/native_sim/pty_symlink/Kconfig
```kconfig
# SPDX-License-Identifier: Apache-2.0

config PTY_INTERACTIVE_TEST
	bool "Enable interactive PTY UART test"
	default n
	help
	  Enable the test_uart_echo test which waits for UART input and responds.
	  This test blocks execution waiting for user input, so it should only be
	  enabled when specifically testing interactive UART communication.
	  The test is designed to be used by test_e2e.sh for automated E2E testing.

source "Kconfig.zephyr"
```

## tests/boards/native_sim/pty_symlink/testcase.yaml
```yaml
tests:
  boards.native_sim.pty_symlink:
    build_only: false
    platform_allow:
      - native_posix
      - native_sim
    integration_platforms:
      - native_sim
    tags:
      - uart
      - pty
      - symlink
```

## tests/boards/native_sim/reset_hw_info/testcase.yaml
```yaml
tests:
  boards.native_sim.reset_hw_info:
    platform_allow:
      - native_sim
      - native_sim/native/64
    integration_platforms:
      - native_sim
    harness: console
    harness_config:
      type: multi_line
      ordered: true
      regex:
        - "(.*)Booting Zephyr OS build(.*)"
        - "This seems like the first start => Resetting"
        - "(.*)Booting Zephyr OS build(.*)"
        - "Booted after SOFTWARE reset => we are done"
```

## tests/boards/native_sim/rtc/testcase.yaml
```yaml
# Test of the native_sim real timeness and RTC model
tests:
  boards.native.rtc:
    platform_allow:
      - native_sim
      - native_sim/native/64
    integration_platforms:
      - native_sim
    build_only: true
# Note: this test depends too much on not having a high host load to pass.
#      Therefore it should not be run in automated regression
```

## tests/boards/neorv32/build_all/testcase.yaml
```yaml
tests:
  boards.neorv32.build_all:
    build_only: true
    tags:
      - drivers
      - entropy
      - gpio
      - uart
    platform_allow: neorv32/neorv32/minimalboot
    integration_platforms:
      - neorv32/neorv32/minimalboot
```

## tests/boards/nrf/comp/Kconfig
```kconfig
# Copyright (c) 2025 Nordic Semiconductor ASA
# SPDX-License-Identifier: Apache-2.0

config TEST_COMP_SE_PSEL_AIN_INDEX
	  int "Index of analog input for SE psel."
	  default 5

config TEST_COMP_SE_EXTREFSEL_AIN_INDEX
	  int "Index of analog input for SE extrefsel."
	  default 1

config TEST_COMP_DIFF_PSEL_AIN_INDEX
	  int "Index of analog input for DIFF psel."
	  default 4

config TEST_COMP_DIFF_EXTREFSEL_AIN_INDEX
	  int "Index of analog input for DIFF extrefsel."
	  default 5

source "Kconfig.zephyr"
```

## tests/boards/nrf/comp/boards/nrf54lm20dk_nrf54lm20b_cpuapp.conf
```kconfig
CONFIG_TEST_COMP_SE_PSEL_AIN_INDEX=1
CONFIG_TEST_COMP_SE_EXTREFSEL_AIN_INDEX=4
CONFIG_TEST_COMP_DIFF_PSEL_AIN_INDEX=6
CONFIG_TEST_COMP_DIFF_EXTREFSEL_AIN_INDEX=5
```

## tests/boards/nrf/comp/boards/nrf7120dk_nrf7120_cpuapp.conf
```kconfig
CONFIG_TEST_COMP_SE_PSEL_AIN_INDEX=0
CONFIG_TEST_COMP_SE_EXTREFSEL_AIN_INDEX=5
CONFIG_TEST_COMP_DIFF_PSEL_AIN_INDEX=1
CONFIG_TEST_COMP_DIFF_EXTREFSEL_AIN_INDEX=0
```

## tests/boards/nrf/comp/testcase.yaml
```yaml
# Copyright (c) 2024 Nordic Semiconductor
# SPDX-License-Identifier: Apache-2.0

common:
  harness_config:
    fixture: gpio_loopback
  tags:
    - drivers
    - comparator
tests:
  drivers.comparator.nrf_comp:
    platform_allow:
      - nrf54h20dk/nrf54h20/cpuapp
      - nrf54l15dk/nrf54l15/cpuapp
```

## tests/boards/nrf/coresight_stm/Kconfig.sysbuild
```kconfig
# Copyright 2024 Nordic Semiconductor ASA
#
# SPDX-License-Identifier: Apache-2.0

source "share/sysbuild/Kconfig"

config CORESIGHT_STM_USE_REMOTE_1
	bool "Use first remote core"
	default "y" if "$(BOARD)${BOARD_QUALIFIERS}" = "nrf54h20dk/nrf54h20/cpuapp"

config CORESIGHT_STM_USE_REMOTE_2
	bool "Use second remote core"

config CORESIGHT_STM_USE_REMOTE_3
	bool "Use third remote core"


config REMOTE_1_BOARD
string
	default "nrf54h20dk/nrf54h20/cpurad" if "$(BOARD)${BOARD_QUALIFIERS}" = "nrf54h20dk/nrf54h20/cpuapp"
	depends on CORESIGHT_STM_USE_REMOTE_1

config REMOTE_2_BOARD
string
	default "nrf54h20dk/nrf54h20/cpuppr" if "$(BOARD)${BOARD_QUALIFIERS}" = "nrf54h20dk/nrf54h20/cpuapp"
	depends on CORESIGHT_STM_USE_REMOTE_2

config REMOTE_3_BOARD
string
	default "nrf54h20dk/nrf54h20/cpuflpr" if "$(BOARD)${BOARD_QUALIFIERS}" = "nrf54h20dk/nrf54h20/cpuapp"
	depends on CORESIGHT_STM_USE_REMOTE_3
```

## tests/boards/nrf/coresight_stm/remote/boards/nrf54h20dk_nrf54h20_cpuppr.conf
```kconfig
CONFIG_LOG=y
CONFIG_SERIAL=n
CONFIG_CONSOLE=n
CONFIG_UART_CONSOLE=n
CONFIG_BOOT_BANNER=n
CONFIG_PRINTK=n
```

## tests/boards/nrf/coresight_stm/testcase.yaml
```yaml
sample:
  name: Logging using Coresight STM on nrf54h20

common:
  tags: coresight_stm
  sysbuild: true
  platform_allow:
    - nrf54h20dk/nrf54h20/cpuapp
  integration_platforms:
    - nrf54h20dk/nrf54h20/cpuapp

tests:
  boards.nrf.coresight_stm.dict:
    filter: not CONFIG_COVERAGE
    harness: pytest
    harness_config:
      pytest_dut_scope: session
      pytest_root:
        - "$ZEPHYR_BASE/samples/boards/nordic/coresight_stm/pytest/test_stm.py::test_STM_dictionary_mode"
    required_snippets:
      - nordic-log-stm-dict
    extra_args:
      - SB_CONFIG_APP_CPUPPR_RUN=y
      - SB_CONFIG_APP_CPUFLPR_RUN=y

  boards.nrf.coresight_stm:
    filter: not CONFIG_COVERAGE
    harness: pytest
    harness_config:
      pytest_dut_scope: session
      pytest_root:
        - "$ZEPHYR_BASE/samples/boards/nordic/coresight_stm/pytest/test_stm.py::test_STM_decoded"
    required_snippets:
      - nordic-log-stm
    extra_args:
      - SB_CONFIG_APP_CPUPPR_RUN=y
      - SB_CONFIG_APP_CPUFLPR_RUN=y

  boards.nrf.coresight_stm.dict.coverage:
    filter: CONFIG_COVERAGE
    harness: console
    harness_config:
      type: one_line
      regex:
        - "GCOV_COVERAGE_DUMP_END"
    required_snippets:
      - nordic-log-stm-dict
    extra_args:
      - SB_CONFIG_APP_CPUPPR_RUN=y
      - SB_CONFIG_APP_CPUFLPR_RUN=n
      - coresight_stm_CONFIG_LOG_PRINTK=n

  boards.nrf.coresight_stm.coverage:
    filter: CONFIG_COVERAGE
    harness: console
    harness_config:
      type: multi_line
      ordered: true
      regex:
        - "Timing for log message with 0 arguments:"
        - "Timing for log message with 1 argument:"
        - "Timing for log message with 2 arguments:"
        - "Timing for log message with 3 arguments:"
        - "Timing for log_message with string:"
    required_snippets:
      - nordic-log-stm
    extra_args:
      - SB_CONFIG_APP_CPUPPR_RUN=y
      - SB_CONFIG_APP_CPUFLPR_RUN=n
      - coresight_stm_CONFIG_LOG_PRINTK=n

  boards.nrf.coresight_stm.local_uart.coverge:
    filter: CONFIG_COVERAGE
    harness: console
    harness_config:
      type: multi_line
      ordered: true
      regex:
        - "Timing for log message with 0 arguments:"
        - "Timing for log message with 1 argument:"
        - "Timing for log message with 2 arguments:"
        - "Timing for log message with 3 arguments:"
        - "Timing for log_message with string:"
    extra_args:
      - CONFIG_LOG_MODE_IMMEDIATE=y
```

## tests/boards/nrf/dmm/testcase.yaml
```yaml
common:
  tags: drivers
  harness: ztest

tests:
  boards.nrf.dmm:
    platform_allow:
      - nrf54h20dk/nrf54h20/cpuapp
      - nrf5340dk/nrf5340/cpuapp
    integration_platforms:
      - nrf5340dk/nrf5340/cpuapp
      - nrf54h20dk/nrf54h20/cpuapp

  boards.nrf.dmm.cache_disabled:
    extra_configs:
      - CONFIG_DCACHE=n
    platform_allow:
      - nrf54h20dk/nrf54h20/cpuapp
  boards.nrf.dmm.stats:
    extra_configs:
      - CONFIG_DMM_STATS=y
    platform_allow:
      - nrf54h20dk/nrf54h20/cpuapp
  boards.nrf.dmm.more_chunks:
    extra_configs:
      - CONFIG_DMM_STATS=y
      - CONFIG_DMM_HEAP_CHUNKS=96
    platform_allow:
      - nrf54h20dk/nrf54h20/cpuapp
```

## tests/boards/nrf/gppi/testcase.yaml
```yaml
common:
  tags: drivers
  harness: ztest
tests:
  boards.nrf.gppi:
    platform_allow:
      - nrf52840dk/nrf52840
      - nrf5340dk/nrf5340/cpuapp
      - nrf54h20dk/nrf54h20/cpuapp
      - nrf54h20dk/nrf54h20/cpurad
      - nrf54l15dk/nrf54l15/cpuapp
    integration_platforms:
      - nrf52840dk/nrf52840
      - nrf5340dk/nrf5340/cpuapp
      - nrf54h20dk/nrf54h20/cpuapp
      - nrf54h20dk/nrf54h20/cpurad
      - nrf54l15dk/nrf54l15/cpuapp
  boards.nrf.gppi.flpr:
    sysbuild: true
    platform_allow:
      - nrf54l15dk/nrf54l15/cpuflpr
      - nrf54lm20dk/nrf54lm20a/cpuflpr
      - nrf54lm20dk/nrf54lm20b/cpuflpr
    integration_platforms:
      - nrf54l15dk/nrf54l15/cpuflpr
      - nrf54lm20dk/nrf54lm20a/cpuflpr
    extra_configs:
      - CONFIG_IPC_SERVICE=y
      - CONFIG_MBOX=y
      - CONFIG_GPPI_EXT_ALLOCATOR_CLI=y
  boards.nrf.gppi.flpr.54h:
    sysbuild: true
    platform_allow:
      - nrf54h20dk/nrf54h20/cpuflpr
    integration_platforms:
      - nrf54h20dk/nrf54h20/cpuflpr
    extra_args:
      - vpr_launcher_SNIPPET=nordic-log-stm
      - vpr_launcher_CONFIG_BOOT_BANNER=n
      - SNIPPET=nordic-log-stm
    extra_configs:
      - CONFIG_IPC_SERVICE=y
      - CONFIG_MBOX=y
      - CONFIG_GPPI_EXT_ALLOCATOR_CLI=y
  boards.nrf.gppi.ppr.54h:
    sysbuild: true
    platform_allow:
      - nrf54h20dk/nrf54h20/cpuppr
    integration_platforms:
      - nrf54h20dk/nrf54h20/cpuppr
    extra_configs:
      - CONFIG_IPC_SERVICE=y
      - CONFIG_MBOX=y
      - CONFIG_GPPI_EXT_ALLOCATOR_CLI=y
```

## tests/boards/nrf/hwinfo/reset_cause/testcase.yaml
```yaml
common:
  tags:
    - drivers
    - hwinfo
  harness: console

tests:
  drivers.hwinfo.reset_cause:
    harness_config:
      type: multi_line
      ordered: true
      regex:
        - "HW Info reset reason test on"
        - "PASS: RESET_PIN detected"
        - "PASS: reset causes were cleared"
        - "Supported reset causes are"
        - "RESET_PIN is supported"
        - "RESET_SOFTWARE is supported"
        - "RESET_WATCHDOG is supported"
        - "RESET_DEBUG is supported"
        - "RESET_LOW_POWER_WAKE is supported"
        - "RESET_CPU_LOCKUP is supported"
        - "HW Info reset reason test on"
        - "This boot is due to expected software reset"
        - "PASS: RESET_SOFTWARE detected"
        - "PASS: reset causes were cleared"
        - "Watchdog shall fire"
        - "HW Info reset reason test on"
        - "This boot is due to expected watchdog reset"
        - "PASS: RESET_WATCHDOG detected"
        - "PASS: reset causes were cleared"
        - "HW Info reset reason test on"
        - "This boot is due to expected cpu lockup reset"
        - "PASS: RESET_CPU_LOCKUP detected"
        - "PASS: reset causes were cleared"
        - "All tests done"
    platform_allow:
      - nrf54h20dk/nrf54h20/cpuapp
      - nrf54h20dk/nrf54h20/cpurad
      - nrf54l15dk/nrf54l15/cpuapp
      - nrf54l20pdk/nrf54l20/cpuapp
    integration_platforms:
      - nrf54h20dk/nrf54h20/cpuapp
```

## tests/boards/nrf/i2c/i2c_slave/boards/bl54l15u_dvk_nrf54l15_cpuapp.conf
```kconfig
# Copyright 2024 Nordic Semiconductor ASA
# Copyright 2025 Ezurio LLC
# SPDX-License-Identifier: Apache-2.0

CONFIG_NRFX_TWIS22=y
```

## tests/boards/nrf/i2c/i2c_slave/testcase.yaml
```yaml
common:
  depends_on: i2c
  tags:
    - drivers
    - i2c
  harness: ztest
  harness_config:
    fixture: i2c_loopback

tests:
  boards.nrf.i2c.i2c_slave:
    platform_allow:
      - nrf52840dk/nrf52840
      - nrf5340dk/nrf5340/cpuapp
      - nrf54l15dk/nrf54l15/cpuapp
      - nrf54l20pdk/nrf54l20/cpuapp
      - nrf54lm20dk/nrf54lm20a/cpuapp
      - nrf54h20dk/nrf54h20/cpuapp
      - nrf54h20dk/nrf54h20/cpuppr
    integration_platforms:
      - nrf52840dk/nrf52840
      - nrf5340dk/nrf5340/cpuapp
      - nrf54l15dk/nrf54l15/cpuapp
      - nrf54h20dk/nrf54h20/cpuapp
      - nrf54h20dk/nrf54h20/cpuppr
  boards.nrf.i2c.i2c_slave.fast:
    platform_allow:
      - nrf52840dk/nrf52840
      - nrf5340dk/nrf5340/cpuapp
      - nrf54l15dk/nrf54l15/cpuapp
      - nrf54l20pdk/nrf54l20/cpuapp
      - nrf54lm20dk/nrf54lm20a/cpuapp
      - nrf54h20dk/nrf54h20/cpuapp
      - nrf54h20dk/nrf54h20/cpuppr
    integration_platforms:
      - nrf52840dk/nrf52840
      - nrf5340dk/nrf5340/cpuapp
      - nrf54l15dk/nrf54l15/cpuapp
      - nrf54h20dk/nrf54h20/cpuapp
      - nrf54h20dk/nrf54h20/cpuppr
    extra_args:
      - EXTRA_DTC_OVERLAY_FILE="boards/i2c_speed_fast.overlay"
  boards.nrf.i2c.i2c_slave.fast_plus:
    platform_allow:
      - nrf5340dk/nrf5340/cpuapp
      - nrf54h20dk/nrf54h20/cpuapp
      - nrf54h20dk/nrf54h20/cpuppr
    integration_platforms:
      - nrf5340dk/nrf5340/cpuapp
      - nrf54h20dk/nrf54h20/cpuapp
      - nrf54h20dk/nrf54h20/cpuppr
    extra_args:
      - EXTRA_DTC_OVERLAY_FILE="boards/i2c_speed_fast_plus.overlay"
```
