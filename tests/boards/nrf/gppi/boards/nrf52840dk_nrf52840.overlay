/*
 * Copyright (c) 2025 Nordic Semiconductor ASA
 *
 * SPDX-License-Identifier: Apache-2.0
 */

dut_timer0: &timer0 {
	status = "reserved";
};

dut_timer1: &timer1 {
	status = "reserved";
};

dut_timer2: &timer2 {
	status = "reserved";
};

&comp {
	status = "reserved";
};
