/*
 * Copyright (c) 2025 Nordic Semiconductor ASA
 *
 * SPDX-License-Identifier: Apache-2.0
 */

dut_timer0: &timer020 {
	status = "reserved";
};

dut_timer1: &timer021 {
	status = "reserved";
};

dut_timer2: &timer022 {
	status = "reserved";
};
