/*
 * Copyright 2024 Nordic Semiconductor ASA
 * Copyright 2025 Ezurio LLC
 * SPDX-License-Identifier: Apache-2.0
 */

#include "bl54l15u_dvk_nrf54l15_common.dtsi"

/* To prevent enabling console receiver. */
&uart20 {
	disable-rx;
};
