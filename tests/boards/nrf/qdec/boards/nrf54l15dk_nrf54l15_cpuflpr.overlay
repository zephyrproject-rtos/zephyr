/*
 * Copyright 2024 Nordic Semiconductor ASA
 * SPDX-License-Identifier: Apache-2.0
 */

#include "nrf54l15dk_nrf54l15_common.dtsi"

/* To prevent enabling console receiver. */
&uart30 {
	disable-rx;
};
