/*
 * Copyright 2024 Nordic Semiconductor ASA
 * SPDX-License-Identifier: Apache-2.0
 */

#include "nrf54l15pdk_nrf54l15_common.dtsi"

/* To prevent enabling console receiver. */
&uart20 {
	disable-rx;
};
