## tests/boards/nrf/i2s/i2s_divider/testcase.yaml
```yaml
tests:
  boards.nrf.i2s.i2s_divider:
    tags:
      - drivers
      - i2s
    harness: console
    harness_config:
      type: multi_line
      ordered: true
      regex:
        - "test_i2s_frame_clk_freq_08000"
        - "I2S MCK frequency: 256000, actual PCM rate: 8000"
        - "test_i2s_frame_clk_freq_16000"
        - "I2S MCK frequency: 507936, actual PCM rate: 15873"
        - "test_i2s_frame_clk_freq_32000"
        - "I2S MCK frequency: 1032258, actual PCM rate: 32258"
        - "test_i2s_frame_clk_freq_44100"
        - "I2S MCK frequency: 1391304, actual PCM rate: 43478"
        - "test_i2s_frame_clk_freq_48000"
        - "I2S MCK frequency: 1523809, actual PCM rate: 47619"
        - "test_i2s_frame_clk_freq_88200"
        - "I2S MCK frequency: 2909090, actual PCM rate: 90909"
        - "test_i2s_frame_clk_freq_96000"
        - "I2S MCK frequency: 3200000, actual PCM rate: 100000"
        - "PROJECT EXECUTION SUCCESSFUL"
    platform_allow:
      - nrf52840dk/nrf52840
      - nrf5340dk/nrf5340/cpuapp
      - nrf54l15dk/nrf54l15/cpuapp
    integration_platforms:
      - nrf52840dk/nrf52840
      - nrf54l15dk/nrf54l15/cpuapp
```

## tests/boards/nrf/ironside_se_boot_report/testcase.yaml
```yaml
common:
  tags:
    - drivers
    - hwinfo
  harness: console

tests:
  soc.nordic.ironside_se_boot_report:
    harness_config:
      type: multi_line
      ordered: true
      regex:
        - "err: 0"
        - "version: 0x([0-9a-fA-F]+)"
        - "extraversion: ([0-9a-fA-F]+)"
    platform_allow:
      - nrf54h20dk/nrf54h20/cpuapp/iron
    integration_platforms:
      - nrf54h20dk/nrf54h20/cpuapp/iron
```

## tests/boards/nrf/mram_latency/testcase.yaml
```yaml
common:
  tags: drivers
  harness: ztest

tests:
  boards.nrf.mram_latency:
    platform_allow:
      - nrf54h20dk/nrf54h20/cpuapp
      - nrf54h20dk/nrf54h20/cpurad
    integration_platforms:
      - nrf54h20dk/nrf54h20/cpuapp
      - nrf54h20dk/nrf54h20/cpurad
```

## tests/boards/nrf/mvdma/testcase.yaml
```yaml
tests:
  boards.nrf.mvdma:
    tags:
      - drivers
      - dma
    harness: ztest
    platform_allow:
      - nrf54h20dk/nrf54h20/cpuapp
      - nrf54h20dk/nrf54h20/cpurad
    integration_platforms:
      - nrf54h20dk/nrf54h20/cpuapp
```

## tests/boards/nrf/nrf70/bustest/Kconfig
```kconfig
#
# Copyright (c) 2024 Nordic Semiconductor
#
# SPDX-License-Identifier: Apache-2.0
#
source "Kconfig.zephyr"

menu "NRF70 Buslib test sample"

config NRF70BUS_MEMTEST_LENGTH
	int "Memory test length"
	default 1024
	help
	  This option sets the default length for the memory test.
endmenu
```

## tests/boards/nrf/nrf70/bustest/testcase.yaml
```yaml
common:
  build_only: true
  tags:
    - drivers
    - wifi
tests:
  nrf_wifi.bustest.nrf7002:
    sysbuild: true
    build_only: true
    integration_platforms:
      - nrf7002dk/nrf5340/cpuapp
    platform_allow: nrf7002dk/nrf5340/cpuapp

  nrf_wifi.bustest.nrf7002ek:
    sysbuild: true
    build_only: true
    extra_args: SHIELD=nrf7002ek
    integration_platforms:
      - nrf5340dk/nrf5340/cpuapp
      - nrf52840dk/nrf52840
      - nucleo_h723zg
    platform_allow:
      - nrf5340dk/nrf5340/cpuapp
      - nrf52840dk/nrf52840
      - nucleo_h723zg
```

## tests/boards/nrf/nrf70/ent_security/testcase.yaml
```yaml
common:
  build_only: true
  tags:
    - drivers
    - wifi
    - net
  platform_allow:
    - nrf7002dk/nrf5340/cpuapp
tests:
  wifi.build.crypto_enterprise_typical:
    extra_configs:
      - CONFIG_EAP_TLS=y
      - CONFIG_EAP_TTLS=y
      - CONFIG_EAP_PEAP=y
  wifi.build.crypto_enterprise_tls:
    extra_configs:
      - CONFIG_EAP_TLS=y
  wifi.build.crypto_enterprise_ttls:
    extra_configs:
      - CONFIG_EAP_TTLS=y
  wifi.build.crypto_enterprise_peap:
    extra_configs:
      - CONFIG_EAP_PEAP=y
  wifi.build.crypto_enterprise_md5:
    extra_configs:
      - CONFIG_EAP_MD5=y
  wifi.build.crypto_enterprise_mschapv2:
    extra_configs:
      - CONFIG_EAP_MSCHAPV2=y
  wifi.build.crypto_enterprise_leap:
    extra_configs:
      - CONFIG_EAP_LEAP=y
  wifi.build.crypto_enterprise_psk:
    extra_configs:
      - CONFIG_EAP_PSK=y
  wifi.build.crypto_enterprise_pax:
    extra_configs:
      - CONFIG_EAP_PAX=y
  wifi.build.crypto_enterprise_sake:
    extra_configs:
      - CONFIG_EAP_SAKE=y
  wifi.build.crypto_enterprise_gpsk:
    extra_configs:
      - CONFIG_EAP_GPSK=y
  wifi.build.crypto_enterprise_pwd:
    extra_configs:
      - CONFIG_EAP_PWD=y
  wifi.build.crypto_enterprise_eke:
    extra_configs:
      - CONFIG_EAP_EKE=y
  wifi.build.crypto_enterprise_ikev2:
    extra_configs:
      - CONFIG_EAP_IKEV2=y
  wifi.build.crypto_enterprise_sim:
    extra_configs:
      - CONFIG_EAP_SIM=y
  wifi.build.crypto_enterprise_aka:
    extra_configs:
      - CONFIG_EAP_AKA=y
  wifi.build.crypto_enterprise_gtc:
    extra_configs:
      - CONFIG_EAP_GTC=y
```

## tests/boards/nrf/nrfs/Kconfig.sysbuild
```kconfig
# Copyright (c) 2025 Nordic Semiconductor ASA
# SPDX-License-Identifier: Apache-2.0

source "$(ZEPHYR_BASE)/share/sysbuild/Kconfig"

config REMOTE_BOARD
	string
	default "$(BOARD)/nrf54h20/cpurad" if SOC_NRF54H20_CPUAPP
```

## tests/boards/nrf/nrfs/testcase.yaml
```yaml
common:
  platform_allow:
    - nrf54h20dk/nrf54h20/cpuapp
    - nrf54h20dk/nrf54h20/cpurad
  integration_platforms:
    - nrf54h20dk/nrf54h20/cpuapp
    - nrf54h20dk/nrf54h20/cpurad
  tags:
    - nrfs
  harness: ztest
  sysbuild: true

tests:
  boards.nrf.nrfs.stress_test: {}
```

## tests/boards/nrf/qdec/Kconfig
```kconfig
# Copyright (c) 2025 Nordic Semiconductor ASA
# SPDX-License-Identifier: Apache-2.0

config SECOND_QDEC_INSTANCE
	bool "Enable second !DEC instance"

source "Kconfig.zephyr"
```

## tests/boards/nrf/qdec/dts/bindings/test-qdec-loopback.yaml
```yaml
description: |
  Binding describing loopbacks required to run tests/boards/nrf/qdec test in Zephyr.

compatible: "test-qdec-loopbacks"

child-binding:
  description: |
    Binding describing a single loopback pair consisting of a QDEC device and two "gpio-leds" pins
    working as a quadrature encoder for the test.
  properties:
    qdec:
      type: phandle
      required: true
      description: Node of the QDEC device used to capture quadrature signal in the loopback.
    qenc-emul-gpios:
      type: phandles
      required: true
      description: |
        Children nodes of "gpio-leds" compatible used to generate quadrature signal. The first
        phandles outputs phase A signal, the second one outputs phase B signal.
```

## tests/boards/nrf/qdec/testcase.yaml
```yaml
common:
  harness: ztest
  harness_config:
    fixture: gpio_loopback
tests:
  drivers.sensor.qdec:
    platform_allow:
      - nrf52840dk/nrf52840
      - nrf5340dk/nrf5340/cpuapp
      - nrf54h20dk/nrf54h20/cpuapp
      - nrf54l15dk/nrf54l15/cpuapp
      - nrf54l15dk/nrf54l15/cpuflpr
      - nrf54l20pdk/nrf54l20/cpuapp
      - nrf54l20pdk/nrf54l20/cpuflpr
    integration_platforms:
      - nrf52840dk/nrf52840
      - nrf5340dk/nrf5340/cpuapp
      - nrf54h20dk/nrf54h20/cpuapp
      - nrf54l15dk/nrf54l15/cpuapp
      - nrf54l15dk/nrf54l15/cpuflpr
    tags:
      - drivers
      - sensors
      - qdec
  drivers.sensor.qdec.pm_runtime:
    platform_allow:
      - nrf52840dk/nrf52840
      - nrf5340dk/nrf5340/cpuapp
      - nrf54h20dk/nrf54h20/cpuapp
      - nrf54l15dk/nrf54l15/cpuapp
      - nrf54l15dk/nrf54l15/cpuflpr
      - nrf54l20pdk/nrf54l20/cpuapp
      - nrf54l20pdk/nrf54l20/cpuflpr
    integration_platforms:
      - nrf52840dk/nrf52840
      - nrf5340dk/nrf5340/cpuapp
      - nrf54h20dk/nrf54h20/cpuapp
      - nrf54l15dk/nrf54l15/cpuapp
      - nrf54l15dk/nrf54l15/cpuflpr
    tags:
      - drivers
      - sensors
      - qdec
      - pm
    extra_configs:
      - CONFIG_PM_DEVICE=y
      - CONFIG_PM_DEVICE_RUNTIME=y
  drivers.sensor.qdec.two_instances:
    platform_allow:
      - nrf5340dk/nrf5340/cpuapp
      - nrf54h20dk/nrf54h20/cpuapp
      - nrf54l15dk/nrf54l15/cpuapp
    integration_platforms:
      - nrf5340dk/nrf5340/cpuapp
      - nrf54h20dk/nrf54h20/cpuapp
      - nrf54l15dk/nrf54l15/cpuapp
    tags:
      - drivers
      - sensors
      - qdec
      - pm
    extra_configs:
      - CONFIG_SECOND_QDEC_INSTANCE=y
    build_only: true
```

## tests/boards/nrf/rram/testcase.yaml
```yaml
# Copyright (c) 2025 Nordic Semiconductor ASA
# SPDX-License-Identifier: Apache-2.0

common:
  tags:
    - drivers
    - flash
tests:
  boards.nrf.rram.throttling:
    harness: ztest
    harness_config:
      fixture: external_flash
    extra_configs:
      - CONFIG_SOC_FLASH_NRF_THROTTLING=y
    platform_allow:
      - nrf54l15dk/nrf54l15/cpuapp
      - nrf54l15dk/nrf54l10/cpuapp
    integration_platforms:
      - nrf54l15dk/nrf54l15/cpuapp
  boards.nrf.rram.skip_if_filled:
    harness: ztest
    harness_config:
      fixture: external_flash
    extra_configs:
      - CONFIG_NRF_RRAM_FILL_SKIP_IF_FILLED=y
    platform_allow:
      - nrf54l15dk/nrf54l15/cpuapp
      - nrf54l15dk/nrf54l10/cpuapp
    integration_platforms:
      - nrf54l15dk/nrf54l15/cpuapp
```

## tests/boards/nrf/rram_throttling/testcase.yaml
```yaml
# Copyright (c) 2025 Nordic Semiconductor ASA
# SPDX-License-Identifier: Apache-2.0

common:
  tags:
    - drivers
    - flash
tests:
  boards.nrf.rram_throttling:
    harness: ztest
    harness_config:
      fixture: external_flash
    platform_allow:
      - nrf54l15dk/nrf54l15/cpuapp
      - nrf54l15dk/nrf54l10/cpuapp
    integration_platforms:
      - nrf54l15dk/nrf54l15/cpuapp
```

## tests/boards/nrf/xip/testcase.yaml
```yaml
common:
  harness: ztest
  tags:
    - drivers
    - flash
  timeout: 240
tests:
  boards.nrf.xip:
    platform_allow:
      - nrf5340dk/nrf5340/cpuapp
    integration_platforms:
      - nrf5340dk/nrf5340/cpuapp
  boards.nrf.xip.enabled_at_boot.qspi:
    extra_configs:
      - CONFIG_NORDIC_QSPI_NOR_XIP=y
    platform_allow:
      - nrf5340dk/nrf5340/cpuapp
    integration_platforms:
      - nrf5340dk/nrf5340/cpuapp
```

## tests/boards/nrf52_bsim/egu/testcase.yaml
```yaml
tests:
  boards.nrf52_bsim.egu:
    platform_allow:
      - nrf52840dk_nrf52840
      - nrf52_bsim
```

## tests/boards/qemu_x86_64/ivshmem/testcase.yaml
```yaml
tests:
  boards.qemu_x86_64.ivshmem:
    arch_allow: x86
    platform_allow: qemu_x86_64
```

## tests/boards/renesas/elc/testcase.yaml
```yaml
tests:
  boards.renesas.elc:
    depends_on: renesas_elc
    tags:
      - drivers
      - misc
      - renesas_elc
    filter: dt_compat_enabled("renesas,ra-elc")
    harness: ztest
```

## tests/boards/rpi_pico/bootrom/testcase.yaml
```yaml
common:
  tags:
    - bootrom
    - userspace
tests:
  boards.rpi_pico.bootrom.basic:
    platform_allow:
      - rpi_pico/rp2040
      - rpi_pico2/rp2350a/m33
      - rpi_pico2/rp2350a/hazard3
  boards.rpi_pico.bootrom.basic.mcuboot:
    platform_allow:
      - rpi_pico/rp2040/mcuboot
      - rpi_pico2/rp2350a/m33/mcuboot
    sysbuild: true
  boards.rpi_pico.bootrom.mpu:
    platform_allow:
      - rpi_pico/rp2040
      - rpi_pico2/rp2350a/m33
    extra_configs:
      - CONFIG_ARM_MPU=y
      - CONFIG_HW_STACK_PROTECTION=y
      # Currently excluded from ARCH_HAS_STACK_PROTECTION. See PR #103413
      - platform:rpi_pico/rp2040:CONFIG_MPU_STACK_GUARD=y
  boards.rpi_pico.bootrom.mpu.mcuboot:
    platform_allow:
      - rpi_pico/rp2040/mcuboot
      - rpi_pico2/rp2350a/m33/mcuboot
    sysbuild: true
    extra_configs:
      - CONFIG_ARM_MPU=y
      - CONFIG_HW_STACK_PROTECTION=y
      - platform:rpi_pico/rp2040/mcuboot:CONFIG_MPU_STACK_GUARD=y
  boards.rpi_pico.bootrom.userspace:
    platform_allow:
      - rpi_pico/rp2040
      - rpi_pico2/rp2350a/m33
    extra_configs:
      - CONFIG_ARM_MPU=y
      - CONFIG_HW_STACK_PROTECTION=y
      - CONFIG_USERSPACE=y
      - CONFIG_TEST_USERSPACE=y
      - platform:rpi_pico/rp2040:CONFIG_MPU_STACK_GUARD=y
  boards.rpi_pico.bootrom.userspace.mcuboot:
    sysbuild: true
    platform_allow:
      - rpi_pico/rp2040/mcuboot
      - rpi_pico2/rp2350a/m33/mcuboot
    extra_configs:
      - CONFIG_ARM_MPU=y
      - CONFIG_HW_STACK_PROTECTION=y
      - CONFIG_USERSPACE=y
      - CONFIG_TEST_USERSPACE=y
      - platform:rpi_pico/rp2040/mcuboot:CONFIG_MPU_STACK_GUARD=y
```

## tests/boards/silabs/dma/block_append/Kconfig
```kconfig
# Copyright (c) 2025 Silicon Laboratories Inc.
# SPDX-License-Identifier: Apache-2.0

mainmenu "DMA block append Test"

source "Kconfig.zephyr"

config DMA_BA_XFER_SIZE
	int "Number of bytes to transfer"
	default 4096
```

## tests/boards/silabs/dma/block_append/testcase.yaml
```yaml
tests:
  boards.silabs.dma.block_append:
    depends_on: dma
    tags:
      - drivers
      - dma
    platform_allow:
      - slwrb4180a
      - xg29_rb4412a
    filter: dt_alias_exists("dma0")
```

## tests/boards/up_squared_adsp/testcase.yaml
```yaml
tests:
  boards.up_squared_adsp:
    platform_whitelist: up_squared_adsp
    tags: boards
```

## tests/boards/vmu_rt1170/icm42688/testcase.yaml
```yaml
# Copyright 2025 CogniPilot Foundation
# SPDX-License-Identifier: Apache-2.0

tests:
  boards.vmu_rt1170.icm42688:
    tags:
      - drivers
      - sensor
      - subsys
    platform_allow:
      - vmu_rt1170/mimxrt1176/cm7
```

## tests/boot/mcuboot_data_sharing/boards/apollo510_eb.conf
```kconfig
#
# Copyright (c) 2025, Ambiq Micro Inc. <www.ambiq.com>
#
# SPDX-License-Identifier: Apache-2.0
#
CONFIG_RETAINED_MEM_ZEPHYR_RAM=y
```
