/*
 * Copyright (c) 2020 Intel Corporation
 *
 * SPDX-License-Identifier: Apache-2.0
 */

&qspi0 {
	status = "okay";

	pinctrl-0 = <&shd_cs0_n_gpio055
		     &shd_clk_gpio056
		     &shd_io0_gpio223
		     &shd_io1_gpio224
		     &shd_io2_gpio227
		     &shd_io3_gpio016>;
};
