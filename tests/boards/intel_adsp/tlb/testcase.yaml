## tests/boards/intel_adsp/tlb/testcase.yaml
```yaml
common:
  tags:
    - boards
    - mm
  filter: CONFIG_MM_DRV_INTEL_ADSP_MTL_TLB
tests:
  boards.intel_adsp.tlb:
    platform_allow:
      - intel_adsp/ace15_mtpm
      - intel_adsp/ace20_lnl
      - intel_adsp/ace30/ptl
      - intel_adsp/ace40/nvl
    integration_platforms:
      - intel_adsp/ace15_mtpm
```

## tests/bsim/bluetooth/ll/conn/Kconfig
```kconfig
# Copyright (c) 2024 Nordic Semiconductor ASA
# SPDX-License-Identifier: Apache-2.0

config TEST_CONN_INTERVAL_1MS
	bool "Test 1 ms connection interval support"
	help
	  Test 1 ms connection interval support.

config BT_CTLR_TEST_ENTROPY_SHIM
	bool "Entropy shim for controller ISR entropy testing"
	depends on BT_LL_SW_SPLIT
	help
	  Replace the entropy device with a software shim (entropy_shim.overlay)
	  that can be forced to deliver short reads or errors from
	  entropy_get_entropy_isr() when ENTROPY_BUSYWAIT is not requested.
	  Used to test the Bluetooth controller's ISR entropy path.

	  The shim configurations select CONFIG_BT_CTLR_TEST_ENTROPY_SHIM and set
	  CONFIG_BT_CTLR_ENTROPY=n so that the vendor LLL does not select the
	  nRF RNG entropy driver for the node taken over by the shim.

if BT_CTLR_TEST_ENTROPY_SHIM

config ENTROPY_SHIM
	bool "BabbleSim test entropy shim driver"
	default y
	depends on DT_HAS_VND_ENTROPY_SHIM_ENABLED
	select ENTROPY_GENERATOR
	select ENTROPY_HAS_DRIVER
	help
	  Software entropy driver for the test-only entropy shim, see
	  BT_CTLR_TEST_ENTROPY_SHIM.

choice BT_CTLR_TEST_ENTROPY_SHIM_ISR_MODE
	prompt "get_entropy_isr() behavior without ENTROPY_BUSYWAIT"
	default BT_CTLR_TEST_ENTROPY_SHIM_ISR_SHORT_READ

config BT_CTLR_TEST_ENTROPY_SHIM_ISR_SHORT_READ
	bool "Return half of the requested bytes"

config BT_CTLR_TEST_ENTROPY_SHIM_ISR_ERROR
	bool "Return -EBUSY"

endchoice

endif # BT_CTLR_TEST_ENTROPY_SHIM

menu "Zephyr Kernel"
source "Kconfig.zephyr"
endmenu
```

## tests/bsim/bluetooth/ll/conn/dts/bindings/rng/vnd,entropy-shim.yaml
```yaml
# Copyright (c) 2026 The Zephyr Project Contributors
# SPDX-License-Identifier: Apache-2.0

title: BabbleSim test entropy shim

description: |
  Test-only entropy driver for BabbleSim tests. Replaces the real entropy
  device to force short reads or errors from entropy_get_entropy_isr() when
  ENTROPY_BUSYWAIT is not requested, see CONFIG_BT_CTLR_TEST_ENTROPY_SHIM.

compatible: vnd,entropy-shim

include: base.yaml
```

## tests/bsim/bluetooth/ll/conn_subrate/testcase.yaml
```yaml
common:
  build_only: true
  tags:
    - bluetooth
    - bsim_multi
  platform_allow:
    - nrf52_bsim/native
    - nrf54l15bsim/nrf54l15/cpuapp
  integration_platforms:
    - nrf52_bsim/native
  harness: bsim

tests:
  bluetooth.ll.conn_subrate:
    harness_config:
      bsim_exe_name: tests_bsim_bluetooth_ll_conn_subrate_prj_conf
```

## tests/bsim/bluetooth/ll/frame_space/testcase.yaml
```yaml
common:
  build_only: true
  tags:
    - bluetooth
    - bsim_multi
  platform_allow:
    - nrf52_bsim/native
    - nrf5340bsim/nrf5340/cpunet
    - nrf54l15bsim/nrf54l15/cpuapp
  integration_platforms:
    - nrf52_bsim/native
  harness: bsim

tests:
  bluetooth.ll.frame_space:
    harness_config:
      bsim_exe_name: tests_bsim_bluetooth_ll_frame_space_prj_conf
  bluetooth.ll.frame_space.tifs_hw:
    extra_args: EXTRA_CONF_FILE=overlay-tifs_hw.conf
    harness_config:
      bsim_exe_name: tests_bsim_bluetooth_ll_frame_space_prj_conf_overlay-tifs_hw_conf
```

## tests/drivers/adc/adc_api/boards/kit_psoc4_hvpa_144k_lite.conf
```kconfig
# SPDX-FileCopyrightText: Copyright (c) 2026 Infineon Technologies AG,
# SPDX-FileCopyrightText: or an affiliate of Infineon Technologies AG. All rights reserved.
#
# SPDX-License-Identifier: Apache-2.0

# Fit the test into the 8 KB SRAM
CONFIG_ISR_STACK_SIZE=1024
```

## tests/drivers/dma/chan_blen_transfer/boards/nucleo_h7p5ii.conf
```kconfig
# SPDX-FileCopyrightText: Copyright The Zephyr Project Contributors
# SPDX-License-Identifier: Apache-2.0

CONFIG_DMA_TRANSFER_CHANNEL_NR_0=0
CONFIG_DMA_TRANSFER_CHANNEL_NR_1=15
CONFIG_DMA_LOOP_TRANSFER_NUMBER_OF_DMAS=2
```

## tests/drivers/dma/loop_transfer/boards/nucleo_h7p5ii.conf
```kconfig
# SPDX-FileCopyrightText: Copyright The Zephyr Project Contributors
# SPDX-License-Identifier: Apache-2.0

CONFIG_DMA_LOOP_TRANSFER_CHANNEL_NR=0
CONFIG_DMA_LOOP_TRANSFER_NUMBER_OF_DMAS=2
CONFIG_DMA_LOOP_TRANSFER_SIZE=16384
```

## tests/drivers/dma/restart/Kconfig
```kconfig
# SPDX-FileCopyrightText: Copyright The Zephyr Project Contributors
# SPDX-License-Identifier: Apache-2.0

mainmenu "DMA Restart Test"

source "Kconfig.zephyr"

config DMA_RESTART_CHANNEL
	int "DMA channel to use"
	default 0

config DMA_RESTART_IDLE_SLOT
	int "DMA request of a peripheral that never requests a transfer"
	default 0
	help
	  Used to keep a peripheral-to-memory transfer pending, so that it can be
	  stopped before it has transferred anything. The peripheral must stay
	  disabled in the test configuration.

config DMA_RESTART_RELOCATE_SECTION
	string "Memory region to place the test buffers in"
	depends on CODE_DATA_RELOCATION
	default "RAM"
```

## tests/drivers/dma/restart/boards/nucleo_h755zi_q_stm32h755xx_m7_bdma.conf
```kconfig
# SPDX-FileCopyrightText: Copyright The Zephyr Project Contributors
# SPDX-License-Identifier: Apache-2.0

CONFIG_DCACHE=n
# BDMA channel 4 through DMAMUX2 channel 4
CONFIG_DMA_RESTART_CHANNEL=4
# SPI6_RX, SPI6 stays disabled
CONFIG_DMA_RESTART_IDLE_SLOT=11

# BDMA can only access SRAM4
CONFIG_CODE_DATA_RELOCATION=y
CONFIG_DMA_RESTART_RELOCATE_SECTION="SRAM4"
```

## tests/drivers/dma/restart/boards/nucleo_l432kc.conf
```kconfig
# SPDX-FileCopyrightText: Copyright The Zephyr Project Contributors
# SPDX-License-Identifier: Apache-2.0

CONFIG_DMA_RESTART_CHANNEL=5
# USART1_RX, USART1 stays disabled
CONFIG_DMA_RESTART_IDLE_SLOT=2
```

## tests/drivers/dma/restart/boards/nucleo_u3c5zi_q.conf
```kconfig
# SPDX-FileCopyrightText: Copyright The Zephyr Project Contributors
# SPDX-License-Identifier: Apache-2.0

CONFIG_DMA_RESTART_CHANNEL=4
# UART4_RX, UART4 stays disabled
CONFIG_DMA_RESTART_IDLE_SLOT=30
```

## tests/drivers/flash/common/boards/ek_ra8m1_bitbang.conf
```kconfig
# SPDX-FileCopyrightText: Copyright The Zephyr Project Contributors
# SPDX-License-Identifier: Apache-2.0

CONFIG_TEST_DRIVER_FLASH_SIZE=67108864
CONFIG_FLASH_MSPI_NOR_LAYOUT_PAGE_SIZE=262144
```

## tests/drivers/flash/common/boards/mikroe_flash_8_click.conf
```kconfig
# Copyright The Zephyr Project Contributors
# SPDX-License-Identifier: Apache-2.0

CONFIG_ZTEST_STACK_SIZE=6144
CONFIG_FLASH_FILL_BUFFER_SIZE=2048
CONFIG_TEST_DRIVER_FLASH_SIZE=268435456
```

## tests/drivers/i2c/i2c_at24/Kconfig
```kconfig
# SPDX-FileCopyrightText: Copyright The Zephyr Project Contributors
# SPDX-License-Identifier: Apache-2.0

config TEST_I2C_AT24_AREA_OFFSET
	hex "EEPROM offset of the test area"
	default 0x0
	help
	  First EEPROM address the test writes. The test overwrites one page
	  from here. Boards that keep data at the start of the EEPROM, such as
	  the board ID on the AM62L EVM, move the test area past it. Must be
	  page-aligned, and the page must lie inside the device and inside
	  what the EEPROM's address width (8 or 16 bits) can reach.

source "Kconfig.zephyr"
```
