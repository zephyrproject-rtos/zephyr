## CMakeLists.txt
```
# SPDX-License-Identifier: Apache-2.0

cmake_minimum_required(VERSION 3.28.0)
find_package(Zephyr REQUIRED HINTS $ENV{ZEPHYR_BASE})
project(intel_adsp)

target_sources(app PRIVATE src/main.c src/smpboot.c src/hostipc.c src/cpus.c src/clock.c)
```

## prj.conf
```kconfig
CONFIG_ZTEST=y
CONFIG_SMP=y
CONFIG_SCHED_SIMPLE=y
CONFIG_SCHED_CPU_MASK=y
```

## boards/intel_adsp_ace15_mtpm.overlay
```dts
/*
 * Copyright (c) 2026 Intel Corporation
 *
 * SPDX-License-Identifier: Apache-2.0
 */

/* Secondary DSP cores are started by the test at run time. */

&cpu1 {
	zephyr,deferred-start;
};

&cpu2 {
	zephyr,deferred-start;
};
```

## boards/intel_adsp_ace30_ptl.overlay
```dts
/*
 * Copyright (c) 2026 Intel Corporation
 *
 * SPDX-License-Identifier: Apache-2.0
 */

/* Secondary DSP cores are started by the test at run time. */

&cpu1 {
	zephyr,deferred-start;
};

&cpu2 {
	zephyr,deferred-start;
};

&cpu3 {
	zephyr,deferred-start;
};

&cpu4 {
	zephyr,deferred-start;
};
```

## src/main.c
```c
/*
 * Copyright (c) 2022, 2025 Intel Corporation
 *
 * SPDX-License-Identifier: Apache-2.0
 */

#include <zephyr/kernel.h>
#include <zephyr/ztest.h>
#include <stdlib.h>

#if XCHAL_HAVE_VECBASE
ZTEST(intel_adsp, test_vecbase_lock)
{
	uintptr_t vecbase;

	/* Unfortunately there is not symbol to check if the target
	 * supports locking VECBASE. The best we can do is checking if
	 * the first is not set and skip the test.
	 */
	__asm__ volatile("rsr.vecbase %0" : "=r"(vecbase));
	if ((vecbase & 0x1) == 0) {
		ztest_test_skip();
	}

	/* VECBASE register should have been locked during the cpu
	 * start up. Trying to change its location should fail.
	 */
	__asm__ volatile("wsr.vecbase %0; rsync" : : "r"(0x0));
	__asm__ volatile("rsr.vecbase %0" : "=r"(vecbase));

	zassert_not_equal(vecbase, 0x0, "VECBASE was changed");
}
#endif

static void intel_adsp_teardown(void *data)
{
	/* Wait a bit so the python script on host is ready to receive
	 * IPC messages. An IPC message could be used instead of a timer,
	 * but expecting IPC to be working on a test suite that is going
	 * to test IPC may not be indicated.
	 */
	k_msleep(1000);
}

ZTEST_SUITE(intel_adsp, NULL, NULL, NULL, NULL, intel_adsp_teardown);

ZTEST_SUITE(intel_adsp_boot, NULL, NULL, NULL, NULL, NULL);
```

## src/clock.c
```c
/*
 * Copyright (c) 2022, 2025 Intel Corporation
 *
 * SPDX-License-Identifier: Apache-2.0
 */

#include <zephyr/kernel.h>
#include <zephyr/ztest.h>
#include <stdlib.h>
#include "tests.h"

#ifndef CONFIG_INTEL_ADSP_IPC_OLD_INTERFACE
#include <zephyr/ipc/ipc_service.h>
#include <zephyr/ipc/backends/intel_adsp_host_ipc.h>
#endif

#ifdef CONFIG_INTEL_ADSP_IPC_OLD_INTERFACE

static volatile uint32_t old_host_dt;

static bool clock_msg(const struct device *dev, void *arg, uint32_t data, uint32_t ext_data)
{
	*(uint32_t *)arg = data;
	return true;
}

#else /* CONFIG_INTEL_ADSP_IPC_OLD_INTERFACE */

extern struct ipc_ept host_ipc_ept;

struct intel_adsp_ipc_ept_priv_data test_priv_data;

void clock_ipc_receive_cb(const void *data, size_t len, void *priv)
{
	struct intel_adsp_ipc_ept_priv_data *tpd =
		(struct intel_adsp_ipc_ept_priv_data *)priv;
	const uint32_t *msg = (const uint32_t *)data;

	zassert_equal(len, sizeof(uint32_t) * 2, "unexpected IPC message length");
	zassert_not_null(data, "IPC payload pointer is NULL");

	/* Store returned timestamp from the extended payload word. */
	tpd->priv = (void *)(uintptr_t)msg[1];
	tpd->msg_done = true;
}

struct ipc_ept_cfg clock_ipc_ept_cfg = {
	.name = "host_ipc_ept",
	.cb = {
		.received = clock_ipc_receive_cb,
	},
	.priv = (void *)&test_priv_data,
};

extern int intel_adsp_ipc_send_message(const struct device *dev, uint32_t data, uint32_t ext_data);

#endif /* CONFIG_INTEL_ADSP_IPC_OLD_INTERFACE */

ZTEST(intel_adsp, test_clock_calibrate)
{
	uint32_t cyc0, cyc1, hz, diff;
	volatile uint32_t *host_dt;

#ifdef CONFIG_INTEL_ADSP_IPC_OLD_INTERFACE
	host_dt = &old_host_dt;
	/* Set handler early so all messages get ACK'd, even if we don't care about the response */
	intel_adsp_ipc_set_message_handler(INTEL_ADSP_IPC_HOST_DEV, clock_msg, (void *)host_dt);
#else
	int ret;

	host_dt = (volatile uint32_t *)&test_priv_data.priv;

	ret = ipc_service_register_endpoint(INTEL_ADSP_IPC_HOST_DEV, &host_ipc_ept,
					    &clock_ipc_ept_cfg);
	zassert_equal(ret, 0, "cannot register IPC endpoint");
#endif /* CONFIG_INTEL_ADSP_IPC_OLD_INTERFACE */

	/* Prime the host script's timestamp */
	cyc0 = k_cycle_get_32();
	intel_adsp_ipc_send_message(INTEL_ADSP_IPC_HOST_DEV, IPCCMD_TIMESTAMP, 0);

	k_msleep(1000);
	*host_dt = 0;

	/* Now do it again, but with a handler to catch the result */
	cyc1 = k_cycle_get_32();
	intel_adsp_ipc_send_message(INTEL_ADSP_IPC_HOST_DEV, IPCCMD_TIMESTAMP, 0);
	AWAIT(*host_dt != 0);
#ifdef CONFIG_INTEL_ADSP_IPC_OLD_INTERFACE
	intel_adsp_ipc_set_message_handler(INTEL_ADSP_IPC_HOST_DEV, NULL, NULL);
#else
	ret = ipc_service_deregister_endpoint(&host_ipc_ept);
	zassert_equal(ret, 0, "cannot de-register IPC endpoint");
#endif

	hz = 1000000ULL * (cyc1 - cyc0) / *host_dt;
	printk("CLOCK: %lld Hz\n", (1000000ULL * (cyc1 - cyc0)) / *host_dt);

	/* Make sure we're within 1% of spec */
	diff = abs((int32_t)(hz - CONFIG_SYS_CLOCK_HW_CYCLES_PER_SEC));
	zassert_true((hz / MIN(1, diff)) > 100, "clock rate wrong");
}
```

## src/cpus.c
```c
/* Copyright (c) 2022 Intel Corporation
 * SPDX-License-Identifier: Apache-2.0
 */
#include <stdlib.h>
#include <zephyr/kernel.h>
#include <zephyr/kernel/smp.h>
#include <zephyr/ztest.h>
#include <zephyr/cache.h>

#include <intel_adsp_ipc.h>
#include "tests.h"

#define RUN_ON_STACKSZ 2048
#define HAR_STACKSZ    1024
#define HAR_PRIORITY   7

/* Utility for spin-polled loops.  Avoids spamming shared resources
 * like SRAM or MMIO registers
 */
static ALWAYS_INLINE void delay_relax(void)
{
	for (volatile int j = 0; j < 1000; j++) {
	}
}

static void run_on_cpu_threadfn(void *a, void *b, void *c)
{
	void (*fn)(void *) = a;
	void *arg = b;
	volatile bool *done_flag = c;

	fn(arg);
	*done_flag = true;
}

static struct k_thread thread_har;
static K_THREAD_STACK_DEFINE(tstack_har, HAR_STACKSZ);

static struct k_thread run_on_threads[CONFIG_MP_MAX_NUM_CPUS];
static K_THREAD_STACK_ARRAY_DEFINE(run_on_stacks, CONFIG_MP_MAX_NUM_CPUS, RUN_ON_STACKSZ);
static volatile bool run_on_flags[CONFIG_MP_MAX_NUM_CPUS];

static uint32_t clk_ratios[CONFIG_MP_MAX_NUM_CPUS];

static void run_on_cpu(int cpu, void (*fn)(void *), void *arg, bool wait)
{
	__ASSERT_NO_MSG(cpu < arch_num_cpus());

	/* Highest priority isn't actually guaranteed to preempt
	 * whatever's running, but we assume the test hasn't laid
	 * traps for itself.
	 */
	k_thread_create(&run_on_threads[cpu], run_on_stacks[cpu], RUN_ON_STACKSZ,
			run_on_cpu_threadfn, fn, arg, (void *)&run_on_flags[cpu],
			K_HIGHEST_THREAD_PRIO, 0, K_FOREVER);
	k_thread_cpu_mask_clear(&run_on_threads[cpu]);
	k_thread_cpu_mask_enable(&run_on_threads[cpu], cpu);
	run_on_flags[cpu] = false;
	k_thread_start(&run_on_threads[cpu]);

	if (wait) {
		while (!run_on_flags[cpu]) {
			delay_relax();
			k_yield();
		}
		k_thread_abort(&run_on_threads[cpu]);
	}
}

static inline uint32_t ccount(void)
{
	uint32_t ret;

	__asm__ volatile("rsr %0, CCOUNT" : "=r"(ret));
	return ret;
}

static void core_smoke(void *arg)
{
	int cpu = (int) arg;
	volatile int tag;
	static int static_tag;

	zassert_equal(cpu, arch_curr_cpu()->id, "wrong cpu");

	/* Un/cached regions should be configured and distinct */
	zassert_equal(&tag, sys_cache_cached_ptr_get((void *)&tag),
		      "stack memory not cached");
	zassert_not_equal(&tag, sys_cache_uncached_ptr_get((void *)&tag),
			  "stack memory not cached");
	zassert_not_equal(&static_tag, sys_cache_cached_ptr_get((void *)&static_tag),
		      "stack memory not cached");
	zassert_equal(&static_tag, sys_cache_uncached_ptr_get((void *)&static_tag),
			  "stack memory not cached");

	/* Un/cached regions should be working */
	printk(" Cache behavior check\n");
	volatile int *ctag = (volatile int *)sys_cache_cached_ptr_get((void *)&tag);
	volatile int *utag = (volatile int *)sys_cache_uncached_ptr_get((void *)&tag);

	tag = 99;
	zassert_true(*ctag == 99, "variable is cached");
	*utag = 42;
	zassert_true(*ctag == 99, "uncached assignment unexpectedly affected cache");
	zassert_true(*utag == 42, "uncached memory affected unexpectedly");
	sys_cache_data_flush_range((void *)ctag, sizeof(*ctag));
	zassert_true(*utag == 99, "cache flush didn't work");

	/* Calibrate clocks */
	uint32_t cyc1, cyc0 = k_cycle_get_32();
	uint32_t cc1, cc0 = ccount();

	do {
		cyc1 = k_cycle_get_32();
		cc1 = ccount();
	} while ((cc1 - cc0) < 1000 || (cyc1 - cyc0) < 1000);

	clk_ratios[cpu] = ((cc1 - cc0) * 1000) / (cyc1 - cyc0);
	printk(" CCOUNT/WALCLK ratio %d.%3.3d\n",
	       clk_ratios[cpu] / 1000, clk_ratios[cpu] % 1000);

	for (int i = 0; i < cpu; i++) {
		int32_t diff = MAX(1, abs((int32_t)((int64_t)clk_ratios[i] - clk_ratios[cpu])));

		zassert_true((clk_ratios[cpu] / diff) > 100,
			     "clocks off by more than 1%%");
	}

	/* Check tight loop performance to validate instruction cache */
	uint32_t count0 = 1000, count, dt, insns;

	count = count0;
	cyc0 = ccount();
	__asm__ volatile("1: addi %0, %0, -1; bnez %0, 1b" : "+r"(count));
	cyc1 = ccount();
	dt = cyc1 - cyc0;
	insns = count0 * 2;
	zassert_true((dt / insns) < 3.5,
		     "instruction rate too slow, icache disabled?");
	printk(" CPI = %d.%2.2d\n", dt / insns, ((1000 * dt) / insns) % 1000);
}

ZTEST(intel_adsp_boot, test_4th_cpu_behavior)
{
	unsigned int num_cpus = arch_num_cpus();

	for (int i = 0; i < num_cpus; i++) {
		printk("Per-CPU smoke test %d...\n", i);
		run_on_cpu(i, core_smoke, (void *)i, true);
	}
}

static void alive_fn(void *arg)
{
	*(bool *)arg = true;
}

static void halt_and_restart(int cpu)
{
	printk("halt/restart core %d...\n", cpu);
	static bool alive_flag;
	int ret;

	ret = soc_adsp_halt_cpu(cpu);
	zassert_ok(ret, "Couldn't halt CPU");

	alive_flag = false;
	run_on_cpu(cpu, alive_fn, &alive_flag, false);
	k_msleep(100);
	zassert_false(alive_flag, "cpu didn't halt");

	k_smp_cpu_start(cpu, NULL, NULL);

	/* Startup can be slow */
	k_msleep(50);

	AWAIT(alive_flag == true);

	k_thread_abort(&run_on_threads[cpu]);
}

void halt_and_restart_thread(void *p1, void *p2, void *p3)
{
	unsigned int num_cpus = arch_num_cpus();

	for (int i = 1; i < num_cpus; i++) {
		halt_and_restart(i);
	}
}

ZTEST(intel_adsp_boot, test_2nd_cpu_halt)
{
	int ret;

	if (IS_ENABLED(CONFIG_SOC_SERIES_INTEL_ADSP_ACE)) {
		ztest_test_skip();
	}

	/* Obviously this only works on CPU0. So, we create a thread pinned
	 * to CPU0 to effectively run the test.
	 */
	k_thread_create(&thread_har, tstack_har, HAR_STACKSZ,
			halt_and_restart_thread, NULL, NULL, NULL,
			HAR_PRIORITY, 0, K_FOREVER);
	ret = k_thread_cpu_pin(&thread_har, 0);
	zassert_ok(ret, "Couldn't pin thread to CPU 0, test can't be run");
	k_thread_start(&thread_har);

	k_thread_join(&thread_har, K_FOREVER);
}
```

## src/hostipc.c
```c
/*
 * Copyright (c) 2022, 2025 Intel Corporation
 *
 * SPDX-License-Identifier: Apache-2.0
 */

#include <zephyr/kernel.h>
#include <zephyr/ztest.h>
#include <intel_adsp_ipc.h>
#include "tests.h"

static volatile bool done_flag, msg_flag;

#define RETURN_MSG_SYNC_VAL  0x12345
#define RETURN_MSG_ASYNC_VAL 0x54321

#ifdef CONFIG_INTEL_ADSP_IPC_OLD_INTERFACE
static bool ipc_message(const struct device *dev, void *arg,
			uint32_t data, uint32_t ext_data)
{
	zassert_is_null(arg, "wrong message arg");
	zassert_equal(data, ext_data, "unequal message data/ext_data");
	zassert_true(data == RETURN_MSG_SYNC_VAL ||
		     data == RETURN_MSG_ASYNC_VAL, "unexpected msg data");
	msg_flag = true;
	return data == RETURN_MSG_SYNC_VAL;
}

static bool ipc_done(const struct device *dev, void *arg)
{
	zassert_is_null(arg, "wrong done arg");
	zassert_false(done_flag, "done called unexpectedly");
	done_flag = true;
	return false;
}
#else /* CONFIG_INTEL_ADSP_IPC_OLD_INTERFACE */

#include <zephyr/ipc/ipc_service.h>
#include <zephyr/ipc/backends/intel_adsp_host_ipc.h>

typedef bool (*intel_adsp_ipc_done_t)(const struct device *dev, void *arg);

struct ipc_ept host_ipc_ept;

void ipc_receive_cb(const void *data, size_t len, void *priv)
{
	struct intel_adsp_ipc_ept_priv_data *priv_data =
		(struct intel_adsp_ipc_ept_priv_data *)priv;

	const uint32_t *msg = (const uint32_t *)data;

	zassert_equal(len, sizeof(uint32_t) * 2, "unexpected IPC message length");
	zassert_not_null(data, "IPC payload pointer is NULL");

	zassert_equal(msg[0], msg[1], "unequal message data/ext_data");
	zassert_true(msg[0] == RETURN_MSG_SYNC_VAL ||
		     msg[0] == RETURN_MSG_ASYNC_VAL, "unexpected msg data");
	msg_flag = true;
	priv_data->msg_done = true;
}

static struct intel_adsp_ipc_ept_priv_data host_ipc_priv_data;

struct ipc_ept_cfg host_ipc_ept_cfg = {
	.name = "host_ipc_ept",
	.cb = {
		.received = ipc_receive_cb,
	},
	.priv = &host_ipc_priv_data,
};

static void intel_adsp_ipc_set_done_handler(const struct device *dev,
					    intel_adsp_ipc_done_t fn,
					    void *arg)
{
	struct intel_adsp_ipc_data *devdata = dev->data;
	k_spinlock_key_t key = k_spin_lock(&devdata->lock);

	devdata->done_notify = fn;
	devdata->done_arg = arg;
	k_spin_unlock(&devdata->lock, key);
}

static bool host_ipc_done(const struct device *dev, void *arg)
{
	ARG_UNUSED(dev);

	zassert_is_null(arg, "wrong done arg");
	zassert_false(done_flag, "done called unexpectedly");
	done_flag = true;

	return false;
}

static void intel_adsp_ipc_complete(const struct device *dev)
{
	int ret;

	ARG_UNUSED(dev);
	ret = ipc_service_release_rx_buffer(&host_ipc_ept, NULL);
	zassert_equal(ret, 0, "ipc_service_release_rx_buffer() failed: %d", ret);
}

static bool intel_adsp_ipc_is_complete(const struct device *dev)
{
	ARG_UNUSED(dev);
	return ipc_service_get_tx_buffer_size(&host_ipc_ept) > 0;
}

int intel_adsp_ipc_send_message(const struct device *dev, uint32_t data, uint32_t ext_data)
{
	ARG_UNUSED(dev);
	uint32_t msg[2] = {data, ext_data};

	return ipc_service_send(&host_ipc_ept, &msg, sizeof(msg));
}

static int intel_adsp_ipc_send_message_sync(const struct device *dev, uint32_t data,
					    uint32_t ext_data, k_timeout_t timeout)
{
	uint32_t msg[2] = {data, ext_data};
	struct intel_adsp_ipc_data *devdata = dev->data;

	int ret = ipc_service_send(&host_ipc_ept, &msg, sizeof(msg));

	if (ret == 0) {
		k_sem_take(&devdata->sem, timeout);
	}

	return ret;
}
#endif /* CONFIG_INTEL_ADSP_IPC_OLD_INTERFACE */

ZTEST(intel_adsp, test_host_ipc)
{
	int ret;

#ifdef CONFIG_INTEL_ADSP_IPC_OLD_INTERFACE
	intel_adsp_ipc_set_message_handler(INTEL_ADSP_IPC_HOST_DEV, ipc_message, NULL);
	intel_adsp_ipc_set_done_handler(INTEL_ADSP_IPC_HOST_DEV, ipc_done, NULL);
#else /* CONFIG_INTEL_ADSP_IPC_OLD_INTERFACE */
	ret = ipc_service_register_endpoint(INTEL_ADSP_IPC_HOST_DEV, &host_ipc_ept,
					    &host_ipc_ept_cfg);
	zassert_equal(ret, 0, "cannot register IPC endpoint");
	intel_adsp_ipc_set_done_handler(INTEL_ADSP_IPC_HOST_DEV, host_ipc_done, NULL);
#endif /* CONFIG_INTEL_ADSP_IPC_OLD_INTERFACE */

	/* Just send a message and wait for it to complete */
	printk("Simple message send...\n");
	done_flag = false;
	ret = intel_adsp_ipc_send_message(INTEL_ADSP_IPC_HOST_DEV, IPCCMD_SIGNAL_DONE, 0);
	zassert_true(!ret, "send failed");
	AWAIT(intel_adsp_ipc_is_complete(INTEL_ADSP_IPC_HOST_DEV));
	AWAIT(done_flag);

	/* Request the host to return a message which we will complete
	 * immediately.
	 */
	printk("Return message request...\n");
	done_flag = false;
	msg_flag = false;
	ret = intel_adsp_ipc_send_message(INTEL_ADSP_IPC_HOST_DEV, IPCCMD_RETURN_MSG,
				RETURN_MSG_SYNC_VAL);
	zassert_true(!ret, "send failed");
	AWAIT(done_flag);
	AWAIT(intel_adsp_ipc_is_complete(INTEL_ADSP_IPC_HOST_DEV));
	AWAIT(msg_flag);

	/* Do exactly the same thing again to check for state bugs
	 * (e.g. failing to signal done on one side or the other)
	 */
	printk("Return message request 2...\n");
	done_flag = false;
	msg_flag = false;
	ret = intel_adsp_ipc_send_message(INTEL_ADSP_IPC_HOST_DEV, IPCCMD_RETURN_MSG,
				RETURN_MSG_SYNC_VAL);
	zassert_true(!ret, "send failed");
	AWAIT(done_flag);
	AWAIT(intel_adsp_ipc_is_complete(INTEL_ADSP_IPC_HOST_DEV));
	AWAIT(msg_flag);

	/* Same, but we'll complete it asynchronously (1.8+ only) */
	printk("Return message request, async...\n");
	done_flag = false;
	msg_flag = false;
	ret = intel_adsp_ipc_send_message(INTEL_ADSP_IPC_HOST_DEV, IPCCMD_RETURN_MSG,
				RETURN_MSG_ASYNC_VAL);
	zassert_true(!ret, "send failed");
	AWAIT(done_flag);
	AWAIT(intel_adsp_ipc_is_complete(INTEL_ADSP_IPC_HOST_DEV));
	AWAIT(msg_flag);
	intel_adsp_ipc_complete(INTEL_ADSP_IPC_HOST_DEV);

	/* Now make a synchronous call with (on the host) a delayed
	 * completion and make sure the interrupt fires and wakes us
	 * up. (On 1.5 a delay isn't possible and this will complete
	 * immediately).
	 */
	printk("Synchronous message send...\n");
	done_flag = false;
	ret = intel_adsp_ipc_send_message_sync(INTEL_ADSP_IPC_HOST_DEV, IPCCMD_ASYNC_DONE_DELAY,
					 0, K_FOREVER);
	zassert_true(!ret, "send failed");
	zassert_true(done_flag, "done interrupt failed to fire");
	zassert_true(intel_adsp_ipc_is_complete(INTEL_ADSP_IPC_HOST_DEV),
		"sync message incomplete");

	intel_adsp_ipc_set_done_handler(INTEL_ADSP_IPC_HOST_DEV, NULL, NULL);
#ifdef CONFIG_INTEL_ADSP_IPC_OLD_INTERFACE
	/* Clean up. Further tests might want to use IPC */
	intel_adsp_ipc_set_message_handler(INTEL_ADSP_IPC_HOST_DEV, NULL, NULL);
#else /* CONFIG_INTEL_ADSP_IPC_OLD_INTERFACE */
	ret = ipc_service_deregister_endpoint(&host_ipc_ept);
	zassert_equal(ret, 0, "cannot de-register IPC endpoint");
#endif /* CONFIG_INTEL_ADSP_IPC_OLD_INTERFACE */
}
```

## src/ipm.c
```c
/* Copyright (c) 2022 Intel Corporation
 * SPDX-License-Identifier: Apache-2.0
 */
#include <zephyr/ztest.h>
#include <zephyr/drivers/ipm.h>
#include "tests.h"

#define IPM_DEV device_get_binding("ipm_cavs_host")

/* Two values impossible to transmit in a cAVS ID */
#define ID_INBOUND 0xfffffff0
#define ID_INVALID 0xffffffff

K_SEM_STATIC_DEFINE(ipm_sem, 0, 1);

static const uint32_t msg[] = { 29, 15, 58, 71, 99 };

static uint32_t received_id = ID_INVALID;
static volatile uint32_t *received_data;

static void ipm_msg(const struct device *ipmdev, void *user_data,
		    uint32_t id, volatile void *data)
{
	zassert_equal(ipmdev, IPM_DEV, "wrong device");
	zassert_equal(user_data, NULL, "wrong user_data pointer");
	zassert_equal(received_id, ID_INBOUND, "unexpected message");

	received_id = id;
	received_data = data;

	k_sem_give(&ipm_sem);
}

static void msg_transact(bool do_wait)
{
	/* Send an IPCCMD_RETURN_MSG, this will send us a return
	 * message with msg[0] as the ID (on cAVS 1.8+, otherwise
	 * zero).
	 */
	received_id = ID_INBOUND;
	ipm_send(IPM_DEV, do_wait, IPCCMD_RETURN_MSG, msg, sizeof(msg));

	/* Wait for the return message */
	k_sem_take(&ipm_sem, K_FOREVER);

	zassert_equal(received_id,
		      IS_ENABLED(IPM_CAVS_HOST_REGWORD) ? msg[0] : 0,
		      "wrong return message ID");

	received_id = ID_INVALID;

	/* Now whitebox the message protocol: copy the message buffer
	 * (on the host side!) from the outbox to the inbox. That
	 * will write into our "already received" inbox buffer memory.
	 * We do this using the underlying intel_adsp_ipc API, which works
	 * only because we know it works. Note that on cAVS 1.8+, the
	 * actual in-use amount of the message will be one word
	 * shorter (because the first word is sent as IPC ext_data),
	 * but it won't be inspected below.
	 */
	for (int i = 0; i < ARRAY_SIZE(msg); i++) {
		intel_adsp_ipc_send_message_sync(INTEL_ADSP_IPC_HOST_DEV, IPCCMD_WINCOPY,
			(i << 16) | i, K_FOREVER);
	}

	/* Validate data */
	for (int i = 0; i < ARRAY_SIZE(msg); i++) {
		zassert_equal(msg[i], received_data[i], "wrong message data");
	}
}

/* This is a little whiteboxey. It relies on the knowledge that an
 * IPM message is nothing but a IPC message with the "id" parameter
 * passed as data (and, on cAVS 1.8+ only, the first word of the
 * message buffer passed as ext_data).
 */
ZTEST(intel_adsp, test_ipm_cavs_host)
{
	/* Restore IPM driver state (we've been mucking with intel_adsp_ipc tests) */
	intel_adsp_ipc_set_message_handler(INTEL_ADSP_IPC_HOST_DEV, ipm_handler, (void *)IPM_DEV);
	intel_adsp_ipc_set_done_handler(INTEL_ADSP_IPC_HOST_DEV, NULL, NULL);

	ipm_register_callback(IPM_DEV, ipm_msg, NULL);

	/* Do it twice just for coverage on the wait parameter */
	msg_transact(true);
	msg_transact(false);
}
```

## src/smpboot.c
```c
/* Copyright (c) 2022 Intel Corporation.
 * SPDX-License-Identifier: Apache-2.0
 */

#include <zephyr/kernel.h>
#include <zephyr/kernel/smp.h>
#include <zephyr/ztest.h>
#include <zephyr/devicetree.h>
#include "tests.h"

/* Experimentally 10ms is enough time to get the second CPU to run on
 * all known platforms.
 */
#define CPU_START_DELAY 10000

/* IPIs happen  much faster than CPU startup */
#define CPU_IPI_DELAY 250

BUILD_ASSERT(CONFIG_SMP);

/* The test brings up every secondary core itself and checks that each one is
 * idle beforehand, so none of them may be started during kernel boot. Assert
 * that here rather than discovering a missing overlay entry as a runtime
 * failure on the one board that has more cores than the others.
 */
#define CPU_MUST_DEFER_START(node_id)                                                              \
	BUILD_ASSERT(DT_SAME_NODE(node_id, DT_PATH(cpus, cpu_0)) ||                                \
			     DT_PROP_OR(node_id, zephyr_deferred_start, 0),                        \
		     "every secondary cpu node needs zephyr,deferred-start for this test");

DT_FOREACH_CPU(CPU_MUST_DEFER_START)

#define STACKSZ 2048
char stack[STACKSZ];

volatile bool mp_flag;

struct k_thread cpu_thr;
K_THREAD_STACK_DEFINE(thr_stack, STACKSZ);

static void thread_fn(void *a, void *b, void *c)
{
	int cpuid = (int) a;

	zassert_true(cpuid == 0 || cpuid == arch_curr_cpu()->id,
		     "running on wrong cpu");
	mp_flag = true;
}

/* Needless to say: since this is starting the SMP CPUs, it needs to
 * be the first test run! Ztest runs the cases of a suite in alphabetical
 * order, which is what the "1st" in the name is for.
 */
ZTEST(intel_adsp_boot, test_1st_cpu_deferred_start)
{
	unsigned int num_cpus = arch_num_cpus();

	if (arch_num_cpus() < 2) {
		ztest_test_skip();
	}

	for (int i = 1; i < num_cpus; i++) {
		printk("Launch cpu%d\n", i);
		mp_flag = false;
		k_thread_create(&cpu_thr, thr_stack, K_THREAD_STACK_SIZEOF(thr_stack),
				thread_fn, (void *)i, NULL, NULL,
				0, 0, K_FOREVER);
		k_thread_cpu_mask_clear(&cpu_thr);
		k_thread_cpu_mask_enable(&cpu_thr, i);
		k_thread_start(&cpu_thr);

		/* Make sure that thread has not run (because the cpu is halted) */
		k_busy_wait(CPU_START_DELAY);
		zassert_false(mp_flag, "cpu %d must not be running yet", i);

		/* Start the second CPU */
		k_smp_cpu_start(i, NULL, NULL);

		/* Verify the thread ran */
		k_busy_wait(CPU_START_DELAY);
		zassert_true(mp_flag, "cpu %d did not start", i);

		k_thread_abort(&cpu_thr);
	}
}

ZTEST(intel_adsp_boot, test_3rd_post_boot_ipi)
{
	if (arch_num_cpus() < 2) {
		ztest_test_skip();
	}

	/* Spawn the same thread to do the same thing, but this time
	 * expect that the thread is going to run synchronously on
	 * another CPU as soon as its created.  Intended to test
	 * whether IPIs were correctly set up on the runtime-launched
	 * CPU.
	 */
	mp_flag = false;
	k_thread_create(&cpu_thr, thr_stack, K_THREAD_STACK_SIZEOF(thr_stack),
			thread_fn, (void *)0, NULL, NULL,
			1, 0, K_NO_WAIT);

	k_busy_wait(CPU_IPI_DELAY);
	zassert_true(mp_flag, "cpu did not start thread via IPI");
}
```

## src/tests.h
```c
/* Copyright (c) 2022 Intel Corporation
 * SPDX-License-Identifier: Apache-2.0
 */
#ifndef ZEPHYR_TESTS_INTEL_ADSP_TESTS_H
#define ZEPHYR_TESTS_INTEL_ADSP_TESTS_H

#include <intel_adsp_ipc.h>
#include <cavstool.h>

/* Helper to escape from infinite polling loops with a test failure
 * instead of a hang.  Spins with a relaxation loop so that it works
 * in interrupt context and doesn't stress shared resources like SRAM
 */
#define AWAIT(expr) do {                                                \
		int i;							\
		for (i = 0; !(expr) && i < 10000; i++) {		\
			for (volatile int j = 0; j < 1000; j++) {	\
			}						\
		}							\
		zassert_true(i < 10000, "timeout waiting for %s", #expr); \
	} while (0)

#endif /* ZEPHYR_TESTS_INTEL_ADSP_TESTS_H */
```
