/*
 * Copyright 2026 Robin Sachsenweger Ballantyne <makenenjoy@gmail.com>
 *
 * SPDX-License-Identifier: Apache-2.0
 */

loopback_pio: &pio1 {
	status = "okay";
};

&dma {
	status = "okay";
};

/ {
	zephyr,user {
		dma-test-devs = <&dma>;
	};
};
