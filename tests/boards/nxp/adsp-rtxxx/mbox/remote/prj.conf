## CMakeLists.txt
```
# Copyright 2025 NXP
# SPDX-License-Identifier: Apache-2.0

cmake_minimum_required(VERSION 3.20.0)

find_package(Zephyr REQUIRED HINTS $ENV{ZEPHYR_BASE})
project(remote)

target_sources(app PRIVATE src/main.c)

include("${CMAKE_CURRENT_LIST_DIR}/../../common/common.cmake")
```

## prj.conf
```kconfig
CONFIG_MBOX=y
CONFIG_BOOT_BANNER=n
```

## boards/mimxrt685_evk_mimxrt685s_hifi4.overlay
```dts
/*
 * Copyright 2026 NXP
 *
 * SPDX-License-Identifier: Apache-2.0
 */

/ {
	mailboxes: mbox-consumer {
		mboxes = <&mbox 1>, <&mbox 0>;
		mbox-names = "rx", "tx";

		compatible = "vnd,mbox-consumer";
	};
};
```

## boards/mimxrt700_evk_mimxrt798s_hifi4.overlay
```dts
/*
 * Copyright 2025 - 2026 NXP
 *
 * SPDX-License-Identifier: Apache-2.0
 */

/ {
	mailboxes: mbox-consumer {
		mboxes = <&mbox4_b 1>, <&mbox4_b 0>;
		mbox-names = "rx", "tx";

		compatible = "vnd,mbox-consumer";
	};
};
```

## src/main.c
```c
/*
 * Copyright 2025 - 2026 NXP
 *
 * SPDX-License-Identifier: Apache-2.0
 */

/*
 * AMP mbox test (remote HiFi4 DSP side).
 *
 * On boot the DSP emits an "alive" beacon over the MU/mbox (via the shared
 * testipc request/response layer) so the ARM core can confirm it started. It
 * then services echo requests from the ARM core, closing the loop for the mbox
 * IPC usecase. Each echo also proves to the ARM side that the DSP is still
 * running.
 */

#include <stdint.h>
#include <zephyr/kernel.h>
#include <zephyr/sys/printk.h>

#include "testipc.h"

int main(void)
{
	int ret;
	uint32_t msg;

	printk("[DSP] Hello World! %s\n", CONFIG_BOARD_TARGET);

	ret = testipc_init();
	if (ret < 0) {
		printk("[DSP] IPC init fail: %d\n", ret);
		return ret;
	}

	/* Announce that we booted and are running. */
	ret = testipc_send(testipc_msg_make(AMP_OP_ALIVE, 0));
	if (ret < 0) {
		testipc_report_error(ret);
		return ret;
	}

	/* Service requests from the ARM core. */
	while (true) {
		ret = testipc_recv(&msg);
		if (ret < 0) {
			testipc_report_error(ret);
			return ret;
		}

		switch (testipc_msg_get_op(msg)) {
		case AMP_OP_ECHO_REQ:
			ret = testipc_send(testipc_msg_make(AMP_OP_ECHO_RESP,
							    testipc_msg_get_payload(msg)));
			if (ret < 0) {
				testipc_report_error(ret);
				return ret;
			}
			break;
		default:
			/* Ignore unexpected opcodes. */
			break;
		}
	}

	return 0;
}
```
