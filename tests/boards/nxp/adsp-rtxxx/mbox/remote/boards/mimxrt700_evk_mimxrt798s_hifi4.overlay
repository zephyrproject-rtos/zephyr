/*
 * Copyright 2025 - 2026 NXP
 *
 * SPDX-License-Identifier: Apache-2.0
 */

/ {
	mailboxes: mbox-consumer {
		mboxes = <&mbox4_b 1>, <&mbox4_b 0>;
		mbox-names = "rx", "tx";

		compatible = "vnd,mbox-consumer";
	};
};
