## tests/cmake/overlays/soc_folder_kconfig/testcase.yaml
```yaml
common:
  tags:
    - cmake
  platform_allow:
    - native_sim
    - native_sim/native/64
  integration_platforms:
    - native_sim
    - native_sim/native/64
tests:
  cmake.overlays.soc_folder_kconfig.default:
    extra_args:
      - CONFIG_TEST_TYPE=0
  cmake.overlays.soc_folder_kconfig.suffix:
    extra_args:
      - CONFIG_TEST_TYPE=1
      - FILE_SUFFIX=somesuffix
  cmake.overlays.soc_folder_kconfig.conf:
    extra_args:
      - CONFIG_TEST_TYPE=2
      - EXTRA_CONF_FILE=boards/other.conf
  cmake.overlays.soc_folder_kconfig.suffix.conf:
    extra_args:
      - CONFIG_TEST_TYPE=3
      - FILE_SUFFIX=somesuffix
      - EXTRA_CONF_FILE=boards/other.conf
```

## tests/cmake/overlays/soc_folder_overlay/Kconfig
```kconfig
# Copyright (c) 2024 Nordic Semiconductor ASA
# SPDX-License-Identifier: Apache-2.0

config SOC_FOLDER_TEST_INCLUDE_APP
	bool
	default "$(dt_alias_enabled,test-app)"

config SOC_FOLDER_TEST_INCLUDE_BOARD
	bool
	default "$(dt_alias_enabled,test-board)"

config SOC_FOLDER_TEST_INCLUDE_BOARD_SUFFIX
	bool
	default "$(dt_alias_enabled,test-board-suffix)"

config SOC_FOLDER_TEST_INCLUDE_BOARD_QUALIFIERS
	bool
	default "$(dt_alias_enabled,test-board-qualifiers)"

config SOC_FOLDER_TEST_INCLUDE_SOC
	bool
	default "$(dt_alias_enabled,test-soc)"

config SOC_FOLDER_TEST_INCLUDE_SOC_SUFFIX
	bool
	default "$(dt_alias_enabled,test-soc-suffix)"

config TEST_TYPE
	int "Test type"

source "Kconfig.zephyr"
```

## tests/cmake/overlays/soc_folder_overlay/testcase.yaml
```yaml
common:
  tags:
    - cmake
tests:
  buildsystem.cmake.overlays.soc_folder_overlay.default:
    platform_allow:
      - native_sim
      - native_sim/native/64
    integration_platforms:
      - native_sim
      - native_sim/native/64
    extra_args:
      - CONFIG_TEST_TYPE=0
  buildsystem.cmake.overlays.soc_folder_overlay.suffix:
    platform_allow:
      - native_sim
      - native_sim/native/64
    integration_platforms:
      - native_sim
      - native_sim/native/64
    extra_args:
      - CONFIG_TEST_TYPE=1
      - FILE_SUFFIX=somesuffix
  buildsystem.cmake.overlays.soc_folder_overlay.app:
    platform_allow:
      - qemu_cortex_m3
    integration_platforms:
      - qemu_cortex_m3
    extra_args:
      - CONFIG_TEST_TYPE=2
```

## tests/cmake/overlays/var_expansions/testcase.yaml
```yaml
common:
  tags: cmake
  build_only: true
  platform_allow: native_sim
tests:
  buildsystem.overlays.var_expansions.CONF_FILE:
    extra_conf_files:
      - ${ZEPHYR_MY_MODULE_NAME_MODULE_DIR}/zephyr/my_module-overlay.conf
      - ${ZEPHYR_MY_EXTRA_MODULE_NAME_MODULE_DIR}/zephyr/my_extra_module-overlay.conf
      - prj.conf
  buildsystem.overlays.var_expansions.OVERLAY_CONFIG:
    extra_overlay_confs:
      - ${ZEPHYR_MY_MODULE_NAME_MODULE_DIR}/zephyr/my_module-overlay.conf
      - ${ZEPHYR_MY_EXTRA_MODULE_NAME_MODULE_DIR}/zephyr/my_extra_module-overlay.conf
  buildsystem.overlays.var_expansions.DTC_OVERLAY_FILE:
    extra_dtc_overlay_files:
      - ${ZEPHYR_MY_MODULE_NAME_MODULE_DIR}/zephyr/my_module-board.overlay
      - ${ZEPHYR_MY_EXTRA_MODULE_NAME_MODULE_DIR}/zephyr/my_extra_module-board.overlay
```

## tests/cmake/snippets/Kconfig
```kconfig
# Copyright 2023 Nordic Semiconductor ASA
# SPDX-License-Identifier: Apache-2.0

mainmenu "Snippet tests"

menu "Zephyr"
source "Kconfig.zephyr"
endmenu

# Snippet test types used by the test implementation to steer the test logic
choice
	prompt "Snippet Test Type"
	default TEST_TYPE_NONE

config TEST_TYPE_NONE
	bool "Test Type: None"
	help
	  Test the initial state with no snippets applied.

config TEST_TYPE_FOO
	bool "Test Type: Foo"
	help
	  Test the `foo` snippet from the default application snippet root.

config TEST_TYPE_BAR
	bool "Test Type: Bar"
	help
	  Test the `bar` snippet from an extra snippet root.

config TEST_TYPE_FOO_BAR
	bool "Test Type: Foo-Bar"
	help
	  Test the snippet processing order (1. foo, 2. bar)

config TEST_TYPE_BAR_FOO
	bool "Test Type: Bar-Foo"
	help
	  Test the snippet processing order (1. bar, 2. foo)

config TEST_TYPE_VER_CHECK
	bool "Test Type: Version check"
	help
	  Test board version snippet application

config TEST_TYPE_VER_CHECK_SPECIFIC
	bool "Test Type: Version check specific"
	help
	  Test board version snippet application with specific board version

endchoice

# Test values set by the snippet config overlays and tested by the test logic
config TEST_FOO_VAL
	int "Test value set by the 'foo' snippet config overlay"
	help
	  This option's value should be overridden by the 'foo' snippet config
	  overlay.

config TEST_BAR_VAL
	int "Test value set by the 'bar' snippet config overlay"
	help
	  This option's value should be overridden by the 'bar' snippet config
	  overlay.

config TEST_COMMON_VAL
	int "Test value set by the snippet config overlays"
	help
	  This option's value should be overridden by the snippet config
	  overlays.

# Used for testing board version snippets
config TEST_VER_CHECK_APPLIED
	bool "Test version check snippet applied"
	help
	  This option's value should be set by the ver_check snippet.

config TEST_VER_CHECK_SPECIFIC_VERSION_APPLIED
	bool "Test version check with board version snippet applied"
	help
	  This option's value should be set by the ver_check snippet.
```

## tests/cmake/snippets/testcase.yaml
```yaml
common:
  tags: snippets
  sysbuild: false

tests:
  # Test the initial state with no snippets applied
  buildsystem.snippets.none:
    extra_configs:
    - CONFIG_TEST_TYPE_NONE=y
    platform_allow:
    - native_sim
    - qemu_x86
    - qemu_x86_64
    - qemu_cortex_m3
    integration_platforms:
    - native_sim
  # Test the `foo` snippet from the default application snippet root
  buildsystem.snippets.foo:
    extra_args: SNIPPET="foo"
    extra_configs:
    - CONFIG_TEST_TYPE_FOO=y
    platform_allow:
    - native_sim
    - qemu_x86
    - qemu_x86_64
    - qemu_cortex_m3
    integration_platforms:
    - native_sim
  # Test the `bar` snippet from an extra snippet root
  buildsystem.snippets.bar:
    extra_args: SNIPPET="bar"
    extra_configs:
    - CONFIG_TEST_TYPE_BAR=y
    platform_allow:
    - native_sim
    - qemu_x86
    - qemu_x86_64
    - qemu_cortex_m3
    integration_platforms:
    - native_sim
  # Test the snippet processing order (1. foo, 2. bar)
  buildsystem.snippets.foo_bar:
    extra_args: SNIPPET="foo;bar"
    extra_configs:
    - CONFIG_TEST_TYPE_FOO_BAR=y
    platform_allow:
    - native_sim
    - qemu_x86
    - qemu_x86_64
    - qemu_cortex_m3
    integration_platforms:
    - native_sim
  # Test the snippet processing order (1. bar, 2. foo)
  buildsystem.snippets.bar_foo:
    extra_args: SNIPPET="bar;foo"
    extra_configs:
    - CONFIG_TEST_TYPE_BAR_FOO=y
    platform_allow:
    - native_sim
    - qemu_x86
    - qemu_x86_64
    - qemu_cortex_m3
    integration_platforms:
    - native_sim
  # Test the snippet board version processing
  buildsystem.snippets.version_exclude:
    extra_args: SNIPPET="ver_check"
    extra_configs:
    - CONFIG_TEST_TYPE_VER_CHECK=y
    platform_allow:
    - nrf9160dk@0.14.0/nrf9160
    integration_platforms:
    - nrf9160dk@0.14.0/nrf9160
    build_only: true
  buildsystem.snippets.version_include:
    extra_args: SNIPPET="ver_check"
    extra_configs:
    - CONFIG_TEST_TYPE_VER_CHECK_SPECIFIC=y
    platform_allow:
    - nrf9160dk@0.7.0/nrf9160
    integration_platforms:
    - nrf9160dk@0.7.0/nrf9160
    build_only: true
```

## tests/cmake/sysbuild_merged_hex/testcase.yaml
```yaml
common:
  sysbuild: true
  build_only: true
  tags:
    - sysbuild
    - pytest
  platform_allow:
    - nrf9160dk/nrf9160
  integration_platforms:
    - nrf9160dk/nrf9160

tests:
  buildsystem.sysbuild.merged.hex: {}
```

## tests/cmake/sysbuild_snippets/Kconfig
```kconfig
# Copyright 2024 Nordic Semiconductor ASA
# SPDX-License-Identifier: Apache-2.0

menu "Zephyr"
source "Kconfig.zephyr"
endmenu

# Test values set by the snippet config overlays and tested by the test logic
config TEST_FOO_VAL
	int "Test value"
	default 12
	help
	  This option's value should be overridden by sysbuild.
```

## tests/cmake/sysbuild_snippets/Kconfig.sysbuild
```kconfig
# Copyright 2024 Nordic Semiconductor ASA
# SPDX-License-Identifier: Apache-2.0

config TEST_FOO_VAL
	int "Test value"
	default 0
	help
	  This option's value should be overridden by the 'foo' snippet config overlay.

config EXPECTED_SB_TEST_FOO_VAL
	int "Expected sysbuild test value"
	default 999999
	help
	  Expected sysbuild value for the test.

config EXPECTED_APP_TEST_FOO_VAL
	int "Expected application test value"
	default 999999
	help
	  Expected application value for the test.

source "${ZEPHYR_BASE}/share/sysbuild/Kconfig"
```

## tests/cmake/sysbuild_snippets/testcase.yaml
```yaml
common:
  sysbuild: true
  tags: sysbuild_snippets sysbuild
  platform_allow:
  - native_sim
  integration_platforms:
  - native_sim

tests:
  # Test the initial state with no snippets applied
  buildsystem.sysbuild.snippets.none:
    extra_args:
    - SB_CONFIG_EXPECTED_SB_TEST_FOO_VAL=0
    - SB_CONFIG_EXPECTED_APP_TEST_FOO_VAL=12
  # Test the `foo` snippet in sysbuild
  buildsystem.sysbuild.snippets.applied:
    extra_args:
    - SNIPPET=foo
    - SB_CONFIG_EXPECTED_SB_TEST_FOO_VAL=464372
    - SB_CONFIG_EXPECTED_APP_TEST_FOO_VAL=18382
```

## tests/cmake/syscalls/testcase.yaml
```yaml
tests:
  buildsystem.syscalls:
    build_only: true
    platform_allow: native_sim
```

## tests/cmake/yaml/testcase.yaml
```yaml
common:
  tags: cmake
  build_only: true
  platform_allow: native_sim
tests:
  buildsystem.module.yaml:
    sysbuild: false
```

## tests/cmake/zephyr_as_module/testcase.yaml
```yaml
tests:
  cmake.zephyr_as_module:
    platform_allow: native_posix
    build_only: true
```

## tests/cmake/zephyr_get/testcase.yaml
```yaml
tests:
  buildsystem.extensions.zephyr_get:
    build_only: true
    tags: cmake
    type: unit
```

## tests/cmock/example/testcase.yaml
```yaml
tests:
  tests.cmock.example.unit:
    extra_configs:
      - CONFIG_CMOCK=y
    platform_allow: native_posix
  tests.cmock.example.integration:
    platform_allow: native_posix
```

## tests/cmsis_rtos_v2/testcase.yaml
```yaml
tests:
  portability.cmsis_rtos_v2:
    platform_exclude: qemu_x86_64 m2gl025_miv
    tags: cmsis_rtos_v2
    min_ram: 32
    min_flash: 34
```

## tests/cpputest/base/testcase.yaml
```yaml
common:
  tags:
    - test_framework

tests:
  base.my_test_group:
    platform_allow:
      - native_sim/native/64
    harness: "cpputest"
```

## tests/crypto/crypto_hash/boards/kit_pse84_ai_pse846gps2dbzc4a_m55.conf
```kconfig
# Infineon MXCRYPTO requires IO buffers to be cache-line (32-byte) aligned
# and padded to whole cache lines on this Cortex-M55 SoC with D-Cache.
CONFIG_TEST_CRYPTO_IO_ALIGNMENT_BYTES=32
```

## tests/crypto/crypto_hash/boards/s32z2xxdc2_s32z270_rtu0.conf
```kconfig
# Copyright 2024 NXP
# SPDX-License-Identifier: Apache-2.0

# Only used for test
CONFIG_CRYPTO_NXP_S32_HSE_FORMAT_KEY_CATALOG=y
```
