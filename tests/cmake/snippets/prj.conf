## CMakeLists.txt
```
# SPDX-License-Identifier: Apache-2.0

cmake_minimum_required(VERSION 3.28.0)

set(SNIPPET_ROOT "${CMAKE_CURRENT_SOURCE_DIR}/extra_snippet_root;${CMAKE_CURRENT_SOURCE_DIR}")

find_package(Zephyr REQUIRED HINTS $ENV{ZEPHYR_BASE})
project(test_snippets)

FILE(GLOB app_sources src/*.c)
target_sources(app PRIVATE ${app_sources})
```

## Kconfig
```
# Copyright 2023 Nordic Semiconductor ASA
# SPDX-License-Identifier: Apache-2.0

mainmenu "Snippet tests"

menu "Zephyr"
source "Kconfig.zephyr"
endmenu

# Snippet test types used by the test implementation to steer the test logic
choice
	prompt "Snippet Test Type"
	default TEST_TYPE_NONE

config TEST_TYPE_NONE
	bool "Test Type: None"
	help
	  Test the initial state with no snippets applied.

config TEST_TYPE_FOO
	bool "Test Type: Foo"
	help
	  Test the `foo` snippet from the default application snippet root.

config TEST_TYPE_BAR
	bool "Test Type: Bar"
	help
	  Test the `bar` snippet from an extra snippet root.

config TEST_TYPE_FOO_BAR
	bool "Test Type: Foo-Bar"
	help
	  Test the snippet processing order (1. foo, 2. bar)

config TEST_TYPE_BAR_FOO
	bool "Test Type: Bar-Foo"
	help
	  Test the snippet processing order (1. bar, 2. foo)

config TEST_TYPE_VER_CHECK
	bool "Test Type: Version check"
	help
	  Test board version snippet application

config TEST_TYPE_VER_CHECK_SPECIFIC
	bool "Test Type: Version check specific"
	help
	  Test board version snippet application with specific board version

config TEST_TYPE_FILE_LIST
	bool "Test Type: File list"
	help
	  Test list support for snippet conf and overlay files.

endchoice

# Test values set by the snippet config overlays and tested by the test logic
config TEST_FOO_VAL
	int "Test value set by the 'foo' snippet config overlay"
	help
	  This option's value should be overridden by the 'foo' snippet config
	  overlay.

config TEST_BAR_VAL
	int "Test value set by the 'bar' snippet config overlay"
	help
	  This option's value should be overridden by the 'bar' snippet config
	  overlay.

config TEST_COMMON_VAL
	int "Test value set by the snippet config overlays"
	help
	  This option's value should be overridden by the snippet config
	  overlays.

# Used for testing board version snippets
config TEST_VER_CHECK_APPLIED
	bool "Test version check snippet applied"
	help
	  This option's value should be set by the ver_check snippet.

config TEST_VER_CHECK_SPECIFIC_VERSION_APPLIED
	bool "Test version check with board version snippet applied"
	help
	  This option's value should be set by the ver_check snippet.

# Used for testing board file list variables
config TEST_BOARD1
	bool "Test value set by the snippet file list board 1 config overlay"
	help
	  This option's value should be overridden by the snippet config
	  overlays.

config TEST_BOARD2
	bool "Test value set by the snippet file list board 2 config overlay"
	help
	  This option's value should be overridden by the snippet config
	  overlays.
```

## prj.conf
```kconfig
CONFIG_ZTEST=y
CONFIG_TEST_FOO_VAL=774392
CONFIG_TEST_BAR_VAL=182834
CONFIG_TEST_COMMON_VAL=588411
```

## app.overlay
```dts
/ {
	/* This node will be deleted by the `foo` snippet. */
	deleted-by-foo { };

	/* This node will be deleted by the `bar` snippet. */
	deleted-by-bar { };
};
```

## src/main.c
```c
/*
 * Copyright (c) 2023 Nordic Semiconductor ASA
 * SPDX-License-Identifier: Apache-2.0
 */

#include <zephyr/ztest.h>
#include <zephyr/devicetree.h>

/* Initial test config values set by `prj.conf` */
#define TEST_FOO_VAL_INIT		(774392)
#define TEST_BAR_VAL_INIT		(182834)
#define TEST_COMMON_VAL_INIT		(588411)

/* Test config values set by the `foo` snippet */
#define TEST_FOO_VAL_FOO		(464372)
#define TEST_COMMON_VAL_FOO		(271983)

/* Test config values set by the `bar` snippet */
#define TEST_BAR_VAL_BAR		(964183)
#define TEST_COMMON_VAL_BAR		(109234)

/* Check board-specific snippet files */
#if defined(CONFIG_TEST_TYPE_VER_CHECK)
#if !defined(CONFIG_TEST_VER_CHECK_APPLIED)
#error "Base ver_check snippet has not been applied"
#endif
#if defined(CONFIG_TEST_VER_CHECK_SPECIFIC_VERSION_APPLIED)
#error "Board specific ver_check snippet has wrongly been applied"
#endif
#elif defined(CONFIG_TEST_TYPE_VER_CHECK_SPECIFIC)
#if !defined(CONFIG_TEST_VER_CHECK_APPLIED)
#error "Base ver_check snippet has not been applied"
#endif
#if !defined(CONFIG_TEST_VER_CHECK_SPECIFIC_VERSION_APPLIED)
#error "Board specific ver_check snippet has not been applied"
#endif
#endif

ZTEST_SUITE(snippet_tests, NULL, NULL, NULL, NULL, NULL);

ZTEST(snippet_tests, test_overlay_config)
{
	if (IS_ENABLED(CONFIG_TEST_TYPE_NONE)) {
		/*
		 * When no snippet is applied, test that the config values
		 * correspond to the initial values set by `prj.conf`.
		 */
		zassert_equal(CONFIG_TEST_FOO_VAL, TEST_FOO_VAL_INIT);
		zassert_equal(CONFIG_TEST_BAR_VAL, TEST_BAR_VAL_INIT);
		zassert_equal(CONFIG_TEST_COMMON_VAL, TEST_COMMON_VAL_INIT);
	} else if (IS_ENABLED(CONFIG_TEST_TYPE_FOO)) {
		/*
		 * When `foo` snippet is applied, test that the foo and common
		 * config values correspond to the values set by the `foo`
		 * snippet.
		 */
		zassert_equal(CONFIG_TEST_FOO_VAL, TEST_FOO_VAL_FOO);
		zassert_equal(CONFIG_TEST_BAR_VAL, TEST_BAR_VAL_INIT);
		zassert_equal(CONFIG_TEST_COMMON_VAL, TEST_COMMON_VAL_FOO);
	} else if (IS_ENABLED(CONFIG_TEST_TYPE_BAR)) {
		/*
		 * When `bar` snippet is applied, test that the bar and common
		 * config values correspond to the values set by the `bar`
		 * snippet.
		 */
		zassert_equal(CONFIG_TEST_FOO_VAL, TEST_FOO_VAL_INIT);
		zassert_equal(CONFIG_TEST_BAR_VAL, TEST_BAR_VAL_BAR);
		zassert_equal(CONFIG_TEST_COMMON_VAL, TEST_COMMON_VAL_BAR);
	} else if (IS_ENABLED(CONFIG_TEST_TYPE_FOO_BAR)) {
		/*
		 * When `foo` and `bar` snippets are applied, with `bar`
		 * specified after `foo`, test that the common config value
		 * corresponds to the value set by the `bar` snippet.
		 */
		zassert_equal(CONFIG_TEST_FOO_VAL, TEST_FOO_VAL_FOO);
		zassert_equal(CONFIG_TEST_BAR_VAL, TEST_BAR_VAL_BAR);
		zassert_equal(CONFIG_TEST_COMMON_VAL, TEST_COMMON_VAL_BAR);
	} else if (IS_ENABLED(CONFIG_TEST_TYPE_BAR_FOO)) {
		/*
		 * When `foo` and `bar` snippets are applied, with `foo`
		 * specified after `bar`, test that the common config value
		 * corresponds to the value set by the `foo` snippet.
		 */
		zassert_equal(CONFIG_TEST_FOO_VAL, TEST_FOO_VAL_FOO);
		zassert_equal(CONFIG_TEST_BAR_VAL, TEST_BAR_VAL_BAR);
		zassert_equal(CONFIG_TEST_COMMON_VAL, TEST_COMMON_VAL_FOO);
	} else if (IS_ENABLED(CONFIG_TEST_TYPE_FILE_LIST)) {
		/*
		 * The 'file_list' snippet will apply two configs that should
		 * combine to match the 'foo' values. Specifically for native_sim
		 * we have additional configs set.
		 */
		zassert_equal(CONFIG_TEST_FOO_VAL, TEST_FOO_VAL_FOO);
		zassert_equal(CONFIG_TEST_COMMON_VAL, TEST_COMMON_VAL_FOO);
		if (strcmp(CONFIG_BOARD_TARGET, "native_sim/native") == 0) {
			zassert_true(IS_ENABLED(CONFIG_TEST_BOARD1));
			zassert_true(IS_ENABLED(CONFIG_TEST_BOARD2));
		} else {
			zassert_false(IS_ENABLED(CONFIG_TEST_BOARD1));
			zassert_false(IS_ENABLED(CONFIG_TEST_BOARD2));
		}
	} else {
		zassert(false, "Invalid test type");
	}
}

ZTEST(snippet_tests, test_dtc_overlay)
{
	if (IS_ENABLED(CONFIG_TEST_TYPE_NONE)) {
		/*
		 * When no snippet is applied, test that both `deleted-by-foo`
		 * and `deleted-by-bar` nodes exist, and that none of the nodes
		 * added by the `foo` and `bar` snippets exist.
		 */
		zassert_true(DT_NODE_EXISTS(DT_PATH(deleted_by_foo)));
		zassert_true(DT_NODE_EXISTS(DT_PATH(deleted_by_bar)));
		zassert_false(DT_NODE_EXISTS(DT_PATH(added_by_foo)));
		zassert_false(DT_NODE_EXISTS(DT_PATH(added_by_bar)));
	} else if (IS_ENABLED(CONFIG_TEST_TYPE_FOO)) {
		/*
		 * When `foo` snippet is applied, test that `deleted-by-foo` is
		 * deleted and `added-by-foo` is added.
		 */
		zassert_false(DT_NODE_EXISTS(DT_PATH(deleted_by_foo)));
		zassert_true(DT_NODE_EXISTS(DT_PATH(deleted_by_bar)));
		zassert_true(DT_NODE_EXISTS(DT_PATH(added_by_foo)));
		zassert_false(DT_NODE_EXISTS(DT_PATH(added_by_bar)));
	} else if (IS_ENABLED(CONFIG_TEST_TYPE_BAR)) {
		/*
		 * When `bar` snippet is applied, test that `deleted-by-bar` is
		 * deleted and `added-by-bar` is added.
		 */
		zassert_true(DT_NODE_EXISTS(DT_PATH(deleted_by_foo)));
		zassert_false(DT_NODE_EXISTS(DT_PATH(deleted_by_bar)));
		zassert_false(DT_NODE_EXISTS(DT_PATH(added_by_foo)));
		zassert_true(DT_NODE_EXISTS(DT_PATH(added_by_bar)));
	} else if (IS_ENABLED(CONFIG_TEST_TYPE_FOO_BAR)) {
		/*
		 * When `foo` and `bar` snippets are applied, with `bar`
		 * specified after `foo`, test that both `deleted-by-foo` and
		 * `deleted-by-bar` are deleted, and that the `added-by-foo` is
		 * deleted by the `bar` snippet.
		 */
		zassert_false(DT_NODE_EXISTS(DT_PATH(deleted_by_foo)));
		zassert_false(DT_NODE_EXISTS(DT_PATH(deleted_by_bar)));
		zassert_false(DT_NODE_EXISTS(DT_PATH(added_by_foo)));
		zassert_true(DT_NODE_EXISTS(DT_PATH(added_by_bar)));
	} else if (IS_ENABLED(CONFIG_TEST_TYPE_BAR_FOO)) {
		/*
		 * When `foo` and `bar` snippets are applied, with `foo`
		 * specified after `bar`, test that both `deleted-by-foo` and
		 * `deleted-by-bar` are deleted, and that the `added-by-bar` is
		 * deleted by the `foo` snippet.
		 */
		zassert_false(DT_NODE_EXISTS(DT_PATH(deleted_by_foo)));
		zassert_false(DT_NODE_EXISTS(DT_PATH(deleted_by_bar)));
		zassert_true(DT_NODE_EXISTS(DT_PATH(added_by_foo)));
		zassert_false(DT_NODE_EXISTS(DT_PATH(added_by_bar)));
	} else if (IS_ENABLED(CONFIG_TEST_TYPE_FILE_LIST)) {
		/*
		 * The 'file_list' snippet will apply two overlays, each adding
		 * a node.
		 */
		zassert_true(DT_NODE_EXISTS(DT_PATH(added_by_conf1)));
		zassert_true(DT_NODE_EXISTS(DT_PATH(added_by_conf2)));
	} else {
		zassert(false, "Invalid test type");
	}
}

ZTEST(snippet_tests, test_cmake_include)
{
	if (IS_ENABLED(CONFIG_TEST_TYPE_FOO) ||
	    IS_ENABLED(CONFIG_TEST_TYPE_FOO_BAR) ||
	    IS_ENABLED(CONFIG_TEST_TYPE_BAR_FOO) ||
	    IS_ENABLED(CONFIG_TEST_TYPE_FILE_LIST)) {
		zassert_true(DT_NODE_EXISTS(DT_PATH(cmake_dts_configure)));
	} else {
		zassert_false(DT_NODE_EXISTS(DT_PATH(cmake_dts_configure)));
	}
}
```
