## tests/cmake/hwm/board_extend/oot_root/boards/qemu/x86_default/Kconfig.defconfig
```kconfig
# SPDX-License-Identifier: Apache-2.0
# Copyright (c) 2026 Intel Corp.

if BOARD_QEMU_X86_DEFAULT

# The EEPROM emulator must be initialized after the flash simulator
config EEPROM_INIT_PRIORITY
	default 60
	depends on EEPROM

config BUILD_OUTPUT_BIN
	default n

config QEMU_TARGET
	default y

config HAS_COVERAGE_SUPPORT
	default y

config FLASH_SIMULATOR
	default y
	depends on FLASH

config KERNEL_VM_SIZE
	default 0x10000000 if ACPI

config MULTIBOOT
	default y

config MULTIBOOT_INFO
	default y if MULTIBOOT

config MULTIBOOT_MEMMAP
	default y if MULTIBOOT

config QEMU_ICOUNT
	default n if HPET_TIMER && SHELL

config QEMU_ICOUNT_SHIFT
	default 5

endif # BOARD_QEMU_X86_DEFAULT
```

## tests/cmake/hwm/board_extend/oot_root/boards/qemu/x86_default/board.yml
```yaml
board:
  name: qemu_x86_default
  full_name: QEMU Emulation for X86 Default Qualifier Test
  vendor: intel
  default_qualifier: atom/virt
  socs:
    - name: atom
      variants:
        - name: virt
          variants:
            - name: two
```

## tests/crypto/crypto_aes/testcase.yaml
```yaml
tests:
  crypto.aes.mbedtls_shim:
    platform_allow:
      - native_sim
    integration_platforms:
      - native_sim
    extra_args: EXTRA_CONF_FILE=prj_mtls_shim.conf
    tags: crypto
  crypto.aes:
    platform_allow:
      - esp32_devkitc/esp32/procpu
      - esp32s2_devkitc
      - esp32s3_devkitc/esp32s3/procpu
      - esp32c3_devkitc
      - esp32c6_devkitc/esp32c6/hpcore
      - esp32h2_devkitm
      - nucleo_h753zi
      - sama7g54_ek
      - sf32lb52_devkit_lcd
      - lp_em_cc35x1/cc3551e
      - lp_em_cc2745r10_q1/cc2745r10_q1
      - lp_em_cc2745r10_q1/cc2755r10
      - lp_em_cc2755p10
      - lp_em_cc2755p20
      - lp_em_cc2340r5
      - lp_em_cc2340r5moda
      - lp_em_cc2340r53
      - lp_em_cc2340r53_wcsp
    tags: crypto
```

## tests/crypto/crypto_hash/Kconfig
```kconfig
# SPDX-FileCopyrightText: Copyright (c) 2026 Infineon Technologies AG,
# SPDX-FileCopyrightText: or an affiliate of Infineon Technologies AG. All rights reserved.
#
# SPDX-License-Identifier: Apache-2.0

source "Kconfig.zephyr"

config TEST_CRYPTO_IO_ALIGNMENT_BYTES
	int "Alignment (bytes) for hash test IO buffers"
	default 4
	help
	  Alignment (in bytes) applied to the hash test input and output
	  buffers, and to which their sizes are rounded up.  Some crypto
	  drivers require IO buffers handed to them to be cache-line
	  aligned and to occupy whole cache lines so that the driver's
	  cache-maintenance operations do not corrupt unrelated data
	  sharing a partial cache line.  Boards whose crypto driver has
	  this requirement should override this value (typically to the
	  D-Cache line size) via a board overlay.

config TEST_CRYPTO_HASH_BENCH
	bool "Enable hash throughput/CPU-load benchmark tests"
	select CPU_LOAD
	help
	  Enable additional ZTEST cases that benchmark hash_compute()
	  throughput (cycles/byte, MB/s) and CPU load for each supported
	  algorithm, on top of the functional known-answer tests. Disabled
	  by default since it requires CONFIG_CPU_LOAD and takes noticeably
	  longer to run.
```

## tests/crypto/psa-test-suite/Kconfig
```kconfig
# SPDX-FileCopyrightText: Copyright (c) 2026 STMicroelectronics
# SPDX-License-Identifier: Apache-2.0

source "Kconfig.zephyr"

config TF_PSA_CRYPTO_PATH
	string "Path of the TF PSA Crypto source tree"
	default "${ZEPHYR_TF_PSA_CRYPTO_MODULE_DIR}"

config MBEDTLS_FRAMEWORK_PATH
	string "Path of the Mbed TLS framework source tree"
	help
	  Path to mbedtsl-framework source tree. If not set, framework/
	  subdirectory of tf_psa_crypto root directory
	  (TF_PSA_CRYPTO_PATH) is used.

config TF_PSA_CRYPTO_TEST_BUILD_PATH
	string "Path of the generated test files from TF-PSA-Crypto"
	help
	  Path to tf-psa-crypto build directory. If not set, build/
	  subdirectory of tf_psa_crypto root directory
	  (TF_PSA_CRYPTO_PATH) is used.

config PSA_TEST_SUITE_LIST
	string "Path of the files that defines tests to be embedded"
	default "all.txt"

config PSA_TEST_SUITE_MBEDTLS_HEAP_SIZE
	int "Byte size of the mbedtls heap used for the test"
	default 128000
	help
          The TF PSA Crypto test suite uses a dedicated mbedtls heap
	  (MBEDTLS_MEMORY_BUFFER_ALLOC_C enabled) that must be
	  sized according to the target tests. This heap is wiped
	  between tests so that a failing test does not compromise
	  the next executed ones.

	  Not the heap is allocatetd in the test main function stac,
	  hence enough stack must be provisioned by the system.

config PSA_TEST_SUITE_DATA_LINE_MAX_SIZE
	int "Max length of tesst data string in test suites data"
	default 16384
	help
	  Max length supported for input/output data read from the
	  test suite .data files. If a test case has a data line
	  description in the test suite .datax file (generated from
	  the test suite .data file, equivalent sizes), input and
	  output vectors won't be extracted and test will be skipped.

	  Note that the line buffer is allocated in the mbedtls
	  heap used for the tests, see PSA_TEST_SUITE_MBEDTLS_HEAP_SIZE.

	  16kByte should be enough. Lower this value only if you
	  need small mbedtls heap for the tests.
```

## tests/crypto/psa-test-suite/boards/nucleo_u385rg_q.conf
```kconfig
# SPDX-FileCopyrightText: Copyright (c) 2026 STMicroelectronics
# SPDX-License-Identifier: Apache-2.0

# The board has 256kB of RAM
CONFIG_PSA_TEST_SUITE_MBEDTLS_HEAP_SIZE=120000
CONFIG_ZTEST_STACK_SIZE=128000
```

## tests/drivers/adc/adc_api/Kconfig
```kconfig
# ADC API test configuration options

# Copyright (c) 2024 STMicroelectronics
# SPDX-License-Identifier: Apache-2.0

mainmenu "ADC API Test"

source "Kconfig.zephyr"

config TEST_ADC_BASIC
	bool "Exercise the ADC API on the board's channels"
	default y

config ADC_API_SAMPLE_INTERVAL_US
	int "Interval between repeatead samples in us"
	default 0

config ADC_32_BITS_DATA
	bool "ADC data is 32-bits long"

config TEST_ADC_CALIBRATE_REQUIRED
	bool "Require calibrate field in ADC test"
	default y if DT_HAS_RENESAS_RA_ADC16_ENABLED

config TEST_ADC_ERROR_CASES
	bool "Check the error codes of the ADC API"

config TEST_ADC_ACCURACY_REF
	bool "Compare a channel against the board's reference voltage"
	depends on DT_HAS_TEST_ADC_REFERENCE_VOLTAGE_ENABLED

config TEST_ADC_ACCURACY_DAC
	bool "Compare a channel against a DAC output of the board"
	depends on DT_HAS_TEST_ADC_DAC_LOOPBACK_ENABLED
	select DAC

config TEST_ADC_ACCURACY_PASSES
	int "Number of readings in the accuracy tests"
	default 5

config TEST_DAC_BUFFER_NOT_SUPPORTED
	bool "DAC on board/SoC does not support output buffer mode"
	help
	  The accuracy test then sets up the DAC channel without its output buffer.
```

## tests/drivers/adc/adc_api/boards/frdm_mcxa287.conf
```kconfig
# SPDX-FileCopyrightText: Copyright 2026 NXP
# SPDX-License-Identifier: Apache-2.0

CONFIG_LPADC_DO_OFFSET_CALIBRATION=y
```

## tests/drivers/adc/adc_api/boards/nucleo_u5a5zj_q.conf
```kconfig
CONFIG_COUNTER=y
CONFIG_TEST_USERSPACE=n
CONFIG_ADC_API_SAMPLE_INTERVAL_US=10000
```

## tests/drivers/adc/adc_api/boards/pic32cx_sg61_cult.conf
```kconfig
# Copyright (c) 2026 Microchip Technology Inc.
# SPDX-License-Identifier: Apache-2.0

CONFIG_TEST_DAC_BUFFER_NOT_SUPPORTED=y
```

## tests/drivers/adc/adc_api/boards/stm32h7_renode_reference_board.conf
```kconfig
# Copyright (c) 2026 Antmicro <www.antmicro.com>
# SPDX-License-Identifier: Apache-2.0

CONFIG_NOCACHE_MEMORY=y
```

## tests/drivers/adc/adc_api/dts/bindings/test-adc-dac-loopback.yaml
```yaml
# SPDX-FileCopyrightText: Copyright The Zephyr Project Contributors
# SPDX-License-Identifier: Apache-2.0

description: |
  A DAC output of the board wired to one of its ADC channels, for the
  accuracy test of tests/drivers/adc/adc_api.

compatible: "test-adc-dac-loopback"

include: base.yaml

properties:
  io-channels:
    type: phandle-array
    required: true
    description: The ADC channel the DAC output is wired to.

  dac:
    type: phandle
    required: true
    description: The DAC controller.

  dac-channel-id:
    type: int
    required: true
    description: The DAC channel driving the output.

  dac-resolution:
    type: int
    required: true
    description: The resolution the DAC channel is set up with, in bits.
```

## tests/drivers/adc/adc_api/dts/bindings/test-adc-reference-voltage.yaml
```yaml
# SPDX-FileCopyrightText: Copyright The Zephyr Project Contributors
# SPDX-License-Identifier: Apache-2.0

description: |
  A known voltage wired to an ADC channel of the board, for the accuracy
  test of tests/drivers/adc/adc_api.

compatible: "test-adc-reference-voltage"

include: base.yaml

properties:
  io-channels:
    type: phandle-array
    required: true
    description: The ADC channel the reference voltage is wired to.

  reference-mv:
    type: int
    required: true
    description: The reference voltage, in millivolts.

  expected-accuracy:
    type: int
    required: true
    description: The largest acceptable difference from the reference, in millivolts.
```

## tests/drivers/audio/dmic_api/Kconfig
```kconfig
# Copyright 2025 NXP
# SPDX-License-Identifier: Apache-2.0

source "Kconfig.zephyr"

config SAMPLE_BIT_WIDTH
	int "Sample bit width"
	default 32 if DT_HAS_NXP_MICFIL_ENABLED
	default 16
	help
	  PCM sample bit width.

config SAMPLE_PDM_CHANNELS
	int "Number of DMIC channels"
	default 4 if DT_HAS_NXP_MICFIL_ENABLED || DT_HAS_NXP_DMIC_ENABLED
	default 1 if DT_HAS_RENESAS_RA_PDM_ENABLED
	default 2
	help
	  Count of DMIC channels to capture and process. With 1, the stereo
	  test is skipped.

config TEST_HW_CHANNEL_INDEX
	int "hardware controller index"
	default 0
	help
	  Specifies the index of the hardware controller.

config TEST_SMALL_BUFFER
	bool "Use a smaller buffer for testing"
	default y if DT_HAS_RENESAS_RA_PDM_ENABLED
	help
	  Use a smaller buffer for testing. This is useful if your device has limited memory.
```

## tests/drivers/audio/dmic_api/boards/kit_pse84_eval_pse846gps2dbzc4a_m33.conf
```kconfig
# SPDX-FileCopyrightText: Copyright (c) 2026 Infineon Technologies AG,
# SPDX-FileCopyrightText: or an affiliate of Infineon Technologies AG. All rights reserved.
#
# SPDX-License-Identifier: Apache-2.0

CONFIG_TEST_HW_CHANNEL_INDEX=1
CONFIG_TEST_SMALL_BUFFER=y
```

## tests/drivers/clock_control/stm32n6_cpu_clock/Kconfig
```kconfig
# SPDX-FileCopyrightText: Copyright The Zephyr Project Contributors
# SPDX-License-Identifier: Apache-2.0

source "Kconfig.zephyr"

config TEST_STM32N6_CPU_CLOCK_STRESS_ITERATIONS
	int "CPU clock rate change stress iterations"
	range 0 10000
	default 0
	help
	  Number of additional CPU clock changes to run after the normal sweep.
	  Set to 10000 for an extended hardware stress run.
```

## tests/drivers/clock_management/clock_management_api/Kconfig
```kconfig
# SPDX-License-Identifier: Apache-2.0
# Copyright (c) 2026, Analog Devices

rsource "../common/emul_clock_drivers/Kconfig"
source "Kconfig.zephyr"
```

## tests/drivers/clock_management/clock_management_api/dts/bindings/vnd,emul-clock-consumer.yaml
```yaml
# Copyright 2024 NXP
#
# SPDX-License-Identifier: Apache-2.0

description: |
  Binding for emulated clock consumer device. This device is used in testing
  to verify that clock states are applied as expected.

compatible: "vnd,emul-clock-consumer"

include: [clock-device.yaml]

properties:
  default-freq:
    type: int
    required: true
    description: |
      Frequency this consumer expects to read when applying default clock
      management request

  shared-freq:
    type: int
    required: true
    description: |
      Frequency this consumer expects to read when applying shared clock
      management request

  ranked-freq:
    type: int
    required: true
    description: |
      Frequency this consumer expects to read when applying ranked clock
      management request

  freq-req-1:
    type: int
    required: true
    description: |
      Frequency this consumer will request for the clock set rate test

  req-freq-1:
    type: int
    required: true
    description: |
      Expected frequency the consumer will realize when requesting 'freq-req-1'
```
