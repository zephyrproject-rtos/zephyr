## tests/cmake/app_version/testcase.yaml
```yaml
tests:
  buildsystem.app_version:
    tags: version
    integration_platforms:
      - native_sim
```

## tests/cmake/armlink_scatter/testcase.yaml
```yaml
common:
  tags: cmake
  build_only: true
  platform_allow: native_sim
tests:
  buildsystem.cmake.armlink_scatter.empty_noinput:
    sysbuild: false
```

## tests/cmake/config_dir/Kconfig
```kconfig
# Copyright (c) 2021 Nordic Semiconductor ASA
# SPDX-License-Identifier: Apache-2.0

config FAIL_TEST
	bool "Fail the test"
	default y

source "Kconfig.zephyr"
```

## tests/cmake/config_dir/testcase.yaml
```yaml
tests:
  buildsystem.config_dir.user_defined:
    platform_allow: native_sim
    build_only: true
    extra_args: APPLICATION_CONFIG_DIR:PATH=foo
```

## tests/cmake/hwm/board_extend/Kconfig
```kconfig
# Copyright (c) 2024 Nordic Semiconductor ASA
#
# SPDX-License-Identifier: Apache-2.0

config BASE_BOARD_SETTING
	bool "Base board test string"
	help
	  This kconfig is set when the base board config fragment is supposed to
	  be sourced, that is when oot variant defines
	  'extends:'
	  '  board: native_sim'
	  '  qualifier: posix'
	  '  inherit: 1'

source "Kconfig.zephyr"
```

## tests/cmake/hwm/board_extend/oot_root/boards/arm/mps2/Kconfig.mps2
```kconfig
# Copyright (c) 2017 Linaro Limited
# SPDX-License-Identifier: Apache-2.0

config BOARD_MPS2
	select SOC_MPS2_AN521_CPUTEST if BOARD_MPS2_AN521_CPUTEST
```

## tests/cmake/hwm/board_extend/oot_root/boards/native/native_sim_extend/Kconfig
```kconfig
# Copyright (c) 2024 Nordic Semiconductor ASA
# SPDX-License-Identifier: Apache-2.0

config EXTENDED_VARIANT_BOARD_SETTING
	bool "Extended variant board test string"
	depends on BOARD_NATIVE_SIM_NATIVE_ONE || BOARD_NATIVE_SIM_NATIVE_64_TWO
	help
	  This kconfig is set when the extended variant board config fragment
	  is supposed to be sourced, that is when oot variant defines 'extends:'

config EXTENDED_VARIANT_BOARD_ONE_SETTING_PROMPTLESS
	bool
	depends on BOARD_NATIVE_SIM_NATIVE_ONE
	help
	  This kconfig is promptless and is expected to be set through the
	  Kconfig.defconfig for the extended board.

config EXTENDED_VARIANT_BOARD_TWO_SETTING_PROMPTLESS
	bool
	depends on BOARD_NATIVE_SIM_NATIVE_64_TWO
	help
	  This kconfig is promptless and is expected to be set through the
	  Kconfig.defconfig for the extended board.

config EXTENDED_VARIANT_BOARD_SETTING_DEFCONFIG
	bool "Extended variant board test string defconfig"
	depends on BOARD_NATIVE_SIM_NATIVE_ONE || BOARD_NATIVE_SIM_NATIVE_64_TWO
	help
	  This kconfig is set when the extended variant board defconfig fragment
	  is supposed to be sourced, that is when oot variant defines 'extends:'
```

## tests/cmake/hwm/board_extend/oot_root/boards/native/native_sim_extend/Kconfig.defconfig
```kconfig
# Copyright (c) 2024 Nordic Semiconductor ASA
# SPDX-License-Identifier: Apache-2.0

if BOARD_NATIVE_SIM_NATIVE_ONE

config EXTENDED_VARIANT_BOARD_ONE_SETTING_PROMPTLESS
	default y

endif # BOARD_NATIVE_SIM_NATIVE_ONE

if BOARD_NATIVE_SIM_NATIVE_64_TWO

config EXTENDED_VARIANT_BOARD_TWO_SETTING_PROMPTLESS
	default y

endif # BOARD_NATIVE_SIM_NATIVE_64_TWO
```

## tests/cmake/hwm/board_extend/oot_root/boards/native/native_sim_extend/board.yml
```yaml
board:
  extend: native_sim
  variants:
    - name: one
      qualifier: native
    - name: two
      qualifier: native/64
```

## tests/cmake/hwm/board_extend/oot_root/boards/native/native_sim_extend/native_sim_native_one_defconfig
```kconfig
# Copyright (c) 2024 Nordic Semiconductor ASA
# SPDX-License-Identifier: Apache-2.0

CONFIG_CONSOLE=y
CONFIG_SYS_CLOCK_HW_CYCLES_PER_SEC=1000000

CONFIG_EXTENDED_VARIANT_BOARD_SETTING_DEFCONFIG=y
```

## tests/cmake/hwm/board_extend/oot_root/soc/arm/Kconfig.soc
```kconfig
# Copyright (c) 2024, Nordic Semiconductor ASA
# SPDX-License-Identifier: Apache-2.0

config SOC_AN521_CPUTEST
	bool
	select SOC_AN521
```

## tests/cmake/hwm/board_extend/testcase.yaml
```yaml
common:
  tags:
    - cmake
tests:
  cmake.board.extend_one:
    extra_args:
      # Twister can only lookup known board roots.
      # Thus platform above is set to native_sim, while at this location
      # we overrule with the native_sim/native/one board.
      # Test will fail if we accidentially build for the base native_sim board.
      - CACHED_BOARD=native_sim/native/one
    platform_allow:
      - native_sim
      - native_sim/native/64
    integration_platforms:
      - native_sim
      - native_sim/native/64
  cmake.board.extend_two:
    extra_args:
      - CACHED_BOARD=native_sim/native/64/two
    platform_allow:
      - native_sim
      - native_sim/native/64
    integration_platforms:
      - native_sim
      - native_sim/native/64
  cmake.soc.extend_cputest:
    extra_args:
      - CACHED_BOARD=mps2/an521/cputest
    platform_allow:
      - mps2/an521/cpu0
    integration_platforms:
      - mps2/an521/cpu0
```

## tests/cmake/mcuboot_image_size_check/testcase.yaml
```yaml
common:
  tags: cmake mcuboot
  build_only: true
  platform_allow: native_sim
tests:
  buildsystem.cmake.mcuboot_image_size_check:
    sysbuild: false
```

## tests/cmake/mcuboot_image_size_check_sysbuild/Kconfig
```kconfig
# Copyright (c) 2025 Nordic Semiconductor ASA
# SPDX-License-Identifier: Apache-2.0

config TEST_BLOAT_SIZE
	int "Padding array size in bytes to inflate the binary"
	default 0
	help
	  Size of a const padding array linked into .rodata.
	  Used to push the signed image close to or beyond the
	  slot size limit for testing the MCUboot image size check.

source "Kconfig.zephyr"
```

## tests/cmake/mcuboot_image_size_check_sysbuild/testcase.yaml
```yaml
# To manually verify the overflow check, the bloat size must land in the
# narrow gap between the linker limit and the signed-binary limit (~336
# bytes of imgtool header + TLV overhead):
#   west build -b nrf52840dk/nrf52840 \
#     tests/cmake/mcuboot_image_size_check_sysbuild \
#     --sysbuild -- -DCONFIG_TEST_BLOAT_SIZE=23700
# The build should fail with:
#   "MCUboot signed image exceeds maximum size for swap upgrade"
common:
  sysbuild: true
  build_only: true
  tags:
    - cmake
    - mcuboot
  platform_allow:
    - nrf52840dk/nrf52840
tests:
  buildsystem.cmake.mcuboot_image_size_check_sysbuild.pass:
    extra_configs:
      - CONFIG_TEST_BLOAT_SIZE=6000
```

## tests/cmake/module_path/fake_workspace/main_project/west.yml
```yaml
manifest:
  projects:
    - name: module
      url: https://example.com/module
      revision: master
      path: module
      userdata:
        module-path: custom
  self:
    path: main_project
```

## tests/cmake/module_path/fake_workspace/module/custom/Kconfig
```kconfig
# SPDX-License-Identifier: Apache-2.0
# SPDX-FileCopyrightText: Copyright (c) 2026 Silicon Laboratories Inc.

config MODULE_PATH_TEST_OPTION
	bool "Fake option used to test module_path attribute"
	default y
```

## tests/cmake/overlays/soc_folder_kconfig/Kconfig
```kconfig
# Copyright (c) 2024 Nordic Semiconductor ASA
# SPDX-License-Identifier: Apache-2.0

config SOC_FOLDER_TEST_STRING
	string "Test string"
	default "one"

config SOC_FOLDER_TEST_INCLUDE_BOARD
	bool "Included board Kconfig fragment"

config SOC_FOLDER_TEST_INCLUDE_BOARD_SUFFIX
	bool "Included board Kconfig fragment with suffix"

config SOC_FOLDER_TEST_INCLUDE_BOARD_QUALIFIERS
	bool "Included board with qualifiers Kconfig fragment"

config SOC_FOLDER_TEST_INCLUDE_BOARD_OTHER
	bool "Included other board Kconfig fragment"

config SOC_FOLDER_TEST_INCLUDE_SOC
	bool "Included soc Kconfig fragment"

config SOC_FOLDER_TEST_INCLUDE_SOC_SUFFIX
	bool "Included soc overlay Kconfig fragment"

config SOC_FOLDER_TEST_INCLUDE_SOC_OTHER
	bool "Included other soc overlay Kconfig fragment"

config TEST_TYPE
	int "Test type"

source "Kconfig.zephyr"
```

## tests/cmake/overlays/soc_folder_kconfig/boards/native_sim_native_64.conf
```kconfig
CONFIG_SOC_FOLDER_TEST_INCLUDE_BOARD_QUALIFIERS=y
CONFIG_SOC_FOLDER_TEST_STRING="five"
```

## tests/cmake/overlays/soc_folder_kconfig/boards/native_sim_native_somesuffix.conf
```kconfig
CONFIG_SOC_FOLDER_TEST_INCLUDE_BOARD_SUFFIX=y
CONFIG_SOC_FOLDER_TEST_STRING="four"
```

## tests/cmake/overlays/soc_folder_kconfig/boards/other.conf
```kconfig
CONFIG_SOC_FOLDER_TEST_INCLUDE_BOARD_OTHER=y
CONFIG_SOC_FOLDER_TEST_STRING="three"
CONFIG_ZTEST=y
```
