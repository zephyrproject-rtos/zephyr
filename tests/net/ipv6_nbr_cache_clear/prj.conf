## CMakeLists.txt
```
# SPDX-License-Identifier: Apache-2.0

cmake_minimum_required(VERSION 3.28.0)
find_package(Zephyr REQUIRED HINTS $ENV{ZEPHYR_BASE})
project(ipv6_nbr_cache_clear)

target_include_directories(app PRIVATE ${ZEPHYR_BASE}/subsys/net/ip)
FILE(GLOB app_sources src/*.c)
target_sources(app PRIVATE ${app_sources})
```

## prj.conf
```kconfig
CONFIG_NETWORKING=y
CONFIG_NET_TEST=y
CONFIG_NET_IPV6=y
CONFIG_NET_IPV6_NBR_CACHE=y
CONFIG_NET_IPV6_MAX_NEIGHBORS=4

CONFIG_NET_L2_DUMMY=y
CONFIG_NET_L2_ETHERNET=n

# Neighbor Discovery uses sys_rand_get(); provide a random backend so the build
# links on boards without a hardware entropy source (e.g. mps2/an385).
CONFIG_ENTROPY_GENERATOR=y
CONFIG_TEST_RANDOM_GENERATOR=y

CONFIG_ZTEST=y
CONFIG_NET_IF_MAX_IPV6_COUNT=3
CONFIG_MAIN_STACK_SIZE=2048
CONFIG_ZTEST_STACK_SIZE=2048
```

## src/main.c
```c
/*
 * SPDX-FileCopyrightText: 2026 Basalte bv
 * SPDX-License-Identifier: Apache-2.0
 */

/*
 * Test that the IPv6 neighbor cache is cleared when the interface link goes
 * down: non-static entries must be removed (so they are re-resolved once the
 * link is back), while static entries must survive.
 */

#include <zephyr/ztest.h>
#include <zephyr/kernel.h>
#include <zephyr/device.h>

#include <zephyr/net/net_if.h>
#include <zephyr/net/net_ip.h>
#include <zephyr/net/net_linkaddr.h>
#include <zephyr/net/dummy.h>

#include "ipv6.h"

static struct net_if *iface;

/* An address to enable IPv6 on the interface (so the link-down path runs). */
static struct net_in6_addr my_addr = {
	{{0x20, 0x01, 0x0d, 0xb8, 0, 0, 0, 0, 0, 0, 0, 0, 0, 0, 0, 0x1}}};
/* A dynamically learned peer, expected to be cleared on link down. */
static struct net_in6_addr peer_addr = {
	{{0x20, 0x01, 0x0d, 0xb8, 0, 0, 0, 0, 0, 0, 0, 0, 0, 0, 0, 0x2}}};
/* A static peer, expected to survive link down. */
static struct net_in6_addr static_addr = {
	{{0x20, 0x01, 0x0d, 0xb8, 0, 0, 0, 0, 0, 0, 0, 0, 0, 0, 0, 0x3}}};

struct dummy_dev_data {
	uint8_t mac[6];
};

static struct dummy_dev_data dev_data = {
	.mac = {0x00, 0x00, 0x5e, 0x00, 0x53, 0x2b},
};

static void dummy_iface_init(struct net_if *dev_iface)
{
	struct dummy_dev_data *data = net_if_get_device(dev_iface)->data;

	net_if_set_link_addr(dev_iface, data->mac, sizeof(data->mac), NET_LINK_DUMMY);

	/* Keep the interface down until the test brings it up explicitly. */
	net_if_flag_set(dev_iface, NET_IF_NO_AUTO_START);
}

static int dummy_dev_send(const struct device *dev, struct net_pkt *pkt)
{
	ARG_UNUSED(dev);
	ARG_UNUSED(pkt);

	return 0;
}

static DEVICE_API(dummy, dummy_api_funcs) = {
	.iface_api.init = dummy_iface_init,
	.send = dummy_dev_send,
};

NET_DEVICE_INIT(nbr_clear_dev, "nbr_clear", NULL, NULL, &dev_data, NULL,
		CONFIG_KERNEL_INIT_PRIORITY_DEFAULT, &dummy_api_funcs, DUMMY_L2,
		NET_L2_GET_CTX_TYPE(DUMMY_L2), 127);

static void *nbr_clear_setup(void)
{
	iface = net_if_lookup_by_dev(DEVICE_GET(nbr_clear_dev));
	zassert_not_null(iface, "Interface not found");

	return NULL;
}

static void nbr_clear_after(void *fixture)
{
	ARG_UNUSED(fixture);

	(void)net_ipv6_nbr_rm(iface, &peer_addr);
	(void)net_ipv6_nbr_rm(iface, &static_addr);
	(void)net_if_ipv6_addr_rm(iface, &my_addr);

	if (net_if_is_admin_up(iface)) {
		(void)net_if_down(iface);
	}
}

ZTEST(net_ipv6_nbr_cache_clear, test_clear_on_link_down)
{
	struct net_linkaddr lladdr = {
		.type = NET_LINK_DUMMY,
		.len = 6,
		.addr = {0x00, 0x00, 0x5e, 0x00, 0x53, 0xaa},
	};
	struct net_if_addr *ifaddr;
	struct net_nbr *nbr;
	int ret;

	ret = net_if_up(iface);
	zassert_ok(ret, "Cannot bring interface up");

	/* Enable IPv6 on the interface so the link-down path runs. */
	ifaddr = net_if_ipv6_addr_add(iface, &my_addr, NET_ADDR_MANUAL, 0);
	zassert_not_null(ifaddr, "Cannot add IPv6 address");

	/* A dynamically learned neighbor and a static one. */
	nbr = net_ipv6_nbr_add(iface, &peer_addr, &lladdr, false, NET_IPV6_NBR_STATE_STALE);
	zassert_not_null(nbr, "Cannot add dynamic neighbor");
	nbr = net_ipv6_nbr_add(iface, &static_addr, &lladdr, false, NET_IPV6_NBR_STATE_STATIC);
	zassert_not_null(nbr, "Cannot add static neighbor");

	zassert_not_null(net_ipv6_nbr_lookup(iface, &peer_addr), "Dynamic neighbor missing");
	zassert_not_null(net_ipv6_nbr_lookup(iface, &static_addr), "Static neighbor missing");

	/* Bring the link down: the dynamic entry must be cleared, the static
	 * one must survive.
	 */
	ret = net_if_down(iface);
	zassert_ok(ret, "Cannot bring interface down");

	zassert_is_null(net_ipv6_nbr_lookup(iface, &peer_addr),
			"Dynamic neighbor not cleared on link down");
	zassert_not_null(net_ipv6_nbr_lookup(iface, &static_addr),
			 "Static neighbor must survive link down");
}

/* The public entry point flushes the same entries as the link-down path, and
 * a NULL interface reaches every interface.
 */
ZTEST(net_ipv6_nbr_cache_clear, test_public_flush)
{
	struct net_linkaddr lladdr = {
		.type = NET_LINK_DUMMY,
		.len = 6,
		.addr = {0x00, 0x00, 0x5e, 0x00, 0x53, 0xbb},
	};
	struct net_if_addr *ifaddr;
	struct net_nbr *nbr;
	int ret;

	ret = net_if_up(iface);
	zassert_ok(ret, "Cannot bring interface up");

	ifaddr = net_if_ipv6_addr_add(iface, &my_addr, NET_ADDR_MANUAL, 0);
	zassert_not_null(ifaddr, "Cannot add IPv6 address");

	nbr = net_ipv6_nbr_add(iface, &peer_addr, &lladdr, false, NET_IPV6_NBR_STATE_STALE);
	zassert_not_null(nbr, "Cannot add dynamic neighbor");
	nbr = net_ipv6_nbr_add(iface, &static_addr, &lladdr, false, NET_IPV6_NBR_STATE_STATIC);
	zassert_not_null(nbr, "Cannot add static neighbor");

	net_if_ipv6_nbr_flush(iface);

	zexpect_is_null(net_ipv6_nbr_lookup(iface, &peer_addr),
			"Dynamic neighbor was not flushed");
	zexpect_not_null(net_ipv6_nbr_lookup(iface, &static_addr),
			 "Static neighbor must survive a flush");

	/* Learn it again and flush without naming the interface. */
	nbr = net_ipv6_nbr_add(iface, &peer_addr, &lladdr, false, NET_IPV6_NBR_STATE_STALE);
	zassert_not_null(nbr, "Cannot add dynamic neighbor");

	net_if_ipv6_nbr_flush(NULL);

	zexpect_is_null(net_ipv6_nbr_lookup(iface, &peer_addr),
			"Dynamic neighbor was not flushed on every interface");
	zexpect_not_null(net_ipv6_nbr_lookup(iface, &static_addr),
			 "Static neighbor must survive a flush");
}

/* Per-address removal takes a static neighbor back, which a flush does not,
 * and reports whether it found anything.
 */
ZTEST(net_ipv6_nbr_cache_clear, test_public_rm)
{
	struct net_linkaddr lladdr = {
		.type = NET_LINK_DUMMY,
		.len = 6,
		.addr = {0x00, 0x00, 0x5e, 0x00, 0x53, 0xcc},
	};
	struct net_if_addr *ifaddr;
	struct net_nbr *nbr;
	int ret;

	ret = net_if_up(iface);
	zassert_ok(ret, "Cannot bring interface up");

	ifaddr = net_if_ipv6_addr_add(iface, &my_addr, NET_ADDR_MANUAL, 0);
	zassert_not_null(ifaddr, "Cannot add IPv6 address");

	nbr = net_ipv6_nbr_add(iface, &peer_addr, &lladdr, false, NET_IPV6_NBR_STATE_STALE);
	zassert_not_null(nbr, "Cannot add dynamic neighbor");
	nbr = net_ipv6_nbr_add(iface, &static_addr, &lladdr, false, NET_IPV6_NBR_STATE_STATIC);
	zassert_not_null(nbr, "Cannot add static neighbor");

	zexpect_true(net_if_ipv6_nbr_rm(iface, &peer_addr),
		     "Cannot remove the dynamic neighbor");
	zexpect_is_null(net_ipv6_nbr_lookup(iface, &peer_addr),
			"Dynamic neighbor is still there");

	zexpect_false(net_if_ipv6_nbr_rm(iface, &peer_addr),
		      "Removing the neighbor twice reported success");

	zexpect_true(net_if_ipv6_nbr_rm(NULL, &static_addr),
		     "Cannot remove the static neighbor without an interface");
	zexpect_is_null(net_ipv6_nbr_lookup(iface, &static_addr),
			"Static neighbor is still there");
}

ZTEST_SUITE(net_ipv6_nbr_cache_clear, NULL, nbr_clear_setup, NULL, nbr_clear_after, NULL);
```
