## CMakeLists.txt
```
# SPDX-License-Identifier: Apache-2.0

cmake_minimum_required(VERSION 3.28.0)

find_package(Zephyr REQUIRED HINTS $ENV{ZEPHYR_BASE})
project(net_ethernet_l2_only)

target_sources(app PRIVATE src/main.c)
```

## prj.conf
```kconfig
CONFIG_NETWORKING=y
CONFIG_NET_NATIVE=y
CONFIG_NET_L2_ETHERNET=y
CONFIG_NET_TEST=y

CONFIG_NET_IPV4=n
CONFIG_NET_IPV6=n
CONFIG_NET_CONTEXT=n

CONFIG_NET_SHELL=y
```

## src/main.c
```c
/*
 * SPDX-FileCopyrightText: Copyright (c) 2026 Axonne Inc.
 * SPDX-License-Identifier: Apache-2.0
 */

#include <zephyr/net/net_ip.h>
#include <zephyr/sys/util.h>

BUILD_ASSERT(IS_ENABLED(CONFIG_NET_L2_ETHERNET));
BUILD_ASSERT(!IS_ENABLED(CONFIG_NET_IP));
BUILD_ASSERT(!IS_ENABLED(CONFIG_NET_CONTEXT));

int main(void)
{
	return 0;
}
```
