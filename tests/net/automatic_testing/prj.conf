## CMakeLists.txt
```
set(KCONFIG_ROOT ${CMAKE_CURRENT_SOURCE_DIR}/Kconfig)

include($ENV{ZEPHYR_BASE}/cmake/app/boilerplate.cmake NO_POLICY_SCOPE)
project(NONE)

target_sources(app PRIVATE src/main.c)
target_sources(app PRIVATE src/echo-server.c)
target_sources_ifdef(CONFIG_NET_TCP app PRIVATE src/tcp.c)
target_sources_ifdef(CONFIG_NET_UDP app PRIVATE src/udp.c)
target_sources_ifdef(CONFIG_NET_VLAN app PRIVATE src/vlan.c)
```

## Kconfig
```
# Kconfig - Private config options for network testing app

#
# Copyright (c) 2018 Intel Corporation
#
# SPDX-License-Identifier: Apache-2.0
#

mainmenu "Networking test application"

config ZEPHYR_BASE
	string
	option env="ZEPHYR_BASE"

source "$ZEPHYR_BASE/Kconfig.zephyr"

config NET_DEBUG_TEST_APP
	bool "Enable debugging for this test application"
	default n
	depends on NET_LOG
	help
	  Enable debugging output from this test application.
	  The used log level is the CONFIG_SYS_LOG_NET_LEVEL option.

config SAMPLE_VLAN_TAG_1
	int "Virtual lan tag used in this app"
	default 100
	range 0 4094
	depends on NET_VLAN
	help
	  Set virtual lan tag (id) that is used in this application.

config SAMPLE_VLAN_TAG_2
	int "Second VLAN tag used in this app"
	default 200
	range 0 4094
	depends on NET_VLAN
	help
	  Set virtual lan tag (id) that is used in this application.

config SAMPLE_IPV6_ADDR_1
	string "My IPv6 address for a network interface"
	help
	  The value depends on your network setup.

config SAMPLE_IPV4_ADDR_1
	string "My IPv4 address for a network interface"
	help
	  The value depends on your network setup.

config SAMPLE_IPV4_GW_1
	string "My IPv4 gateway for a network interface"
	help
	  The value depends on your network setup.

config SAMPLE_IPV4_NETMASK_1
	string "My IPv4 netmask for a network interface"
	default "255.255.255.0"
	help
	  Static netmask to use if not overridden by DHCP. Use empty value to
	  skip setting static value.

config SAMPLE_IPV6_ADDR_2
	string "My IPv6 address for another network interface"
	help
	  The value depends on your network setup.

config SAMPLE_IPV4_ADDR_2
	string "My IPv4 address for another network interface"
	help
	  The value depends on your network setup.

config SAMPLE_IPV4_GW_2
	string "My IPv4 gateway for another network interface"
	help
	  The value depends on your network setup.

config SAMPLE_IPV4_NETMASK_2
	string "My IPv4 netmask for another network interface"
	default "255.255.255.0"
	help
	  Static netmask to use if not overridden by DHCP. Use empty value to
	  skip setting static value.
```

## sample.yaml
```
common:
  harness: net
  tags: net net_automatic_testing vlan traffic_class
sample:
  description: Test network functionality via automatic scripts
  name: Network automatic testing app
tests:
  test:
    min_ram: 32
    depends_on: netif
```

## prj.conf
```kconfig
#
# Configuration file for test application that can be used in networking
# automatic testing.
#

# Generic kernel configuration
CONFIG_TEST_RANDOM_GENERATOR=y
CONFIG_ENTROPY_GENERATOR=y
CONFIG_INIT_STACKS=y
CONFIG_PRINTK=y

# Network features to activate
CONFIG_NETWORKING=y
CONFIG_NET_IPV6=y
CONFIG_NET_IPV4=y
CONFIG_NET_DHCPV4=n
CONFIG_NET_UDP=y
CONFIG_NET_TCP=y
CONFIG_NET_STATISTICS=y
CONFIG_NET_SHELL=y

# Logging
CONFIG_NET_LOG=y
CONFIG_SYS_LOG_SHOW_COLOR=y
CONFIG_SYS_LOG_NET_LEVEL=4

# Amount of network buffers
CONFIG_NET_PKT_RX_COUNT=64
CONFIG_NET_PKT_TX_COUNT=64
CONFIG_NET_BUF_RX_COUNT=64
CONFIG_NET_BUF_TX_COUNT=64

# Max number of IP address addresses for each network interface
CONFIG_NET_IF_UNICAST_IPV6_ADDR_COUNT=5
CONFIG_NET_IF_MCAST_IPV6_ADDR_COUNT=5
CONFIG_NET_IF_UNICAST_IPV4_ADDR_COUNT=1

# Network context max count
CONFIG_NET_MAX_CONTEXTS=10

# Ethernet is needed for VLAN
CONFIG_NET_L2_ETHERNET=y

# Echo-server uses net-app
CONFIG_NET_APP_SERVER=y
CONFIG_NET_APP_NEED_IPV6=y
CONFIG_NET_APP_NEED_IPV4=y
CONFIG_NET_APP_SETTINGS=y

# First ethernet interface will use these settings
CONFIG_NET_APP_MY_IPV6_ADDR="2001:db8::1"
CONFIG_NET_APP_MY_IPV4_ADDR="192.0.2.1"
CONFIG_NET_APP_MY_IPV4_GW="192.0.2.2"

# 2nd ethernet interface will use these settings
CONFIG_SAMPLE_IPV6_ADDR_1="2001:db8:100::1"
# TEST-NET-2 from RFC 5737
CONFIG_SAMPLE_IPV4_ADDR_1="198.51.100.1"
CONFIG_SAMPLE_IPV4_GW_1="198.51.100.2"
# VLAN tag for the this interface
CONFIG_NET_VLAN_SAMPLE_TAG_1=100

# 3rd ethernet interface will use these settings
CONFIG_SAMPLE_IPV6_ADDR_2="2001:db8:200::1"
CONFIG_NET_VLAN_SAMPLE_TAG_2=200
# TEST-NET-3 from RFC 5737
CONFIG_SAMPLE_IPV4_ADDR_2="203.0.113.1"
CONFIG_SAMPLE_IPV4_GW_2="203.0.113.2"

# Debugging options
CONFIG_NET_DEBUG_NET_PKT=y
CONFIG_NET_DEBUG_L2_ETHERNET=n
CONFIG_NET_DEBUG_ARP=n
CONFIG_NET_DEBUG_IPV4=n
CONFIG_NET_DEBUG_IPV6=n
CONFIG_NET_DEBUG_CORE=n
CONFIG_NET_DEBUG_IF=n
CONFIG_NET_DEBUG_TEST_APP=n

# VLAN settings. Note that currently SLIP only supports one VLAN tag,
# and that is enforced by Kconfig file. This application will create
# three network interfaces, the first one without any VLAN tag and
# the other two with VLAN tags.
CONFIG_NET_VLAN=y
CONFIG_NET_VLAN_COUNT=3

# Full amount of traffic classes
CONFIG_NET_TC_COUNT=8

# Enable priority support in net_context
CONFIG_NET_CONTEXT_PRIORITY=y

# Driver specific options

# Use static link-layer address for SLIP, so that in host side
# the neighbor information do not need to be flushed.
CONFIG_SLIP_MAC_ADDR="00:00:5E:00:53:88"

# Static link-layer address for FRDM-K64F board
CONFIG_ETH_MCUX_0_RANDOM_MAC=n
CONFIG_ETH_MCUX_0_MAC3=0x00
CONFIG_ETH_MCUX_0_MAC3=0x53
CONFIG_ETH_MCUX_0_MAC3=0x88

# Native-posix ethernet settings
CONFIG_ETH_NATIVE_POSIX=y
CONFIG_SYS_LOG_ETHERNET_LEVEL=1
CONFIG_ETH_NATIVE_POSIX_RANDOM_MAC=n
CONFIG_ETH_NATIVE_POSIX_MAC_ADDR="00:00:5e:00:53:88"
CONFIG_ETH_NATIVE_POSIX_SETUP_SCRIPT="${ZEPHYR_BASE}/tests/net/automatic_testing/net_setup_host"
```

## net_setup_host.conf
```kconfig
#
# Configuration options for setting up the host network interface
#

HWADDR="00:00:5e:00:53:99"

IPV6_ADDR_1="2001:db8::2"
IPV6_ROUTE_1="2001:db8::/64"

IPV4_ADDR_1="192.0.2.2"
IPV4_ROUTE_1="192.0.2.0/24"

VLAN_NAME_PREFIX="vlan"
VLAN_TAG_1=100
VLAN_TAG_2=200

VLAN_ADDR_1_IPV6="2001:db8:100::2"
VLAN_ROUTE_1_IPV6="2001:db8:100::/64"
VLAN_ADDR_2_IPV6="2001:db8:200::2"
VLAN_ROUTE_2_IPV6="2001:db8:200::/64"

# Documentation addresses from RFC 5737
VLAN_ADDR_1_IPV4="198.51.100.2"
VLAN_ROUTE_1_IPV4="198.51.100.0/24"
VLAN_ADDR_2_IPV4="203.0.113.2"
VLAN_ROUTE_2_IPV4="203.0.113.0/24"
```

## src/main.c
```c
/*
 * Copyright (c) 2018 Intel Corporation.
 *
 * SPDX-License-Identifier: Apache-2.0
 */

#if defined(CONFIG_NET_DEBUG_TEST_APP)
#define SYS_LOG_DOMAIN "net-test/main"
#define NET_SYS_LOG_LEVEL CONFIG_SYS_LOG_NET_LEVEL
#define NET_LOG_ENABLED 1
#endif

#include <zephyr.h>
#include <errno.h>

#include <net/net_core.h>

#include "common.h"

static struct k_sem quit_lock;

static struct interfaces network_interfaces;

void panic(const char *msg)
{
	if (msg) {
		NET_ERR("%s", msg);
	}

	for (;;) {
		k_sleep(K_FOREVER);
	}
}

void quit(void)
{
	k_sem_give(&quit_lock);
}

void iface_cb(struct net_if *iface, void *user_data)
{
	struct interfaces *interfaces = user_data;

	if (net_if_l2(iface) != &NET_L2_GET_NAME(ETHERNET)) {
		return;
	}

	if (interfaces->non_vlan == iface) {
		NET_DBG("1st interface %p", iface);
		return;
	}

	if (!interfaces->first_vlan) {
		NET_DBG("2nd interface %p", iface);
		interfaces->first_vlan = iface;
		return;
	}

	if (!interfaces->second_vlan) {
		NET_DBG("3rd interface %p", iface);
		interfaces->second_vlan = iface;
		return;
	}
}

static inline int init_app(struct interfaces *interfaces)
{
	struct net_if *iface;

	iface = net_if_get_first_by_type(&NET_L2_GET_NAME(ETHERNET));
	if (!iface) {
		NET_ERR("No ethernet interfaces found.");
		return -ENOENT;
	}

	interfaces->non_vlan = iface;
	interfaces->first_vlan = NULL;
	interfaces->second_vlan = NULL;

	net_if_foreach(iface_cb, interfaces);

	k_sem_init(&quit_lock, 0, UINT_MAX);

	return 0;
}

static int setup_vlan_iface(struct net_if *iface, char *ipv6_addr,
			    char *ipv4_addr, char *ipv4_gw, char *ipv4_netmask)
{
	struct net_if_addr *ifaddr;
	struct in_addr addr4;
	struct in6_addr addr6;

	if (net_addr_pton(AF_INET6, ipv6_addr, &addr6)) {
		NET_ERR("Invalid address: %s", ipv6_addr);
		return -EINVAL;
	}

	ifaddr = net_if_ipv6_addr_add(iface, &addr6, NET_ADDR_MANUAL, 0);
	if (!ifaddr) {
		NET_ERR("Cannot add %s to interface %p", ipv6_addr, iface);
		return -EINVAL;
	}

	if (net_addr_pton(AF_INET, ipv4_addr, &addr4)) {
		NET_ERR("Invalid address: %s", ipv4_addr);
		return -EINVAL;
	}

	ifaddr = net_if_ipv4_addr_add(iface, &addr4, NET_ADDR_MANUAL, 0);
	if (!ifaddr) {
		NET_ERR("Cannot add %s to interface %p", ipv4_addr, iface);
		return -EINVAL;
	}

	if (ipv4_gw[0]) {
		/* If not empty */
		if (net_addr_pton(AF_INET, ipv4_gw, &addr4)) {
			NET_ERR("Invalid gateway: %s", ipv4_gw);
		} else {
			net_if_ipv4_set_gw(iface, &addr4);
		}
	}

	if (ipv4_netmask[0]) {
		if (net_addr_pton(AF_INET, ipv4_netmask, &addr4)) {
			NET_ERR("Invalid netmask: %s", ipv4_netmask);
		} else {
			net_if_ipv4_set_netmask(iface, &addr4);
		}
	}

	return 0;
}

static int setup_vlan_iface_1(struct net_if *iface)
{
	return setup_vlan_iface(iface,
				CONFIG_SAMPLE_IPV6_ADDR_1,
				CONFIG_SAMPLE_IPV4_ADDR_1,
				CONFIG_SAMPLE_IPV4_GW_1,
				CONFIG_SAMPLE_IPV4_NETMASK_1);
}

static int setup_vlan_iface_2(struct net_if *iface)
{
	return setup_vlan_iface(iface,
				CONFIG_SAMPLE_IPV6_ADDR_2,
				CONFIG_SAMPLE_IPV4_ADDR_2,
				CONFIG_SAMPLE_IPV4_GW_2,
				CONFIG_SAMPLE_IPV4_NETMASK_2);
}

static int setup_ip_addresses(struct interfaces *interfaces)
{
	if (interfaces->first_vlan) {
		setup_vlan_iface_1(interfaces->first_vlan);
	}

	if (interfaces->second_vlan) {
		setup_vlan_iface_2(interfaces->second_vlan);
	}

	return 0;
}

void main(void)
{
	int ret;

	ret = init_app(&network_interfaces);
	if (ret < 0) {
		NET_ERR("Cannot initialize application (%d)", ret);
		return;
	}

#if defined(CONFIG_NET_VLAN)
	setup_vlan(&network_interfaces);
#endif

	ret = setup_ip_addresses(&network_interfaces);
	if (ret < 0) {
		NET_ERR("Cannot set IP addresses (%d)", ret);
		return;
	}

	setup_echo_server();

	k_sem_take(&quit_lock, K_FOREVER);

	NET_INFO("Stopping...");

	cleanup_echo_server();
}
```

## src/common.h
```c
/*
 * Copyright (c) 2017 Intel Corporation.
 *
 * SPDX-License-Identifier: Apache-2.0
 */

#include <net/net_if.h>
#include <net/net_app.h>

#define MY_PORT 4242

#define MAX_DBG_PRINT 64

struct interfaces {
	struct net_if *non_vlan;
	struct net_if *first_vlan;
	struct net_if *second_vlan;
};

void start_udp(void);
void stop_udp(void);

void start_tcp(void);
void stop_tcp(void);

struct net_pkt *build_reply_pkt(const char *name,
				struct net_app_ctx *ctx,
				struct net_pkt *pkt);
void pkt_sent(struct net_app_ctx *ctx, int status,
	      void *token, void *user_data);
void panic(const char *msg);
void quit(void);

int setup_vlan(struct interfaces *interfaces);
void setup_echo_server(void);
void cleanup_echo_server(void);
```

## src/echo-server.c
```c
/* echo.c - Networking echo server */

/*
 * Copyright (c) 2018 Intel Corporation.
 *
 * SPDX-License-Identifier: Apache-2.0
 */

#if defined(CONFIG_NET_DEBUG_TEST_APP)
#define SYS_LOG_DOMAIN "net-test/echo"
#define NET_SYS_LOG_LEVEL CONFIG_SYS_LOG_NET_LEVEL
#define NET_LOG_ENABLED 1
#endif

#include <zephyr.h>
#include <linker/sections.h>
#include <errno.h>

#include <net/net_pkt.h>
#include <net/net_core.h>
#include <net/net_context.h>

#include <net/net_app.h>

#include "common.h"

/* The startup time needs to be longish if DHCP is enabled as setting
 * DHCP up takes some time.
 */
#define APP_STARTUP_TIME K_SECONDS(20)

#define APP_BANNER "Run echo server"

struct net_pkt *build_reply_pkt(const char *name,
				struct net_app_ctx *ctx,
				struct net_pkt *pkt)
{
	struct net_pkt *reply_pkt;
	struct net_buf *frag, *tmp;
	int header_len = 0, recv_len, reply_len;

	NET_INFO("%s received %d bytes", name, net_pkt_appdatalen(pkt));

	if (net_pkt_appdatalen(pkt) == 0) {
		return NULL;
	}

	reply_pkt = net_app_get_net_pkt(ctx, net_pkt_family(pkt), K_FOREVER);

	NET_ASSERT(reply_pkt);
	NET_ASSERT(net_pkt_family(reply_pkt) == net_pkt_family(pkt));

	recv_len = net_pkt_get_len(pkt);

	tmp = pkt->frags;

	/* If we have link layer headers, then get rid of them here. */
	if (recv_len != net_pkt_appdatalen(pkt)) {
		/* First fragment will contain IP header so move the data
		 * down in order to get rid of it.
		 */
		header_len = net_pkt_appdata(pkt) - tmp->data;

		NET_ASSERT(header_len < CONFIG_NET_BUF_DATA_SIZE);

		/* After this pull, the tmp->data points directly to application
		 * data.
		 */
		net_buf_pull(tmp, header_len);
	}

	net_pkt_set_appdatalen(reply_pkt, net_pkt_appdatalen(pkt));

	while (tmp) {
		frag = net_app_get_net_buf(ctx, reply_pkt, K_FOREVER);

		if (net_buf_headroom(tmp) == 0) {
			/* If there is no link layer headers in the
			 * received fragment, then get rid of that also
			 * in the sending fragment. We end up here
			 * if MTU is larger than fragment size, this
			 * is typical for ethernet.
			 */
			net_buf_push(frag, net_buf_headroom(frag));

			frag->len = 0; /* to make fragment empty */

			/* Make sure to set the reserve so that
			 * in sending side we add the link layer
			 * header if needed.
			 */
			net_pkt_set_ll_reserve(reply_pkt, 0);
		}

		NET_ASSERT_INFO(net_buf_tailroom(frag) >= tmp->len,
				"tail %zd longer than len %d",
				net_buf_tailroom(frag), tmp->len);

		memcpy(net_buf_add(frag, tmp->len), tmp->data, tmp->len);

		tmp = net_pkt_frag_del(pkt, NULL, tmp);
	}

	reply_len = net_pkt_get_len(reply_pkt);

	NET_ASSERT_INFO((recv_len - header_len) == reply_len,
			"Received %d bytes, sending %d bytes",
			recv_len - header_len, reply_len);

	return reply_pkt;
}

void pkt_sent(struct net_app_ctx *ctx,
	     int status,
	     void *user_data_send,
	     void *user_data)
{
	if (!status) {
		NET_INFO("Sent %d bytes", POINTER_TO_UINT(user_data_send));
	}
}

void setup_echo_server(void)
{
	if (IS_ENABLED(CONFIG_NET_TCP)) {
		start_tcp();
	}

	if (IS_ENABLED(CONFIG_NET_UDP)) {
		start_udp();
	}
}

void cleanup_echo_server(void)
{
	if (IS_ENABLED(CONFIG_NET_TCP)) {
		stop_tcp();
	}

	if (IS_ENABLED(CONFIG_NET_UDP)) {
		stop_udp();
	}
}
```

## src/tcp.c
```c
/* tcp.c - TCP specific code for echo server */

/*
 * Copyright (c) 2017 Intel Corporation.
 *
 * SPDX-License-Identifier: Apache-2.0
 */

#if defined(CONFIG_NET_DEBUG_TEST_APP)
#define SYS_LOG_DOMAIN "net-test/echo/tcp"
#define NET_SYS_LOG_LEVEL CONFIG_SYS_LOG_NET_LEVEL
#define NET_LOG_ENABLED 1
#endif

#include <zephyr.h>
#include <errno.h>
#include <stdio.h>

#include <net/net_pkt.h>
#include <net/net_core.h>
#include <net/net_context.h>

#include <net/net_app.h>

#include "common.h"

static struct net_app_ctx tcp;

/* Note that both tcp and udp can share the same pool but in this
 * example the UDP context and TCP context have separate pools.
 */
#if defined(CONFIG_NET_CONTEXT_NET_PKT_POOL)
NET_PKT_TX_SLAB_DEFINE(echo_tx_tcp, 15);
NET_PKT_DATA_POOL_DEFINE(echo_data_tcp, 30);

static struct k_mem_slab *tx_tcp_slab(void)
{
	return &echo_tx_tcp;
}

static struct net_buf_pool *data_tcp_pool(void)
{
	return &echo_data_tcp;
}
#else
#define tx_tcp_slab NULL
#define data_tcp_pool NULL
#endif /* CONFIG_NET_CONTEXT_NET_PKT_POOL */

#if defined(CONFIG_NET_APP_TLS)

/* The result buf size is set to large enough so that we can receive max size
 * buf back. Note that mbedtls needs also be configured to have equal size
 * value for its buffer size. See MBEDTLS_SSL_MAX_CONTENT_LEN option in TLS
 * config file.
 */
#define RESULT_BUF_SIZE 1500
static u8_t tls_result[RESULT_BUF_SIZE];

#if !defined(CONFIG_NET_APP_TLS_STACK_SIZE)
#define CONFIG_NET_APP_TLS_STACK_SIZE		8192
#endif /* CONFIG_NET_APP_TLS_STACK_SIZE */

#define APP_BANNER "Run TLS echo-server"
#define INSTANCE_INFO "Zephyr TLS echo-server #1"

/* Note that each net_app context needs its own stack as there will be
 * a separate thread needed.
 */
NET_STACK_DEFINE(NET_APP_TLS, net_app_tls_stack,
		 CONFIG_NET_APP_TLS_STACK_SIZE, CONFIG_NET_APP_TLS_STACK_SIZE);

#define RX_FIFO_DEPTH 4
K_MEM_POOL_DEFINE(ssl_pool, 4, 64, RX_FIFO_DEPTH, 4);
#endif /* CONFIG_NET_APP_TLS */

#if defined(CONFIG_NET_APP_TLS)
/* Load the certificates and private RSA key. */

#include "test_certs.h"

static int setup_cert(struct net_app_ctx *ctx,
		      mbedtls_x509_crt *cert,
		      mbedtls_pk_context *pkey)
{
	int ret;

	ret = mbedtls_x509_crt_parse(cert, rsa_example_cert_der,
				     rsa_example_cert_der_len);
	if (ret != 0) {
		NET_ERR("mbedtls_x509_crt_parse returned %d", ret);
		return ret;
	}

	ret = mbedtls_pk_parse_key(pkey, rsa_example_keypair_der,
				   rsa_example_keypair_der_len, NULL, 0);
	if (ret != 0) {
		NET_ERR("mbedtls_pk_parse_key returned %d", ret);
		return ret;
	}

	return 0;
}
#endif /* CONFIG_NET_APP_TLS */

static void tcp_received(struct net_app_ctx *ctx,
			 struct net_pkt *pkt,
			 int status,
			 void *user_data)
{
	static char dbg[MAX_DBG_PRINT + 1];
	struct net_pkt *reply_pkt;
	sa_family_t family;
	int ret;

	if (!pkt) {
		/* EOF condition */
		return;
	}

	family = net_pkt_family(pkt);

	snprintk(dbg, MAX_DBG_PRINT, "TCP IPv%c",
		 family == AF_INET6 ? '6' : '4');

	reply_pkt = build_reply_pkt(dbg, ctx, pkt);

	net_pkt_unref(pkt);

	if (!reply_pkt) {
		return;
	}

	ret = net_app_send_pkt(ctx, reply_pkt, NULL, 0, K_NO_WAIT,
			       UINT_TO_POINTER(net_pkt_get_len(reply_pkt)));
	if (ret < 0) {
		NET_ERR("Cannot send data to peer (%d)", ret);
		net_pkt_unref(reply_pkt);

		quit();
	}
}

void start_tcp(void)
{
	int ret;

	ret = net_app_init_tcp_server(&tcp, NULL, MY_PORT, NULL);
	if (ret < 0) {
		NET_ERR("Cannot init TCP service at port %d", MY_PORT);
		return;
	}

#if defined(CONFIG_NET_CONTEXT_NET_PKT_POOL)
	net_app_set_net_pkt_pool(&tcp, tx_tcp_slab, data_tcp_pool);
#endif

	ret = net_app_set_cb(&tcp, NULL, tcp_received, NULL, NULL);
	if (ret < 0) {
		NET_ERR("Cannot set callbacks (%d)", ret);
		net_app_release(&tcp);
		return;
	}

#if defined(CONFIG_NET_APP_TLS)
	ret = net_app_server_tls(&tcp,
				 tls_result,
				 sizeof(tls_result),
				 APP_BANNER,
				 INSTANCE_INFO,
				 strlen(INSTANCE_INFO),
				 setup_cert,
				 NULL,
				 &ssl_pool,
				 net_app_tls_stack,
				 K_THREAD_STACK_SIZEOF(net_app_tls_stack));
	if (ret < 0) {
		NET_ERR("Cannot init TLS");
	}
#endif

	net_app_server_enable(&tcp);

	ret = net_app_listen(&tcp);
	if (ret < 0) {
		NET_ERR("Cannot wait connection (%d)", ret);
		net_app_release(&tcp);
		return;
	}
}

void stop_tcp(void)
{
	net_app_server_disable(&tcp);

	net_app_close(&tcp);
	net_app_release(&tcp);
}
```

## src/test_certs.h
```c
/*
 * Copyright (c) 2017 Intel Corporation
 *
 * SPDX-License-Identifier: Apache-2.0
 */

#ifndef __TEST_CERTS_H__
#define __TEST_CERTS_H__

/* Read the README file in net-tools repo how to generate
 * the key and the certificate.
 */

/* This is the private key in pkcs#8 format. */
static const unsigned char rsa_example_keypair_der[] = {
	0x30, 0x82, 0x04, 0xbe, 0x02, 0x01, 0x00, 0x30,
	0x0d, 0x06, 0x09, 0x2a, 0x86, 0x48, 0x86, 0xf7,
	0x0d, 0x01, 0x01, 0x01, 0x05, 0x00, 0x04, 0x82,
	0x04, 0xa8, 0x30, 0x82, 0x04, 0xa4, 0x02, 0x01,
	0x00, 0x02, 0x82, 0x01, 0x01, 0x00, 0xc6, 0x00,
	0x7b, 0x0d, 0xd1, 0x17, 0x43, 0x6b, 0xa9, 0xa7,
	0x79, 0x9c, 0x0f, 0x8d, 0x77, 0x91, 0xd2, 0xf7,
	0x47, 0x35, 0xb3, 0x17, 0xe2, 0xdd, 0xed, 0x6d,
	0x01, 0xf9, 0xb1, 0x92, 0xc9, 0x48, 0x80, 0xe0,
	0x1f, 0xcf, 0xb7, 0xa4, 0x5f, 0xf0, 0x36, 0xea,
	0xbf, 0xe1, 0x33, 0xf8, 0xa9, 0xc5, 0xe6, 0xd4,
	0x19, 0x8b, 0x82, 0x25, 0xd9, 0x19, 0x74, 0x70,
	0x79, 0xec, 0xc6, 0x68, 0xc9, 0xef, 0xce, 0x1a,
	0xa9, 0xf0, 0xb7, 0x01, 0x35, 0x91, 0xff, 0xd3,
	0x75, 0x6e, 0x02, 0xba, 0x06, 0x9a, 0x2a, 0xac,
	0xcf, 0x22, 0xbf, 0x2b, 0x1f, 0xc1, 0x72, 0x38,
	0x22, 0x35, 0xea, 0xda, 0x6f, 0xdd, 0x67, 0xa2,
	0x2b, 0x19, 0x38, 0x19, 0x0e, 0x44, 0xd1, 0x71,
	0x38, 0xb4, 0x6d, 0x26, 0x85, 0xd6, 0xc6, 0xbe,
	0xc1, 0x6f, 0x3c, 0xee, 0xaf, 0x94, 0x3c, 0x05,
	0x56, 0x4e, 0xad, 0x53, 0x81, 0x8b, 0xd4, 0x23,
	0x31, 0x69, 0x72, 0x27, 0x93, 0xb4, 0x3a, 0xac,
	0x23, 0xe8, 0x10, 0xae, 0xf5, 0x9f, 0x0b, 0xa6,
	0x6e, 0xd3, 0x73, 0xca, 0x18, 0x11, 0xca, 0xbe,
	0x71, 0x00, 0x56, 0x29, 0x34, 0x54, 0xcc, 0xda,
	0x29, 0x5b, 0x26, 0x29, 0x99, 0x4d, 0x5f, 0xa1,
	0xa6, 0xb9, 0xcb, 0x2b, 0xb2, 0x0f, 0x10, 0x00,
	0x04, 0xa9, 0x11, 0x2c, 0x48, 0xb1, 0x99, 0xa5,
	0xca, 0x7c, 0x67, 0xa5, 0xbe, 0x14, 0x20, 0x12,
	0xb7, 0x3b, 0x7a, 0x4f, 0xdc, 0xc7, 0xd5, 0x2d,
	0x04, 0x66, 0xbb, 0xf5, 0x0c, 0xcd, 0xf1, 0x32,
	0x39, 0xd7, 0x51, 0x9b, 0xba, 0xdb, 0xf1, 0xa7,
	0xfe, 0x2d, 0x9a, 0xe6, 0x9c, 0x6b, 0x54, 0xda,
	0xf1, 0xdd, 0x48, 0xf9, 0xd7, 0xf0, 0x35, 0x7c,
	0x8e, 0x24, 0x7e, 0x44, 0x2f, 0xf3, 0xbf, 0x39,
	0x0e, 0x96, 0xab, 0xe1, 0x45, 0x03, 0x8b, 0x54,
	0xdc, 0xe1, 0xb6, 0x11, 0x81, 0x21, 0x02, 0x03,
	0x01, 0x00, 0x01, 0x02, 0x82, 0x01, 0x01, 0x00,
	0xaf, 0x01, 0x1b, 0xc2, 0x41, 0x8d, 0xa3, 0x3c,
	0x94, 0x8d, 0xfe, 0xf1, 0x8d, 0xd9, 0x86, 0xd6,
	0x6f, 0xb5, 0xb9, 0xcd, 0xdf, 0xc6, 0x7b, 0xf1,
	0x95, 0x79, 0xa4, 0xa6, 0x52, 0x6a, 0x1f, 0xd8,
	0x22, 0x78, 0x76, 0x05, 0x7d, 0x16, 0x1e, 0xe9,
	0xcd, 0x50, 0x3d, 0x5a, 0x4a, 0x3a, 0x3d, 0xac,
	0x3a, 0x72, 0x3b, 0x45, 0xd0, 0x39, 0xad, 0xa2,
	0x4f, 0x05, 0x5e, 0xee, 0x85, 0x0b, 0x77, 0x78,
	0xaa, 0x1d, 0x6d, 0x18, 0xe2, 0x57, 0x82, 0x46,
	0xd1, 0xeb, 0xcf, 0xbd, 0xf5, 0x51, 0x00, 0xa6,
	0xe0, 0x93, 0x2e, 0xdd, 0x52, 0x44, 0x46, 0x64,
	0x0f, 0x95, 0x47, 0xbf, 0x8a, 0x1d, 0x99, 0x84,
	0x02, 0xa6, 0x16, 0x1b, 0xcb, 0x36, 0x72, 0x23,
	0x27, 0x4f, 0x40, 0x44, 0x50, 0xb9, 0x1c, 0xd0,
	0x91, 0x87, 0x66, 0xa6, 0xf0, 0x1f, 0x33, 0x36,
	0xfc, 0xb9, 0xe6, 0xe7, 0xd1, 0x50, 0x9e, 0x8d,
	0x2f, 0x66, 0xbd, 0x7b, 0x52, 0x20, 0xf8, 0x7f,
	0x51, 0x3a, 0x48, 0xac, 0x3a, 0x32, 0xde, 0x65,
	0x1a, 0xac, 0x9c, 0xa6, 0x6a, 0xec, 0x44, 0xee,
	0x06, 0x95, 0x05, 0xf2, 0x4a, 0xc5, 0x0c, 0x7d,
	0x51, 0x1f, 0xaa, 0xb4, 0xc0, 0xb9, 0x07, 0x87,
	0xff, 0x2b, 0x28, 0x12, 0x80, 0xea, 0x3c, 0x9e,
	0xb1, 0x81, 0xef, 0xfd, 0xd4, 0xe3, 0x09, 0x1f,
	0xc9, 0x9b, 0xf3, 0xea, 0xa1, 0x7d, 0x0d, 0x2a,
	0x4d, 0x6d, 0x9c, 0x06, 0xdf, 0x87, 0x51, 0xf4,
	0x7b, 0xc0, 0x7d, 0xc3, 0x6c, 0x78, 0x59, 0xe4,
	0xb7, 0x27, 0xd7, 0xf7, 0xf5, 0x6f, 0x63, 0xff,
	0x27, 0xe1, 0x57, 0x86, 0xf3, 0x08, 0xa3, 0xf9,
	0x6b, 0xef, 0xbe, 0xd0, 0x72, 0x29, 0x44, 0x3b,
	0xa9, 0x06, 0x4c, 0xde, 0xf7, 0x0e, 0x63, 0x22,
	0x90, 0x33, 0x2e, 0x14, 0x0c, 0xff, 0x83, 0x42,
	0xf0, 0x96, 0xa3, 0x4a, 0xf5, 0x5b, 0x01, 0xf1,
	0x02, 0x81, 0x81, 0x00, 0xe3, 0xa4, 0x26, 0x57,
	0x02, 0x11, 0x99, 0x42, 0xbb, 0x40, 0x10, 0x68,
	0xf4, 0xcc, 0xa1, 0x2f, 0x3c, 0x84, 0x0e, 0x7c,
	0xa5, 0xfc, 0x3c, 0x68, 0x18, 0x8e, 0xe9, 0x9c,
	0x2f, 0x1c, 0x49, 0x57, 0xe0, 0xdd, 0x89, 0xca,
	0xf9, 0x4f, 0x99, 0x22, 0xe5, 0xd4, 0x30, 0x0a,
	0x60, 0xa7, 0x02, 0x1c, 0x04, 0x2e, 0x07, 0x1c,
	0x0f, 0xb6, 0x60, 0x59, 0xeb, 0x8f, 0x38, 0x91,
	0x36, 0x0b, 0xb3, 0x6c, 0x13, 0xd8, 0xaf, 0x3a,
	0xe5, 0x70, 0x47, 0x4c, 0xeb, 0x6d, 0x29, 0xd1,
	0x66, 0xa7, 0xe7, 0x97, 0x51, 0x5c, 0x6d, 0xda,
	0xf7, 0x6c, 0xb3, 0x31, 0xd2, 0xd9, 0x5c, 0x99,
	0xaa, 0x84, 0x32, 0x2d, 0x40, 0xfb, 0xf0, 0xa8,
	0x85, 0x3b, 0x2c, 0x86, 0x87, 0x9b, 0xe7, 0xb4,
	0x9f, 0x21, 0x13, 0x50, 0xd4, 0x56, 0x6b, 0x65,
	0xda, 0x3c, 0xf6, 0x9e, 0xc1, 0xe4, 0xee, 0xde,
	0x64, 0x10, 0x29, 0x5d, 0x02, 0x81, 0x81, 0x00,
	0xde, 0xab, 0x15, 0x8b, 0xc5, 0xd1, 0x8f, 0xc1,
	0x51, 0xd7, 0x54, 0x47, 0xa2, 0xc5, 0x7f, 0xae,
	0x87, 0xcc, 0xdd, 0xc2, 0x9a, 0x1e, 0x8f, 0x15,
	0xb2, 0x9d, 0x37, 0xfe, 0x4d, 0x43, 0xb2, 0x52,
	0xe7, 0xb2, 0x0e, 0xe0, 0x1f, 0x48, 0xde, 0x07,
	0x8e, 0xff, 0x74, 0xbd, 0xfc, 0xbd, 0x27, 0x2a,
	0x7a, 0xc0, 0x66, 0x09, 0xaf, 0x5b, 0x04, 0xed,
	0xbc, 0x9c, 0x9f, 0xe6, 0x43, 0xa3, 0x9e, 0xc7,
	0x73, 0x3d, 0xcb, 0x6f, 0x69, 0x58, 0x43, 0xe8,
	0xfe, 0xd8, 0x06, 0xb9, 0xcb, 0x09, 0xbc, 0xc7,
	0xb5, 0x2e, 0xed, 0xcc, 0xdf, 0x29, 0x26, 0x6c,
	0x01, 0x33, 0xfd, 0xa3, 0xad, 0xc6, 0x82, 0x0b,
	0xb2, 0x14, 0x75, 0xb2, 0xf6, 0xba, 0xc1, 0xae,
	0xdb, 0x4c, 0x08, 0x09, 0x47, 0x09, 0xc9, 0x88,
	0x3d, 0x69, 0x72, 0xeb, 0x78, 0xd9, 0xf6, 0x5a,
	0xe7, 0xcf, 0x58, 0xf1, 0xdb, 0x22, 0x46, 0x95,
	0x02, 0x81, 0x80, 0x47, 0x0b, 0xe6, 0x43, 0x65,
	0x8b, 0xe4, 0x8f, 0x65, 0x2d, 0x9b, 0x71, 0x86,
	0x65, 0x8f, 0x30, 0xd4, 0xec, 0x4a, 0x31, 0x31,
	0x04, 0xc6, 0x3d, 0x9e, 0xdc, 0x8b, 0xa0, 0x89,
	0x3b, 0x84, 0xd0, 0x7e, 0x87, 0xe6, 0x07, 0x89,
	0x44, 0x04, 0x81, 0x55, 0xc5, 0xa1, 0xb0, 0xbb,
	0x75, 0xa4, 0x3c, 0xe6, 0x39, 0x0f, 0x52, 0xfc,
	0xbc, 0x68, 0xd9, 0xe7, 0xa0, 0xed, 0x80, 0xb4,
	0xa3, 0x76, 0x3e, 0x16, 0xfb, 0x9b, 0xc4, 0xff,
	0xf2, 0xc8, 0xee, 0x02, 0xd4, 0x31, 0x26, 0xff,
	0xa9, 0x0b, 0xa8, 0xb8, 0x65, 0xe6, 0x8b, 0x5e,
	0x89, 0x78, 0x6b, 0xe6, 0x68, 0x9c, 0x74, 0x01,
	0x39, 0xfd, 0x07, 0x0e, 0xaf, 0x12, 0xef, 0x25,
	0x95, 0xd0, 0x51, 0xb4, 0x65, 0x3e, 0x2d, 0xab,
	0x34, 0x81, 0x78, 0xca, 0xac, 0xa6, 0x1c, 0x45,
	0xbe, 0x9d, 0x21, 0xf3, 0x55, 0xe6, 0x0f, 0x56,
	0x9f, 0x8c, 0xa9, 0x02, 0x81, 0x81, 0x00, 0xd6,
	0xcf, 0x45, 0xa1, 0xe9, 0xdd, 0x19, 0x49, 0xee,
	0xa2, 0x44, 0xf4, 0x36, 0xdb, 0x41, 0x2a, 0x26,
	0x68, 0x45, 0x27, 0x8f, 0x77, 0x1b, 0xa2, 0x5b,
	0x05, 0xc1, 0x16, 0xdb, 0x83, 0x0b, 0x6d, 0x5f,
	0x88, 0x2f, 0x41, 0x97, 0xec, 0xbc, 0x05, 0x9e,
	0xb6, 0x62, 0xf1, 0x45, 0xf9, 0x54, 0xe7, 0x6e,
	0x34, 0x5e, 0x3b, 0xc9, 0xa7, 0x8d, 0x41, 0xac,
	0x4b, 0x8d, 0x16, 0x9e, 0xfa, 0x22, 0x1b, 0x57,
	0xd9, 0xad, 0x80, 0x75, 0xa8, 0x69, 0x1b, 0x45,
	0x7f, 0x32, 0x3d, 0xda, 0xda, 0x31, 0xfc, 0x97,
	0x96, 0x06, 0x63, 0x36, 0x86, 0x84, 0x42, 0x7d,
	0x86, 0xa2, 0x92, 0x5c, 0xfa, 0xbc, 0x4a, 0x7c,
	0x29, 0xb0, 0xc2, 0x4d, 0xb4, 0x2d, 0x55, 0x7a,
	0xca, 0x06, 0x96, 0xac, 0xa9, 0x8c, 0x7a, 0x9a,
	0x84, 0x38, 0x11, 0x62, 0x2d, 0x23, 0xb4, 0xdf,
	0x1c, 0xf1, 0x39, 0xa1, 0xa5, 0x97, 0x61, 0x02,
	0x81, 0x80, 0x6c, 0xfb, 0x23, 0x03, 0xa6, 0xa4,
	0x29, 0x03, 0x36, 0x84, 0x86, 0x95, 0x6d, 0x86,
	0x32, 0x98, 0xbe, 0x0a, 0xa2, 0xba, 0x47, 0xd0,
	0x29, 0x3f, 0x8c, 0xa6, 0x28, 0x93, 0x6f, 0x25,
	0x69, 0x38, 0x38, 0x03, 0xe5, 0x9b, 0xc8, 0x48,
	0x35, 0xc7, 0x26, 0xc0, 0x75, 0xd2, 0x95, 0x5b,
	0x51, 0x6d, 0x28, 0x88, 0xb1, 0x4b, 0xf0, 0x59,
	0x18, 0x15, 0x9d, 0x9e, 0x48, 0xb5, 0x67, 0x0c,
	0xb0, 0x83, 0xfa, 0x45, 0x48, 0x4d, 0xaa, 0xba,
	0xe3, 0xdf, 0x76, 0x60, 0x06, 0x09, 0x0d, 0x72,
	0x8c, 0x0c, 0xd2, 0x70, 0x39, 0xed, 0x19, 0xd8,
	0x1b, 0x64, 0x33, 0xce, 0x12, 0xa8, 0xb3, 0xa0,
	0xf5, 0x5f, 0xcc, 0xf7, 0x1a, 0x63, 0x5d, 0x44,
	0x61, 0xc6, 0xa0, 0x54, 0xe9, 0x01, 0xa6, 0x54,
	0x16, 0xa7, 0xa0, 0x9e, 0xc9, 0xd8, 0x9c, 0x19,
	0x04, 0xe1, 0x5e, 0xd5, 0x37, 0xbb, 0xfd, 0x76,
	0x77, 0x75,
};

static const unsigned int rsa_example_keypair_der_len =
					sizeof(rsa_example_keypair_der);

static const unsigned char rsa_example_cert_der[] = {
	0x30, 0x82, 0x02, 0xfb, 0x30, 0x82, 0x01, 0xe3,
	0xa0, 0x03, 0x02, 0x01, 0x02, 0x02, 0x09, 0x00,
	0xee, 0x10, 0x1f, 0xc1, 0xf2, 0x30, 0xe9, 0x11,
	0x30, 0x0d, 0x06, 0x09, 0x2a, 0x86, 0x48, 0x86,
	0xf7, 0x0d, 0x01, 0x01, 0x0b, 0x05, 0x00, 0x30,
	0x14, 0x31, 0x12, 0x30, 0x10, 0x06, 0x03, 0x55,
	0x04, 0x03, 0x0c, 0x09, 0x6c, 0x6f, 0x63, 0x61,
	0x6c, 0x68, 0x6f, 0x73, 0x74, 0x30, 0x1e, 0x17,
	0x0d, 0x31, 0x37, 0x30, 0x36, 0x32, 0x36, 0x31,
	0x30, 0x35, 0x36, 0x31, 0x30, 0x5a, 0x17, 0x0d,
	0x34, 0x34, 0x31, 0x31, 0x31, 0x31, 0x31, 0x30,
	0x35, 0x36, 0x31, 0x30, 0x5a, 0x30, 0x14, 0x31,
	0x12, 0x30, 0x10, 0x06, 0x03, 0x55, 0x04, 0x03,
	0x0c, 0x09, 0x6c, 0x6f, 0x63, 0x61, 0x6c, 0x68,
	0x6f, 0x73, 0x74, 0x30, 0x82, 0x01, 0x22, 0x30,
	0x0d, 0x06, 0x09, 0x2a, 0x86, 0x48, 0x86, 0xf7,
	0x0d, 0x01, 0x01, 0x01, 0x05, 0x00, 0x03, 0x82,
	0x01, 0x0f, 0x00, 0x30, 0x82, 0x01, 0x0a, 0x02,
	0x82, 0x01, 0x01, 0x00, 0xc6, 0x00, 0x7b, 0x0d,
	0xd1, 0x17, 0x43, 0x6b, 0xa9, 0xa7, 0x79, 0x9c,
	0x0f, 0x8d, 0x77, 0x91, 0xd2, 0xf7, 0x47, 0x35,
	0xb3, 0x17, 0xe2, 0xdd, 0xed, 0x6d, 0x01, 0xf9,
	0xb1, 0x92, 0xc9, 0x48, 0x80, 0xe0, 0x1f, 0xcf,
	0xb7, 0xa4, 0x5f, 0xf0, 0x36, 0xea, 0xbf, 0xe1,
	0x33, 0xf8, 0xa9, 0xc5, 0xe6, 0xd4, 0x19, 0x8b,
	0x82, 0x25, 0xd9, 0x19, 0x74, 0x70, 0x79, 0xec,
	0xc6, 0x68, 0xc9, 0xef, 0xce, 0x1a, 0xa9, 0xf0,
	0xb7, 0x01, 0x35, 0x91, 0xff, 0xd3, 0x75, 0x6e,
	0x02, 0xba, 0x06, 0x9a, 0x2a, 0xac, 0xcf, 0x22,
	0xbf, 0x2b, 0x1f, 0xc1, 0x72, 0x38, 0x22, 0x35,
	0xea, 0xda, 0x6f, 0xdd, 0x67, 0xa2, 0x2b, 0x19,
	0x38, 0x19, 0x0e, 0x44, 0xd1, 0x71, 0x38, 0xb4,
	0x6d, 0x26, 0x85, 0xd6, 0xc6, 0xbe, 0xc1, 0x6f,
	0x3c, 0xee, 0xaf, 0x94, 0x3c, 0x05, 0x56, 0x4e,
	0xad, 0x53, 0x81, 0x8b, 0xd4, 0x23, 0x31, 0x69,
	0x72, 0x27, 0x93, 0xb4, 0x3a, 0xac, 0x23, 0xe8,
	0x10, 0xae, 0xf5, 0x9f, 0x0b, 0xa6, 0x6e, 0xd3,
	0x73, 0xca, 0x18, 0x11, 0xca, 0xbe, 0x71, 0x00,
	0x56, 0x29, 0x34, 0x54, 0xcc, 0xda, 0x29, 0x5b,
	0x26, 0x29, 0x99, 0x4d, 0x5f, 0xa1, 0xa6, 0xb9,
	0xcb, 0x2b, 0xb2, 0x0f, 0x10, 0x00, 0x04, 0xa9,
	0x11, 0x2c, 0x48, 0xb1, 0x99, 0xa5, 0xca, 0x7c,
	0x67, 0xa5, 0xbe, 0x14, 0x20, 0x12, 0xb7, 0x3b,
	0x7a, 0x4f, 0xdc, 0xc7, 0xd5, 0x2d, 0x04, 0x66,
	0xbb, 0xf5, 0x0c, 0xcd, 0xf1, 0x32, 0x39, 0xd7,
	0x51, 0x9b, 0xba, 0xdb, 0xf1, 0xa7, 0xfe, 0x2d,
	0x9a, 0xe6, 0x9c, 0x6b, 0x54, 0xda, 0xf1, 0xdd,
	0x48, 0xf9, 0xd7, 0xf0, 0x35, 0x7c, 0x8e, 0x24,
	0x7e, 0x44, 0x2f, 0xf3, 0xbf, 0x39, 0x0e, 0x96,
	0xab, 0xe1, 0x45, 0x03, 0x8b, 0x54, 0xdc, 0xe1,
	0xb6, 0x11, 0x81, 0x21, 0x02, 0x03, 0x01, 0x00,
	0x01, 0xa3, 0x50, 0x30, 0x4e, 0x30, 0x1d, 0x06,
	0x03, 0x55, 0x1d, 0x0e, 0x04, 0x16, 0x04, 0x14,
	0xa4, 0xef, 0x6d, 0xdc, 0x9b, 0x23, 0xc5, 0x3a,
	0xdd, 0x34, 0xd9, 0x01, 0x1c, 0x68, 0x03, 0x53,
	0xae, 0x92, 0xc2, 0xc9, 0x30, 0x1f, 0x06, 0x03,
	0x55, 0x1d, 0x23, 0x04, 0x18, 0x30, 0x16, 0x80,
	0x14, 0xa4, 0xef, 0x6d, 0xdc, 0x9b, 0x23, 0xc5,
	0x3a, 0xdd, 0x34, 0xd9, 0x01, 0x1c, 0x68, 0x03,
	0x53, 0xae, 0x92, 0xc2, 0xc9, 0x30, 0x0c, 0x06,
	0x03, 0x55, 0x1d, 0x13, 0x04, 0x05, 0x30, 0x03,
	0x01, 0x01, 0xff, 0x30, 0x0d, 0x06, 0x09, 0x2a,
	0x86, 0x48, 0x86, 0xf7, 0x0d, 0x01, 0x01, 0x0b,
	0x05, 0x00, 0x03, 0x82, 0x01, 0x01, 0x00, 0x67,
	0x65, 0xbf, 0x93, 0x89, 0xde, 0x4f, 0x71, 0xff,
	0x1c, 0x93, 0x68, 0xa0, 0x64, 0x09, 0x5e, 0x95,
	0x94, 0xf5, 0xd5, 0xf4, 0x6b, 0x20, 0x32, 0xd8,
	0x04, 0x80, 0xac, 0xf8, 0x52, 0x36, 0x7a, 0x38,
	0x83, 0xae, 0xab, 0x29, 0x22, 0x42, 0x71, 0x7e,
	0xea, 0xe5, 0x4f, 0x71, 0xac, 0x44, 0x3f, 0x9e,
	0x5e, 0x49, 0x22, 0x05, 0xee, 0xa6, 0x7b, 0xab,
	0x56, 0x2e, 0xb3, 0x9a, 0x35, 0x1a, 0x88, 0xc3,
	0x54, 0x9b, 0xfd, 0xac, 0x65, 0x54, 0xaf, 0x21,
	0xa7, 0xe0, 0xdd, 0x62, 0x29, 0x8c, 0xae, 0x26,
	0x0b, 0x84, 0x1f, 0x69, 0x78, 0x84, 0xc6, 0x7e,
	0xcf, 0xc8, 0xf5, 0x92, 0x8c, 0x05, 0xa8, 0x13,
	0x38, 0xcd, 0x0b, 0x98, 0x53, 0xfb, 0xdd, 0x8d,
	0x51, 0x90, 0xa8, 0x51, 0xfa, 0x52, 0xbe, 0x28,
	0xd4, 0x71, 0x50, 0x73, 0x1f, 0xb0, 0xb6, 0x0e,
	0x45, 0xb1, 0x47, 0x41, 0x06, 0xd9, 0x1d, 0x7a,
	0x34, 0xe7, 0x80, 0x2e, 0x0c, 0x02, 0x50, 0x97,
	0xde, 0xa8, 0x7a, 0x84, 0x2c, 0x1d, 0xf4, 0x51,
	0x56, 0xa5, 0x52, 0xb5, 0x04, 0x2e, 0xcb, 0xdd,
	0x8b, 0x2e, 0x16, 0xc6, 0xde, 0xc8, 0xe9, 0x8d,
	0xee, 0x5e, 0xb6, 0xa0, 0xe0, 0x2b, 0x85, 0x2a,
	0x89, 0x7b, 0xba, 0x68, 0x80, 0x2b, 0xfb, 0x6e,
	0x2e, 0x80, 0xe7, 0x7a, 0x97, 0x09, 0xb5, 0x2f,
	0x20, 0x8e, 0xed, 0xbc, 0x98, 0x6f, 0x95, 0xd5,
	0x5b, 0x3d, 0x26, 0x19, 0x26, 0x14, 0x39, 0x82,
	0xa8, 0xa8, 0x42, 0x46, 0xab, 0x59, 0x93, 0x47,
	0x83, 0xf7, 0x79, 0xbf, 0x73, 0xb5, 0x5d, 0x5d,
	0x78, 0xfe, 0x62, 0xac, 0xed, 0xb7, 0x1e, 0x4a,
	0xad, 0xc3, 0x99, 0x39, 0x7d, 0x3e, 0x30, 0x21,
	0x26, 0x1d, 0x66, 0xdb, 0x0d, 0xf3, 0xba, 0x87,
	0x46, 0xf0, 0x04, 0xfc, 0xc3, 0xbe, 0x84, 0x85,
	0x3c, 0x01, 0xef, 0xe0, 0x68, 0x65, 0xee,
};

static const unsigned int rsa_example_cert_der_len =
					sizeof(rsa_example_cert_der);

#endif
```

## src/udp.c
```c
/* udp.c - UDP specific code for echo server */

/*
 * Copyright (c) 2017 Intel Corporation.
 *
 * SPDX-License-Identifier: Apache-2.0
 */

#if defined(CONFIG_NET_DEBUG_TEST_APP)
#define SYS_LOG_DOMAIN "net-test/echo/udp"
#define NET_SYS_LOG_LEVEL CONFIG_SYS_LOG_NET_LEVEL
#define NET_LOG_ENABLED 1
#endif

#include <zephyr.h>
#include <errno.h>
#include <stdio.h>

#include <net/net_pkt.h>
#include <net/net_core.h>
#include <net/net_context.h>
#include <net/udp.h>

#include <net/net_app.h>

#include "common.h"

static struct net_app_ctx udp;

/* Note that both tcp and udp can share the same pool but in this
 * example the UDP context and TCP context have separate pools.
 */
#if defined(CONFIG_NET_CONTEXT_NET_PKT_POOL)
NET_PKT_TX_SLAB_DEFINE(echo_tx_udp, 5);
NET_PKT_DATA_POOL_DEFINE(echo_data_udp, 20);

static struct k_mem_slab *tx_udp_slab(void)
{
	return &echo_tx_udp;
}

static struct net_buf_pool *data_udp_pool(void)
{
	return &echo_data_udp;
}
#else
#define tx_udp_slab NULL
#define data_udp_pool NULL
#endif /* CONFIG_NET_CONTEXT_NET_PKT_POOL */

#if defined(CONFIG_NET_APP_DTLS)

/* The result buf size is set to large enough so that we can receive max size
 * buf back. Note that mbedtls needs also be configured to have equal size
 * value for its buffer size. See MBEDTLS_SSL_MAX_CONTENT_LEN option in TLS
 * config file.
 */
#define RESULT_BUF_SIZE 1500
static u8_t dtls_result[RESULT_BUF_SIZE];

#define APP_BANNER "Run DTLS echo-server"
#define INSTANCE_INFO "Zephyr DTLS echo-server #1"

/* Note that each net_app context needs its own stack as there will be
 * a separate thread needed.
 */
NET_STACK_DEFINE(NET_APP_DTLS, net_app_dtls_stack,
		 CONFIG_NET_APP_TLS_STACK_SIZE, CONFIG_NET_APP_TLS_STACK_SIZE);

#define RX_FIFO_DEPTH 4
K_MEM_POOL_DEFINE(dtls_pool, 4, 64, RX_FIFO_DEPTH, 4);
#endif /* CONFIG_NET_APP_TLS */

#if defined(CONFIG_NET_APP_DTLS)
/* Load the certificates and private RSA key. */

#include "test_certs.h"

static int setup_cert(struct net_app_ctx *ctx,
		      mbedtls_x509_crt *cert,
		      mbedtls_pk_context *pkey)
{
	int ret;

	ret = mbedtls_x509_crt_parse(cert, rsa_example_cert_der,
				     rsa_example_cert_der_len);
	if (ret != 0) {
		NET_ERR("mbedtls_x509_crt_parse returned %d", ret);
		return ret;
	}

	ret = mbedtls_pk_parse_key(pkey, rsa_example_keypair_der,
				   rsa_example_keypair_der_len, NULL, 0);
	if (ret != 0) {
		NET_ERR("mbedtls_pk_parse_key returned %d", ret);
		return ret;
	}

	return 0;
}
#endif /* CONFIG_NET_APP_DTLS */

static inline void set_dst_addr(sa_family_t family,
				struct net_pkt *pkt,
				struct sockaddr *dst_addr)
{
	struct net_udp_hdr hdr, *udp_hdr;

	udp_hdr = net_udp_get_hdr(pkt, &hdr);
	if (!udp_hdr) {
		return;
	}

#if defined(CONFIG_NET_IPV6)
	if (family == AF_INET6) {
		net_ipaddr_copy(&net_sin6(dst_addr)->sin6_addr,
				&NET_IPV6_HDR(pkt)->src);
		net_sin6(dst_addr)->sin6_family = AF_INET6;
		net_sin6(dst_addr)->sin6_port = udp_hdr->src_port;
	}
#endif /* CONFIG_NET_IPV6) */

#if defined(CONFIG_NET_IPV4)
	if (family == AF_INET) {
		net_ipaddr_copy(&net_sin(dst_addr)->sin_addr,
				&NET_IPV4_HDR(pkt)->src);
		net_sin(dst_addr)->sin_family = AF_INET;
		net_sin(dst_addr)->sin_port = udp_hdr->src_port;
	}
#endif /* CONFIG_NET_IPV6) */
}

static void udp_received(struct net_app_ctx *ctx,
			 struct net_pkt *pkt,
			 int status,
			 void *user_data)
{
	static char dbg[MAX_DBG_PRINT + 1];
	struct net_pkt *reply_pkt;
	struct sockaddr dst_addr;
	sa_family_t family = net_pkt_family(pkt);
	socklen_t dst_len;
	u32_t pkt_len;
	int ret;

	snprintk(dbg, MAX_DBG_PRINT, "UDP IPv%c",
		 family == AF_INET6 ? '6' : '4');

	if (family == AF_INET6) {
		dst_len = sizeof(struct sockaddr_in6);
	} else {
		dst_len = sizeof(struct sockaddr_in);
	}

	/* Note that for DTLS swapping the source/destination address has no
	 * effect as the user data is sent in a DTLS tunnel where tunnel end
	 * points are already set.
	 */
	set_dst_addr(family, pkt, &dst_addr);

	reply_pkt = build_reply_pkt(dbg, ctx, pkt);

	net_pkt_unref(pkt);

	if (!reply_pkt) {
		return;
	}

	pkt_len = net_pkt_appdatalen(reply_pkt);

	ret = net_app_send_pkt(ctx, reply_pkt, &dst_addr, dst_len, K_NO_WAIT,
			       UINT_TO_POINTER(pkt_len));
	if (ret < 0) {
		NET_ERR("Cannot send data to peer (%d)", ret);
		net_pkt_unref(reply_pkt);
	}
}

void start_udp(void)
{
	int ret;

	ret = net_app_init_udp_server(&udp, NULL, MY_PORT, NULL);
	if (ret < 0) {
		NET_ERR("Cannot init UDP service at port %d", MY_PORT);
		return;
	}

#if defined(CONFIG_NET_CONTEXT_NET_PKT_POOL)
	net_app_set_net_pkt_pool(&udp, tx_udp_slab, data_udp_pool);
#endif

	ret = net_app_set_cb(&udp, NULL, udp_received, pkt_sent, NULL);
	if (ret < 0) {
		NET_ERR("Cannot set callbacks (%d)", ret);
		net_app_release(&udp);
		return;
	}

#if defined(CONFIG_NET_APP_DTLS)
	ret = net_app_server_tls(&udp,
				 dtls_result,
				 sizeof(dtls_result),
				 APP_BANNER,
				 INSTANCE_INFO,
				 strlen(INSTANCE_INFO),
				 setup_cert,
				 NULL,
				 &dtls_pool,
				 net_app_dtls_stack,
				 K_THREAD_STACK_SIZEOF(net_app_dtls_stack));
	if (ret < 0) {
		NET_ERR("Cannot init DTLS");
	}
#endif

	net_app_server_enable(&udp);

	ret = net_app_listen(&udp);
	if (ret < 0) {
		NET_ERR("Cannot wait connection (%d)", ret);
		net_app_release(&udp);
		return;
	}
}

void stop_udp(void)
{
	net_app_close(&udp);
	net_app_release(&udp);
}
```

## src/vlan.c
```c
/*
 * Copyright (c) 2018 Intel Corporation.
 *
 * SPDX-License-Identifier: Apache-2.0
 */

#if defined(CONFIG_NET_DEBUG_TEST_APP)
#define SYS_LOG_DOMAIN "net-test/vlan"
#define NET_SYS_LOG_LEVEL CONFIG_SYS_LOG_NET_LEVEL
#define NET_LOG_ENABLED 1
#endif

#include <zephyr.h>
#include <errno.h>

#include <net/net_core.h>
#include <net/net_l2.h>
#include <net/net_if.h>
#include <net/ethernet.h>

#include "common.h"

#if CONFIG_NET_VLAN_COUNT > 1
#define CREATE_MULTIPLE_TAGS
#endif

int setup_vlan(struct interfaces *interfaces)
{
	int ret;

	/* For SLIP technology, we create one VLAN interface */
#if !defined(CREATE_MULTIPLE_TAGS)
	ret = net_eth_vlan_enable(interfaces->non_vlan,
				  CONFIG_SAMPLE_VLAN_TAG_1);
	if (ret < 0) {
		NET_ERR("Cannot enable VLAN for tag %d (%d)",
			CONFIG_SAMPLE_VLAN_TAG_1, ret);
	}
#endif

#if defined(CREATE_MULTIPLE_TAGS)
	/* This sample has two VLANs. First the VLAN needs to be
	 * added to the interface so that IPv6 DAD can work properly.
	 */
	ret = net_eth_vlan_enable(interfaces->first_vlan,
				  CONFIG_SAMPLE_VLAN_TAG_1);
	if (ret < 0) {
		NET_ERR("Cannot enable VLAN for tag %d (%d)",
			CONFIG_SAMPLE_VLAN_TAG_1, ret);
	}

	ret = net_eth_vlan_enable(interfaces->second_vlan,
				  CONFIG_SAMPLE_VLAN_TAG_2);
	if (ret < 0) {
		NET_ERR("Cannot enable VLAN for tag %d (%d)",
			CONFIG_SAMPLE_VLAN_TAG_2, ret);
	}

#endif

	return ret;
}
```
