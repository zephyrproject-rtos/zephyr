## CMakeLists.txt
```
# SPDX-FileCopyrightText: Copyright (c) 2026 Nordic Semiconductor ASA
# SPDX-License-Identifier: Apache-2.0

cmake_minimum_required(VERSION 3.28.0)
find_package(Zephyr REQUIRED HINTS $ENV{ZEPHYR_BASE})
project(zperf_api)

target_sources(app PRIVATE
  src/main.c
  )

target_sources_ifdef(CONFIG_NET_ZPERF_IPERF3 app PRIVATE
  src/iperf3_proto.c
  src/iperf3_server.c
  )

target_include_directories(app PRIVATE
  ${ZEPHYR_BASE}/subsys/net/lib/zperf
  )
```

## prj.conf
```kconfig
# Self-contained networking, no external driver required.
CONFIG_NET_TEST=y

CONFIG_ZTEST=y
CONFIG_ZTEST_STACK_SIZE=2048
CONFIG_MAIN_STACK_SIZE=2048
CONFIG_SYSTEM_WORKQUEUE_STACK_SIZE=2048

# Networking
CONFIG_NETWORKING=y
CONFIG_NET_IPV4=y
CONFIG_NET_IPV6=y
CONFIG_NET_UDP=y
CONFIG_NET_TCP=y
CONFIG_NET_SOCKETS=y
CONFIG_NET_MAX_CONTEXTS=10
CONFIG_NET_MAX_CONN=10

# Loopback interface for local client/server testing
CONFIG_NET_DRIVERS=y
CONFIG_NET_LOOPBACK=y
CONFIG_NET_LOOPBACK_MTU=1280
CONFIG_TEST_RANDOM_GENERATOR=y

# zperf library under test
CONFIG_NET_ZPERF=y
CONFIG_NET_ZPERF_SERVER=y

# The zperf TCP/UDP receivers register one socket service each. The socket
# service worker polls all of them at once (TCP: MAX_SESSIONS + 2 listeners,
# UDP: 2 sockets) plus an internal eventfd, so give zvfs_poll() enough slots.
CONFIG_ZVFS_POLL_MAX=16

# zperf is packet heavy, give it enough buffers for the stress test
CONFIG_NET_PKT_RX_COUNT=32
CONFIG_NET_PKT_TX_COUNT=32
CONFIG_NET_BUF_RX_COUNT=64
CONFIG_NET_BUF_TX_COUNT=96
CONFIG_NET_BUF_DATA_SIZE=256

# The UDP uploader needs a receive timeout to collect the server statistics
CONFIG_NET_CONTEXT_RCVTIMEO=y

CONFIG_HEAP_MEM_POOL_SIZE=1024

# Uncomment for debugging the test
#CONFIG_LOG=y
#CONFIG_NET_LOG=y
#CONFIG_NET_ZPERF_LOG_LEVEL_DBG=y
```

## src/main.c
```c
/*
 * SPDX-FileCopyrightText: Copyright (c) 2026 Nordic Semiconductor ASA
 * SPDX-License-Identifier: Apache-2.0
 */

/*
 * Self-test for the zperf network performance library.
 */

#include <inttypes.h>
#include <string.h>

#include <zephyr/kernel.h>
#include <zephyr/ztest.h>
#include <zephyr/net/net_ip.h>
#include <zephyr/net/socket.h>
#include <zephyr/net/zperf.h>

#include "zperf_internal.h"

#define LOOPBACK_IPV4_ADDR "127.0.0.1"
#define TEST_PORT          5001
#define TEST_DURATION_MS   1000
#define TEST_PACKET_SIZE   256
#define TEST_RATE_KBPS     1000

/* Upper bound for the server callback to fire after the (already completed)
 * upload. The server processes the stream almost immediately, so this only
 * needs to be a safety margin.
 */
#define TEST_TIMEOUT       K_SECONDS(2)

/* An asynchronous upload runs the whole transfer on a work queue before the
 * FINISHED callback fires, so allow for the full duration plus a margin.
 */
#define UPLOAD_TIMEOUT     K_MSEC(TEST_DURATION_MS + 2000)

static K_SEM_DEFINE(session_finished, 0, 1);
static K_SEM_DEFINE(upload_finished, 0, 1);

static struct zperf_results server_results;
static enum zperf_status server_last_status = ZPERF_SESSION_ERROR;

static struct zperf_results client_async_results;
static enum zperf_status client_last_status = ZPERF_SESSION_ERROR;

struct test_udp_stat {
	struct zperf_udp_datagram datagram;
	struct zperf_server_hdr server;
} __packed;

static void server_session_cb(enum zperf_status status, struct zperf_results *result,
			      void *user_data)
{
	ARG_UNUSED(user_data);

	switch (status) {
	case ZPERF_SESSION_STARTED:
		break;
	case ZPERF_SESSION_FINISHED:
		if (result == NULL) {
			/* A FINISHED event must carry results; a missing result
			 * is treated as an error so the failure is explicit.
			 */
			server_last_status = ZPERF_SESSION_ERROR;
		} else {
			memcpy(&server_results, result, sizeof(server_results));
			server_last_status = status;
		}
		k_sem_give(&session_finished);
		break;
	case ZPERF_SESSION_ERROR:
		server_last_status = status;
		k_sem_give(&session_finished);
		break;
	default:
		break;
	}
}

static void client_upload_cb(enum zperf_status status,
			     struct zperf_results *result,
			     void *user_data)
{
	ARG_UNUSED(user_data);

	switch (status) {
	case ZPERF_SESSION_STARTED:
		break;
	case ZPERF_SESSION_FINISHED:
		if (result == NULL) {
			/* A FINISHED event must carry results; a missing result
			 * is treated as an error so the failure is explicit.
			 */
			client_last_status = ZPERF_SESSION_ERROR;
		} else {
			memcpy(&client_async_results, result,
			       sizeof(client_async_results));
			client_last_status = status;
		}
		k_sem_give(&upload_finished);
		break;
	case ZPERF_SESSION_ERROR:
		client_last_status = status;
		k_sem_give(&upload_finished);
		break;
	default:
		break;
	}
}

static void fill_upload_params(struct zperf_upload_params *param)
{
	struct net_sockaddr_in peer = {
		.sin_family = NET_AF_INET,
		.sin_port = net_htons(TEST_PORT),
	};

	zassert_equal(net_addr_pton(NET_AF_INET, LOOPBACK_IPV4_ADDR,
				    &peer.sin_addr), 0,
		      "Failed to parse loopback address");

	memset(param, 0, sizeof(*param));
	memcpy(&param->peer_addr_storage, &peer, sizeof(peer));
	param->duration_ms = TEST_DURATION_MS;
	param->packet_size = TEST_PACKET_SIZE;
	param->rate_kbps = TEST_RATE_KBPS;
	param->unix_offset_us = (uint64_t)k_uptime_get() * USEC_PER_MSEC;
	param->options.priority = -1;
}

static void zperf_before(void *fixture)
{
	ARG_UNUSED(fixture);

	k_sem_reset(&session_finished);
	k_sem_reset(&upload_finished);
	memset(&server_results, 0, sizeof(server_results));
	memset(&client_async_results, 0, sizeof(client_async_results));
	server_last_status = ZPERF_SESSION_ERROR;
	client_last_status = ZPERF_SESSION_ERROR;
}

static void zperf_after(void *fixture)
{
	ARG_UNUSED(fixture);

	/* Only one server runs per test; stopping the idle one returns
	 * -EALREADY, which is harmless here. This makes sure the server is
	 * always torn down, even if the test aborted early.
	 */
	(void)zperf_udp_download_stop();
	(void)zperf_tcp_download_stop();
}

ZTEST(zperf_api, test_packet_duration_zero_rate)
{
	/* 1000 bytes at 10 kbps:
	 * (1000 * 8 * 1000000) / (10 * 1024) = 781250 us
	 */
	zassert_equal(zperf_packet_duration(1000, 10), 781250U,
		      "Unexpected pacing delay for a non-zero rate");
	zassert_equal(zperf_packet_duration(1000, 0), 0U,
		      "A zero rate must not divide and means no pacing");
	zassert_equal(zperf_packet_duration(1000, 4194304U), 1U,
		      "A large rate must not wrap the duration divisor");
}

ZTEST(zperf_api, test_udp_upload_unlimited_rate)
{
	struct zperf_download_params download_param = {
		.port = TEST_PORT,
	};
	struct zperf_upload_params upload_param;
	struct zperf_results client_results = { 0 };
	int ret;

	ret = zperf_udp_download(&download_param, server_session_cb, NULL);
	zassert_ok(ret, "Failed to start UDP server (%d)", ret);

	fill_upload_params(&upload_param);
	upload_param.rate_kbps = 0U;
	/* Short run: POSIX waits 1 ms/packet; long enough to hit compensation. */
	upload_param.duration_ms = 200;

	ret = zperf_udp_upload(&upload_param, &client_results);
	zassert_ok(ret, "Unlimited-rate UDP upload failed (%d)", ret);
	zassert_true(client_results.nb_packets_sent > 0,
		     "Unlimited-rate upload did not send any packets");

	ret = k_sem_take(&session_finished, TEST_TIMEOUT);
	zassert_ok(ret, "Timed out waiting for UDP server session to finish");
	zassert_equal(server_last_status, ZPERF_SESSION_FINISHED,
		      "UDP server session did not finish cleanly (status %d)",
		      server_last_status);
	zassert_true(server_results.nb_packets_rcvd > 0,
		     "UDP server did not receive any packets");
}

ZTEST(zperf_api, test_udp_upload_download)
{
	struct zperf_download_params download_param = {
		.port = TEST_PORT,
	};
	struct zperf_upload_params upload_param;
	struct zperf_results client_results = { 0 };
	int ret;

	ret = zperf_udp_download(&download_param, server_session_cb, NULL);
	zassert_ok(ret, "Failed to start UDP server (%d)", ret);

	fill_upload_params(&upload_param);

	/* Blocking upload for TEST_DURATION_MS. */
	ret = zperf_udp_upload(&upload_param, &client_results);
	zassert_ok(ret, "UDP upload failed (%d)", ret);

	/* Client side: we sent packets and collected the server statistics. */
	zassert_true(client_results.nb_packets_sent > 0, "Client did not send any UDP packets");
	zassert_equal(client_results.packet_size, TEST_PACKET_SIZE,
		      "Unexpected client packet size %u", client_results.packet_size);
	zassert_true(client_results.client_time_in_us > 0, "Client transfer time not reported");
	zassert_true(client_results.nb_packets_rcvd > 0,
		     "Server did not report any received packets to client");
	zassert_true(client_results.nb_packets_rcvd <= client_results.nb_packets_sent,
		     "Server received more packets (%u) than were sent (%u)",
		     client_results.nb_packets_rcvd, client_results.nb_packets_sent);
	zassert_equal(client_results.nb_packets_rcvd + client_results.nb_packets_lost,
		      client_results.nb_packets_sent,
		      "Server packet accounting does not match the sent total");

	/* Server side: wait for the FINISHED callback and verify its stats. */
	ret = k_sem_take(&session_finished, TEST_TIMEOUT);
	zassert_ok(ret, "Timed out waiting for UDP server session to finish");
	zassert_equal(server_last_status, ZPERF_SESSION_FINISHED,
		      "UDP server session did not finish cleanly (status %d)", server_last_status);
	zassert_true(server_results.nb_packets_rcvd > 0, "UDP server did not receive any packets");
	zassert_true(server_results.total_len > 0, "UDP server did not report any received data");
	zassert_true(server_results.time_in_us > 0, "UDP server did not report a transfer time");
}

static void verify_udp_packet_sequence(const int32_t *packet_ids, size_t packet_count,
				       uint32_t expected_lost, uint32_t expected_outorder,
				       uint32_t expected_total)
{
	struct zperf_download_params download_param = {
		.port = TEST_PORT,
	};
	struct net_sockaddr_in peer = {
		.sin_family = NET_AF_INET,
		.sin_port = net_htons(TEST_PORT),
	};
	struct timeval timeout = {
		.tv_sec = 2,
	};
	struct test_udp_stat stat = {0};
	struct zperf_udp_datagram packet = {0};
	int sock;
	int ret;

	ret = zperf_udp_download(&download_param, server_session_cb, NULL);
	zassert_ok(ret, "Failed to start UDP server (%d)", ret);
	zassert_equal(net_addr_pton(NET_AF_INET, LOOPBACK_IPV4_ADDR, &peer.sin_addr), 0,
		      "Failed to parse loopback address");

	sock = zsock_socket(NET_AF_INET, NET_SOCK_DGRAM, NET_IPPROTO_UDP);
	zassert_true(sock >= 0, "Failed to create UDP socket (%d)", errno);
	ret = zsock_setsockopt(sock, ZSOCK_SOL_SOCKET, ZSOCK_SO_RCVTIMEO, &timeout,
			       sizeof(timeout));
	zassert_ok(ret, "Failed to set UDP receive timeout (%d)", errno);

	for (size_t i = 0; i < packet_count; i++) {
		packet.id = net_htonl((uint32_t)packet_ids[i]);
		ret = zsock_sendto(sock, &packet, sizeof(packet), 0, (struct net_sockaddr *)&peer,
				   sizeof(peer));
		zassert_equal(ret, sizeof(packet), "Failed to send packet ID %d (%d)",
			      packet_ids[i], errno);
	}

	ret = zsock_recv(sock, &stat, sizeof(stat), 0);
	zassert_equal(ret, sizeof(stat), "Failed to receive UDP statistics (%d)", errno);
	zsock_close(sock);

	ret = k_sem_take(&session_finished, TEST_TIMEOUT);
	zassert_ok(ret, "Timed out waiting for UDP server session to finish");
	zassert_equal(server_last_status, ZPERF_SESSION_FINISHED,
		      "UDP server session did not finish cleanly (status %d)", server_last_status);
	zassert_equal(server_results.nb_packets_rcvd, packet_count,
		      "Expected %zu received packets, got %u", packet_count,
		      server_results.nb_packets_rcvd);
	zassert_equal(server_results.nb_packets_lost, expected_lost,
		      "Expected %u lost packets, got %u", expected_lost,
		      server_results.nb_packets_lost);
	zassert_equal(server_results.nb_packets_outorder, expected_outorder,
		      "Expected %u out-of-order packets, got %u", expected_outorder,
		      server_results.nb_packets_outorder);
	zassert_equal(net_ntohl(stat.server.error_cnt), expected_lost,
		      "UDP ACK reported %u lost packets instead of %u",
		      net_ntohl(stat.server.error_cnt), expected_lost);
	zassert_equal(net_ntohl(stat.server.outorder_cnt), expected_outorder,
		      "UDP ACK reported %u out-of-order packets instead of %u",
		      net_ntohl(stat.server.outorder_cnt), expected_outorder);
	zassert_equal(net_ntohl(stat.server.datagrams), expected_total,
		      "UDP ACK reported a total of %u datagrams instead of %u",
		      net_ntohl(stat.server.datagrams), expected_total);
}

ZTEST(zperf_api, test_udp_fin_accounts_for_trailing_loss)
{
	/* The iperf2 end of test handshake; iperf3 has none */
	Z_TEST_SKIP_IFDEF(CONFIG_NET_ZPERF_IPERF3);

	const int32_t packet_ids[] = {1, 2, -5};

	verify_udp_packet_sequence(packet_ids, ARRAY_SIZE(packet_ids), 2, 0, 5);
}

ZTEST(zperf_api, test_udp_fin_reconciles_out_of_order_gap)
{
	/* The iperf2 end of test handshake; iperf3 has none */
	Z_TEST_SKIP_IFDEF(CONFIG_NET_ZPERF_IPERF3);

	const int32_t packet_ids[] = {1, 3, 2, -4};

	verify_udp_packet_sequence(packet_ids, ARRAY_SIZE(packet_ids), 0, 1, 4);
}

ZTEST(zperf_api, test_udp_fin_does_not_reconcile_duplicate)
{
	/* The iperf2 end of test handshake; iperf3 has none */
	Z_TEST_SKIP_IFDEF(CONFIG_NET_ZPERF_IPERF3);

	const int32_t packet_ids[] = {1, 3, 3, -5};

	verify_udp_packet_sequence(packet_ids, ARRAY_SIZE(packet_ids), 2, 1, 5);
}

ZTEST(zperf_api, test_udp_fin_does_not_reconcile_recovered_duplicate)
{
	/* The iperf2 end of test handshake; iperf3 has none */
	Z_TEST_SKIP_IFDEF(CONFIG_NET_ZPERF_IPERF3);

	const int32_t packet_ids[] = {1, 4, 2, 2, -5};

	verify_udp_packet_sequence(packet_ids, ARRAY_SIZE(packet_ids), 1, 2, 5);
}

/* The server's byte count against what the client sent over TCP. An iperf2
 * server counts until the client closes the connection, so it sees every
 * byte. An iperf3 server counts until the client ends the test on the
 * control connection, which can overtake the last of the data, so it may
 * see a little less, as iperf3 itself reports.
 */
static void check_tcp_total(uint64_t server_len, uint64_t client_len)
{
	if (IS_ENABLED(CONFIG_NET_ZPERF_IPERF3)) {
		zassert_true(server_len <= client_len,
			     "TCP server received %" PRIu64 " bytes, client sent %" PRIu64,
			     server_len, client_len);
		zassert_true(client_len - server_len < client_len / 10,
			     "TCP server received %" PRIu64 " bytes, client sent %" PRIu64,
			     server_len, client_len);
		return;
	}

	zassert_equal(server_len, client_len,
		      "TCP server received %" PRIu64 " bytes, client sent %" PRIu64,
		      server_len, client_len);
}

ZTEST(zperf_api, test_tcp_upload_download)
{
	struct zperf_download_params download_param = {
		.port = TEST_PORT,
	};
	struct zperf_upload_params upload_param;
	struct zperf_results client_results = { 0 };
	int ret;

	ret = zperf_tcp_download(&download_param, server_session_cb, NULL);
	zassert_ok(ret, "Failed to start TCP server (%d)", ret);

	fill_upload_params(&upload_param);

	/* Blocking upload for TEST_DURATION_MS. */
	ret = zperf_tcp_upload(&upload_param, &client_results);
	zassert_ok(ret, "TCP upload failed (%d)", ret);

	/* Client side stats. */
	zassert_true(client_results.nb_packets_sent > 0,
		     "Client did not send any TCP packets");
	zassert_true(client_results.total_len > 0,
		     "Client did not transfer any TCP data");
	zassert_equal(client_results.packet_size, TEST_PACKET_SIZE,
		      "Unexpected client packet size %u",
		      client_results.packet_size);
	zassert_true(client_results.client_time_in_us > 0,
		     "Client transfer time not reported");

	/* Server side: the FINISHED callback fires when the client closes. */
	ret = k_sem_take(&session_finished, TEST_TIMEOUT);
	zassert_ok(ret, "Timed out waiting for TCP server session to finish");
	zassert_equal(server_last_status, ZPERF_SESSION_FINISHED,
		      "TCP server session did not finish cleanly (status %d)",
		      server_last_status);
	zassert_true(server_results.total_len > 0,
		     "TCP server did not report any received data");

	check_tcp_total(server_results.total_len, client_results.total_len);
}

ZTEST(zperf_api, test_udp_upload_async)
{
	struct zperf_download_params download_param = {
		.port = TEST_PORT,
	};
	struct zperf_upload_params upload_param;
	int ret;

	ret = zperf_udp_download(&download_param, server_session_cb, NULL);
	zassert_ok(ret, "Failed to start UDP server (%d)", ret);

	fill_upload_params(&upload_param);

	/* Non-blocking upload, results are delivered through the callback. */
	ret = zperf_udp_upload_async(&upload_param, client_upload_cb, NULL);
	zassert_ok(ret, "UDP async upload failed to start (%d)", ret);

	/* Client side: wait for the upload to complete via the callback. */
	ret = k_sem_take(&upload_finished, UPLOAD_TIMEOUT);
	zassert_ok(ret, "Timed out waiting for UDP async upload to finish");
	zassert_equal(client_last_status, ZPERF_SESSION_FINISHED,
		      "UDP async upload did not finish cleanly (status %d)",
		      client_last_status);
	zassert_true(client_async_results.nb_packets_sent > 0,
		     "Client did not send any UDP packets");
	zassert_true(client_async_results.nb_packets_rcvd > 0,
		     "Server did not report any received packets to client");
	zassert_true(client_async_results.nb_packets_rcvd <=
			     client_async_results.nb_packets_sent,
		     "Server received more packets (%u) than were sent (%u)",
		     client_async_results.nb_packets_rcvd,
		     client_async_results.nb_packets_sent);

	/* Server side: verify the FINISHED callback stats. */
	ret = k_sem_take(&session_finished, TEST_TIMEOUT);
	zassert_ok(ret, "Timed out waiting for UDP server session to finish");
	zassert_equal(server_last_status, ZPERF_SESSION_FINISHED,
		      "UDP server session did not finish cleanly (status %d)",
		      server_last_status);
	zassert_true(server_results.nb_packets_rcvd > 0,
		     "UDP server did not receive any packets");
	zassert_true(server_results.total_len > 0,
		     "UDP server did not report any received data");
}

ZTEST(zperf_api, test_tcp_upload_async)
{
	struct zperf_download_params download_param = {
		.port = TEST_PORT,
	};
	struct zperf_upload_params upload_param;
	int ret;

	ret = zperf_tcp_download(&download_param, server_session_cb, NULL);
	zassert_ok(ret, "Failed to start TCP server (%d)", ret);

	fill_upload_params(&upload_param);

	/* Non-blocking upload, results are delivered through the callback. */
	ret = zperf_tcp_upload_async(&upload_param, client_upload_cb, NULL);
	zassert_ok(ret, "TCP async upload failed to start (%d)", ret);

	/* Client side: wait for the upload to complete via the callback. */
	ret = k_sem_take(&upload_finished, UPLOAD_TIMEOUT);
	zassert_ok(ret, "Timed out waiting for TCP async upload to finish");
	zassert_equal(client_last_status, ZPERF_SESSION_FINISHED,
		      "TCP async upload did not finish cleanly (status %d)",
		      client_last_status);
	zassert_true(client_async_results.nb_packets_sent > 0,
		     "Client did not send any TCP packets");
	zassert_true(client_async_results.total_len > 0,
		     "Client did not transfer any TCP data");

	/* Server side: the FINISHED callback fires when the client closes. */
	ret = k_sem_take(&session_finished, TEST_TIMEOUT);
	zassert_ok(ret, "Timed out waiting for TCP server session to finish");
	zassert_equal(server_last_status, ZPERF_SESSION_FINISHED,
		      "TCP server session did not finish cleanly (status %d)",
		      server_last_status);
	zassert_true(server_results.total_len > 0,
		     "TCP server did not report any received data");

	check_tcp_total(server_results.total_len, client_async_results.total_len);
}

ZTEST_SUITE(zperf_api, NULL, NULL, zperf_before, zperf_after, NULL);
```

## src/iperf3_proto.c
```c
/*
 * SPDX-FileCopyrightText: Copyright The Zephyr Project Contributors
 * SPDX-License-Identifier: Apache-2.0
 */

/* The iperf3 message encoding, checked against messages captured from
 * iperf 3.16 with --debug.
 */

#include <string.h>

#include <zephyr/sys/byteorder.h>
#include <zephyr/ztest.h>

#include "zperf_iperf3.h"

/* The parameters iperf 3.16 sends for "-t 1", "-u -b 1M -l 1000
 * --udp-counters-64bit" and "-R"
 */
static const char params_tcp[] =
	"{\"tcp\":true,\"omit\":0,\"time\":1,\"num\":0,\"blockcount\":0,\"parallel\":1,"
	"\"len\":131072,\"pacing_timer\":1000,\"client_version\":\"3.16\"}";
static const char params_udp64[] =
	"{\"udp\":true,\"omit\":0,\"time\":1,\"num\":0,\"blockcount\":0,\"parallel\":1,"
	"\"len\":1000,\"bandwidth\":1000000,\"pacing_timer\":1000,\"udp_counters_64bit\":1,"
	"\"client_version\":\"3.16\"}";
static const char params_reverse[] =
	"{\"tcp\":true,\"omit\":0,\"time\":1,\"num\":0,\"blockcount\":0,\"parallel\":1,"
	"\"reverse\":true,\"len\":131072,\"pacing_timer\":1000,\"client_version\":\"3.16\"}";

/* The results an iperf 3.16 server sent after a UDP and a TCP test */
static const char results_udp[] =
	"{\"cpu_util_total\":0.93776675176068669,\"cpu_util_user\":0,"
	"\"cpu_util_system\":0.93756684411801738,\"sender_has_retransmits\":-1,"
	"\"streams\":[{\"id\":1,\"bytes\":125000,\"retransmits\":-1,"
	"\"jitter\":4.1014147773721059e-05,\"errors\":0,\"omitted_errors\":0,"
	"\"packets\":125,\"omitted_packets\":0,\"start_time\":0,\"end_time\":1.000422}]}";
static const char results_tcp[] =
	"{\"cpu_util_total\":77.29023946953204,\"cpu_util_user\":2.6414547923865066,"
	"\"cpu_util_system\":74.648684814955359,\"sender_has_retransmits\":-1,"
	"\"congestion_used\":\"cubic\",\"streams\":[{\"id\":1,\"bytes\":9313976320,"
	"\"retransmits\":-1,\"jitter\":0,\"errors\":0,\"omitted_errors\":0,\"packets\":0,"
	"\"omitted_packets\":0,\"start_time\":0,\"end_time\":1.001358}]}";

/* The parser writes into its input, so each test works on a copy */
static char json_buf[512];

static char *copy(const char *json)
{
	zassert_true(strlen(json) < sizeof(json_buf));
	strcpy(json_buf, json);

	return json_buf;
}

ZTEST(zperf_iperf3_proto, test_params_decode_tcp)
{
	struct zperf_iperf3_params p;

	zassert_ok(zperf_iperf3_params_decode(copy(params_tcp), strlen(params_tcp), &p));

	zassert_true(p.tcp);
	zassert_false(p.udp);
	zassert_false(p.reverse);
	zassert_equal(p.time, 1);
	zassert_equal(p.parallel, 1);
	zassert_equal(p.omit, 0);
	zassert_equal(p.len, 131072);
	zassert_equal(p.client_version.length, 4);
	zassert_mem_equal(p.client_version.start, "3.16", 4);
}

ZTEST(zperf_iperf3_proto, test_params_decode_udp_64bit_counters)
{
	struct zperf_iperf3_params p;

	zassert_ok(zperf_iperf3_params_decode(copy(params_udp64), strlen(params_udp64), &p));

	zassert_true(p.udp);
	zassert_false(p.tcp);
	zassert_equal(p.len, 1000);
	zassert_equal(p.bandwidth, 1000000);
	zassert_equal(p.udp_counters_64bit, 1);
}

ZTEST(zperf_iperf3_proto, test_params_decode_reverse)
{
	struct zperf_iperf3_params p;

	zassert_ok(zperf_iperf3_params_decode(copy(params_reverse), strlen(params_reverse), &p));

	zassert_true(p.reverse);
}

ZTEST(zperf_iperf3_proto, test_params_decode_ignores_unknown_keys)
{
	/* Keys zperf does not model, including nested ones, and a bandwidth
	 * beyond 32 bits
	 */
	static const char json[] =
		"{\"tcp\":true,\"window\":131072,\"congestion\":\"cubic\","
		"\"extra_data\":\"x\",\"future\":{\"a\":[1,{\"b\":2}],\"c\":\"d\"},"
		"\"bandwidth\":10000000000,\"time\":10}";
	struct zperf_iperf3_params p;

	zassert_ok(zperf_iperf3_params_decode(copy(json), strlen(json), &p));

	zassert_true(p.tcp);
	zassert_equal(p.time, 10);
	zassert_equal(p.bandwidth, 10000000000ULL);
}

ZTEST(zperf_iperf3_proto, test_params_decode_rejects_garbage)
{
	static const char *const bad[] = {
		"",
		"not json",
		"{\"tcp\":tru}",
		/* A string where a number is expected */
		"{\"time\":\"10\"}",
	};
	struct zperf_iperf3_params p;

	ARRAY_FOR_EACH(bad, i) {
		zassert_true(zperf_iperf3_params_decode(copy(bad[i]), strlen(bad[i]), &p) < 0,
			     "accepted \"%s\"", bad[i]);
	}
}

static void check_params_encode(const struct zperf_iperf3_params *p, const char *expected)
{
	struct zperf_iperf3_params back;
	uint8_t buf[256];
	char *json = (char *)buf + ZPERF_IPERF3_JSON_LEN_SIZE;
	int len;

	len = zperf_iperf3_params_encode(p, buf, sizeof(buf));
	zassert_equal(len, ZPERF_IPERF3_JSON_LEN_SIZE + strlen(expected), "encode gave %d", len);
	zassert_equal(sys_get_be32(buf), strlen(expected));
	zassert_mem_equal(json, expected, strlen(expected), "got %.*s",
			  len - ZPERF_IPERF3_JSON_LEN_SIZE, json);

	zassert_ok(zperf_iperf3_params_decode(json, len - ZPERF_IPERF3_JSON_LEN_SIZE, &back));
	zassert_equal(back.tcp, p->tcp);
	zassert_equal(back.udp, p->udp);
	zassert_equal(back.bandwidth, p->bandwidth);
}

ZTEST(zperf_iperf3_proto, test_params_encode_matches_iperf3)
{
	/* The same test settings produce the very message iperf 3.16 sends */
	char version[] = "3.16";
	struct zperf_iperf3_params tcp = {
		.tcp = true,
		.time = 1,
		.parallel = 1,
		.len = 131072,
		.pacing_timer = 1000,
		.client_version = { .start = version, .length = sizeof(version) - 1 },
	};
	struct zperf_iperf3_params udp = {
		.udp = true,
		.time = 1,
		.parallel = 1,
		.len = 1000,
		.bandwidth = 1000000,
		.pacing_timer = 1000,
		.client_version = { .start = version, .length = sizeof(version) - 1 },
	};

	check_params_encode(&tcp, params_tcp);
	check_params_encode(&udp,
			    "{\"udp\":true,\"omit\":0,\"time\":1,\"num\":0,\"blockcount\":0,"
			    "\"parallel\":1,\"len\":1000,\"bandwidth\":1000000,"
			    "\"pacing_timer\":1000,\"client_version\":\"3.16\"}");
}

ZTEST(zperf_iperf3_proto, test_params_encode_leaves_out_unset_flags)
{
	/* A server takes a flag to be set whenever its key is present, so
	 * one that is not set must not be sent at all, not even as false.
	 * Options with a value are sent only when they have one.
	 */
	char version[] = "zperf";
	struct zperf_iperf3_params p = {
		.tcp = true,
		.nodelay = true,
		.tos = 16,
		.time = 10,
		.parallel = 1,
		.len = 1024,
		.client_version = { .start = version, .length = sizeof(version) - 1 },
	};

	check_params_encode(&p, "{\"tcp\":true,\"omit\":0,\"time\":10,\"num\":0,"
				"\"blockcount\":0,\"nodelay\":true,\"parallel\":1,"
				"\"len\":1024,\"pacing_timer\":0,\"TOS\":16,"
				"\"client_version\":\"zperf\"}");

	/* And a bandwidth beyond 32 bits survives */
	p = (struct zperf_iperf3_params){ .udp = true, .bandwidth = 10000000000ULL };
	check_params_encode(&p, "{\"udp\":true,\"omit\":0,\"time\":0,\"num\":0,"
				"\"blockcount\":0,\"parallel\":0,\"len\":0,"
				"\"bandwidth\":10000000000,\"pacing_timer\":0,"
				"\"client_version\":\"\"}");
}

ZTEST(zperf_iperf3_proto, test_params_encode_too_small)
{
	struct zperf_iperf3_params p = { .tcp = true };
	uint8_t buf[16];

	zassert_equal(zperf_iperf3_params_encode(&p, buf, sizeof(buf)), -ENOSPC);
}

ZTEST(zperf_iperf3_proto, test_results_encode_receiver)
{
	static const char expected[] =
		"{\"cpu_util_total\":0,\"cpu_util_user\":0,\"cpu_util_system\":0,"
		"\"sender_has_retransmits\":-1,\"streams\":[{\"id\":1,\"bytes\":125000,"
		"\"retransmits\":-1,\"jitter\":0.000041,\"errors\":3,\"packets\":125,"
		"\"start_time\":0,\"end_time\":1.000422}]}";
	struct zperf_iperf3_stream_stats stats = {
		.bytes = 125000,
		.packets = 125,
		.errors = 3,
		.jitter_us = 41,
		.duration_us = 1000422,
	};
	uint8_t buf[512];
	int len;

	len = zperf_iperf3_results_encode(&stats, false, buf, sizeof(buf));
	zassert_equal(len, ZPERF_IPERF3_JSON_LEN_SIZE + sizeof(expected) - 1,
		      "unexpected length %d", len);
	zassert_equal(sys_get_be32(buf), sizeof(expected) - 1);
	zassert_mem_equal(buf + ZPERF_IPERF3_JSON_LEN_SIZE, expected, sizeof(expected) - 1,
			  "got %s", (char *)buf + ZPERF_IPERF3_JSON_LEN_SIZE);
}

ZTEST(zperf_iperf3_proto, test_results_encode_sender)
{
	struct zperf_iperf3_stream_stats stats = { .bytes = 1, .duration_us = 1 };
	uint8_t buf[512];

	zassert_true(zperf_iperf3_results_encode(&stats, true, buf, sizeof(buf)) > 0);
	zassert_not_null(strstr((char *)buf + ZPERF_IPERF3_JSON_LEN_SIZE,
				"\"sender_has_retransmits\":0"));
}

ZTEST(zperf_iperf3_proto, test_results_decode_udp)
{
	struct zperf_iperf3_stream_stats stats;

	zassert_ok(zperf_iperf3_results_decode(copy(results_udp), strlen(results_udp), &stats));

	zassert_equal(stats.bytes, 125000);
	zassert_equal(stats.packets, 125);
	zassert_equal(stats.errors, 0);
	/* 4.1014e-05 s */
	zassert_equal(stats.jitter_us, 41);
	zassert_equal(stats.duration_us, 1000422);
}

ZTEST(zperf_iperf3_proto, test_results_decode_tcp)
{
	struct zperf_iperf3_stream_stats stats;

	zassert_ok(zperf_iperf3_results_decode(copy(results_tcp), strlen(results_tcp), &stats));

	/* More than 32 bits */
	zassert_equal(stats.bytes, 9313976320ULL);
	zassert_equal(stats.jitter_us, 0);
	zassert_equal(stats.duration_us, 1001358);
}

ZTEST(zperf_iperf3_proto, test_results_roundtrip)
{
	struct zperf_iperf3_stream_stats in = {
		.bytes = 9313976320ULL,
		.packets = 7,
		.errors = 2,
		.jitter_us = 1234,
		.duration_us = 10000001,
	};
	struct zperf_iperf3_stream_stats out;
	uint8_t buf[512];
	int len;

	len = zperf_iperf3_results_encode(&in, false, buf, sizeof(buf));
	zassert_true(len > 0);
	zassert_ok(zperf_iperf3_results_decode((char *)buf + ZPERF_IPERF3_JSON_LEN_SIZE,
					       len - ZPERF_IPERF3_JSON_LEN_SIZE, &out));
	zassert_mem_equal(&in, &out, sizeof(in));
}

ZTEST(zperf_iperf3_proto, test_results_decode_without_streams)
{
	static const char json[] = "{\"cpu_util_total\":0,\"cpu_util_user\":0,"
				   "\"cpu_util_system\":0,\"sender_has_retransmits\":-1}";
	struct zperf_iperf3_stream_stats stats;

	zassert_true(zperf_iperf3_results_decode(copy(json), strlen(json), &stats) < 0);
}

ZTEST(zperf_iperf3_proto, test_parse_seconds)
{
	static const struct {
		const char *str;
		uint64_t usec;
	} good[] = {
		{ "0", 0 },
		{ "12", 12000000 },
		{ "1.000422", 1000422 },
		{ "0.0000005", 1 },
		{ "0.0000004", 0 },
		{ "4.1014147773721059e-05", 41 },
		{ "1e-6", 1 },
		{ "1E+1", 10000000 },
		{ "2.5e3", 2500000000ULL },
		{ "1e-400", 0 },
		{ "0e400", 0 },
		/* More digits than fit, beyond the precision kept */
		{ "123456789012345678901e-12", 123456789012346ULL },
	};
	static const char *const bad[] = {
		"", "-1", "abc", ".", "1.2.3", "1e", "1e+", "1x", "1e400",
	};
	uint64_t usec;

	ARRAY_FOR_EACH(good, i) {
		zassert_ok(zperf_iperf3_parse_seconds(good[i].str, strlen(good[i].str), &usec),
			   "rejected \"%s\"", good[i].str);
		zassert_equal(usec, good[i].usec, "\"%s\" gave %llu", good[i].str, usec);
	}

	ARRAY_FOR_EACH(bad, i) {
		zassert_true(zperf_iperf3_parse_seconds(bad[i], strlen(bad[i]), &usec) < 0,
			     "accepted \"%s\"", bad[i]);
	}

	/* The length bounds the number: it need not be NUL terminated */
	zassert_ok(zperf_iperf3_parse_seconds("1.5,\"x\"", 3, &usec));
	zassert_equal(usec, 1500000);
}

ZTEST(zperf_iperf3_proto, test_fmt_seconds)
{
	char buf[32];

	zassert_equal(zperf_iperf3_fmt_seconds(buf, sizeof(buf), 0), 8);
	zassert_str_equal(buf, "0.000000");
	zassert_equal(zperf_iperf3_fmt_seconds(buf, sizeof(buf), 1000422), 8);
	zassert_str_equal(buf, "1.000422");
	zassert_true(zperf_iperf3_fmt_seconds(buf, sizeof(buf), 12345678901ULL) > 0);
	zassert_str_equal(buf, "12345.678901");
	zassert_equal(zperf_iperf3_fmt_seconds(buf, 8, 0), -ENOSPC);
}

ZTEST(zperf_iperf3_proto, test_udp_header)
{
	uint8_t buf[ZPERF_IPERF3_UDP_HDR_SIZE_64];
	uint64_t time_us;
	uint64_t seq;

	zperf_iperf3_udp_hdr_put(buf, 3000004ULL, 0x01020304, false);
	zassert_mem_equal(buf, ((uint8_t[]){ 0, 0, 0, 3, 0, 0, 0, 4, 1, 2, 3, 4 }),
			  ZPERF_IPERF3_UDP_HDR_SIZE);
	zassert_ok(zperf_iperf3_udp_hdr_get(buf, ZPERF_IPERF3_UDP_HDR_SIZE, false, &time_us,
					    &seq));
	zassert_equal(time_us, 3000004ULL);
	zassert_equal(seq, 0x01020304);

	zperf_iperf3_udp_hdr_put(buf, 5, 0x0102030405060708ULL, true);
	zassert_mem_equal(buf + 8, ((uint8_t[]){ 1, 2, 3, 4, 5, 6, 7, 8 }), 8);
	zassert_ok(zperf_iperf3_udp_hdr_get(buf, sizeof(buf), true, &time_us, &seq));
	zassert_equal(seq, 0x0102030405060708ULL);

	zassert_equal(zperf_iperf3_udp_hdr_get(buf, ZPERF_IPERF3_UDP_HDR_SIZE, true, &time_us,
					       &seq), -EINVAL);
	zassert_equal(zperf_iperf3_udp_hdr_get(buf, 11, false, &time_us, &seq), -EINVAL);
}

ZTEST(zperf_iperf3_proto, test_udp_accounting)
{
	static const uint64_t seqs[] = { 1, 2, 4, 3, 6 };
	struct zperf_iperf3_udp_stats stats = { 0 };

	ARRAY_FOR_EACH(seqs, i) {
		zperf_iperf3_udp_account(&stats, seqs[i], 100, 1000);
	}

	/* 4 opens a gap of one, 3 closes it, 6 opens another */
	zassert_equal(stats.packet_count, 6);
	zassert_equal(stats.errors, 1);
	zassert_equal(stats.outoforder, 1);
	zassert_equal(stats.datagrams, 5);
	zassert_equal(stats.bytes, 5000);
	/* Constant transit time: no jitter */
	zassert_equal(zperf_iperf3_udp_jitter_us(&stats), 0);
}

ZTEST(zperf_iperf3_proto, test_udp_jitter)
{
	struct zperf_iperf3_udp_stats stats = { 0 };

	/* The first transit time only sets the reference, however large the
	 * clock offset it contains
	 */
	zperf_iperf3_udp_account(&stats, 1, 1000000, 100);
	zassert_equal(zperf_iperf3_udp_jitter_us(&stats), 0);

	/* A transit change of 1600 us moves the jitter by 1/16 of it */
	zperf_iperf3_udp_account(&stats, 2, 1001600, 100);
	zassert_equal(zperf_iperf3_udp_jitter_us(&stats), 100);

	/* Repeated changes converge towards their size */
	for (uint64_t seq = 3; seq < 200; seq++) {
		zperf_iperf3_udp_account(&stats, seq, (seq % 2 == 0) ? 1001600 : 1000000, 100);
	}
	zassert_within(zperf_iperf3_udp_jitter_us(&stats), 1600, 16);
}

ZTEST(zperf_iperf3_proto, test_cookie)
{
	char a[ZPERF_IPERF3_COOKIE_SIZE];
	char b[ZPERF_IPERF3_COOKIE_SIZE];

	zperf_iperf3_make_cookie(a);
	zperf_iperf3_make_cookie(b);

	zassert_equal(strlen(a), ZPERF_IPERF3_COOKIE_SIZE - 1);
	zassert_equal(strspn(a, "abcdefghijklmnopqrstuvwxyz234567"),
		      ZPERF_IPERF3_COOKIE_SIZE - 1);
	zassert_true(memcmp(a, b, sizeof(a)) != 0);
}

ZTEST(zperf_iperf3_proto, test_udp_connect_messages)
{
	/* Text, so the same bytes whatever the byte order of either end */
	zassert_mem_equal(zperf_iperf3_udp_connect_msg, "9876", ZPERF_IPERF3_UDP_CONNECT_SIZE);
	zassert_mem_equal(zperf_iperf3_udp_connect_reply, "6789",
			  ZPERF_IPERF3_UDP_CONNECT_SIZE);
}

ZTEST_SUITE(zperf_iperf3_proto, NULL, NULL, NULL, NULL, NULL);
```
