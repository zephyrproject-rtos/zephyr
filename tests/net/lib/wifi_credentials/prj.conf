## CMakeLists.txt
```
#
# Copyright (c) 2024 Nordic Semiconductor ASA
#
# SPDX-License-Identifier: Apache-2.0
#

cmake_minimum_required(VERSION 3.28.0)

find_package(Zephyr REQUIRED HINTS $ENV{ZEPHYR_BASE})
project(wifi_credentials_test)

if(CONFIG_WIFI_CREDENTIALS)
  # The library is built with the backend selected in Kconfig.
  target_sources(app PRIVATE src/backend_psa_ps.c)
  if(CONFIG_SECURE_STORAGE)
    # To store a corrupt entry with the internal ITS store API.
    target_include_directories(app PRIVATE ${ZEPHYR_BASE}/subsys/secure_storage/include/internal)
  endif()
  return()
endif()

target_sources(app PRIVATE src/main.c)

target_sources(app
  PRIVATE
  ${ZEPHYR_BASE}/subsys/net/lib/wifi_credentials/wifi_credentials.c
)

zephyr_include_directories(${ZEPHYR_BASE}/subsys/testsuite/include)
zephyr_include_directories(${ZEPHYR_BASE}/subsys/net/lib/wifi_credentials/)

target_compile_options(app
  PRIVATE
  -DCONFIG_WIFI_CREDENTIALS_MAX_ENTRIES=2
  -DCONFIG_WIFI_CREDENTIALS_SAE_PASSWORD_LENGTH=128
  -DCONFIG_WIFI_CREDENTIALS_LOG_LEVEL=4
)
```

## prj.conf
```kconfig
#
# Copyright (c) 2024 Nordic Semiconductor ASA
#
# SPDX-License-Identifier: LicenseRef-Nordic-5-Clause
#

CONFIG_ZTEST=y
CONFIG_LOG=y
```

## backend_psa_ps.conf
```kconfig
CONFIG_NETWORKING=y
# No network interface is needed, so do not connect QEMU to the host.
CONFIG_NET_TEST=y
CONFIG_WIFI_CREDENTIALS=y
CONFIG_WIFI_CREDENTIALS_BACKEND_PSA_PS=y
CONFIG_WIFI_CREDENTIALS_CONNECT_STORED=n
CONFIG_ZTEST_STACK_SIZE=4096
CONFIG_MAIN_STACK_SIZE=4096

CONFIG_PSA_CRYPTO=y
CONFIG_ENTROPY_GENERATOR=y
CONFIG_TEST_RANDOM_GENERATOR=y
CONFIG_TIMER_RANDOM_GENERATOR=y
CONFIG_MBEDTLS_PSA_CRYPTO_EXTERNAL_RNG_ALLOW_NON_CSPRNG=y

CONFIG_SECURE_STORAGE=y
# One slot more for the corrupt entry.
CONFIG_WIFI_CREDENTIALS_MAX_ENTRIES=3
```

## overlay-backend_psa.conf
```kconfig
CONFIG_NETWORKING=y
# No network interface is needed, so do not connect QEMU to the host.
CONFIG_NET_TEST=y
CONFIG_WIFI_CREDENTIALS=y
CONFIG_WIFI_CREDENTIALS_BACKEND_PSA=y
CONFIG_WIFI_CREDENTIALS_CONNECT_STORED=n
CONFIG_ZTEST_STACK_SIZE=4096
CONFIG_MAIN_STACK_SIZE=4096

CONFIG_PSA_CRYPTO=y
CONFIG_ENTROPY_GENERATOR=y
CONFIG_TEST_RANDOM_GENERATOR=y
CONFIG_TIMER_RANDOM_GENERATOR=y
CONFIG_MBEDTLS_PSA_CRYPTO_EXTERNAL_RNG_ALLOW_NON_CSPRNG=y
# The default Mbed TLS heap cannot hold the credentials entries.
CONFIG_MBEDTLS_HEAP_SIZE=2048

CONFIG_SECURE_STORAGE=y
CONFIG_SECURE_STORAGE_ITS_STORE_IMPLEMENTATION_SETTINGS=y
CONFIG_SETTINGS=y
CONFIG_SETTINGS_NVS=y
CONFIG_NVS=y
CONFIG_FLASH=y
CONFIG_FLASH_MAP=y
```

## overlay-backend_psa_ps.conf
```kconfig
CONFIG_NETWORKING=y
# No network interface is needed, so do not connect QEMU to the host.
CONFIG_NET_TEST=y
CONFIG_WIFI_CREDENTIALS=y
CONFIG_WIFI_CREDENTIALS_BACKEND_PSA_PS=y
CONFIG_WIFI_CREDENTIALS_CONNECT_STORED=n
CONFIG_ZTEST_STACK_SIZE=4096
CONFIG_MAIN_STACK_SIZE=4096

CONFIG_PSA_CRYPTO=y
CONFIG_ENTROPY_GENERATOR=y
CONFIG_TEST_RANDOM_GENERATOR=y
CONFIG_TIMER_RANDOM_GENERATOR=y
CONFIG_MBEDTLS_PSA_CRYPTO_EXTERNAL_RNG_ALLOW_NON_CSPRNG=y

CONFIG_SECURE_STORAGE=y
```

## overlay-backend_psa_ps_tfm.conf
```kconfig
CONFIG_NETWORKING=y
# No network interface is needed, so do not connect QEMU to the host.
CONFIG_NET_TEST=y
CONFIG_WIFI_CREDENTIALS=y
CONFIG_WIFI_CREDENTIALS_BACKEND_PSA_PS=y
CONFIG_WIFI_CREDENTIALS_CONNECT_STORED=n
CONFIG_ZTEST_STACK_SIZE=4096
CONFIG_MAIN_STACK_SIZE=4096
CONFIG_TEST_RANDOM_GENERATOR=y
CONFIG_TIMER_RANDOM_GENERATOR=y
```

## store_settings.conf
```kconfig
CONFIG_SECURE_STORAGE_ITS_STORE_IMPLEMENTATION_SETTINGS=y
CONFIG_SETTINGS=y
CONFIG_SETTINGS_NVS=y
CONFIG_NVS=y
CONFIG_FLASH=y
CONFIG_FLASH_MAP=y
```

## zms.overlay
```dts
/*
 * SPDX-FileCopyrightText: Copyright The Zephyr Project Contributors
 * SPDX-License-Identifier: Apache-2.0
 */

/ {
	chosen {
		zephyr,secure-storage-its-partition = &storage_partition;
	};
};
```

## src/main.c
```c
/*
 * Copyright (c) 2024 Nordic Semiconductor ASA
 *
 * SPDX-License-Identifier: Apache-2.0
 */

#include <stdbool.h>
#include <stdlib.h>
#include <string.h>
#include <zephyr/kernel.h>
#include <zephyr/ztest.h>

#include <zephyr/fff.h>

#include <zephyr/net/wifi_credentials.h>

#include "wifi_credentials_internal.h"

DEFINE_FFF_GLOBALS;

FAKE_VALUE_FUNC(int, wifi_credentials_store_entry, size_t, const void *, size_t)
FAKE_VALUE_FUNC(int, wifi_credentials_load_entry, size_t, void *, size_t)
FAKE_VALUE_FUNC(int, wifi_credentials_delete_entry, size_t)
FAKE_VALUE_FUNC(int, wifi_credentials_backend_init)

uint8_t fake_settings_buf[CONFIG_WIFI_CREDENTIALS_MAX_ENTRIES][ENTRY_MAX_LEN];

int custom_wifi_credentials_store_entry(size_t idx, const void *buf, size_t buf_len)
{
	zassert_true(idx < CONFIG_WIFI_CREDENTIALS_MAX_ENTRIES, "Index out of bounds");
	memcpy(fake_settings_buf[idx], buf, MIN(ENTRY_MAX_LEN, buf_len));
	return 0;
}

int custom_wifi_credentials_load_entry(size_t idx, void *buf, size_t buf_len)
{
	zassert_true(idx < CONFIG_WIFI_CREDENTIALS_MAX_ENTRIES, "Index out of bounds");
	memcpy(buf, fake_settings_buf[idx], MIN(ENTRY_MAX_LEN, buf_len));
	return 0;
}

#define SSID1     "test1"
#define PSK1      "super secret"
#define SECURITY1 WIFI_SECURITY_TYPE_PSK
#define BSSID1    "abcdef"
#define FLAGS1    WIFI_CREDENTIALS_FLAG_BSSID
#define CHANNEL1  1

#define SSID2     "test2"
#define SECURITY2 WIFI_SECURITY_TYPE_NONE
#define FLAGS2    0
#define CHANNEL2  2

#define SSID3     "test3"
#define PSK3      "extremely secret"
#define SECURITY3 WIFI_SECURITY_TYPE_SAE
#define FLAGS3    0
#define CHANNEL3  3

#define SSID4     "\0what's\0null\0termination\0anyway"
#define PSK4      PSK1
#define SECURITY4 SECURITY1
#define BSSID4    BSSID1
#define FLAGS4    FLAGS1
#define CHANNEL4  4

#define SSID5         "test5"
#define SECURITY5     WIFI_SECURITY_TYPE_OWE
#define BSSID5        BSSID1
#define FLAGS5        FLAGS1
#define CHANNEL5      5
#define PSK5_UNWANTED "unwanted secret"

static void wifi_credentials_setup(void *unused)
{
	RESET_FAKE(wifi_credentials_store_entry);
	RESET_FAKE(wifi_credentials_load_entry);
	RESET_FAKE(wifi_credentials_delete_entry);
	wifi_credentials_store_entry_fake.custom_fake = custom_wifi_credentials_store_entry;
	wifi_credentials_load_entry_fake.custom_fake = custom_wifi_credentials_load_entry;
}

static void wifi_credentials_teardown(void *unused)
{
	/* Delete the entries even if the test made deleting fail. */
	RESET_FAKE(wifi_credentials_delete_entry);
	wifi_credentials_delete_by_ssid(SSID1, ARRAY_SIZE(SSID1));
	wifi_credentials_delete_by_ssid(SSID2, ARRAY_SIZE(SSID2));
	wifi_credentials_delete_by_ssid(SSID3, ARRAY_SIZE(SSID3));
	wifi_credentials_delete_by_ssid(SSID4, ARRAY_SIZE(SSID4));
	wifi_credentials_delete_by_ssid(SSID5, ARRAY_SIZE(SSID5));
	wifi_credentials_delete_by_ssid("", 0);
}

/* Verify that attempting to retrieve a non-existent credentials entry raises -ENOENT. */
ZTEST(wifi_credentials, test_get_non_existing)
{
	int err;
	enum wifi_security_type security = -1;
	uint8_t bssid_buf[WIFI_MAC_ADDR_LEN] = "";
	char psk_buf[WIFI_CREDENTIALS_MAX_PASSWORD_LEN] = "";
	size_t psk_len = 0;
	uint32_t flags = 0;
	uint8_t channel = 0;
	uint32_t timeout = 0;

	err = wifi_credentials_get_by_ssid_personal(
		SSID1, sizeof(SSID1), &security, bssid_buf, ARRAY_SIZE(bssid_buf), psk_buf,
		ARRAY_SIZE(psk_buf), &psk_len, &flags, &channel, &timeout);
	zassert_equal(err, -ENOENT, "Expected -ENOENT, got %d", err);
}

/* Verify that we can successfully set/get a network without a specified BSSID. */
ZTEST(wifi_credentials, test_single_no_bssid)
{
	int err;

	/* set network credentials without BSSID */
	err = wifi_credentials_set_personal(SSID1, sizeof(SSID1), SECURITY1, NULL, 0, PSK1,
					    sizeof(PSK1), 0, 0, 0);
	zassert_equal(err, EXIT_SUCCESS, "Expected EXIT_SUCCESS, got %d", err);

	enum wifi_security_type security = -1;
	uint8_t bssid_buf[WIFI_MAC_ADDR_LEN] = "";
	char psk_buf[WIFI_CREDENTIALS_MAX_PASSWORD_LEN] = "";
	size_t psk_len = 0;
	uint32_t flags = 0;
	uint8_t channel = 0;
	uint32_t timeout = 0;

	/* retrieve network credentials without BSSID */
	err = wifi_credentials_get_by_ssid_personal(
		SSID1, sizeof(SSID1), &security, bssid_buf, ARRAY_SIZE(bssid_buf), psk_buf,
		ARRAY_SIZE(psk_buf), &psk_len, &flags, &channel, &timeout);
	zassert_equal(err, EXIT_SUCCESS, "Expected EXIT_SUCCESS, got %d", err);
	zassert_equal(strncmp(PSK1, psk_buf, ARRAY_SIZE(psk_buf)), 0, "PSK mismatch");
	zassert_equal(flags, 0, "Flags mismatch");
	zassert_equal(channel, 0, "Channel mismatch");
	zassert_equal(security, SECURITY1, "Security type mismatch");

	err = wifi_credentials_delete_by_ssid(SSID1, sizeof(SSID1));
	zassert_equal(err, EXIT_SUCCESS, "Expected EXIT_SUCCESS, got %d", err);
}

/* Verify that we can successfully set/get a network with a fixed BSSID. */
ZTEST(wifi_credentials, test_single_with_bssid)
{
	int err;

	/* set network credentials with BSSID */
	err = wifi_credentials_set_personal(SSID1, sizeof(SSID1), SECURITY1, BSSID1, 6, PSK1,
					    sizeof(PSK1), FLAGS1, CHANNEL1, 0);
	zassert_equal(err, EXIT_SUCCESS, "Expected EXIT_SUCCESS, got %d", err);

	enum wifi_security_type security = -1;
	uint8_t bssid_buf[WIFI_MAC_ADDR_LEN] = "";
	char psk_buf[WIFI_CREDENTIALS_MAX_PASSWORD_LEN] = "";
	size_t psk_len = 0;
	uint32_t flags = 0;
	uint8_t channel = 0;
	uint32_t timeout = 0;

	/* retrieve network credentials with BSSID */
	err = wifi_credentials_get_by_ssid_personal(
		SSID1, sizeof(SSID1), &security, bssid_buf, ARRAY_SIZE(bssid_buf), psk_buf,
		ARRAY_SIZE(psk_buf), &psk_len, &flags, &channel, &timeout);
	zassert_equal(err, EXIT_SUCCESS, "Expected EXIT_SUCCESS, got %d", err);
	zassert_equal(strncmp(PSK1, psk_buf, ARRAY_SIZE(psk_buf)), 0, "PSK mismatch");
	zassert_equal(psk_len, sizeof(PSK1), "PSK length mismatch");
	zassert_equal(strncmp(BSSID1, bssid_buf, ARRAY_SIZE(bssid_buf)), 0, "BSSID mismatch");
	zassert_equal(flags, WIFI_CREDENTIALS_FLAG_BSSID, "Flags mismatch");
	zassert_equal(channel, CHANNEL1, "Channel mismatch");
	zassert_equal(security, SECURITY1, "Security type mismatch");

	err = wifi_credentials_delete_by_ssid(SSID1, sizeof(SSID1));
	zassert_equal(err, EXIT_SUCCESS, "Expected EXIT_SUCCESS, got %d", err);
}

/* Verify that we can successfully set/get an open network. */
ZTEST(wifi_credentials, test_single_without_psk)
{
	int err;

	/* set network credentials without PSK/BSSID */
	err = wifi_credentials_set_personal(SSID2, sizeof(SSID2), SECURITY2, NULL, 6, NULL, 0,
					    FLAGS2, CHANNEL2, 0);
	zassert_equal(err, EXIT_SUCCESS, "Expected EXIT_SUCCESS, got %d", err);

	enum wifi_security_type security = -1;
	uint8_t bssid_buf[WIFI_MAC_ADDR_LEN] = "";
	char psk_buf[WIFI_CREDENTIALS_MAX_PASSWORD_LEN] = "";
	size_t psk_len = 0;
	uint32_t flags = 0;
	uint8_t channel = 0;
	uint32_t timeout = 0;

	/* retrieve network credentials without PSK/BSSID */
	err = wifi_credentials_get_by_ssid_personal(
		SSID2, sizeof(SSID2), &security, bssid_buf, ARRAY_SIZE(bssid_buf), psk_buf,
		ARRAY_SIZE(psk_buf), &psk_len, &flags, &channel, &timeout);
	zassert_equal(err, EXIT_SUCCESS, "Expected EXIT_SUCCESS, got %d", err);
	zassert_equal(psk_len, 0, "PSK length mismatch");
	zassert_equal(flags, 0, "Flags mismatch");
	zassert_equal(channel, CHANNEL2, "Channel mismatch");

	err = wifi_credentials_delete_by_ssid(SSID2, sizeof(SSID2));
	zassert_equal(err, EXIT_SUCCESS, "Expected EXIT_SUCCESS, got %d", err);
}

/* Verify that we can set/get a network that is only identified by a BSSID. */
ZTEST(wifi_credentials, test_single_without_ssid)
{
	int err;

	err = wifi_credentials_set_personal("", 0, SECURITY1, BSSID1, 6, PSK1, sizeof(PSK1), FLAGS1,
					    CHANNEL1, 0);
	zassert_equal(err, -EINVAL, "Expected -EINVAL, got %d", err);

	enum wifi_security_type security = -1;
	uint8_t bssid_buf[WIFI_MAC_ADDR_LEN] = "";
	char psk_buf[WIFI_CREDENTIALS_MAX_PASSWORD_LEN] = "";
	size_t psk_len = 0;
	uint32_t flags = 0;
	uint8_t channel = 0;
	uint32_t timeout = 0;

	err = wifi_credentials_get_by_ssid_personal(
		"", 0, &security, bssid_buf, ARRAY_SIZE(bssid_buf), psk_buf, ARRAY_SIZE(psk_buf),
		&psk_len, &flags, &channel, &timeout);
	zassert_equal(err, -EINVAL, "Expected -EINVAL, got %d", err);

	err = wifi_credentials_delete_by_ssid("", 0);
	zassert_equal(err, -EINVAL, "Expected -EINVAL, got %d", err);
}

/* Verify that we can handle SSIDs that contain NULL characters. */
ZTEST(wifi_credentials, test_single_garbled_ssid)
{
	int err;

	err = wifi_credentials_set_personal(SSID4, sizeof(SSID4), SECURITY4, BSSID4, 6, PSK4,
					    sizeof(PSK4), FLAGS4, CHANNEL4, 0);
	zassert_equal(err, EXIT_SUCCESS, "Expected EXIT_SUCCESS, got %d", err);

	enum wifi_security_type security = -1;
	uint8_t bssid_buf[WIFI_MAC_ADDR_LEN] = "";
	char psk_buf[WIFI_CREDENTIALS_MAX_PASSWORD_LEN] = "";
	size_t psk_len = 0;
	uint32_t flags = 0;
	uint8_t channel = 0;
	uint32_t timeout = 0;

	err = wifi_credentials_get_by_ssid_personal(
		SSID4, sizeof(SSID4), &security, bssid_buf, ARRAY_SIZE(bssid_buf), psk_buf,
		ARRAY_SIZE(psk_buf), &psk_len, &flags, &channel, &timeout);
	zassert_equal(err, EXIT_SUCCESS, "Expected EXIT_SUCCESS, got %d", err);
	zassert_equal(strncmp(PSK4, psk_buf, ARRAY_SIZE(psk_buf)), 0, "PSK mismatch");
	zassert_equal(psk_len, sizeof(PSK4), "PSK length mismatch");
	zassert_equal(strncmp(BSSID4, bssid_buf, ARRAY_SIZE(bssid_buf)), 0, "BSSID mismatch");
	zassert_equal(security, SECURITY4, "Security type mismatch");
	zassert_equal(flags, FLAGS4, "Flags mismatch");
	zassert_equal(channel, CHANNEL4, "Channel mismatch");

	err = wifi_credentials_delete_by_ssid(SSID4, sizeof(SSID4));
	zassert_equal(err, EXIT_SUCCESS, "Expected EXIT_SUCCESS, got %d", err);
}

/** Verify that we can handle OWE connection with and without PSK */
ZTEST(wifi_credentials, test_add_network_owe)
{
	int err;

	/* set network credentials without PSK */
	err = wifi_credentials_set_personal(SSID5, sizeof(SSID5), SECURITY5, BSSID5, 6, NULL, 0,
					    FLAGS2, CHANNEL5, 0);
	zassert_equal(err, EXIT_SUCCESS, "Expected EXIT_SUCCESS, got %d", err);

	{
		enum wifi_security_type security = -1;
		uint8_t bssid_buf[WIFI_MAC_ADDR_LEN] = "";
		char psk_buf[WIFI_CREDENTIALS_MAX_PASSWORD_LEN] = "";
		size_t psk_len = 0;
		uint32_t flags = 0;
		uint8_t channel = 0;
		uint32_t timeout = 0;

		/* retrieve network credentials without PSK */
		err = wifi_credentials_get_by_ssid_personal(
			SSID5, sizeof(SSID5), &security, bssid_buf, ARRAY_SIZE(bssid_buf), psk_buf,
			ARRAY_SIZE(psk_buf), &psk_len, &flags, &channel, &timeout);
		zassert_equal(err, EXIT_SUCCESS, "Expected EXIT_SUCCESS, got %d", err);
		zassert_equal(security, WIFI_SECURITY_TYPE_OWE, "Security type mismatch");
		zassert_mem_equal(psk_buf, (char[WIFI_CREDENTIALS_MAX_PASSWORD_LEN]) {0},
				  WIFI_CREDENTIALS_MAX_PASSWORD_LEN,
				  "OWE PSK buffer should be zeroed");
		zassert_equal(psk_len, 0, "PSK length mismatch");
		zassert_equal(flags, 0, "Flags mismatch");
		zassert_equal(channel, CHANNEL5, "Channel mismatch");
	}

	err = wifi_credentials_delete_by_ssid(SSID5, sizeof(SSID5));
	zassert_equal(err, EXIT_SUCCESS, "Cleanup between subtests failed, got %d", err);

	/* set network credentials with PSK */
	err = wifi_credentials_set_personal(SSID5, sizeof(SSID5), SECURITY5, BSSID5, 6,
					    PSK5_UNWANTED, sizeof(PSK5_UNWANTED), FLAGS2, CHANNEL5,
					    0);
	zassert_equal(err, EXIT_SUCCESS, "Expected EXIT_SUCCESS, got %d", err);

	{
		enum wifi_security_type security = -1;
		uint8_t bssid_buf[WIFI_MAC_ADDR_LEN] = "";
		char psk_buf[WIFI_CREDENTIALS_MAX_PASSWORD_LEN] = "";
		size_t psk_len = 0;
		uint32_t flags = 0;
		uint8_t channel = 0;
		uint32_t timeout = 0;

		/* retrieve network credentials with PSK */
		err = wifi_credentials_get_by_ssid_personal(
			SSID5, sizeof(SSID5), &security, bssid_buf, ARRAY_SIZE(bssid_buf), psk_buf,
			ARRAY_SIZE(psk_buf), &psk_len, &flags, &channel, &timeout);
		zassert_equal(err, EXIT_SUCCESS, "Expected EXIT_SUCCESS, got %d", err);
		zassert_equal(security, WIFI_SECURITY_TYPE_OWE, "Security type mismatch");
		zassert_mem_equal(psk_buf, (char[WIFI_CREDENTIALS_MAX_PASSWORD_LEN]) {0},
				  WIFI_CREDENTIALS_MAX_PASSWORD_LEN,
				  "OWE PSK buffer should be zeroed");
		zassert_equal(psk_len, 0, "PSK length mismatch");
		zassert_equal(flags, 0, "Flags mismatch");
		zassert_equal(channel, CHANNEL5, "Channel mismatch");
	}

	err = wifi_credentials_delete_by_ssid(SSID5, sizeof(SSID5));
	zassert_equal(err, EXIT_SUCCESS, "Expected EXIT_SUCCESS, got %d", err);
}

/* Helper function for test_set_storage_limit, making sure that the SSID cache is correct. */
void verify_ssid_cache_cb(void *cb_arg, const char *ssid, size_t ssid_len)
{
	static int call_count;
	static const char *const ssids[] = {SSID3, SSID2};

	zassert_equal(strncmp(ssids[call_count++], ssid, ssid_len), 0, "SSID cache mismatch");
	zassert_is_null(cb_arg, "Callback argument is not NULL");
}

/* Verify that wifi_credentials behaves correctly when the storage limit is reached. */
ZTEST(wifi_credentials, test_storage_limit)
{
	int err;

	/* Set two networks */
	err = wifi_credentials_set_personal(SSID1, sizeof(SSID1), SECURITY1, BSSID1, 6, PSK1,
					    sizeof(PSK1), FLAGS1, CHANNEL1, 0);
	zassert_equal(err, EXIT_SUCCESS, "Expected EXIT_SUCCESS, got %d", err);

	err = wifi_credentials_set_personal(SSID2, sizeof(SSID2), SECURITY2, NULL, 6, NULL, 0,
					    FLAGS2, CHANNEL2, 0);
	zassert_equal(err, EXIT_SUCCESS, "Expected EXIT_SUCCESS, got %d", err);

	enum wifi_security_type security = -1;
	uint8_t bssid_buf[WIFI_MAC_ADDR_LEN] = "";
	char psk_buf[WIFI_CREDENTIALS_MAX_PASSWORD_LEN] = "";
	size_t psk_len = 0;
	uint32_t flags = 0;
	uint8_t channel = 0;
	uint32_t timeout = 0;

	/* Get two networks */
	err = wifi_credentials_get_by_ssid_personal(
		SSID1, sizeof(SSID1), &security, bssid_buf, ARRAY_SIZE(bssid_buf), psk_buf,
		ARRAY_SIZE(psk_buf), &psk_len, &flags, &channel, &timeout);
	zassert_equal(err, EXIT_SUCCESS, "Expected EXIT_SUCCESS, got %d", err);
	zassert_equal(strncmp(PSK1, psk_buf, ARRAY_SIZE(psk_buf)), 0, "PSK mismatch");
	zassert_equal(psk_len, sizeof(PSK1), "PSK length mismatch");
	zassert_equal(strncmp(BSSID1, bssid_buf, ARRAY_SIZE(bssid_buf)), 0, "BSSID mismatch");
	zassert_equal(security, SECURITY1, "Security type mismatch");
	zassert_equal(flags, FLAGS1, "Flags mismatch");
	zassert_equal(channel, CHANNEL1, "Channel mismatch");

	err = wifi_credentials_get_by_ssid_personal(
		SSID2, sizeof(SSID2), &security, bssid_buf, ARRAY_SIZE(bssid_buf), psk_buf,
		ARRAY_SIZE(psk_buf), &psk_len, &flags, &channel, &timeout);
	zassert_equal(err, EXIT_SUCCESS, "Expected EXIT_SUCCESS, got %d", err);
	zassert_equal(security, SECURITY2, "Security type mismatch");
	zassert_equal(flags, FLAGS2, "Flags mismatch");
	zassert_equal(channel, CHANNEL2, "Channel mismatch");

	/* Set third network */
	err = wifi_credentials_set_personal(SSID3, sizeof(SSID3), SECURITY3, NULL, 6, PSK3,
					    sizeof(PSK3), FLAGS3, CHANNEL3, 0);
	zassert_equal(err, -ENOBUFS, "Expected -ENOBUFS, got %d", err);

	/* Not enough space? Delete the first one. */
	wifi_credentials_delete_by_ssid(SSID1, ARRAY_SIZE(SSID1));
	err = wifi_credentials_set_personal(SSID3, sizeof(SSID3), SECURITY3, NULL, 6, PSK3,
					    sizeof(PSK3), FLAGS3, CHANNEL3, 0);
	zassert_equal(err, EXIT_SUCCESS, "Expected EXIT_SUCCESS, got %d", err);

	err = wifi_credentials_get_by_ssid_personal(
		SSID3, sizeof(SSID3), &security, bssid_buf, ARRAY_SIZE(bssid_buf), psk_buf,
		ARRAY_SIZE(psk_buf), &psk_len, &flags, &channel, &timeout);
	zassert_equal(err, EXIT_SUCCESS, "Expected EXIT_SUCCESS, got %d", err);
	zassert_equal(security, SECURITY3, "Security type mismatch");
	zassert_equal(psk_len, sizeof(PSK3), "PSK length mismatch");
	zassert_equal(strncmp(PSK3, psk_buf, ARRAY_SIZE(psk_buf)), 0, "PSK mismatch");
	zassert_equal(flags, FLAGS3, "Flags mismatch");
	zassert_equal(channel, CHANNEL3, "Channel mismatch");

	wifi_credentials_for_each_ssid(verify_ssid_cache_cb, NULL);
}

/* Verify that all entries are deleted. */
ZTEST(wifi_credentials, test_delete_all_entries)
{
	/* Set two networks */
	int err = wifi_credentials_set_personal(SSID1, sizeof(SSID1), SECURITY1, BSSID1, 6, PSK1,
						sizeof(PSK1), FLAGS1, CHANNEL1, 0);
	zassert_equal(err, EXIT_SUCCESS, "Expected EXIT_SUCCESS, got %d", err);

	err = wifi_credentials_set_personal(SSID2, sizeof(SSID2), SECURITY2, NULL, 6, NULL, 0,
					    FLAGS2, CHANNEL2, 0);
	zassert_equal(err, EXIT_SUCCESS, "Expected EXIT_SUCCESS, got %d", err);

	/* Delete all networks */
	err = wifi_credentials_delete_all();
	zassert_equal(err, EXIT_SUCCESS, "Expected EXIT_SUCCESS, got %d", err);

	/* Verify that the storage is empty */
	zassert_true(wifi_credentials_is_empty(), "Storage is not empty");
}

static int custom_wifi_credentials_delete_entry_enoent(size_t idx)
{
	ARG_UNUSED(idx);

	return -ENOENT;
}

/* Verify that every slot is deleted, also the ones that are not cached, and that an empty
 * slot is not an error.
 */
ZTEST(wifi_credentials, test_delete_all_uncached_entries)
{
	wifi_credentials_delete_entry_fake.custom_fake =
		custom_wifi_credentials_delete_entry_enoent;

	zassert_ok(wifi_credentials_delete_all());
	zassert_equal(wifi_credentials_delete_entry_fake.call_count,
		      CONFIG_WIFI_CREDENTIALS_MAX_ENTRIES);
}

static int custom_wifi_credentials_delete_entry_first_fails(size_t idx)
{
	return idx == 0 ? -EIO : 0;
}

/* Verify that a failure to delete a slot does not prevent deleting the other slots. */
ZTEST(wifi_credentials, test_delete_all_failure)
{
	int err = wifi_credentials_set_personal(SSID2, sizeof(SSID2), SECURITY2, NULL, 6, NULL, 0,
						FLAGS2, CHANNEL2, 0);
	zassert_equal(err, EXIT_SUCCESS, "Expected EXIT_SUCCESS, got %d", err);

	wifi_credentials_delete_entry_fake.custom_fake =
		custom_wifi_credentials_delete_entry_first_fails;

	zassert_equal(wifi_credentials_delete_all(), -EIO);
	zassert_equal(wifi_credentials_delete_entry_fake.call_count,
		      CONFIG_WIFI_CREDENTIALS_MAX_ENTRIES);
	/* The entry in the slot that failed to be deleted is still cached. */
	zassert_false(wifi_credentials_is_empty());
}

/* Verify that no entry is stored in an unusable slot, and that a failure to delete it is not
 * an error.
 */
ZTEST(wifi_credentials, test_unusable_slot)
{
	int err;

	/* Load the entries before marking the slot, as the backend does when loading them. */
	zassert_true(wifi_credentials_is_empty());
	wifi_credentials_mark_unusable(0);

	err = wifi_credentials_set_personal(SSID1, sizeof(SSID1), SECURITY1, BSSID1, 6, PSK1,
					    sizeof(PSK1), FLAGS1, CHANNEL1, 0);
	zassert_equal(err, EXIT_SUCCESS, "Expected EXIT_SUCCESS, got %d", err);
	zassert_equal(wifi_credentials_store_entry_fake.arg0_val, 1, "Stored in unusable slot");

	err = wifi_credentials_set_personal(SSID2, sizeof(SSID2), SECURITY2, NULL, 6, NULL, 0,
					    FLAGS2, CHANNEL2, 0);
	zassert_equal(err, -ENOBUFS, "Expected -ENOBUFS, got %d", err);

	/* The unusable slot cannot be deleted, which is not an error. It stays unusable. */
	wifi_credentials_delete_entry_fake.custom_fake =
		custom_wifi_credentials_delete_entry_first_fails;
	zassert_ok(wifi_credentials_delete_all());
	zassert_true(wifi_credentials_is_empty());

	err = wifi_credentials_set_personal(SSID2, sizeof(SSID2), SECURITY2, NULL, 6, NULL, 0,
					    FLAGS2, CHANNEL2, 0);
	zassert_equal(err, EXIT_SUCCESS, "Expected EXIT_SUCCESS, got %d", err);
	zassert_equal(wifi_credentials_store_entry_fake.arg0_val, 1, "Stored in unusable slot");

	/* Once deleted, the slot can be used again. */
	RESET_FAKE(wifi_credentials_delete_entry);
	zassert_ok(wifi_credentials_delete_all());

	err = wifi_credentials_set_personal(SSID1, sizeof(SSID1), SECURITY1, BSSID1, 6, PSK1,
					    sizeof(PSK1), FLAGS1, CHANNEL1, 0);
	zassert_equal(err, EXIT_SUCCESS, "Expected EXIT_SUCCESS, got %d", err);
	zassert_equal(wifi_credentials_store_entry_fake.arg0_val, 0, "Slot not reused");
}

ZTEST_SUITE(wifi_credentials, NULL, NULL, wifi_credentials_setup, wifi_credentials_teardown, NULL);
```

## src/backend_psa.c
```c
/*
 * Copyright (c) 2026 Nordic Semiconductor ASA
 *
 * SPDX-License-Identifier: Apache-2.0
 */

#include <string.h>
#include <zephyr/ztest.h>
#include <zephyr/net/wifi_credentials.h>
#include <zephyr/psa/key_ids.h>
#include <psa/crypto.h>

#define SSID1 "test1"
#define PSK1  "super secret"
#define SSID2 "test2"
#define PSK2  "another secret"

static const uint8_t bssid1[WIFI_MAC_ADDR_LEN] = {0x00, 0x11, 0x22, 0x33, 0x44, 0x55};

/* Count the persistent keys in the Wi-Fi credentials key ID range. */
static size_t count_stored_keys(void)
{
	size_t count = 0;

	for (size_t i = 0; i < CONFIG_WIFI_CREDENTIALS_MAX_ENTRIES; i++) {
		psa_key_attributes_t attr = PSA_KEY_ATTRIBUTES_INIT;
		psa_status_t ret;

		ret = psa_get_key_attributes(ZEPHYR_PSA_WIFI_CREDENTIALS_KEY_ID_RANGE_BEGIN + i,
					     &attr);
		if (ret == PSA_SUCCESS) {
			zassert_equal(psa_get_key_lifetime(&attr), PSA_KEY_LIFETIME_PERSISTENT);
			count++;
		} else {
			zassert_equal(ret, PSA_ERROR_INVALID_HANDLE, "unexpected status %d", ret);
		}
		psa_reset_key_attributes(&attr);
	}

	return count;
}

static void before(void *fixture)
{
	ARG_UNUSED(fixture);

	zassert_ok(wifi_credentials_delete_all());
	zassert_true(wifi_credentials_is_empty());
	zassert_equal(count_stored_keys(), 0);
}

ZTEST_SUITE(wifi_credentials_backend_psa, NULL, NULL, before, NULL, NULL);

ZTEST(wifi_credentials_backend_psa, test_set_get)
{
	enum wifi_security_type type;
	uint8_t bssid[WIFI_MAC_ADDR_LEN];
	char password[WIFI_CREDENTIALS_MAX_PASSWORD_LEN];
	size_t password_len;
	uint32_t flags;
	uint8_t channel;
	uint32_t timeout;

	zassert_ok(wifi_credentials_set_personal(SSID1, strlen(SSID1), WIFI_SECURITY_TYPE_PSK,
						 bssid1, sizeof(bssid1), PSK1, strlen(PSK1),
						 WIFI_CREDENTIALS_FLAG_BSSID, 6, 10));
	zassert_false(wifi_credentials_is_empty());
	zassert_equal(count_stored_keys(), 1);

	zassert_ok(wifi_credentials_get_by_ssid_personal(SSID1, strlen(SSID1), &type, bssid,
							 sizeof(bssid), password,
							 sizeof(password), &password_len, &flags,
							 &channel, &timeout));
	zassert_equal(type, WIFI_SECURITY_TYPE_PSK);
	zassert_mem_equal(bssid, bssid1, sizeof(bssid1));
	zassert_equal(password_len, strlen(PSK1));
	zassert_mem_equal(password, PSK1, password_len);
	zassert_equal(flags, WIFI_CREDENTIALS_FLAG_BSSID);
	zassert_equal(channel, 6);
	zassert_equal(timeout, 10);
}

/* An entry with the longest SSID and password must fit in the storage. */
ZTEST(wifi_credentials_backend_psa, test_set_get_max_length)
{
	char ssid[WIFI_SSID_MAX_LEN];
	char password[WIFI_CREDENTIALS_MAX_PASSWORD_LEN];
	struct wifi_credentials_personal creds;

	memset(ssid, 's', sizeof(ssid));
	memset(password, 'p', sizeof(password));

	zassert_ok(wifi_credentials_set_personal(ssid, sizeof(ssid), WIFI_SECURITY_TYPE_SAE,
						 bssid1, sizeof(bssid1), password,
						 sizeof(password), WIFI_CREDENTIALS_FLAG_BSSID, 6,
						 10));
	zassert_equal(count_stored_keys(), 1);

	zassert_ok(wifi_credentials_get_by_ssid_personal_struct(ssid, sizeof(ssid), &creds));
	zassert_equal(creds.header.type, WIFI_SECURITY_TYPE_SAE);
	zassert_equal(creds.password_len, sizeof(password));
	zassert_mem_equal(creds.password, password, sizeof(password));
}

ZTEST(wifi_credentials_backend_psa, test_overwrite)
{
	struct wifi_credentials_personal creds;

	zassert_ok(wifi_credentials_set_personal(SSID1, strlen(SSID1), WIFI_SECURITY_TYPE_PSK,
						 NULL, 0, PSK1, strlen(PSK1), 0, 0, 0));
	zassert_ok(wifi_credentials_set_personal(SSID1, strlen(SSID1), WIFI_SECURITY_TYPE_PSK,
						 NULL, 0, PSK2, strlen(PSK2), 0, 0, 0));
	zassert_equal(count_stored_keys(), 1);

	zassert_ok(wifi_credentials_get_by_ssid_personal_struct(SSID1, strlen(SSID1), &creds));
	zassert_equal(creds.password_len, strlen(PSK2));
	zassert_mem_equal(creds.password, PSK2, creds.password_len);
}

ZTEST(wifi_credentials_backend_psa, test_delete)
{
	struct wifi_credentials_personal creds;

	zassert_ok(wifi_credentials_set_personal(SSID1, strlen(SSID1), WIFI_SECURITY_TYPE_PSK,
						 NULL, 0, PSK1, strlen(PSK1), 0, 0, 0));
	zassert_ok(wifi_credentials_set_personal(SSID2, strlen(SSID2), WIFI_SECURITY_TYPE_NONE,
						 NULL, 0, NULL, 0, 0, 0, 0));
	zassert_equal(count_stored_keys(), 2);

	zassert_ok(wifi_credentials_delete_by_ssid(SSID1, strlen(SSID1)));
	zassert_equal(count_stored_keys(), 1);
	zassert_equal(wifi_credentials_get_by_ssid_personal_struct(SSID1, strlen(SSID1), &creds),
		      -ENOENT);
	zassert_ok(wifi_credentials_get_by_ssid_personal_struct(SSID2, strlen(SSID2), &creds));

	zassert_ok(wifi_credentials_delete_by_ssid(SSID2, strlen(SSID2)));
	zassert_equal(count_stored_keys(), 0);
	zassert_true(wifi_credentials_is_empty());
}
```

## src/backend_psa_ps.c
```c
/*
 * Copyright (c) 2026 Nordic Semiconductor ASA
 *
 * SPDX-License-Identifier: Apache-2.0
 */

#include <string.h>
#include <zephyr/ztest.h>
#include <zephyr/net/wifi_credentials.h>
#include <zephyr/psa/ps_ids.h>
#include <psa/protected_storage.h>
#ifdef CONFIG_SECURE_STORAGE
#include <zephyr/secure_storage/its/store.h>
#endif

#define SSID1 "test1"
#define PSK1  "super secret"
#define SSID2 "test2"
#define PSK2  "another secret"
#define SSID_STORED "stored before first use"
#define PSK_STORED  "stored secret"

/* The entries stored before first use need two slots, and a third one for the corrupt entry
 * with the secure storage subsystem.
 */
BUILD_ASSERT(CONFIG_WIFI_CREDENTIALS_MAX_ENTRIES >= (IS_ENABLED(CONFIG_SECURE_STORAGE) ? 3 : 2));

static const uint8_t bssid1[WIFI_MAC_ADDR_LEN] = {0x00, 0x11, 0x22, 0x33, 0x44, 0x55};

/* Count the entries in the Wi-Fi credentials PS UID range. */
static size_t count_stored_entries(void)
{
	size_t count = 0;

	for (size_t i = 0; i < CONFIG_WIFI_CREDENTIALS_MAX_ENTRIES; i++) {
		struct psa_storage_info_t info;
		psa_status_t ret;

		ret = psa_ps_get_info(ZEPHYR_PSA_WIFI_CREDENTIALS_PS_UID_RANGE_BEGIN + i, &info);
		if (ret == PSA_SUCCESS) {
			zassert_equal(info.size, sizeof(struct wifi_credentials_personal));
			count++;
		} else {
			zassert_equal(ret, PSA_ERROR_DOES_NOT_EXIST, "unexpected status %d", ret);
		}
	}

	return count;
}

static psa_status_t stored_set_status = PSA_ERROR_GENERIC_ERROR;
static psa_status_t wrong_size_set_status = PSA_ERROR_GENERIC_ERROR;
static psa_status_t wrong_size_info_status = PSA_ERROR_GENERIC_ERROR;
static size_t wrong_size_slot_size;
static psa_status_t corrupt_info_status = PSA_ERROR_GENERIC_ERROR;
static int first_use_set_ret = -EINPROGRESS;
static int stored_lookup_ret = -EINPROGRESS;

static void *setup(void)
{
	struct wifi_credentials_personal creds = {
		.header = {
			.type = WIFI_SECURITY_TYPE_PSK,
			.ssid = SSID_STORED,
			.ssid_len = strlen(SSID_STORED),
		},
		.password = PSK_STORED,
		.password_len = strlen(PSK_STORED),
	};
	struct psa_storage_info_t info;

	/* Store an entry before the library is used, as if it was stored before a reboot. */
	stored_set_status = psa_ps_set(ZEPHYR_PSA_WIFI_CREDENTIALS_PS_UID_RANGE_BEGIN,
				       sizeof(creds), &creds, PSA_STORAGE_FLAG_NONE);

	/* Store an entry whose size does not match, as if it was stored with another
	 * configuration. It must be skipped, without preventing the use of the library.
	 */
	wrong_size_set_status = psa_ps_set(ZEPHYR_PSA_WIFI_CREDENTIALS_PS_UID_RANGE_BEGIN + 1,
					   sizeof(creds) / 2, &creds, PSA_STORAGE_FLAG_NONE);

#ifdef CONFIG_SECURE_STORAGE
	/* Store data that fails authentication, as if the entry was corrupted in flash. It must
	 * be skipped, without preventing the use of the library, and be deleted by
	 * wifi_credentials_delete_all() in before().
	 */
	static const uint8_t garbage[sizeof(creds)] = {0xff};
	const secure_storage_its_uid_t corrupt_uid = {
		.uid = ZEPHYR_PSA_WIFI_CREDENTIALS_PS_UID_RANGE_BEGIN + 2,
		.caller_id = SECURE_STORAGE_ITS_CALLER_PSA_PS,
	};

	if (secure_storage_its_store_set(corrupt_uid, sizeof(garbage), garbage) == PSA_SUCCESS) {
		corrupt_info_status = psa_ps_get_info(corrupt_uid.uid, &info);
	}
#endif

	/* The first use of the library stores another entry, which must not overwrite it.
	 * This is done before before() deletes all entries.
	 */
	first_use_set_ret = wifi_credentials_set_personal(SSID1, strlen(SSID1),
							  WIFI_SECURITY_TYPE_PSK, NULL, 0, PSK1,
							  strlen(PSK1), 0, 0, 0);

	/* The first stored entry must replace the skipped one. */
	wrong_size_info_status = psa_ps_get_info(ZEPHYR_PSA_WIFI_CREDENTIALS_PS_UID_RANGE_BEGIN + 1,
						 &info);
	wrong_size_slot_size = info.size;

	memset(&creds, 0, sizeof(creds));
	stored_lookup_ret = wifi_credentials_get_by_ssid_personal_struct(SSID_STORED,
									 strlen(SSID_STORED),
									 &creds);
	if (stored_lookup_ret == 0 && (creds.password_len != strlen(PSK_STORED) ||
				       memcmp(creds.password, PSK_STORED,
					      creds.password_len) != 0)) {
		stored_lookup_ret = -EBADMSG;
	}

	return NULL;
}

static void before(void *fixture)
{
	ARG_UNUSED(fixture);

	zassert_ok(wifi_credentials_delete_all());
	zassert_true(wifi_credentials_is_empty());
	zassert_equal(count_stored_entries(), 0);
}

ZTEST_SUITE(wifi_credentials_backend_psa_ps, NULL, setup, before, NULL, NULL);

/* Entries stored before the library is used must be loaded on first use. */
ZTEST(wifi_credentials_backend_psa_ps, test_load_on_first_use)
{
	zassert_equal(stored_set_status, PSA_SUCCESS);
	zassert_ok(first_use_set_ret);
	zassert_ok(stored_lookup_ret);
}

/* An entry whose size does not match must be skipped and its slot reused. */
ZTEST(wifi_credentials_backend_psa_ps, test_skip_wrong_size)
{
	zassert_equal(wrong_size_set_status, PSA_SUCCESS);
	zassert_ok(first_use_set_ret);
	zassert_equal(wrong_size_info_status, PSA_SUCCESS);
	zassert_equal(wrong_size_slot_size, sizeof(struct wifi_credentials_personal));
}

/* A corrupt entry must be skipped on first use. before() checks that it is deleted. */
ZTEST(wifi_credentials_backend_psa_ps, test_skip_corrupt)
{
	Z_TEST_SKIP_IFNDEF(CONFIG_SECURE_STORAGE);

	zassert_true(corrupt_info_status == PSA_ERROR_INVALID_SIGNATURE ||
		     corrupt_info_status == PSA_ERROR_DATA_CORRUPT,
		     "unexpected status %d", corrupt_info_status);
	zassert_ok(first_use_set_ret);
	zassert_ok(stored_lookup_ret);
}

/* Entries that are not cached, like a skipped entry, must also be deleted. */
ZTEST(wifi_credentials_backend_psa_ps, test_delete_all_uncached)
{
	struct wifi_credentials_personal creds = {0};
	struct psa_storage_info_t info;

	zassert_equal(psa_ps_set(ZEPHYR_PSA_WIFI_CREDENTIALS_PS_UID_RANGE_BEGIN, sizeof(creds) / 2,
				 &creds, PSA_STORAGE_FLAG_NONE),
		      PSA_SUCCESS);
	zassert_true(wifi_credentials_is_empty());

	zassert_ok(wifi_credentials_delete_all());
	zassert_equal(psa_ps_get_info(ZEPHYR_PSA_WIFI_CREDENTIALS_PS_UID_RANGE_BEGIN, &info),
		      PSA_ERROR_DOES_NOT_EXIST);
}

ZTEST(wifi_credentials_backend_psa_ps, test_set_get)
{
	enum wifi_security_type type;
	uint8_t bssid[WIFI_MAC_ADDR_LEN];
	char password[WIFI_CREDENTIALS_MAX_PASSWORD_LEN];
	size_t password_len;
	uint32_t flags;
	uint8_t channel;
	uint32_t timeout;

	zassert_ok(wifi_credentials_set_personal(SSID1, strlen(SSID1), WIFI_SECURITY_TYPE_PSK,
						 bssid1, sizeof(bssid1), PSK1, strlen(PSK1),
						 WIFI_CREDENTIALS_FLAG_BSSID, 6, 10));
	zassert_false(wifi_credentials_is_empty());
	zassert_equal(count_stored_entries(), 1);

	zassert_ok(wifi_credentials_get_by_ssid_personal(SSID1, strlen(SSID1), &type, bssid,
							 sizeof(bssid), password,
							 sizeof(password), &password_len, &flags,
							 &channel, &timeout));
	zassert_equal(type, WIFI_SECURITY_TYPE_PSK);
	zassert_mem_equal(bssid, bssid1, sizeof(bssid1));
	zassert_equal(password_len, strlen(PSK1));
	zassert_mem_equal(password, PSK1, password_len);
	zassert_equal(flags, WIFI_CREDENTIALS_FLAG_BSSID);
	zassert_equal(channel, 6);
	zassert_equal(timeout, 10);
}

/* An entry with the longest SSID and password must fit in the storage. */
ZTEST(wifi_credentials_backend_psa_ps, test_set_get_max_length)
{
	char ssid[WIFI_SSID_MAX_LEN];
	char password[WIFI_CREDENTIALS_MAX_PASSWORD_LEN];
	struct wifi_credentials_personal creds;

	memset(ssid, 's', sizeof(ssid));
	memset(password, 'p', sizeof(password));

	zassert_ok(wifi_credentials_set_personal(ssid, sizeof(ssid), WIFI_SECURITY_TYPE_SAE,
						 bssid1, sizeof(bssid1), password,
						 sizeof(password), WIFI_CREDENTIALS_FLAG_BSSID, 6,
						 10));
	zassert_equal(count_stored_entries(), 1);

	zassert_ok(wifi_credentials_get_by_ssid_personal_struct(ssid, sizeof(ssid), &creds));
	zassert_equal(creds.header.type, WIFI_SECURITY_TYPE_SAE);
	zassert_equal(creds.password_len, sizeof(password));
	zassert_mem_equal(creds.password, password, sizeof(password));
}

ZTEST(wifi_credentials_backend_psa_ps, test_overwrite)
{
	struct wifi_credentials_personal creds;

	zassert_ok(wifi_credentials_set_personal(SSID1, strlen(SSID1), WIFI_SECURITY_TYPE_PSK,
						 NULL, 0, PSK1, strlen(PSK1), 0, 0, 0));
	zassert_ok(wifi_credentials_set_personal(SSID1, strlen(SSID1), WIFI_SECURITY_TYPE_PSK,
						 NULL, 0, PSK2, strlen(PSK2), 0, 0, 0));
	zassert_equal(count_stored_entries(), 1);

	zassert_ok(wifi_credentials_get_by_ssid_personal_struct(SSID1, strlen(SSID1), &creds));
	zassert_equal(creds.password_len, strlen(PSK2));
	zassert_mem_equal(creds.password, PSK2, creds.password_len);
}

ZTEST(wifi_credentials_backend_psa_ps, test_delete)
{
	struct wifi_credentials_personal creds;

	zassert_ok(wifi_credentials_set_personal(SSID1, strlen(SSID1), WIFI_SECURITY_TYPE_PSK,
						 NULL, 0, PSK1, strlen(PSK1), 0, 0, 0));
	zassert_ok(wifi_credentials_set_personal(SSID2, strlen(SSID2), WIFI_SECURITY_TYPE_NONE,
						 NULL, 0, NULL, 0, 0, 0, 0));
	zassert_equal(count_stored_entries(), 2);

	zassert_ok(wifi_credentials_delete_by_ssid(SSID1, strlen(SSID1)));
	zassert_equal(count_stored_entries(), 1);
	zassert_equal(wifi_credentials_get_by_ssid_personal_struct(SSID1, strlen(SSID1), &creds),
		      -ENOENT);
	zassert_ok(wifi_credentials_get_by_ssid_personal_struct(SSID2, strlen(SSID2), &creds));

	zassert_ok(wifi_credentials_delete_by_ssid(SSID2, strlen(SSID2)));
	zassert_equal(count_stored_entries(), 0);
	zassert_true(wifi_credentials_is_empty());
}
```
