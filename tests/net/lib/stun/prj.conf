## CMakeLists.txt
```
# SPDX-FileCopyrightText: Copyright The Zephyr Project Contributors
# SPDX-FileCopyrightText: Copyright (c) 2026 Kirill Shypachov
# SPDX-License-Identifier: Apache-2.0

cmake_minimum_required(VERSION 3.28.0)
find_package(Zephyr REQUIRED HINTS $ENV{ZEPHYR_BASE})
project(stun)

target_sources(app PRIVATE
  src/main.c
)
```

## prj.conf
```kconfig
# SPDX-FileCopyrightText: Copyright The Zephyr Project Contributors
# SPDX-FileCopyrightText: Copyright (c) 2026 Kirill Shypachov
# SPDX-License-Identifier: Apache-2.0

CONFIG_ZTEST=y
# The tests keep whole messages on the stack: a test and the helper it calls
# hold a 1200-byte buffer each, and the HMAC runs under them. About 4 KB at
# the deepest.
CONFIG_ZTEST_STACK_SIZE=8192
# Zephyr calls psa_crypto_init() at boot on the main thread. On a board without
# an entropy driver Mbed TLS seeds its random generator there, and the default
# stack is too small for that.
CONFIG_MAIN_STACK_SIZE=2048

# The library is a network library, but it needs no interface and no driver.
CONFIG_NETWORKING=y
CONFIG_NET_TEST=y
CONFIG_NET_L2_ETHERNET=n
CONFIG_NET_IPV4=y
CONFIG_NET_IPV6=y

# Nothing else is asked for: the library enables the PSA algorithms and the
# CRC it needs.
CONFIG_STUN=y
# But for MD5, which the key of a long-term credential takes.
CONFIG_PSA_WANT_ALG_MD5=y

# The Binding transaction comes with the client, which takes sockets and UDP.
CONFIG_NET_SOCKETS=y
CONFIG_NET_UDP=y
CONFIG_STUN_CLIENT=y
```

## src/address.c
```c
/*
 * SPDX-FileCopyrightText: Copyright The Zephyr Project Contributors
 * SPDX-FileCopyrightText: Copyright (c) 2026 Kirill Shypachov
 * SPDX-License-Identifier: Apache-2.0
 *
 * XOR-MAPPED-ADDRESS and the attributes that share its format (RFC 8489 §14.2),
 * for IPv4 and IPv6.
 */
#include <errno.h>

#include "stun_test.h"

/* XOR-PEER-ADDRESS of TURN: the same format, a type the codec does not know. */
#define ATTR_XOR_PEER_ADDRESS 0x0012U

/* 2001:db8:1234:5678:11:2233:4455:6677, the address of RFC 5769 §2.3. */
static const uint8_t kV6Rfc[16] __maybe_unused = {0x20, 0x01, 0x0d, 0xb8, 0x12, 0x34, 0x56, 0x78,
						  0x00, 0x11, 0x22, 0x33, 0x44, 0x55, 0x66, 0x77};

/* 2001:db8::1:2, the address of the kV6Response vector. */
static const uint8_t kV6Gen[16] __maybe_unused = {0x20, 0x01, 0x0d, 0xb8, 0x00, 0x00, 0x00, 0x00,
						  0x00, 0x00, 0x00, 0x00, 0x00, 0x01, 0x00, 0x02};

ZTEST(stun, test_xor_mapped_address_ipv4)
{
	struct net_sockaddr addr;
	struct stun_msg m;

	zassert_ok(stun_parse(kResponse, sizeof(kResponse), &m));
	zassert_ok(stun_get_xor_mapped_address(kResponse, sizeof(kResponse), &m, &addr));
	zassert_true(sa_is_v4(&addr, 192, 0, 2, 1, 32853), "expected 192.0.2.1 port 32853");
}

ZTEST(stun, test_xor_mapped_address_ipv6)
{
	struct net_sockaddr addr;
	struct stun_msg m;
	int rc;

	/* A well-formed message whatever the IP stack is built with. */
	zassert_ok(stun_parse(kResponseV6, sizeof(kResponseV6), &m));
	rc = stun_get_xor_mapped_address(kResponseV6, sizeof(kResponseV6), &m, &addr);
#if defined(CONFIG_NET_IPV6)
	zassert_ok(rc);
	zassert_true(sa_is_v6(&addr, kV6Rfc, 32853),
		     "expected 2001:db8:1234:5678:11:2233:4455:6677 port 32853");
#else
	zassert_equal(rc, -EAFNOSUPPORT, "an IPv6 address without the IPv6 stack");
#endif
}

/* Build a response that carries one address attribute, parse it, read it back. */
static void roundtrip(uint16_t type, const struct net_sockaddr *in, struct net_sockaddr *out)
{
	struct stun_builder b;
	struct stun_msg m;
	uint8_t msg[64];
	uint8_t txid[STUN_TXID_SIZE];
	int len;

	fill_txid(txid, 0x90);
	stun_builder_init(&b, msg, sizeof(msg), STUN_BINDING_SUCCESS_RESPONSE, txid);
	zassert_ok(stun_add_xor_address(&b, type, in));
	len = stun_builder_len(&b);
	zassert_true(len > 0);
	zassert_ok(stun_parse(msg, (size_t)len, &m));
	zassert_ok(stun_get_xor_address(msg, (size_t)len, &m, type, out));
}

ZTEST(stun, test_xor_address_roundtrip)
{
	static const uint16_t kTypes[] = {STUN_ATTR_XOR_MAPPED_ADDRESS, ATTR_XOR_PEER_ADDRESS};
	struct net_sockaddr in, out;

	for (size_t i = 0; i < ARRAY_SIZE(kTypes); i++) {
		sa_v4(&in, 203, 0, 113, 7, 1);
		roundtrip(kTypes[i], &in, &out);
		zassert_true(sa_is_v4(&out, 203, 0, 113, 7, 1), "type 0x%04x", kTypes[i]);

		sa_v4(&in, 255, 255, 255, 255, 65535);
		roundtrip(kTypes[i], &in, &out);
		zassert_true(sa_is_v4(&out, 255, 255, 255, 255, 65535), "type 0x%04x", kTypes[i]);

#if defined(CONFIG_NET_IPV6)
		sa_v6(&in, kV6Gen, 50000);
		roundtrip(kTypes[i], &in, &out);
		zassert_true(sa_is_v6(&out, kV6Gen, 50000), "type 0x%04x", kTypes[i]);

		sa_v6(&in, kV6Rfc, 1);
		roundtrip(kTypes[i], &in, &out);
		zassert_true(sa_is_v6(&out, kV6Rfc, 1), "type 0x%04x", kTypes[i]);
#endif
	}
}

ZTEST(stun, test_xor_mapped_address_ipv6_byte_exact)
{
#if defined(CONFIG_NET_IPV6)
	struct net_sockaddr addr;
	struct stun_builder b;
	uint8_t msg[128];
	uint8_t txid[STUN_TXID_SIZE];
	int len;

	/* Against the independent encoder: the address is XORed with the magic
	 * cookie and the transaction id (RFC 8489 §14.2).
	 */
	ensure_psa();
	fill_txid(txid, 0xB0);
	stun_builder_init(&b, msg, sizeof(msg), STUN_BINDING_SUCCESS_RESPONSE, txid);
	sa_v6(&addr, kV6Gen, 50000);
	zassert_ok(stun_add_xor_mapped_address(&b, &addr));
	len = stun_finish(&b, (const uint8_t *)kBaselinePwd, strlen(kBaselinePwd));
	zassert_equal(len, (int)sizeof(kV6Response), "length %d", len);
	zassert_mem_equal(msg, kV6Response, sizeof(kV6Response));
#else
	ztest_test_skip();
#endif
}

ZTEST(stun, test_xor_address_absent_and_bad_arguments)
{
	struct net_sockaddr addr;
	struct stun_builder b;
	struct raw_msg r;
	struct stun_msg m;
	uint8_t msg[64];
	uint8_t txid[STUN_TXID_SIZE];

	raw_init(&r, STUN_BINDING_SUCCESS_RESPONSE, 0x91);
	zassert_ok(stun_parse(r.buf, r.len, &m));
	zassert_equal(stun_get_xor_mapped_address(r.buf, r.len, &m, &addr), -ENOENT);
	zassert_equal(stun_get_xor_address(r.buf, r.len, &m, ATTR_XOR_PEER_ADDRESS, &addr),
		      -ENOENT);

	zassert_equal(stun_get_xor_mapped_address(r.buf, r.len, &m, NULL), -EINVAL);
	zassert_equal(stun_get_xor_mapped_address(NULL, r.len, &m, &addr), -EINVAL);
	zassert_equal(stun_get_xor_mapped_address(r.buf, r.len, NULL, &addr), -EINVAL);

	fill_txid(txid, 0x92);
	stun_builder_init(&b, msg, sizeof(msg), STUN_BINDING_SUCCESS_RESPONSE, txid);
	sa_v4(&addr, 192, 0, 2, 1, 3478);
	zassert_equal(stun_add_xor_mapped_address(&b, NULL), -EINVAL);
	zassert_equal(stun_add_xor_mapped_address(NULL, &addr), -EINVAL);
	zassert_equal(stun_add_xor_address(&b, STUN_ATTR_FINGERPRINT, &addr), -EINVAL,
		      "FINGERPRINT is not an address attribute");
	zassert_equal(b.err, 0, "a refused argument must not poison the builder");
	zassert_equal(stun_builder_len(&b), STUN_HEADER_SIZE, "and must not write anything");
}

ZTEST(stun, test_xor_address_unsupported_family)
{
	struct net_sockaddr addr;
	struct stun_builder b;
	uint8_t msg[64];
	uint8_t txid[STUN_TXID_SIZE];

	fill_txid(txid, 0x93);
	stun_builder_init(&b, msg, sizeof(msg), STUN_BINDING_SUCCESS_RESPONSE, txid);

	sa_v4(&addr, 192, 0, 2, 1, 3478);
	net_sin(&addr)->sin_family = NET_AF_UNSPEC;
	zassert_equal(stun_add_xor_mapped_address(&b, &addr), -EAFNOSUPPORT);
	zassert_equal(b.err, 0);
	zassert_equal(stun_builder_len(&b), STUN_HEADER_SIZE);

#if !defined(CONFIG_NET_IPV6)
	{
		/* Bigger than struct net_sockaddr in this build: only its family
		 * may be looked at.
		 */
		struct net_sockaddr_in6 sin6 = {.sin6_family = NET_AF_INET6};

		zassert_equal(stun_add_xor_mapped_address(&b, (struct net_sockaddr *)&sin6),
			      -EAFNOSUPPORT, "IPv6 without the IPv6 stack");
		zassert_equal(b.err, 0);
		zassert_equal(stun_builder_len(&b), STUN_HEADER_SIZE);
	}
#endif

	/* The builder is still usable. */
	sa_v4(&addr, 192, 0, 2, 1, 3478);
	zassert_ok(stun_add_xor_mapped_address(&b, &addr));
	zassert_equal(stun_builder_len(&b), STUN_HEADER_SIZE + 12);
}

ZTEST(stun, test_xor_address_of_an_extension_is_checked_by_the_getter)
{
	static const uint8_t kFamily3[8] = {0x00, 0x03};
	static const uint8_t kV4In20[20] = {0x00, 0x01};
	static const uint8_t kShort[7] = {0x00, 0x01};
	struct net_sockaddr addr;
	struct raw_msg r;
	struct stun_msg m;

	/* The parser cannot judge an attribute it does not know; whoever reads
	 * it as an address gets the verdict.
	 */
	raw_init(&r, STUN_BINDING_SUCCESS_RESPONSE, 0x94);
	raw_attr(&r, ATTR_XOR_PEER_ADDRESS, sizeof(kFamily3), kFamily3, sizeof(kFamily3));
	zassert_ok(stun_parse(r.buf, r.len, &m));
	zassert_equal(stun_get_xor_address(r.buf, r.len, &m, ATTR_XOR_PEER_ADDRESS, &addr),
		      -EBADMSG, "address family 3");

	raw_init(&r, STUN_BINDING_SUCCESS_RESPONSE, 0x95);
	raw_attr(&r, ATTR_XOR_PEER_ADDRESS, sizeof(kV4In20), kV4In20, sizeof(kV4In20));
	zassert_ok(stun_parse(r.buf, r.len, &m));
	zassert_equal(stun_get_xor_address(r.buf, r.len, &m, ATTR_XOR_PEER_ADDRESS, &addr),
		      -EBADMSG, "IPv4 in 20 bytes");

	raw_init(&r, STUN_BINDING_SUCCESS_RESPONSE, 0x96);
	raw_attr(&r, ATTR_XOR_PEER_ADDRESS, sizeof(kShort), kShort, sizeof(kShort));
	zassert_ok(stun_parse(r.buf, r.len, &m));
	zassert_equal(stun_get_xor_address(r.buf, r.len, &m, ATTR_XOR_PEER_ADDRESS, &addr),
		      -EBADMSG, "address of 7 bytes");
}
```

## src/builder.c
```c
/*
 * SPDX-FileCopyrightText: Copyright The Zephyr Project Contributors
 * SPDX-FileCopyrightText: Copyright (c) 2026 Kirill Shypachov
 * SPDX-License-Identifier: Apache-2.0
 *
 * The message builder: generic attributes, the closing attributes and their
 * order, the limits RFC 8489 puts on what is sent, and what an error leaves
 * behind.
 */
#include <errno.h>

#include "stun_test.h"

#define CHECK_KEY     ((const uint8_t *)kCheckPwd)
#define CHECK_KEY_LEN (sizeof(kCheckPwd) - 1U)

/* A type no RFC assigns. */
#define ATTR_PRIVATE 0x7F10U

/* Longer than any key the PSA key store takes: importing it fails. */
static uint8_t huge_key[9000];

/* Room for the longest strings the tests build, and a message to hold them. */
static char text[4U * (STUN_TEXT_MAX_CHARS + 2U)];
static uint8_t big_msg[1024];

static void start(struct stun_builder *b, uint8_t *buf, size_t cap, uint16_t type, uint8_t txid0)
{
	uint8_t txid[STUN_TXID_SIZE];

	fill_txid(txid, txid0);
	stun_builder_init(b, buf, cap, type, txid);
}

/* The USERNAME and PRIORITY of the reference vectors. */
static void add_check_head(struct stun_builder *b)
{
	zassert_ok(stun_add_username(b, CHECK_USERNAME));
	zassert_ok(stun_add_priority(b, 0x6E0001FFU));
}

/* `n` characters of `utf8` (one character, 1 to 4 bytes) into text[]. */
static const char *repeat(const char *utf8, size_t n)
{
	size_t clen = strlen(utf8);

	zassert_true(n * clen < sizeof(text));
	for (size_t i = 0; i < n; i++) {
		memcpy(text + i * clen, utf8, clen);
	}
	text[n * clen] = '\0';
	return text;
}

ZTEST(stun, test_add_attr)
{
	static const uint8_t kVal[5] = {0xA1, 0xA2, 0xA3, 0xA4, 0xA5};
	struct stun_builder b;
	uint8_t msg[64];

	for (size_t vlen = 0; vlen <= sizeof(kVal); vlen++) {
		size_t padded = (vlen + 3U) & ~3U;

		memset(msg, 0xFF, sizeof(msg));
		start(&b, msg, sizeof(msg), STUN_BINDING_REQUEST, 0x70);
		zassert_ok(stun_add_attr(&b, ATTR_PRIVATE, kVal, vlen), "length %zu", vlen);
		zassert_equal(stun_builder_len(&b), (int)(STUN_HEADER_SIZE + 4U + padded));

		/* type, length without padding, value, zero padding */
		zassert_equal(msg[20], ATTR_PRIVATE >> 8);
		zassert_equal(msg[21], ATTR_PRIVATE & 0xFFU);
		zassert_equal(msg[22], 0);
		zassert_equal(msg[23], vlen);
		zassert_mem_equal(msg + 24, kVal, vlen);
		for (size_t i = vlen; i < padded; i++) {
			zassert_equal(msg[24 + i], 0, "padding byte %zu of length %zu", i, vlen);
		}
		/* the header counts it */
		zassert_equal(msg[2], 0);
		zassert_equal(msg[3], 4U + padded);
		zassert_true(stun_is_message(msg, STUN_HEADER_SIZE + 4U + padded));
	}

	/* What does not fit an attribute, or is not for this function. */
	start(&b, msg, sizeof(msg), STUN_BINDING_REQUEST, 0x71);
	zassert_equal(stun_add_attr(&b, ATTR_PRIVATE, kVal, 65536), -EINVAL);
	zassert_equal(stun_add_attr(&b, ATTR_PRIVATE, NULL, 4), -EINVAL);
	zassert_equal(stun_add_attr(&b, STUN_ATTR_MESSAGE_INTEGRITY, kVal, 4), -EINVAL);
	zassert_equal(stun_add_attr(&b, STUN_ATTR_MESSAGE_INTEGRITY_SHA256, kVal, 4), -EINVAL);
	zassert_equal(stun_add_attr(&b, STUN_ATTR_FINGERPRINT, kVal, 4), -EINVAL);
	zassert_equal(stun_add_attr(NULL, ATTR_PRIVATE, kVal, 4), -EINVAL);
	zassert_equal(b.err, 0, "a refused argument must not poison the builder");
	zassert_equal(stun_builder_len(&b), STUN_HEADER_SIZE, "and must not write anything");
	zassert_ok(stun_add_attr(&b, ATTR_PRIVATE, NULL, 0));
}

ZTEST(stun, test_builder_len)
{
	struct stun_builder b;
	uint8_t msg[64];
	int len;

	start(&b, msg, sizeof(msg), STUN_BINDING_REQUEST, 0x72);
	zassert_equal(stun_builder_len(&b), STUN_HEADER_SIZE);
	zassert_ok(stun_add_priority(&b, 1));
	zassert_equal(stun_builder_len(&b), STUN_HEADER_SIZE + 8);
	zassert_equal(stun_builder_len(&b), STUN_HEADER_SIZE + 8, "asking twice changes nothing");

	len = stun_finish_plain(&b);
	zassert_equal(len, STUN_HEADER_SIZE + 8 + 8);
	zassert_equal(stun_builder_len(&b), len);

	zassert_equal(stun_builder_len(NULL), -EINVAL);

	/* The error an overflow left behind. */
	start(&b, msg, STUN_HEADER_SIZE + 4U, STUN_BINDING_REQUEST, 0x73);
	zassert_equal(stun_add_priority(&b, 1), -EMSGSIZE);
	zassert_equal(stun_builder_len(&b), -EMSGSIZE);
}

/* A call out of order: -EPERM, and neither the message nor the builder changes. */
#define EXPECT_EPERM(call)                                                                         \
	do {                                                                                       \
		uint8_t before_[sizeof(msg)];                                                      \
		int len_ = stun_builder_len(&b);                                                   \
                                                                                                   \
		memcpy(before_, msg, sizeof(msg));                                                 \
		zassert_equal(call, -EPERM, #call);                                                \
		zassert_equal(b.err, 0, #call " must not poison the builder");                     \
		zassert_equal(stun_builder_len(&b), len_, #call " must not change the length");    \
		zassert_mem_equal(msg, before_, sizeof(msg), #call " must not touch the message"); \
	} while (false)

ZTEST(stun, test_closing_attributes_order)
{
	struct net_sockaddr addr;
	struct stun_builder b;
	struct stun_msg m;
	uint8_t msg[192];
	int len;

	ensure_psa();
	sa_v4(&addr, 192, 0, 2, 1, 3478);

	/* RFC 8489 §9, §14.7: MESSAGE-INTEGRITY, then MESSAGE-INTEGRITY-SHA256,
	 * then FINGERPRINT, and nothing else from the first of them on.
	 */
	start(&b, msg, sizeof(msg), STUN_BINDING_REQUEST, 0x74);
	add_check_head(&b);
	zassert_ok(stun_add_integrity(&b, CHECK_KEY, CHECK_KEY_LEN));

	EXPECT_EPERM(stun_add_priority(&b, 1));
	EXPECT_EPERM(stun_add_use_candidate(&b));
	EXPECT_EPERM(stun_add_username(&b, "late"));
	EXPECT_EPERM(stun_add_software(&b, "late"));
	EXPECT_EPERM(stun_add_error_code(&b, 400, NULL));
	EXPECT_EPERM(stun_add_xor_mapped_address(&b, &addr));
	EXPECT_EPERM(stun_add_ice_controlling(&b, 1));
	EXPECT_EPERM(stun_add_ice_controlled(&b, 1));
	EXPECT_EPERM(stun_add_unknown_attributes(&b, NULL, 0));
	EXPECT_EPERM(stun_add_attr(&b, ATTR_PRIVATE, NULL, 0));
	EXPECT_EPERM(stun_add_integrity(&b, CHECK_KEY, CHECK_KEY_LEN));

	zassert_ok(stun_add_integrity_sha256(&b, CHECK_KEY, CHECK_KEY_LEN));
	EXPECT_EPERM(stun_add_integrity(&b, CHECK_KEY, CHECK_KEY_LEN));
	EXPECT_EPERM(stun_add_integrity_sha256(&b, CHECK_KEY, CHECK_KEY_LEN));
	EXPECT_EPERM(stun_add_priority(&b, 1));

	zassert_ok(stun_add_fingerprint(&b));
	EXPECT_EPERM(stun_add_fingerprint(&b));
	EXPECT_EPERM(stun_add_integrity(&b, CHECK_KEY, CHECK_KEY_LEN));
	EXPECT_EPERM(stun_add_integrity_sha256(&b, CHECK_KEY, CHECK_KEY_LEN));
	EXPECT_EPERM(stun_add_priority(&b, 1));
	EXPECT_EPERM(stun_finish(&b, CHECK_KEY, CHECK_KEY_LEN));
	EXPECT_EPERM(stun_finish_plain(&b));

	/* What was built is a message the parser takes, with all three. */
	len = stun_builder_len(&b);
	zassert_ok(stun_parse(msg, (size_t)len, &m));
	zassert_ok(stun_verify_integrity(msg, (size_t)len, &m, CHECK_KEY, CHECK_KEY_LEN));
	zassert_ok(
		stun_verify_integrity_sha256(msg, (size_t)len, &m, CHECK_KEY, CHECK_KEY_LEN, 32));
	zassert_ok(stun_verify_fingerprint(msg, (size_t)len, &m));

	/* MESSAGE-INTEGRITY cannot follow MESSAGE-INTEGRITY-SHA256. */
	start(&b, msg, sizeof(msg), STUN_BINDING_REQUEST, 0x75);
	zassert_ok(stun_add_integrity_sha256(&b, CHECK_KEY, CHECK_KEY_LEN));
	EXPECT_EPERM(stun_add_integrity(&b, CHECK_KEY, CHECK_KEY_LEN));

	/* Closing twice with the wrappers. */
	start(&b, msg, sizeof(msg), STUN_BINDING_REQUEST, 0x76);
	zassert_true(stun_finish(&b, CHECK_KEY, CHECK_KEY_LEN) > 0);
	EXPECT_EPERM(stun_finish(&b, CHECK_KEY, CHECK_KEY_LEN));
	EXPECT_EPERM(stun_finish_plain(&b));
}

ZTEST(stun, test_integrity_failure_leaves_the_message_intact)
{
	uint8_t before[64];
	struct stun_builder b;
	uint8_t msg[64];

	ensure_psa();

	/* An empty or missing key is a refused argument. */
	start(&b, msg, sizeof(msg), STUN_BINDING_REQUEST, 0x77);
	zassert_ok(stun_add_priority(&b, 1));
	zassert_equal(stun_add_integrity(&b, NULL, 4), -EINVAL);
	zassert_equal(stun_add_integrity(&b, CHECK_KEY, 0), -EINVAL);
	zassert_equal(stun_add_integrity_sha256(&b, NULL, 4), -EINVAL);
	zassert_equal(stun_add_integrity_sha256(&b, CHECK_KEY, 0), -EINVAL);
	zassert_equal(stun_finish(&b, NULL, 4), -EINVAL);
	zassert_equal(b.err, 0);
	zassert_equal(stun_builder_len(&b), STUN_HEADER_SIZE + 8);

	/* A backend that fails is remembered, and nothing half-written stays:
	 * the header still describes the message as it was.
	 */
	memcpy(before, msg, sizeof(msg));
	zassert_equal(stun_add_integrity(&b, huge_key, sizeof(huge_key)), -EIO);
	zassert_equal(b.err, -EIO);
	zassert_equal(b.len, STUN_HEADER_SIZE + 8U);
	zassert_mem_equal(msg, before, sizeof(msg));
	zassert_true(stun_is_message(msg, b.len));
	zassert_equal(stun_add_priority(&b, 2), -EIO);
	zassert_equal(stun_builder_len(&b), -EIO);
	zassert_equal(stun_finish(&b, CHECK_KEY, CHECK_KEY_LEN), -EIO);
	zassert_equal(stun_finish_plain(&b), -EIO);

	start(&b, msg, sizeof(msg), STUN_BINDING_REQUEST, 0x78);
	memcpy(before, msg, sizeof(msg));
	zassert_equal(stun_add_integrity_sha256(&b, huge_key, sizeof(huge_key)), -EIO);
	zassert_equal(b.len, STUN_HEADER_SIZE);
	zassert_mem_equal(msg, before, sizeof(msg));

	start(&b, msg, sizeof(msg), STUN_BINDING_REQUEST, 0x79);
	zassert_equal(stun_finish(&b, huge_key, sizeof(huge_key)), -EIO);
	zassert_equal(b.err, -EIO);
	zassert_equal(b.len, STUN_HEADER_SIZE);
}

ZTEST(stun, test_text_limits_on_sending)
{
	struct stun_builder b;
	struct stun_msg m;
	int len;

	/* RFC 8489 §14.3: USERNAME is fewer than 509 bytes. */
	start(&b, big_msg, sizeof(big_msg), STUN_BINDING_REQUEST, 0x7A);
	zassert_equal(stun_add_username(&b, repeat("u", STUN_USERNAME_MAX_LEN + 1U)), -EINVAL);
	zassert_equal(b.err, 0);
	zassert_equal(stun_builder_len(&b), STUN_HEADER_SIZE);
	zassert_ok(stun_add_username(&b, repeat("u", STUN_USERNAME_MAX_LEN)));
	len = stun_builder_len(&b);
	zassert_ok(stun_parse(big_msg, (size_t)len, &m));
	zassert_equal(m.username_len, STUN_USERNAME_MAX_LEN);

	/* §14.14: SOFTWARE is fewer than 128 characters, whatever they take in
	 * bytes: U+20AC is three.
	 */
	start(&b, big_msg, sizeof(big_msg), STUN_BINDING_REQUEST, 0x7B);
	zassert_equal(stun_add_software(&b, repeat("s", STUN_TEXT_MAX_CHARS + 1U)), -EINVAL);
	zassert_equal(stun_add_software(&b, repeat("\xe2\x82\xac", STUN_TEXT_MAX_CHARS + 1U)),
		      -EINVAL);
	zassert_equal(b.err, 0);
	zassert_equal(stun_builder_len(&b), STUN_HEADER_SIZE);
	zassert_ok(stun_add_software(&b, repeat("\xe2\x82\xac", STUN_TEXT_MAX_CHARS)));
	zassert_equal(stun_builder_len(&b), STUN_HEADER_SIZE + 4 + 384, "381 bytes, padded");

	start(&b, big_msg, sizeof(big_msg), STUN_BINDING_REQUEST, 0x7C);
	zassert_ok(stun_add_software(&b, repeat("s", STUN_TEXT_MAX_CHARS)));

	/* §14.8: the same limit for the reason phrase. */
	start(&b, big_msg, sizeof(big_msg), STUN_BINDING_ERROR_RESPONSE, 0x7D);
	zassert_equal(stun_add_error_code(&b, 400, repeat("r", STUN_TEXT_MAX_CHARS + 1U)), -EINVAL);
	zassert_equal(
		stun_add_error_code(&b, 400, repeat("\xe2\x82\xac", STUN_TEXT_MAX_CHARS + 1U)),
		-EINVAL);
	zassert_equal(b.err, 0);
	zassert_equal(stun_builder_len(&b), STUN_HEADER_SIZE);
	zassert_ok(stun_add_error_code(&b, 400, repeat("\xe2\x82\xac", STUN_TEXT_MAX_CHARS)));
	len = stun_builder_len(&b);
	zassert_equal(len, STUN_HEADER_SIZE + 4 + 4 + 384, "the phrase is sent whole");
	zassert_ok(stun_parse(big_msg, (size_t)len, &m));
	zassert_equal(m.error_code, 400U);

	/* A string that is not there. NULL is legal only for the reason phrase. */
	start(&b, big_msg, sizeof(big_msg), STUN_BINDING_REQUEST, 0x7E);
	zassert_equal(stun_add_username(&b, NULL), -EINVAL);
	zassert_equal(stun_add_software(&b, NULL), -EINVAL);
	zassert_equal(b.err, 0);
	zassert_equal(stun_builder_len(&b), STUN_HEADER_SIZE);
}

ZTEST(stun, test_unknown_attributes_error_byte_exact)
{
	static const uint16_t kTypes[] = {0x7F00U, 0x7F01U, 0x7F02U};
	struct stun_builder b;
	struct stun_msg m;
	const uint8_t *val;
	uint16_t vlen;
	uint8_t msg[128];
	int len;

	/* The 420 response of RFC 8489 §6.3.1, against the independent encoder;
	 * it also pins stun_finish_plain().
	 */
	start(&b, msg, sizeof(msg), STUN_BINDING_ERROR_RESPONSE, 0xB0);
	zassert_ok(stun_add_error_code(&b, 420, "Unknown Attribute"));
	zassert_ok(stun_add_unknown_attributes(&b, kTypes, ARRAY_SIZE(kTypes)));
	len = stun_finish_plain(&b);
	zassert_equal(len, (int)sizeof(kUnknownAttributesError), "length %d", len);
	zassert_mem_equal(msg, kUnknownAttributesError, sizeof(kUnknownAttributesError));

	zassert_ok(stun_parse(msg, (size_t)len, &m));
	zassert_equal(m.error_code, 420U);
	zassert_false(m.has_integrity);
	zassert_ok(stun_verify_fingerprint(msg, (size_t)len, &m));
	zassert_ok(stun_find_attr(msg, (size_t)len, &m, STUN_ATTR_UNKNOWN_ATTRIBUTES, &val, &vlen));
	zassert_equal(vlen, 6);

	/* One and two types: 2 bytes each, padded to 4. An empty list is legal. */
	for (size_t n = 0; n <= 2; n++) {
		start(&b, msg, sizeof(msg), STUN_BINDING_ERROR_RESPONSE, 0xB1);
		zassert_ok(stun_add_unknown_attributes(&b, kTypes, n));
		len = stun_builder_len(&b);
		zassert_equal(len, (int)(STUN_HEADER_SIZE + 4U + ((2U * n + 3U) & ~3U)));
		zassert_ok(stun_parse(msg, (size_t)len, &m));
		zassert_ok(stun_find_attr(msg, (size_t)len, &m, STUN_ATTR_UNKNOWN_ATTRIBUTES, &val,
					  &vlen));
		zassert_equal(vlen, 2U * n);
	}

	start(&b, msg, sizeof(msg), STUN_BINDING_ERROR_RESPONSE, 0xB2);
	zassert_equal(stun_add_unknown_attributes(&b, NULL, 2), -EINVAL);
	zassert_equal(stun_add_unknown_attributes(&b, kTypes, 40000), -EINVAL);
	zassert_equal(b.err, 0);
	zassert_equal(stun_builder_len(&b), STUN_HEADER_SIZE);
}

ZTEST(stun, test_integrity_attributes_byte_exact)
{
	struct stun_builder b;
	uint8_t msg[160];
	int len;

	/* Against the independent encoder, in the three combinations. */
	ensure_psa();

	start(&b, msg, sizeof(msg), STUN_BINDING_REQUEST, 0xC0);
	add_check_head(&b);
	zassert_ok(stun_add_integrity(&b, CHECK_KEY, CHECK_KEY_LEN));
	len = stun_builder_len(&b);
	zassert_equal(len, (int)sizeof(kIntegrityOnlyRequest), "length %d", len);
	zassert_mem_equal(msg, kIntegrityOnlyRequest, sizeof(kIntegrityOnlyRequest));

	start(&b, msg, sizeof(msg), STUN_BINDING_REQUEST, 0xC0);
	add_check_head(&b);
	zassert_ok(stun_add_integrity_sha256(&b, CHECK_KEY, CHECK_KEY_LEN));
	len = stun_builder_len(&b);
	zassert_equal(len, (int)sizeof(kSha256Request), "length %d", len);
	zassert_mem_equal(msg, kSha256Request, sizeof(kSha256Request));

	start(&b, msg, sizeof(msg), STUN_BINDING_REQUEST, 0xC0);
	add_check_head(&b);
	zassert_ok(stun_add_integrity(&b, CHECK_KEY, CHECK_KEY_LEN));
	zassert_ok(stun_add_integrity_sha256(&b, CHECK_KEY, CHECK_KEY_LEN));
	zassert_ok(stun_add_fingerprint(&b));
	len = stun_builder_len(&b);
	zassert_equal(len, (int)sizeof(kSha256BothRequest), "length %d", len);
	zassert_mem_equal(msg, kSha256BothRequest, sizeof(kSha256BothRequest));
}
```

## src/example.c
```c
/*
 * SPDX-FileCopyrightText: Copyright The Zephyr Project Contributors
 * SPDX-FileCopyrightText: Copyright (c) 2026 Kirill Shypachov
 * SPDX-License-Identifier: Apache-2.0
 */

/*
 * The example of doc/services/connectivity/networking/api/stun.rst, "Parsing
 * and building messages": an ICE agent answering a Binding request that is
 * protected with a short-term credential. The code below is that example
 * verbatim but for two things: `send_datagram(out, len)` is a copy to the
 * caller's buffer plus the length as the return value, and a refused request
 * returns 0. So what the documentation shows is tested against RFC 8489
 * section 9.1.3. Keep the two in sync.
 */

#include <errno.h>
#include <stdbool.h>
#include <string.h>

#include <zephyr/net/stun.h>
#include <zephyr/ztest.h>

#include "stun_test.h"

#define KEY     ((const uint8_t *)kCheckPwd)
#define KEY_LEN (sizeof(kCheckPwd) - 1U)

/* --- begin: the example as the documentation shows it ------------------- */

static int doc_example_answer(const uint8_t *buf, size_t n, const struct net_sockaddr *from,
			      const uint8_t *key, size_t key_len, uint8_t *sent)
{
	struct stun_builder b;
	struct stun_msg msg;
	uint8_t out[128];
	int len;

	if (!stun_is_message(buf, n) || stun_parse(buf, n, &msg) != 0) {
		return 0;
	}
	if (msg.type != STUN_BINDING_REQUEST) {
		return 0;
	}
	if (msg.has_integrity_sha256) {
		if (stun_verify_integrity_sha256(buf, n, &msg, key, key_len, 32) != 0) {
			return 0;
		}
	} else if (stun_verify_integrity(buf, n, &msg, key, key_len) != 0) {
		return 0;
	}

	stun_builder_init(&b, out, sizeof(out), STUN_BINDING_SUCCESS_RESPONSE, msg.txid);
	if (stun_add_xor_mapped_address(&b, from) != 0) {
		return 0;
	}
	if (msg.has_integrity_sha256) {
		if (stun_add_integrity_sha256(&b, key, key_len) != 0 ||
		    stun_add_fingerprint(&b) != 0) {
			return 0;
		}
		len = stun_builder_len(&b);
	} else {
		len = stun_finish(&b, key, key_len);
	}
	if (len > 0) {
		memcpy(sent, out, (size_t)len); /* send_datagram(out, len); */
		return len;
	}
	return 0;
}

/* --- end: the example ------------------------------------------------- */

/* A Binding request with USERNAME, signed as `how` says: 1 = MESSAGE-INTEGRITY
 * only, 2 = MESSAGE-INTEGRITY-SHA256 only, 3 = both; FINGERPRINT last if
 * `with_fp`.
 */
static size_t request(uint8_t *buf, size_t cap, uint8_t txid0, int how, bool with_fp,
		      const uint8_t *key, size_t key_len)
{
	uint8_t txid[STUN_TXID_SIZE];
	struct stun_builder b;
	int len;

	fill_txid(txid, txid0);
	stun_builder_init(&b, buf, cap, STUN_BINDING_REQUEST, txid);
	zassert_ok(stun_add_username(&b, CHECK_USERNAME));
	if ((how & 1) != 0) {
		zassert_ok(stun_add_integrity(&b, key, key_len));
	}
	if ((how & 2) != 0) {
		zassert_ok(stun_add_integrity_sha256(&b, key, key_len));
	}
	if (with_fp) {
		zassert_ok(stun_add_fingerprint(&b));
	}
	len = stun_builder_len(&b);
	zassert_true(len > 0);
	return (size_t)len;
}

static void peer(struct net_sockaddr *from)
{
	sa_v4(from, 198, 51, 100, 7, 40000);
}

ZTEST(stun, test_doc_example_accepts_a_request_signed_with_sha256_only)
{
	struct net_sockaddr from;
	struct stun_msg m;
	uint8_t req[256], rsp[128];
	size_t req_len;
	int rsp_len;

	ensure_psa();
	peer(&from);

	/* RFC 8489 section 9.1.3: a request may carry MESSAGE-INTEGRITY-SHA256
	 * instead of MESSAGE-INTEGRITY; the server verifies the one it finds.
	 */
	req_len = request(req, sizeof(req), 0xD0, 2, true, KEY, KEY_LEN);
	rsp_len = doc_example_answer(req, req_len, &from, KEY, KEY_LEN, rsp);
	zassert_true(rsp_len > 0, "a request signed with MESSAGE-INTEGRITY-SHA256 was refused");

	/* ...and "any response generated by a server to a request that
	 * contains a MESSAGE-INTEGRITY-SHA256 attribute MUST include the
	 * MESSAGE-INTEGRITY-SHA256 attribute".
	 */
	zassert_ok(stun_parse(rsp, (size_t)rsp_len, &m));
	zassert_equal(m.type, STUN_BINDING_SUCCESS_RESPONSE);
	zassert_true(m.has_integrity_sha256,
		     "the response does not carry MESSAGE-INTEGRITY-SHA256");
	zassert_ok(stun_verify_integrity_sha256(rsp, (size_t)rsp_len, &m, KEY, KEY_LEN, 32U));
}

ZTEST(stun, test_doc_example_rejects_a_wrong_sha256_next_to_a_right_sha1)
{
	struct net_sockaddr from;
	struct stun_msg m;
	uint8_t req[256], rsp[128];
	size_t req_len;

	ensure_psa();
	peer(&from);

	/* Both attributes present: section 9.1.3 says the SHA-256 one is the
	 * one to check. A correct MESSAGE-INTEGRITY next to a corrupted
	 * MESSAGE-INTEGRITY-SHA256 must not get the request through.
	 */
	req_len = request(req, sizeof(req), 0xD1, 3, false, KEY, KEY_LEN);
	zassert_ok(stun_parse(req, req_len, &m));
	zassert_true(m.has_integrity && m.has_integrity_sha256);
	req[m.integrity_sha256_off + 4U + 5U] ^= 0x40; /* a byte of the SHA-256 value */
	zassert_ok(stun_parse(req, req_len, &m));
	zassert_ok(stun_verify_integrity(req, req_len, &m, KEY, KEY_LEN), "SHA-1 is still right");
	zassert_equal(stun_verify_integrity_sha256(req, req_len, &m, KEY, KEY_LEN, 32U), -EBADMSG,
		      "SHA-256 is wrong");

	zassert_equal(doc_example_answer(req, req_len, &from, KEY, KEY_LEN, rsp), 0,
		      "a request with a wrong MESSAGE-INTEGRITY-SHA256 was answered");
}

ZTEST(stun, test_doc_example_answers_with_sha256_when_asked_with_both)
{
	struct net_sockaddr from;
	struct stun_msg m;
	uint8_t req[256], rsp[128];
	size_t req_len;
	int rsp_len;

	ensure_psa();
	peer(&from);

	req_len = request(req, sizeof(req), 0xD2, 3, true, KEY, KEY_LEN);
	rsp_len = doc_example_answer(req, req_len, &from, KEY, KEY_LEN, rsp);
	zassert_true(rsp_len > 0);
	zassert_ok(stun_parse(rsp, (size_t)rsp_len, &m));
	zassert_true(m.has_integrity_sha256,
		     "the request carried MESSAGE-INTEGRITY-SHA256, the response must too");
	zassert_ok(stun_verify_integrity_sha256(rsp, (size_t)rsp_len, &m, KEY, KEY_LEN, 32U));
}

ZTEST(stun, test_doc_example_still_serves_sha1_only_peers)
{
	struct net_sockaddr from;
	struct stun_msg m;
	uint8_t req[256], rsp[128];
	size_t req_len;
	int rsp_len;

	ensure_psa();
	peer(&from);

	/* The case the example was written for: MESSAGE-INTEGRITY alone, as
	 * ICE peers send it (RFC 8445). It keeps working.
	 */
	req_len = request(req, sizeof(req), 0xD3, 1, true, KEY, KEY_LEN);
	rsp_len = doc_example_answer(req, req_len, &from, KEY, KEY_LEN, rsp);
	zassert_true(rsp_len > 0);
	zassert_ok(stun_parse(rsp, (size_t)rsp_len, &m));
	zassert_true(m.has_integrity);
	zassert_false(m.has_integrity_sha256);
	zassert_ok(stun_verify_integrity(rsp, (size_t)rsp_len, &m, KEY, KEY_LEN));
	zassert_ok(stun_verify_fingerprint(rsp, (size_t)rsp_len, &m));
	{
		struct net_sockaddr seen;

		zassert_ok(stun_get_xor_mapped_address(rsp, (size_t)rsp_len, &m, &seen));
		zassert_true(sa_is_v4(&seen, 198, 51, 100, 7, 40000),
			     "the response tells the peer its address");
	}
}
```

## src/integrity.c
```c
/*
 * SPDX-FileCopyrightText: Copyright The Zephyr Project Contributors
 * SPDX-FileCopyrightText: Copyright (c) 2026 Kirill Shypachov
 * SPDX-License-Identifier: Apache-2.0
 *
 * MESSAGE-INTEGRITY and MESSAGE-INTEGRITY-SHA256 (RFC 8489 §9, §14.5, §14.6).
 */
#include <errno.h>

#include "stun_test.h"

#define CHECK_KEY     ((const uint8_t *)kCheckPwd)
#define CHECK_KEY_LEN (sizeof(kCheckPwd) - 1U)

/* Longer than any key the PSA key store takes: importing it fails. */
static uint8_t huge_key[9000];

/* Offset of the value of the first attribute of `type` in a parsed message. */
static size_t value_offset(const uint8_t *buf, size_t len, uint16_t type)
{
	struct stun_msg m;
	const uint8_t *val;
	uint16_t vlen;

	zassert_ok(stun_parse(buf, len, &m));
	zassert_ok(stun_find_attr(buf, len, &m, type, &val, &vlen));
	zassert_true(vlen > 0);
	return (size_t)(val - buf);
}

ZTEST(stun, test_integrity_of_ipv6_response)
{
	struct stun_msg m;

	/* RFC 5769 §2.3; the other two vectors are checked in main.c. */
	ensure_psa();
	zassert_ok(stun_parse(kResponseV6, sizeof(kResponseV6), &m));
	zassert_ok(stun_verify_integrity(kResponseV6, sizeof(kResponseV6), &m,
					 (const uint8_t *)kPassword, strlen(kPassword)));
	zassert_ok(stun_verify_fingerprint(kResponseV6, sizeof(kResponseV6), &m));
}

ZTEST(stun, test_integrity_detects_a_changed_attribute)
{
	uint8_t msg[sizeof(kRequest)];
	struct stun_msg m;

	ensure_psa();
	memcpy(msg, kRequest, sizeof(kRequest));
	msg[value_offset(msg, sizeof(msg), STUN_ATTR_PRIORITY)] ^= 0x01;
	zassert_ok(stun_parse(msg, sizeof(msg), &m));
	zassert_equal(stun_verify_integrity(msg, sizeof(msg), &m, (const uint8_t *)kPassword,
					    strlen(kPassword)),
		      -EBADMSG);
}

ZTEST(stun, test_integrity_without_fingerprint)
{
	struct stun_msg m;

	ensure_psa();
	zassert_ok(stun_parse(kIntegrityOnlyRequest, sizeof(kIntegrityOnlyRequest), &m));
	zassert_true(m.has_integrity);
	zassert_false(m.has_fingerprint);
	zassert_ok(stun_verify_integrity(kIntegrityOnlyRequest, sizeof(kIntegrityOnlyRequest), &m,
					 CHECK_KEY, CHECK_KEY_LEN));
	zassert_equal(
		stun_verify_fingerprint(kIntegrityOnlyRequest, sizeof(kIntegrityOnlyRequest), &m),
		-ENOENT);
}

ZTEST(stun, test_integrity_bad_arguments)
{
	const uint8_t *req = kSha256BothRequest;
	size_t len = sizeof(kSha256BothRequest);
	struct stun_msg m;

	ensure_psa();
	zassert_ok(stun_parse(req, len, &m));

	zassert_equal(stun_verify_integrity(req, len, &m, NULL, CHECK_KEY_LEN), -EINVAL);
	zassert_equal(stun_verify_integrity(req, len, &m, CHECK_KEY, 0), -EINVAL);
	zassert_equal(stun_verify_integrity(req, len, NULL, CHECK_KEY, CHECK_KEY_LEN), -EINVAL);
	zassert_equal(stun_verify_integrity(NULL, len, &m, CHECK_KEY, CHECK_KEY_LEN), -EINVAL);
	zassert_equal(stun_verify_integrity(req, len - 4U, &m, CHECK_KEY, CHECK_KEY_LEN), -EINVAL,
		      "msg was parsed from another buffer length");

	zassert_equal(stun_verify_integrity_sha256(req, len, &m, NULL, CHECK_KEY_LEN, 32), -EINVAL);
	zassert_equal(stun_verify_integrity_sha256(req, len, &m, CHECK_KEY, 0, 32), -EINVAL);
	zassert_equal(stun_verify_integrity_sha256(req, len, NULL, CHECK_KEY, CHECK_KEY_LEN, 32),
		      -EINVAL);
	zassert_equal(stun_verify_integrity_sha256(NULL, len, &m, CHECK_KEY, CHECK_KEY_LEN, 32),
		      -EINVAL);

	zassert_equal(stun_verify_fingerprint(NULL, len, &m), -EINVAL);
	zassert_equal(stun_verify_fingerprint(req, len, NULL), -EINVAL);
}

ZTEST(stun, test_integrity_backend_failure_is_not_a_mismatch)
{
	const uint8_t *req = kSha256BothRequest;
	size_t len = sizeof(kSha256BothRequest);
	struct stun_msg m;

	/* A caller must be able to tell "forged" from "could not check". */
	ensure_psa();
	zassert_ok(stun_parse(req, len, &m));
	zassert_equal(stun_verify_integrity(req, len, &m, huge_key, sizeof(huge_key)), -EIO);
	zassert_equal(stun_verify_integrity_sha256(req, len, &m, huge_key, sizeof(huge_key), 32),
		      -EIO);
}

ZTEST(stun, test_integrity_sha256)
{
	struct stun_msg m;

	ensure_psa();

	/* MESSAGE-INTEGRITY-SHA256 alone. */
	zassert_ok(stun_parse(kSha256Request, sizeof(kSha256Request), &m));
	zassert_true(m.has_integrity_sha256);
	zassert_equal(m.integrity_sha256_len, STUN_INTEGRITY_SHA256_MAX_LEN);
	zassert_false(m.has_integrity);
	zassert_ok(stun_verify_integrity_sha256(kSha256Request, sizeof(kSha256Request), &m,
						CHECK_KEY, CHECK_KEY_LEN, 32));
	zassert_equal(stun_verify_integrity(kSha256Request, sizeof(kSha256Request), &m, CHECK_KEY,
					    CHECK_KEY_LEN),
		      -ENOENT);

	/* Both attributes and FINGERPRINT, as RFC 8489 §9.1.2 has a request. */
	zassert_ok(stun_parse(kSha256BothRequest, sizeof(kSha256BothRequest), &m));
	zassert_ok(stun_verify_integrity(kSha256BothRequest, sizeof(kSha256BothRequest), &m,
					 CHECK_KEY, CHECK_KEY_LEN));
	zassert_ok(stun_verify_integrity_sha256(kSha256BothRequest, sizeof(kSha256BothRequest), &m,
						CHECK_KEY, CHECK_KEY_LEN, 32));
	zassert_ok(stun_verify_fingerprint(kSha256BothRequest, sizeof(kSha256BothRequest), &m));

	/* A message without it. */
	zassert_ok(stun_parse(kRequest, sizeof(kRequest), &m));
	zassert_equal(stun_verify_integrity_sha256(kRequest, sizeof(kRequest), &m,
						   (const uint8_t *)kPassword, strlen(kPassword),
						   32),
		      -ENOENT);
}

ZTEST(stun, test_integrity_sha256_detects_changes)
{
	uint8_t msg[sizeof(kSha256Request)];
	struct stun_msg m;

	ensure_psa();

	memcpy(msg, kSha256Request, sizeof(msg));
	zassert_ok(stun_parse(msg, sizeof(msg), &m));
	msg[m.integrity_sha256_off + 4U] ^= 0x01;
	zassert_equal(
		stun_verify_integrity_sha256(msg, sizeof(msg), &m, CHECK_KEY, CHECK_KEY_LEN, 32),
		-EBADMSG, "a bit of the value");

	memcpy(msg, kSha256Request, sizeof(msg));
	msg[value_offset(msg, sizeof(msg), STUN_ATTR_PRIORITY)] ^= 0x01;
	zassert_ok(stun_parse(msg, sizeof(msg), &m));
	zassert_equal(
		stun_verify_integrity_sha256(msg, sizeof(msg), &m, CHECK_KEY, CHECK_KEY_LEN, 32),
		-EBADMSG, "a bit of a signed attribute");

	zassert_ok(stun_parse(kSha256Request, sizeof(kSha256Request), &m));
	zassert_equal(stun_verify_integrity_sha256(kSha256Request, sizeof(kSha256Request), &m,
						   (const uint8_t *)"wrongpass", 9, 32),
		      -EBADMSG, "another key");
}

ZTEST(stun, test_integrity_sha256_truncated)
{
	static const size_t kBadMin[] = {0, 12, 17, 36};
	uint8_t msg[sizeof(kSha256TruncatedRequest)];
	const uint8_t *req = kSha256TruncatedRequest;
	size_t len = sizeof(kSha256TruncatedRequest);
	struct stun_msg m;

	ensure_psa();
	zassert_ok(stun_parse(req, len, &m));
	zassert_equal(m.integrity_sha256_len, STUN_INTEGRITY_SHA256_MIN_LEN);

	/* RFC 8489 §14.6: the full 32 bytes unless the usage allows truncation. */
	zassert_equal(stun_verify_integrity_sha256(req, len, &m, CHECK_KEY, CHECK_KEY_LEN, 32),
		      -EBADMSG, "truncated, and the caller did not allow it");
	zassert_ok(stun_verify_integrity_sha256(req, len, &m, CHECK_KEY, CHECK_KEY_LEN, 16));

	memcpy(msg, req, len);
	msg[m.integrity_sha256_off + 4U + 15U] ^= 0x80;
	zassert_equal(stun_verify_integrity_sha256(msg, len, &m, CHECK_KEY, CHECK_KEY_LEN, 16),
		      -EBADMSG, "the last bit of the truncated value");

	for (size_t i = 0; i < ARRAY_SIZE(kBadMin); i++) {
		zassert_equal(stun_verify_integrity_sha256(req, len, &m, CHECK_KEY, CHECK_KEY_LEN,
							   kBadMin[i]),
			      -EINVAL, "min_len %zu", kBadMin[i]);
	}
}

ZTEST(stun, test_integrity_sha256_rfc8489_vector)
{
	/* Username U+30DE U+30C8 U+30EA U+30C3 U+30AF U+30B9, realm and password
	 * of RFC 8489 Appendix B.1; with the SHA-256 password algorithm the key
	 * is SHA-256(username ":" realm ":" password) (RFC 8489 §9.2.2).
	 */
	static const uint8_t kKeyInput[] = "\xe3\x83\x9e\xe3\x83\x88\xe3\x83\xaa\xe3\x83\x83"
					   "\xe3\x82\xaf\xe3\x82\xb9:example.org:TheMatrIX";
	uint8_t key[PSA_HASH_LENGTH(PSA_ALG_SHA_256)];
	uint16_t unknown[4] = {0};
	struct stun_msg m;
	size_t key_len = 0;

	ensure_psa();
	zassert_equal(psa_hash_compute(PSA_ALG_SHA_256, kKeyInput, sizeof(kKeyInput) - 1U, key,
				       sizeof(key), &key_len),
		      PSA_SUCCESS);
	zassert_equal(key_len, sizeof(key));

	zassert_true(stun_is_message(kRfc8489Request, sizeof(kRfc8489Request)));
	zassert_ok(stun_parse(kRfc8489Request, sizeof(kRfc8489Request), &m));
	zassert_true(m.has_integrity_sha256);
	zassert_false(m.has_integrity);
	zassert_ok(stun_verify_integrity_sha256(kRfc8489Request, sizeof(kRfc8489Request), &m, key,
						sizeof(key), 32));

	/* The codec does not implement long-term credentials: USERHASH and
	 * PASSWORD-ALGORITHM are for whoever does.
	 */
	zassert_equal(stun_unknown_attrs(kRfc8489Request, sizeof(kRfc8489Request), &m, NULL, 0,
					 unknown, ARRAY_SIZE(unknown)),
		      2);
	zassert_equal(unknown[0], 0x001EU, "USERHASH");
	zassert_equal(unknown[1], 0x001DU, "PASSWORD-ALGORITHM");
}

ZTEST(stun, test_attributes_after_integrity_sha256_are_ignored)
{
	uint8_t msg[sizeof(kSha256Request) + 4U + 8U];
	struct stun_msg m;
	size_t len = sizeof(kSha256Request);

	/* The forgery of parse.c, on a message that MESSAGE-INTEGRITY-SHA256
	 * protects: USE-CANDIDATE inserted after it, then a fresh FINGERPRINT.
	 */
	ensure_psa();
	memcpy(msg, kSha256Request, len);
	put16(msg + len, STUN_ATTR_USE_CANDIDATE);
	put16(msg + len + 2, 0);
	len += 4U;
	put16(msg + 2, (uint16_t)(len + 8U - STUN_HEADER_SIZE));
	put16(msg + len, STUN_ATTR_FINGERPRINT);
	put16(msg + len + 2, 4);
	put32(msg + len + 4, crc32_ieee(msg, len) ^ FINGERPRINT_XOR);
	len += 8U;

	zassert_ok(stun_parse(msg, len, &m));
	zassert_ok(stun_verify_integrity_sha256(msg, len, &m, CHECK_KEY, CHECK_KEY_LEN, 32),
		   "the forged message must still pass MESSAGE-INTEGRITY-SHA256");
	zassert_ok(stun_verify_fingerprint(msg, len, &m),
		   "the forged message must still pass FINGERPRINT");
	zassert_false(m.has_use_candidate);
	zassert_true(m.has_priority);
}
```

## src/log_capture.c
```c
/*
 * SPDX-FileCopyrightText: Copyright The Zephyr Project Contributors
 * SPDX-FileCopyrightText: Copyright (c) 2026 Kirill Shypachov
 * SPDX-License-Identifier: Apache-2.0
 */
#include <string.h>

#include <zephyr/kernel.h>
#include <zephyr/logging/log_backend.h>
#include <zephyr/logging/log_ctrl.h>
#include <zephyr/logging/log_msg.h>
#include <zephyr/sys/cbprintf.h>
#include <zephyr/sys/printk.h>

#include "log_capture.h"

#define SOURCE_NAME "net_stun"

/* More records than any one test makes; the ones beyond are counted only. */
#define RECORDS_MAX 32
#define TEXT_SIZE   160

struct record {
	uint8_t level;
	char text[TEXT_SIZE];
};

static struct record records[RECORDS_MAX];
static size_t count;

struct text_out {
	char *at;
	char *end;
};

static int text_out_char(int c, void *ctx)
{
	struct text_out *out = ctx;

	if (out->at < out->end) {
		*out->at++ = (char)c;
	}
	return c;
}

static void process(const struct log_backend *const backend, union log_msg_generic *msg)
{
	const char *source = log_source_name_get(log_msg_get_domain(&msg->log),
						 log_msg_get_source_id(&msg->log));
	size_t len;

	ARG_UNUSED(backend);

	if (source == NULL || strcmp(source, SOURCE_NAME) != 0) {
		return;
	}
	if (count < RECORDS_MAX) {
		struct record *r = &records[count];
		struct text_out out = {.at = r->text, .end = r->text + sizeof(r->text) - 1};

		r->level = log_msg_get_level(&msg->log);
		(void)cbpprintf(text_out_char, &out, log_msg_get_package(&msg->log, &len));
		*out.at = '\0';
	}
	count++;
}

static void panic(const struct log_backend *const backend)
{
	ARG_UNUSED(backend);
}

static const struct log_backend_api capture_api = {
	.process = process,
	.panic = panic,
};

LOG_BACKEND_DEFINE(stun_test_log_capture, capture_api, false);

void log_capture_start(void)
{
	static bool started;

	if (!started) {
		started = true;
		log_backend_enable(&stun_test_log_capture, NULL, LOG_LEVEL_DBG);
	}
	log_capture_clear();
}

void log_capture_clear(void)
{
	count = 0;
	memset(records, 0, sizeof(records));
}

size_t log_capture_count(void)
{
	return count;
}

size_t log_capture_count_level(uint8_t level)
{
	size_t n = 0;

	for (size_t i = 0; i < MIN(count, RECORDS_MAX); i++) {
		if (records[i].level == level) {
			n++;
		}
	}
	return n;
}

bool log_capture_contains(const char *needle)
{
	for (size_t i = 0; i < MIN(count, RECORDS_MAX); i++) {
		if (strstr(records[i].text, needle) != NULL) {
			return true;
		}
	}
	return false;
}

void log_capture_dump(void)
{
	for (size_t i = 0; i < MIN(count, RECORDS_MAX); i++) {
		printk("  log record %u, level %u: %s\n", (unsigned int)i, records[i].level,
		       records[i].text);
	}
}
```

## src/log_capture.h
```c
/*
 * SPDX-FileCopyrightText: Copyright The Zephyr Project Contributors
 * SPDX-FileCopyrightText: Copyright (c) 2026 Kirill Shypachov
 * SPDX-License-Identifier: Apache-2.0
 *
 * A log backend that keeps what the STUN library writes, for the tests to look
 * at: the level and the text of every record of the "net_stun" module. What the
 * rest of the system logs is dropped.
 */
#ifndef STUN_TEST_LOG_CAPTURE_H_
#define STUN_TEST_LOG_CAPTURE_H_

#include <stdbool.h>
#include <stddef.h>
#include <stdint.h>

/* Start keeping records; the first call does it, the later ones do nothing. */
void log_capture_start(void);

/* Forget the records kept so far. */
void log_capture_clear(void);

/* Number of records since the last clear. */
size_t log_capture_count(void);

/* Number of them that have this level, LOG_LEVEL_ERR to LOG_LEVEL_DBG. */
size_t log_capture_count_level(uint8_t level);

/* Does the text of any record contain this? */
bool log_capture_contains(const char *needle);

/* Print the records, to go with a failed assertion. */
void log_capture_dump(void);

#endif /* STUN_TEST_LOG_CAPTURE_H_ */
```
