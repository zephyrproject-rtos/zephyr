## CMakeLists.txt
```
# SPDX-License-Identifier: Apache-2.0

cmake_minimum_required(VERSION 3.28.0)
find_package(Zephyr REQUIRED HINTS $ENV{ZEPHYR_BASE})
project(socket_quic)

target_include_directories(app PRIVATE ${ZEPHYR_BASE}/subsys/net/ip)
target_include_directories(app PRIVATE ${ZEPHYR_BASE}/subsys/net/lib/quic)
FILE(GLOB app_sources src/*.c)
target_sources(app PRIVATE ${app_sources})

set(gen_dir ${ZEPHYR_BINARY_DIR}/include/generated/)

if(CONFIG_QUIC)
  foreach(inc_file
    ca.crt
    server.crt
    server.key
    client.crt
    client.key
    intermediate.crt
    chain_server.crt
    chain_server.key
  )
    generate_inc_file_for_target(app
      ${ZEPHYR_BASE}/tests/net/lib/quic/certs/${inc_file}
      ${gen_dir}/${inc_file}.inc
    )
  endforeach()

  target_include_directories(app PRIVATE ${ZEPHYR_BASE}/tests/net/lib/quic/certs/)
endif()
```

## prj.conf
```kconfig
# Networking config
CONFIG_NETWORKING=y
CONFIG_NET_LOG=y
CONFIG_NET_IPV4=y
CONFIG_NET_IPV6=y
CONFIG_NET_UDP=y
CONFIG_NET_SOCKETS=y
CONFIG_ZVFS_OPEN_ADD_SIZE_NET=14
CONFIG_ZVFS_POLL_MAX=16
CONFIG_NET_IPV6_DAD=n
CONFIG_NET_IPV6_MLD=n

# Network driver config
CONFIG_NET_DRIVERS=y
CONFIG_NET_LOOPBACK=y
CONFIG_NET_L2_ETHERNET=y
CONFIG_ETH_DRIVER=n
CONFIG_NET_PKT_LARGE_DEFAULTS=y
CONFIG_TEST_RANDOM_GENERATOR=y

CONFIG_ZTEST=y
CONFIG_NET_TEST=y
CONFIG_TEST_USERSPACE=y

CONFIG_ZTEST_STACK_SIZE=17408
CONFIG_MAIN_STACK_SIZE=4096
CONFIG_PRIVILEGED_STACK_SIZE=8192

CONFIG_MBEDTLS_HEAP_SIZE=32768
CONFIG_MBEDTLS_ENABLE_HEAP=y

CONFIG_QUIC=y
CONFIG_NET_STATISTICS=y
CONFIG_NET_STATISTICS_QUIC=y
CONFIG_QUIC_STATS_HISTORY=y
CONFIG_QUIC_STATS_HISTORY_SIZE=4
CONFIG_QUIC_MAX_CONTEXTS=6
CONFIG_QUIC_MAX_STREAMS_BIDI=2
CONFIG_QUIC_MAX_STREAMS_UNI=2
CONFIG_QUIC_MAX_ENDPOINTS=6
CONFIG_QUIC_PKT_COUNT=10

CONFIG_NET_NAMESPACE_COMPAT_MODE=n

CONFIG_TLS_MAX_CREDENTIALS_NUMBER=11
CONFIG_MBEDTLS_PSA_KEY_SLOT_COUNT=48
CONFIG_MBEDTLS_PSA_CRYPTO_EXTERNAL_RNG_ALLOW_NON_CSPRNG=y

# Make sure to test packet retransmission logic
CONFIG_NET_LOOPBACK_SIMULATE_PACKET_DROP=y
```

## boards/qemu_x86.conf
```kconfig
CONFIG_MAX_THREAD_BYTES=4
```

## src/quic_helpers.c
```c
/*
 * Copyright 2026 Nordic Semiconductor ASA
 *
 * SPDX-License-Identifier: Apache-2.0
 */

#include <zephyr/logging/log.h>
LOG_MODULE_DECLARE(net_test, CONFIG_QUIC_LOG_LEVEL);

#include <zephyr/ztest_assert.h>
#include <zephyr/net/net_ip.h>
#include <zephyr/net/socket.h>
#include <zephyr/net/quic.h>
#include <zephyr/net/tls_credentials.h>

#include "quic_test.h"

void prepare_quic_socket(int *sock,
			 const struct net_sockaddr *remote_addr,
			 const struct net_sockaddr *local_addr)
{
	int ret;

	zassert_not_null(sock, "null socket pointer");
	zassert_not_null(local_addr, "null sockaddr pointer");

	if (remote_addr != NULL && net_sin(remote_addr)->sin_port == 0) {
		net_sin(remote_addr)->sin_port = net_htons(DEFAULT_QUIC_PORT);
	}

	if (local_addr != NULL && net_sin(local_addr)->sin_port == 0) {
		net_sin(local_addr)->sin_port = net_htons(DEFAULT_QUIC_PORT);
	}

	ret = quic_connection_open(remote_addr, local_addr);
	zassert_true(ret >= 0, "Failed to open QUIC connection socket (%d)", ret);

	*sock = ret;
}

void setup_quic_certs(int sock, sec_tag_t sec_tag_list[], size_t sec_tag_list_size)
{
	int ret;

	ret = zsock_setsockopt(sock, ZSOCK_SOL_TLS, ZSOCK_TLS_SEC_TAG_LIST,
			       sec_tag_list,
			       sec_tag_list_size * sizeof(sec_tag_list[0]));
	zassert_equal(ret, 0, "Failed to set TLS sec tags (%d)", -errno);
}

void setup_alpn(int sock, const char * const alpn_list[], size_t alpn_list_size)
{
	int ret;

	ret = zsock_setsockopt(sock, ZSOCK_SOL_TLS, ZSOCK_TLS_ALPN_LIST,
			       alpn_list, sizeof(const char *) * alpn_list_size);
	zassert_equal(ret, 0, "Failed to set ALPN list (%d)", -errno);
}
```

## src/quic_test.h
```c
/*
 * Copyright 2026 Nordic Semiconductor ASA
 *
 * SPDX-License-Identifier: Apache-2.0
 */

#define DEFAULT_QUIC_PORT 42424

void prepare_quic_socket(int *sock,
			 const struct net_sockaddr *remote_addr,
			 const struct net_sockaddr *local_addr);
void setup_quic_certs(int sock, sec_tag_t sec_tag_list[], size_t sec_tag_list_size);
void setup_alpn(int sock, const char * const alpn_list[], size_t alpn_list_size);
```
