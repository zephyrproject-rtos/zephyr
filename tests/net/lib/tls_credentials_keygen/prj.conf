## CMakeLists.txt
```
# SPDX-License-Identifier: Apache-2.0

cmake_minimum_required(VERSION 3.20.0)

find_package(Zephyr REQUIRED HINTS $ENV{ZEPHYR_BASE})
project(tls_credentials_keygen)

target_sources(app PRIVATE src/main.c)
target_sources_ifdef(CONFIG_TLS_CREDENTIALS_SHELL_KEYGEN app PRIVATE src/shell.c)
target_sources_ifdef(CONFIG_TLS_CREDENTIALS_KEYGEN_KEY_STORE_CUSTOM app PRIVATE src/test_store.c)
```

## prj.conf
```kconfig
CONFIG_ZTEST=y
CONFIG_MAIN_STACK_SIZE=4096
CONFIG_ZTEST_STACK_SIZE=4096
CONFIG_HEAP_MEM_POOL_SIZE=16384

CONFIG_NETWORKING=y
CONFIG_NET_SOCKETS=n

# PSA crypto (software backend) with an external RNG, so key generation, signing and public key
# export run for real on the host.
CONFIG_MBEDTLS=y
CONFIG_MBEDTLS_PSA_CRYPTO_EXTERNAL_RNG=y
CONFIG_MBEDTLS_PSA_CRYPTO_EXTERNAL_RNG_ALLOW_NON_CSPRNG=y
CONFIG_MBEDTLS_ENABLE_HEAP=y
CONFIG_MBEDTLS_HEAP_SIZE=8192
CONFIG_ENTROPY_GENERATOR=y
CONFIG_TEST_RANDOM_GENERATOR=y
CONFIG_PSA_CRYPTO=y

# Persistent PSA keys, kept in settings on native_sim.
CONFIG_SECURE_STORAGE=y
CONFIG_SECURE_STORAGE_PS_IMPLEMENTATION_ITS=y
CONFIG_SECURE_STORAGE_ITS_STORE_IMPLEMENTATION_SETTINGS=y
CONFIG_SETTINGS=y
CONFIG_SETTINGS_NVS=y
CONFIG_NVS=y
CONFIG_FLASH=y
CONFIG_FLASH_MAP=y

# Small store so the rollback test can fill it.
CONFIG_TLS_CREDENTIALS=y
CONFIG_TLS_MAX_CREDENTIALS_NUMBER=4
CONFIG_TLS_CREDENTIALS_BACKEND_PROTECTED_STORAGE=y
CONFIG_TLS_CREDENTIALS_KEYGEN=y
CONFIG_TLS_CREDENTIALS_KEYGEN_SECP384R1=y

# Parsing lets the test re-parse the generated CSR.
CONFIG_MBEDTLS_MD_C=y
CONFIG_MBEDTLS_X509_CSR_PARSE_C=y
CONFIG_MBEDTLS_X509_USE_C=y
```

## src/main.c
```c
/*
 * Copyright (c) 2026 Nordic Semiconductor ASA
 *
 * SPDX-License-Identifier: Apache-2.0
 */

#include <string.h>
#include <zephyr/kernel.h>
#include <zephyr/ztest.h>
#include <zephyr/net/tls_credentials.h>
#include <zephyr/net/tls_credentials_keygen.h>
#include <zephyr/psa/key_ids.h>

#include <psa/crypto.h>
#include <mbedtls/pk.h>
#include <mbedtls/x509_csr.h>

#include "common.h"

static const sec_tag_t test_tags[] = {TEST_SEC_TAG, TEST_SEC_TAG_2, TEST_SEC_TAG_LARGE};

void reset_state(void)
{
	zassert_equal(psa_crypto_init(), PSA_SUCCESS);

	for (size_t i = 0; i < ARRAY_SIZE(test_tags); i++) {
		(void)tls_credential_delete(test_tags[i], TLS_CREDENTIAL_PRIVATE_KEY_PSA);
		(void)tls_credential_delete(test_tags[i], TLS_CREDENTIAL_PRIVATE_KEY);
	}

	for (size_t i = 0; i < KEY_ID_COUNT; i++) {
		(void)psa_destroy_key(KEY_ID_MIN + i);
	}

	(void)psa_destroy_key(FOREIGN_KEY_ID);
}

static void before(void *fixture)
{
	ARG_UNUSED(fixture);
	reset_state();
}

static void foreign_key_create(psa_key_id_t id, size_t bits)
{
	psa_key_attributes_t attr = PSA_KEY_ATTRIBUTES_INIT;
	psa_key_id_t out;

	psa_set_key_type(&attr, PSA_KEY_TYPE_ECC_KEY_PAIR(PSA_ECC_FAMILY_SECP_R1));
	psa_set_key_bits(&attr, bits);
	psa_set_key_usage_flags(&attr, PSA_KEY_USAGE_SIGN_HASH | PSA_KEY_USAGE_SIGN_MESSAGE);
	psa_set_key_algorithm(&attr, PSA_ALG_ECDSA(PSA_ALG_ANY_HASH));
	psa_set_key_lifetime(&attr, PSA_KEY_LIFETIME_PERSISTENT);
	psa_set_key_id(&attr, id);
	zassert_equal(psa_generate_key(&attr, &out), PSA_SUCCESS, "PSA key generation failed");
}

static void key_register(sec_tag_t tag, psa_key_id_t id)
{
	zassert_ok(tls_credential_add(tag, TLS_CREDENTIAL_PRIVATE_KEY_PSA, &id, sizeof(id)));
}

static bool key_exists(psa_key_id_t id)
{
	psa_key_attributes_t attr = PSA_KEY_ATTRIBUTES_INIT;
	bool exists = psa_get_key_attributes(id, &attr) == PSA_SUCCESS;

	psa_reset_key_attributes(&attr);

	return exists;
}

psa_key_id_t key_id_get(sec_tag_t tag)
{
	psa_key_id_t id = PSA_KEY_ID_NULL;

	zassert_ok(tls_credential_keygen_key_id_get(tag, &id));

	return id;
}

/* Verify the signature of the CSR with the exported public key. */
static void csr_signature_check(sec_tag_t tag, const mbedtls_x509_csr *csr)
{
	uint8_t pub[TLS_CREDENTIAL_KEYGEN_PUBKEY_MAX_SIZE];
	uint8_t hash[PSA_HASH_MAX_SIZE];
	psa_algorithm_t alg;
	mbedtls_pk_context pk;
	size_t hash_len;
	size_t len;

	alg = csr->MBEDTLS_PRIVATE(sig_md) == MBEDTLS_MD_SHA384 ? PSA_ALG_SHA_384 : PSA_ALG_SHA_256;
	zassert_equal(psa_hash_compute(alg, csr->cri.p, csr->cri.len, hash, sizeof(hash),
				       &hash_len), PSA_SUCCESS);

	zassert_ok(tls_credential_keygen_pubkey_get(tag, pub, sizeof(pub), &len));
	mbedtls_pk_init(&pk);
	zassert_equal(mbedtls_pk_parse_public_key(&pk, pub, len), 0, "public key does not parse");
	zassert_equal(mbedtls_pk_verify(&pk, csr->MBEDTLS_PRIVATE(sig_md), hash, hash_len,
					csr->MBEDTLS_PRIVATE(sig).p, csr->MBEDTLS_PRIVATE(sig).len),
		      0, "CSR signature does not verify with the exported public key");
	mbedtls_pk_free(&pk);
}

static void csr_check(sec_tag_t tag, mbedtls_md_type_t md)
{
	uint8_t der[512];
	size_t len = 0;
	mbedtls_x509_csr csr;
	char subj[64];

	zassert_ok(tls_credential_keygen_csr(tag, "CN=test,O=Nordic", der, sizeof(der), &len));
	zassert_true(len > 0, "CSR length must be positive");
	zassert_equal(der[0], 0x30, "DER CSR must begin with a SEQUENCE tag");

	/* Parsing checks the structure, the subject and the signature made through PSA. */
	mbedtls_x509_csr_init(&csr);
	zassert_equal(mbedtls_x509_csr_parse_der(&csr, der, len), 0, "CSR does not parse");
	zassert_true(mbedtls_x509_dn_gets(subj, sizeof(subj), &csr.subject) > 0);
	zassert_not_null(strstr(subj, "CN=test"), "unexpected CSR subject: %s", subj);
	zassert_not_null(strstr(subj, "O=Nordic"), "unexpected CSR subject: %s", subj);
	zassert_equal(csr.MBEDTLS_PRIVATE(sig_md), md, "unexpected CSR signature hash");
	csr_signature_check(tag, &csr);
	mbedtls_x509_csr_free(&csr);
}

ZTEST_SUITE(tls_credentials_keygen_api, NULL, NULL, before, NULL, NULL);

ZTEST(tls_credentials_keygen_api, test_generate)
{
	psa_key_id_t id = PSA_KEY_ID_NULL;

	zassert_equal(tls_credential_keygen_key_id_get(TEST_SEC_TAG, &id), -ENOENT);
	zassert_ok(tls_credential_keygen_generate(TEST_SEC_TAG, P256));
	zassert_ok(tls_credential_keygen_key_id_get(TEST_SEC_TAG, &id));
	zassert_equal(tls_credential_keygen_generate(TEST_SEC_TAG, P256), -EEXIST,
		      "second generate must report -EEXIST");
}

ZTEST(tls_credentials_keygen_api, test_key_attributes)
{
	psa_key_attributes_t attr = PSA_KEY_ATTRIBUTES_INIT;
	psa_key_id_t id;

	zassert_ok(tls_credential_keygen_generate(TEST_SEC_TAG, P256));
	id = key_id_get(TEST_SEC_TAG);

	zassert_true(id >= KEY_ID_MIN && id < KEY_ID_MIN + KEY_ID_COUNT,
		     "key ID 0x%08x not in the reserved range", id);
	zassert_equal(psa_get_key_attributes(id, &attr), PSA_SUCCESS);
	zassert_equal(psa_get_key_type(&attr), PSA_KEY_TYPE_ECC_KEY_PAIR(PSA_ECC_FAMILY_SECP_R1));
	zassert_equal(psa_get_key_bits(&attr), 256);
	zassert_equal(psa_get_key_algorithm(&attr), PSA_ALG_ECDSA(PSA_ALG_ANY_HASH),
		      "TLS must be able to choose the hash");
	zassert_false(PSA_KEY_LIFETIME_IS_VOLATILE(psa_get_key_lifetime(&attr)),
		      "key must be persistent");
	zassert_false(psa_get_key_usage_flags(&attr) & PSA_KEY_USAGE_EXPORT,
		      "key must not be exportable");
	zassert_true(psa_get_key_usage_flags(&attr) & PSA_KEY_USAGE_SIGN_HASH);
	zassert_true(psa_get_key_usage_flags(&attr) & PSA_KEY_USAGE_VERIFY_MESSAGE,
		      "a JWT signer verifies its signature");
	zassert_false(psa_get_key_usage_flags(&attr) & PSA_KEY_USAGE_VERIFY_HASH,
		      "key must not have usages that it does not need");
	psa_reset_key_attributes(&attr);
}

ZTEST(tls_credentials_keygen_api, test_invalid_type)
{
	zassert_equal(tls_credential_keygen_generate(TEST_SEC_TAG,
						     (enum tls_credential_keygen_type)99),
		      -EINVAL);
}

ZTEST(tls_credentials_keygen_api, test_p384)
{
	uint8_t pub[TLS_CREDENTIAL_KEYGEN_PUBKEY_MAX_SIZE];
	size_t len = 0;

	if (!IS_ENABLED(CONFIG_TLS_CREDENTIALS_KEYGEN_SECP384R1)) {
		zassert_equal(tls_credential_keygen_generate(TEST_SEC_TAG, P384), -ENOTSUP);
		return;
	}

	zassert_ok(tls_credential_keygen_generate(TEST_SEC_TAG, P384));
	zassert_ok(tls_credential_keygen_pubkey_get(TEST_SEC_TAG, pub, sizeof(pub), &len));
	zassert_equal(len, TLS_CREDENTIAL_KEYGEN_PUBKEY_MAX_SIZE,
		      "P-384 SubjectPublicKeyInfo must be %d bytes",
		      TLS_CREDENTIAL_KEYGEN_PUBKEY_MAX_SIZE);
	csr_check(TEST_SEC_TAG, MBEDTLS_MD_SHA384);
}

ZTEST(tls_credentials_keygen_api, test_large_sec_tag)
{
	zassert_ok(tls_credential_keygen_generate(TEST_SEC_TAG_LARGE, P256));
	csr_check(TEST_SEC_TAG_LARGE, MBEDTLS_MD_SHA256);
}

ZTEST(tls_credentials_keygen_api, test_raw_private_key_exists)
{
	static const uint8_t dummy[] = {0xAA};

	zassert_ok(tls_credential_add(TEST_SEC_TAG, TLS_CREDENTIAL_PRIVATE_KEY, dummy,
				      sizeof(dummy)));
	zassert_equal(tls_credential_keygen_generate(TEST_SEC_TAG, P256), -EEXIST,
		      "a tag with a private key must be rejected");
	zassert_equal(tls_credential_keygen_delete(TEST_SEC_TAG), -ENOENT,
		      "a raw private key is not a generated key");
}

ZTEST(tls_credentials_keygen_api, test_delete)
{
	psa_key_id_t id;

	zassert_ok(tls_credential_keygen_generate(TEST_SEC_TAG, P256));
	id = key_id_get(TEST_SEC_TAG);
	zassert_ok(tls_credential_keygen_delete(TEST_SEC_TAG));
	zassert_false(key_exists(id), "key must be destroyed");
	zassert_equal(tls_credential_keygen_key_id_get(TEST_SEC_TAG, &id), -ENOENT);

	zassert_equal(tls_credential_keygen_delete(TEST_SEC_TAG), -ENOENT,
		      "deleting a key that does not exist must be reported");
}

ZTEST(tls_credentials_keygen_api, test_pubkey_get)
{
	uint8_t pub[TLS_CREDENTIAL_KEYGEN_PUBKEY_MAX_SIZE];
	size_t len = 0;

	zassert_ok(tls_credential_keygen_generate(TEST_SEC_TAG, P256));

	zassert_equal(tls_credential_keygen_pubkey_get(TEST_SEC_TAG, NULL, sizeof(pub), &len),
		      -EINVAL, "NULL output must be rejected");
	zassert_equal(tls_credential_keygen_pubkey_get(TEST_SEC_TAG, pub, 64, &len), -EFBIG,
		      "a small buffer must be reported");
	zassert_ok(tls_credential_keygen_pubkey_get(TEST_SEC_TAG, pub, sizeof(pub), &len));
	zassert_equal(len, 91, "P-256 SubjectPublicKeyInfo must be 91 bytes");
	zassert_equal(pub[0], 0x30, "SubjectPublicKeyInfo must begin with a SEQUENCE tag");
}

ZTEST(tls_credentials_keygen_api, test_csr_generate)
{
	uint8_t der[512];
	size_t len = 0;

	zassert_ok(tls_credential_keygen_generate(TEST_SEC_TAG, P256));

	zassert_equal(tls_credential_keygen_csr(TEST_SEC_TAG, NULL, der, sizeof(der), &len),
		      -EINVAL, "NULL subject must be rejected");
	zassert_equal(tls_credential_keygen_csr(TEST_SEC_TAG, "not a subject", der, sizeof(der),
						&len),
		      -EINVAL, "invalid subject must be rejected");
	zassert_equal(tls_credential_keygen_csr(TEST_SEC_TAG_2, "CN=test", der, sizeof(der),
						&len),
		      -ENOENT, "missing key must be reported");

	csr_check(TEST_SEC_TAG, MBEDTLS_MD_SHA256);
}

ZTEST_SUITE(tls_credentials_keygen_range, NULL, NULL, before, NULL, NULL);

ZTEST(tls_credentials_keygen_range, test_foreign_key_rejected)
{
	uint8_t buf[512];
	size_t len;
	psa_key_id_t id;

	/* A registration that points to a key of another PSA user. */
	foreign_key_create(FOREIGN_KEY_ID, 256);
	key_register(TEST_SEC_TAG, FOREIGN_KEY_ID);

	zassert_equal(tls_credential_keygen_key_id_get(TEST_SEC_TAG, &id), -EPERM);
	zassert_equal(tls_credential_keygen_csr(TEST_SEC_TAG, "CN=test", buf, sizeof(buf), &len),
		      -EPERM, "CSR must not be signed with a foreign key");
	zassert_equal(tls_credential_keygen_pubkey_get(TEST_SEC_TAG, buf, sizeof(buf), &len),
		      -EPERM);
	zassert_equal(tls_credential_keygen_delete(TEST_SEC_TAG), -EPERM);
	zassert_true(key_exists(FOREIGN_KEY_ID), "foreign key must not be destroyed");
}

ZTEST(tls_credentials_keygen_range, test_two_sec_tags)
{
	psa_key_id_t id;
	psa_key_id_t id_2;

	zassert_ok(tls_credential_keygen_generate(TEST_SEC_TAG, P256));
	zassert_ok(tls_credential_keygen_generate(TEST_SEC_TAG_2, P256));

	id = key_id_get(TEST_SEC_TAG);
	id_2 = key_id_get(TEST_SEC_TAG_2);
	zassert_not_equal(id, id_2, "each tag must have its own key");

	/* Deleting one key keeps the other. */
	zassert_ok(tls_credential_keygen_delete(TEST_SEC_TAG));
	zassert_false(key_exists(id));
	zassert_equal(key_id_get(TEST_SEC_TAG_2), id_2);
}

ZTEST(tls_credentials_keygen_range, test_unregistered_key_kept)
{
	/* A key in the range that no tag refers to, for example after tls_credential_delete(). */
	foreign_key_create(KEY_ID_MIN, 256);

	zassert_ok(tls_credential_keygen_generate(TEST_SEC_TAG, P256));
	zassert_equal(key_id_get(TEST_SEC_TAG), KEY_ID_MIN + 1,
		      "the unregistered key ID must be skipped");
	zassert_true(key_exists(KEY_ID_MIN), "the unregistered key must not be destroyed");
}

ZTEST(tls_credentials_keygen_range, test_stale_registration_replaced)
{
	psa_key_id_t id;

	/* A power loss after the registration and before the key generation. */
	key_register(TEST_SEC_TAG, KEY_ID_MIN);
	zassert_equal(tls_credential_keygen_key_id_get(TEST_SEC_TAG, &id), -ENOENT);

	zassert_ok(tls_credential_keygen_generate(TEST_SEC_TAG, P256),
		   "a registration without a key must be replaced");
	zassert_equal(key_id_get(TEST_SEC_TAG), KEY_ID_MIN);
	zassert_true(key_exists(KEY_ID_MIN));
}

ZTEST(tls_credentials_keygen_range, test_delete_stale_registration)
{
	psa_key_id_t id;
	size_t len = sizeof(id);

	/* A power loss in delete, after the key is destroyed. */
	key_register(TEST_SEC_TAG, KEY_ID_MIN);

	zassert_ok(tls_credential_keygen_delete(TEST_SEC_TAG),
		   "a registration without a key must be removed");
	zassert_equal(tls_credential_get(TEST_SEC_TAG, TLS_CREDENTIAL_PRIVATE_KEY_PSA, &id, &len),
		      -ENOENT);
}

ZTEST(tls_credentials_keygen_range, test_stale_foreign_registration_kept)
{
	psa_key_id_t id;
	size_t len = sizeof(id);

	key_register(TEST_SEC_TAG, FOREIGN_KEY_ID);

	zassert_equal(tls_credential_keygen_generate(TEST_SEC_TAG, P256), -EEXIST,
		      "a registration of another PSA user must not be replaced");
	zassert_ok(tls_credential_get(TEST_SEC_TAG, TLS_CREDENTIAL_PRIVATE_KEY_PSA, &id, &len));
	zassert_equal(id, FOREIGN_KEY_ID);
}

ZTEST(tls_credentials_keygen_range, test_registered_key_kept)
{
	zassert_ok(tls_credential_keygen_generate(TEST_SEC_TAG, P256));
	zassert_equal(key_id_get(TEST_SEC_TAG), KEY_ID_MIN);

	zassert_ok(tls_credential_keygen_generate(TEST_SEC_TAG_2, P256));
	zassert_equal(key_id_get(TEST_SEC_TAG_2), KEY_ID_MIN + 1);
	zassert_equal(key_id_get(TEST_SEC_TAG), KEY_ID_MIN, "the first key must be kept");
}

ZTEST(tls_credentials_keygen_range, test_rollback_on_registration_failure)
{
	static const uint8_t dummy[] = {0xAA};
	const sec_tag_t fill_tags[] = {9001, 9002, 9003, 9004};

	BUILD_ASSERT(ARRAY_SIZE(fill_tags) >= CONFIG_TLS_MAX_CREDENTIALS_NUMBER,
		     "must be able to fill the whole TLS credentials store");

	/* Fill the TLS credentials store so the registration fails. */
	for (int i = 0; i < CONFIG_TLS_MAX_CREDENTIALS_NUMBER; i++) {
		zassert_ok(tls_credential_add(fill_tags[i], TLS_CREDENTIAL_CA_CERTIFICATE, dummy,
					      sizeof(dummy)));
	}

	zassert_not_equal(tls_credential_keygen_generate(TEST_SEC_TAG, P256), 0,
			  "generate must fail when the registration cannot complete");

	for (size_t i = 0; i < KEY_ID_COUNT; i++) {
		zassert_false(key_exists(KEY_ID_MIN + i),
			      "no key must be generated when the registration fails");
	}

	for (int i = 0; i < CONFIG_TLS_MAX_CREDENTIALS_NUMBER; i++) {
		(void)tls_credential_delete(fill_tags[i], TLS_CREDENTIAL_CA_CERTIFICATE);
	}
}

ZTEST(tls_credentials_keygen_api, test_csr_buffer_too_small)
{
	uint8_t der[64];
	size_t len;

	zassert_ok(tls_credential_keygen_generate(TEST_SEC_TAG, P256));
	zassert_equal(tls_credential_keygen_csr(TEST_SEC_TAG, "CN=test", der, sizeof(der), &len),
		      -EFBIG, "a small buffer must be reported");
}

ZTEST(tls_credentials_keygen_api, test_csr_size_macro)
{
	/* Short attribute names with short values have the largest encoding for their length,
	 * and "R=a" the largest of all. Mbed TLS keeps only the last value of an attribute, so
	 * each name is used once.
	 */
	static const char *const subjects[] = {
		"R=a",
		"R=a,C=a,ST=a,L=a,O=a,OU=a,CN=a,DC=a,SN=a,GN=a",
	};
	static uint8_t der[TLS_CREDENTIAL_KEYGEN_CSR_SIZE(64)];
	enum tls_credential_keygen_type type =
		IS_ENABLED(CONFIG_TLS_CREDENTIALS_KEYGEN_SECP384R1) ? P384 : P256;
	size_t len;

	zassert_ok(tls_credential_keygen_generate(TEST_SEC_TAG, type));

	for (size_t i = 0; i < ARRAY_SIZE(subjects); i++) {
		size_t size = TLS_CREDENTIAL_KEYGEN_CSR_SIZE(strlen(subjects[i]));

		zassert_ok(tls_credential_keygen_csr(TEST_SEC_TAG, subjects[i], der, size, &len),
			   "TLS_CREDENTIAL_KEYGEN_CSR_SIZE() is too small for %s", subjects[i]);
	}
}
```

## src/common.h
```c
/*
 * Copyright (c) 2026 Nordic Semiconductor ASA
 *
 * SPDX-License-Identifier: Apache-2.0
 */

#ifndef TLS_CREDENTIALS_KEYGEN_TEST_COMMON_H_
#define TLS_CREDENTIALS_KEYGEN_TEST_COMMON_H_

#include <zephyr/net/tls_credentials_keygen.h>
#include <zephyr/psa/key_ids.h>

#define TEST_SEC_TAG   42
#define TEST_SEC_TAG_2 43
/* Outside of the PSA user key ID range, as used by nRF Cloud. */
#define TEST_SEC_TAG_LARGE 16842753

#if defined(CONFIG_TLS_CREDENTIALS_KEYGEN_KEY_STORE_CUSTOM)
/* Range of the custom key store of the test, see test_store.c. */
#define KEY_ID_MIN   (ZEPHYR_PSA_APPLICATION_KEY_ID_RANGE_BEGIN + 0x1000)
#define KEY_ID_COUNT 2
#else
#define KEY_ID_MIN   ZEPHYR_PSA_TLS_CREDENTIALS_KEYGEN_KEY_ID_RANGE_BEGIN
#define KEY_ID_COUNT ZEPHYR_PSA_TLS_CREDENTIALS_KEYGEN_KEY_ID_RANGE_SIZE
#endif
/* A key of another user of PSA, outside of the reserved range. */
#define FOREIGN_KEY_ID ZEPHYR_PSA_APPLICATION_KEY_ID_RANGE_BEGIN

#define P256 TLS_CREDENTIAL_KEYGEN_ECDSA_SECP256R1
#define P384 TLS_CREDENTIAL_KEYGEN_ECDSA_SECP384R1

/* Delete the keys and registrations of the test sec tags. */
void reset_state(void);

/* Key ID of the generated key of a sec tag. Fails the test if there is none. */
psa_key_id_t key_id_get(sec_tag_t tag);

#endif /* TLS_CREDENTIALS_KEYGEN_TEST_COMMON_H_ */
```

## src/shell.c
```c
/*
 * Copyright (c) 2026 Nordic Semiconductor ASA
 *
 * SPDX-License-Identifier: Apache-2.0
 */

#include <string.h>
#include <zephyr/kernel.h>
#include <zephyr/ztest.h>
#include <zephyr/shell/shell.h>
#include <zephyr/shell/shell_dummy.h>
#include <zephyr/sys/base64.h>

#include <psa/crypto.h>
#include <mbedtls/x509_csr.h>

#include "common.h"

/* Host tools capture the command output, so the markers below are a contract. */

static const struct shell *dummy;

static void *shell_setup(void)
{
	dummy = shell_backend_dummy_get_ptr();
	WAIT_FOR(shell_ready(dummy), 20000, k_msleep(1));
	zassert_true(shell_ready(dummy), "timed out waiting for dummy shell backend");
	return NULL;
}

static void shell_before(void *fixture)
{
	ARG_UNUSED(fixture);
	reset_state();
	shell_backend_dummy_clear_output(dummy);
}

static const char *run(const char *cmd, int *ret)
{
	size_t size;
	int r;

	shell_backend_dummy_clear_output(dummy);
	r = shell_execute_cmd(dummy, cmd);
	if (ret != NULL) {
		*ret = r;
	}
	return shell_backend_dummy_get_output(dummy, &size);
}

/* Copy the token that follows @p prefix in @p out. Returns its length, or 0 if not found. */
static size_t token_after(const char *out, const char *prefix, char *tok, size_t tok_size)
{
	const char *p = strstr(out, prefix);
	size_t i = 0;

	if (p == NULL) {
		return 0;
	}
	p += strlen(prefix);

	while (p[i] != '\0' && p[i] != '\r' && p[i] != '\n' && p[i] != ' ' && i < tok_size - 1) {
		tok[i] = p[i];
		i++;
	}
	tok[i] = '\0';

	return i;
}

ZTEST_SUITE(tls_credentials_keygen_shell, NULL, shell_setup, shell_before, NULL, NULL);

ZTEST(tls_credentials_keygen_shell, test_keygen)
{
	psa_key_id_t id;
	int ret;
	const char *out = run("cred keygen 42", &ret);

	zassert_ok(ret, "keygen command returned %d", ret);
	zassert_not_null(strstr(out, "Generated device key in sec tag 42"),
			 "missing success line, got: %s", out);
	zassert_ok(tls_credential_keygen_key_id_get(TEST_SEC_TAG, &id),
		   "key not created by shell command");
}

ZTEST(tls_credentials_keygen_shell, test_keygen_type)
{
	psa_key_attributes_t attr = PSA_KEY_ATTRIBUTES_INIT;
	int ret;

	(void)run("cred keygen 42 p384", &ret);
	if (!IS_ENABLED(CONFIG_TLS_CREDENTIALS_KEYGEN_SECP384R1)) {
		zassert_not_equal(ret, 0, "disabled key type must be rejected");
		return;
	}

	zassert_ok(ret, "keygen command returned %d", ret);
	zassert_equal(psa_get_key_attributes(key_id_get(TEST_SEC_TAG), &attr), PSA_SUCCESS);
	zassert_equal(psa_get_key_bits(&attr), 384);
	psa_reset_key_attributes(&attr);

	(void)run("cred keygen 43 p521", &ret);
	zassert_not_equal(ret, 0, "unknown key type must be rejected");
}

ZTEST(tls_credentials_keygen_shell, test_keygen_already_exists)
{
	int ret;
	const char *out;

	(void)run("cred keygen 42", NULL);
	out = run("cred keygen 42", &ret);

	zassert_not_equal(ret, 0, "second keygen should fail");
	zassert_not_null(strstr(out, "already exists"), "missing warning, got: %s", out);
	zassert_not_null(strstr(out, "keydel"), "should point user to 'keydel', got: %s", out);
}

ZTEST(tls_credentials_keygen_shell, test_csr)
{
	int ret;
	const char *out;
	char tok[1024];
	uint8_t der[512];
	size_t tok_len;
	size_t der_len = 0;
	mbedtls_x509_csr csr;

	(void)run("cred keygen 42", NULL);
	out = run("cred csr 42 CN=test,O=Nordic", &ret);

	zassert_ok(ret, "csr command returned %d", ret);
	zassert_not_null(strstr(out, "CSR generation complete"),
			 "missing completion marker, got: %s", out);

	/* A truncated line would decode to a DER that does not parse. */
	tok_len = token_after(out, "CSR: ", tok, sizeof(tok));
	zassert_true(tok_len > 0, "no CSR token in output: %s", out);
	zassert_ok(base64_decode(der, sizeof(der), &der_len, tok, tok_len),
		   "CSR Base64 does not decode");

	mbedtls_x509_csr_init(&csr);
	zassert_equal(mbedtls_x509_csr_parse_der(&csr, der, der_len), 0,
		      "decoded CSR does not parse");
	mbedtls_x509_csr_free(&csr);
}

ZTEST(tls_credentials_keygen_shell, test_csr_requires_subject)
{
	int ret;

	(void)run("cred keygen 42", NULL);
	(void)run("cred csr 42", &ret);

	zassert_not_equal(ret, 0, "csr without a subject should fail");
}

ZTEST(tls_credentials_keygen_shell, test_csr_invalid_subject)
{
	int ret;
	const char *out;

	(void)run("cred keygen 42", NULL);
	out = run("cred csr 42 notasubject", &ret);

	zassert_not_equal(ret, 0, "csr with an invalid subject should fail");
	zassert_not_null(strstr(out, "CSR generation failed"), "missing error, got: %s", out);
}

ZTEST(tls_credentials_keygen_shell, test_pubkey)
{
	int ret;
	const char *out;
	char tok[160];
	uint8_t dec[100];
	size_t tok_len;
	size_t dec_len = 0;

	(void)run("cred keygen 42", NULL);
	out = run("cred pubkey 42", &ret);

	zassert_ok(ret, "pubkey command returned %d", ret);
	zassert_not_null(strstr(out, "Public key export complete"),
			 "missing completion marker, got: %s", out);

	/* A 91-byte P-256 SubjectPublicKeyInfo is exactly 124 Base64 characters. */
	tok_len = token_after(out, "PUBKEY: ", tok, sizeof(tok));
	zassert_equal(tok_len, 124, "public key Base64 length %zu != 124", tok_len);
	zassert_ok(base64_decode(dec, sizeof(dec), &dec_len, tok, tok_len),
		   "public key Base64 does not decode");
	zassert_equal(dec_len, 91, "decoded public key is %zu bytes, expected 91", dec_len);
	zassert_equal(dec[0], 0x30, "decoded public key is not a SubjectPublicKeyInfo");
}

ZTEST(tls_credentials_keygen_shell, test_keydel)
{
	psa_key_id_t id;
	int ret;
	const char *out;

	(void)run("cred keygen 42", NULL);
	out = run("cred keydel 42", &ret);

	zassert_ok(ret, "keydel command returned %d", ret);
	zassert_not_null(strstr(out, "Deleted device key in sec tag 42"),
			 "missing delete confirmation, got: %s", out);
	zassert_equal(tls_credential_keygen_key_id_get(TEST_SEC_TAG, &id), -ENOENT,
		      "key still present after shell delete");
}

ZTEST(tls_credentials_keygen_shell, test_invalid_sec_tag)
{
	int ret;
	const char *out = run("cred keygen notanumber", &ret);

	zassert_not_equal(ret, 0, "invalid sec tag should fail");
	zassert_not_null(strstr(out, "not a valid sectag"), "missing error, got: %s", out);
}

ZTEST(tls_credentials_keygen_shell, test_keydel_without_key)
{
	int ret;
	const char *out = run("cred keydel 42", &ret);

	zassert_not_equal(ret, 0, "keydel without a key should fail");
	zassert_not_null(strstr(out, "Key deletion failed"), "missing error, got: %s", out);
}

ZTEST(tls_credentials_keygen_shell, test_csr_too_large)
{
	static char cmd[180];
	int ret;
	const char *out;
	size_t len;

	(void)run("cred keygen 42", NULL);

	/* The test sets a small CSR buffer, which this common name does not fit. */
	len = snprintk(cmd, sizeof(cmd), "cred csr 42 CN=");
	memset(&cmd[len], 'a', sizeof(cmd) - len - 1);
	out = run(cmd, &ret);

	zassert_not_equal(ret, 0, "a CSR that does not fit should fail");
	zassert_not_null(strstr(out, "CONFIG_TLS_CREDENTIALS_SHELL_KEYGEN_CSR_BUF_SIZE"),
			 "missing hint, got: %s", out);
}
```

## src/test_store.c
```c
/*
 * Copyright (c) 2026 Nordic Semiconductor ASA
 *
 * SPDX-License-Identifier: Apache-2.0
 */

#include <errno.h>
#include <zephyr/net/tls_credentials_keygen_store.h>
#include <zephyr/sys/util.h>
#include <psa/crypto.h>

#include "common.h"

/* A custom key store with a small range of its own. */

int tls_credential_keygen_store_attr_set(enum tls_credential_keygen_type type,
					 psa_key_attributes_t *attr)
{
	ARG_UNUSED(type);

	psa_set_key_lifetime(attr, PSA_KEY_LIFETIME_PERSISTENT);

	return 0;
}

bool tls_credential_keygen_store_id_is_own(psa_key_id_t key_id)
{
	return key_id >= KEY_ID_MIN && key_id - KEY_ID_MIN < KEY_ID_COUNT;
}

static psa_key_id_t key_id_at(size_t index)
{
	return KEY_ID_MIN + index;
}

int tls_credential_keygen_store_id_alloc(sec_tag_t tag, enum tls_credential_keygen_type type,
					 const psa_key_id_t *used, size_t used_count,
					 psa_key_id_t *key_id)
{
	ARG_UNUSED(tag);
	ARG_UNUSED(type);

	return tls_credential_keygen_store_id_pick(KEY_ID_COUNT, key_id_at, used, used_count,
						   key_id);
}
```
