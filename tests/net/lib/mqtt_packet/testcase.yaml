## tests/net/lib/mqtt_packet/testcase.yaml
```yaml
common:
  pre-filter: subsys_dt_compat_enabled("ethernet")
tests:
  net.mqtt.packet:
    min_ram: 16
    tags: mqtt net userspace
```

## tests/net/lib/mqtt_publisher/boards/cc3220sf_launchxl.conf
```kconfig
# Networking Config:
CONFIG_NET_IPV4=y
CONFIG_NET_IPV6=n
CONFIG_NET_SOCKETS=y
CONFIG_NET_NATIVE=n

# Enable SimpleLink WiFi Driver and Socket Offload
CONFIG_WIFI=y
CONFIG_WIFI_SIMPLELINK=y
CONFIG_NET_SOCKETS_OFFLOAD=y

# Enable Secure Socket Offload
CONFIG_TLS_CREDENTIAL_FILENAMES=y

# Disable unneeded settings from the base prj.conf:
CONFIG_DNS_RESOLVER=n
CONFIG_NET_CONFIG_SETTINGS=n
CONFIG_NET_CONFIG_MY_IPV4_ADDR=""
CONFIG_NET_CONFIG_PEER_IPV4_ADDR=""

# Debugging
CONFIG_NET_LOG=y
CONFIG_WIFI_LOG_LEVEL_DBG=y
CONFIG_DEBUG=y
CONFIG_ASSERT=y
```

## tests/net/lib/mqtt_publisher/testcase.yaml
```yaml
common:
  tags:
    - net
    - mqtt
  harness: net
  depends_on: netif
tests:
  net.mqtt:
    min_ram: 16
  net.mqtt.tls:
    min_ram: 16
    extra_args: CONF_FILE="prj_tls.conf"
    extra_configs:
      - CONFIG_NET_PKT_RX_COUNT=20
      - CONFIG_NET_PKT_TX_COUNT=20
      - CONFIG_NET_BUF_RX_COUNT=20
      - CONFIG_NET_BUF_TX_COUNT=20
```

## tests/net/lib/mqtt_pubsub/testcase.yaml
```yaml
common:
  depends_on: netif
  min_ram: 16
  tags:
    - net
    - mqtt
  harness: net
tests:
  net.mqtt.pubsub:
    extra_configs:
      - CONFIG_NET_TC_THREAD_COOPERATIVE=y
  net.mqtt.pubsub.preempt:
    extra_configs:
      - CONFIG_NET_TC_THREAD_PREEMPTIVE=y
```

## tests/net/lib/mqtt_sn_client/testcase.yaml
```yaml
common:
  depends_on: netif
tests:
  net.mqtt_sn.client:
    min_ram: 16
    tags: mqtt_sn net
```

## tests/net/lib/mqtt_sn_packet/testcase.yaml
```yaml
tests:
  net.mqtt_sn.packet:
    min_ram: 16
    tags:
      - mqtt_sn
      - net
  platform_exclude:
    - nrf7120dk/nrf7120/cpuapp
```

## tests/net/lib/mqtt_sn_udp/testcase.yaml
```yaml
common:
  depends_on: netif
  tags:
    - mqtt_sn
    - net

tests:
  net.mqtt_sn.udp.v4:
    min_ram: 16
    harness: pytest
    harness_config:
      pytest_dut_scope: function
    extra_configs:
      - arch:posix:CONFIG_UART_NATIVE_PTY_0_ON_STDINOUT=y
    extra_overlay_confs:
      - ipv4.conf
    integration_platforms:
      - native_sim
      - native_sim/native/64

  net.mqtt_sn.udp.v6:
    min_ram: 16
    harness: pytest
    harness_config:
      pytest_dut_scope: function
    extra_configs:
      - arch:posix:CONFIG_UART_NATIVE_PTY_0_ON_STDINOUT=y
    extra_overlay_confs:
      - ipv6.conf
    integration_platforms:
      - native_sim
      - native_sim/native/64

  net.mqtt_sn.udp.v4v6:
    min_ram: 16
    harness: pytest
    harness_config:
      pytest_dut_scope: function
    extra_configs:
      - arch:posix:CONFIG_UART_NATIVE_PTY_0_ON_STDINOUT=y
    extra_overlay_confs:
      - ipv4.conf
      - ipv6.conf
    integration_platforms:
      - native_sim
      - native_sim/native/64
```

## tests/net/lib/mqtt_subscriber/testcase.yaml
```yaml
common:
  depends_on: netif
  min_ram: 16
  tags: net mqtt
  harness: net
tests:
  net.mqtt.subscriber:
    extra_configs:
      - CONFIG_NET_TC_THREAD_COOPERATIVE=y
  net.mqtt.subscriber.preempt:
    extra_configs:
      - CONFIG_NET_TC_THREAD_PREEMPTIVE=y
```

## tests/net/lib/ocpp/testcase.yaml
```yaml
tests:
  net.ocpp:
    depends_on: netif
    slow: true
    build_only: true
    platform_allow:
      - native_sim/native
    min_ram: 16
    tags:
      - net
      - ocpp
```

## tests/net/lib/prometheus/collector/testcase.yaml
```yaml
tests:
  # section.subsection
  net.prometheus.collector:
    depends_on: netif
    integration_platforms:
      - native_sim
      - qemu_x86
    tags: prometheus
```

## tests/net/lib/prometheus/counter/testcase.yaml
```yaml
tests:
  # section.subsection
  net.prometheus.counter:
    depends_on: netif
    integration_platforms:
      - native_sim
      - qemu_x86
    tags: prometheus
```

## tests/net/lib/prometheus/formatter/testcase.yaml
```yaml
tests:
  # section.subsection
  net.prometheus.formatter:
    depends_on: netif
    integration_platforms:
      - native_sim
      - qemu_x86
    tags: prometheus
```

## tests/net/lib/prometheus/gauge/testcase.yaml
```yaml
tests:
  # section.subsection
  net.prometheus.gauge:
    depends_on: netif
    integration_platforms:
      - native_sim
      - qemu_x86
    platform_exclude:
      - native_posix
      - native_posix/native/64
    tags: prometheus
```

## tests/net/lib/prometheus/histogram/testcase.yaml
```yaml
tests:
  # section.subsection
  prometheus.histogram:
    integration_platforms:
      - native_sim
      - qemu_x86
    platform_exclude:
      - native_posix
      - native_posix/native/64
    tags: prometheus
```

## tests/net/lib/quic/testcase.yaml
```yaml
common:
  depends_on: netif
  min_ram: 80
  min_flash: 194
  tags:
    - net
    - socket
    - quic
  integration_platforms:
    - native_sim
    - qemu_x86
tests:
  net.quic:
    platform_allow:
      - native_sim
      - qemu_x86
```

## tests/net/lib/ssh/ssh_server/testcase.yaml
```yaml
common:
  tags:
    - ssh
    - net
  depends_on: netif
  platform_allow: native_sim
tests:
  net.ssh.server: {}
```

## tests/net/lib/tftp/testcase.yaml
```yaml
tests:
  net.lib.tftp.server:
    tags: net tftp
    platform_allow: native_sim
    harness: ztest
```

## tests/net/lib/tls_credentials/testcase.yaml
```yaml
tests:
  net.tls_credentials:
    tags:
      - net
      - tls
    depends_on: netif
  net.tls_credentials.parse_crt:
    tags:
      - net
      - tls
      - mbedtls
    depends_on: netif
    extra_args: EXTRA_CONF_FILE="./prj_parse_crt.conf"
  net.tls_credentials.trusted_tfm:
    filter: CONFIG_BUILD_WITH_TFM
    extra_args: EXTRA_CONF_FILE="./prj_trusted_tfm.conf"
    tags:
      - net
      - tls
      - trusted-firmware-m
  net.tls_credentials.trusted_tfm.parse_crt:
    filter: CONFIG_BUILD_WITH_TFM
    extra_args: EXTRA_CONF_FILE="./prj_trusted_tfm.conf;./prj_parse_crt.conf"
    tags:
      - net
      - tls
      - trusted-firmware-m
      - mbedtls
```

## tests/net/lib/wifi_credentials/testcase.yaml
```yaml
tests:
  net.wifi_credentials:
    tags:
      - net
    integration_platforms:
      - native_sim
```

## tests/net/lib/wifi_credentials_backend_psa/Kconfig
```kconfig
#
# Copyright (c) 2026 Nordic Semiconductor ASA
#
# SPDX-License-Identifier: Apache-2.0
#

# This test mocks PSA Crypto API so the following option must be set by the test
# to enable Kconfig options that define reserved persistent key ID ranges.
config PSA_CRYPTO_PERSISTENT_KEYS
	default y

source "Kconfig.zephyr"
```

## tests/net/lib/wifi_credentials_backend_psa/testcase.yaml
```yaml
tests:
  net.wifi_credentials_backend_psa:
    tags:
      - net
    platform_allow:
      - native_sim
    integration_platforms:
      - native_sim
```

## tests/net/lib/wifi_credentials_backend_settings/testcase.yaml
```yaml
tests:
  net.wifi_credentials_backend_settings:
    tags:
      - net
    platform_allow:
      - native_sim
    integration_platforms:
      - native_sim
```

## tests/net/lib/wireguard/testcase.yaml
```yaml
tests:
  net.wireguard:
    platform_allow: native_sim
    tags:
      - net
      - wireguard
    depends_on: netif
```

## tests/net/mgmt/testcase.yaml
```yaml
common:
  depends_on: netif
  min_ram: 16
  tags:
    - net
    - mgmt
tests:
  net.management:
    extra_configs:
      - CONFIG_NET_TC_THREAD_COOPERATIVE=y
  net.management.preempt:
    extra_configs:
      - CONFIG_NET_TC_THREAD_PREEMPTIVE=y
  net.workqueue:
    extra_configs:
      - CONFIG_NET_MGMT_EVENT_SYSTEM_WORKQUEUE=y
  net.synchronous:
    extra_configs:
      - CONFIG_NET_MGMT_EVENT_DIRECT=y
```
