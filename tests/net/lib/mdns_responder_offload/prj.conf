## CMakeLists.txt
```
# SPDX-FileCopyrightText: Copyright The Zephyr Project Contributors
# SPDX-License-Identifier: Apache-2.0

cmake_minimum_required(VERSION 3.28.0)

find_package(Zephyr REQUIRED HINTS $ENV{ZEPHYR_BASE})
project(mdns_responder_offload)

target_sources(app PRIVATE src/main.c)
```

## prj.conf
```kconfig
# SPDX-FileCopyrightText: Copyright The Zephyr Project Contributors
# SPDX-License-Identifier: Apache-2.0

# Networking
CONFIG_NETWORKING=y
CONFIG_NET_IPV6=y
CONFIG_NET_IPV4=y

# Use the host network stack through offloaded sockets (NSOS) instead of the
# native TAP driver. The mDNS responder then binds host sockets and joins the
# mDNS multicast group on the host, so a host-side query can reach it.
CONFIG_ETH_NATIVE_TAP=n
CONFIG_NET_DRIVERS=y
CONFIG_NET_SOCKETS_OFFLOAD=y
CONFIG_NET_NATIVE_OFFLOADED_SOCKETS=y
CONFIG_ZVFS_POLL_MAX=10

# mDNS responder with a DNS-SD service, answering for "zephyr.local".
CONFIG_NET_HOSTNAME_ENABLE=y
CONFIG_NET_HOSTNAME="zephyr"
CONFIG_MDNS_RESPONDER=y
CONFIG_DNS_SD=y

# Logging (the ready marker printed by the app).
CONFIG_LOG=y
```

## src/main.c
```c
/*
 * SPDX-FileCopyrightText: Copyright The Zephyr Project Contributors
 * SPDX-License-Identifier: Apache-2.0
 */

#include <zephyr/kernel.h>
#include <zephyr/net/dns_sd.h>
#include <zephyr/net/socket.h>
#include <zephyr/logging/log.h>

LOG_MODULE_REGISTER(mdns_offload_test, LOG_LEVEL_INF);

#define SERVICE_PORT 4242

/* Advertise a DNS-SD service so the host can resolve the responder's
 * hostname (and thus its A/AAAA records) through the offloaded sockets.
 */
DNS_SD_REGISTER_TCP_SERVICE(mdns_offload, CONFIG_NET_HOSTNAME, "_zephyr", "local", DNS_SD_EMPTY_TXT,
			    SERVICE_PORT);

/* Open a listening TCP socket bound to the service port so DNS-SD advertises
 * the service: the responder only answers the browse once the port is actually
 * in use. With offloaded sockets the binding lives in the offload engine, and
 * the socket layer records it for the port-in-use check.
 */
static int listen_on_service_port(net_sa_family_t family)
{
	struct net_sockaddr_in6 addr6 = {
		.sin6_family = NET_AF_INET6,
		.sin6_addr = net_in6addr_any,
		.sin6_port = net_htons(SERVICE_PORT),
	};
	struct net_sockaddr_in addr4 = {
		.sin_family = NET_AF_INET,
		.sin_addr.s_addr = NET_INADDR_ANY,
		.sin_port = net_htons(SERVICE_PORT),
	};
	struct net_sockaddr *addr;
	net_socklen_t addrlen;
	int sock;

	if (family == NET_AF_INET6) {
		addr = (struct net_sockaddr *)&addr6;
		addrlen = sizeof(addr6);
	} else {
		addr = (struct net_sockaddr *)&addr4;
		addrlen = sizeof(addr4);
	}

	sock = zsock_socket(family, NET_SOCK_STREAM, NET_IPPROTO_TCP);
	if (sock < 0) {
		LOG_ERR("Cannot create service socket (%d)", -errno);
		return -errno;
	}

	if (family == NET_AF_INET6) {
		int v6only = 1;

		if (zsock_setsockopt(sock, NET_IPPROTO_IPV6, ZSOCK_IPV6_V6ONLY, &v6only,
				     sizeof(v6only)) < 0) {
			LOG_ERR("Cannot set ZSOCK_IPV6_V6ONLY on service socket (%d)", -errno);
			zsock_close(sock);
			return -errno;
		}
	}

	if (zsock_bind(sock, addr, addrlen) < 0) {
		LOG_ERR("Cannot bind service socket (%d)", -errno);
		zsock_close(sock);
		return -errno;
	}

	if (zsock_listen(sock, 1) < 0) {
		LOG_ERR("Cannot listen on service socket (%d)", -errno);
		zsock_close(sock);
		return -errno;
	}

	return sock;
}

int main(void)
{
	/* The offloaded interface comes up and mirrors the host addresses at
	 * boot; the mDNS responder then runs on its own, without application
	 * interaction. Bind the advertised service port so the responder
	 * answers for it, then signal readiness to the host-side test harness.
	 */
	if (IS_ENABLED(CONFIG_NET_IPV6)) {
		(void)listen_on_service_port(NET_AF_INET6);
	}

	if (IS_ENABLED(CONFIG_NET_IPV4)) {
		(void)listen_on_service_port(NET_AF_INET);
	}

	LOG_INF("mDNS offload responder ready");

	return 0;
}
```
