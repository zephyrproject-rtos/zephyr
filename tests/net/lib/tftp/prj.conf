## CMakeLists.txt
```
# SPDX-FileCopyrightText: Copyright The Zephyr Project Contributors
# SPDX-License-Identifier: Apache-2.0

cmake_minimum_required(VERSION 3.28.0)

find_package(Zephyr REQUIRED HINTS $ENV{ZEPHYR_BASE})
project(tftp_client)

target_include_directories(app PRIVATE ${ZEPHYR_BASE}/subsys/net/ip)
target_include_directories(app PRIVATE ${ZEPHYR_BASE}/subsys/net/lib/tftp)
target_sources(app PRIVATE src/main.c src/make_request.c src/error_response.c)
```

## prj.conf
```kconfig
# SPDX-FileCopyrightText: Copyright The Zephyr Project Contributors
# SPDX-FileCopyrightText: Copyright (c) 2026 DevItWise
# SPDX-License-Identifier: Apache-2.0

CONFIG_ZTEST=y

CONFIG_NETWORKING=y
CONFIG_NET_IPV4=y
CONFIG_NET_IPV6=y
CONFIG_NET_UDP=y
CONFIG_NET_SOCKETS=y

CONFIG_NET_IF_UNICAST_IPV4_ADDR_COUNT=4
CONFIG_NET_IF_UNICAST_IPV6_ADDR_COUNT=6
CONFIG_NET_IF_MCAST_IPV6_ADDR_COUNT=6

CONFIG_NET_IPV6_DAD=n

CONFIG_NET_DRIVERS=y
CONFIG_NET_LOOPBACK=y
CONFIG_NET_L2_ETHERNET=n
CONFIG_NET_TEST=y

CONFIG_TFTP_LIB=y

CONFIG_TFTPC_REQUEST_TIMEOUT=200

CONFIG_MAIN_STACK_SIZE=4096
CONFIG_ZTEST_STACK_SIZE=4096
```

## boards/native_sim.overlay
```dts
/*
 * Copyright (c) 2026 Guy Shilman
 *
 * SPDX-License-Identifier: Apache-2.0
 */

/ {
	fstab {
		compatible = "zephyr,fstab";

		tftp_ramfs: tftp_ramfs {
			compatible = "zephyr,fstab,ext2";
			disk-access;
			disk-name = "RAM";
			mount-point = "/RAM";
		};
	};

	ramdisk0 {
		compatible = "zephyr,ram-disk";
		disk-name = "RAM";
		sector-size = <512>;
		sector-count = <256>;
	};
};
```

## src/main.c
```c
/*
 * SPDX-FileCopyrightText: Copyright The Zephyr Project Contributors
 * SPDX-FileCopyrightText: Copyright (c) 2026 DevItWise
 * SPDX-License-Identifier: Apache-2.0
 */

#include <errno.h>
#include <stdint.h>

#include <zephyr/kernel.h>
#include <zephyr/logging/log.h>
#include <zephyr/net/net_if.h>
#include <zephyr/net/net_ip.h>
#include <zephyr/net/socket.h>
#include <zephyr/net/tftp.h>
#include <zephyr/sys/byteorder.h>
#include <zephyr/ztest.h>

LOG_MODULE_REGISTER(tftp_client_test, LOG_LEVEL_INF);

#include "net_private.h"

#define SERVER_PORT 69

#define DATA_OPCODE  3
#define ERROR_OPCODE 5

#define TFTP_ERROR_DISK_FULL 3

#define TFTP_BLOCK_SIZE 512

#define V4_SERVER      "127.0.0.1"
#define V4_SAME_PREFIX "127.0.0.2"
#define V4_OFF_PREFIX  "192.0.2.2"

#define V6_SERVER      "2001:db8::1"
#define V6_SAME_PREFIX "2001:db8::2"
#define V6_OFF_PREFIX  "2001:db8:1::2"

#define SERVER_WAIT_MS 300

#define FORGED_BURST     8
#define FORGED_RUNT_LEN  2
#define REQUEST_COUNT_MS 600

static K_THREAD_STACK_DEFINE(server_stack, 2048);
static struct k_thread server_thread;

static struct tftpc client;

static bool saw_data;
static bool saw_error;
static size_t seen_data_len;
static size_t seen_data_total;
static uint8_t seen_first_byte;
static int seen_error_code;

static int request_fd = -1;
static int reply_fd = -1;
static int attacker_fd = -1;

static sa_family_t family;
static const char *server_addr_str;

static bool zero_server_addr_on_request;

static bool forge_second_block;

static bool forge_before_connect;

static bool forge_burst_before_reply;
static int seen_requests;

#define MAX_ADDED 3
static struct {
	sa_family_t family;
	union {
		struct in_addr v4;
		struct in6_addr v6;
	} addr;
} added[MAX_ADDED];
static int added_count;

static void tftp_cb(const struct tftp_evt *evt)
{
	switch (evt->type) {
	case TFTP_EVT_DATA:
		saw_data = true;
		seen_data_len = evt->param.data.len;
		seen_data_total += evt->param.data.len;
		if (evt->param.data.len > 0) {
			seen_first_byte = evt->param.data.data_ptr[0];
		}
		break;
	case TFTP_EVT_ERROR:
		saw_error = true;
		seen_error_code = evt->param.error.code;
		break;
	default:
		break;
	}
}

static void parse_addr(const char *str, void *out)
{
	zassert_equal(zsock_inet_pton(family, str, out), 1, "could not parse %s", str);
}

static void iface_add_addr(const char *str)
{
	struct net_if *iface = net_if_get_default();

	zassert_not_null(iface, "no default network interface");
	zassert_true(added_count < MAX_ADDED, "too many interface addresses in one case");

	added[added_count].family = family;

	if (family == AF_INET6) {
		parse_addr(str, &added[added_count].addr.v6);
		zassert_not_null(net_if_ipv6_addr_add(iface, &added[added_count].addr.v6,
						      NET_ADDR_MANUAL, 0),
				 "could not add %s to the interface", str);
	} else {
		parse_addr(str, &added[added_count].addr.v4);
		zassert_not_null(net_if_ipv4_addr_add(iface, &added[added_count].addr.v4,
						      NET_ADDR_MANUAL, 0),
				 "could not add %s to the interface", str);
	}

	added_count++;
}

static void iface_drop_addrs(void)
{
	struct net_if *iface = net_if_get_default();

	while (added_count > 0) {
		added_count--;

		if (iface == NULL) {
			continue;
		}

		if (added[added_count].family == AF_INET6) {
			(void)net_if_ipv6_addr_rm(iface, &added[added_count].addr.v6);
		} else {
			(void)net_if_ipv4_addr_rm(iface, &added[added_count].addr.v4);
		}
	}
}

static int bind_loopback(const char *addr_str, uint16_t port)
{
	struct sockaddr_storage addr = {
		.ss_family = family,
	};
	socklen_t addr_len;
	int fd;

	if (family == AF_INET6) {
		struct sockaddr_in6 *a6 = (struct sockaddr_in6 *)&addr;

		a6->sin6_port = htons(port);
		parse_addr(addr_str, &a6->sin6_addr);
		addr_len = sizeof(*a6);
	} else {
		struct sockaddr_in *a4 = (struct sockaddr_in *)&addr;

		a4->sin_port = htons(port);
		parse_addr(addr_str, &a4->sin_addr);
		addr_len = sizeof(*a4);
	}

	fd = zsock_socket(family, SOCK_DGRAM, IPPROTO_UDP);
	zassert_true(fd >= 0, "could not open a UDP socket");

	if (zsock_bind(fd, (struct sockaddr *)&addr, addr_len) < 0) {
		int err = errno;

		(void)zsock_close(fd);
		zassert_unreachable("could not bind to [%s]:%u, err %d", addr_str, port, err);
	}

	return fd;
}

static void setup_server(sa_family_t af)
{
	family = af;

	if (family == AF_INET6) {
		struct sockaddr_in6 *a6 = (struct sockaddr_in6 *)&client.server;

		server_addr_str = V6_SERVER;
		iface_add_addr(server_addr_str);

		a6->sin6_family = AF_INET6;
		a6->sin6_port = htons(SERVER_PORT);
		parse_addr(server_addr_str, &a6->sin6_addr);
	} else {
		struct sockaddr_in *a4 = (struct sockaddr_in *)&client.server;

		server_addr_str = V4_SERVER;

		a4->sin_family = AF_INET;
		a4->sin_port = htons(SERVER_PORT);
		parse_addr(server_addr_str, &a4->sin_addr);
	}

	request_fd = bind_loopback(server_addr_str, SERVER_PORT);
	reply_fd = bind_loopback(server_addr_str, 0);
}

static void setup_attacker(const char *addr_str)
{
	iface_add_addr(addr_str);
	attacker_fd = bind_loopback(addr_str, 0);
}

static void setup_attacker_on_server_address(void)
{
	attacker_fd = bind_loopback(server_addr_str, 0);
}

static void send_data_block(int fd, uint16_t block_no, uint8_t fill, size_t payload,
			    const struct sockaddr *to, socklen_t to_len)
{
	uint8_t buf[TFTP_HEADER_SIZE + TFTP_BLOCK_SIZE];

	sys_put_be16(DATA_OPCODE, buf);
	sys_put_be16(block_no, buf + 2);
	memset(buf + TFTP_HEADER_SIZE, fill, payload);

	(void)zsock_sendto(fd, buf, TFTP_HEADER_SIZE + payload, 0, to, to_len);
}

static void server_fn(void *a, void *b, void *c)
{
	struct sockaddr_storage from;
	socklen_t from_len = sizeof(from);
	struct sockaddr *from_sa = (struct sockaddr *)&from;
	uint8_t request[64];
	struct zsock_pollfd fds = {
		.fd = request_fd,
		.events = ZSOCK_POLLIN,
	};

	ARG_UNUSED(a);
	ARG_UNUSED(b);
	ARG_UNUSED(c);

	if (zsock_poll(&fds, 1, SERVER_WAIT_MS) <= 0) {
		return;
	}

	if (zsock_recvfrom(request_fd, request, sizeof(request), 0, from_sa, &from_len) < 0) {
		return;
	}

	seen_requests++;

	if (zero_server_addr_on_request) {
		if (family == AF_INET6) {
			struct sockaddr_in6 *a6 =
				(struct sockaddr_in6 *)&client.server;

			memset(&a6->sin6_addr, 0, sizeof(a6->sin6_addr));
		} else {
			struct sockaddr_in *a4 = (struct sockaddr_in *)&client.server;

			a4->sin_addr.s_addr = 0;
		}
	}

	if (forge_before_connect) {
		send_data_block(reply_fd, 1, 's', TFTP_BLOCK_SIZE, from_sa, from_len);
		send_data_block(attacker_fd, 2, 'a', 4, from_sa, from_len);

		fds.fd = reply_fd;
		if (zsock_poll(&fds, 1, SERVER_WAIT_MS) <= 0) {
			return;
		}

		from_len = sizeof(from);
		if (zsock_recvfrom(reply_fd, request, sizeof(request), 0, from_sa, &from_len) < 0) {
			return;
		}

		send_data_block(reply_fd, 2, 's', 4, from_sa, from_len);
		return;
	}

	if (forge_burst_before_reply) {
		static const uint8_t runt[FORGED_RUNT_LEN];
		int64_t until;

		for (int i = 0; i < FORGED_BURST; i++) {
			(void)zsock_sendto(attacker_fd, runt, sizeof(runt), 0, from_sa, from_len);
		}

		send_data_block(reply_fd, 1, 'x', 4, from_sa, from_len);

		until = k_uptime_get() + REQUEST_COUNT_MS;
		while (k_uptime_get() < until) {
			int64_t left = until - k_uptime_get();

			if (zsock_poll(&fds, 1, (int)left) <= 0) {
				break;
			}

			from_len = sizeof(from);
			if (zsock_recvfrom(request_fd, request, sizeof(request), 0, from_sa,
					   &from_len) < 0) {
				break;
			}

			seen_requests++;
		}

		return;
	}

	if (attacker_fd >= 0 && !forge_second_block) {
		uint8_t forged[TFTP_HEADER_SIZE];

		sys_put_be16(ERROR_OPCODE, forged);
		sys_put_be16(TFTP_ERROR_DISK_FULL, forged + 2);

		(void)zsock_sendto(attacker_fd, forged, sizeof(forged), 0, from_sa, from_len);
	}

	if (!forge_second_block) {
		send_data_block(reply_fd, 1, 'x', 4, from_sa, from_len);
		return;
	}

	send_data_block(reply_fd, 1, 's', TFTP_BLOCK_SIZE, from_sa, from_len);

	fds.fd = reply_fd;
	if (zsock_poll(&fds, 1, SERVER_WAIT_MS) <= 0) {
		return;
	}

	if (zsock_recvfrom(reply_fd, request, sizeof(request), 0, from_sa, &from_len) < 0) {
		return;
	}

	send_data_block(attacker_fd, 2, 'a', 4, from_sa, from_len);
	send_data_block(reply_fd, 2, 's', 4, from_sa, from_len);
}

static int run_transfer_ret(void)
{
	k_tid_t tid;
	int ret;

	tid = k_thread_create(&server_thread, server_stack, K_THREAD_STACK_SIZEOF(server_stack),
			      server_fn, NULL, NULL, NULL, K_PRIO_COOP(0), 0, K_NO_WAIT);

	ret = tftp_get(&client, "file", "octet");

	zassert_ok(k_thread_join(tid, K_SECONDS(5)), "the server thread did not finish");

	return ret;
}

static void run_transfer(void)
{
	zassert_equal(run_transfer_ret(), 4, "the transfer did not report 4 bytes");
}

static void expect_server_reply_won(void)
{
	zexpect_true(saw_data, "the real server's reply was not accepted");
	zexpect_equal(seen_data_len, 4, "wrong payload length");
	zexpect_false(saw_error, "an error was reported for a transfer that should have completed");
	zexpect_not_equal(seen_error_code, TFTP_ERROR_DISK_FULL,
			  "the attacker's error code was reported");
}

static void expect_burst_cost_nothing(void)
{
	int ret = run_transfer_ret();

	zexpect_equal(ret, 4, "tftp_get() returned %d, expected 4 bytes of data", ret);
	zexpect_equal(seen_requests, 1, "the client put %d requests on the wire, expected 1",
		      seen_requests);
	expect_server_reply_won();
}

static void before(void *f)
{
	ARG_UNUSED(f);

	loopback_enable_address_swap(false);

	memset(&client, 0, sizeof(client));
	client.callback = tftp_cb;

	saw_data = false;
	saw_error = false;
	seen_data_len = 0;
	seen_data_total = 0;
	seen_first_byte = 0;
	seen_error_code = -1;

	request_fd = -1;
	reply_fd = -1;
	attacker_fd = -1;
	added_count = 0;
	zero_server_addr_on_request = false;
	forge_second_block = false;
	forge_before_connect = false;
	forge_burst_before_reply = false;
	seen_requests = 0;
	family = AF_INET;
}

static void after(void *f)
{
	ARG_UNUSED(f);

	if (request_fd >= 0) {
		(void)zsock_close(request_fd);
		request_fd = -1;
	}
	if (reply_fd >= 0) {
		(void)zsock_close(reply_fd);
		reply_fd = -1;
	}
	if (attacker_fd >= 0) {
		(void)zsock_close(attacker_fd);
		attacker_fd = -1;
	}

	iface_drop_addrs();

	loopback_enable_address_swap(true);
}

ZTEST(tftp_client, test_reply_from_a_different_port_is_accepted)
{
	setup_server(AF_INET);

	run_transfer();

	expect_server_reply_won();
}

ZTEST(tftp_client, test_reply_from_a_different_port_is_accepted_v6)
{
	setup_server(AF_INET6);

	run_transfer();

	expect_server_reply_won();
}

ZTEST(tftp_client, test_reply_from_a_different_address_is_rejected)
{
	setup_server(AF_INET);
	setup_attacker(V4_OFF_PREFIX);

	run_transfer();

	expect_server_reply_won();
}

ZTEST(tftp_client, test_reply_from_a_different_address_is_rejected_v6)
{
	setup_server(AF_INET6);
	setup_attacker(V6_OFF_PREFIX);

	run_transfer();

	expect_server_reply_won();
}

ZTEST(tftp_client, test_reply_from_a_same_prefix_address_is_rejected)
{
	setup_server(AF_INET);
	setup_attacker(V4_SAME_PREFIX);

	run_transfer();

	expect_server_reply_won();
}

ZTEST(tftp_client, test_reply_from_a_same_prefix_address_is_rejected_v6)
{
	setup_server(AF_INET6);
	setup_attacker(V6_SAME_PREFIX);

	run_transfer();

	expect_server_reply_won();
}

ZTEST(tftp_client, test_a_forged_block_mid_transfer_is_rejected)
{
	setup_server(AF_INET);
	setup_attacker(V4_OFF_PREFIX);
	forge_second_block = true;

	zassert_equal(run_transfer_ret(), TFTP_BLOCK_SIZE + 4,
		      "the transfer did not report both of the server's blocks");

	zexpect_true(saw_data, "the callback saw no data event");
	zexpect_equal(seen_data_total, TFTP_BLOCK_SIZE + 4, "wrong total payload length");
	zexpect_equal(seen_first_byte, 's', "the attacker's block was reported to the caller");
	zexpect_false(saw_error, "an error was reported for a transfer that should have completed");
}

ZTEST(tftp_client, test_a_forged_block_mid_transfer_is_rejected_v6)
{
	setup_server(AF_INET6);
	setup_attacker(V6_OFF_PREFIX);
	forge_second_block = true;

	zassert_equal(run_transfer_ret(), TFTP_BLOCK_SIZE + 4,
		      "the transfer did not report both of the server's blocks");

	zexpect_true(saw_data, "the callback saw no data event");
	zexpect_equal(seen_data_total, TFTP_BLOCK_SIZE + 4, "wrong total payload length");
	zexpect_equal(seen_first_byte, 's', "the attacker's block was reported to the caller");
	zexpect_false(saw_error, "an error was reported for a transfer that should have completed");
}

ZTEST(tftp_client, test_a_forged_block_from_the_server_address_is_rejected)
{
	setup_server(AF_INET);
	setup_attacker_on_server_address();
	forge_second_block = true;

	zassert_equal(run_transfer_ret(), TFTP_BLOCK_SIZE + 4,
		      "the transfer did not report both of the server's blocks");

	zexpect_true(saw_data, "the callback saw no data event");
	zexpect_equal(seen_data_total, TFTP_BLOCK_SIZE + 4, "wrong total payload length");
	zexpect_equal(seen_first_byte, 's', "the attacker's block was reported to the caller");
	zexpect_false(saw_error, "an error was reported for a transfer that should have completed");
}

ZTEST(tftp_client, test_a_forged_block_from_the_server_address_is_rejected_v6)
{
	setup_server(AF_INET6);
	setup_attacker_on_server_address();
	forge_second_block = true;

	zassert_equal(run_transfer_ret(), TFTP_BLOCK_SIZE + 4,
		      "the transfer did not report both of the server's blocks");

	zexpect_true(saw_data, "the callback saw no data event");
	zexpect_equal(seen_data_total, TFTP_BLOCK_SIZE + 4, "wrong total payload length");
	zexpect_equal(seen_first_byte, 's', "the attacker's block was reported to the caller");
	zexpect_false(saw_error, "an error was reported for a transfer that should have completed");
}

ZTEST(tftp_client, test_a_forged_block_racing_the_connect_is_rejected)
{
	setup_server(AF_INET);
	setup_attacker_on_server_address();
	forge_before_connect = true;

	zassert_equal(run_transfer_ret(), TFTP_BLOCK_SIZE + 4,
		      "the transfer did not report both of the server's blocks");

	zexpect_true(saw_data, "the callback saw no data event");
	zexpect_equal(seen_data_total, TFTP_BLOCK_SIZE + 4, "wrong total payload length");
	zexpect_equal(seen_first_byte, 's', "the attacker's block was reported to the caller");
	zexpect_false(saw_error, "an error was reported for a transfer that should have completed");
}

ZTEST(tftp_client, test_a_forged_block_racing_the_connect_is_rejected_v6)
{
	setup_server(AF_INET6);
	setup_attacker_on_server_address();
	forge_before_connect = true;

	zassert_equal(run_transfer_ret(), TFTP_BLOCK_SIZE + 4,
		      "the transfer did not report both of the server's blocks");

	zexpect_true(saw_data, "the callback saw no data event");
	zexpect_equal(seen_data_total, TFTP_BLOCK_SIZE + 4, "wrong total payload length");
	zexpect_equal(seen_first_byte, 's', "the attacker's block was reported to the caller");
	zexpect_false(saw_error, "an error was reported for a transfer that should have completed");
}

ZTEST(tftp_client, test_forged_datagrams_do_not_cost_a_retry)
{
	setup_server(AF_INET);
	setup_attacker(V4_OFF_PREFIX);
	forge_burst_before_reply = true;

	expect_burst_cost_nothing();
}

ZTEST(tftp_client, test_forged_datagrams_do_not_cost_a_retry_v6)
{
	setup_server(AF_INET6);
	setup_attacker(V6_OFF_PREFIX);
	forge_burst_before_reply = true;

	expect_burst_cost_nothing();
}

ZTEST(tftp_client, test_reply_when_server_address_is_unset_is_rejected)
{
	setup_server(AF_INET);
	setup_attacker(V4_OFF_PREFIX);
	zero_server_addr_on_request = true;

	zexpect_not_equal(run_transfer_ret(), 4,
			  "an unset server address must not validate any reply");
	zexpect_false(saw_data, "a reply was accepted against an unset server address");
	zexpect_not_equal(seen_error_code, TFTP_ERROR_DISK_FULL,
			  "the attacker's error code was reported");
}

ZTEST(tftp_client, test_reply_when_server_address_is_unset_is_rejected_v6)
{
	setup_server(AF_INET6);
	setup_attacker(V6_OFF_PREFIX);
	zero_server_addr_on_request = true;

	zexpect_not_equal(run_transfer_ret(), 4,
			  "an unset server address must not validate any reply");
	zexpect_false(saw_data, "a reply was accepted against an unset server address");
	zexpect_not_equal(seen_error_code, TFTP_ERROR_DISK_FULL,
			  "the attacker's error code was reported");
}

ZTEST_SUITE(tftp_client, NULL, NULL, before, after, NULL);
```

## src/error_response.c
```c
/*
 * SPDX-FileCopyrightText: Copyright The Zephyr Project Contributors
 * SPDX-FileCopyrightText: Copyright (c) 2026 DevItWise
 * SPDX-License-Identifier: Apache-2.0
 */

#include <stdint.h>
#include <string.h>

#include <zephyr/kernel.h>
#include <zephyr/net/net_ip.h>
#include <zephyr/net/socket.h>
#include <zephyr/net/tftp.h>
#include <zephyr/sys/byteorder.h>
#include <zephyr/ztest.h>

#define SERVER_PORT 69

#define DATA_OPCODE  3
#define ACK_OPCODE   4
#define ERROR_OPCODE 5

#define TFTP_ERROR_NO_FILE   1
#define TFTP_ERROR_DISK_FULL 3

#define SERVER_QUIET_MS     300
#define SERVER_MAX_REQUESTS 8

static int server_fd = -1;

static K_THREAD_STACK_DEFINE(server_stack, 2048);
static struct k_thread server_thread;

#define MAX_REPLIES 2

static uint8_t server_reply[MAX_REPLIES][TFTPC_MAX_BUF_SIZE];
static size_t server_reply_len[MAX_REPLIES];
static int server_replies;

static bool saw_error;
static bool saw_data;
static int seen_code;
static size_t seen_msg_len;
static char seen_msg[64];
static size_t seen_data_len;

static struct {
	struct tftpc client;
	uint8_t poison[1024];
} fixture;

static void tftp_cb(const struct tftp_evt *evt)
{
	switch (evt->type) {
	case TFTP_EVT_ERROR:
		saw_error = true;
		seen_code = evt->param.error.code;
		seen_msg_len = strlen(evt->param.error.msg);
		strncpy(seen_msg, evt->param.error.msg, sizeof(seen_msg) - 1);
		seen_msg[sizeof(seen_msg) - 1] = '\0';
		break;
	case TFTP_EVT_DATA:
		saw_data = true;
		seen_data_len = evt->param.data.len;
		break;
	default:
		break;
	}
}

static void server_fn(void *a, void *b, void *c)
{
	struct net_sockaddr_storage from;
	uint8_t request[TFTPC_MAX_BUF_SIZE];

	ARG_UNUSED(a);
	ARG_UNUSED(b);
	ARG_UNUSED(c);

	for (int i = 0; i < SERVER_MAX_REQUESTS; i++) {
		struct zsock_pollfd fds = {
			.fd = server_fd,
			.events = ZSOCK_POLLIN,
		};
		net_socklen_t from_len = sizeof(from);
		int idx = MIN(i, server_replies - 1);

		if (zsock_poll(&fds, 1, SERVER_QUIET_MS) <= 0) {
			return;
		}

		if (zsock_recvfrom(server_fd, request, sizeof(request), 0,
				   (struct net_sockaddr *)&from, &from_len) < 0) {
			return;
		}

		(void)zsock_sendto(server_fd, server_reply[idx], server_reply_len[idx], 0,
				   (struct net_sockaddr *)&from, from_len);
	}
}

static void prepare_client(void)
{
	struct net_sockaddr_in *addr;

	memset(&fixture, 0xAA, sizeof(fixture));
	fixture.poison[sizeof(fixture.poison) - 1] = '\0';

	memset(&fixture.client.server_addr, 0, sizeof(fixture.client.server_addr));
	addr = (struct net_sockaddr_in *)&fixture.client.server_addr;
	addr->sin_family = NET_AF_INET;
	addr->sin_port = net_htons(SERVER_PORT);
	addr->sin_addr.s4_addr[0] = 127;
	addr->sin_addr.s4_addr[3] = 1;

	fixture.client.callback = tftp_cb;

	saw_error = false;
	saw_data = false;
	seen_code = -1;
	seen_msg_len = 0;
	seen_msg[0] = '\0';
	seen_data_len = 0;
}

static int run_transfer(bool put)
{
	static const uint8_t payload[4] = {1, 2, 3, 4};
	k_tid_t tid;
	int ret;

	tid = k_thread_create(&server_thread, server_stack, K_THREAD_STACK_SIZEOF(server_stack),
			      server_fn, NULL, NULL, NULL, K_PRIO_PREEMPT(0), 0, K_NO_WAIT);

	if (put) {
		ret = tftp_put(&fixture.client, "file", "octet", payload, sizeof(payload));
	} else {
		ret = tftp_get(&fixture.client, "file", "octet");
	}

	zassert_ok(k_thread_join(tid, K_SECONDS(5)), "the server thread did not finish");

	return ret;
}

static int run_get(void)
{
	return run_transfer(false);
}

static int run_put(void)
{
	return run_transfer(true);
}

static void set_error_reply(int slot, uint16_t code, const char *msg, size_t msg_len,
			    bool terminate)
{
	if (terminate) {
		size_t max_msg_len = TFTPC_MAX_BUF_SIZE - TFTP_HEADER_SIZE - 1;

		if (msg_len > max_msg_len) {
			msg_len = max_msg_len;
		}
	}

	sys_put_be16(ERROR_OPCODE, server_reply[slot]);
	sys_put_be16(code, server_reply[slot] + 2);

	if (msg != NULL) {
		memcpy(server_reply[slot] + TFTP_HEADER_SIZE, msg, msg_len);
	} else {
		memset(server_reply[slot] + TFTP_HEADER_SIZE, 'A', msg_len);
	}

	server_reply_len[slot] = TFTP_HEADER_SIZE + msg_len;

	if (terminate) {
		server_reply[slot][server_reply_len[slot]] = '\0';
		server_reply_len[slot]++;
	}
}

static void set_ack_reply(int slot, uint16_t block)
{
	sys_put_be16(ACK_OPCODE, server_reply[slot]);
	sys_put_be16(block, server_reply[slot] + 2);
	server_reply_len[slot] = TFTP_HEADER_SIZE;
}

ZTEST(tftp_client_error_response, test_unterminated_error_message_stays_in_the_buffer)
{
	prepare_client();
	server_replies = 1;
	set_error_reply(0, TFTP_ERROR_NO_FILE, NULL, TFTP_BLOCK_SIZE, false);

	zassert_equal(run_get(), TFTPC_REMOTE_ERROR, "the error was not reported");
	zassert_true(saw_error, "the callback saw no error event");
	zassert_true(seen_msg_len < TFTP_BLOCK_SIZE,
		     "the message runs %zu bytes past the end of tftp_buf",
		     seen_msg_len - TFTP_BLOCK_SIZE + 1);
}

ZTEST(tftp_client_error_response, test_terminated_error_message_is_passed_through)
{
	static const char msg[] = "file not found";

	prepare_client();
	server_replies = 1;
	set_error_reply(0, TFTP_ERROR_NO_FILE, msg, strlen(msg), true);

	zassert_equal(run_get(), TFTPC_REMOTE_ERROR, "the error was not reported");
	zassert_true(saw_error, "the callback saw no error event");
	zassert_equal(seen_msg_len, strlen(msg), "the message was truncated");
	zassert_str_equal(seen_msg, msg, "the message was altered");
	zassert_equal(seen_code, TFTP_ERROR_NO_FILE, "wrong error code reported");
}

ZTEST(tftp_client_error_response, test_short_unterminated_error_message_is_kept_whole)
{
	static const char msg[] = "disk full";

	prepare_client();
	server_replies = 1;
	set_error_reply(0, TFTP_ERROR_DISK_FULL, msg, strlen(msg), false);

	zassert_equal(run_get(), TFTPC_REMOTE_ERROR, "the error was not reported");
	zassert_true(saw_error, "the callback saw no error event");
	zassert_str_equal(seen_msg, msg, "the message was altered");
}

ZTEST(tftp_client_error_response, test_terminated_error_message_is_clamped_to_fit)
{
	prepare_client();
	server_replies = 1;
	memset(server_reply[1], 0xAA, sizeof(server_reply[1]));
	set_error_reply(0, TFTP_ERROR_NO_FILE, NULL, TFTP_BLOCK_SIZE, true);

	zassert_equal(server_reply[1][0], 0xAA, "set_error_reply() wrote past server_reply[0]");

	zassert_equal(run_get(), TFTPC_REMOTE_ERROR, "the error was not reported");
	zassert_true(saw_error, "the callback saw no error event");
	zassert_equal(seen_msg_len, TFTPC_MAX_BUF_SIZE - TFTP_HEADER_SIZE - 1,
		      "the clamp let %zu bytes through", seen_msg_len);
	zassert_equal(seen_code, TFTP_ERROR_NO_FILE, "wrong error code reported");
}

ZTEST(tftp_client_error_response, test_error_without_a_message)
{
	prepare_client();
	server_replies = 1;
	set_error_reply(0, TFTP_ERROR_NO_FILE, NULL, 0, false);

	zassert_equal(run_get(), TFTPC_REMOTE_ERROR, "the error was not reported");
	zassert_true(saw_error, "the callback saw no error event");
	zassert_equal(seen_msg_len, 0, "an empty message was reported as %zu bytes", seen_msg_len);
}

ZTEST(tftp_client_error_response, test_short_data_block_ends_the_transfer)
{
	prepare_client();

	server_replies = 1;
	sys_put_be16(DATA_OPCODE, server_reply[0]);
	sys_put_be16(1, server_reply[0] + 2);
	memset(server_reply[0] + TFTP_HEADER_SIZE, 'x', 4);
	server_reply_len[0] = TFTP_HEADER_SIZE + 4;

	zassert_equal(run_get(), 4, "the transfer did not report 4 bytes");
	zassert_true(saw_data, "the callback saw no data event");
	zassert_equal(seen_data_len, 4, "wrong payload length");
}

ZTEST(tftp_client_error_response, test_data_block_rejected_reports_the_servers_code)
{
	prepare_client();

	server_replies = 2;
	set_ack_reply(0, 0);
	set_error_reply(1, TFTP_ERROR_DISK_FULL, NULL, 0, false);

	zassert_equal(run_put(), TFTPC_REMOTE_ERROR, "the rejection did not end the transfer");

	zassert_true(saw_error, "the callback saw no error event");
	zassert_equal(seen_code, TFTP_ERROR_DISK_FULL,
		      "reported error code %d, not the server's %d", seen_code,
		      TFTP_ERROR_DISK_FULL);
	zassert_equal(seen_msg_len, 0, "an absent message was reported as %zu bytes", seen_msg_len);
}

ZTEST(tftp_client_error_response, test_data_block_rejected_with_a_message_reports_it)
{
	static const char msg[] = "disk full";

	prepare_client();

	server_replies = 2;
	set_ack_reply(0, 0);
	set_error_reply(1, TFTP_ERROR_DISK_FULL, msg, strlen(msg), true);

	zassert_equal(run_put(), TFTPC_REMOTE_ERROR, "the rejection did not end the transfer");

	zassert_true(saw_error, "the callback saw no error event");
	zassert_equal(seen_code, TFTP_ERROR_DISK_FULL,
		      "reported error code %d, not the server's %d", seen_code,
		      TFTP_ERROR_DISK_FULL);
	zassert_equal(seen_msg_len, strlen(msg), "the message was truncated");
	zassert_str_equal(seen_msg, msg, "the message was altered");
}

ZTEST(tftp_client_error_response, test_put_completes)
{
	prepare_client();

	server_replies = 2;
	set_ack_reply(0, 0);
	set_ack_reply(1, 1);

	zassert_equal(run_put(), 4, "the transfer did not report 4 bytes sent");
	zassert_false(saw_error, "an error was reported for a clean transfer");
}

static void before(void *f)
{
	struct net_sockaddr_in addr = {
		.sin_family = NET_AF_INET,
		.sin_port = net_htons(SERVER_PORT),
	};

	ARG_UNUSED(f);

	addr.sin_addr.s4_addr[0] = 127;
	addr.sin_addr.s4_addr[3] = 1;

	server_fd = zsock_socket(NET_AF_INET, NET_SOCK_DGRAM, NET_IPPROTO_UDP);
	zassert_true(server_fd >= 0, "could not open the server socket");

	zassert_ok(zsock_bind(server_fd, (struct net_sockaddr *)&addr, sizeof(addr)),
		   "could not bind the server socket");
}

static void after(void *f)
{
	ARG_UNUSED(f);

	(void)zsock_close(server_fd);
	server_fd = -1;
}

ZTEST_SUITE(tftp_client_error_response, NULL, NULL, before, after, NULL);
```

## src/make_request.c
```c
/*
 * SPDX-FileCopyrightText: Copyright The Zephyr Project Contributors
 * SPDX-FileCopyrightText: Copyright (c) 2026 DevItWise
 * SPDX-License-Identifier: Apache-2.0
 */

#include <errno.h>
#include <stddef.h>
#include <string.h>

#include <zephyr/net/tftp.h>
#include <zephyr/ztest.h>

#include "tftp_client.h"

#define REQUEST_BUF_PADDING 256

#define DEFAULT_MODE_LEN 5

#define SERVER_ADDR "127.0.0.1"
#define SERVER_PORT 69

#define REQUEST_WAIT_MS 100

static struct tftpc api_client;
static const uint8_t put_data[] = "data";

static void fill(char *dst, size_t len, char c)
{
	memset(dst, c, len);
	dst[len] = '\0';
}

/* Bind a socket where api_client sends its requests, so a test can see them. */
static int bind_server(void)
{
	struct net_sockaddr_in *addr = (struct net_sockaddr_in *)&api_client.server;
	int fd;

	addr->sin_family = NET_AF_INET;
	addr->sin_port = net_htons(SERVER_PORT);
	zassert_equal(zsock_inet_pton(NET_AF_INET, SERVER_ADDR, &addr->sin_addr), 1,
		      "could not parse %s", SERVER_ADDR);

	fd = zsock_socket(NET_AF_INET, NET_SOCK_DGRAM, NET_IPPROTO_UDP);
	zassert_true(fd >= 0, "could not open a UDP socket");

	if (zsock_bind(fd, (struct net_sockaddr *)addr, sizeof(*addr)) < 0) {
		(void)zsock_close(fd);
		zassert_unreachable("could not bind to %s:%u", SERVER_ADDR, SERVER_PORT);
	}

	return fd;
}

/* Size of the first request that reached fd, or 0 if none did. */
static int first_request_size(int fd)
{
	uint8_t buf[TFTPC_MAX_BUF_SIZE + 1];
	struct zsock_pollfd pfd = {
		.fd = fd,
		.events = ZSOCK_POLLIN,
	};

	if (zsock_poll(&pfd, 1, REQUEST_WAIT_MS) <= 0) {
		return 0;
	}

	return zsock_recv(fd, buf, sizeof(buf), 0);
}

ZTEST(tftp_client, test_make_request_filename_one_under_budget)
{
	uint8_t buf[TFTPC_MAX_BUF_SIZE + REQUEST_BUF_PADDING];
	char remote_file[TFTP_MAX_FILENAME_SIZE];
	size_t req_size;

	fill(remote_file, TFTP_MAX_FILENAME_SIZE - 1, 'a');

	req_size = make_request(buf, READ_REQUEST, remote_file, NULL);

	zassert_equal(req_size, 2 + (TFTP_MAX_FILENAME_SIZE - 1) + 1 + DEFAULT_MODE_LEN + 1,
		      "unexpected request size %zu for a filename one byte under budget", req_size);
}

ZTEST(tftp_client, test_make_request_filename_at_budget)
{
	uint8_t buf[TFTPC_MAX_BUF_SIZE + REQUEST_BUF_PADDING];
	char remote_file[TFTP_MAX_FILENAME_SIZE + 1];
	size_t req_size;

	fill(remote_file, TFTP_MAX_FILENAME_SIZE, 'a');

	req_size = make_request(buf, READ_REQUEST, remote_file, NULL);

	zassert_equal(req_size, 2 + TFTP_MAX_FILENAME_SIZE + 1 + DEFAULT_MODE_LEN + 1,
		      "unexpected request size %zu for a filename exactly at budget", req_size);
}

ZTEST(tftp_client, test_filename_one_over_budget_is_rejected)
{
	char remote_file[TFTP_MAX_FILENAME_SIZE + 2];
	int fd = bind_server();

	fill(remote_file, TFTP_MAX_FILENAME_SIZE + 1, 'a');

	zexpect_equal(tftp_get(&api_client, remote_file, NULL), -EINVAL,
		      "tftp_get() accepted a filename one byte over budget");
	zexpect_equal(tftp_put(&api_client, remote_file, NULL, put_data, sizeof(put_data)),
		      -EINVAL, "tftp_put() accepted a filename one byte over budget");
	zexpect_equal(first_request_size(fd), 0,
		      "a request was sent for a filename one byte over budget");

	(void)zsock_close(fd);
}

ZTEST(tftp_client, test_make_request_mode_one_under_budget)
{
	uint8_t buf[TFTPC_MAX_BUF_SIZE + REQUEST_BUF_PADDING];
	const char *remote_file = "file.bin";
	char mode[TFTP_MAX_MODE_SIZE];
	size_t req_size;

	fill(mode, TFTP_MAX_MODE_SIZE - 1, 'b');

	req_size = make_request(buf, READ_REQUEST, remote_file, mode);

	zassert_equal(req_size, 2 + strlen(remote_file) + 1 + (TFTP_MAX_MODE_SIZE - 1) + 1,
		      "unexpected request size %zu for a mode one byte under budget", req_size);
}

ZTEST(tftp_client, test_make_request_mode_at_budget)
{
	uint8_t buf[TFTPC_MAX_BUF_SIZE + REQUEST_BUF_PADDING];
	const char *remote_file = "file.bin";
	char mode[TFTP_MAX_MODE_SIZE + 1];
	size_t req_size;

	fill(mode, TFTP_MAX_MODE_SIZE, 'b');

	req_size = make_request(buf, READ_REQUEST, remote_file, mode);

	zassert_equal(req_size, 2 + strlen(remote_file) + 1 + TFTP_MAX_MODE_SIZE + 1,
		      "unexpected request size %zu for a mode exactly at budget", req_size);
}

ZTEST(tftp_client, test_mode_one_over_budget_is_rejected)
{
	const char *remote_file = "file.bin";
	char mode[TFTP_MAX_MODE_SIZE + 2];
	int fd = bind_server();

	fill(mode, TFTP_MAX_MODE_SIZE + 1, 'b');

	zexpect_equal(tftp_get(&api_client, remote_file, mode), -EINVAL,
		      "tftp_get() accepted a mode one byte over budget");
	zexpect_equal(tftp_put(&api_client, remote_file, mode, put_data, sizeof(put_data)),
		      -EINVAL, "tftp_put() accepted a mode one byte over budget");
	zexpect_equal(first_request_size(fd), 0,
		      "a request was sent for a mode one byte over budget");

	(void)zsock_close(fd);
}

ZTEST(tftp_client, test_make_request_filename_and_mode_at_budget)
{
	uint8_t buf[TFTPC_MAX_BUF_SIZE + REQUEST_BUF_PADDING];
	char remote_file[TFTP_MAX_FILENAME_SIZE + 1];
	char mode[TFTP_MAX_MODE_SIZE + 1];
	size_t req_size;

	fill(remote_file, TFTP_MAX_FILENAME_SIZE, 'a');
	fill(mode, TFTP_MAX_MODE_SIZE, 'b');

	req_size = make_request(buf, READ_REQUEST, remote_file, mode);

	zassert_equal(req_size, TFTPC_MAX_BUF_SIZE,
		      "unexpected request size %zu with both filename and mode at budget",
		      req_size);
}

ZTEST(tftp_client, test_filename_and_mode_at_budget_are_sent_whole)
{
	char remote_file[TFTP_MAX_FILENAME_SIZE + 1];
	char mode[TFTP_MAX_MODE_SIZE + 1];
	int fd = bind_server();

	fill(remote_file, TFTP_MAX_FILENAME_SIZE, 'a');
	fill(mode, TFTP_MAX_MODE_SIZE, 'b');

	/* No server answers, so the transfer fails after the request went out. */
	zexpect_not_equal(tftp_get(&api_client, remote_file, mode), -EINVAL,
			  "tftp_get() rejected a filename and mode at budget");
	zexpect_equal(first_request_size(fd), TFTPC_MAX_BUF_SIZE,
		      "the request for a filename and mode at budget was not sent whole");

	(void)zsock_close(fd);
}

ZTEST(tftp_client, test_make_request_short_filename_unaffected)
{
	uint8_t buf[TFTPC_MAX_BUF_SIZE];
	const char *remote_file = "boot.bin";
	size_t req_size;

	req_size = make_request(buf, READ_REQUEST, remote_file, NULL);

	zassert_equal(req_size, 2 + strlen(remote_file) + 1 + DEFAULT_MODE_LEN + 1,
		      "unexpected request size %zu for a short filename", req_size);
}
```
