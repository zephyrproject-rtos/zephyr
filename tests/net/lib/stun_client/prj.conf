## CMakeLists.txt
```
# SPDX-FileCopyrightText: Copyright The Zephyr Project Contributors
# SPDX-FileCopyrightText: Copyright (c) 2026 Kirill Shypachov
# SPDX-License-Identifier: Apache-2.0

cmake_minimum_required(VERSION 3.28.0)
find_package(Zephyr REQUIRED HINTS $ENV{ZEPHYR_BASE})
project(stun_client)

target_sources(app PRIVATE src/main.c src/server.c)
target_sources_ifdef(CONFIG_NET_SHELL app PRIVATE src/shell.c)

# What the client writes to the log is looked at where it can write to it, with
# the log backend of the tests of the codec.
if(CONFIG_NET_LOG AND NOT CONFIG_LOG_MODE_MINIMAL)
  target_sources(app PRIVATE src/log.c ../stun/src/log_capture.c)
  target_include_directories(app PRIVATE ../stun/src)
endif()
```

## prj.conf
```kconfig
# SPDX-FileCopyrightText: Copyright The Zephyr Project Contributors
# SPDX-FileCopyrightText: Copyright (c) 2026 Kirill Shypachov
# SPDX-License-Identifier: Apache-2.0

CONFIG_ZTEST=y
CONFIG_ZTEST_STACK_SIZE=8192
CONFIG_MAIN_STACK_SIZE=8192

# Client and server talk over the loopback interface: no driver, no hardware.
CONFIG_NETWORKING=y
CONFIG_NET_TEST=y
CONFIG_NET_IPV4=y
CONFIG_NET_IPV6=y
CONFIG_NET_UDP=y
CONFIG_NET_SOCKETS=y
CONFIG_NET_DRIVERS=y
CONFIG_NET_LOOPBACK=y
CONFIG_NET_L2_ETHERNET=n
CONFIG_NET_IPV6_DAD=n
CONFIG_NET_IPV6_MLD=n
CONFIG_ZVFS_OPEN_ADD_SIZE_NET=6

CONFIG_STUN=y
CONFIG_STUN_CLIENT=y

CONFIG_ENTROPY_GENERATOR=y
CONFIG_TEST_RANDOM_GENERATOR=y
```

## src/main.c
```c
/*
 * SPDX-FileCopyrightText: Copyright The Zephyr Project Contributors
 * SPDX-FileCopyrightText: Copyright (c) 2026 Kirill Shypachov
 * SPDX-License-Identifier: Apache-2.0
 *
 * The STUN client over real UDP sockets, against the scripted server of
 * server.c.
 */
#include <errno.h>
#include <string.h>

#include <zephyr/kernel.h>
#include <zephyr/net/net_ip.h>
#include <zephyr/net/socket.h>
#include <zephyr/net/stun.h>
#include <zephyr/net/stun_client.h>
#include <zephyr/sys/atomic.h>
#include <zephyr/ztest.h>

#include "server.h"

/* More calls than there can be sockets: one left open by any of them leaves the
 * calls after it without. test_many_calls_exceed_the_socket_limit holds the
 * number to that.
 */
#define MANY_CALLS 64

/* The socket of the test that is running, closed after it whatever its outcome:
 * a failed test must not leave the ones after it without sockets.
 */
static int client_sock = -1;

static bool is_loopback(const struct net_sockaddr *sa, int family)
{
	static const uint8_t kV4[4] = {127, 0, 0, 1};

	if (sa->sa_family != family) {
		return false;
	}
	if (family == NET_AF_INET) {
		return memcmp(net_sin(sa)->sin_addr.s4_addr, kV4, sizeof(kV4)) == 0;
	}
#if defined(CONFIG_NET_IPV6)
	{
		static const uint8_t kV6[16] = {[15] = 1};

		return memcmp(net_sin6(sa)->sin6_addr.s6_addr, kV6, sizeof(kV6)) == 0;
	}
#else
	return false;
#endif
}

static void *suite_setup(void)
{
	server_start();
	return NULL;
}

static void before_each(void *fixture)
{
	ARG_UNUSED(fixture);
	server_reset();
}

static void after_each(void *fixture)
{
	ARG_UNUSED(fixture);
	if (client_sock >= 0) {
		(void)zsock_close(client_sock);
		client_sock = -1;
	}
}

ZTEST_SUITE(stun_client, NULL, suite_setup, before_each, after_each, NULL);

static int client_socket(int family)
{
	client_sock = udp_socket(family);
	return client_sock;
}

/* The port a socket is bound to. */
static uint16_t local_port(int sock)
{
	struct net_sockaddr local;
	net_socklen_t len = sizeof(local);

	memset(&local, 0, sizeof(local));
	zassert_ok(zsock_getsockname(sock, &local, &len), "getsockname: %d", errno);
	return port_of(&local);
}

/* One query to the server of a family; what comes back is this very socket. */
static void check_query(int family)
{
	struct net_sockaddr srv, mapped;
	int sock = client_socket(family);

	set_loopback(&srv, family, SERVER_PORT);
	memset(&mapped, 0, sizeof(mapped));
	zassert_ok(stun_client_query(sock, &srv, addr_len(family), 2000, &mapped));

	zassert_true(is_loopback(&mapped, family));
	zassert_true(port_of(&mapped) != 0);
	zassert_equal(port_of(&mapped), local_port(sock), "mapped port %u, socket port %u",
		      port_of(&mapped), local_port(sock));
	zassert_equal(atomic_get(&server.requests), 1);
	/* RFC 8489 §6.1: a request should say what sent it, unless told not to. */
	zassert_equal(atomic_get(&server.software_seen) != 0,
		      sizeof(CONFIG_STUN_CLIENT_SOFTWARE) > 1U, "SOFTWARE in the request");
}

ZTEST(stun_client, test_query_ipv4)
{
	if (!IS_ENABLED(CONFIG_NET_IPV4)) {
		ztest_test_skip();
	}
	check_query(NET_AF_INET);
}

ZTEST(stun_client, test_query_ipv6)
{
	if (!IS_ENABLED(CONFIG_NET_IPV6)) {
		ztest_test_skip();
	}
	check_query(NET_AF_INET6);
}

ZTEST(stun_client, test_query_timeout)
{
	struct net_sockaddr srv, mapped;
	int sock = client_socket(FAMILY);
	int64_t took, start;

	atomic_set(&server.mode, MODE_SILENT);
	set_loopback(&srv, FAMILY, SERVER_PORT);

	/* Shorter than the first retransmission interval, 500 ms: the call
	 * returns when the caller said, not when the schedule has a deadline.
	 */
	start = k_uptime_get();
	zassert_equal(stun_client_query(sock, &srv, addr_len(FAMILY), 300, &mapped), -ETIMEDOUT);
	took = k_uptime_get() - start;
	zassert_true(took >= 300 && took < 500, "gave up after %lld ms", took);
	zassert_equal(atomic_get(&server.requests), 1);

	/* Longer than it: the request is sent again in the meantime. */
	atomic_set(&server.requests, 0);
	start = k_uptime_get();
	zassert_equal(stun_client_query(sock, &srv, addr_len(FAMILY), 700, &mapped), -ETIMEDOUT);
	took = k_uptime_get() - start;
	zassert_true(took >= 700 && took < 900, "gave up after %lld ms", took);
	zassert_equal(atomic_get(&server.requests), 2);
}

ZTEST(stun_client, test_query_gives_up_when_the_schedule_ends)
{
	struct net_sockaddr srv, mapped;
	int64_t took, start;
	int sock;

	/* 39.5 seconds: nothing where they are real ones. */
	if (!IS_ENABLED(CONFIG_ARCH_POSIX)) {
		ztest_test_skip();
	}

	sock = client_socket(FAMILY);
	atomic_set(&server.mode, MODE_SILENT);
	set_loopback(&srv, FAMILY, SERVER_PORT);

	/* No time of the caller's: the schedule of RFC 8489 §6.2.1 runs out,
	 * seven transmissions and then 8 seconds of waiting.
	 */
	start = k_uptime_get();
	zassert_equal(stun_client_query(sock, &srv, addr_len(FAMILY), 0, &mapped), -ETIMEDOUT);
	took = k_uptime_get() - start;
	zassert_true(took >= 39500 && took < 40500, "gave up after %lld ms", took);
	zassert_equal(atomic_get(&server.requests), 7);
}

ZTEST(stun_client, test_query_retransmits)
{
	struct net_sockaddr srv, mapped;
	int sock = client_socket(FAMILY);
	int64_t took, start;

	atomic_set(&server.mode, MODE_ANSWER_SECOND);
	set_loopback(&srv, FAMILY, SERVER_PORT);

	start = k_uptime_get();
	zassert_ok(stun_client_query(sock, &srv, addr_len(FAMILY), 0, &mapped));
	took = k_uptime_get() - start;

	/* The same request again, 500 ms after the first (RFC 8489 §6.2.1). */
	zassert_equal(atomic_get(&server.requests), 2);
	zassert_mem_equal(server.txid[0], server.txid[1], STUN_TXID_SIZE);
	zassert_true(took >= 500 && took < 1000, "answered after %lld ms", took);
	zassert_true(is_loopback(&mapped, FAMILY));
	zassert_equal(port_of(&mapped), local_port(sock));
}

ZTEST(stun_client, test_query_error_response)
{
	struct net_sockaddr srv, mapped;
	int sock = client_socket(FAMILY);

	atomic_set(&server.mode, MODE_ERROR_500);
	set_loopback(&srv, FAMILY, SERVER_PORT);
	zassert_equal(stun_client_query(sock, &srv, addr_len(FAMILY), 2000, &mapped), -EPROTO);
	zassert_equal(atomic_get(&server.requests), 1, "an error response is not retried");
}

ZTEST(stun_client, test_query_ignores_what_is_not_the_answer)
{
	struct net_sockaddr srv, mapped;
	int sock = client_socket(FAMILY);

	atomic_set(&server.mode, MODE_NOISE_FIRST);
	set_loopback(&srv, FAMILY, SERVER_PORT);
	zassert_ok(stun_client_query(sock, &srv, addr_len(FAMILY), 2000, &mapped));

	/* Three datagrams came before the answer, two of them with an address
	 * that is a lie. What is returned is what the answer said.
	 */
	zassert_true(is_loopback(&mapped, FAMILY));
	zassert_equal(port_of(&mapped), local_port(sock), "mapped port %u", port_of(&mapped));
	zassert_equal(atomic_get(&server.requests), 1);
}

ZTEST(stun_client, test_truncated_datagram_is_not_the_answer)
{
	struct net_sockaddr srv, mapped;
	int sock = client_socket(FAMILY);
	int rc;

	/* RFC 8489 sections 5 and 6.3: a STUN message fills its datagram. The
	 * server sends CONFIG_STUN_CLIENT_RX_BUF_SIZE + 4 bytes, the first
	 * CONFIG_STUN_CLIENT_RX_BUF_SIZE of them a well-formed response with a
	 * lie in it. Whatever the receive buffer holds, the client has to know
	 * that the datagram was longer than what it got, and treat it like any
	 * other datagram that is not the answer: ignore it and go on waiting,
	 * so the query times out instead of returning the lie.
	 */
	atomic_set(&server.mode, MODE_OVERSIZED);
	set_loopback(&srv, FAMILY, SERVER_PORT);
	memset(&mapped, 0, sizeof(mapped));
	rc = stun_client_query(sock, &srv, addr_len(FAMILY), 1200, &mapped);
	zassert_equal(atomic_get(&server.sent_len), CONFIG_STUN_CLIENT_RX_BUF_SIZE + 4,
		      "the server could not build the oversized datagram");
	zassert_true(atomic_get(&server.requests) >= 1);
	zassert_equal(rc, -ETIMEDOUT,
		      "a truncated datagram was taken for the answer: rc %d, "
		      "mapped port %u",
		      rc, port_of(&mapped));
}

ZTEST(stun_client, test_two_queries_on_one_socket)
{
	struct net_sockaddr srv, first, second;
	int sock = client_socket(FAMILY);

	set_loopback(&srv, FAMILY, SERVER_PORT);
	zassert_ok(stun_client_query(sock, &srv, addr_len(FAMILY), 2000, &first));
	zassert_ok(stun_client_query(sock, &srv, addr_len(FAMILY), 2000, &second));

	zassert_equal(atomic_get(&server.requests), 2);
	zassert_true(memcmp(server.txid[0], server.txid[1], STUN_TXID_SIZE) != 0,
		     "every transaction has an id of its own");
	zassert_equal(port_of(&first), port_of(&second), "the same socket, the same address");
}

ZTEST(stun_client, test_many_calls_exceed_the_socket_limit)
{
	int socks[MANY_CALLS];
	int n = 0;

	/* What the two tests below rest on: fewer than MANY_CALLS sockets can be
	 * open at once.
	 */
	while (n < MANY_CALLS) {
		socks[n] = zsock_socket(FAMILY, NET_SOCK_DGRAM, NET_IPPROTO_UDP);
		if (socks[n] < 0) {
			break;
		}
		n++;
	}
	zassert_true(n > 0 && n < MANY_CALLS, "%d sockets could be opened", n);
	while (n > 0) {
		zassert_ok(zsock_close(socks[--n]));
	}
}

ZTEST(stun_client, test_simple)
{
	struct net_sockaddr mapped;

	/* Port 0 is the default port; another one is where the request goes. */
	zassert_ok(stun_client_simple(HOST, 0, 2000, &mapped));
	zassert_true(is_loopback(&mapped, FAMILY));
	zassert_true(port_of(&mapped) != 0);
	zassert_equal(atomic_get(&server.last_port), STUN_CLIENT_DEFAULT_PORT);

	zassert_ok(stun_client_simple(HOST, OTHER_PORT, 2000, &mapped));
	zassert_true(is_loopback(&mapped, FAMILY));
	zassert_equal(atomic_get(&server.last_port), OTHER_PORT);

	/* It opens a socket of the family the name resolves to. */
	if (IS_ENABLED(CONFIG_NET_IPV4)) {
		zassert_ok(stun_client_simple("127.0.0.1", SERVER_PORT, 2000, &mapped));
		zassert_true(is_loopback(&mapped, NET_AF_INET));
	}
	if (IS_ENABLED(CONFIG_NET_IPV6)) {
		zassert_ok(stun_client_simple("::1", SERVER_PORT, 2000, &mapped));
		zassert_true(is_loopback(&mapped, NET_AF_INET6));
	}

	/* And closes it. */
	for (int i = 0; i < MANY_CALLS; i++) {
		zassert_ok(stun_client_simple(HOST, SERVER_PORT, 2000, &mapped), "call %d", i);
	}
}

ZTEST(stun_client, test_simple_failures_do_not_leak)
{
	struct net_sockaddr mapped;

	atomic_set(&server.mode, MODE_SILENT);
	for (int i = 0; i < MANY_CALLS; i++) {
		/* A name nothing resolves, and a server that never answers. */
		zassert_equal(stun_client_simple("no-such-host.invalid", 0, 100, &mapped),
			      -EHOSTUNREACH, "call %d", i);
		zassert_equal(stun_client_simple(HOST, SERVER_PORT, 10, &mapped), -ETIMEDOUT,
			      "call %d", i);
	}

	atomic_set(&server.mode, MODE_ANSWER);
	zassert_ok(stun_client_simple(HOST, SERVER_PORT, 2000, &mapped));
}

ZTEST(stun_client, test_bad_arguments)
{
	struct net_sockaddr srv, mapped;
	int sock = client_socket(FAMILY);

	set_loopback(&srv, FAMILY, SERVER_PORT);

	zassert_equal(stun_client_query(sock, NULL, addr_len(FAMILY), 100, &mapped), -EINVAL);
	zassert_equal(stun_client_query(sock, &srv, addr_len(FAMILY), 100, NULL), -EINVAL);
	zassert_equal(stun_client_query(-1, &srv, addr_len(FAMILY), 100, &mapped), -EBADF);

	/* An address length too short for the family is refused before the
	 * address is read and before the socket is touched.
	 */
	zassert_equal(stun_client_query(sock, &srv, addr_len(FAMILY) - 1U, 100, &mapped), -EINVAL);
	zassert_equal(stun_client_query(-1, &srv, addr_len(FAMILY) - 1U, 100, &mapped), -EINVAL);
	zassert_equal(stun_client_query(-1, &srv, 0, 100, &mapped), -EINVAL);

	set_loopback(&srv, FAMILY, 0);
	zassert_equal(stun_client_query(sock, &srv, addr_len(FAMILY), 100, &mapped), -EINVAL,
		      "a server without a port");

	set_loopback(&srv, FAMILY, SERVER_PORT);
	srv.sa_family = NET_AF_UNSPEC;
	zassert_equal(stun_client_query(sock, &srv, addr_len(FAMILY), 100, &mapped), -EAFNOSUPPORT);

#if !defined(CONFIG_NET_IPV6)
	{
		struct net_sockaddr_in6 srv6 = {
			.sin6_family = NET_AF_INET6,
			.sin6_port = net_htons(SERVER_PORT),
		};

		zassert_equal(stun_client_query(sock, (struct net_sockaddr *)&srv6, sizeof(srv6),
						100, &mapped),
			      -EAFNOSUPPORT, "an IPv6 server without the IPv6 stack");
	}
#endif

	zassert_equal(stun_client_simple(NULL, SERVER_PORT, 100, &mapped), -EINVAL);
	zassert_equal(stun_client_simple(HOST, SERVER_PORT, 100, NULL), -EINVAL);

	zassert_equal(atomic_get(&server.requests), 0, "nothing was sent");
}
```

## src/log.c
```c
/*
 * SPDX-FileCopyrightText: Copyright The Zephyr Project Contributors
 * SPDX-FileCopyrightText: Copyright (c) 2026 Kirill Shypachov
 * SPDX-License-Identifier: Apache-2.0
 *
 * What the socket client writes to the log: the reasons its return codes do
 * not carry, as debug records, and nothing when a query simply works.
 */
#include <errno.h>

#include <zephyr/kernel.h>
#include <zephyr/logging/log.h>
#include <zephyr/sys/util.h>
#include <zephyr/ztest.h>

#include "log_capture.h"
#include "server.h"

/* What the module writes depends on the level it is built with, and on the
 * ceiling the system sets for every module.
 */
#define DBG_ON (MIN(CONFIG_STUN_LOG_LEVEL, CONFIG_LOG_MAX_LEVEL) >= LOG_LEVEL_DBG)

static int sock = -1;

static void *suite_setup(void)
{
	server_start();
	log_capture_start();
	return NULL;
}

static void before_each(void *fixture)
{
	ARG_UNUSED(fixture);
	server_reset();
	sock = udp_socket(FAMILY);
	log_capture_clear();
}

static void after_each(void *fixture)
{
	ARG_UNUSED(fixture);
	if (sock >= 0) {
		(void)zsock_close(sock);
		sock = -1;
	}
}

ZTEST_SUITE(stun_client_log, NULL, suite_setup, before_each, after_each, NULL);

/* All the records are debug records, and there are this many of them. */
static void expect_debug_records(size_t n)
{
	size_t expected = DBG_ON ? n : 0U;

	if (log_capture_count() != expected) {
		log_capture_dump();
	}
	zassert_equal(log_capture_count(), expected, "%u records",
		      (unsigned int)log_capture_count());
	zassert_equal(log_capture_count_level(LOG_LEVEL_DBG), log_capture_count(),
		      "a record above the debug level");
}

ZTEST(stun_client_log, test_an_answered_query_leaves_no_record)
{
	struct net_sockaddr srv, mapped;

	set_loopback(&srv, FAMILY, SERVER_PORT);
	zassert_ok(stun_client_query(sock, &srv, addr_len(FAMILY), 2000, &mapped));
	expect_debug_records(0);
}

ZTEST(stun_client_log, test_ignored_datagrams_are_debug_records)
{
	struct net_sockaddr srv, mapped;

	/* Three datagrams that are not the answer come first: the caller is
	 * told nothing about them, the log one line each.
	 */
	atomic_set(&server.mode, MODE_NOISE_FIRST);
	set_loopback(&srv, FAMILY, SERVER_PORT);
	zassert_ok(stun_client_query(sock, &srv, addr_len(FAMILY), 2000, &mapped));
	expect_debug_records(3);
}

ZTEST(stun_client_log, test_an_error_response_is_a_debug_record)
{
	struct net_sockaddr srv, mapped;

	/* -EPROTO does not say which error the server answered with. */
	atomic_set(&server.mode, MODE_ERROR_500);
	set_loopback(&srv, FAMILY, SERVER_PORT);
	zassert_equal(stun_client_query(sock, &srv, addr_len(FAMILY), 2000, &mapped), -EPROTO);
	expect_debug_records(1);
	if (DBG_ON) {
		zassert_true(log_capture_contains("500"));
	}
}

ZTEST(stun_client_log, test_a_name_that_does_not_resolve_is_a_debug_record)
{
	struct net_sockaddr mapped;

	/* -EHOSTUNREACH stands for every code the resolver has. */
	zassert_equal(stun_client_simple("no-such-host.invalid", 0, 100, &mapped), -EHOSTUNREACH);
	expect_debug_records(1);
	if (DBG_ON) {
		zassert_true(log_capture_contains("no-such-host.invalid"));
	}
}

ZTEST(stun_client_log, test_a_timeout_leaves_no_record)
{
	struct net_sockaddr srv, mapped;

	/* The return code says it all. */
	atomic_set(&server.mode, MODE_SILENT);
	set_loopback(&srv, FAMILY, SERVER_PORT);
	zassert_equal(stun_client_query(sock, &srv, addr_len(FAMILY), 100, &mapped), -ETIMEDOUT);
	expect_debug_records(0);
}

ZTEST(stun_client_log, test_the_end_of_the_schedule_leaves_no_record)
{
	struct net_sockaddr srv, mapped;

	/* 39.5 seconds: nothing where they are real ones. */
	if (!IS_ENABLED(CONFIG_ARCH_POSIX)) {
		ztest_test_skip();
	}

	/* The other way a query times out: not the caller's time, but the
	 * retransmissions of the transaction running out.
	 */
	atomic_set(&server.mode, MODE_SILENT);
	set_loopback(&srv, FAMILY, SERVER_PORT);
	zassert_equal(stun_client_query(sock, &srv, addr_len(FAMILY), 0, &mapped), -ETIMEDOUT);
	zassert_equal(atomic_get(&server.requests), 7);
	expect_debug_records(0);
}
```

## src/server.c
```c
/*
 * SPDX-FileCopyrightText: Copyright The Zephyr Project Contributors
 * SPDX-FileCopyrightText: Copyright (c) 2026 Kirill Shypachov
 * SPDX-License-Identifier: Apache-2.0
 */
#include <errno.h>
#include <string.h>

#include <zephyr/kernel.h>
#include <zephyr/ztest.h>

#include "server.h"

struct test_server server;

static K_THREAD_STACK_DEFINE(server_stack, 4096);
static struct k_thread server_thread;

net_socklen_t addr_len(int family)
{
	return (family == NET_AF_INET) ? sizeof(struct net_sockaddr_in)
				       : sizeof(struct net_sockaddr_in6);
}

void set_loopback(struct net_sockaddr *sa, int family, uint16_t port)
{
	memset(sa, 0, sizeof(*sa));
	if (family == NET_AF_INET) {
		net_sin(sa)->sin_family = NET_AF_INET;
		net_sin(sa)->sin_port = net_htons(port);
		net_sin(sa)->sin_addr.s4_addr[0] = 127;
		net_sin(sa)->sin_addr.s4_addr[3] = 1;
	} else {
#if defined(CONFIG_NET_IPV6)
		net_sin6(sa)->sin6_family = NET_AF_INET6;
		net_sin6(sa)->sin6_port = net_htons(port);
		net_sin6(sa)->sin6_addr.s6_addr[15] = 1;
#endif
	}
}

uint16_t port_of(const struct net_sockaddr *sa)
{
#if defined(CONFIG_NET_IPV6)
	if (sa->sa_family == NET_AF_INET6) {
		return net_ntohs(net_sin6(sa)->sin6_port);
	}
#endif
	return net_ntohs(net_sin(sa)->sin_port);
}

int udp_socket(int family)
{
	int sock = zsock_socket(family, NET_SOCK_DGRAM, NET_IPPROTO_UDP);

	zassert_true(sock >= 0, "socket: %d", errno);
	return sock;
}

static void server_listen(int family, uint16_t port)
{
	struct net_sockaddr addr;
	int sock = udp_socket(family);

	set_loopback(&addr, family, port);
	zassert_ok(zsock_bind(sock, &addr, addr_len(family)), "bind: %d", errno);
	zassert_true(server.count < SERVER_SOCKS_MAX);
	server.fds[server.count].fd = sock;
	server.fds[server.count].events = ZSOCK_POLLIN;
	server.ports[server.count] = port;
	server.count++;
	if (port == OTHER_PORT) {
		server.sock_other = sock;
	}
}

/* A response to the transaction `txid`, telling the client its address is `addr`. */
static size_t make_response(uint8_t *out, size_t cap, const uint8_t *txid, uint16_t type,
			    const struct net_sockaddr *addr)
{
	struct stun_builder b;
	int len;

	stun_builder_init(&b, out, cap, type, txid);
	if (type == STUN_BINDING_ERROR_RESPONSE) {
		(void)stun_add_error_code(&b, 500, "Server Error");
	} else {
		(void)stun_add_xor_mapped_address(&b, addr);
	}
	len = stun_finish_plain(&b);
	return (len > 0) ? (size_t)len : 0U;
}

/* What must not end a query, each of them saying the client is at an address
 * it is not at: something that is not STUN, a response to another transaction,
 * and a response to this one that comes from another port than the client
 * wrote to.
 */
static void send_noise(int sock, const struct stun_msg *req, const struct net_sockaddr *from,
		       net_socklen_t from_len)
{
	static const uint8_t kNotStun[24] = {0x80, 0x60, 0x12, 0x34};
	uint8_t other_txid[STUN_TXID_SIZE];
	struct net_sockaddr lie;
	uint8_t out[128];
	size_t len;

	set_loopback(&lie, from->sa_family, LIE_PORT);
	(void)zsock_sendto(sock, kNotStun, sizeof(kNotStun), 0, from, from_len);

	memcpy(other_txid, req->txid, sizeof(other_txid));
	other_txid[0] ^= 0x01;
	len = make_response(out, sizeof(out), other_txid, STUN_BINDING_SUCCESS_RESPONSE, &lie);
	(void)zsock_sendto(sock, out, len, 0, from, from_len);

	len = make_response(out, sizeof(out), req->txid, STUN_BINDING_SUCCESS_RESPONSE, &lie);
	(void)zsock_sendto(server.sock_other, out, len, 0, from, from_len);
}

/* A datagram of CONFIG_STUN_CLIENT_RX_BUF_SIZE + 4 bytes whose first
 * CONFIG_STUN_CLIENT_RX_BUF_SIZE bytes are a well-formed success response
 * that says the client is at `lie`, padded with a comprehension-optional
 * attribute nobody knows. As a whole the datagram is not a STUN message
 * (RFC 8489 section 5: the header says how long the message is, and the
 * message fills the datagram); only its truncated view is.
 */
static void send_oversized(int sock, const struct stun_msg *req, const struct net_sockaddr *from,
			   net_socklen_t from_len)
{
	static uint8_t out[CONFIG_STUN_CLIENT_RX_BUF_SIZE + 4U];
	static uint8_t pad[CONFIG_STUN_CLIENT_RX_BUF_SIZE];
	struct net_sockaddr lie;
	struct stun_builder b;
	int len, room;

	set_loopback(&lie, from->sa_family, LIE_PORT);
	memset(pad, 0x5A, sizeof(pad));
	stun_builder_init(&b, out, CONFIG_STUN_CLIENT_RX_BUF_SIZE, STUN_BINDING_SUCCESS_RESPONSE,
			  req->txid);
	(void)stun_add_xor_mapped_address(&b, &lie);
	/* Fill up to the buffer size exactly: this attribute, then FINGERPRINT. */
	room = CONFIG_STUN_CLIENT_RX_BUF_SIZE - stun_builder_len(&b) - 4 - 8;
	(void)stun_add_attr(&b, 0x8FFFU, pad, (size_t)room);
	len = stun_finish_plain(&b);
	if (len != CONFIG_STUN_CLIENT_RX_BUF_SIZE) {
		atomic_set(&server.sent_len, -1); /* the test sees that the setup failed */
		return;
	}
	memset(out + len, 0xA5, 4U);
	atomic_set(&server.sent_len, len + 4);
	(void)zsock_sendto(sock, out, (size_t)len + 4U, 0, from, from_len);
}

static void serve_one(int sock, uint16_t port)
{
	struct net_sockaddr from;
	net_socklen_t from_len = sizeof(from);
	struct stun_msg m;
	const uint8_t *val;
	uint16_t vlen;
	uint8_t req[256];
	uint8_t out[128];
	atomic_val_t idx;
	ssize_t n;
	size_t len;

	n = zsock_recvfrom(sock, req, sizeof(req), ZSOCK_MSG_DONTWAIT, &from, &from_len);
	if (n <= 0 || stun_parse(req, (size_t)n, &m) != 0 || m.type != STUN_BINDING_REQUEST) {
		return;
	}
	idx = atomic_inc(&server.requests);
	if (idx < 2) {
		memcpy(server.txid[idx], m.txid, STUN_TXID_SIZE);
	}
	atomic_set(&server.last_port, port);
	atomic_set(&server.last_client_port, port_of(&from));
	atomic_set(&server.software_seen,
		   stun_find_attr(req, (size_t)n, &m, STUN_ATTR_SOFTWARE, &val, &vlen) == 0);

	switch ((enum server_mode)atomic_get(&server.mode)) {
	case MODE_SILENT:
		return;
	case MODE_ANSWER_SECOND:
		if (idx == 0) {
			return;
		}
		break;
	case MODE_ERROR_500:
		len = make_response(out, sizeof(out), m.txid, STUN_BINDING_ERROR_RESPONSE, &from);
		(void)zsock_sendto(sock, out, len, 0, &from, from_len);
		return;
	case MODE_NOISE_FIRST:
		send_noise(sock, &m, &from, from_len);
		break;
	case MODE_OVERSIZED:
		send_oversized(sock, &m, &from, from_len);
		return;
	default:
		break;
	}

	len = make_response(out, sizeof(out), m.txid, STUN_BINDING_SUCCESS_RESPONSE, &from);
	(void)zsock_sendto(sock, out, len, 0, &from, from_len);
}

static void server_main(void *p1, void *p2, void *p3)
{
	ARG_UNUSED(p1);
	ARG_UNUSED(p2);
	ARG_UNUSED(p3);

	for (;;) {
		if (zsock_poll(server.fds, server.count, -1) <= 0) {
			continue;
		}
		for (int i = 0; i < server.count; i++) {
			if ((server.fds[i].revents & ZSOCK_POLLIN) != 0) {
				serve_one(server.fds[i].fd, server.ports[i]);
			}
		}
	}
}

void server_start(void)
{
	static bool started;

	if (started) {
		return;
	}
	started = true;

	if (IS_ENABLED(CONFIG_NET_IPV4)) {
		server_listen(NET_AF_INET, SERVER_PORT);
	}
	if (IS_ENABLED(CONFIG_NET_IPV6)) {
		server_listen(NET_AF_INET6, SERVER_PORT);
	}
	server_listen(FAMILY, OTHER_PORT);
	k_thread_create(&server_thread, server_stack, K_THREAD_STACK_SIZEOF(server_stack),
			server_main, NULL, NULL, NULL, K_PRIO_PREEMPT(1), 0, K_NO_WAIT);
}

void server_reset(void)
{
	atomic_set(&server.mode, MODE_ANSWER);
	atomic_set(&server.requests, 0);
	atomic_set(&server.last_port, 0);
	atomic_set(&server.last_client_port, 0);
	atomic_set(&server.software_seen, 0);
	memset(server.txid, 0, sizeof(server.txid));
	atomic_set(&server.sent_len, 0);
}
```

## src/server.h
```c
/*
 * SPDX-FileCopyrightText: Copyright The Zephyr Project Contributors
 * SPDX-FileCopyrightText: Copyright (c) 2026 Kirill Shypachov
 * SPDX-License-Identifier: Apache-2.0
 *
 * A scripted STUN server for the tests of the client: it runs in a thread of
 * the test and is reached over the loopback interface.
 */
#ifndef STUN_CLIENT_TEST_SERVER_H_
#define STUN_CLIENT_TEST_SERVER_H_

#include <stdbool.h>
#include <stdint.h>

#include <zephyr/net/net_ip.h>
#include <zephyr/net/socket.h>
#include <zephyr/net/stun.h>
#include <zephyr/net/stun_client.h>
#include <zephyr/sys/atomic.h>

/* The server listens on the port STUN has by default, and on one more. */
#define SERVER_PORT STUN_CLIENT_DEFAULT_PORT
#define OTHER_PORT  34781

/* A port nothing in the test has: an address with it is a lie. */
#define LIE_PORT 9

/* The tests that are about no family in particular run over IPv4 where there is
 * an IPv4 stack, and over IPv6 where there is not.
 */
#if defined(CONFIG_NET_IPV4)
#define FAMILY NET_AF_INET
#define HOST   "127.0.0.1"
#else
#define FAMILY NET_AF_INET6
#define HOST   "::1"
#endif

/* What the server does with the requests it receives. */
enum server_mode {
	MODE_ANSWER,        /* a success response with the address it saw */
	MODE_SILENT,        /* nothing */
	MODE_ANSWER_SECOND, /* nothing to the first request, an answer to the second */
	MODE_ERROR_500,     /* an error response */
	MODE_NOISE_FIRST,   /* three datagrams that are not the answer, then the answer */
	MODE_OVERSIZED,     /* a datagram longer than the client's buffer, with a lie in it */
};

#define SERVER_SOCKS_MAX 3

struct test_server {
	struct zsock_pollfd fds[SERVER_SOCKS_MAX];
	uint16_t ports[SERVER_SOCKS_MAX];
	int count;
	int sock_other; /* the one bound to OTHER_PORT */
	atomic_t mode;
	atomic_t requests;
	atomic_t last_port;              /* the port the last request came to */
	atomic_t last_client_port;       /* the port the last request came from */
	atomic_t software_seen;          /* the last request carried SOFTWARE */
	atomic_t sent_len;               /* length of the last datagram sent */
	uint8_t txid[2][STUN_TXID_SIZE]; /* of the first two requests */
};

extern struct test_server server;

/* Bind the sockets of the server and start its thread, the first time it is
 * called; the suites of the test share one server.
 */
void server_start(void);

/* Back to answering every request, with nothing counted. */
void server_reset(void);

/* A UDP socket of a family; the test fails if there is none to be had. */
int udp_socket(int family);

/* The size of a socket address of a family. */
net_socklen_t addr_len(int family);

/* The loopback address of a family, with a port. */
void set_loopback(struct net_sockaddr *sa, int family, uint16_t port);

/* The port of a socket address, in host byte order. */
uint16_t port_of(const struct net_sockaddr *sa);

#endif /* STUN_CLIENT_TEST_SERVER_H_ */
```

## src/shell.c
```c
/*
 * SPDX-FileCopyrightText: Copyright The Zephyr Project Contributors
 * SPDX-FileCopyrightText: Copyright (c) 2026 Kirill Shypachov
 * SPDX-License-Identifier: Apache-2.0
 *
 * The "net stun" shell commands, run through the dummy shell backend against
 * the scripted server of server.c.
 */
#include <stdio.h>
#include <string.h>

#include <zephyr/kernel.h>
#include <zephyr/shell/shell.h>
#include <zephyr/shell/shell_dummy.h>
#include <zephyr/sys/util.h>
#include <zephyr/ztest.h>

#include "server.h"

static const struct shell *sh;

/* What the last command printed. */
static const char *output;

/* Run a command in this thread; its output is kept, its return code returned. */
static int run(const char *cmd)
{
	size_t len;
	int rc;

	shell_backend_dummy_clear_output(sh);
	rc = shell_execute_cmd(sh, cmd);
	output = shell_backend_dummy_get_output(sh, &len);
	return rc;
}

#define expect_output(text)                                                                        \
	zassert_not_null(strstr(output, text), "no '%s' in the output: '%s'", text, output)

#define expect_no_output(text)                                                                     \
	zassert_is_null(strstr(output, text), "'%s' in the output: '%s'", text, output)

static void *suite_setup(void)
{
	server_start();

	sh = shell_backend_dummy_get_ptr();
	WAIT_FOR(shell_ready(sh), 20000, k_msleep(1));
	zassert_true(shell_ready(sh), "the dummy shell backend did not start");

#if defined(CONFIG_STUN_SHELL)
	/* Before any command has named a server, it is the one of Kconfig. */
	zassert_ok(run("net stun server"));
	expect_output((sizeof(CONFIG_STUN_SHELL_SERVER) > 1U) ? CONFIG_STUN_SHELL_SERVER
							      : "No STUN server");
#endif
	return NULL;
}

#if defined(CONFIG_STUN_SHELL)

#define OTHER_PORT_STR STRINGIFY(OTHER_PORT)

/* Has the shell printed `text` yet? For a command that runs in its own thread. */
static bool printed(const char *text)
{
	struct shell_dummy *dummy = (struct shell_dummy *)sh->iface->ctx;

	dummy->buf[dummy->len] = '\0';
	return strstr(dummy->buf, text) != NULL;
}

static void before_each(void *fixture)
{
	ARG_UNUSED(fixture);
	server_reset();

	/* Every test starts with no server set. */
	zassert_ok(run("net stun server \"\""));
}

ZTEST_SUITE(stun_shell, NULL, suite_setup, before_each, NULL, NULL);

/* The address the server saw the last request come from, as the command
 * prints it.
 */
static const char *client_address(int family)
{
	static char text[64];

	snprintf(text, sizeof(text), (family == NET_AF_INET) ? "127.0.0.1:%u" : "[::1]:%u",
		 (unsigned int)atomic_get(&server.last_client_port));
	return text;
}

ZTEST(stun_shell, test_server_then_query)
{
	/* A server with a port of its own. */
	zassert_ok(run("net stun server " HOST " " OTHER_PORT_STR));
	zassert_ok(run("net stun query"));
	zassert_equal(atomic_get(&server.requests), 1);
	zassert_equal(atomic_get(&server.last_port), OTHER_PORT);
	expect_output(client_address(FAMILY));

	/* And one on the default port. */
	zassert_ok(run("net stun server " HOST));
	zassert_ok(run("net stun query 2000"));
	zassert_equal(atomic_get(&server.requests), 2);
	zassert_equal(atomic_get(&server.last_port), STUN_CLIENT_DEFAULT_PORT);
	expect_output(client_address(FAMILY));

	/* The same over IPv6, where an address is printed in brackets. */
	if (IS_ENABLED(CONFIG_NET_IPV4) && IS_ENABLED(CONFIG_NET_IPV6)) {
		zassert_ok(run("net stun server ::1"));
		zassert_ok(run("net stun query"));
		zassert_equal(atomic_get(&server.requests), 3);
		expect_output(client_address(NET_AF_INET6));
	}
}

ZTEST(stun_shell, test_query_without_server)
{
	zassert_true(run("net stun query") != 0);
	expect_output("net stun server");
	zassert_equal(atomic_get(&server.requests), 0);
}

ZTEST(stun_shell, test_server_shows_what_is_set)
{
	zassert_ok(run("net stun server"));
	expect_output("No STUN server");

	zassert_ok(run("net stun server " HOST " " OTHER_PORT_STR));
	zassert_ok(run("net stun server"));
	expect_output(HOST);
	expect_output(OTHER_PORT_STR);

	/* Without a port it is the default one. */
	zassert_ok(run("net stun server " HOST));
	zassert_ok(run("net stun server"));
	expect_output(HOST);
	expect_output(STRINGIFY(STUN_CLIENT_DEFAULT_PORT));

	/* An empty name takes the server away again. */
	zassert_ok(run("net stun server \"\""));
	zassert_ok(run("net stun server"));
	expect_output("No STUN server");
}

ZTEST(stun_shell, test_server_refuses_a_bad_port)
{
	static const char *const kBad[] = {
		"net stun server other.invalid 0",
		"net stun server other.invalid 65536",
		"net stun server other.invalid 70000",
		"net stun server other.invalid 4294967297",
		"net stun server other.invalid 99999999999999999999",
		"net stun server other.invalid -1",
		"net stun server other.invalid abc",
		"net stun server other.invalid 34x",
		"net stun server other.invalid \"\"",
		"net stun server other.invalid 3478 more",
	};

	zassert_ok(run("net stun server " HOST " " OTHER_PORT_STR));

	for (size_t i = 0; i < ARRAY_SIZE(kBad); i++) {
		zassert_true(run(kBad[i]) != 0, "'%s' was accepted", kBad[i]);

		/* And the server is what it was. */
		zassert_ok(run("net stun server"));
		expect_output(HOST);
		expect_output(OTHER_PORT_STR);
		expect_no_output("other.invalid");
	}

	zassert_ok(run("net stun query"));
	zassert_equal(atomic_get(&server.last_port), OTHER_PORT);
}

ZTEST(stun_shell, test_server_refuses_a_name_too_long)
{
	/* One character more than the command keeps. */
	char cmd[sizeof("net stun server ") + ZSOCK_NI_MAXHOST];
	size_t at = strlen("net stun server ");

	zassert_ok(run("net stun server " HOST " " OTHER_PORT_STR));

	memset(cmd, 0, sizeof(cmd));
	memcpy(cmd, "net stun server ", at);
	memset(cmd + at, 'a', ZSOCK_NI_MAXHOST);
	zassert_true(run(cmd) != 0);

	zassert_ok(run("net stun server"));
	expect_output(HOST);
	expect_output(OTHER_PORT_STR);
	expect_no_output("aaaa");

	/* The longest one it keeps is kept whole. */
	cmd[at + ZSOCK_NI_MAXHOST - 1] = '\0';
	zassert_ok(run(cmd));
	zassert_ok(run("net stun server"));
	expect_output(cmd + at);
}

ZTEST(stun_shell, test_query_timeout)
{
	int64_t start, took;

	atomic_set(&server.mode, MODE_SILENT);
	zassert_ok(run("net stun server " HOST));

	start = k_uptime_get();
	zassert_true(run("net stun query 300") != 0);
	took = k_uptime_get() - start;

	expect_output("No answer");
	zassert_true(took >= 300 && took < 2000, "gave up after %lld ms", took);
	zassert_equal(atomic_get(&server.requests), 1);
}

ZTEST(stun_shell, test_query_refuses_a_bad_timeout)
{
	/* clang-format off */
	static const char *const kBad[] = {
		"net stun query abc",
		"net stun query -5",
		"net stun query 12x",
		"net stun query \"\"",
		"net stun query 4294967296",
		"net stun query 99999999999999999999",
		"net stun query 100 200",
	};
	/* clang-format on */

	zassert_ok(run("net stun server " HOST));

	for (size_t i = 0; i < ARRAY_SIZE(kBad); i++) {
		zassert_true(run(kBad[i]) != 0, "'%s' was accepted", kBad[i]);
	}
	zassert_equal(atomic_get(&server.requests), 0, "nothing was sent");
}

ZTEST(stun_shell, test_query_reports_what_went_wrong)
{
	/* The server answers with an error. */
	atomic_set(&server.mode, MODE_ERROR_500);
	zassert_ok(run("net stun server " HOST));
	zassert_true(run("net stun query") != 0);
	expect_output("error");
	zassert_equal(atomic_get(&server.requests), 1);

	/* A name nothing resolves. */
	zassert_ok(run("net stun server no-such-host.invalid"));
	zassert_true(run("net stun query") != 0);
	expect_output("no-such-host.invalid");
	zassert_equal(atomic_get(&server.requests), 1, "nothing more was sent");
}

ZTEST(stun_shell, test_query_on_the_shell_thread)
{
	static const char kCmd[] = "net stun query 2000\n";
	const char *expected;
	size_t unused = 0;
	size_t len;

	/* The tests above run the commands in the thread of the test. A user
	 * runs them in the thread of the shell, which has the stack that
	 * CONFIG_SHELL_STACK_SIZE gives it: type the command in, and see what
	 * is left of that stack afterwards.
	 */
	zassert_ok(run("net stun server " HOST));
	shell_backend_dummy_clear_output(sh);
	zassert_ok(shell_backend_dummy_push_input(sh, kCmd, strlen(kCmd)));

	WAIT_FOR(atomic_get(&server.requests) == 1, 5000, k_msleep(1));
	zassert_equal(atomic_get(&server.requests), 1, "the command did not run");
	expected = client_address(FAMILY);
	WAIT_FOR(printed(expected), 5000, k_msleep(1));

	output = shell_backend_dummy_get_output(sh, &len);
	expect_output(expected);

	zassert_ok(k_thread_stack_space_get(sh->thread, &unused));
	TC_PRINT("shell thread: %u of %u bytes of stack never used\n", (unsigned int)unused,
		 (unsigned int)CONFIG_SHELL_STACK_SIZE);
	zassert_true(unused >= 256U, "%u bytes of the shell stack left", (unsigned int)unused);
}

#else /* CONFIG_STUN_SHELL */

ZTEST_SUITE(stun_shell, NULL, suite_setup, NULL, NULL, NULL);

ZTEST(stun_shell, test_disabled_commands_say_how_to_enable_them)
{
	server_reset();

	zassert_ok(run("net stun server " HOST));
	expect_output("CONFIG_STUN_SHELL");

	zassert_ok(run("net stun query"));
	expect_output("CONFIG_STUN_SHELL");
	zassert_equal(atomic_get(&server.requests), 0);
}

#endif /* CONFIG_STUN_SHELL */
```
