## CMakeLists.txt
```
# SPDX-License-Identifier: Apache-2.0

cmake_minimum_required(VERSION 3.28.0)
find_package(Zephyr REQUIRED HINTS $ENV{ZEPHYR_BASE})
project(net_wireguard)

target_include_directories(app PRIVATE ${ZEPHYR_BASE}/subsys/net/ip)
target_include_directories(app PRIVATE ${ZEPHYR_BASE}/subsys/net/lib/wireguard)

FILE(GLOB app_sources src/*.c)
target_sources(app PRIVATE ${app_sources})
```

## prj.conf
```kconfig
CONFIG_NETWORKING=y
CONFIG_NET_IPV4=y
CONFIG_NET_IPV6=n
CONFIG_NET_UDP=y
CONFIG_NET_DRIVERS=y
CONFIG_NET_LOOPBACK=y
CONFIG_NET_L2_DUMMY=y
CONFIG_NET_L2_VIRTUAL=y
CONFIG_NET_L2_VIRTUAL_MGMT=y
CONFIG_WIREGUARD=y
CONFIG_WIREGUARD_MAX_PEER=2
CONFIG_WIREGUARD_BUF_COUNT=4
CONFIG_WIREGUARD_PORT=51820

CONFIG_NET_STATISTICS=y
CONFIG_NET_STATISTICS_VPN=y
CONFIG_NET_STATISTICS_USER_API=y

CONFIG_ZTEST=y
CONFIG_NET_TEST=y
CONFIG_TEST_RANDOM_GENERATOR=y

CONFIG_MAIN_STACK_SIZE=4096
CONFIG_SYSTEM_WORKQUEUE_STACK_SIZE=2048
CONFIG_MBEDTLS_HEAP_SIZE=16384
CONFIG_MBEDTLS_ENABLE_HEAP=y
CONFIG_MBEDTLS_PSA_KEY_SLOT_COUNT=32
```

## src/iface_test.c
```c
/*
 * Copyright The Zephyr Project Contributors
 *
 * SPDX-License-Identifier: Apache-2.0
 */

#include <string.h>

#include <zephyr/ztest.h>
#include <zephyr/net/net_if.h>
#include <zephyr/net/net_ip.h>
#include <zephyr/net/net_mgmt.h>
#include <zephyr/net/virtual.h>
#include <zephyr/net/virtual_mgmt.h>
#include <zephyr/net/wireguard.h>
#include <zephyr/sys/base64.h>

static void find_vpn_iface(struct net_if *iface, void *user_data)
{
	struct net_if **found = user_data;

	if (*found == NULL && net_if_l2(iface) == &NET_L2_GET_NAME(VIRTUAL) &&
	    net_virtual_get_iface_capabilities(iface) == VIRTUAL_INTERFACE_VPN) {
		*found = iface;
	}
}

static void set_private_key(void)
{
	static const char *private_key = "lmAIbJR8PQOpgJxmfOydBiDbexTMEKsjglZ1sj3kIjs=";
	struct virtual_interface_req_params params = { 0 };
	struct net_if *vpn_iface = NULL;
	uint8_t key[32];
	size_t olen;
	int ret;

	net_if_foreach(find_vpn_iface, &vpn_iface);
	zassert_not_null(vpn_iface, "No VPN interface");

	ret = base64_decode(key, sizeof(key), &olen, private_key, strlen(private_key));
	zassert_true(ret == 0 && olen == sizeof(key), "Cannot decode the private key");

	params.private_key.data = key;
	params.private_key.len = sizeof(key);

	ret = net_mgmt(NET_REQUEST_VIRTUAL_INTERFACE_SET_PRIVATE_KEY, vpn_iface, &params,
		       sizeof(params));
	(void)memset(key, 0, sizeof(key));
	zassert_equal(ret, 0, "Cannot set the private key (%d)", ret);
}

/* Adding the first peer takes its virtual interface up, and the virtual L2
 * takes the wg_ctrl control interface below it up as well. wg_ctrl is a dummy
 * L2 interface without a link address, which used to trip an assertion in
 * notify_iface_up().
 */
ZTEST(wireguard_iface, test_peer_add_takes_ctrl_iface_up)
{
	struct wireguard_peer_config config = {
		.public_key = "fF2zTE6NVbBEZkwDgaPDkd9Vx7nL6xj/6g9W3nwyyHc=",
	};
	struct net_sockaddr_in *endpoint = (struct net_sockaddr_in *)&config.endpoint_ip;
	struct net_if *peer_iface = NULL;
	struct net_if *ctrl_iface;
	int peer_id;
	int ret;

	ctrl_iface = net_if_get_by_index(net_if_get_by_name("wg_ctrl"));
	zassert_not_null(ctrl_iface, "No wg_ctrl interface");

	set_private_key();

	endpoint->sin_family = NET_AF_INET;
	endpoint->sin_port = net_htons(51820);
	endpoint->sin_addr.s_addr = net_htonl(0xC0000201U);

	peer_id = wireguard_peer_add(&config, &peer_iface);
	zassert_true(peer_id > 0, "Peer add failed (%d)", peer_id);
	zassert_not_null(peer_iface, "No peer interface");

	zassert_true(net_if_is_up(peer_iface), "Peer interface is not up");
	zassert_true(net_if_is_up(ctrl_iface), "wg_ctrl is not up");

	ret = wireguard_peer_remove(peer_id);
	zassert_equal(ret, 0, "Peer remove failed (%d)", ret);
}

ZTEST_SUITE(wireguard_iface, NULL, NULL, NULL, NULL, NULL);
```

## src/keepalive_test.c
```c
/*
 * Copyright The Zephyr Project Contributors
 *
 * SPDX-License-Identifier: Apache-2.0
 */

#include <string.h>

#include <zephyr/kernel.h>
#include <zephyr/ztest.h>
#include <zephyr/net/net_if.h>
#include <zephyr/net/net_ip.h>
#include <zephyr/net/net_mgmt.h>
#include <zephyr/net/net_pkt.h>
#include <zephyr/net/virtual.h>
#include <zephyr/net/virtual_mgmt.h>
#include <zephyr/net/wireguard.h>
#include <zephyr/sys/base64.h>

#include "wg_test_helpers.h"

static void find_vpn_iface(struct net_if *iface, void *user_data)
{
	struct net_if **found = user_data;

	if (*found == NULL && net_if_l2(iface) == &NET_L2_GET_NAME(VIRTUAL) &&
	    net_virtual_get_iface_capabilities(iface) == VIRTUAL_INTERFACE_VPN) {
		*found = iface;
	}
}

static void set_private_key(void)
{
	static const char *private_key = "lmAIbJR8PQOpgJxmfOydBiDbexTMEKsjglZ1sj3kIjs=";
	struct virtual_interface_req_params params = { 0 };
	struct net_if *vpn_iface = NULL;
	uint8_t key[32];
	size_t olen;
	int ret;

	net_if_foreach(find_vpn_iface, &vpn_iface);
	zassert_not_null(vpn_iface, "No VPN interface");

	ret = base64_decode(key, sizeof(key), &olen, private_key, strlen(private_key));
	zassert_true(ret == 0 && olen == sizeof(key), "Cannot decode the private key");

	params.private_key.data = key;
	params.private_key.len = sizeof(key);

	ret = net_mgmt(NET_REQUEST_VIRTUAL_INTERFACE_SET_PRIVATE_KEY, vpn_iface, &params,
		       sizeof(params));
	(void)memset(key, 0, sizeof(key));
	zassert_equal(ret, 0, "Cannot set the private key (%d)", ret);
}

/* Each test removes the peer it adds, and checks with zexpect while the peer
 * exists so that it always gets there.
 */

static const char *peer_public_key = "fF2zTE6NVbBEZkwDgaPDkd9Vx7nL6xj/6g9W3nwyyHc=";

static void set_test_endpoint(struct wireguard_peer_config *config)
{
	struct net_sockaddr_in *cfg_endpoint = (struct net_sockaddr_in *)&config->endpoint_ip;

	cfg_endpoint->sin_family = NET_AF_INET;
	cfg_endpoint->sin_port = net_htons(51820);
	cfg_endpoint->sin_addr.s_addr = net_htonl(0xC0000201U); /* 192.0.2.1 */
}

/* With a Wireguard work queue of its own, the periodic timer sends the first
 * initiation there, after the call that started it has returned.
 */
static uint32_t wait_for_init_tx(int peer_id, uint32_t count)
{
	struct net_stats_vpn stats = { 0 };
	k_timepoint_t end = sys_timepoint_calc(K_SECONDS(1));

	do {
		if (wireguard_test_get_stats(peer_id, &stats) != 0) {
			break;
		}

		if (stats.handshake_init_tx >= count) {
			break;
		}

		k_sleep(K_MSEC(10));
	} while (!sys_timepoint_expired(end));

	return stats.handshake_init_tx;
}

/* A peer that was just added has no endpoint learnt from it yet. A keepalive
 * must start the first handshake, to the configured endpoint, so that an
 * application can bring the tunnel up without sending traffic into it.
 */
ZTEST(wireguard_keepalive, test_keepalive_starts_first_handshake)
{
	struct wireguard_peer_config config = {
		.public_key = peer_public_key,
	};
	struct net_sockaddr_in *cfg_endpoint = (struct net_sockaddr_in *)&config.endpoint_ip;
	struct net_sockaddr_storage endpoint;
	struct net_stats_vpn before;
	struct net_stats_vpn after;
	struct net_if *peer_iface;
	int peer_id;
	int ret;

	set_private_key();
	set_test_endpoint(&config);

	peer_id = wireguard_peer_add(&config, &peer_iface);
	zassert_true(peer_id > 0, "Peer add failed (%d)", peer_id);

	ret = wireguard_test_peer_endpoint(peer_id, &endpoint);
	zexpect_equal(ret, 0);
	zexpect_equal(endpoint.ss_family, NET_AF_UNSPEC, "New peer has a learnt endpoint");

	ret = wireguard_test_get_stats(peer_id, &before);
	zexpect_equal(ret, 0);

	ret = wireguard_peer_keepalive(peer_id);
	zexpect_equal(ret, 0, "Keepalive failed (%d)", ret);

	zexpect_equal(wait_for_init_tx(peer_id, before.handshake_init_tx + 1),
		      before.handshake_init_tx + 1, "No handshake initiation sent");

	ret = wireguard_test_get_stats(peer_id, &after);
	zexpect_equal(ret, 0);

	ret = wireguard_test_peer_endpoint(peer_id, &endpoint);
	zexpect_equal(ret, 0);
	zexpect_equal(endpoint.ss_family, NET_AF_INET, "Not sent to the configured endpoint");
	zexpect_equal(net_sin(net_sad(&endpoint))->sin_addr.s_addr,
		      cfg_endpoint->sin_addr.s_addr);
	zexpect_equal(net_sin(net_sad(&endpoint))->sin_port, cfg_endpoint->sin_port);

	/* While the handshake is pending, another keepalive is no error and
	 * sends no other initiation before the rekey timeout. Nor does it leave
	 * a handshake request behind, which would rekey the session as soon as
	 * the rekey timeout expires.
	 */
	ret = wireguard_peer_keepalive(peer_id);
	zexpect_equal(ret, 0, "Second keepalive failed (%d)", ret);
	zexpect_false(wireguard_test_peer_send_handshake(peer_id),
		      "Handshake request left pending");

	before = after;
	ret = wireguard_test_get_stats(peer_id, &after);
	zexpect_equal(ret, 0);
	zexpect_equal(after.handshake_init_tx, before.handshake_init_tx);
	zexpect_equal(after.invalid_key, before.invalid_key);
	zexpect_equal(after.invalid_ip_family, before.invalid_ip_family);

	ret = wireguard_peer_remove(peer_id);
	zassert_equal(ret, 0, "Peer remove failed (%d)", ret);
}

/* With a Wireguard work queue of its own, the initiation started by a
 * keepalive is not computed on the stack of the calling thread: with the
 * scheduler locked nothing is sent before the call returns, and the work
 * queue sends the initiation once the scheduler is unlocked.
 */
ZTEST(wireguard_keepalive, test_keepalive_initiation_on_workq)
{
	struct wireguard_peer_config config = {
		.public_key = peer_public_key,
	};
	struct net_stats_vpn before;
	struct net_stats_vpn locked;
	struct net_if *peer_iface;
	bool pending;
	int peer_id;
	int ret;

	if (CONFIG_WIREGUARD_WORKQ_STACK_SIZE == 0) {
		ztest_test_skip();
	}

	set_private_key();
	set_test_endpoint(&config);

	peer_id = wireguard_peer_add(&config, &peer_iface);
	zassert_true(peer_id > 0, "Peer add failed (%d)", peer_id);

	ret = wireguard_test_get_stats(peer_id, &before);
	zexpect_equal(ret, 0);

	k_sched_lock();
	ret = wireguard_peer_keepalive(peer_id);
	pending = wireguard_test_peer_send_handshake(peer_id);
	(void)wireguard_test_get_stats(peer_id, &locked);
	k_sched_unlock();

	zexpect_equal(ret, 0, "Keepalive failed (%d)", ret);
	zexpect_true(pending, "Initiation not left to the work queue");
	zexpect_equal(locked.handshake_init_tx, before.handshake_init_tx,
		      "Initiation sent from the calling thread");

	zexpect_equal(wait_for_init_tx(peer_id, before.handshake_init_tx + 1),
		      before.handshake_init_tx + 1, "No handshake initiation sent");
	zexpect_false(wireguard_test_peer_send_handshake(peer_id),
		      "Handshake request left pending");

	ret = wireguard_peer_remove(peer_id);
	zassert_equal(ret, 0, "Peer remove failed (%d)", ret);
}

/* Nor is the initiation started by the first packet sent to a peer: the
 * packet is dropped with -EAGAIN, the handshake left due, and the work queue
 * sends the initiation once the scheduler is unlocked.
 */
ZTEST(wireguard_keepalive, test_first_packet_initiation_on_workq)
{
	struct wireguard_peer_config config = {
		.public_key = peer_public_key,
	};
	const struct virtual_interface_driver_api *api;
	struct net_stats_vpn before;
	struct net_stats_vpn locked;
	struct net_if *peer_iface;
	struct net_pkt *pkt;
	bool pending;
	int peer_id;
	int ret;

	if (CONFIG_WIREGUARD_WORKQ_STACK_SIZE == 0) {
		ztest_test_skip();
	}

	set_private_key();
	set_test_endpoint(&config);

	peer_id = wireguard_peer_add(&config, &peer_iface);
	zassert_true(peer_id > 0, "Peer add failed (%d)", peer_id);

	ret = wireguard_test_get_stats(peer_id, &before);
	zexpect_equal(ret, 0);

	/* An empty packet passes the allowed IP check */
	pkt = net_pkt_alloc_with_buffer(peer_iface, 0, NET_AF_INET, 0, K_NO_WAIT);
	zexpect_not_null(pkt, "Cannot allocate a packet");

	if (pkt != NULL) {
		api = net_if_get_device(peer_iface)->api;

		k_sched_lock();
		ret = api->send(peer_iface, pkt);
		pending = wireguard_test_peer_send_handshake(peer_id);
		(void)wireguard_test_get_stats(peer_id, &locked);
		k_sched_unlock();

		/* A packet that is not sent is left to the caller */
		net_pkt_unref(pkt);

		zexpect_equal(ret, -EAGAIN, "Unexpected result (%d)", ret);
		zexpect_true(pending, "Initiation not left to the work queue");
		zexpect_equal(locked.handshake_init_tx, before.handshake_init_tx,
			      "Initiation sent from the calling thread");

		zexpect_equal(wait_for_init_tx(peer_id, before.handshake_init_tx + 1),
			      before.handshake_init_tx + 1, "No handshake initiation sent");
		zexpect_false(wireguard_test_peer_send_handshake(peer_id),
			      "Handshake request left pending");
	}

	ret = wireguard_peer_remove(peer_id);
	zassert_equal(ret, 0, "Peer remove failed (%d)", ret);
}

/* A peer added without an endpoint can only be reached once it contacts us */
ZTEST(wireguard_keepalive, test_keepalive_without_endpoint)
{
	struct wireguard_peer_config config = {
		.public_key = peer_public_key,
	};
	struct net_stats_vpn before;
	struct net_stats_vpn after;
	struct net_if *peer_iface;
	int peer_id;
	int ret;

	set_private_key();

	peer_id = wireguard_peer_add(&config, &peer_iface);
	zassert_true(peer_id > 0, "Peer add failed (%d)", peer_id);

	ret = wireguard_test_get_stats(peer_id, &before);
	zexpect_equal(ret, 0);

	ret = wireguard_peer_keepalive(peer_id);
	zexpect_equal(ret, -EDESTADDRREQ, "Unexpected result (%d)", ret);

	ret = wireguard_test_get_stats(peer_id, &after);
	zexpect_equal(ret, 0);
	zexpect_equal(after.handshake_init_tx, before.handshake_init_tx);

	ret = wireguard_peer_remove(peer_id);
	zassert_equal(ret, 0, "Peer remove failed (%d)", ret);
}

static void *keepalive_setup(void)
{
	/* The library takes a zero tick count for "never sent", so leave the
	 * first tick behind before sending anything.
	 */
	k_sleep(K_MSEC(10));

	return NULL;
}

ZTEST_SUITE(wireguard_keepalive, NULL, keepalive_setup, NULL, NULL, NULL);
```

## src/replay_test.c
```c
/*
 * Copyright (c) 2026 Nordic Semiconductor ASA
 *
 * SPDX-License-Identifier: Apache-2.0
 */

#include <zephyr/ztest.h>

#include "wg_test_helpers.h"

ZTEST(wireguard_replay, test_first_packet)
{
	uint32_t bitmap = 0;
	uint64_t counter = 0;

	zassert_true(wg_replay_check(&bitmap, &counter, 0));
	zassert_equal(counter, 1);
	zassert_equal(bitmap, 1);
}

ZTEST(wireguard_replay, test_duplicate)
{
	uint32_t bitmap = 0;
	uint64_t counter = 0;

	zassert_true(wg_replay_check(&bitmap, &counter, 5));
	zassert_false(wg_replay_check(&bitmap, &counter, 5));
}

ZTEST(wireguard_replay, test_out_of_order)
{
	uint32_t bitmap = 0;
	uint64_t counter = 0;

	zassert_true(wg_replay_check(&bitmap, &counter, 10));
	zassert_true(wg_replay_check(&bitmap, &counter, 8));
}

ZTEST(wireguard_replay, test_too_old)
{
	uint32_t bitmap = 0;
	uint64_t counter = 0;

	zassert_true(wg_replay_check(&bitmap, &counter, 100));
	zassert_false(wg_replay_check(&bitmap, &counter, 50));
}

ZTEST(wireguard_replay, test_large_jump)
{
	uint32_t bitmap = 0;
	uint64_t counter = 0;

	zassert_true(wg_replay_check(&bitmap, &counter, 5));
	zassert_true(wg_replay_check(&bitmap, &counter, 1000));
	zassert_equal(counter, 1001);
	zassert_equal(bitmap, 1);
}

/* A forward jump larger than 2^32 must reset the window rather than be
 * truncated into a small in-window delta (which would keep stale bits and make
 * a never-seen counter look like a replay).
 */
ZTEST(wireguard_replay, test_forward_jump_over_2_32)
{
	uint32_t bitmap = 0;
	uint64_t counter = 0;
	uint64_t base = 3;

	zassert_true(wg_replay_check(&bitmap, &counter, base));

	zassert_true(wg_replay_check(&bitmap, &counter, base + (1ULL << 32) + 5));
	zassert_equal(bitmap, 1);

	/* Never seen before, so must be accepted (a truncated diff would treat
	 * it as already seen via a stale bit).
	 */
	zassert_true(wg_replay_check(&bitmap, &counter, base + (1ULL << 32)));
}

/* A counter roughly 2^32 behind the window must be rejected as too old, not
 * truncated into an in-window delta and accepted.
 */
ZTEST(wireguard_replay, test_backward_gap_over_2_32)
{
	uint32_t bitmap = 0;
	uint64_t counter = 0;

	zassert_true(wg_replay_check(&bitmap, &counter, (1ULL << 32) + 100));
	zassert_false(wg_replay_check(&bitmap, &counter, 95));
}

ZTEST_SUITE(wireguard_replay, NULL, NULL, NULL, NULL, NULL);
```

## src/transport_test.c
```c
/*
 * Copyright (c) 2026 Nordic Semiconductor ASA
 *
 * SPDX-License-Identifier: Apache-2.0
 */

#include <string.h>

#include <zephyr/kernel.h>
#include <zephyr/ztest.h>
#include <zephyr/net/wireguard.h>
#include <zephyr/net/socket.h>

#include "wg_test_helpers.h"

static int test_peer_id;

static struct wireguard_test_session test_session = {
	.recv_key = {
		0x01, 0x02, 0x03, 0x04, 0x05, 0x06, 0x07, 0x08,
		0x09, 0x0a, 0x0b, 0x0c, 0x0d, 0x0e, 0x0f, 0x10,
		0x11, 0x12, 0x13, 0x14, 0x15, 0x16, 0x17, 0x18,
		0x19, 0x1a, 0x1b, 0x1c, 0x1d, 0x1e, 0x1f, 0x20,
	},
	.send_key = {
		0x21, 0x22, 0x23, 0x24, 0x25, 0x26, 0x27, 0x28,
		0x29, 0x2a, 0x2b, 0x2c, 0x2d, 0x2e, 0x2f, 0x30,
		0x31, 0x32, 0x33, 0x34, 0x35, 0x36, 0x37, 0x38,
		0x39, 0x3a, 0x3b, 0x3c, 0x3d, 0x3e, 0x3f, 0x40,
	},
	.local_index = 0x12345678,
	.remote_index = 0x87654321,
};

static struct net_sockaddr_storage make_addr(uint32_t addr_be32, uint16_t port)
{
	struct net_sockaddr_storage storage = { 0 };
	struct net_sockaddr *addr = (struct net_sockaddr *)&storage;

	addr->sa_family = NET_AF_INET;
	net_sin(addr)->sin_addr.s_addr = addr_be32;
	net_sin(addr)->sin_port = net_htons(port);

	return storage;
}

static void *transport_setup(void)
{
	int ret;

	test_peer_id = wireguard_test_peer_add(NULL);
	zassert_true(test_peer_id > 0, "peer add failed (%d)", test_peer_id);

	ret = wireguard_test_install_session(test_peer_id, &test_session);
	zassert_equal(ret, 0, "session install failed (%d)", ret);

	return NULL;
}

static void transport_before(void *fixture)
{
	int ret;

	ARG_UNUSED(fixture);

	ret = wireguard_test_install_session(test_peer_id, &test_session);
	zassert_equal(ret, 0, "session reinstall failed (%d)", ret);
}

ZTEST(wireguard_transport, test_replay_does_not_mutate_peer_state)
{
	struct net_stats_vpn stats_before;
	struct net_stats_vpn stats_after;
	struct wireguard_test_keypair_state kp_before;
	struct wireguard_test_keypair_state kp_after;
	struct net_sockaddr_storage endpoint_before;
	struct net_sockaddr_storage endpoint_after;
	uint8_t ciphertext[32];
	size_t ciphertext_len;
	uint32_t last_rx_before;
	uint32_t last_rx_after;
	struct net_sockaddr_storage src_a;
	struct net_sockaddr_storage src_b;
	int ret;

	src_a = make_addr(net_htonl(0xC0000201), 51820); /* 192.0.2.1 */
	src_b = make_addr(net_htonl(0xC0000263), 51820); /* 192.0.2.99 */

	ret = wireguard_test_encrypt(test_session.recv_key, 0, NULL, 0,
				     ciphertext, sizeof(ciphertext),
				     &ciphertext_len);
	zassert_equal(ret, 0);
	zassert_equal(ciphertext_len, 16U);

	ret = wireguard_test_inject_transport(test_peer_id,
					      (struct net_sockaddr *)&src_a,
					      0, ciphertext, ciphertext_len);
	zassert_equal(ret, 0, "first inject failed (%d)", ret);

	last_rx_before = wireguard_test_peer_last_rx(test_peer_id);
	ret = wireguard_test_peer_endpoint(test_peer_id, &endpoint_before);
	zassert_equal(ret, 0);
	ret = wireguard_test_get_stats(test_peer_id, &stats_before);
	zassert_equal(ret, 0);
	ret = wireguard_test_peer_keypair_state(test_peer_id, &kp_before);
	zassert_equal(ret, 0);

	ret = wireguard_test_inject_transport(test_peer_id,
					      (struct net_sockaddr *)&src_b,
					      0, ciphertext, ciphertext_len);
	zassert_true(ret < 0, "replay inject should fail (%d)", ret);

	last_rx_after = wireguard_test_peer_last_rx(test_peer_id);
	ret = wireguard_test_peer_endpoint(test_peer_id, &endpoint_after);
	zassert_equal(ret, 0);
	ret = wireguard_test_get_stats(test_peer_id, &stats_after);
	zassert_equal(ret, 0);
	ret = wireguard_test_peer_keypair_state(test_peer_id, &kp_after);
	zassert_equal(ret, 0);

	zassert_equal(last_rx_after, last_rx_before);
	zassert_mem_equal(&endpoint_before, &endpoint_after, sizeof(endpoint_before));
	zassert_equal(stats_after.replay_error, stats_before.replay_error + 1);
	zassert_equal(kp_after.prev_valid, kp_before.prev_valid);
	zassert_equal(kp_after.current_valid, kp_before.current_valid);
	zassert_equal(kp_after.next_valid, kp_before.next_valid);
}

ZTEST(wireguard_transport, test_forged_keepalive_rejected)
{
	struct net_stats_vpn stats_before;
	struct net_stats_vpn stats_after;
	uint8_t garbage[16];
	struct net_sockaddr_storage src;
	int ret;

	src = make_addr(net_htonl(0xC0000201), 51820);
	memset(garbage, 0x5a, sizeof(garbage));

	ret = wireguard_test_get_stats(test_peer_id, &stats_before);
	zassert_equal(ret, 0);
	zassert_false(wireguard_test_peer_first_valid(test_peer_id));

	ret = wireguard_test_inject_transport(test_peer_id,
					      (struct net_sockaddr *)&src,
					      0, garbage, sizeof(garbage));
	zassert_true(ret < 0, "forged keepalive should fail (%d)", ret);

	ret = wireguard_test_get_stats(test_peer_id, &stats_after);
	zassert_equal(ret, 0);
	zassert_false(wireguard_test_peer_first_valid(test_peer_id));
	zassert_equal(stats_after.decrypt_failed, stats_before.decrypt_failed + 1);
	zassert_equal(stats_after.keepalive_rx, stats_before.keepalive_rx);
}

ZTEST(wireguard_transport, test_valid_keepalive_accepted)
{
	struct net_stats_vpn stats_before;
	struct net_stats_vpn stats_after;
	uint8_t ciphertext[32];
	size_t ciphertext_len;
	struct net_sockaddr_storage src;
	int ret;

	src = make_addr(net_htonl(0xC0000201), 51820);

	ret = wireguard_test_encrypt(test_session.recv_key, 1, NULL, 0,
				     ciphertext, sizeof(ciphertext),
				     &ciphertext_len);
	zassert_equal(ret, 0);
	zassert_equal(ciphertext_len, 16U);

	ret = wireguard_test_get_stats(test_peer_id, &stats_before);
	zassert_equal(ret, 0);

	ret = wireguard_test_inject_transport(test_peer_id,
					      (struct net_sockaddr *)&src,
					      1, ciphertext, ciphertext_len);
	zassert_equal(ret, 0, "valid keepalive failed (%d)", ret);

	ret = wireguard_test_get_stats(test_peer_id, &stats_after);
	zassert_equal(ret, 0);
	zassert_true(wireguard_test_peer_first_valid(test_peer_id));
	zassert_equal(stats_after.keepalive_rx, stats_before.keepalive_rx + 1);
	zassert_equal(stats_after.valid_rx, stats_before.valid_rx);
}

ZTEST(wireguard_transport, test_unknown_session_does_not_move_endpoint)
{
	struct net_sockaddr_storage endpoint_before;
	struct net_sockaddr_storage endpoint_after;
	struct net_sockaddr_storage attacker;
	int ret;

	/* Neither a session nor a handshake in progress, which is the state at
	 * boot and after the session has expired.
	 */
	ret = wireguard_test_clear_session(test_peer_id);
	zassert_equal(ret, 0, "session clear failed (%d)", ret);

	ret = wireguard_test_peer_endpoint(test_peer_id, &endpoint_before);
	zassert_equal(ret, 0);

	attacker = make_addr(net_htonl(0xC000022A), 40000); /* 192.0.2.42 */

	ret = wireguard_test_inject_stale_session(test_peer_id,
						  (struct net_sockaddr *)&attacker,
						  0xdeadbeef);
	zexpect_true(ret < 0, "unauthenticated message should be dropped (%d)", ret);

	ret = wireguard_test_peer_endpoint(test_peer_id, &endpoint_after);
	zassert_equal(ret, 0);

	zexpect_mem_equal(&endpoint_after, &endpoint_before, sizeof(endpoint_after),
			  "endpoint moved by unauthenticated message");

	/* Recovery from a stale session is still attempted, but only towards
	 * the endpoint we already trust.
	 */
	zexpect_true(wireguard_test_peer_send_handshake(test_peer_id),
		     "handshake not triggered for stale session");
}

ZTEST_SUITE(wireguard_transport, NULL, transport_setup, transport_before, NULL, NULL);
```

## src/wg_test_helpers.c
```c
/*
 * Copyright (c) 2026 Nordic Semiconductor ASA
 *
 * SPDX-License-Identifier: Apache-2.0
 */

#include <string.h>

#include <zephyr/kernel.h>
#include <zephyr/sys/util.h>
#include <zephyr/sys/base64.h>
#include <zephyr/net/net_if.h>
#include <zephyr/net/net_ip.h>
#include <zephyr/net/net_pkt.h>
#include <zephyr/net/net_mgmt.h>
#include <zephyr/net/net_stats.h>
#include <zephyr/net/socket.h>
#include <zephyr/net/virtual.h>
#include <zephyr/net/virtual_mgmt.h>
#include <zephyr/net/wireguard.h>

#include <psa/crypto.h>

/* Internal library types and constants (struct wg_peer/wg_keypair,
 * msg_transport_data, REJECT_AFTER_TIME, WG_AUTHTAG_LEN, ...).
 */
#include "wg_internal.h"

#include "wg_test_helpers.h"

/* Library internals exported for tests via ZTESTABLE_STATIC. */
struct wg_peer *peer_lookup_by_id(int id);
void keypair_destroy(struct wg_keypair *keypair);
int wg_psa_import_chacha_key(psa_key_id_t *key_id, const uint8_t *key_data,
			     psa_key_usage_t usage);
int wg_psa_aead_encrypt(uint8_t *dst, const uint8_t *src, size_t src_len,
			const uint8_t *ad, size_t ad_len, uint64_t nonce,
			const uint8_t *key);
int wg_process_data_message(struct wg_iface_context *ctx, struct wg_peer *peer,
			    struct msg_transport_data *data_hdr, struct net_pkt *pkt,
			    size_t ip_udp_hdr_len, struct net_sockaddr *addr);
int handle_transport_data(struct wg_peer *peer, struct net_sockaddr *peer_addr,
			  struct net_pkt *pkt, size_t ip_udp_hdr_len, size_t data_len);

/* Preallocated peer pool / active list, exported via ZTESTABLE_STATIC. */
extern sys_slist_t peer_list;
extern sys_slist_t active_peers;

static void find_wg_iface(struct net_if *iface, void *user_data)
{
	struct net_if **found = user_data;

	if (net_if_l2(iface) != &NET_L2_GET_NAME(VIRTUAL)) {
		return;
	}

	if (net_virtual_get_iface_capabilities(iface) != VIRTUAL_INTERFACE_VPN) {
		return;
	}

	if (*found == NULL) {
		*found = iface;
	}
}

int wireguard_test_peer_add(struct net_if **iface_out)
{
	static const char *iface_privkey = "lmAIbJR8PQOpgJxmfOydBiDbexTMEKsjglZ1sj3kIjs=";
	static int test_peer_id;
	struct virtual_interface_req_params params = { 0 };
	uint8_t private_key[WG_PRIVATE_KEY_LEN];
	struct net_if *iface = NULL;
	struct wg_peer *peer;
	sys_snode_t *node;
	size_t olen;
	int ret;

	net_if_foreach(find_wg_iface, &iface);
	if (iface == NULL) {
		return -ENODEV;
	}

	ret = base64_decode(private_key, sizeof(private_key), &olen, iface_privkey,
			    strlen(iface_privkey));
	if (ret < 0 || olen != sizeof(private_key)) {
		return -EINVAL;
	}

	params.private_key.data = private_key;
	params.private_key.len = sizeof(private_key);

	ret = net_mgmt(NET_REQUEST_VIRTUAL_INTERFACE_SET_PRIVATE_KEY, iface, &params,
		       sizeof(params));
	(void)memset(private_key, 0, sizeof(private_key));
	if (ret < 0) {
		return ret;
	}

	/* Grab a peer from the preallocated pool and wire up only the fields the
	 * transport receive path and the test getters touch. We deliberately do
	 * not bring the interface up nor run the Noise handshake: the tests inject
	 * transport-data messages straight into the receive path, decrypting with
	 * the synthetic session keys installed by wireguard_test_install_session().
	 */
	node = sys_slist_get(&peer_list);
	if (node == NULL) {
		return -ENOMEM;
	}

	peer = CONTAINER_OF(node, struct wg_peer, node);

	(void)memset(&peer->session, 0, sizeof(peer->session));

	peer->ctx = net_if_get_device(iface)->data;
	peer->iface = iface;
	peer->id = ++test_peer_id;
	peer->first_valid = false;
	peer->last_rx = 0;

	net_sin(net_sad(&peer->cfg_endpoint))->sin_family = NET_AF_INET;
	net_sin(net_sad(&peer->cfg_endpoint))->sin_port = net_htons(51820);
	net_sin(net_sad(&peer->cfg_endpoint))->sin_addr.s_addr = net_htonl(0xC0000201);
	memcpy(&peer->endpoint, &peer->cfg_endpoint, sizeof(peer->endpoint));

	sys_slist_prepend(&active_peers, node);

	if (iface_out != NULL) {
		*iface_out = iface;
	}

	return peer->id;
}

int wireguard_test_install_session(int peer_id,
				   const struct wireguard_test_session *session)
{
	struct wg_keypair *kp;
	struct wg_peer *peer;
	int ret;

	if (session == NULL) {
		return -EINVAL;
	}

	peer = peer_lookup_by_id(peer_id);
	if (peer == NULL) {
		return -ENOENT;
	}

	kp = &peer->session.keypair.current;

	keypair_destroy(kp);
	(void)memset(kp, 0, sizeof(*kp));

	ret = wg_psa_import_chacha_key(&kp->receiving_key_id, session->recv_key,
				       PSA_KEY_USAGE_DECRYPT);
	if (ret < 0) {
		return ret;
	}

	ret = wg_psa_import_chacha_key(&kp->sending_key_id, session->send_key,
				       PSA_KEY_USAGE_ENCRYPT);
	if (ret < 0) {
		keypair_destroy(kp);
		return ret;
	}

	kp->local_index = session->local_index;
	kp->remote_index = session->remote_index;
	kp->expires = sys_timepoint_calc(K_SECONDS(REJECT_AFTER_TIME));
	kp->rejected = sys_timepoint_calc(K_SECONDS(REJECT_AFTER_TIME * 3));
	kp->is_valid = true;
	kp->is_sending_valid = true;
	kp->is_receiving_valid = true;
	kp->is_initiator = true;

	peer->first_valid = false;

	return 0;
}

int wireguard_test_encrypt(const uint8_t key[32], uint64_t counter,
			   const uint8_t *plaintext, size_t plaintext_len,
			   uint8_t *ciphertext, size_t ciphertext_size,
			   size_t *ciphertext_len)
{
	size_t padded_len = ROUND_UP(plaintext_len, 16U);
	int ret;

	if (key == NULL || ciphertext == NULL || ciphertext_len == NULL) {
		return -EINVAL;
	}

	if (ciphertext_size < padded_len + WG_AUTHTAG_LEN) {
		return -ENOMEM;
	}

	(void)memset(ciphertext, 0, padded_len);
	if (plaintext_len > 0U && plaintext != NULL) {
		memcpy(ciphertext, plaintext, plaintext_len);
	}

	ret = wg_psa_aead_encrypt(ciphertext, ciphertext, padded_len, NULL, 0, counter, key);
	if (ret < 0) {
		return -EINVAL;
	}

	*ciphertext_len = padded_len + WG_AUTHTAG_LEN;

	return 0;
}

int wireguard_test_inject_transport(int peer_id,
				    const struct net_sockaddr *src,
				    uint64_t counter,
				    const uint8_t *ciphertext,
				    size_t ciphertext_len)
{
	NET_PKT_DATA_ACCESS_DEFINE(access, struct msg_transport_data);
	struct msg_transport_data *msg;
	struct msg_transport_data hdr;
	struct net_pkt *pkt = NULL;
	struct wg_peer *peer;
	size_t payload_len;
	int ret;

	if (src == NULL || ciphertext == NULL) {
		return -EINVAL;
	}

	if (src->sa_family != NET_AF_INET) {
		return -EAFNOSUPPORT;
	}

	peer = peer_lookup_by_id(peer_id);
	if (peer == NULL) {
		return -ENOENT;
	}

	payload_len = sizeof(struct msg_transport_data) + ciphertext_len;
	if (payload_len > CONFIG_WIREGUARD_BUF_LEN) {
		return -EMSGSIZE;
	}

	pkt = net_pkt_alloc_with_buffer(peer->iface, payload_len, NET_AF_UNSPEC, 0,
					PKT_ALLOC_WAIT_TIME);
	if (pkt == NULL) {
		return -ENOMEM;
	}

	hdr.type = MESSAGE_TRANSPORT_DATA;
	hdr.reserved[0] = hdr.reserved[1] = hdr.reserved[2] = 0;
	hdr.receiver = peer->session.keypair.current.local_index;
	sys_put_le64(counter, hdr.counter);

	ret = net_pkt_write(pkt, &hdr, sizeof(hdr));
	if (ret < 0) {
		goto out;
	}

	ret = net_pkt_write(pkt, ciphertext, ciphertext_len);
	if (ret < 0) {
		goto out;
	}

	net_pkt_cursor_init(pkt);

	msg = (struct msg_transport_data *)net_pkt_get_data(pkt, &access);
	if (msg == NULL) {
		ret = -EINVAL;
		goto out;
	}

	ret = wg_process_data_message(peer->ctx, peer, msg, pkt, 0,
				      (struct net_sockaddr *)src);

out:
	net_pkt_unref(pkt);

	return ret;
}

int wireguard_test_clear_session(int peer_id)
{
	struct wg_peer *peer;

	peer = peer_lookup_by_id(peer_id);
	if (peer == NULL) {
		return -ENOENT;
	}

	keypair_destroy(&peer->session.keypair.prev);
	keypair_destroy(&peer->session.keypair.current);
	keypair_destroy(&peer->session.keypair.next);

	peer->handshake.is_valid = false;
	peer->send_handshake = false;
	peer->first_valid = false;

	return 0;
}

int wireguard_test_inject_stale_session(int peer_id, const struct net_sockaddr *src,
					uint32_t receiver)
{
	struct msg_transport_data hdr;
	struct net_pkt *pkt = NULL;
	struct wg_peer *peer;
	int ret;

	if (src == NULL) {
		return -EINVAL;
	}

	peer = peer_lookup_by_id(peer_id);
	if (peer == NULL) {
		return -ENOENT;
	}

	pkt = net_pkt_alloc_with_buffer(peer->iface, sizeof(hdr), NET_AF_UNSPEC, 0,
					PKT_ALLOC_WAIT_TIME);
	if (pkt == NULL) {
		return -ENOMEM;
	}

	hdr.type = MESSAGE_TRANSPORT_DATA;
	hdr.reserved[0] = hdr.reserved[1] = hdr.reserved[2] = 0;
	hdr.receiver = receiver;
	sys_put_le64(0ULL, hdr.counter);

	ret = net_pkt_write(pkt, &hdr, sizeof(hdr));
	if (ret < 0) {
		goto out;
	}

	net_pkt_cursor_init(pkt);

	ret = handle_transport_data(peer, (struct net_sockaddr *)src, pkt, 0, 0);

out:
	net_pkt_unref(pkt);

	return ret;
}

bool wireguard_test_peer_send_handshake(int peer_id)
{
	struct wg_peer *peer = peer_lookup_by_id(peer_id);

	return peer != NULL ? peer->send_handshake : false;
}

int wireguard_test_get_stats(int peer_id, struct net_stats_vpn *stats)
{
	struct wg_peer *peer;

	if (stats == NULL) {
		return -EINVAL;
	}

	peer = peer_lookup_by_id(peer_id);
	if (peer == NULL) {
		return -ENOENT;
	}

#if defined(CONFIG_NET_STATISTICS_VPN) && defined(CONFIG_NET_STATISTICS_USER_API)
	return net_mgmt(NET_REQUEST_STATS_GET_VPN, peer->iface, stats, sizeof(*stats));
#else
	return -ENOTSUP;
#endif
}

bool wireguard_test_peer_first_valid(int peer_id)
{
	struct wg_peer *peer = peer_lookup_by_id(peer_id);

	return peer != NULL ? peer->first_valid : false;
}

uint32_t wireguard_test_peer_last_rx(int peer_id)
{
	struct wg_peer *peer = peer_lookup_by_id(peer_id);

	return peer != NULL ? peer->last_rx : 0;
}

int wireguard_test_peer_endpoint(int peer_id, struct net_sockaddr_storage *endpoint)
{
	struct wg_peer *peer;

	if (endpoint == NULL) {
		return -EINVAL;
	}

	peer = peer_lookup_by_id(peer_id);
	if (peer == NULL) {
		return -ENOENT;
	}

	memcpy(endpoint, &peer->endpoint, sizeof(*endpoint));

	return 0;
}

int wireguard_test_peer_keypair_state(int peer_id,
				      struct wireguard_test_keypair_state *state)
{
	struct wg_peer *peer;

	if (state == NULL) {
		return -EINVAL;
	}

	peer = peer_lookup_by_id(peer_id);
	if (peer == NULL) {
		return -ENOENT;
	}

	state->prev_valid = peer->session.keypair.prev.is_valid;
	state->current_valid = peer->session.keypair.current.is_valid;
	state->next_valid = peer->session.keypair.next.is_valid;

	return 0;
}
```

## src/wg_test_helpers.h
```c
/*
 * Copyright (c) 2026 Nordic Semiconductor ASA
 *
 * SPDX-License-Identifier: Apache-2.0
 */

#ifndef ZEPHYR_TESTS_NET_LIB_WIREGUARD_WG_TEST_HELPERS_H_
#define ZEPHYR_TESTS_NET_LIB_WIREGUARD_WG_TEST_HELPERS_H_

/**
 * @file
 * @brief Test-only helpers for the WireGuard unit tests.
 *
 * These build synthetic transport sessions and drive the WireGuard receive
 * path directly. They live in the test tree and reach into the library only
 * through functions exported via ZTESTABLE_STATIC (see subsys/net/lib/wireguard).
 */

#include <stddef.h>
#include <stdint.h>

#include <zephyr/net/net_if.h>
#include <zephyr/net/socket.h>
#include <zephyr/net/wireguard.h>

#ifdef __cplusplus
extern "C" {
#endif

/**
 * @brief Pure replay-window check exported by the library via ZTESTABLE_STATIC.
 *
 * @param replay_bitmap Sliding replay bitmap (updated in place on success).
 * @param replay_counter Replay algorithm counter (greatest observed seq + 1) (updated on success).
 * @param seq WireGuard transport counter from the packet header.
 *
 * @return true if the counter is new or acceptably out-of-order, false otherwise.
 */
bool wg_replay_check(uint32_t *replay_bitmap, uint64_t *replay_counter, uint64_t seq);

/** Session material for wireguard_test_install_session(). */
struct wireguard_test_session {
	/** AEAD key used to decrypt inbound transport data. */
	uint8_t recv_key[32];
	/** AEAD key used to encrypt outbound transport data (peer side). */
	uint8_t send_key[32];
	/** Local session index (receiver index in inbound packets). */
	uint32_t local_index;
	/** Remote session index. */
	uint32_t remote_index;
};

/** Snapshot of whether prev/current/next keypairs are valid. */
struct wireguard_test_keypair_state {
	bool prev_valid;
	bool current_valid;
	bool next_valid;
};

/**
 * @brief Add a test peer with a fixed interface private key.
 *
 * @param iface_out Optional pointer to receive the peer virtual interface.
 *
 * @return Peer id on success, negative errno otherwise.
 */
int wireguard_test_peer_add(struct net_if **iface_out);

/**
 * @brief Install a synthetic transport session on a test peer.
 *
 * @param peer_id Peer id from wireguard_test_peer_add().
 * @param session Session keys and indices.
 *
 * @return 0 on success, negative errno otherwise.
 */
int wireguard_test_install_session(int peer_id,
				   const struct wireguard_test_session *session);

/**
 * @brief Encrypt transport plaintext with a raw session key.
 *
 * @param key 32-byte ChaCha20-Poly1305 key.
 * @param counter Transport-data counter.
 * @param plaintext Plaintext (may be NULL when @p plaintext_len is 0).
 * @param plaintext_len Plaintext length in bytes.
 * @param ciphertext Output buffer for ciphertext (plaintext + tag).
 * @param ciphertext_size Size of @p ciphertext buffer.
 * @param ciphertext_len Output ciphertext length.
 *
 * @return 0 on success, negative errno otherwise.
 */
int wireguard_test_encrypt(const uint8_t key[32], uint64_t counter,
			   const uint8_t *plaintext, size_t plaintext_len,
			   uint8_t *ciphertext, size_t ciphertext_size,
			   size_t *ciphertext_len);

/**
 * @brief Inject a transport-data message into the receive path.
 *
 * @param peer_id Peer id from wireguard_test_peer_add().
 * @param src Source UDP/IP address of the outer packet.
 * @param counter Transport-data counter.
 * @param ciphertext Encrypted transport payload (including Poly1305 tag).
 * @param ciphertext_len Length of @p ciphertext.
 *
 * @return 0 on success, negative errno otherwise.
 */
int wireguard_test_inject_transport(int peer_id,
				    const struct net_sockaddr *src,
				    uint64_t counter,
				    const uint8_t *ciphertext,
				    size_t ciphertext_len);

/**
 * @brief Drop any session and handshake state from a test peer.
 *
 * Leaves the peer in the state it has at boot or after a session has expired.
 *
 * @param peer_id Peer id from wireguard_test_peer_add().
 *
 * @return 0 on success, negative errno otherwise.
 */
int wireguard_test_clear_session(int peer_id);

/**
 * @brief Inject a transport-data message for an unknown session.
 *
 * Drives the receive path with a message whose receiver index matches no
 * session, i.e. a message that cannot be authenticated.
 *
 * @param peer_id Peer id from wireguard_test_peer_add().
 * @param src Source UDP/IP address of the outer packet.
 * @param receiver Receiver index to put into the message.
 *
 * @return 0 on success, negative errno otherwise.
 */
int wireguard_test_inject_stale_session(int peer_id, const struct net_sockaddr *src,
					uint32_t receiver);

/** @brief Query whether a peer is scheduled to send a handshake initiation. */
bool wireguard_test_peer_send_handshake(int peer_id);

/**
 * @brief Read accumulated VPN statistics for a peer interface.
 *
 * @param peer_id Peer id from wireguard_test_peer_add().
 * @param stats Output statistics (unchanged on error).
 *
 * @return 0 on success, negative errno otherwise.
 */
int wireguard_test_get_stats(int peer_id, struct net_stats_vpn *stats);

/** @brief Query whether a peer has received a valid transport message. */
bool wireguard_test_peer_first_valid(int peer_id);

/** @brief Read peer last_rx tick value. */
uint32_t wireguard_test_peer_last_rx(int peer_id);

/** @brief Copy the peer roaming endpoint. */
int wireguard_test_peer_endpoint(int peer_id,
				 struct net_sockaddr_storage *endpoint);

/** @brief Snapshot prev/current/next keypair validity. */
int wireguard_test_peer_keypair_state(int peer_id,
				      struct wireguard_test_keypair_state *state);

#ifdef __cplusplus
}
#endif

#endif /* ZEPHYR_TESTS_NET_LIB_WIREGUARD_WG_TEST_HELPERS_H_ */
```
