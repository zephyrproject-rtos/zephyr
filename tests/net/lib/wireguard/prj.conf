## CMakeLists.txt
```
# SPDX-License-Identifier: Apache-2.0

cmake_minimum_required(VERSION 3.28.0)
find_package(Zephyr REQUIRED HINTS $ENV{ZEPHYR_BASE})
project(net_wireguard)

target_include_directories(app PRIVATE ${ZEPHYR_BASE}/subsys/net/ip)
target_include_directories(app PRIVATE ${ZEPHYR_BASE}/subsys/net/lib/wireguard)

FILE(GLOB app_sources src/*.c)
target_sources(app PRIVATE ${app_sources})

if(CONFIG_WIREGUARD_HANDSHAKE_WORKQ_STACK_SIZE GREATER 0)
  zephyr_include_directories(${ZEPHYR_BASE}/tests/crypto/psa/include)
  zephyr_link_libraries(-Wl,--wrap=psa_raw_key_agreement)
endif()
```

## prj.conf
```kconfig
CONFIG_NETWORKING=y
CONFIG_NET_IPV4=y
CONFIG_NET_IF_MAX_IPV4_COUNT=3
CONFIG_NET_IPV6=n
CONFIG_NET_UDP=y
CONFIG_NET_DRIVERS=y
CONFIG_NET_LOOPBACK=y
CONFIG_NET_L2_DUMMY=y
CONFIG_NET_L2_VIRTUAL=y
CONFIG_NET_L2_VIRTUAL_MGMT=y
CONFIG_WIREGUARD=y
CONFIG_WIREGUARD_MAX_PEER=2
CONFIG_WIREGUARD_BUF_COUNT=4
CONFIG_WIREGUARD_PORT=51820

CONFIG_NET_STATISTICS=y
CONFIG_NET_STATISTICS_VPN=y
CONFIG_NET_STATISTICS_USER_API=y

CONFIG_ZTEST=y
CONFIG_NET_TEST=y
CONFIG_TEST_RANDOM_GENERATOR=y

CONFIG_MAIN_STACK_SIZE=4096
CONFIG_SYSTEM_WORKQUEUE_STACK_SIZE=2048
CONFIG_MBEDTLS_HEAP_SIZE=16384
CONFIG_MBEDTLS_ENABLE_HEAP=y
CONFIG_MBEDTLS_PSA_KEY_SLOT_COUNT=32

CONFIG_NET_MGMT_EVENT_INFO=y
```

## src/datagram_test.c
```c
/*
 * SPDX-FileCopyrightText: Copyright The Zephyr Project Contributors
 * SPDX-License-Identifier: Apache-2.0
 */

#include <zephyr/kernel.h>
#include <zephyr/net/net_mgmt.h>
#include <zephyr/net/virtual_mgmt.h>
#include "wg_private.h"
#include <zephyr/random/random.h>
#include <zephyr/sys/base64.h>
#include <zephyr/sys/byteorder.h>
#include <zephyr/ztest.h>

#include "ipv4.h"
#include "udp_internal.h"
#include "wg_internal.h"
#include "wg_test_helpers.h"

struct datagram {
	uint8_t data[160];
	size_t len;
	int from;
	uint32_t reply_relay;
};

K_MSGQ_DEFINE(datagrams, sizeof(struct datagram), 4, 4);

static int capture(int peer_id, const struct wireguard_datagram_path *path, const uint8_t *data,
		   size_t len, void *user_data)
{
	struct datagram msg = {
		.from = peer_id,
		.len = len,
		.reply_relay = path != NULL ? path->relay_id : 0U,
	};

	atomic_t *refuse_init = user_data;

	if (data[0] == 1U && atomic_cas(refuse_init, 1, 0)) {
		return -ENOBUFS;
	}
	if (len > sizeof(msg.data)) {
		return -EMSGSIZE;
	}
	memcpy(msg.data, data, len);
	return k_msgq_put(&datagrams, &msg, K_NO_WAIT);
}

static void collect_interfaces(struct net_if *iface, void *user_data)
{
	struct net_if **interfaces = user_data;

	if (net_if_l2(iface) == &NET_L2_GET_NAME(VIRTUAL) &&
	    net_virtual_get_iface_capabilities(iface) == VIRTUAL_INTERFACE_VPN) {
		if (interfaces[0] == NULL) {
			interfaces[0] = iface;
		} else if (interfaces[1] == NULL) {
			interfaces[1] = iface;
		}
	}
}

static void configure_identity(struct net_if *iface, uint8_t seed, char *pubkey, size_t size)
{
	struct virtual_interface_req_params params = {0};
	uint8_t key[32];
	size_t olen;

	memset(key, seed, sizeof(key));
	params.private_key.data = key;
	params.private_key.len = sizeof(key);
	zassert_ok(net_mgmt(NET_REQUEST_VIRTUAL_INTERFACE_SET_PRIVATE_KEY, iface, &params,
			    sizeof(params)));
	zassert_ok(net_mgmt(NET_REQUEST_VIRTUAL_INTERFACE_GET_PUBLIC_KEY, iface, &params,
			    sizeof(params)));
	zassert_ok(
		base64_encode(pubkey, size, &olen, params.public_key.data, params.public_key.len));
}

struct echo_listener {
	struct k_work remove;
	struct k_sem done;
	int peer_id;
	int remove_result;
	struct net_if *iface;
	uint8_t bytes[16];
	bool received;
};

static void remove_during_delivery(struct k_work *work)
{
	struct echo_listener *listener = CONTAINER_OF(work, struct echo_listener, remove);

	listener->remove_result = wireguard_peer_remove(listener->peer_id);
	k_sem_give(&listener->done);
}

static enum net_verdict echo_input(struct net_conn *conn, struct net_pkt *pkt,
				   union net_ip_header *ip, union net_proto_header *proto,
				   void *user_data)
{
	struct echo_listener *listener = user_data;

	if (net_pkt_iface(pkt) != listener->iface ||
	    net_pkt_read(pkt, listener->bytes, sizeof(listener->bytes)) < 0) {
		return NET_DROP;
	}

	if (k_work_submit(&listener->remove) < 0 ||
	    k_sem_take(&listener->done, K_SECONDS(1)) != 0 || listener->remove_result != -EBUSY) {
		return NET_DROP;
	}
	listener->received = true;
	net_pkt_unref(pkt);
	return NET_OK;
}

static int send_udp(struct net_if *iface, struct net_in_addr *src, struct net_in_addr *dst,
		    const uint8_t *payload, size_t len)
{
	struct net_pkt *pkt;
	int ret;

	pkt = net_pkt_alloc_with_buffer(iface, len, NET_AF_INET, NET_IPPROTO_UDP, K_NO_WAIT);
	zassert_not_null(pkt);
	net_pkt_set_ipv4_ttl(pkt, 64);
	zassert_ok(net_ipv4_create(pkt, src, dst));
	zassert_ok(net_udp_create(pkt, net_htons(9501), net_htons(9500)));
	zassert_ok(net_pkt_write(pkt, payload, len));
	net_pkt_cursor_init(pkt);
	zassert_ok(net_ipv4_finalize(pkt, NET_IPPROTO_UDP));
	ret = net_if_l2(iface)->send(iface, pkt);
	if (ret < 0) {
		net_pkt_unref(pkt);
	}
	return ret;
}

static void receive(int sender, int receiver, struct wireguard_datagram_path *path, uint8_t type,
		    uint32_t expected_reply)
{
	struct datagram msg;
	int ret;

	zassert_ok(k_msgq_get(&datagrams, &msg, K_SECONDS(1)));
	zassert_equal(msg.from, sender);
	zassert_equal(msg.data[0], type);
	zassert_equal(msg.reply_relay, expected_reply);
	ret = wireguard_peer_receive_datagram(receiver, path, msg.data, msg.len);

	zassert_ok(ret, "peer %d type %u len %zu returned %d", receiver, type, msg.len, ret);
}

struct keepalive_work {
	struct k_work work;
	int id;
	int result;
};

static void send_keepalives(struct k_work *work)
{
	struct keepalive_work *tx = CONTAINER_OF(work, struct keepalive_work, work);

	tx->result = wireguard_peer_keepalive(tx->id);
	if (tx->result == 0) {
		tx->result = wireguard_peer_keepalive(tx->id);
	}
}

struct wireguard_datagram_fixture {
	atomic_t refuse_init;
	struct net_if *interfaces[2];
	struct net_in_addr ips[2];
	int ids[2];
	struct wireguard_datagram_path relay;
	struct echo_listener listener;
	struct net_conn_handle *handle;
};

ZTEST_F(wireguard_datagram, test_concurrent_tx_and_backpressure)
{
	int peer_id = fixture->ids[0];
	struct k_work_sync sync;
	struct keepalive_work tx = {.id = peer_id};
	struct datagram msg;
	uint64_t counter = 0U;

	k_work_init(&tx.work, send_keepalives);
	zassert_true(k_work_submit(&tx.work) >= 0);
	zexpect_ok(wireguard_peer_keepalive(peer_id));
	zexpect_ok(wireguard_peer_keepalive(peer_id));
	(void)k_work_flush(&tx.work, &sync);
	zassert_ok(tx.result);
	zexpect_true(wireguard_peer_keepalive(peer_id) < 0);

	for (int i = 0; i < 4; i++) {
		zassert_ok(k_msgq_get(&datagrams, &msg, K_NO_WAIT));
		zassert_equal(msg.len, 32U);
		if (i > 0) {
			zassert_equal(sys_get_le64(msg.data + 8), counter + 1U);
		}
		counter = sys_get_le64(msg.data + 8);
	}

	zassert_ok(wireguard_peer_keepalive(peer_id));
	zassert_ok(k_msgq_get(&datagrams, &msg, K_NO_WAIT));
	/* The transport refused one encrypted datagram while its queue was full. */
	zassert_equal(sys_get_le64(msg.data + 8), counter + 2U);
}

static void *suite_setup(void)
{
	static struct wireguard_datagram_fixture fixture;

	fixture.ips[0].s_addr = net_htonl(0xC6336401U);
	fixture.ips[1].s_addr = net_htonl(0xC6336402U);
	fixture.relay.kind = WIREGUARD_PATH_RELAY;
	fixture.relay.relay_id = 7U;
	return &fixture;
}

static void connect_peers(void *data)
{
	struct wireguard_datagram_fixture *fixture = data;
	const struct wireguard_transport transport = {
		.send = capture,
		.user_data = &fixture->refuse_init,
	};
	const uint8_t first = 0;
	int ret;
	struct wireguard_peer_config config = {0};
	struct net_if *assigned;
	char pubkeys[2][45];

	net_if_foreach(collect_interfaces, fixture->interfaces);
	for (size_t i = 0; i < ARRAY_SIZE(fixture->interfaces); i++) {
		zassert_not_null(fixture->interfaces[i]);
		configure_identity(fixture->interfaces[i], i + 1U, pubkeys[i], sizeof(pubkeys[i]));
	}
	for (size_t i = 0; i < ARRAY_SIZE(fixture->interfaces); i++) {
		config.public_key = pubkeys[1U - i];
		config.allowed_ip[0].is_valid = true;
		config.allowed_ip[0].addr.family = NET_AF_INET;
		config.allowed_ip[0].addr.in_addr = fixture->ips[1U - i];
		config.allowed_ip[0].mask_len = 32U;
		fixture->ids[i] = wireguard_peer_add_with_transport(&config, &assigned, &transport);
		zassert_true(fixture->ids[i] > 0, "peer add failed (%d)", fixture->ids[i]);
		zassert_equal(assigned, fixture->interfaces[i]);
	}

	k_sleep(K_TICKS(1));
	atomic_set(&fixture->refuse_init, 1);
	ret = send_udp(fixture->interfaces[0], &fixture->ips[0], &fixture->ips[1], &first, 1U);
	zassert_true(ret == -ENOBUFS || ret == -EAGAIN);
	receive(fixture->ids[0], fixture->ids[1], &fixture->relay, 1U, 0U);
	receive(fixture->ids[1], fixture->ids[0], &fixture->relay, 2U, fixture->relay.relay_id);
	receive(fixture->ids[0], fixture->ids[1], &fixture->relay, 4U, 0U);
}

static void disconnect_peers(void *data)
{
	struct wireguard_datagram_fixture *fixture = data;

	if (fixture->handle != NULL) {
		zexpect_ok(net_udp_unregister(fixture->handle));
		fixture->handle = NULL;
	}
	for (size_t i = 0; i < ARRAY_SIZE(fixture->ids); i++) {
		if (fixture->ids[i] > 0) {
			zexpect_ok(wireguard_peer_remove(fixture->ids[i]));
			fixture->ids[i] = 0;
		}
		if (fixture->interfaces[i] != NULL) {
			(void)net_if_ipv4_addr_rm(fixture->interfaces[i], &fixture->ips[i]);
			fixture->interfaces[i] = NULL;
		}
	}
	k_msgq_purge(&datagrams);
}

ZTEST_F(wireguard_datagram, test_udp_echo_and_path_change)
{
	struct wireguard_datagram_path direct = {.kind = WIREGUARD_PATH_DIRECT};
	struct net_sockaddr_storage endpoint;
	struct echo_listener *listener = &fixture->listener;
	uint8_t challenge[sizeof(listener->bytes)];
	int *ids = fixture->ids;

	direct.iface = net_if_get_default();
	direct.remote.ss_family = NET_AF_INET;
	net_sin(net_sad(&direct.remote))->sin_addr.s_addr = net_htonl(0xC0000201U);
	net_sin(net_sad(&direct.remote))->sin_port = net_htons(51820);
	direct.local.ss_family = NET_AF_INET;
	net_sin(net_sad(&direct.local))->sin_addr.s_addr = net_htonl(0xC0000202U);
	net_sin(net_sad(&direct.local))->sin_port = net_htons(51820);
	zassert_ok(wireguard_peer_keepalive(ids[0]));
	receive(ids[0], ids[1], &direct, 4U, 0U);
	zassert_ok(wireguard_peer_keepalive(ids[0]));
	receive(ids[0], ids[1], &fixture->relay, 4U, 0U);
	zassert_ok(wireguard_test_peer_endpoint(ids[1], &endpoint));
	zassert_mem_equal(&endpoint, &direct.remote, sizeof(endpoint));

	k_work_init(&listener->remove, remove_during_delivery);
	k_sem_init(&listener->done, 0, 1);
	sys_rand_get(challenge, sizeof(challenge));
	zassert_ok(net_udp_register(NET_AF_INET, NULL, NULL, 0, 9500, NULL, echo_input, listener,
				    &fixture->handle));
	/* Both nodes share a simulated IP stack. Install only the receiving address
	 * so the stack can verify the source as a remote address on each leg.
	 */
	listener->peer_id = ids[1];
	listener->iface = fixture->interfaces[1];
	zassert_not_null(
		net_if_ipv4_addr_add(listener->iface, &fixture->ips[1], NET_ADDR_MANUAL, 0));
	zassert_ok(send_udp(fixture->interfaces[0], &fixture->ips[0], &fixture->ips[1], challenge,
			    sizeof(challenge)));
	receive(ids[0], ids[1], &fixture->relay, 4U, 0U);
	zassert_true(listener->received);
	zassert_mem_equal(listener->bytes, challenge, sizeof(challenge));

	zassert_true(net_if_ipv4_addr_rm(listener->iface, &fixture->ips[1]));
	listener->peer_id = ids[0];
	listener->iface = fixture->interfaces[0];
	zassert_not_null(
		net_if_ipv4_addr_add(listener->iface, &fixture->ips[0], NET_ADDR_MANUAL, 0));
	listener->received = false;
	zassert_ok(send_udp(fixture->interfaces[1], &fixture->ips[1], &fixture->ips[0],
			    listener->bytes, sizeof(listener->bytes)));
	receive(ids[1], ids[0], &direct, 4U, 0U);
	zassert_true(listener->received);
	zassert_mem_equal(listener->bytes, challenge, sizeof(challenge));
	zassert_true(net_if_ipv4_addr_rm(listener->iface, &fixture->ips[0]));
}

ZTEST_F(wireguard_datagram, test_receive_across_rekey)
{
	struct datagram pending;
	struct datagram renewed;
	int *ids = fixture->ids;

	zassert_ok(wireguard_peer_keepalive(ids[0]));
	zassert_ok(k_msgq_get(&datagrams, &pending, K_SECONDS(1)));

	k_sleep(K_SECONDS(REKEY_AFTER_TIME + 1U));
	zassert_ok(wireguard_peer_keepalive(ids[1]));
	receive(ids[1], ids[0], &fixture->relay, MESSAGE_TRANSPORT_DATA, 0U);
	receive(ids[0], ids[1], &fixture->relay, MESSAGE_HANDSHAKE_INITIATION, 0U);
	receive(ids[1], ids[0], &fixture->relay, MESSAGE_HANDSHAKE_RESPONSE,
		fixture->relay.relay_id);

	zassert_ok(k_msgq_get(&datagrams, &renewed, K_SECONDS(1)));
	zassert_equal(renewed.from, ids[0]);
	zassert_equal(renewed.data[0], MESSAGE_TRANSPORT_DATA);
	zassert_not_equal(sys_get_le32(renewed.data + 4), sys_get_le32(pending.data + 4));
	zassert_ok(wireguard_peer_receive_datagram(ids[1], &fixture->relay, renewed.data,
						   renewed.len));
	zassert_ok(wireguard_peer_receive_datagram(ids[1], &fixture->relay, pending.data,
						   pending.len));
}

ZTEST_F(wireguard_datagram, test_key_failure_and_late_receive)
{
	int *ids = fixture->ids;
	int retired = ids[1];
	struct datagram msg;

	zassert_ok(wireguard_peer_keepalive(ids[0]));
	zassert_ok(k_msgq_get(&datagrams, &msg, K_SECONDS(1)));
	zassert_ok(net_if_down(fixture->interfaces[1]));
	zexpect_equal(wireguard_peer_keepalive(ids[1]), -ENETDOWN);
	zexpect_equal(wireguard_peer_receive_datagram(ids[1], &fixture->relay, msg.data, msg.len),
		      -ENETDOWN);
	zassert_ok(net_if_up(fixture->interfaces[1]));
	zassert_ok(wireguard_peer_receive_datagram(ids[1], &fixture->relay, msg.data, msg.len));
	zassert_ok(wireguard_test_destroy_sending_key(ids[0]));
	zexpect_true(wireguard_peer_keepalive(ids[0]) < 0);
	zexpect_equal(k_msgq_num_used_get(&datagrams), 0U);
	zassert_ok(wireguard_peer_remove(ids[1]));
	ids[1] = 0;
	zexpect_equal(wireguard_peer_receive_datagram(retired, &fixture->relay, msg.data, msg.len),
		      -ENOENT);
}

ZTEST_SUITE(wireguard_datagram, NULL, suite_setup, connect_peers, disconnect_peers, NULL);

#if defined(CONFIG_WIREGUARD_MULTI_PEER)
static int add_shared_peer(struct net_if *iface, const char *key, uint32_t address, uint8_t prefix,
			   const struct wireguard_transport *transport)
{
	struct wireguard_peer_config config = {.public_key = key};

	config.allowed_ip[0].addr.family = NET_AF_INET;
	config.allowed_ip[0].addr.in_addr.s_addr = net_htonl(address);
	config.allowed_ip[0].is_valid = true;
	config.allowed_ip[0].mask_len = prefix;
	return wireguard_peer_add_to_interface(iface, &config, transport);
}

static void shared_path(struct wireguard_datagram_path *path)
{
	*path = (struct wireguard_datagram_path){
		.kind = WIREGUARD_PATH_DIRECT,
		.iface = net_if_get_default(),
	};
	path->local.ss_family = NET_AF_INET;
	net_sin(net_sad(&path->local))->sin_port = net_htons(51820);
	net_sin(net_sad(&path->local))->sin_addr.s_addr = net_htonl(0xc0000260U);
	path->remote.ss_family = NET_AF_INET;
	net_sin(net_sad(&path->remote))->sin_port = net_htons(51821);
	net_sin(net_sad(&path->remote))->sin_addr.s_addr = net_htonl(0xc0000261U);
}

struct wireguard_shared_fixture {
	int hub[2];
	int leaves[2];
	atomic_t refuse;
};

static void *shared_setup(void)
{
	static struct wireguard_shared_fixture fixture;

	return &fixture;
}

static void shared_cleanup(void *data)
{
	struct wireguard_shared_fixture *fixture = data;

	ARRAY_FOR_EACH(fixture->leaves, i) {
		if (fixture->leaves[i] > 0) {
			zexpect_ok(wireguard_peer_remove(fixture->leaves[i]));
			fixture->leaves[i] = 0;
		}
		if (fixture->hub[i] > 0) {
			zexpect_ok(wireguard_peer_remove(fixture->hub[i]));
			fixture->hub[i] = 0;
		}
	}
}

static void receive_pair(const int senders[2], uint8_t type, struct datagram pair[2])
{
	bool seen[2] = {false};

	ARRAY_FOR_EACH(seen, i) {
		struct datagram msg;
		size_t slot;

		zassert_ok(k_msgq_get(&datagrams, &msg, K_SECONDS(1)));
		zassert_equal(msg.data[0], type);
		slot = msg.from == senders[0] ? 0U : 1U;
		zassert_equal(msg.from, senders[slot]);
		zassert_false(seen[slot], "duplicate datagram from peer %d", msg.from);
		seen[slot] = true;
		pair[slot] = msg;
	}
}

ZTEST_F(wireguard_shared, test_concurrent_initiation_and_ownership)
{
	struct net_if *iface[] = {
		net_if_get_by_index(net_if_get_by_name("wg0")),
		net_if_get_by_index(net_if_get_by_name("wg1")),
		net_if_get_by_index(net_if_get_by_name("wg2")),
	};
	uint32_t addresses[] = {0xc6336401U, 0xc6336402U, 0xc6336403U};
	struct wireguard_datagram_path relay = {.kind = WIREGUARD_PATH_RELAY, .relay_id = 7};
	struct wireguard_datagram_path direct;
	struct wireguard_transport transport = {.send = capture, .user_data = &fixture->refuse};
	struct datagram pair[2], msg;
	char keys[3][45];

	k_msgq_purge(&datagrams);
	shared_path(&direct);
	for (size_t i = 0; i < ARRAY_SIZE(iface); i++) {
		zassert_not_null(iface[i]);
		configure_identity(iface[i], 20 + i * 8, keys[i], sizeof(keys[i]));
	}

	fixture->hub[0] = add_shared_peer(iface[0], keys[1], addresses[1], 24, &transport);
	zassert_true(fixture->hub[0] > 0);
	zassert_equal(add_shared_peer(iface[0], keys[1], addresses[2], 32, &transport), -EALREADY);
	zassert_equal(add_shared_peer(iface[0], keys[2], addresses[2], 24, &transport),
		      -EADDRINUSE);
	fixture->hub[1] = add_shared_peer(iface[0], keys[2], addresses[2], 32, &transport);
	zassert_true(fixture->hub[1] > 0);

	for (size_t i = 0; i < ARRAY_SIZE(fixture->leaves); i++) {
		fixture->leaves[i] =
			add_shared_peer(iface[i + 1], keys[0], addresses[0], 32, &transport);
		zassert_true(fixture->leaves[i] > 0);
		zassert_ok(wireguard_peer_keepalive(fixture->leaves[i]));
	}
	receive_pair(fixture->leaves, MESSAGE_HANDSHAKE_INITIATION, pair);
	for (size_t i = 0; i < ARRAY_SIZE(pair); i++) {
		/* Relay metadata binds a specific peer; the direct socket knows only the device. */
		zassert_true(wireguard_peer_receive_datagram(fixture->hub[1 - i], &relay,
							     pair[i].data, pair[i].len) < 0);
		zassert_true(wireguard_interface_receive_datagram(iface[0], &relay, pair[i].data,
								  pair[i].len) < 0);
		zassert_ok(wireguard_interface_receive_datagram(iface[0], &direct, pair[i].data,
								pair[i].len));
	}
	receive_pair(fixture->hub, MESSAGE_HANDSHAKE_RESPONSE, pair);
	for (size_t i = 0; i < ARRAY_SIZE(pair); i++) {
		zassert_ok(wireguard_interface_receive_datagram(iface[i + 1], &direct,
								pair[i].data, pair[i].len));
	}
	receive_pair(fixture->leaves, MESSAGE_TRANSPORT_DATA, pair);
	for (size_t i = 0; i < ARRAY_SIZE(pair); i++) {
		zassert_ok(wireguard_interface_receive_datagram(iface[0], &direct, pair[i].data,
								pair[i].len));
	}
	zassert_not_equal(sys_get_le32(&pair[0].data[4]), sys_get_le32(&pair[1].data[4]));

	struct net_in_addr narrow = {.s_addr = net_htonl(addresses[2])};
	struct net_in_addr local = {.s_addr = net_htonl(addresses[0])};
	uint8_t payload = 123U;

	zassert_ok(send_udp(iface[0], &local, &narrow, &payload, sizeof(payload)));
	zassert_ok(k_msgq_get(&datagrams, &msg, K_SECONDS(1)));
	zassert_equal(msg.from, fixture->hub[1], "prefer the host route to the covering prefix");

	/* The covering peer cannot claim a source owned by the more specific peer. */
	zassert_ok(send_udp(iface[1], &narrow, &local, &payload, sizeof(payload)));
	zassert_ok(k_msgq_get(&datagrams, &msg, K_SECONDS(1)));
	zassert_equal(msg.from, fixture->leaves[0]);
	struct net_stats_vpn before, after;

	zassert_ok(wireguard_test_get_stats(fixture->hub[0], &before));
	zassert_equal(wireguard_interface_receive_datagram(iface[0], &direct, msg.data, msg.len),
		      -ENOENT);
	zassert_ok(wireguard_test_get_stats(fixture->hub[0], &after));
	zassert_equal(after.denied_ip, before.denied_ip + 1);
	zassert_ok(wireguard_peer_remove(fixture->hub[1]));
	fixture->hub[1] = 0;
	zassert_ok(send_udp(iface[0], &local, &narrow, &payload, sizeof(payload)));
	zassert_ok(k_msgq_get(&datagrams, &msg, K_SECONDS(1)));
	zassert_equal(msg.from, fixture->hub[0], "covering prefix is now the longest match");
}

ZTEST_SUITE(wireguard_shared, NULL, shared_setup, NULL, shared_cleanup, NULL);
#endif /* CONFIG_WIREGUARD_MULTI_PEER */
```

## src/iface_test.c
```c
/*
 * Copyright The Zephyr Project Contributors
 *
 * SPDX-License-Identifier: Apache-2.0
 */

#include <string.h>

#include <zephyr/ztest.h>
#include <zephyr/net/net_if.h>
#include <zephyr/net/net_ip.h>
#include <zephyr/net/net_mgmt.h>
#include <zephyr/net/virtual.h>
#include <zephyr/net/virtual_mgmt.h>
#include <zephyr/net/wireguard.h>
#include <zephyr/sys/base64.h>

static void find_vpn_iface(struct net_if *iface, void *user_data)
{
	struct net_if **found = user_data;

	if (*found == NULL && net_if_l2(iface) == &NET_L2_GET_NAME(VIRTUAL) &&
	    net_virtual_get_iface_capabilities(iface) == VIRTUAL_INTERFACE_VPN) {
		*found = iface;
	}
}

static void set_private_key(void)
{
	static const char *private_key = "lmAIbJR8PQOpgJxmfOydBiDbexTMEKsjglZ1sj3kIjs=";
	struct virtual_interface_req_params params = { 0 };
	struct net_if *vpn_iface = NULL;
	uint8_t key[32];
	size_t olen;
	int ret;

	net_if_foreach(find_vpn_iface, &vpn_iface);
	zassert_not_null(vpn_iface, "No VPN interface");

	ret = base64_decode(key, sizeof(key), &olen, private_key, strlen(private_key));
	zassert_true(ret == 0 && olen == sizeof(key), "Cannot decode the private key");

	params.private_key.data = key;
	params.private_key.len = sizeof(key);

	ret = net_mgmt(NET_REQUEST_VIRTUAL_INTERFACE_SET_PRIVATE_KEY, vpn_iface, &params,
		       sizeof(params));
	(void)memset(key, 0, sizeof(key));
	zassert_equal(ret, 0, "Cannot set the private key (%d)", ret);
}

/* Adding the first peer takes its virtual interface up, and the virtual L2
 * takes the wg_ctrl control interface below it up as well. wg_ctrl is a dummy
 * L2 interface without a link address, which used to trip an assertion in
 * notify_iface_up().
 */
ZTEST(wireguard_iface, test_peer_add_takes_ctrl_iface_up)
{
	struct wireguard_peer_config config = {
		.public_key = "fF2zTE6NVbBEZkwDgaPDkd9Vx7nL6xj/6g9W3nwyyHc=",
	};
	struct net_sockaddr_in *endpoint = (struct net_sockaddr_in *)&config.endpoint_ip;
	struct net_if *peer_iface = NULL;
	struct net_if *ctrl_iface;
	int peer_id;
	int ret;

	ctrl_iface = net_if_get_by_index(net_if_get_by_name("wg_ctrl"));
	zassert_not_null(ctrl_iface, "No wg_ctrl interface");

	set_private_key();

	endpoint->sin_family = NET_AF_INET;
	endpoint->sin_port = net_htons(51820);
	endpoint->sin_addr.s_addr = net_htonl(0xC0000201U);

	peer_id = wireguard_peer_add(&config, &peer_iface);
	zassert_true(peer_id > 0, "Peer add failed (%d)", peer_id);
	zassert_not_null(peer_iface, "No peer interface");

	zassert_true(net_if_is_up(peer_iface), "Peer interface is not up");
	zassert_true(net_if_is_up(ctrl_iface), "wg_ctrl is not up");

	ret = wireguard_peer_remove(peer_id);
	zassert_equal(ret, 0, "Peer remove failed (%d)", ret);
}

ZTEST_SUITE(wireguard_iface, NULL, NULL, NULL, NULL, NULL);
```

## src/index_test.c
```c
/*
 * SPDX-FileCopyrightText: Copyright The Zephyr Project Contributors
 * SPDX-License-Identifier: Apache-2.0
 */

#include <errno.h>
#include <string.h>

#include <zephyr/net/net_mgmt.h>
#include <zephyr/net/net_event.h>
#include <zephyr/net/virtual_mgmt.h>
#include "wg_private.h"
#include <zephyr/sys/base64.h>
#include <zephyr/ztest.h>

#include "wg_internal.h"
#include "wg_test_helpers.h"

struct wg_peer *peer_lookup_by_id(int id);
int wg_create_cookie_reply(struct wg_iface_context *ctx, struct msg_cookie_reply *dst,
			   const uint8_t *mac1, uint32_t index, uint8_t *source_addr_port,
			   size_t source_length);

#define PUBLIC_KEY_B64_SIZE 45

struct handshake_capture {
	struct k_sem ready;
	struct msg_handshake_init initiation;
};

struct wireguard_index_fixture {
	int ids[3];
	struct handshake_capture captures[2];
};

static void *index_setup(void)
{
	static struct wireguard_index_fixture fixture;

	return &fixture;
}

static void index_cleanup(void *data)
{
	struct wireguard_index_fixture *fixture = data;

	ARRAY_FOR_EACH(fixture->ids, i) {
		if (fixture->ids[i] > 0) {
			zexpect_ok(wireguard_peer_remove(fixture->ids[i]));
			fixture->ids[i] = 0;
		}
	}
}

static void encode_key(const uint8_t *key, char encoded[PUBLIC_KEY_B64_SIZE])
{
	size_t size;

	zassert_ok(base64_encode(encoded, PUBLIC_KEY_B64_SIZE, &size, key, WG_PUBLIC_KEY_LEN));
}

static void configure_key(struct net_if *iface, uint8_t value, char encoded[PUBLIC_KEY_B64_SIZE])
{
	struct virtual_interface_req_params params = {0};
	uint8_t key[WG_PRIVATE_KEY_LEN];

	memset(key, value, sizeof(key));
	params.private_key.data = key;
	params.private_key.len = sizeof(key);
	zassert_ok(net_mgmt(NET_REQUEST_VIRTUAL_INTERFACE_SET_PRIVATE_KEY, iface, &params,
			    sizeof(params)));
	zassert_ok(net_mgmt(NET_REQUEST_VIRTUAL_INTERFACE_GET_PUBLIC_KEY, iface, &params,
			    sizeof(params)));
	encode_key(params.public_key.data, encoded);
}

static int capture_initiation(int peer_id, const struct wireguard_datagram_path *path,
			      const uint8_t *data, size_t len, void *user_data)
{
	struct handshake_capture *capture = user_data;

	ARG_UNUSED(peer_id);
	ARG_UNUSED(path);
	if (len == sizeof(capture->initiation) && data[0] == MESSAGE_HANDSHAKE_INITIATION) {
		memcpy(&capture->initiation, data, len);
		k_sem_give(&capture->ready);
	}
	return 0;
}

ZTEST_F(wireguard_index, test_cookie_and_transport_index_routing)
{
	const uint8_t base_point[WG_PUBLIC_KEY_LEN] = {9U};
	const struct msg_handshake_init *first_init = &fixture->captures[0].initiation;
	const struct msg_handshake_init *second_init = &fixture->captures[1].initiation;
	char keys[3][PUBLIC_KEY_B64_SIZE];
	struct wireguard_peer_config config = {0};
	struct wireguard_transport transport = {.send = capture_initiation};
	struct wireguard_datagram_path path = {.kind = WIREGUARD_PATH_DIRECT};
	struct net_sockaddr_in *local = net_sin(net_sad(&path.local));
	struct net_sockaddr_in *remote = net_sin(net_sad(&path.remote));
	struct msg_cookie_reply cookie;
	struct wireguard_test_session session = {.local_index = 0x5432U};
	struct msg_transport_data header = {
		.type = MESSAGE_TRANSPORT_DATA,
		.receiver = session.local_index,
	};
	uint8_t datagram[sizeof(header) + WG_AUTHTAG_LEN] = {0};
	size_t ciphertext_len;
	struct wg_peer *first;
	struct net_if *hub;
	struct net_if *responder;

	if (!IS_ENABLED(CONFIG_WIREGUARD_MULTI_PEER) || CONFIG_WIREGUARD_MAX_PEER < 3 ||
	    net_if_get_by_name("wg1") < 0) {
		ztest_test_skip();
		return;
	}

	hub = net_if_get_by_index(net_if_get_by_name("wg0"));
	responder = net_if_get_by_index(net_if_get_by_name("wg1"));
	configure_key(hub, 5U, keys[0]);
	encode_key(base_point, keys[1]);
	configure_key(responder, 7U, keys[2]);
	ARRAY_FOR_EACH(fixture->captures, i) {
		struct handshake_capture *capture = &fixture->captures[i];

		k_sem_init(&capture->ready, 0, 1);
		transport.user_data = capture;
		config.public_key = keys[i + 1U];
		fixture->ids[i] = wireguard_peer_add_to_interface(hub, &config, &transport);
		zassert_true(fixture->ids[i] > 0, "add returned %d", fixture->ids[i]);
		zassert_ok(wireguard_peer_keepalive(fixture->ids[i]));
		zassert_ok(k_sem_take(&capture->ready, K_SECONDS(1)));
	}
	config.public_key = keys[0];
	fixture->ids[2] = wireguard_peer_add_to_interface(responder, &config, &transport);
	zassert_true(fixture->ids[2] > 0, "add returned %d", fixture->ids[2]);
	zassert_not_equal(first_init->sender, second_init->sender);

	path.iface = net_if_get_default();
	local->sin_family = NET_AF_INET;
	local->sin_port = net_htons(51820);
	local->sin_addr.s_addr = net_htonl(0xC0000201U);
	remote->sin_family = NET_AF_INET;
	remote->sin_port = net_htons(51821);
	remote->sin_addr.s_addr = net_htonl(0xC0000202U);

	zassert_ok(wg_create_cookie_reply(net_if_get_device(responder)->data, &cookie,
					  second_init->mac1, second_init->sender,
					  (uint8_t *)&local->sin_addr, sizeof(local->sin_addr)));
	zassert_equal(wireguard_peer_receive_datagram(fixture->ids[0], &path,
						      (const uint8_t *)&cookie, sizeof(cookie)),
		      -ENOENT);
	first = peer_lookup_by_id(fixture->ids[0]);
	zassert_not_null(first);
	first->handshake.local_index = second_init->sender;
	zassert_equal(wireguard_interface_receive_datagram(hub, &path, (const uint8_t *)&cookie,
							   sizeof(cookie)), -ENOENT);
	first->handshake.local_index = first_init->sender;
	zassert_ok(wireguard_interface_receive_datagram(hub, &path, (const uint8_t *)&cookie,
							sizeof(cookie)));

	memset(session.recv_key, 0x5a, sizeof(session.recv_key));
	zassert_ok(wireguard_test_install_session(fixture->ids[0], &session));
	zassert_ok(wireguard_test_install_session(fixture->ids[1], &session));
	memcpy(datagram, &header, sizeof(header));
	zassert_ok(wireguard_test_encrypt(session.recv_key, 0U, NULL, 0U, datagram + sizeof(header),
					  WG_AUTHTAG_LEN, &ciphertext_len));
	zassert_equal(ciphertext_len, WG_AUTHTAG_LEN);
	zassert_equal(wireguard_interface_receive_datagram(hub, &path, datagram, sizeof(datagram)),
		      -ENOENT);
	zassert_equal(wireguard_peer_receive_datagram(fixture->ids[1], &path, datagram,
						      sizeof(datagram)), -ENOENT);
	zassert_ok(wireguard_peer_remove(fixture->ids[0]));
	fixture->ids[0] = 0;
	zassert_ok(wireguard_interface_receive_datagram(hub, &path, datagram, sizeof(datagram)));
}

ZTEST_F(wireguard_index, test_native_udp_rejects_duplicate_local_identity)
{
	const uint8_t base_point[WG_PUBLIC_KEY_LEN] = {9U};
	char local[2][PUBLIC_KEY_B64_SIZE];
	char remote[PUBLIC_KEY_B64_SIZE];
	struct wireguard_peer_config config = {.public_key = remote};
	struct net_if *left;
	struct net_if *right;

	if (!IS_ENABLED(CONFIG_WIREGUARD_MULTI_PEER) || net_if_get_by_name("wg1") < 0) {
		ztest_test_skip();
		return;
	}
	left = net_if_get_by_index(net_if_get_by_name("wg0"));
	right = net_if_get_by_index(net_if_get_by_name("wg1"));
	configure_key(left, 9U, local[0]);
	configure_key(right, 9U, local[1]);
	zassert_mem_equal(local[0], local[1], sizeof(local[0]));
	encode_key(base_point, remote);

	fixture->ids[0] = wireguard_peer_add_to_interface(left, &config, NULL);
	zassert_true(fixture->ids[0] > 0, "add returned %d", fixture->ids[0]);
	fixture->ids[1] = wireguard_peer_add_to_interface(right, &config, NULL);
	zassert_equal(fixture->ids[1], -EADDRINUSE);
	zassert_false(net_if_is_up(right));

	zassert_ok(wireguard_peer_remove(fixture->ids[0]));
	fixture->ids[0] = 0;
	fixture->ids[1] = wireguard_peer_add_to_interface(right, &config, NULL);
	zassert_true(fixture->ids[1] > 0, "add returned %d", fixture->ids[1]);
}

#if defined(CONFIG_WIREGUARD_MULTI_PEER) && defined(CONFIG_NET_MGMT_EVENT_INFO)
struct event_sample {
	uint64_t event;
	int id;
	char public_key[PUBLIC_KEY_B64_SIZE];
	uint32_t endpoint;
	uint32_t prefix;
	int keepalive;
};

K_MSGQ_DEFINE(vpn_events, sizeof(struct event_sample), 16, 8);
static K_SEM_DEFINE(event_entered, 0, 1);
static K_SEM_DEFINE(event_release, 0, 1);
static atomic_t pause_add;
static struct net_mgmt_event_callback event_cb;
static struct net_if *event_iface;

static void record_event(struct net_mgmt_event_callback *cb, uint64_t event, struct net_if *iface)
{
	struct event_sample sample = {.event = event};

	if (iface != event_iface) {
		return;
	}
	switch (event) {
	case NET_EVENT_VPN_PEER_ADD:
		if (atomic_cas(&pause_add, 1, 0)) {
			k_sem_give(&event_entered);
			(void)k_sem_take(&event_release, K_SECONDS(2));
		}
		if (cb->info_length == sizeof(struct net_event_vpn_peer)) {
			struct net_event_vpn_peer added;

			memcpy(&added, cb->info, sizeof(added));
			sample.id = added.id;
			if (added.public_key != NULL) {
				memcpy(sample.public_key, added.public_key,
				       sizeof(sample.public_key));
			}
			if (added.endpoint != NULL && added.endpoint->sa_family == NET_AF_INET) {
				sample.endpoint = net_sin(added.endpoint)->sin_addr.s_addr;
			}
			if (added.allowed_ip[0] != NULL && added.allowed_ip[0]->is_valid) {
				sample.prefix = added.allowed_ip[0]->addr.in_addr.s_addr;
			}
			sample.keepalive = added.keepalive_interval;
		}
		break;
	case NET_EVENT_VPN_PEER_DEL:
		memcpy(&sample.id, cb->info, sizeof(sample.id));
		break;
	case NET_EVENT_VPN_CONNECTED:
	case NET_EVENT_VPN_DISCONNECTED:
		break;
	default:
		return;
	}
	(void)k_msgq_put(&vpn_events, &sample, K_NO_WAIT);
}

static struct event_sample expect_event(uint64_t event, int id)
{
	struct event_sample sample;

	zassert_ok(k_msgq_get(&vpn_events, &sample, K_SECONDS(1)));
	zassert_equal(sample.event, event);
	zassert_equal(sample.id, id);
	return sample;
}

static int add_event_peer(struct net_if *iface, uint8_t value)
{
	uint8_t key[WG_PUBLIC_KEY_LEN] = {value};
	char encoded[PUBLIC_KEY_B64_SIZE];
	struct wireguard_peer_config config = {.public_key = encoded};
	struct wireguard_transport transport = {.send = capture_initiation};
	int id;

	encode_key(key, encoded);
	net_sin(net_sad(&config.endpoint_ip))->sin_family = NET_AF_INET;
	net_sin(net_sad(&config.endpoint_ip))->sin_addr.s_addr = net_htonl(0xc0000200U | value);
	config.allowed_ip[0] = (struct wireguard_allowed_ip){
		.addr.family = NET_AF_INET,
		.addr.in_addr.s_addr = net_htonl(0xc6336400U | value),
		.mask_len = 32,
		.is_valid = true,
	};
	config.keepalive_interval = value;
	id = wireguard_peer_add_to_interface(iface, &config, &transport);
	zassert_true(id > 0, "add returned %d", id);
	return id;
}

static void authenticate_peer(int id)
{
	struct wireguard_test_session session = {.local_index = id};
	const struct wireguard_datagram_path path = {.kind = WIREGUARD_PATH_RELAY};
	struct msg_transport_data header = {.type = MESSAGE_TRANSPORT_DATA, .receiver = id};
	uint8_t datagram[sizeof(header) + WG_AUTHTAG_LEN];
	size_t len;

	memcpy(datagram, &header, sizeof(header));
	zassert_ok(wireguard_test_install_session(id, &session));
	zassert_ok(wireguard_test_encrypt(session.recv_key, 0, NULL, 0, datagram + sizeof(header),
					  WG_AUTHTAG_LEN, &len));
	zassert_ok(wireguard_peer_receive_datagram(id, &path, datagram, sizeof(header) + len));
}

ZTEST_F(wireguard_index, test_peer_events_and_interface_connectivity)
{
	struct wireguard_peer_info info;
	char encoded[PUBLIC_KEY_B64_SIZE];
	struct net_if *iface = net_if_get_by_index(net_if_get_by_name("wg0"));
	int retired;

	configure_key(iface, 41, encoded);
	event_iface = iface;
	k_msgq_purge(&vpn_events);
	net_mgmt_init_event_callback(&event_cb, record_event,
		NET_EVENT_VPN_PEER_ADD | NET_EVENT_VPN_PEER_DEL |
		NET_EVENT_VPN_CONNECTED | NET_EVENT_VPN_DISCONNECTED);
	net_mgmt_add_event_callback(&event_cb);

	fixture->ids[0] = add_event_peer(iface, 9);
	expect_event(NET_EVENT_VPN_PEER_ADD, fixture->ids[0]);
	if (IS_ENABLED(CONFIG_NET_MGMT_EVENT_QUEUE)) {
		atomic_set(&pause_add, 1);
	}
	retired = add_event_peer(iface, 10);
	if (IS_ENABLED(CONFIG_NET_MGMT_EVENT_QUEUE)) {
		zassert_ok(k_sem_take(&event_entered, K_SECONDS(1)));
	}
	zassert_ok(wireguard_peer_remove(retired));
	fixture->ids[1] = add_event_peer(iface, 11);
	k_sem_give(&event_release);
	struct event_sample retired_event = expect_event(NET_EVENT_VPN_PEER_ADD, retired);
	uint8_t retired_key[WG_PUBLIC_KEY_LEN] = {10};

	encode_key(retired_key, encoded);
	zexpect_str_equal(retired_event.public_key, encoded);
	zexpect_equal(retired_event.endpoint, net_htonl(0xc000020aU));
	zexpect_equal(retired_event.prefix, net_htonl(0xc633640aU));
	zexpect_equal(retired_event.keepalive, 10);
	expect_event(NET_EVENT_VPN_PEER_DEL, retired);
	expect_event(NET_EVENT_VPN_PEER_ADD, fixture->ids[1]);
	zassert_equal(wireguard_peer_get_info(retired, &info), -ENOENT);
	zassert_ok(wireguard_peer_get_info(fixture->ids[1], &info));
	zassert_equal(info.public_key[0], 11);

	fixture->ids[2] = add_event_peer(iface, 12);
	expect_event(NET_EVENT_VPN_PEER_ADD, fixture->ids[2]);
	authenticate_peer(fixture->ids[0]);
	expect_event(NET_EVENT_VPN_CONNECTED, 0);
	authenticate_peer(fixture->ids[1]);
	for (size_t i = 0; i < ARRAY_SIZE(fixture->ids); i++) {
		zassert_ok(wireguard_peer_remove(fixture->ids[i]));
		expect_event(NET_EVENT_VPN_PEER_DEL, fixture->ids[i]);
		fixture->ids[i] = 0;
		if (i == 1) {
			/* Only the peer which has never authenticated remains. */
			expect_event(NET_EVENT_VPN_DISCONNECTED, 0);
		}
	}
	struct event_sample extra;

	zexpect_not_equal(k_msgq_get(&vpn_events, &extra, K_MSEC(20)), 0);
	net_mgmt_del_event_callback(&event_cb);
	event_iface = NULL;
}
#endif

ZTEST_SUITE(wireguard_index, NULL, index_setup, NULL, index_cleanup, NULL);
```

## src/replay_test.c
```c
/*
 * Copyright (c) 2026 Nordic Semiconductor ASA
 *
 * SPDX-License-Identifier: Apache-2.0
 */

#include <zephyr/ztest.h>

#include "wg_test_helpers.h"

ZTEST(wireguard_replay, test_first_packet)
{
	uint32_t bitmap = 0;
	uint64_t counter = 0;

	zassert_true(wg_replay_check(&bitmap, &counter, 0));
	zassert_equal(counter, 1);
	zassert_equal(bitmap, 1);
}

ZTEST(wireguard_replay, test_duplicate)
{
	uint32_t bitmap = 0;
	uint64_t counter = 0;

	zassert_true(wg_replay_check(&bitmap, &counter, 5));
	zassert_false(wg_replay_check(&bitmap, &counter, 5));
}

ZTEST(wireguard_replay, test_out_of_order)
{
	uint32_t bitmap = 0;
	uint64_t counter = 0;

	zassert_true(wg_replay_check(&bitmap, &counter, 10));
	zassert_true(wg_replay_check(&bitmap, &counter, 8));
}

ZTEST(wireguard_replay, test_too_old)
{
	uint32_t bitmap = 0;
	uint64_t counter = 0;

	zassert_true(wg_replay_check(&bitmap, &counter, 100));
	zassert_false(wg_replay_check(&bitmap, &counter, 50));
}

ZTEST(wireguard_replay, test_large_jump)
{
	uint32_t bitmap = 0;
	uint64_t counter = 0;

	zassert_true(wg_replay_check(&bitmap, &counter, 5));
	zassert_true(wg_replay_check(&bitmap, &counter, 1000));
	zassert_equal(counter, 1001);
	zassert_equal(bitmap, 1);
}

/* A forward jump larger than 2^32 must reset the window rather than be
 * truncated into a small in-window delta (which would keep stale bits and make
 * a never-seen counter look like a replay).
 */
ZTEST(wireguard_replay, test_forward_jump_over_2_32)
{
	uint32_t bitmap = 0;
	uint64_t counter = 0;
	uint64_t base = 3;

	zassert_true(wg_replay_check(&bitmap, &counter, base));

	zassert_true(wg_replay_check(&bitmap, &counter, base + (1ULL << 32) + 5));
	zassert_equal(bitmap, 1);

	/* Never seen before, so must be accepted (a truncated diff would treat
	 * it as already seen via a stale bit).
	 */
	zassert_true(wg_replay_check(&bitmap, &counter, base + (1ULL << 32)));
}

/* A counter roughly 2^32 behind the window must be rejected as too old, not
 * truncated into an in-window delta and accepted.
 */
ZTEST(wireguard_replay, test_backward_gap_over_2_32)
{
	uint32_t bitmap = 0;
	uint64_t counter = 0;

	zassert_true(wg_replay_check(&bitmap, &counter, (1ULL << 32) + 100));
	zassert_false(wg_replay_check(&bitmap, &counter, 95));
}

ZTEST_SUITE(wireguard_replay, NULL, NULL, NULL, NULL, NULL);
```

## src/transport_test.c
```c
/*
 * Copyright (c) 2026 Nordic Semiconductor ASA
 *
 * SPDX-License-Identifier: Apache-2.0
 */

#include <string.h>

#include <zephyr/kernel.h>
#include <zephyr/ztest.h>
#include "wg_private.h"
#include <zephyr/net/socket.h>

#include "wg_test_helpers.h"

static int test_peer_id;

static struct wireguard_test_session test_session = {
	.recv_key = {
		0x01, 0x02, 0x03, 0x04, 0x05, 0x06, 0x07, 0x08,
		0x09, 0x0a, 0x0b, 0x0c, 0x0d, 0x0e, 0x0f, 0x10,
		0x11, 0x12, 0x13, 0x14, 0x15, 0x16, 0x17, 0x18,
		0x19, 0x1a, 0x1b, 0x1c, 0x1d, 0x1e, 0x1f, 0x20,
	},
	.send_key = {
		0x21, 0x22, 0x23, 0x24, 0x25, 0x26, 0x27, 0x28,
		0x29, 0x2a, 0x2b, 0x2c, 0x2d, 0x2e, 0x2f, 0x30,
		0x31, 0x32, 0x33, 0x34, 0x35, 0x36, 0x37, 0x38,
		0x39, 0x3a, 0x3b, 0x3c, 0x3d, 0x3e, 0x3f, 0x40,
	},
	.local_index = 0x12345678,
	.remote_index = 0x87654321,
};

static struct net_sockaddr_storage make_addr(uint32_t addr_be32, uint16_t port)
{
	struct net_sockaddr_storage storage = { 0 };
	struct net_sockaddr *addr = (struct net_sockaddr *)&storage;

	addr->sa_family = NET_AF_INET;
	net_sin(addr)->sin_addr.s_addr = addr_be32;
	net_sin(addr)->sin_port = net_htons(port);

	return storage;
}

static void *transport_setup(void)
{
	int ret;

	test_peer_id = wireguard_test_peer_add(NULL);
	zassert_true(test_peer_id > 0, "peer add failed (%d)", test_peer_id);

	ret = wireguard_test_install_session(test_peer_id, &test_session);
	zassert_equal(ret, 0, "session install failed (%d)", ret);

	return NULL;
}

static void transport_before(void *fixture)
{
	int ret;

	ARG_UNUSED(fixture);

	ret = wireguard_test_install_session(test_peer_id, &test_session);
	zassert_equal(ret, 0, "session reinstall failed (%d)", ret);
}

ZTEST(wireguard_transport, test_replay_does_not_mutate_peer_state)
{
	struct net_stats_vpn stats_before;
	struct net_stats_vpn stats_after;
	struct wireguard_test_keypair_state kp_before;
	struct wireguard_test_keypair_state kp_after;
	struct net_sockaddr_storage endpoint_before;
	struct net_sockaddr_storage endpoint_after;
	uint8_t ciphertext[32];
	size_t ciphertext_len;
	uint32_t last_rx_before;
	uint32_t last_rx_after;
	struct net_sockaddr_storage src_a;
	struct net_sockaddr_storage src_b;
	int ret;

	src_a = make_addr(net_htonl(0xC0000201), 51820); /* 192.0.2.1 */
	src_b = make_addr(net_htonl(0xC0000263), 51820); /* 192.0.2.99 */

	ret = wireguard_test_encrypt(test_session.recv_key, 0, NULL, 0,
				     ciphertext, sizeof(ciphertext),
				     &ciphertext_len);
	zassert_equal(ret, 0);
	zassert_equal(ciphertext_len, 16U);

	ret = wireguard_test_inject_transport(test_peer_id,
					      (struct net_sockaddr *)&src_a,
					      0, ciphertext, ciphertext_len);
	zassert_equal(ret, 0, "first inject failed (%d)", ret);

	last_rx_before = wireguard_test_peer_last_rx(test_peer_id);
	ret = wireguard_test_peer_endpoint(test_peer_id, &endpoint_before);
	zassert_equal(ret, 0);
	ret = wireguard_test_get_stats(test_peer_id, &stats_before);
	zassert_equal(ret, 0);
	ret = wireguard_test_peer_keypair_state(test_peer_id, &kp_before);
	zassert_equal(ret, 0);

	ret = wireguard_test_inject_transport(test_peer_id,
					      (struct net_sockaddr *)&src_b,
					      0, ciphertext, ciphertext_len);
	zassert_true(ret < 0, "replay inject should fail (%d)", ret);

	last_rx_after = wireguard_test_peer_last_rx(test_peer_id);
	ret = wireguard_test_peer_endpoint(test_peer_id, &endpoint_after);
	zassert_equal(ret, 0);
	ret = wireguard_test_get_stats(test_peer_id, &stats_after);
	zassert_equal(ret, 0);
	ret = wireguard_test_peer_keypair_state(test_peer_id, &kp_after);
	zassert_equal(ret, 0);

	zassert_equal(last_rx_after, last_rx_before);
	zassert_mem_equal(&endpoint_before, &endpoint_after, sizeof(endpoint_before));
	zassert_equal(stats_after.replay_error, stats_before.replay_error + 1);
	zassert_equal(kp_after.prev_valid, kp_before.prev_valid);
	zassert_equal(kp_after.current_valid, kp_before.current_valid);
	zassert_equal(kp_after.next_valid, kp_before.next_valid);
}

ZTEST(wireguard_transport, test_forged_keepalive_rejected)
{
	struct net_stats_vpn stats_before;
	struct net_stats_vpn stats_after;
	uint8_t garbage[16];
	struct net_sockaddr_storage src;
	int ret;

	src = make_addr(net_htonl(0xC0000201), 51820);
	memset(garbage, 0x5a, sizeof(garbage));

	ret = wireguard_test_get_stats(test_peer_id, &stats_before);
	zassert_equal(ret, 0);
	zassert_false(wireguard_test_peer_first_valid(test_peer_id));

	ret = wireguard_test_inject_transport(test_peer_id,
					      (struct net_sockaddr *)&src,
					      0, garbage, sizeof(garbage));
	zassert_true(ret < 0, "forged keepalive should fail (%d)", ret);

	ret = wireguard_test_get_stats(test_peer_id, &stats_after);
	zassert_equal(ret, 0);
	zassert_false(wireguard_test_peer_first_valid(test_peer_id));
	zassert_equal(stats_after.decrypt_failed, stats_before.decrypt_failed + 1);
	zassert_equal(stats_after.keepalive_rx, stats_before.keepalive_rx);
}

ZTEST(wireguard_transport, test_valid_keepalive_accepted)
{
	struct net_stats_vpn stats_before;
	struct net_stats_vpn stats_after;
	uint8_t ciphertext[32];
	size_t ciphertext_len;
	struct net_sockaddr_storage src;
	int ret;

	src = make_addr(net_htonl(0xC0000201), 51820);

	ret = wireguard_test_encrypt(test_session.recv_key, 1, NULL, 0,
				     ciphertext, sizeof(ciphertext),
				     &ciphertext_len);
	zassert_equal(ret, 0);
	zassert_equal(ciphertext_len, 16U);

	ret = wireguard_test_get_stats(test_peer_id, &stats_before);
	zassert_equal(ret, 0);

	ret = wireguard_test_inject_transport(test_peer_id,
					      (struct net_sockaddr *)&src,
					      1, ciphertext, ciphertext_len);
	zassert_equal(ret, 0, "valid keepalive failed (%d)", ret);

	ret = wireguard_test_get_stats(test_peer_id, &stats_after);
	zassert_equal(ret, 0);
	zassert_true(wireguard_test_peer_first_valid(test_peer_id));
	zassert_equal(stats_after.keepalive_rx, stats_before.keepalive_rx + 1);
	zassert_equal(stats_after.valid_rx, stats_before.valid_rx);
}

ZTEST(wireguard_transport, test_short_plaintext_rejected_before_ip_parsing)
{
	const uint8_t plaintext[16] = { 0x45 };
	struct net_sockaddr_storage src = make_addr(net_htonl(0xC0000201U), 51820U);
	struct net_stats_vpn before;
	struct net_stats_vpn after;
	uint8_t ciphertext[32];
	size_t ciphertext_len;

	zassert_ok(wireguard_test_encrypt(test_session.recv_key, 1U, plaintext, sizeof(plaintext),
					 ciphertext, sizeof(ciphertext), &ciphertext_len));
	zassert_ok(wireguard_test_get_stats(test_peer_id, &before));
	zexpect_equal(wireguard_test_inject_transport(test_peer_id, net_sad(&src), 1U, ciphertext,
						     ciphertext_len), -EMSGSIZE);
	zassert_ok(wireguard_test_get_stats(test_peer_id, &after));
	zexpect_equal(after.invalid_packet_len, before.invalid_packet_len + 1U);
	zexpect_equal(after.valid_rx, before.valid_rx);
}

ZTEST(wireguard_transport, test_unknown_session_does_not_move_endpoint)
{
	struct net_sockaddr_storage endpoint_before;
	struct net_sockaddr_storage endpoint_after;
	struct net_sockaddr_storage attacker;
	int ret;

	/* Neither a session nor a handshake in progress, which is the state at
	 * boot and after the session has expired.
	 */
	ret = wireguard_test_clear_session(test_peer_id);
	zassert_equal(ret, 0, "session clear failed (%d)", ret);

	ret = wireguard_test_peer_endpoint(test_peer_id, &endpoint_before);
	zassert_equal(ret, 0);

	attacker = make_addr(net_htonl(0xC000022A), 40000); /* 192.0.2.42 */

	ret = wireguard_test_inject_stale_session(test_peer_id,
						  (struct net_sockaddr *)&attacker,
						  0xdeadbeef);
	zexpect_true(ret < 0, "unauthenticated message should be dropped (%d)", ret);

	ret = wireguard_test_peer_endpoint(test_peer_id, &endpoint_after);
	zassert_equal(ret, 0);

	zexpect_mem_equal(&endpoint_after, &endpoint_before, sizeof(endpoint_after),
			  "endpoint moved by unauthenticated message");

	/* Recovery from a stale session is still attempted, but only towards
	 * the endpoint we already trust.
	 */
	zexpect_true(wireguard_test_peer_send_handshake(test_peer_id),
		     "handshake not triggered for stale session");
}

static void transport_teardown(void *data)
{
	zexpect_ok(wireguard_peer_remove(test_peer_id));
}

ZTEST_SUITE(wireguard_transport, NULL, transport_setup, transport_before, NULL, transport_teardown);
```
