## CMakeLists.txt
```
# SPDX-License-Identifier: Apache-2.0

cmake_minimum_required(VERSION 3.28.0)
find_package(Zephyr REQUIRED HINTS $ENV{ZEPHYR_BASE})
project(http_client_multiprotocol_http2)

file(GLOB app_sources src/*.c)
target_sources(app PRIVATE ${app_sources})

if(CONFIG_TLS_CREDENTIALS)
  set(gen_dir ${ZEPHYR_BINARY_DIR}/include/generated/)
  set(certs_dir ${ZEPHYR_BASE}/samples/net/sockets/http_server/src/certs)

  generate_inc_file_for_target(app ${certs_dir}/ca_cert.der ${gen_dir}/ca.inc)
  generate_inc_file_for_target(app ${certs_dir}/server_cert.der ${gen_dir}/server.inc)
  generate_inc_file_for_target(app ${certs_dir}/server_privkey.der ${gen_dir}/server_privkey.inc)
endif()

zephyr_linker_sources(SECTIONS sections-rom.ld)
zephyr_iterable_section(NAME http_resource_desc_test_http_service KVMA RAM_REGION GROUP RODATA_REGION)
```

## prj.conf
```kconfig
CONFIG_ZTEST=y
CONFIG_ZTEST_STACK_SIZE=4096
CONFIG_NET_TEST=y
CONFIG_ENTROPY_GENERATOR=y
CONFIG_TEST_RANDOM_GENERATOR=y
CONFIG_EVENTFD=y
CONFIG_MAIN_STACK_SIZE=2048

# Networking
CONFIG_NETWORKING=y
CONFIG_NET_DRIVERS=y
CONFIG_NET_LOOPBACK=y
CONFIG_NET_IPV6=y
CONFIG_NET_TCP=y
CONFIG_NET_TCP_TIME_WAIT_DELAY=0
CONFIG_NET_SOCKETS=y
CONFIG_NET_SOCKETS_SERVICE_STACK_SIZE=4096
CONFIG_ZVFS_POLL_MAX=16
CONFIG_NET_BUF_RX_COUNT=64
CONFIG_NET_BUF_TX_COUNT=64
CONFIG_NET_PKT_RX_COUNT=16
CONFIG_NET_PKT_TX_COUNT=16
CONFIG_NET_MAX_CONTEXTS=10
CONFIG_NET_MAX_CONN=10

# Client under test, next to the HTTP/1.1-only client it has to coexist with
CONFIG_HTTP_CLIENT_MULTIPROTOCOL=y
CONFIG_HTTP_CLIENT=y
CONFIG_HTTP_CLIENT_MAX_STREAMS=4

# Zephyr HTTP server as the peer
CONFIG_HTTP_SERVER=y
CONFIG_HTTP_SERVER_CAPTURE_HEADERS=y
CONFIG_HTTP_SERVER_CAPTURE_HEADER_COUNT=4
CONFIG_HTTP_SERVER_MAX_STREAMS=8

# Receive timeouts for the scripted peer socket
CONFIG_NET_CONTEXT_RCVTIMEO=y
```

## overlay-tls.conf
```kconfig
CONFIG_TLS_CREDENTIALS=y
CONFIG_TLS_MAX_CREDENTIALS_NUMBER=5
CONFIG_NET_SOCKETS_SOCKOPT_TLS=y
CONFIG_NET_SOCKETS_TLS_MAX_CONTEXTS=6
CONFIG_REQUIRES_FULL_LIBC=y

CONFIG_MBEDTLS=y
CONFIG_MBEDTLS_ENABLE_HEAP=y
CONFIG_MBEDTLS_HEAP_SIZE=60000
CONFIG_MBEDTLS_SSL_IN_CONTENT_LEN=2048
CONFIG_MBEDTLS_SSL_OUT_CONTENT_LEN=2048
CONFIG_MBEDTLS_CIPHERSUITE_TLS_ECDHE_ECDSA_WITH_AES_128_GCM_SHA256=y

# ALPN on both ends, as a real HTTP/2 deployment negotiates it
CONFIG_MBEDTLS_SSL_ALPN=y
CONFIG_NET_SOCKETS_TLS_MAX_APP_PROTOCOLS=2
CONFIG_HTTP_SERVER_TLS_USE_ALPN=y
```

## src/main.c
```c
/*
 * Copyright (c) 2026 Nordic Semiconductor ASA
 *
 * SPDX-License-Identifier: Apache-2.0
 */

/* End-to-end tests against the Zephyr HTTP server over loopback. */

#include <strings.h>

#include <zephyr/misc/lorem_ipsum.h>
#include <zephyr/net/http/server.h>
#include <zephyr/net/http/service.h>
#include <zephyr/net/socket.h>
#include <zephyr/net/tls_credentials.h>
#include <zephyr/ztest.h>

#include "common.h"

#define SERVER_ADDR "::1"
#define SERVER_PORT 8080
#define SERVER_HOST "zephyr.local"

#define BODY_BUF_SIZE (24 * 1024)
#define LARGE_BODY_SIZE (20 * 1024)
#define LARGE_BODY_CHUNK 1000
#define UPLOAD_SIZE 2048
#define UPLOAD_PATTERN_SIZE 1500
#define REQ_HEADERS_MAX 4

static uint16_t test_http_service_port = SERVER_PORT;

#if defined(CONFIG_NET_SOCKETS_SOCKOPT_TLS)
#define CA_CERTIFICATE_TAG 1
#define SERVER_CERTIFICATE_TAG 2

static const unsigned char ca[] = {
#include "ca.inc"
};

static const unsigned char server_cert[] = {
#include "server.inc"
};

static const unsigned char server_privkey[] = {
#include "server_privkey.inc"
};

static const sec_tag_t server_tag_list[] = {
	CA_CERTIFICATE_TAG,
	SERVER_CERTIFICATE_TAG,
};

static const sec_tag_t client_tag_list[] = {
	CA_CERTIFICATE_TAG,
};

HTTPS_SERVICE_DEFINE(test_http_service, SERVER_ADDR, &test_http_service_port, 1, 10, NULL, NULL,
		     NULL, server_tag_list, sizeof(server_tag_list));
#else
HTTP_SERVICE_DEFINE(test_http_service, SERVER_ADDR, &test_http_service_port, 1, 10, NULL, NULL,
		    NULL);
#endif

/* Static resource */

static const char static_payload[] = LOREM_IPSUM_SHORT;

static struct http_resource_detail_static static_detail = {
	.common = {
		.type = HTTP_RESOURCE_TYPE_STATIC,
		.bitmask_of_supported_http_methods = BIT(HTTP_GET),
		.content_type = "text/plain",
	},
	.static_data = static_payload,
	.static_data_len = sizeof(static_payload) - 1,
};

HTTP_RESOURCE_DEFINE(static_resource, test_http_service, "/static", &static_detail);

/* Dynamic resource, driven by per-test settings */

static struct {
	uint16_t status;
	const uint8_t *body;
	size_t body_len;
	size_t chunk;
	const struct http_header *headers;
	size_t header_count;
	uint8_t upload[UPLOAD_SIZE];
	size_t upload_len;
	struct test_header req_headers[REQ_HEADERS_MAX];
	size_t req_header_count;
	size_t offset;
} dyn;

HTTP_SERVER_REGISTER_HEADER_CAPTURE(capture_test_header, "Test-Header");
HTTP_SERVER_REGISTER_HEADER_CAPTURE(capture_test_header2, "Test-Header2");

static void dyn_reset(void)
{
	memset(&dyn, 0, sizeof(dyn));
	dyn.status = HTTP_200_OK;
}

static const char *dyn_request_header(const char *name)
{
	for (size_t i = 0; i < dyn.req_header_count; i++) {
		if (strcasecmp(dyn.req_headers[i].name, name) == 0) {
			return dyn.req_headers[i].value;
		}
	}

	return NULL;
}

static void dyn_capture_request_headers(const struct http_request_ctx *request_ctx)
{
	for (size_t i = 0; i < request_ctx->header_count; i++) {
		struct test_header *hdr;

		if (dyn.req_header_count >= REQ_HEADERS_MAX) {
			break;
		}

		hdr = &dyn.req_headers[dyn.req_header_count++];
		strncpy(hdr->name, request_ctx->headers[i].name, sizeof(hdr->name) - 1);
		strncpy(hdr->value, request_ctx->headers[i].value, sizeof(hdr->value) - 1);
	}
}

static int dynamic_cb(struct http_client_ctx *client, enum http_transaction_status status,
		      const struct http_request_ctx *request_ctx,
		      struct http_response_ctx *response_ctx, void *user_data)
{
	ARG_UNUSED(user_data);

	if (status == HTTP_SERVER_TRANSACTION_ABORTED ||
	    status == HTTP_SERVER_TRANSACTION_COMPLETE) {
		dyn.offset = 0;
		return 0;
	}

	if (request_ctx->header_count > 0) {
		dyn_capture_request_headers(request_ctx);
	}

	switch (client->method) {
	case HTTP_GET: {
		size_t remaining = dyn.body_len - dyn.offset;
		size_t len = (dyn.chunk > 0) ? MIN(dyn.chunk, remaining) : remaining;

		response_ctx->status = dyn.status;
		response_ctx->headers = dyn.headers;
		response_ctx->header_count = dyn.header_count;
		response_ctx->body = dyn.body + dyn.offset;
		response_ctx->body_len = len;
		dyn.offset += len;
		response_ctx->final_chunk = (dyn.offset >= dyn.body_len);
		break;
	}
	case HTTP_POST:
	case HTTP_PUT:
		if (dyn.offset + request_ctx->data_len > sizeof(dyn.upload)) {
			return -ENOMEM;
		}

		if (request_ctx->data_len > 0) {
			memcpy(dyn.upload + dyn.offset, request_ctx->data, request_ctx->data_len);
			dyn.offset += request_ctx->data_len;
		}

		if (status == HTTP_SERVER_REQUEST_DATA_FINAL) {
			dyn.upload_len = dyn.offset;
			dyn.offset = 0;
			response_ctx->status = dyn.status;
			response_ctx->headers = dyn.headers;
			response_ctx->header_count = dyn.header_count;
			response_ctx->final_chunk = true;
		}

		break;
	default:
		return -ENOTSUP;
	}

	return 0;
}

static struct http_resource_detail_dynamic dynamic_detail = {
	.common = {
		.type = HTTP_RESOURCE_TYPE_DYNAMIC,
		.bitmask_of_supported_http_methods = BIT(HTTP_GET) | BIT(HTTP_POST) | BIT(HTTP_PUT),
	},
	.cb = dynamic_cb,
};

HTTP_RESOURCE_DEFINE(dynamic_resource, test_http_service, "/dynamic", &dynamic_detail);

/* Client under test */

static struct http_client client;
#if defined(CONFIG_NET_SOCKETS_SOCKOPT_TLS)
static struct http_client_transport_tls_ctx transport_ctx;
#else
static struct http_client_transport_tcp_ctx transport_ctx;
#endif
static struct http_client_session_config session_cfg;
static struct test_response rsp;
static uint8_t body_buf[BODY_BUF_SIZE];
static uint8_t large_body[LARGE_BODY_SIZE];
static uint8_t upload_pattern[UPLOAD_PATTERN_SIZE];
static bool initialized;

static int client_init(void)
{
	memset(&transport_ctx, 0, sizeof(transport_ctx));

#if defined(CONFIG_NET_SOCKETS_SOCKOPT_TLS)
	transport_ctx.config.sec_tag_list = client_tag_list;
	transport_ctx.config.sec_tag_count = ARRAY_SIZE(client_tag_list);
	transport_ctx.config.hostname = SERVER_HOST;

	return http_client_init_tls(&client, HTTP_CLIENT_VERSION_2, &transport_ctx);
#else
	return http_client_init_tcp(&client, HTTP_CLIENT_VERSION_2, &transport_ctx);
#endif
}

static void session_cfg_init(struct http_client_session_config *cfg, bool async)
{
	struct net_sockaddr_in6 *sa = (struct net_sockaddr_in6 *)&cfg->server_addr;
	int ret;

	memset(cfg, 0, sizeof(*cfg));
	sa->sin6_family = NET_AF_INET6;
	sa->sin6_port = net_htons(SERVER_PORT);
	ret = zsock_inet_pton(NET_AF_INET6, SERVER_ADDR, &sa->sin6_addr);
	zassert_equal(ret, 1, "inet_pton failed");
	cfg->addrlen = sizeof(*sa);
	cfg->host = SERVER_HOST;
	cfg->async = async;
}

static void client_connect(bool async)
{
	int ret;

	ret = client_init();
	zassert_ok(ret, "client init failed (%d)", ret);

	session_cfg_init(&session_cfg, async);

	ret = http_client_connect(&client, &session_cfg);
	zassert_ok(ret, "connect failed (%d)", ret);
}

static void ensure_initialized(void)
{
	int ret;

	if (initialized) {
		return;
	}

	ARG_UNUSED(ret);

	for (size_t i = 0; i < sizeof(large_body); i++) {
		large_body[i] = (uint8_t)(i * 7 + 1);
	}

	for (size_t i = 0; i < sizeof(upload_pattern); i++) {
		upload_pattern[i] = (uint8_t)(i * 3 + 5);
	}

#if defined(CONFIG_NET_SOCKETS_SOCKOPT_TLS)
	ret = tls_credential_add(CA_CERTIFICATE_TAG, TLS_CREDENTIAL_CA_CERTIFICATE, ca,
				 sizeof(ca));
	zassert_ok(ret, "failed to add CA certificate (%d)", ret);

	ret = tls_credential_add(SERVER_CERTIFICATE_TAG, TLS_CREDENTIAL_PUBLIC_CERTIFICATE,
				 server_cert, sizeof(server_cert));
	zassert_ok(ret, "failed to add server certificate (%d)", ret);

	ret = tls_credential_add(SERVER_CERTIFICATE_TAG, TLS_CREDENTIAL_PRIVATE_KEY,
				 server_privkey, sizeof(server_privkey));
	zassert_ok(ret, "failed to add server private key (%d)", ret);
#endif

	initialized = true;
}

static void common_before(bool async)
{
	int ret;

	ensure_initialized();
	dyn_reset();
	test_response_init(&rsp, body_buf, sizeof(body_buf));

	ret = http_server_start();
	zassert_ok(ret, "server start failed (%d)", ret);

	client_connect(async);
}

static void sync_before(void *fixture)
{
	ARG_UNUSED(fixture);

	common_before(false);
}

static void async_before(void *fixture)
{
	ARG_UNUSED(fixture);

	common_before(true);
}

static void common_after(void *fixture)
{
	ARG_UNUSED(fixture);

	(void)http_client_disconnect(&client);
	(void)http_server_stop();

	k_yield();
}

static int do_request(struct http_client_request *req, enum http_method method, const char *url,
		      struct test_response *r)
{
	req->method = method;
	req->url = url;
	req->response_cb = test_response_cb;

	return http_client_send_request(&client, req, TEST_REQUEST_TIMEOUT_MS, r);
}

static int do_get(const char *url, struct test_response *r)
{
	struct http_client_request req = { 0 };

	return do_request(&req, HTTP_GET, url, r);
}

static void assert_complete(const struct test_response *r, uint16_t status)
{
	zassert_false(r->aborted, "transaction aborted, err %d", r->error);
	zassert_equal(r->final_count, 1, "final reported %d times", r->final_count);
	zassert_equal(r->status, status, "unexpected status %u", r->status);
	zassert_false(r->body_overflow, "body buffer too small");
}

/* Synchronous sessions */

ZTEST(http2_client, test_get_static)
{
	int ret;

	ret = do_get("/static", &rsp);
	zassert_ok(ret, "GET failed (%d)", ret);
	assert_complete(&rsp, HTTP_200_OK);
	zassert_equal(rsp.header_blocks, 1, "headers reported %d times", rsp.header_blocks);
	zassert_equal(rsp.body_len, sizeof(static_payload) - 1, "body length %zu",
		      rsp.body_len);
	zassert_mem_equal(rsp.body, static_payload, rsp.body_len, "body mismatch");
	zassert_false(rsp.content_len_present, "content length reported without header");
}

ZTEST(http2_client, test_get_dynamic_status)
{
	int ret;

	dyn.status = HTTP_404_NOT_FOUND;
	ret = do_get("/dynamic", &rsp);
	zassert_ok(ret, "GET failed (%d)", ret);
	assert_complete(&rsp, HTTP_404_NOT_FOUND);

	test_response_init(&rsp, body_buf, sizeof(body_buf));
	dyn.status = HTTP_500_INTERNAL_SERVER_ERROR;
	ret = do_get("/dynamic", &rsp);
	zassert_ok(ret, "GET failed (%d)", ret);
	assert_complete(&rsp, HTTP_500_INTERNAL_SERVER_ERROR);
}

ZTEST(http2_client, test_get_response_headers)
{
	static const char body[] = "dynamic body";
	static const struct http_header headers[] = {
		{ "test-header", "value1" },
		{ "content-length", "12" },
	};
	const char *value;
	int ret;

	dyn.body = body;
	dyn.body_len = sizeof(body) - 1;
	dyn.headers = headers;
	dyn.header_count = ARRAY_SIZE(headers);

	ret = do_get("/dynamic", &rsp);
	zassert_ok(ret, "GET failed (%d)", ret);
	assert_complete(&rsp, HTTP_200_OK);
	zassert_equal(rsp.header_blocks, 1, "headers reported %d times", rsp.header_blocks);

	value = test_response_header(&rsp, "test-header");
	zassert_not_null(value, "test-header missing");
	zassert_str_equal(value, "value1", "test-header value %s", value);

	zassert_true(rsp.content_len_present, "content length not reported");
	zassert_equal(rsp.content_len, 12, "content length %zu", rsp.content_len);
	zassert_equal(rsp.body_len, 12, "body length %zu", rsp.body_len);
	zassert_mem_equal(rsp.body, body, rsp.body_len, "body mismatch");
}

ZTEST(http2_client, test_method_not_allowed)
{
	struct http_client_request req = { 0 };
	int ret;

	ret = do_request(&req, HTTP_DELETE, "/static", &rsp);
	zassert_ok(ret, "DELETE failed (%d)", ret);
	assert_complete(&rsp, HTTP_405_METHOD_NOT_ALLOWED);
}

ZTEST(http2_client, test_put_payload)
{
	struct http_client_request req = { 0 };
	int ret;

	req.payload = upload_pattern;
	req.payload_len = sizeof(upload_pattern);

	ret = do_request(&req, HTTP_PUT, "/dynamic", &rsp);
	zassert_ok(ret, "PUT failed (%d)", ret);
	assert_complete(&rsp, HTTP_200_OK);
	zassert_equal(dyn.upload_len, sizeof(upload_pattern), "upload length %zu",
		      dyn.upload_len);
	zassert_mem_equal(dyn.upload, upload_pattern, dyn.upload_len, "upload mismatch");
}

static int payload_cb(size_t offset, const uint8_t **payload, size_t *len, bool *more,
		      void *user_data)
{
	size_t chunk = MIN(600, sizeof(upload_pattern) - offset);

	ARG_UNUSED(user_data);

	*payload = upload_pattern + offset;
	*len = chunk;
	*more = (offset + chunk < sizeof(upload_pattern));

	return 0;
}

ZTEST(http2_client, test_post_payload_cb)
{
	struct http_client_request req = { 0 };
	int ret;

	req.payload_cb = payload_cb;

	ret = do_request(&req, HTTP_POST, "/dynamic", &rsp);
	zassert_ok(ret, "POST failed (%d)", ret);
	assert_complete(&rsp, HTTP_200_OK);
	zassert_equal(dyn.upload_len, sizeof(upload_pattern), "upload length %zu",
		      dyn.upload_len);
	zassert_mem_equal(dyn.upload, upload_pattern, dyn.upload_len, "upload mismatch");
}

/* Reports the end of the payload with an empty final chunk. */
static int payload_cb_empty_final(size_t offset, const uint8_t **payload, size_t *len,
				  bool *more, void *user_data)
{
	size_t chunk = MIN(500, sizeof(upload_pattern) - offset);

	ARG_UNUSED(user_data);

	*payload = upload_pattern + offset;
	*len = chunk;
	*more = (chunk > 0);

	return 0;
}

ZTEST(http2_client, test_post_payload_cb_empty_final)
{
	struct http_client_request req = { 0 };
	int ret;

	req.payload_cb = payload_cb_empty_final;

	ret = do_request(&req, HTTP_POST, "/dynamic", &rsp);
	zassert_ok(ret, "POST failed (%d)", ret);
	assert_complete(&rsp, HTTP_200_OK);
	zassert_equal(dyn.upload_len, sizeof(upload_pattern), "upload length %zu",
		      dyn.upload_len);
	zassert_mem_equal(dyn.upload, upload_pattern, dyn.upload_len, "upload mismatch");
}

static int headers_cb(const struct http_client_header **headers, size_t *count, bool *more,
		      void *user_data)
{
	static const struct http_client_header extra[] = {
		{ "test-header2", "def" },
	};

	ARG_UNUSED(user_data);

	*headers = extra;
	*count = ARRAY_SIZE(extra);
	*more = false;

	return 0;
}

ZTEST(http2_client, test_request_headers)
{
	static const struct http_client_header fields[] = {
		{ "test-header", "abc" },
	};
	struct http_client_request req = { 0 };
	const char *value;
	int ret;

	req.header_fields = fields;
	req.headers_count = ARRAY_SIZE(fields);
	req.headers_cb = headers_cb;

	ret = do_request(&req, HTTP_GET, "/dynamic", &rsp);
	zassert_ok(ret, "GET failed (%d)", ret);
	assert_complete(&rsp, HTTP_200_OK);

	value = dyn_request_header("test-header");
	zassert_not_null(value, "test-header not received by the server");
	zassert_str_equal(value, "abc", "test-header value %s", value);

	value = dyn_request_header("test-header2");
	zassert_not_null(value, "test-header2 not received by the server");
	zassert_str_equal(value, "def", "test-header2 value %s", value);
}

ZTEST(http2_client, test_skip_response_headers)
{
	struct http_client_request req = { 0 };
	int ret;

	req.skip_response_headers = true;

	ret = do_request(&req, HTTP_GET, "/static", &rsp);
	zassert_ok(ret, "GET failed (%d)", ret);
	assert_complete(&rsp, HTTP_200_OK);
	zassert_equal(rsp.header_blocks, 0, "headers reported although skipped");
	zassert_equal(rsp.header_count, 0, "headers captured although skipped");
	zassert_equal(rsp.body_len, sizeof(static_payload) - 1, "body length %zu",
		      rsp.body_len);
}

ZTEST(http2_client, test_get_large_body)
{
	static const struct http_header headers[] = {
		{ "content-type", "application/octet-stream" },
	};
	int ret;

	dyn.body = large_body;
	dyn.body_len = sizeof(large_body);
	dyn.chunk = LARGE_BODY_CHUNK;
	dyn.headers = headers;
	dyn.header_count = ARRAY_SIZE(headers);

	ret = do_get("/dynamic", &rsp);
	zassert_ok(ret, "GET failed (%d)", ret);
	assert_complete(&rsp, HTTP_200_OK);
	zassert_equal(rsp.header_blocks, 1, "headers reported %d times", rsp.header_blocks);
	zassert_true(rsp.body_chunks > 1, "body delivered in one chunk");
	zassert_equal(rsp.body_len, sizeof(large_body), "body length %zu", rsp.body_len);
	zassert_mem_equal(rsp.body, large_body, rsp.body_len, "body mismatch");
}

ZTEST(http2_client, test_abort_from_callback)
{
	int ret;

	rsp.body_cb_ret = -ECANCELED;

	ret = do_get("/static", &rsp);
	zassert_equal(ret, -ECANCELED, "unexpected result %d", ret);
	zassert_true(rsp.aborted, "abort not reported");
	zassert_equal(rsp.error, -ECANCELED, "abort reason %d", rsp.error);
	zassert_equal(rsp.final_count, 0, "final reported after abort");
}

ZTEST(http2_client, test_request_on_closed_session)
{
	int ret;

	ret = http_client_disconnect(&client);
	zassert_ok(ret, "disconnect failed (%d)", ret);

	ret = do_get("/static", &rsp);
	zassert_equal(ret, -ENOTCONN, "unexpected result %d", ret);
	zassert_true(rsp.aborted, "abort not reported");
	zassert_equal(rsp.error, -ENOTCONN, "abort reason %d", rsp.error);
}

ZTEST(http2_client, test_reconnect)
{
	int ret;

	ret = do_get("/static", &rsp);
	zassert_ok(ret, "GET failed (%d)", ret);
	assert_complete(&rsp, HTTP_200_OK);

	ret = http_client_disconnect(&client);
	zassert_ok(ret, "disconnect failed (%d)", ret);

	ret = http_client_disconnect(&client);
	zassert_ok(ret, "second disconnect failed (%d)", ret);

	ret = http_client_connect(&client, &session_cfg);
	zassert_ok(ret, "reconnect failed (%d)", ret);

	ret = http_client_connect(&client, &session_cfg);
	zassert_equal(ret, -EALREADY, "connect on open session returned %d", ret);

	test_response_init(&rsp, body_buf, sizeof(body_buf));
	ret = do_get("/static", &rsp);
	zassert_ok(ret, "GET after reconnect failed (%d)", ret);
	assert_complete(&rsp, HTTP_200_OK);
}

ZTEST(http2_client, test_connect_invalid_addrlen)
{
	struct http_client_session_config cfg;
	int ret;

	ret = http_client_disconnect(&client);
	zassert_ok(ret, "disconnect failed (%d)", ret);

	session_cfg_init(&cfg, false);
	cfg.addrlen = 0;
	ret = http_client_connect(&client, &cfg);
	zassert_equal(ret, -EINVAL, "zero addrlen accepted (%d)", ret);

	cfg.addrlen = sizeof(cfg.server_addr) + 1;
	ret = http_client_connect(&client, &cfg);
	zassert_equal(ret, -EINVAL, "oversized addrlen accepted (%d)", ret);
}

#if defined(CONFIG_NET_SOCKETS_SOCKOPT_TLS)
ZTEST(http2_client, test_tls_server_name_default)
{
	struct http_client_session_config cfg;
	int ret;

	ret = http_client_disconnect(&client);
	zassert_ok(ret, "disconnect failed (%d)", ret);

	/* With no TLS hostname configured, the session host is sent as the
	 * server name and the certificate is verified against it.
	 */
	memset(&transport_ctx, 0, sizeof(transport_ctx));
	transport_ctx.config.sec_tag_list = client_tag_list;
	transport_ctx.config.sec_tag_count = ARRAY_SIZE(client_tag_list);
	ret = http_client_init_tls(&client, HTTP_CLIENT_VERSION_2, &transport_ctx);
	zassert_ok(ret, "client init failed (%d)", ret);

	session_cfg_init(&cfg, false);
	ret = http_client_connect(&client, &cfg);
	zassert_ok(ret, "connect failed (%d)", ret);
	ret = do_get("/static", &rsp);
	zassert_ok(ret, "GET failed (%d)", ret);
	assert_complete(&rsp, HTTP_200_OK);

	ret = http_client_disconnect(&client);
	zassert_ok(ret, "disconnect failed (%d)", ret);

	cfg.host = "other.test";
	ret = http_client_connect(&client, &cfg);
	zassert_true(ret < 0, "certificate accepted for another host (%d)", ret);
	zassert_equal(client.session.state, HTTP_CLIENT_SESSION_CLOSED, "session state %d",
		      client.session.state);
}
#endif /* CONFIG_NET_SOCKETS_SOCKOPT_TLS */

ZTEST_SUITE(http2_client, NULL, NULL, sync_before, common_after, NULL);

/* Asynchronous sessions */

ZTEST(http2_client_async, test_async_get)
{
	struct http_client_request req = { 0 };
	int ret;

	ret = do_request(&req, HTTP_GET, "/static", &rsp);
	zassert_ok(ret, "GET failed (%d)", ret);

	ret = test_response_wait(&rsp, K_SECONDS(5));
	zassert_ok(ret, "response timed out");
	assert_complete(&rsp, HTTP_200_OK);
	zassert_equal(rsp.body_len, sizeof(static_payload) - 1, "body length %zu",
		      rsp.body_len);
	zassert_mem_equal(rsp.body, static_payload, rsp.body_len, "body mismatch");
}

ZTEST(http2_client_async, test_async_concurrent)
{
	static const char body[] = "dynamic body";
	static struct http_client_request reqs[3];
	static struct test_response rsps[3];
	static uint8_t bufs[3][2048];
	int ret;

	dyn.body = body;
	dyn.body_len = sizeof(body) - 1;

	for (int i = 0; i < 3; i++) {
		memset(&reqs[i], 0, sizeof(reqs[i]));
		test_response_init(&rsps[i], bufs[i], sizeof(bufs[i]));
	}

	ret = do_request(&reqs[0], HTTP_GET, "/static", &rsps[0]);
	zassert_ok(ret, "GET 1 failed (%d)", ret);
	ret = do_request(&reqs[1], HTTP_GET, "/dynamic", &rsps[1]);
	zassert_ok(ret, "GET 2 failed (%d)", ret);
	ret = do_request(&reqs[2], HTTP_GET, "/static", &rsps[2]);
	zassert_ok(ret, "GET 3 failed (%d)", ret);

	for (int i = 0; i < 3; i++) {
		ret = test_response_wait(&rsps[i], K_SECONDS(5));
		zassert_ok(ret, "response %d timed out", i);
		assert_complete(&rsps[i], HTTP_200_OK);
	}

	zassert_equal(rsps[0].body_len, sizeof(static_payload) - 1, "body 1 length");
	zassert_mem_equal(rsps[0].body, static_payload, rsps[0].body_len, "body 1 mismatch");
	zassert_equal(rsps[1].body_len, sizeof(body) - 1, "body 2 length");
	zassert_mem_equal(rsps[1].body, body, rsps[1].body_len, "body 2 mismatch");
	zassert_equal(rsps[2].body_len, sizeof(static_payload) - 1, "body 3 length");
	zassert_mem_equal(rsps[2].body, static_payload, rsps[2].body_len, "body 3 mismatch");
}

ZTEST(http2_client_async, test_async_abort_from_callback)
{
	struct http_client_request req = { 0 };
	int ret;

	rsp.body_cb_ret = -ECANCELED;

	ret = do_request(&req, HTTP_GET, "/static", &rsp);
	zassert_ok(ret, "GET failed (%d)", ret);

	ret = test_response_wait(&rsp, K_SECONDS(5));
	zassert_ok(ret, "abort timed out");
	zassert_true(rsp.aborted, "abort not reported");
	zassert_equal(rsp.error, -ECANCELED, "abort reason %d", rsp.error);
	zassert_equal(rsp.final_count, 0, "final reported after abort");
}

ZTEST_SUITE(http2_client_async, NULL, NULL, async_before, common_after, NULL);
```

## src/common.c
```c
/*
 * Copyright (c) 2026 Nordic Semiconductor ASA
 *
 * SPDX-License-Identifier: Apache-2.0
 */

#include <string.h>
#include <strings.h>

#include "common.h"

static void copy_str(char *dst, size_t size, const char *src)
{
	strncpy(dst, src, size - 1);
	dst[size - 1] = '\0';
}

void test_response_init(struct test_response *rsp, uint8_t *body, size_t body_size)
{
	memset(rsp, 0, sizeof(*rsp));
	rsp->body = body;
	rsp->body_size = body_size;
	k_sem_init(&rsp->done, 0, 1);
}

int test_response_cb(struct http_client *client, const struct http_client_request *request,
		     struct http_client_response *response,
		     enum http_client_transaction_status status, void *user_data)
{
	struct test_response *rsp = user_data;

	ARG_UNUSED(client);
	ARG_UNUSED(request);

	if (status == HTTP_CLIENT_TRANSACTION_ABORTED) {
		rsp->aborted = true;
		rsp->abort_count++;
		rsp->error = response->error;
		k_sem_give(&rsp->done);
		return 0;
	}

	rsp->status = response->status_code;
	rsp->content_len_present = response->content_len_present;
	rsp->content_len = response->content_len;

	if (response->header_count > 0) {
		if (rsp->header_blocks < TEST_MAX_BLOCKS) {
			rsp->block_status[rsp->header_blocks] = response->status_code;
		}

		rsp->header_blocks++;

		for (size_t i = 0; i < response->header_count; i++) {
			struct test_header *hdr;

			if (rsp->header_count >= TEST_MAX_HEADERS) {
				break;
			}

			hdr = &rsp->headers[rsp->header_count++];
			copy_str(hdr->name, sizeof(hdr->name), response->headers[i].name);
			copy_str(hdr->value, sizeof(hdr->value), response->headers[i].value);
		}

		if (rsp->header_cb_ret != 0) {
			return rsp->header_cb_ret;
		}
	}

	if (response->body_len > 0) {
		rsp->body_chunks++;

		if (rsp->body != NULL && rsp->body_len + response->body_len <= rsp->body_size) {
			memcpy(rsp->body + rsp->body_len, response->body, response->body_len);
		} else {
			rsp->body_overflow = true;
		}

		rsp->body_len += response->body_len;

		if (rsp->body_cb_ret != 0) {
			return rsp->body_cb_ret;
		}
	}

	if (status == HTTP_CLIENT_RESPONSE_DATA_FINAL) {
		rsp->final_count++;
		k_sem_give(&rsp->done);
	}

	return 0;
}

const char *test_response_header(const struct test_response *rsp, const char *name)
{
	for (size_t i = 0; i < rsp->header_count; i++) {
		if (strcasecmp(rsp->headers[i].name, name) == 0) {
			return rsp->headers[i].value;
		}
	}

	return NULL;
}

int test_response_wait(struct test_response *rsp, k_timeout_t timeout)
{
	return k_sem_take(&rsp->done, timeout);
}
```

## src/common.h
```c
/*
 * Copyright (c) 2026 Nordic Semiconductor ASA
 *
 * SPDX-License-Identifier: Apache-2.0
 */

#ifndef HTTP2_CLIENT_TEST_COMMON_H_
#define HTTP2_CLIENT_TEST_COMMON_H_

#include <zephyr/kernel.h>
#include <zephyr/net/http/client_multiprotocol.h>

#define TEST_MAX_HEADERS 16
#define TEST_MAX_BLOCKS 4
#define TEST_HEADER_LEN 64
#define TEST_REQUEST_TIMEOUT_MS 5000

struct test_header {
	char name[TEST_HEADER_LEN];
	char value[TEST_HEADER_LEN];
};

/* Everything the response callback records. In an asynchronous session the
 * callback runs on the socket service thread or the client's work queue, so
 * it only records here and the test thread does the asserting.
 */
struct test_response {
	uint8_t *body;
	size_t body_size;
	size_t body_len;
	bool body_overflow;
	uint16_t status;
	bool content_len_present;
	size_t content_len;
	struct test_header headers[TEST_MAX_HEADERS];
	size_t header_count;
	uint16_t block_status[TEST_MAX_BLOCKS];
	int header_blocks;
	int body_chunks;
	int final_count;
	bool aborted;
	int abort_count;
	int error;
	/* Returned from the callback for body chunks, to test aborting. */
	int body_cb_ret;
	/* The same for header blocks. */
	int header_cb_ret;
	/* Given on completion or abort. */
	struct k_sem done;
};

void test_response_init(struct test_response *rsp, uint8_t *body, size_t body_size);
int test_response_cb(struct http_client *client, const struct http_client_request *request,
		     struct http_client_response *response,
		     enum http_client_transaction_status status, void *user_data);
const char *test_response_header(const struct test_response *rsp, const char *name);
int test_response_wait(struct test_response *rsp, k_timeout_t timeout);

#endif /* HTTP2_CLIENT_TEST_COMMON_H_ */
```

## src/peer.c
```c
/*
 * Copyright (c) 2026 Nordic Semiconductor ASA
 *
 * SPDX-License-Identifier: Apache-2.0
 */

#include <errno.h>
#include <string.h>
#include <strings.h>

#include <zephyr/net/http/hpack.h>
#include <zephyr/net/socket.h>
#include <zephyr/sys/byteorder.h>
#include <zephyr/sys/printk.h>

#include "peer.h"

#define PEER_PREFACE "PRI * HTTP/2.0\r\n\r\nSM\r\n\r\n"
#define PEER_PREFACE_LEN (sizeof(PEER_PREFACE) - 1)
#define PEER_SEND_TIMEOUT K_SECONDS(5)
#define PEER_HEADERS_BUF_SIZE 1024
#define PEER_FLAG_ACK 0x01

struct peer_counters peer_stats;

static struct http_hpack_header_buf hpack_buf;
static uint8_t client_settings[64];
static size_t client_settings_len;
static uint8_t headers_buf[PEER_HEADERS_BUF_SIZE];

void peer_stats_reset(void)
{
	memset(&peer_stats, 0, sizeof(peer_stats));
}

int peer_listen(void)
{
	struct net_sockaddr_in6 sa = { 0 };
	int fd, ret;

	fd = zsock_socket(NET_AF_INET6, NET_SOCK_STREAM, NET_IPPROTO_TCP);
	if (fd < 0) {
		return -errno;
	}

	ret = zsock_setsockopt(fd, ZSOCK_SOL_SOCKET, ZSOCK_SO_REUSEADDR, &(int){ 1 }, sizeof(int));
	if (ret < 0) {
		ret = -errno;
		goto error;
	}

	sa.sin6_family = NET_AF_INET6;
	sa.sin6_port = net_htons(PEER_PORT);
	sa.sin6_addr = net_in6addr_loopback;

	ret = zsock_bind(fd, (struct net_sockaddr *)&sa, sizeof(sa));
	if (ret < 0) {
		ret = -errno;
		goto error;
	}

	ret = zsock_listen(fd, 2);
	if (ret < 0) {
		ret = -errno;
		goto error;
	}

	return fd;

error:
	zsock_close(fd);

	return ret;
}

int peer_set_recv_timeout(int conn, uint32_t timeout_ms)
{
	struct zsock_timeval tv = {
		.tv_sec = timeout_ms / MSEC_PER_SEC,
		.tv_usec = (timeout_ms % MSEC_PER_SEC) * USEC_PER_MSEC,
	};

	if (zsock_setsockopt(conn, ZSOCK_SOL_SOCKET, ZSOCK_SO_RCVTIMEO, &tv, sizeof(tv)) < 0) {
		return -errno;
	}

	return 0;
}

int peer_accept(int listen_fd)
{
	int conn, ret;

	conn = zsock_accept(listen_fd, NULL, NULL);
	if (conn < 0) {
		return -errno;
	}

	ret = peer_set_recv_timeout(conn, PEER_RECV_TIMEOUT_MS);
	if (ret < 0) {
		zsock_close(conn);
		return ret;
	}

	return conn;
}

static int recv_exact(int conn, uint8_t *buf, size_t len)
{
	size_t got = 0;

	while (got < len) {
		int ret = zsock_recv(conn, buf + got, len - got, 0);

		if (ret < 0) {
			return -errno;
		}

		if (ret == 0) {
			return -ENOTCONN;
		}

		got += ret;
	}

	return 0;
}

static void stats_update(const struct peer_frame *frame)
{
	peer_stats.frames++;

	switch (frame->type) {
	case HTTP2_WINDOW_UPDATE_FRAME: {
		uint32_t inc = sys_get_be32(frame->payload) & HTTP2_FRAME_STREAM_ID_MASK;

		peer_stats.window_update_frames++;
		if (frame->stream_id == 0) {
			peer_stats.window_update_conn += inc;
		} else {
			peer_stats.window_update_stream += inc;
		}
		break;
	}
	case HTTP2_RST_STREAM_FRAME:
		peer_stats.rst_stream_seen = true;
		peer_stats.rst_stream_id = frame->stream_id;
		peer_stats.rst_error = sys_get_be32(frame->payload);
		break;
	case HTTP2_GOAWAY_FRAME:
		peer_stats.goaway_seen = true;
		peer_stats.goaway_last_stream = sys_get_be32(frame->payload) &
						HTTP2_FRAME_STREAM_ID_MASK;
		peer_stats.goaway_error = sys_get_be32(frame->payload + sizeof(uint32_t));
		break;
	case HTTP2_SETTINGS_FRAME:
		if (frame->flags & PEER_FLAG_ACK) {
			peer_stats.settings_ack_frames++;
		}
		break;
	case HTTP2_PING_FRAME:
		if (frame->flags & PEER_FLAG_ACK) {
			peer_stats.ping_ack_seen = true;
			memcpy(peer_stats.ping_ack_data, frame->payload,
			       sizeof(peer_stats.ping_ack_data));
		}
		break;
	case HTTP2_DATA_FRAME:
		peer_stats.data_bytes += frame->len;
		if (frame->flags & HTTP2_FLAG_END_STREAM) {
			peer_stats.end_stream_seen = true;
		}
		break;
	default:
		break;
	}
}

int peer_recv_frame(int conn, struct peer_frame *frame)
{
	uint8_t hdr[HTTP2_FRAME_HEADER_SIZE];
	int ret;

	ret = recv_exact(conn, hdr, sizeof(hdr));
	if (ret < 0) {
		return ret;
	}

	frame->len = sys_get_be24(&hdr[HTTP2_FRAME_LENGTH_OFFSET]);
	frame->type = hdr[HTTP2_FRAME_TYPE_OFFSET];
	frame->flags = hdr[HTTP2_FRAME_FLAGS_OFFSET];
	frame->stream_id = sys_get_be32(&hdr[HTTP2_FRAME_STREAM_ID_OFFSET]) &
			   HTTP2_FRAME_STREAM_ID_MASK;

	if (frame->len > sizeof(frame->payload)) {
		return -EMSGSIZE;
	}

	ret = recv_exact(conn, frame->payload, frame->len);
	if (ret < 0) {
		return ret;
	}

	stats_update(frame);

	return 0;
}

int peer_recv_frame_type(int conn, uint8_t type, struct peer_frame *frame)
{
	while (true) {
		int ret = peer_recv_frame(conn, frame);

		if (ret < 0) {
			return ret;
		}

		if (frame->type == type) {
			return 0;
		}
	}
}

int peer_drain(int conn)
{
	static struct peer_frame frame;
	int count = 0;

	while (peer_recv_frame(conn, &frame) == 0) {
		count++;
	}

	return count;
}

int peer_recv_preface(int conn)
{
	static struct peer_frame frame;
	uint8_t preface[PEER_PREFACE_LEN];
	int ret;

	ret = recv_exact(conn, preface, sizeof(preface));
	if (ret < 0) {
		return ret;
	}

	if (memcmp(preface, PEER_PREFACE, sizeof(preface)) != 0) {
		return -EBADMSG;
	}

	ret = peer_recv_frame(conn, &frame);
	if (ret < 0) {
		return ret;
	}

	if (frame.type != HTTP2_SETTINGS_FRAME || (frame.flags & PEER_FLAG_ACK) != 0) {
		return -EBADMSG;
	}

	client_settings_len = MIN(frame.len, sizeof(client_settings));
	memcpy(client_settings, frame.payload, client_settings_len);

	return 0;
}

int peer_handshake(int conn)
{
	int ret;

	ret = peer_recv_preface(conn);
	if (ret < 0) {
		return ret;
	}

	ret = peer_send_frame(conn, HTTP2_SETTINGS_FRAME, 0, 0, NULL, 0);
	if (ret < 0) {
		return ret;
	}

	/* The client's acknowledgment of our SETTINGS is not awaited here: a
	 * synchronous session only reads the socket while a request is in
	 * flight, so it arrives with the first request. It is counted in
	 * peer_stats whenever it is read.
	 */
	return peer_send_frame(conn, HTTP2_SETTINGS_FRAME, PEER_FLAG_ACK, 0, NULL, 0);
}

const uint8_t *peer_client_settings(size_t *len)
{
	*len = client_settings_len;

	return client_settings;
}

void peer_frame_header(uint8_t *buf, uint32_t len, uint8_t type, uint8_t flags,
		       uint32_t stream_id)
{
	sys_put_be24(len, &buf[HTTP2_FRAME_LENGTH_OFFSET]);
	buf[HTTP2_FRAME_TYPE_OFFSET] = type;
	buf[HTTP2_FRAME_FLAGS_OFFSET] = flags;
	sys_put_be32(stream_id, &buf[HTTP2_FRAME_STREAM_ID_OFFSET]);
}

int peer_send_raw(int conn, const uint8_t *buf, size_t len)
{
	return zsock_send_all(conn, buf, len, 0, PEER_SEND_TIMEOUT, NULL);
}

int peer_send_sliced(int conn, const uint8_t *buf, size_t len, size_t slice, uint32_t gap_ms)
{
	for (size_t off = 0; off < len; off += slice) {
		int ret = peer_send_raw(conn, buf + off, MIN(slice, len - off));

		if (ret < 0) {
			return ret;
		}

		k_sleep(K_MSEC(gap_ms));
	}

	return 0;
}

int peer_send_frame(int conn, uint8_t type, uint8_t flags, uint32_t stream_id,
		    const uint8_t *payload, size_t len)
{
	uint8_t hdr[HTTP2_FRAME_HEADER_SIZE];
	int ret;

	peer_frame_header(hdr, len, type, flags, stream_id);

	ret = peer_send_raw(conn, hdr, sizeof(hdr));
	if (ret < 0 || len == 0) {
		return ret;
	}

	return peer_send_raw(conn, payload, len);
}

int peer_encode_headers(uint8_t *buf, size_t buflen, const struct http_header *headers,
			size_t count)
{
	size_t off = 0;

	for (size_t i = 0; i < count; i++) {
		int ret;

		hpack_buf.name = headers[i].name;
		hpack_buf.name_len = strlen(headers[i].name);
		hpack_buf.value = headers[i].value;
		hpack_buf.value_len = strlen(headers[i].value);

		ret = http_hpack_encode_header(buf + off, buflen - off, &hpack_buf);
		if (ret < 0) {
			return ret;
		}

		off += ret;
	}

	return (int)off;
}

int peer_send_headers(int conn, uint32_t stream_id, uint8_t flags,
		      const struct http_header *headers, size_t count)
{
	int len;

	len = peer_encode_headers(headers_buf, sizeof(headers_buf), headers, count);
	if (len < 0) {
		return len;
	}

	return peer_send_frame(conn, HTTP2_HEADERS_FRAME, flags, stream_id, headers_buf, len);
}

int peer_send_data(int conn, uint32_t stream_id, uint8_t flags, const uint8_t *data,
		   size_t len)
{
	return peer_send_frame(conn, HTTP2_DATA_FRAME, flags, stream_id, data, len);
}

int peer_decode_headers(const uint8_t *payload, size_t len, struct peer_header *headers,
			size_t max)
{
	size_t off = 0;
	int count = 0;

	while (off < len) {
		int ret;

		hpack_buf.name_len = 0;

		ret = http_hpack_decode_header(payload + off, len - off, &hpack_buf);
		if (ret <= 0) {
			return (ret == 0) ? -EBADMSG : ret;
		}

		off += ret;

		if (hpack_buf.name_len == 0) {
			/* Dynamic table size update, not a field. */
			continue;
		}

		if (count >= max) {
			return -ENOMEM;
		}

		snprintk(headers[count].name, sizeof(headers[count].name), "%.*s",
			 (int)hpack_buf.name_len, hpack_buf.name);
		snprintk(headers[count].value, sizeof(headers[count].value), "%.*s",
			 (int)hpack_buf.value_len, hpack_buf.value);
		count++;
	}

	return count;
}

const char *peer_header_value(const struct peer_header *headers, int count, const char *name)
{
	for (int i = 0; i < count; i++) {
		if (strcasecmp(headers[i].name, name) == 0) {
			return headers[i].value;
		}
	}

	return NULL;
}
```

## src/peer.h
```c
/*
 * Copyright (c) 2026 Nordic Semiconductor ASA
 *
 * SPDX-License-Identifier: Apache-2.0
 */

#ifndef HTTP2_CLIENT_TEST_PEER_H_
#define HTTP2_CLIENT_TEST_PEER_H_

#include <zephyr/kernel.h>
#include <zephyr/net/http/frame.h>
#include <zephyr/net/http/server.h>

/* A scripted HTTP/2 peer driven from the test thread over a raw socket. It
 * produces the frames the real server never does: control frames, malformed
 * input, padding, split header blocks, stalls and abrupt closes.
 */

#define PEER_PORT 8081
#define PEER_PAYLOAD_MAX 16384
#define PEER_RECV_TIMEOUT_MS 2000
#define PEER_MAX_HEADERS 16
#define PEER_HEADER_NAME_LEN 64
#define PEER_HEADER_VALUE_LEN 128

struct peer_frame {
	uint32_t len;
	uint8_t type;
	uint8_t flags;
	uint32_t stream_id;
	uint8_t payload[PEER_PAYLOAD_MAX];
};

struct peer_header {
	char name[PEER_HEADER_NAME_LEN];
	char value[PEER_HEADER_VALUE_LEN];
};

/* Frames seen from the client, accumulated by every peer_recv_frame() call. */
struct peer_counters {
	int frames;
	int window_update_frames;
	uint32_t window_update_conn;
	uint32_t window_update_stream;
	bool rst_stream_seen;
	uint32_t rst_stream_id;
	uint32_t rst_error;
	bool goaway_seen;
	uint32_t goaway_last_stream;
	uint32_t goaway_error;
	int settings_ack_frames;
	bool ping_ack_seen;
	uint8_t ping_ack_data[8];
	size_t data_bytes;
	bool end_stream_seen;
};

extern struct peer_counters peer_stats;

void peer_stats_reset(void);

int peer_listen(void);
int peer_accept(int listen_fd);
int peer_set_recv_timeout(int conn, uint32_t timeout_ms);
/* Read the client's connection preface without answering it. */
int peer_recv_preface(int conn);
/* Read the client's preface and send an empty SETTINGS frame and the ACK. */
int peer_handshake(int conn);
const uint8_t *peer_client_settings(size_t *len);

int peer_recv_frame(int conn, struct peer_frame *frame);
int peer_recv_frame_type(int conn, uint8_t type, struct peer_frame *frame);
int peer_drain(int conn);

void peer_frame_header(uint8_t *buf, uint32_t len, uint8_t type, uint8_t flags,
		       uint32_t stream_id);
int peer_send_raw(int conn, const uint8_t *buf, size_t len);
int peer_send_sliced(int conn, const uint8_t *buf, size_t len, size_t slice, uint32_t gap_ms);
int peer_send_frame(int conn, uint8_t type, uint8_t flags, uint32_t stream_id,
		    const uint8_t *payload, size_t len);
int peer_encode_headers(uint8_t *buf, size_t buflen, const struct http_header *headers,
			size_t count);
int peer_send_headers(int conn, uint32_t stream_id, uint8_t flags,
		      const struct http_header *headers, size_t count);
int peer_send_data(int conn, uint32_t stream_id, uint8_t flags, const uint8_t *data,
		   size_t len);

int peer_decode_headers(const uint8_t *payload, size_t len, struct peer_header *headers,
			size_t max);
const char *peer_header_value(const struct peer_header *headers, int count, const char *name);

#endif /* HTTP2_CLIENT_TEST_PEER_H_ */
```
