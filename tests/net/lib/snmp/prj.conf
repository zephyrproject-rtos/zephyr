## CMakeLists.txt
```
# SPDX-FileCopyrightText: Copyright The Zephyr Project Contributors
# SPDX-License-Identifier: Apache-2.0

cmake_minimum_required(VERSION 3.20.0)
find_package(Zephyr REQUIRED HINTS $ENV{ZEPHYR_BASE})
project(snmp)

target_include_directories(app PRIVATE ${ZEPHYR_BASE}/subsys/net/lib/snmp)
file(GLOB app_sources src/*.c)
target_sources(app PRIVATE ${app_sources})
```

## prj.conf
```kconfig
CONFIG_ZTEST=y

CONFIG_NETWORKING=y
CONFIG_NET_TEST=y

CONFIG_SNMP=y

CONFIG_NET_LOG=y
CONFIG_LOG=y

CONFIG_ZTEST_STACK_SIZE=16384
CONFIG_SNMP_SET_ENABLE=y
```

## src/ber.c
```c
/*
 * SPDX-FileCopyrightText: Copyright The Zephyr Project Contributors
 * SPDX-License-Identifier: Apache-2.0
 */

#include <errno.h>
#include <string.h>

#include <zephyr/ztest.h>

#include "snmp_ber.h"

static uint8_t buf[64];

static void check_encoding(const uint8_t *expected, size_t expected_len,
			   const struct snmp_ber_writer *w)
{
	zassert_equal(w->pos, expected_len, "Encoded %zu bytes, expected %zu", w->pos,
		      expected_len);
	zassert_mem_equal(w->buf, expected, expected_len, "Encoding differs");
}

ZTEST(snmp_ber, test_int32_roundtrip)
{
	static const int32_t values[] = {0,     1,     -1,     127,    128,       -128,     -129,
					 32767, 32768, -32768, -32769, INT32_MAX, INT32_MIN};

	for (size_t i = 0; i < ARRAY_SIZE(values); i++) {
		struct snmp_ber_writer w;
		struct snmp_ber_reader r;
		int32_t got;

		snmp_ber_writer_init(&w, buf, sizeof(buf));
		zassert_ok(snmp_ber_write_int32(&w, values[i]));
		zassert_equal(w.pos, snmp_ber_sizeof_int32(values[i]), "Size mismatch for %d",
			      values[i]);

		snmp_ber_reader_init(&r, buf, w.pos);
		zassert_ok(snmp_ber_read_int32(&r, &got));
		zassert_equal(got, values[i], "Got %d for %d", got, values[i]);
		zassert_true(snmp_ber_reader_at_end(&r), "Trailing bytes");
	}
}

ZTEST(snmp_ber, test_int32_encoding)
{
	static const uint8_t exp_128[] = {0x02, 0x02, 0x00, 0x80};
	static const uint8_t exp_neg129[] = {0x02, 0x02, 0xFF, 0x7F};
	static const uint8_t exp_neg1[] = {0x02, 0x01, 0xFF};
	struct snmp_ber_writer w;

	snmp_ber_writer_init(&w, buf, sizeof(buf));
	zassert_ok(snmp_ber_write_int32(&w, 128));
	check_encoding(exp_128, sizeof(exp_128), &w);

	snmp_ber_writer_init(&w, buf, sizeof(buf));
	zassert_ok(snmp_ber_write_int32(&w, -129));
	check_encoding(exp_neg129, sizeof(exp_neg129), &w);

	snmp_ber_writer_init(&w, buf, sizeof(buf));
	zassert_ok(snmp_ber_write_int32(&w, -1));
	check_encoding(exp_neg1, sizeof(exp_neg1), &w);
}

ZTEST(snmp_ber, test_uint32_encoding)
{
	static const uint8_t exp_128[] = {0x41, 0x02, 0x00, 0x80};
	static const uint8_t exp_max[] = {0x42, 0x05, 0x00, 0xFF, 0xFF, 0xFF, 0xFF};
	static const uint8_t exp_zero[] = {0x43, 0x01, 0x00};
	struct snmp_ber_writer w;
	struct snmp_ber_reader r;
	uint32_t got;

	snmp_ber_writer_init(&w, buf, sizeof(buf));
	zassert_ok(snmp_ber_write_uint32(&w, SNMP_BER_TAG_COUNTER32, 128U));
	check_encoding(exp_128, sizeof(exp_128), &w);

	snmp_ber_writer_init(&w, buf, sizeof(buf));
	zassert_ok(snmp_ber_write_uint32(&w, SNMP_BER_TAG_GAUGE32, UINT32_MAX));
	check_encoding(exp_max, sizeof(exp_max), &w);
	zassert_equal(w.pos, snmp_ber_sizeof_uint32(UINT32_MAX));

	snmp_ber_reader_init(&r, buf, w.pos);
	zassert_ok(snmp_ber_read_uint32(&r, SNMP_BER_TAG_GAUGE32, &got));
	zassert_equal(got, UINT32_MAX);

	snmp_ber_writer_init(&w, buf, sizeof(buf));
	zassert_ok(snmp_ber_write_uint32(&w, SNMP_BER_TAG_TIMETICKS, 0U));
	check_encoding(exp_zero, sizeof(exp_zero), &w);
}

ZTEST(snmp_ber, test_uint64_roundtrip)
{
	static const uint64_t values[] = {
		0U,        1U, 0x80U, UINT32_MAX, (uint64_t)UINT32_MAX + 1U, 0x7FFFFFFFFFFFFFFFULL,
		UINT64_MAX};

	for (size_t i = 0; i < ARRAY_SIZE(values); i++) {
		struct snmp_ber_writer w;
		struct snmp_ber_reader r;
		uint64_t got;

		snmp_ber_writer_init(&w, buf, sizeof(buf));
		zassert_ok(snmp_ber_write_uint64(&w, SNMP_BER_TAG_COUNTER64, values[i]));
		zassert_equal(w.pos, snmp_ber_sizeof_uint64(values[i]));

		snmp_ber_reader_init(&r, buf, w.pos);
		zassert_ok(snmp_ber_read_uint64(&r, SNMP_BER_TAG_COUNTER64, &got));
		zassert_equal(got, values[i], "Got %llu for %llu", got, values[i]);
	}

	zassert_equal(buf[1], 9U, "UINT64_MAX needs a leading zero byte");
}

ZTEST(snmp_ber, test_octets_and_empty)
{
	static const uint8_t expected[] = {0x04, 0x03, 'a', 'b', 'c', 0x05, 0x00, 0x80, 0x00};
	struct snmp_ber_writer w;
	struct snmp_ber_reader r;
	const uint8_t *data;
	size_t len;

	snmp_ber_writer_init(&w, buf, sizeof(buf));
	zassert_ok(
		snmp_ber_write_octets(&w, SNMP_BER_TAG_OCTET_STRING, (const uint8_t *)"abc", 3U));
	zassert_ok(snmp_ber_write_empty(&w, SNMP_BER_TAG_NULL));
	zassert_ok(snmp_ber_write_empty(&w, SNMP_BER_TAG_NO_SUCH_OBJECT));
	check_encoding(expected, sizeof(expected), &w);

	snmp_ber_reader_init(&r, buf, w.pos);
	zassert_ok(snmp_ber_read_octets(&r, SNMP_BER_TAG_OCTET_STRING, &data, &len));
	zassert_equal(len, 3U);
	zassert_mem_equal(data, "abc", 3U);
	zassert_ok(snmp_ber_read_empty(&r, SNMP_BER_TAG_NULL));
	zassert_ok(snmp_ber_read_empty(&r, SNMP_BER_TAG_NO_SUCH_OBJECT));
	zassert_true(snmp_ber_reader_at_end(&r));

	/* An empty OCTET STRING is legal. */
	snmp_ber_writer_init(&w, buf, sizeof(buf));
	zassert_ok(snmp_ber_write_octets(&w, SNMP_BER_TAG_OCTET_STRING, NULL, 0U));
	zassert_equal(w.pos, 2U);
}

ZTEST(snmp_ber, test_oid_encoding)
{
	static const uint32_t sys_descr[] = {1, 3, 6, 1, 2, 1, 1, 1, 0};
	static const uint8_t exp_sys_descr[] = {0x06, 0x08, 0x2B, 0x06, 0x01,
						0x02, 0x01, 0x01, 0x01, 0x00};
	static const uint32_t zero_dot_zero[] = {0, 0};
	static const uint8_t exp_zero_dot_zero[] = {0x06, 0x01, 0x00};
	static const uint32_t enterprise[] = {1, 3, 6, 1, 4, 1, 99999};
	static const uint8_t exp_enterprise[] = {0x06, 0x08, 0x2B, 0x06, 0x01,
						 0x04, 0x01, 0x86, 0x8D, 0x1F};
	static const uint32_t big[] = {2, 4294967215U, UINT32_MAX};
	struct snmp_ber_writer w;
	struct snmp_ber_reader r;
	uint32_t arcs[16];
	size_t len;

	snmp_ber_writer_init(&w, buf, sizeof(buf));
	zassert_ok(snmp_ber_write_oid(&w, sys_descr, ARRAY_SIZE(sys_descr)));
	check_encoding(exp_sys_descr, sizeof(exp_sys_descr), &w);
	zassert_equal(w.pos, snmp_ber_sizeof_oid(sys_descr, ARRAY_SIZE(sys_descr)));

	snmp_ber_reader_init(&r, buf, w.pos);
	zassert_ok(snmp_ber_read_oid(&r, arcs, ARRAY_SIZE(arcs), &len));
	zassert_equal(len, ARRAY_SIZE(sys_descr));
	zassert_mem_equal(arcs, sys_descr, sizeof(sys_descr));

	snmp_ber_writer_init(&w, buf, sizeof(buf));
	zassert_ok(snmp_ber_write_oid(&w, zero_dot_zero, ARRAY_SIZE(zero_dot_zero)));
	check_encoding(exp_zero_dot_zero, sizeof(exp_zero_dot_zero), &w);

	snmp_ber_reader_init(&r, buf, w.pos);
	zassert_ok(snmp_ber_read_oid(&r, arcs, ARRAY_SIZE(arcs), &len));
	zassert_equal(len, 2U);
	zassert_equal(arcs[0], 0U);
	zassert_equal(arcs[1], 0U);

	snmp_ber_writer_init(&w, buf, sizeof(buf));
	zassert_ok(snmp_ber_write_oid(&w, enterprise, ARRAY_SIZE(enterprise)));
	check_encoding(exp_enterprise, sizeof(exp_enterprise), &w);

	/* The largest values that fit: second arc 2.x combines to UINT32_MAX. */
	snmp_ber_writer_init(&w, buf, sizeof(buf));
	zassert_ok(snmp_ber_write_oid(&w, big, ARRAY_SIZE(big)));
	snmp_ber_reader_init(&r, buf, w.pos);
	zassert_ok(snmp_ber_read_oid(&r, arcs, ARRAY_SIZE(arcs), &len));
	zassert_equal(len, 3U);
	zassert_mem_equal(arcs, big, sizeof(big));
}

ZTEST(snmp_ber, test_oid_invalid)
{
	static const uint32_t one_arc[] = {1};
	static const uint32_t bad_first[] = {3, 1};
	static const uint32_t bad_second[] = {1, 40};
	static const uint32_t overflow[] = {2, 4294967216U};
	/* Continuation bit set on the last byte. */
	static const uint8_t truncated[] = {0x06, 0x02, 0x2B, 0x86};
	/* Non-minimal leading 0x80. */
	static const uint8_t leading_zero[] = {0x06, 0x03, 0x2B, 0x80, 0x06};
	/* Sub-identifier wider than 32 bits. */
	static const uint8_t too_wide[] = {0x06, 0x07, 0x2B, 0x90, 0x80, 0x80, 0x80, 0x80, 0x00};
	static const uint8_t empty[] = {0x06, 0x00};
	static const uint8_t valid[] = {0x06, 0x03, 0x2B, 0x06, 0x01};
	struct snmp_ber_writer w;
	struct snmp_ber_reader r;
	uint32_t arcs[16];
	size_t len;

	snmp_ber_writer_init(&w, buf, sizeof(buf));
	zassert_equal(snmp_ber_write_oid(&w, one_arc, ARRAY_SIZE(one_arc)), -EINVAL);
	zassert_equal(snmp_ber_write_oid(&w, bad_first, ARRAY_SIZE(bad_first)), -EINVAL);
	zassert_equal(snmp_ber_write_oid(&w, bad_second, ARRAY_SIZE(bad_second)), -EINVAL);
	zassert_equal(snmp_ber_write_oid(&w, overflow, ARRAY_SIZE(overflow)), -EINVAL);
	zassert_equal(w.pos, 0U, "Nothing may be written on error");
	zassert_equal(snmp_ber_sizeof_oid(one_arc, ARRAY_SIZE(one_arc)), 0U);

	snmp_ber_reader_init(&r, truncated, sizeof(truncated));
	zassert_equal(snmp_ber_read_oid(&r, arcs, ARRAY_SIZE(arcs), &len), -EBADMSG);

	snmp_ber_reader_init(&r, leading_zero, sizeof(leading_zero));
	zassert_equal(snmp_ber_read_oid(&r, arcs, ARRAY_SIZE(arcs), &len), -EBADMSG);

	snmp_ber_reader_init(&r, too_wide, sizeof(too_wide));
	zassert_equal(snmp_ber_read_oid(&r, arcs, ARRAY_SIZE(arcs), &len), -EBADMSG);

	snmp_ber_reader_init(&r, empty, sizeof(empty));
	zassert_equal(snmp_ber_read_oid(&r, arcs, ARRAY_SIZE(arcs), &len), -EBADMSG);

	snmp_ber_reader_init(&r, valid, sizeof(valid));
	zassert_equal(snmp_ber_read_oid(&r, arcs, 2U, &len), -EMSGSIZE);

	snmp_ber_reader_init(&r, valid, sizeof(valid));
	zassert_equal(snmp_ber_read_oid(&r, arcs, 1U, &len), -EMSGSIZE);
}

ZTEST(snmp_ber, test_malformed_input)
{
	static const uint8_t indefinite[] = {0x30, 0x80, 0x02, 0x01, 0x00, 0x00, 0x00};
	static const uint8_t truncated_len[] = {0x30, 0x82, 0x01};
	static const uint8_t too_long[] = {0x30, 0x05, 0x02, 0x01, 0x00};
	static const uint8_t too_wide_len[] = {0x30, 0x89, 0x01, 0x00, 0x00, 0x00,
					       0x00, 0x00, 0x00, 0x00, 0x01, 0x00};
	static const uint8_t reserved_len[] = {0x30, 0xFF, 0x00};
	static const uint8_t multibyte_tag[] = {0x1F, 0x01, 0x00};
	static const uint8_t int_too_wide[] = {0x02, 0x05, 0x00, 0xFF, 0xFF, 0xFF, 0xFF};
	static const uint8_t int_empty[] = {0x02, 0x00};
	static const uint8_t uint_negative[] = {0x41, 0x01, 0x80};
	static const uint8_t uint_too_wide[] = {0x41, 0x05, 0x01, 0x00, 0x00, 0x00, 0x00};
	static const uint8_t wrong_tag[] = {0x04, 0x01, 0x00};
	static const uint8_t null_with_content[] = {0x05, 0x01, 0x00};
	static const uint8_t single[] = {0x02};
	struct snmp_ber_reader r, inner;
	int32_t i32;
	uint32_t u32;
	uint8_t tag;

	snmp_ber_reader_init(&r, indefinite, sizeof(indefinite));
	zassert_equal(snmp_ber_read_sequence(&r, SNMP_BER_TAG_SEQUENCE, &inner), -EBADMSG);

	snmp_ber_reader_init(&r, truncated_len, sizeof(truncated_len));
	zassert_equal(snmp_ber_read_sequence(&r, SNMP_BER_TAG_SEQUENCE, &inner), -EBADMSG);

	snmp_ber_reader_init(&r, too_long, sizeof(too_long));
	zassert_equal(snmp_ber_read_sequence(&r, SNMP_BER_TAG_SEQUENCE, &inner), -EBADMSG);

	snmp_ber_reader_init(&r, too_wide_len, sizeof(too_wide_len));
	zassert_equal(snmp_ber_read_sequence(&r, SNMP_BER_TAG_SEQUENCE, &inner), -EBADMSG);

	snmp_ber_reader_init(&r, reserved_len, sizeof(reserved_len));
	zassert_equal(snmp_ber_read_sequence(&r, SNMP_BER_TAG_SEQUENCE, &inner), -EBADMSG);

	snmp_ber_reader_init(&r, multibyte_tag, sizeof(multibyte_tag));
	zassert_equal(snmp_ber_skip(&r), -EBADMSG);

	snmp_ber_reader_init(&r, int_too_wide, sizeof(int_too_wide));
	zassert_equal(snmp_ber_read_int32(&r, &i32), -EBADMSG);

	snmp_ber_reader_init(&r, int_empty, sizeof(int_empty));
	zassert_equal(snmp_ber_read_int32(&r, &i32), -EBADMSG);

	snmp_ber_reader_init(&r, uint_negative, sizeof(uint_negative));
	zassert_equal(snmp_ber_read_uint32(&r, SNMP_BER_TAG_COUNTER32, &u32), -EBADMSG);

	snmp_ber_reader_init(&r, uint_too_wide, sizeof(uint_too_wide));
	zassert_equal(snmp_ber_read_uint32(&r, SNMP_BER_TAG_COUNTER32, &u32), -EBADMSG);

	snmp_ber_reader_init(&r, wrong_tag, sizeof(wrong_tag));
	zassert_equal(snmp_ber_read_int32(&r, &i32), -EBADMSG);

	snmp_ber_reader_init(&r, null_with_content, sizeof(null_with_content));
	zassert_equal(snmp_ber_read_empty(&r, SNMP_BER_TAG_NULL), -EBADMSG);

	snmp_ber_reader_init(&r, single, sizeof(single));
	zassert_equal(snmp_ber_skip(&r), -EBADMSG);
	zassert_ok(snmp_ber_peek_tag(&r, &tag));
	zassert_equal(tag, 0x02U);

	snmp_ber_reader_init(&r, single, 0U);
	zassert_equal(snmp_ber_peek_tag(&r, &tag), -EBADMSG);
}

/* RFC 3417 section 8 (1): a sender may use more length octets than needed. */
ZTEST(snmp_ber, test_non_minimal_lengths)
{
	static const uint8_t short_as_long[] = {0x04, 0x81, 0x02, 'a', 'b'};
	static const uint8_t two_octets[] = {0x04, 0x82, 0x00, 0x02, 'a', 'b'};
	static const uint8_t five_octets[] = {0x04, 0x85, 0x00, 0x00, 0x00, 0x00, 0x02, 'a', 'b'};
	struct snmp_ber_reader r;
	const uint8_t *data;
	size_t len;

	snmp_ber_reader_init(&r, short_as_long, sizeof(short_as_long));
	zassert_ok(snmp_ber_read_octets(&r, SNMP_BER_TAG_OCTET_STRING, &data, &len));
	zassert_equal(len, 2U);

	snmp_ber_reader_init(&r, two_octets, sizeof(two_octets));
	zassert_ok(snmp_ber_read_octets(&r, SNMP_BER_TAG_OCTET_STRING, &data, &len));
	zassert_equal(len, 2U);

	snmp_ber_reader_init(&r, five_octets, sizeof(five_octets));
	zassert_ok(snmp_ber_read_octets(&r, SNMP_BER_TAG_OCTET_STRING, &data, &len));
	zassert_equal(len, 2U);
	zassert_true(snmp_ber_reader_at_end(&r));
}

/* X.690 8.3.2 forbids senders to pad integers; the decoder tolerates it as
 * long as the value still fits its type.
 */
ZTEST(snmp_ber, test_non_minimal_integers)
{
	static const uint8_t padded_pos[] = {0x02, 0x02, 0x00, 0x05};
	static const uint8_t padded_neg[] = {0x02, 0x02, 0xFF, 0xFF};
	static const uint8_t padded_wide[] = {0x02, 0x05, 0x00, 0x00, 0x00, 0x00, 0x05};
	static const uint8_t padded_min[] = {0x02, 0x05, 0xFF, 0x80, 0x00, 0x00, 0x00};
	static const uint8_t padded_u32[] = {0x41, 0x06, 0x00, 0x00, 0x00, 0x00, 0x00, 0x05};
	static const uint8_t padded_max[] = {0x41, 0x06, 0x00, 0x00, 0xFF, 0xFF, 0xFF, 0xFF};
	static const uint8_t really_wide[] = {0x02, 0x05, 0x01, 0x00, 0x00, 0x00, 0x00};
	struct snmp_ber_reader r;
	int32_t i32;
	uint32_t u32;

	snmp_ber_reader_init(&r, padded_pos, sizeof(padded_pos));
	zassert_ok(snmp_ber_read_int32(&r, &i32));
	zassert_equal(i32, 5);

	snmp_ber_reader_init(&r, padded_neg, sizeof(padded_neg));
	zassert_ok(snmp_ber_read_int32(&r, &i32));
	zassert_equal(i32, -1);

	snmp_ber_reader_init(&r, padded_wide, sizeof(padded_wide));
	zassert_ok(snmp_ber_read_int32(&r, &i32));
	zassert_equal(i32, 5);

	snmp_ber_reader_init(&r, padded_min, sizeof(padded_min));
	zassert_ok(snmp_ber_read_int32(&r, &i32));
	zassert_equal(i32, INT32_MIN);

	snmp_ber_reader_init(&r, padded_u32, sizeof(padded_u32));
	zassert_ok(snmp_ber_read_uint32(&r, SNMP_BER_TAG_COUNTER32, &u32));
	zassert_equal(u32, 5U);

	snmp_ber_reader_init(&r, padded_max, sizeof(padded_max));
	zassert_ok(snmp_ber_read_uint32(&r, SNMP_BER_TAG_COUNTER32, &u32));
	zassert_equal(u32, UINT32_MAX);

	/* Padding never lets a value exceed its type */
	snmp_ber_reader_init(&r, really_wide, sizeof(really_wide));
	zassert_equal(snmp_ber_read_int32(&r, &i32), -EBADMSG);
}

ZTEST(snmp_ber, test_sequence_and_skip)
{
	/* SEQUENCE { INTEGER 5, OCTET STRING "x" } INTEGER 7 */
	static const uint8_t msg[] = {0x30, 0x06, 0x02, 0x01, 0x05, 0x04,
				      0x01, 'x',  0x02, 0x01, 0x07};
	struct snmp_ber_reader r, inner;
	int32_t val;

	snmp_ber_reader_init(&r, msg, sizeof(msg));
	zassert_ok(snmp_ber_read_sequence(&r, SNMP_BER_TAG_SEQUENCE, &inner));
	zassert_equal(inner.len, 6U);
	zassert_ok(snmp_ber_read_int32(&inner, &val));
	zassert_equal(val, 5);
	zassert_ok(snmp_ber_skip(&inner));
	zassert_true(snmp_ber_reader_at_end(&inner));

	zassert_ok(snmp_ber_read_int32(&r, &val));
	zassert_equal(val, 7);
	zassert_true(snmp_ber_reader_at_end(&r));
}

ZTEST(snmp_ber, test_writer_full)
{
	struct snmp_ber_writer w;

	snmp_ber_writer_init(&w, buf, 3U);
	zassert_ok(snmp_ber_write_int32(&w, 1));
	zassert_equal(w.pos, 3U);
	zassert_equal(snmp_ber_sizeof_header(1U), 2U);
	zassert_equal(snmp_ber_sizeof_header(200U), 3U);
	zassert_equal(snmp_ber_sizeof_header(70000U), 5U);
	zassert_equal(snmp_ber_write_int32(&w, 1), -EMSGSIZE);
	zassert_equal(snmp_ber_write_empty(&w, SNMP_BER_TAG_NULL), -EMSGSIZE);
	zassert_equal(snmp_ber_write_header(&w, SNMP_BER_TAG_SEQUENCE, 0U), -EMSGSIZE);
	zassert_equal(w.pos, 3U, "A failed write must not advance");
}

ZTEST(snmp_ber, test_long_lengths)
{
	static uint8_t big[300];
	static uint8_t out[310];
	struct snmp_ber_writer w;
	struct snmp_ber_reader r;
	const uint8_t *data;
	size_t len;

	memset(big, 0xAB, sizeof(big));

	snmp_ber_writer_init(&w, out, sizeof(out));
	zassert_ok(snmp_ber_write_octets(&w, SNMP_BER_TAG_OCTET_STRING, big, 200U));
	zassert_equal(out[1], 0x81U);
	zassert_equal(out[2], 200U);
	zassert_equal(w.pos, 203U);

	snmp_ber_writer_init(&w, out, sizeof(out));
	zassert_ok(snmp_ber_write_octets(&w, SNMP_BER_TAG_OCTET_STRING, big, sizeof(big)));
	zassert_equal(out[1], 0x82U);
	zassert_equal(out[2], 0x01U);
	zassert_equal(out[3], 0x2CU);
	zassert_equal(w.pos, snmp_ber_sizeof_octets(sizeof(big)));

	snmp_ber_reader_init(&r, out, w.pos);
	zassert_ok(snmp_ber_read_octets(&r, SNMP_BER_TAG_OCTET_STRING, &data, &len));
	zassert_equal(len, sizeof(big));
}

ZTEST(snmp_ber, test_prepend)
{
	/* SEQUENCE { INTEGER 1, OCTET STRING "public", INTEGER 300 } */
	static const uint8_t expected[] = {0x30, 0x0F, 0x02, 0x01, 0x01, 0x04, 0x06, 'p', 'u',
					   'b',  'l',  'i',  'c',  0x02, 0x02, 0x01, 0x2C};
	size_t start = sizeof(buf);

	zassert_ok(snmp_ber_prepend_int32(buf, &start, 300));
	zassert_ok(snmp_ber_prepend_octets(buf, &start, SNMP_BER_TAG_OCTET_STRING,
					   (const uint8_t *)"public", 6U));
	zassert_ok(snmp_ber_prepend_int32(buf, &start, 1));
	zassert_ok(
		snmp_ber_prepend_header(buf, &start, SNMP_BER_TAG_SEQUENCE, sizeof(buf) - start));
	zassert_equal(sizeof(buf) - start, sizeof(expected));
	zassert_mem_equal(&buf[start], expected, sizeof(expected));

	start = 1U;
	zassert_equal(snmp_ber_prepend_int32(buf, &start, 1), -EMSGSIZE);
	zassert_equal(snmp_ber_prepend_header(buf, &start, SNMP_BER_TAG_SEQUENCE, 0U), -EMSGSIZE);
	zassert_equal(start, 1U, "A failed prepend must not move the start");
}

ZTEST_SUITE(snmp_ber, NULL, NULL, NULL, NULL, NULL);
```

## src/helpers.c
```c
/*
 * SPDX-FileCopyrightText: Copyright The Zephyr Project Contributors
 * SPDX-License-Identifier: Apache-2.0
 */

#include <string.h>

#include <zephyr/ztest.h>

#include "helpers.h"

uint8_t req_buf[512];
uint8_t rsp_buf[512];

/* Build a request by prepending, so bindings are added last to first. */
size_t build_request(int32_t version, const char *community, uint8_t pdu_type, int32_t err_status,
		     int32_t err_index, const struct req_vb *vbs, size_t count, size_t *start)
{
	size_t s = sizeof(req_buf);
	size_t end = s;

	for (size_t n = count; n > 0; n--) {
		const struct req_vb *vb = &vbs[n - 1];
		size_t vb_end = s;

		switch (vb->value.tag) {
		case 0:
			zassert_ok(
				snmp_ber_prepend_octets(req_buf, &s, SNMP_BER_TAG_NULL, NULL, 0));
			break;
		case SNMP_BER_TAG_INTEGER:
			zassert_ok(snmp_ber_prepend_int32(req_buf, &s, vb->value.i32));
			break;
		case SNMP_BER_TAG_OCTET_STRING:
			zassert_ok(snmp_ber_prepend_octets(req_buf, &s, SNMP_BER_TAG_OCTET_STRING,
							   (const uint8_t *)vb->value.str,
							   strlen(vb->value.str)));
			break;
		default:
			zassert_ok(snmp_ber_prepend_octets(req_buf, &s, vb->value.tag, NULL, 0));
			break;
		}

		{
			/* Encode the name forward into scratch, then prepend it. */
			uint8_t scratch[64];
			struct snmp_ber_writer w;

			snmp_ber_writer_init(&w, scratch, sizeof(scratch));
			zassert_ok(snmp_ber_write_oid(&w, vb->oid, vb->oid_len));
			zassert_true(s >= w.pos);
			s -= w.pos;
			memcpy(&req_buf[s], scratch, w.pos);
		}

		zassert_ok(snmp_ber_prepend_header(req_buf, &s, SNMP_BER_TAG_SEQUENCE, vb_end - s));
	}

	zassert_ok(snmp_ber_prepend_header(req_buf, &s, SNMP_BER_TAG_SEQUENCE, end - s));
	zassert_ok(snmp_ber_prepend_int32(req_buf, &s, err_index));
	zassert_ok(snmp_ber_prepend_int32(req_buf, &s, err_status));
	zassert_ok(snmp_ber_prepend_int32(req_buf, &s, REQUEST_ID));
	zassert_ok(snmp_ber_prepend_header(req_buf, &s, pdu_type, end - s));
	zassert_ok(snmp_ber_prepend_octets(req_buf, &s, SNMP_BER_TAG_OCTET_STRING,
					   (const uint8_t *)community, strlen(community)));
	zassert_ok(snmp_ber_prepend_int32(req_buf, &s, version));
	zassert_ok(snmp_ber_prepend_header(req_buf, &s, SNMP_BER_TAG_SEQUENCE, end - s));

	*start = s;

	return end - s;
}

void parse_response(const uint8_t *data, size_t len, struct response *rsp)
{
	struct snmp_ber_reader outer, msg, pdu, list;
	const uint8_t *octets;
	size_t octets_len, pdu_len;
	uint8_t tag;

	memset(rsp, 0, sizeof(*rsp));

	snmp_ber_reader_init(&outer, data, len);
	zassert_ok(snmp_ber_read_sequence(&outer, SNMP_BER_TAG_SEQUENCE, &msg));
	zassert_true(snmp_ber_reader_at_end(&outer), "Trailing bytes after message");

	zassert_ok(snmp_ber_read_int32(&msg, &rsp->version));
	zassert_ok(snmp_ber_read_octets(&msg, SNMP_BER_TAG_OCTET_STRING, &octets, &octets_len));
	zassert_true(octets_len < sizeof(rsp->community));
	memcpy(rsp->community, octets, octets_len);
	rsp->community_len = octets_len;

	zassert_ok(snmp_ber_read_header(&msg, &tag, &pdu_len));
	zassert_equal(tag, SNMP_BER_TAG_RESPONSE, "PDU type 0x%02x is not a response", tag);
	snmp_ber_reader_init(&pdu, &msg.data[msg.pos], pdu_len);
	msg.pos += pdu_len;
	zassert_true(snmp_ber_reader_at_end(&msg), "Trailing bytes after PDU");

	zassert_ok(snmp_ber_read_int32(&pdu, &rsp->request_id));
	zassert_ok(snmp_ber_read_int32(&pdu, &rsp->error_status));
	zassert_ok(snmp_ber_read_int32(&pdu, &rsp->error_index));
	zassert_ok(snmp_ber_read_sequence(&pdu, SNMP_BER_TAG_SEQUENCE, &list));
	zassert_true(snmp_ber_reader_at_end(&pdu), "Trailing bytes after bindings");

	rsp->raw_vbs = list.data;
	rsp->raw_vbs_len = list.len;

	while (!snmp_ber_reader_at_end(&list)) {
		struct snmp_ber_reader vb;
		struct rsp_vb *out;

		zassert_true(rsp->vb_count < ARRAY_SIZE(rsp->vb), "Too many bindings");
		out = &rsp->vb[rsp->vb_count++];

		zassert_ok(snmp_ber_read_sequence(&list, SNMP_BER_TAG_SEQUENCE, &vb));
		zassert_ok(snmp_ber_read_oid(&vb, out->oid, ARRAY_SIZE(out->oid), &out->oid_len));
		zassert_ok(snmp_ber_peek_tag(&vb, &out->tag));

		/* An error response echoes the request's values as they were,
		 * including ones the codec rejects; expect_echo() checks them.
		 */
		if (rsp->error_status != SNMP_ERR_NO_ERROR) {
			zassert_ok(snmp_ber_skip(&vb));
			zassert_true(snmp_ber_reader_at_end(&vb), "Trailing bytes in binding");
			continue;
		}

		switch (out->tag) {
		case SNMP_BER_TAG_INTEGER:
			zassert_ok(snmp_ber_read_int32(&vb, &out->i32));
			break;
		case SNMP_BER_TAG_OCTET_STRING:
			zassert_ok(snmp_ber_read_octets(&vb, out->tag, &octets, &octets_len));
			/* Long values are truncated; str_len keeps the real length */
			memcpy(out->str, octets, MIN(octets_len, sizeof(out->str)));
			out->str_len = octets_len;
			break;
		case SNMP_BER_TAG_GAUGE32:
		case SNMP_BER_TAG_COUNTER32:
		case SNMP_BER_TAG_TIMETICKS:
			zassert_ok(snmp_ber_read_uint32(&vb, out->tag, &out->u32));
			break;
		case SNMP_BER_TAG_COUNTER64:
			zassert_ok(snmp_ber_read_uint64(&vb, out->tag, &out->u64));
			break;
		case SNMP_BER_TAG_OID:
			zassert_ok(snmp_ber_read_oid(&vb, out->val_oid, ARRAY_SIZE(out->val_oid),
						     &out->val_oid_len));
			break;
		default:
			zassert_ok(snmp_ber_read_empty(&vb, out->tag));
			break;
		}

		zassert_true(snmp_ber_reader_at_end(&vb), "Trailing bytes in binding");
	}
}

/* Send a request through the engine and parse the reply. Returns the reply
 * length, 0 when the engine dropped the request.
 */
size_t exchange(int32_t version, const char *community, uint8_t pdu_type, int32_t err_status,
		int32_t err_index, const struct req_vb *vbs, size_t count, struct response *rsp)
{
	size_t req_start, req_len, rsp_start, rsp_len;

	req_len = build_request(version, community, pdu_type, err_status, err_index, vbs, count,
				&req_start);

	memset(rsp_buf, 0xEE, sizeof(rsp_buf));
	rsp_len = snmp_process_message(&req_buf[req_start], req_len, rsp_buf, sizeof(rsp_buf),
				       &rsp_start);
	if (rsp_len == 0) {
		return 0;
	}

	zassert_true(rsp_start + rsp_len <= sizeof(rsp_buf));
	parse_response(&rsp_buf[rsp_start], rsp_len, rsp);

	zassert_equal(rsp->version, version, "Response version %d", rsp->version);
	zassert_equal(rsp->community_len, strlen(community));
	zassert_mem_equal(rsp->community, community, rsp->community_len);
	zassert_equal(rsp->request_id, REQUEST_ID, "Request id 0x%x", rsp->request_id);

	return rsp_len;
}

void expect_oid(const struct rsp_vb *vb, const uint32_t *oid, size_t len)
{
	zassert_equal(vb->oid_len, len, "Binding has %zu arcs, expected %zu", vb->oid_len, len);
	zassert_mem_equal(vb->oid, oid, len * sizeof(uint32_t), "Wrong binding name");
}

void expect_ok(const struct response *rsp, size_t count)
{
	zassert_equal(rsp->error_status, SNMP_ERR_NO_ERROR, "Error status %d index %d",
		      rsp->error_status, rsp->error_index);
	zassert_equal(rsp->error_index, 0);
	zassert_equal(rsp->vb_count, count, "%zu bindings, expected %zu", rsp->vb_count, count);
}

void expect_error(const struct response *rsp, int32_t status, int32_t index)
{
	zassert_equal(rsp->error_status, status, "Error status %d, expected %d", rsp->error_status,
		      status);
	zassert_equal(rsp->error_index, index, "Error index %d, expected %d", rsp->error_index,
		      index);
}

/* The bindings of an error response are those of the request, byte for byte. */
void expect_echo(const struct response *rsp, const struct req_vb *vbs, size_t count)
{
	zassert_equal(rsp->vb_count, count);

	for (size_t i = 0; i < count; i++) {
		expect_oid(&rsp->vb[i], vbs[i].oid, vbs[i].oid_len);
		zassert_equal(rsp->vb[i].tag,
			      (vbs[i].value.tag == 0) ? SNMP_BER_TAG_NULL : vbs[i].value.tag);
	}
}

void get_display_string(const uint32_t *oid, size_t len, char *out, size_t size)
{
	struct req_vb vb = {oid, len, {0}};
	struct response rsp;

	zassert_true(exchange(V2C, "public", SNMP_BER_TAG_GET_REQUEST, 0, 0, &vb, 1, &rsp) > 0);
	expect_ok(&rsp, 1);
	zassert_equal(rsp.vb[0].tag, SNMP_BER_TAG_OCTET_STRING);
	zassert_true(rsp.vb[0].str_len < size);
	memcpy(out, rsp.vb[0].str, rsp.vb[0].str_len);
	out[rsp.vb[0].str_len] = '\0';
}

int32_t get_int32(const uint32_t *oid, size_t len)
{
	struct req_vb vb = {oid, len, {0}};
	struct response rsp;

	zassert_true(exchange(V2C, "public", SNMP_BER_TAG_GET_REQUEST, 0, 0, &vb, 1, &rsp) > 0);
	expect_ok(&rsp, 1);
	zassert_equal(rsp.vb[0].tag, SNMP_BER_TAG_INTEGER);

	return rsp.vb[0].i32;
}
```

## src/helpers.h
```c
/*
 * SPDX-FileCopyrightText: Copyright The Zephyr Project Contributors
 * SPDX-License-Identifier: Apache-2.0
 */

/* Building requests for and decoding responses from snmp_process_message(). */

#ifndef TESTS_NET_LIB_SNMP_SRC_HELPERS_H_
#define TESTS_NET_LIB_SNMP_SRC_HELPERS_H_

#include <stddef.h>
#include <stdint.h>

#include <zephyr/sys/util.h>

#include "snmp_ber.h"
#include "snmp_internal.h"

#define OID(...) ((const uint32_t[]){__VA_ARGS__})
#define OID_LEN(...) ARRAY_SIZE(OID(__VA_ARGS__))

#define V1  0
#define V2C 1

#define REQUEST_ID 0x12345

/* Value carried by a request binding. */
struct req_value {
	uint8_t tag; /* 0 encodes NULL */
	int32_t i32;
	const char *str;
};

struct req_vb {
	const uint32_t *oid;
	size_t oid_len;
	struct req_value value;
};

#define VB_NULL(...) {OID(__VA_ARGS__), OID_LEN(__VA_ARGS__), {0}}
#define VB_INT(_v, ...) {OID(__VA_ARGS__), OID_LEN(__VA_ARGS__), {SNMP_BER_TAG_INTEGER, _v, NULL}}
#define VB_STR(_s, ...)                                                                            \
	{OID(__VA_ARGS__), OID_LEN(__VA_ARGS__), {SNMP_BER_TAG_OCTET_STRING, 0, _s}}
#define VB_TAG(_t, ...) {OID(__VA_ARGS__), OID_LEN(__VA_ARGS__), {_t, 0, NULL}}

/* One decoded binding of a response. */
struct rsp_vb {
	uint32_t oid[SNMP_OID_MAX_LEN];
	size_t oid_len;
	uint8_t tag;
	int32_t i32;
	uint32_t u32;
	uint64_t u64;
	uint8_t str[64];
	size_t str_len;
	uint32_t val_oid[SNMP_OID_MAX_LEN];
	size_t val_oid_len;
};

struct response {
	int32_t version;
	uint8_t community[32];
	size_t community_len;
	int32_t request_id;
	int32_t error_status;
	int32_t error_index;
	struct rsp_vb vb[20];
	size_t vb_count;
	/* Raw variable binding list content for echo comparisons */
	const uint8_t *raw_vbs;
	size_t raw_vbs_len;
};

extern uint8_t req_buf[512];
extern uint8_t rsp_buf[512];

/* Build a request by prepending, so bindings are added last to first. */
size_t build_request(int32_t version, const char *community, uint8_t pdu_type,
		     int32_t err_status, int32_t err_index, const struct req_vb *vbs, size_t count,
		     size_t *start);

void parse_response(const uint8_t *data, size_t len, struct response *rsp);

/* Send a request through the engine and parse the reply. Returns the reply
 * length, 0 when the engine dropped the request.
 */
size_t exchange(int32_t version, const char *community, uint8_t pdu_type, int32_t err_status,
		int32_t err_index, const struct req_vb *vbs, size_t count, struct response *rsp);

void expect_oid(const struct rsp_vb *vb, const uint32_t *oid, size_t len);
void expect_ok(const struct response *rsp, size_t count);
void expect_error(const struct response *rsp, int32_t status, int32_t index);
/* The bindings of an error response are those of the request, byte for byte. */
void expect_echo(const struct response *rsp, const struct req_vb *vbs, size_t count);

/* GET one OCTET STRING instance into a NUL terminated buffer. */
void get_display_string(const uint32_t *oid, size_t len, char *out, size_t size);
/* GET one INTEGER instance. */
int32_t get_int32(const uint32_t *oid, size_t len);

#endif /* TESTS_NET_LIB_SNMP_SRC_HELPERS_H_ */
```

## src/mib2_snmp.c
```c
/*
 * SPDX-FileCopyrightText: Copyright The Zephyr Project Contributors
 * SPDX-License-Identifier: Apache-2.0
 */

#include <string.h>

#include <zephyr/net/snmp.h>
#include <zephyr/ztest.h>

#include "helpers.h"
#include "test_objects.h"

#define SNMP_GROUP(n) 1, 3, 6, 1, 2, 1, 11, (n)

#define IN_PKTS                SNMP_GROUP(1)
#define IN_BAD_VERSIONS        SNMP_GROUP(3)
#define IN_BAD_COMMUNITY_NAMES SNMP_GROUP(4)
#define IN_BAD_COMMUNITY_USES  SNMP_GROUP(5)
#define IN_ASN_PARSE_ERRS      SNMP_GROUP(6)
#define ENABLE_AUTHEN_TRAPS    SNMP_GROUP(30)
#define SILENT_DROPS           SNMP_GROUP(31)
#define PROXY_DROPS            SNMP_GROUP(32)
#define SET_SERIAL_NO          1, 3, 6, 1, 6, 3, 1, 1, 6, 1

struct counters {
	uint32_t in_pkts;
	uint32_t in_bad_versions;
	uint32_t in_bad_community_names;
	uint32_t in_bad_community_uses;
	uint32_t in_asn_parse_errs;
	uint32_t silent_drops;
	uint32_t proxy_drops;
};

/* One GET, which itself counts as a received message. */
static void read_counters(struct counters *c)
{
	const struct req_vb vbs[] = {
		VB_NULL(IN_PKTS, 0),
		VB_NULL(IN_BAD_VERSIONS, 0),
		VB_NULL(IN_BAD_COMMUNITY_NAMES, 0),
		VB_NULL(IN_BAD_COMMUNITY_USES, 0),
		VB_NULL(IN_ASN_PARSE_ERRS, 0),
		VB_NULL(SILENT_DROPS, 0),
		VB_NULL(PROXY_DROPS, 0),
	};
	struct response rsp;

	zassert_true(exchange(V2C, "public", SNMP_BER_TAG_GET_REQUEST, 0, 0, vbs, ARRAY_SIZE(vbs),
			      &rsp) > 0);
	expect_ok(&rsp, ARRAY_SIZE(vbs));

	for (size_t i = 0; i < ARRAY_SIZE(vbs); i++) {
		zassert_equal(rsp.vb[i].tag, SNMP_BER_TAG_COUNTER32, "Counter %zu", i);
	}

	c->in_pkts = rsp.vb[0].u32;
	c->in_bad_versions = rsp.vb[1].u32;
	c->in_bad_community_names = rsp.vb[2].u32;
	c->in_bad_community_uses = rsp.vb[3].u32;
	c->in_asn_parse_errs = rsp.vb[4].u32;
	c->silent_drops = rsp.vb[5].u32;
	c->proxy_drops = rsp.vb[6].u32;
}

static void before(void *fixture)
{
	ARG_UNUSED(fixture);

	zassert_ok(snmp_agent_set_community(SNMP_COMMUNITY_READ, "public"));
	zassert_ok(snmp_agent_set_community(SNMP_COMMUNITY_WRITE, "private"));
	snmp_mib2_snmp_set_authen_traps(true);
}

ZTEST(snmp_mib2_snmp, test_counters)
{
	const struct req_vb get_a[] = {VB_NULL(TEST_OID_A, 0)};
	const struct req_vb set_c[] = {VB_INT(1, TEST_OID_C, 0)};
	const struct req_vb carries[] = {VB_TAG(SNMP_BER_TAG_COUNTER64, TEST_OID_A, 0)};
	static const uint8_t garbage[] = {0x30, 0x03, 0x02, 0x01};
	struct counters c0, c1;
	size_t req_start, req_len, rsp_start;
	struct response rsp;

	read_counters(&c0);

	/* Two messages with an unknown community, one of them version 1 */
	zassert_equal(exchange(V2C, "wrong", SNMP_BER_TAG_GET_REQUEST, 0, 0, get_a,
			       ARRAY_SIZE(get_a), &rsp),
		      0);
	zassert_equal(exchange(V1, "wrong", SNMP_BER_TAG_GET_REQUEST, 0, 0, get_a,
			       ARRAY_SIZE(get_a), &rsp),
		      0);
	/* An unsupported version */
	zassert_equal(exchange(3, "public", SNMP_BER_TAG_GET_REQUEST, 0, 0, get_a,
			       ARRAY_SIZE(get_a), &rsp),
		      0);
	/* Undecodable, and a version 1 request carrying a Counter64 */
	zassert_equal(snmp_process_message(garbage, sizeof(garbage), rsp_buf, sizeof(rsp_buf),
					   &rsp_start),
		      0);
	zassert_equal(exchange(V1, "public", SNMP_BER_TAG_GET_REQUEST, 0, 0, carries,
			       ARRAY_SIZE(carries), &rsp),
		      0);
	/* SET with the read community, in both versions */
	zassert_true(exchange(V2C, "public", SNMP_BER_TAG_SET_REQUEST, 0, 0, set_c,
			      ARRAY_SIZE(set_c), &rsp) > 0);
	expect_error(&rsp, SNMP_ERR_AUTHORIZATION_ERROR, 0);
	zassert_true(exchange(V1, "public", SNMP_BER_TAG_SET_REQUEST, 0, 0, set_c,
			      ARRAY_SIZE(set_c), &rsp) > 0);
	expect_error(&rsp, SNMP_ERR_NO_SUCH_NAME, 0);
	/* A version 1 error response that cannot carry its bindings */
	req_len = build_request(V1, "public", SNMP_BER_TAG_GET_REQUEST, 0, 0, get_a,
				ARRAY_SIZE(get_a), &req_start);
	zassert_equal(snmp_process_message(&req_buf[req_start], req_len, rsp_buf, req_len - 1,
					   &rsp_start),
		      0);

	read_counters(&c1);

	/* Eight messages above plus the reading GET itself */
	zassert_equal(c1.in_pkts, c0.in_pkts + 9, "snmpInPkts");
	zassert_equal(c1.in_bad_community_names, c0.in_bad_community_names + 2,
		      "snmpInBadCommunityNames");
	zassert_equal(c1.in_bad_versions, c0.in_bad_versions + 1, "snmpInBadVersions");
	zassert_equal(c1.in_asn_parse_errs, c0.in_asn_parse_errs + 2, "snmpInASNParseErrs");
	zassert_equal(c1.in_bad_community_uses, c0.in_bad_community_uses + 2,
		      "snmpInBadCommunityUses");
	zassert_equal(c1.silent_drops, c0.silent_drops + 1, "snmpSilentDrops");
	zassert_equal(c1.proxy_drops, 0, "snmpProxyDrops");
}

ZTEST(snmp_mib2_snmp, test_enable_authen_traps)
{
	const struct req_vb get[] = {VB_NULL(ENABLE_AUTHEN_TRAPS, 0)};
	const struct req_vb disable[] = {VB_INT(2, ENABLE_AUTHEN_TRAPS, 0)};
	const struct req_vb bad[] = {VB_INT(3, ENABLE_AUTHEN_TRAPS, 0)};
	const struct req_vb wrong_type[] = {VB_STR("1", ENABLE_AUTHEN_TRAPS, 0)};
	struct response rsp;

	zassert_true(exchange(V2C, "public", SNMP_BER_TAG_GET_REQUEST, 0, 0, get, ARRAY_SIZE(get),
			      &rsp) > 0);
	expect_ok(&rsp, 1);
	zassert_equal(rsp.vb[0].tag, SNMP_BER_TAG_INTEGER);
	zassert_equal(rsp.vb[0].i32, 1, "enabled(1) by default");

	zassert_true(exchange(V2C, "private", SNMP_BER_TAG_SET_REQUEST, 0, 0, disable,
			      ARRAY_SIZE(disable), &rsp) > 0);
	expect_ok(&rsp, 1);
	zassert_equal(get_int32(OID(ENABLE_AUTHEN_TRAPS, 0), OID_LEN(ENABLE_AUTHEN_TRAPS, 0)), 2);

	zassert_true(exchange(V2C, "private", SNMP_BER_TAG_SET_REQUEST, 0, 0, bad, ARRAY_SIZE(bad),
			      &rsp) > 0);
	expect_error(&rsp, SNMP_ERR_WRONG_VALUE, 1);
	zassert_true(exchange(V2C, "private", SNMP_BER_TAG_SET_REQUEST, 0, 0, wrong_type,
			      ARRAY_SIZE(wrong_type), &rsp) > 0);
	expect_error(&rsp, SNMP_ERR_WRONG_TYPE, 1);
	zassert_equal(get_int32(OID(ENABLE_AUTHEN_TRAPS, 0), OID_LEN(ENABLE_AUTHEN_TRAPS, 0)), 2,
		      "Rejected SET changed the value");

	snmp_mib2_snmp_set_authen_traps(true);
	zassert_true(exchange(V2C, "public", SNMP_BER_TAG_GET_REQUEST, 0, 0, get, ARRAY_SIZE(get),
			      &rsp) > 0);
	zassert_equal(rsp.vb[0].i32, 1);
}

/* RFC 2579 TestAndIncr: only the current value may be written, and doing
 * so advances it.
 */
ZTEST(snmp_mib2_snmp, test_set_serial_no)
{
	const struct req_vb get[] = {VB_NULL(SET_SERIAL_NO, 0)};
	struct response rsp;
	int32_t serial;

	zassert_true(exchange(V2C, "public", SNMP_BER_TAG_GET_REQUEST, 0, 0, get, ARRAY_SIZE(get),
			      &rsp) > 0);
	expect_ok(&rsp, 1);
	zassert_equal(rsp.vb[0].tag, SNMP_BER_TAG_INTEGER);
	serial = rsp.vb[0].i32;
	/* RFC 2579: pseudo-random after a start, so within the TestAndIncr
	 * range; a fixed zero would let a request from before a restart pass.
	 */
	zassert_true(serial >= 0, "Initial value %d out of range", serial);
	zassert_true(serial != 0, "Initial value is not random");

	{
		const struct req_vb stale[] = {VB_INT(serial + 1, SET_SERIAL_NO, 0)};
		const struct req_vb negative[] = {VB_INT(-1, SET_SERIAL_NO, 0)};
		const struct req_vb current[] = {VB_INT(serial, SET_SERIAL_NO, 0)};
		/* The lock and a payload in one request, as managers use it */
		const struct req_vb locked[] = {VB_INT(serial + 1, SET_SERIAL_NO, 0),
						VB_INT(7, TEST_OID_C, 0)};

		zassert_true(exchange(V2C, "private", SNMP_BER_TAG_SET_REQUEST, 0, 0, stale,
				      ARRAY_SIZE(stale), &rsp) > 0);
		expect_error(&rsp, SNMP_ERR_INCONSISTENT_VALUE, 1);
		zassert_true(exchange(V1, "private", SNMP_BER_TAG_SET_REQUEST, 0, 0, stale,
				      ARRAY_SIZE(stale), &rsp) > 0);
		expect_error(&rsp, SNMP_ERR_BAD_VALUE, 1);

		zassert_true(exchange(V2C, "private", SNMP_BER_TAG_SET_REQUEST, 0, 0, negative,
				      ARRAY_SIZE(negative), &rsp) > 0);
		expect_error(&rsp, SNMP_ERR_WRONG_VALUE, 1);

		zassert_true(exchange(V2C, "private", SNMP_BER_TAG_SET_REQUEST, 0, 0, current,
				      ARRAY_SIZE(current), &rsp) > 0);
		expect_ok(&rsp, 1);

		zassert_true(exchange(V2C, "public", SNMP_BER_TAG_GET_REQUEST, 0, 0, get,
				      ARRAY_SIZE(get), &rsp) > 0);
		zassert_equal(rsp.vb[0].i32, serial + 1, "The value advances on a successful SET");

		zassert_true(exchange(V2C, "private", SNMP_BER_TAG_SET_REQUEST, 0, 0, locked,
				      ARRAY_SIZE(locked), &rsp) > 0);
		expect_ok(&rsp, 2);
		zassert_equal(test_c_value(), 7);
		test_c_reset();

		/* Replaying the same request fails without touching the payload */
		zassert_true(exchange(V2C, "private", SNMP_BER_TAG_SET_REQUEST, 0, 0, locked,
				      ARRAY_SIZE(locked), &rsp) > 0);
		expect_error(&rsp, SNMP_ERR_INCONSISTENT_VALUE, 1);
		zassert_equal(test_c_value(), 42);
	}
}

ZTEST_SUITE(snmp_mib2_snmp, NULL, NULL, before, NULL, NULL);
```

## src/registry.c
```c
/*
 * SPDX-FileCopyrightText: Copyright The Zephyr Project Contributors
 * SPDX-License-Identifier: Apache-2.0
 */

#include <string.h>

#include <zephyr/ztest.h>

#include "snmp_internal.h"
#include "test_objects.h"

#define OID(...)     ((const uint32_t[]){__VA_ARGS__})
#define OID_LEN(...) ARRAY_SIZE(OID(__VA_ARGS__))

static void expect_next(const uint32_t *target, size_t target_len, const uint32_t *expected,
			size_t expected_len, void *expected_row)
{
	const struct snmp_object *obj;
	uint32_t inst[SNMP_OID_MAX_LEN];
	size_t inst_len = 0;
	void *row = NULL;

	obj = snmp_registry_next(target, target_len, inst, &inst_len, &row);
	zassert_not_null(obj, "No next instance");
	zassert_equal(inst_len, expected_len, "Next has %zu arcs, expected %zu", inst_len,
		      expected_len);
	zassert_mem_equal(inst, expected, expected_len * sizeof(uint32_t), "Wrong next instance");
	zassert_equal_ptr(row, expected_row, "Wrong row handle");
}

ZTEST(snmp_registry, test_oid_cmp)
{
	zassert_equal(snmp_oid_cmp(OID(1, 3), 2, OID(1, 3), 2), 0);
	zassert_true(snmp_oid_cmp(OID(1, 3), 2, OID(1, 3, 0), 3) < 0, "Prefix sorts first");
	zassert_true(snmp_oid_cmp(OID(1, 3, 0), 3, OID(1, 3), 2) > 0);
	zassert_true(snmp_oid_cmp(OID(1, 2, 9), 3, OID(1, 3), 2) < 0);
	zassert_true(snmp_oid_cmp(OID(1, 3, 10), 3, OID(1, 3, 9), 3) > 0, "Numeric, not string");
	zassert_equal(snmp_oid_cmp(NULL, 0, NULL, 0), 0);
	zassert_true(snmp_oid_cmp(NULL, 0, OID(0), 1) < 0);

	zassert_true(snmp_oid_has_prefix(OID(1, 3, 6), 3, OID(1, 3), 2));
	zassert_true(snmp_oid_has_prefix(OID(1, 3), 2, OID(1, 3), 2));
	zassert_false(snmp_oid_has_prefix(OID(1, 3), 2, OID(1, 3, 6), 3));
	zassert_false(snmp_oid_has_prefix(OID(1, 4, 6), 3, OID(1, 3), 2));
	zassert_true(snmp_oid_has_prefix(OID(1, 3), 2, NULL, 0));
}

ZTEST(snmp_registry, test_lookup)
{
	const struct snmp_object *obj = NULL;
	void *row = (void *)1;

	zassert_equal(snmp_registry_lookup(OID(TEST_OID_A, 0), OID_LEN(TEST_OID_A, 0), &obj, &row),
		      SNMP_LOOKUP_FOUND);
	zassert_not_null(obj);
	zassert_is_null(row, "Scalars have no row");
	zassert_equal(obj->oid_len, OID_LEN(TEST_OID_A));

	zassert_equal(snmp_registry_lookup(OID(TEST_OID_A), OID_LEN(TEST_OID_A), &obj, &row),
		      SNMP_LOOKUP_NO_SUCH_INSTANCE, "Object without instance suffix");
	zassert_not_null(obj, "The matching object is reported for a missing instance");
	zassert_equal(obj->oid_len, OID_LEN(TEST_OID_A));
	zassert_equal(snmp_registry_lookup(OID(TEST_OID_A, 1), OID_LEN(TEST_OID_A, 1), &obj, &row),
		      SNMP_LOOKUP_NO_SUCH_INSTANCE);
	zassert_equal(
		snmp_registry_lookup(OID(TEST_OID_A, 0, 0), OID_LEN(TEST_OID_A, 0, 0), &obj, &row),
		SNMP_LOOKUP_NO_SUCH_INSTANCE);

	zassert_equal(
		snmp_registry_lookup(OID(TEST_BASE, 9, 0), OID_LEN(TEST_BASE, 9, 0), &obj, &row),
		SNMP_LOOKUP_NO_SUCH_OBJECT);
	zassert_is_null(obj, "No object is reported when none matches");
	zassert_equal(snmp_registry_lookup(OID(TEST_BASE), OID_LEN(TEST_BASE), &obj, &row),
		      SNMP_LOOKUP_NO_SUCH_OBJECT, "Prefix of objects is not an object");

	zassert_equal(snmp_registry_lookup(OID(TEST_OID_T_COL1, 5), OID_LEN(TEST_OID_T_COL1, 5),
					   &obj, &row),
		      SNMP_LOOKUP_FOUND);
	zassert_equal_ptr(row, &test_t.rows[0]);
	zassert_equal_ptr(obj->table, &test_t.table);

	zassert_equal(snmp_registry_lookup(OID(TEST_OID_T_COL1, 6), OID_LEN(TEST_OID_T_COL1, 6),
					   &obj, &row),
		      SNMP_LOOKUP_NO_SUCH_INSTANCE);
	zassert_equal_ptr(obj->table, &test_t.table, "Column reported for a missing row");
	zassert_equal(
		snmp_registry_lookup(OID(TEST_OID_T_COL1), OID_LEN(TEST_OID_T_COL1), &obj, &row),
		SNMP_LOOKUP_NO_SUCH_INSTANCE, "Column without index");
	zassert_equal(snmp_registry_lookup(OID(TEST_OID_T_COL1, 5, 0),
					   OID_LEN(TEST_OID_T_COL1, 5, 0), &obj, &row),
		      SNMP_LOOKUP_NO_SUCH_INSTANCE, "Index with extra arc");

	zassert_equal(snmp_registry_lookup(OID(TEST_OID_U_COL1, 1, 9),
					   OID_LEN(TEST_OID_U_COL1, 1, 9), &obj, &row),
		      SNMP_LOOKUP_FOUND);
	zassert_equal_ptr(row, &test_u.rows[2]);
	zassert_equal(snmp_registry_lookup(OID(TEST_OID_U_COL1, 1), OID_LEN(TEST_OID_U_COL1, 1),
					   &obj, &row),
		      SNMP_LOOKUP_NO_SUCH_INSTANCE, "Partial two-arc index");
}

ZTEST(snmp_registry, test_next_walk)
{
	/* Expected walk over the test subtree in lexicographic order. */
	struct {
		const uint32_t *oid;
		size_t len;
		void *row;
	} expected[] = {
		{OID(TEST_OID_A, 0), OID_LEN(TEST_OID_A, 0), NULL},
		{OID(TEST_OID_B, 0), OID_LEN(TEST_OID_B, 0), NULL},
		{OID(TEST_OID_T_COL1, 2), OID_LEN(TEST_OID_T_COL1, 2), &test_t.rows[1]},
		{OID(TEST_OID_T_COL1, 5), OID_LEN(TEST_OID_T_COL1, 5), &test_t.rows[0]},
		{OID(TEST_OID_T_COL1, 10), OID_LEN(TEST_OID_T_COL1, 10), &test_t.rows[2]},
		{OID(TEST_OID_T_COL2, 2), OID_LEN(TEST_OID_T_COL2, 2), &test_t.rows[1]},
		{OID(TEST_OID_T_COL2, 5), OID_LEN(TEST_OID_T_COL2, 5), &test_t.rows[0]},
		{OID(TEST_OID_T_COL2, 10), OID_LEN(TEST_OID_T_COL2, 10), &test_t.rows[2]},
		{OID(TEST_OID_U_COL1, 1, 9), OID_LEN(TEST_OID_U_COL1, 1, 9), &test_u.rows[2]},
		{OID(TEST_OID_U_COL1, 1, 10), OID_LEN(TEST_OID_U_COL1, 1, 10), &test_u.rows[0]},
		{OID(TEST_OID_U_COL1, 2, 0), OID_LEN(TEST_OID_U_COL1, 2, 0), &test_u.rows[1]},
		{OID(TEST_OID_D, 0), OID_LEN(TEST_OID_D, 0), NULL},
		{OID(TEST_OID_E, 0), OID_LEN(TEST_OID_E, 0), NULL},
		{OID(TEST_OID_C, 0), OID_LEN(TEST_OID_C, 0), NULL},
	};
	const struct snmp_object *obj;
	uint32_t inst[SNMP_OID_MAX_LEN];
	size_t inst_len = OID_LEN(TEST_BASE);
	void *row;

	memcpy(inst, OID(TEST_BASE), inst_len * sizeof(uint32_t));

	for (size_t i = 0; i < ARRAY_SIZE(expected); i++) {
		uint32_t target[SNMP_OID_MAX_LEN];
		size_t target_len = inst_len;

		memcpy(target, inst, inst_len * sizeof(uint32_t));
		expect_next(target, target_len, expected[i].oid, expected[i].len, expected[i].row);

		obj = snmp_registry_next(target, target_len, inst, &inst_len, &row);
		zassert_not_null(obj);
	}

	uint32_t last[SNMP_OID_MAX_LEN];
	size_t last_len = inst_len;

	memcpy(last, inst, inst_len * sizeof(uint32_t));
	obj = snmp_registry_next(last, last_len, inst, &inst_len, &row);
	zassert_is_null(obj, "Walk must end after the last test object");
}

ZTEST(snmp_registry, test_next_from_arbitrary_points)
{
	const struct snmp_object *obj;
	uint32_t inst[SNMP_OID_MAX_LEN];
	size_t inst_len;
	void *row;

	/* Between two rows of the same column */
	expect_next(OID(TEST_OID_T_COL1, 6), OID_LEN(TEST_OID_T_COL1, 6), OID(TEST_OID_T_COL1, 10),
		    OID_LEN(TEST_OID_T_COL1, 10), &test_t.rows[2]);

	/* Past the last row of column 1 moves on to column 2 */
	expect_next(OID(TEST_OID_T_COL1, 11), OID_LEN(TEST_OID_T_COL1, 11), OID(TEST_OID_T_COL2, 2),
		    OID_LEN(TEST_OID_T_COL2, 2), &test_t.rows[1]);

	/* A prefix of the table gives its first instance */
	expect_next(OID(TEST_BASE, 3), OID_LEN(TEST_BASE, 3), OID(TEST_OID_T_COL1, 2),
		    OID_LEN(TEST_OID_T_COL1, 2), &test_t.rows[1]);

	/* Two-arc index ordering is lexicographic, not by first arc only */
	expect_next(OID(TEST_OID_U_COL1, 1, 9, 5), OID_LEN(TEST_OID_U_COL1, 1, 9, 5),
		    OID(TEST_OID_U_COL1, 1, 10), OID_LEN(TEST_OID_U_COL1, 1, 10), &test_u.rows[0]);
	expect_next(OID(TEST_OID_U_COL1, 1), OID_LEN(TEST_OID_U_COL1, 1),
		    OID(TEST_OID_U_COL1, 1, 9), OID_LEN(TEST_OID_U_COL1, 1, 9), &test_u.rows[2]);

	/* The scalar instance itself is not greater than itself */
	expect_next(OID(TEST_OID_A, 0), OID_LEN(TEST_OID_A, 0), OID(TEST_OID_B, 0),
		    OID_LEN(TEST_OID_B, 0), NULL);
	expect_next(OID(TEST_OID_A, 0, 0), OID_LEN(TEST_OID_A, 0, 0), OID(TEST_OID_B, 0),
		    OID_LEN(TEST_OID_B, 0), NULL);

	/* Past the last object: end of MIB view */
	obj = snmp_registry_next(OID(TEST_OID_C, 0), OID_LEN(TEST_OID_C, 0), inst, &inst_len, &row);
	zassert_is_null(obj);
	obj = snmp_registry_next(OID(TEST_OID_C, 1), OID_LEN(TEST_OID_C, 1), inst, &inst_len, &row);
	zassert_is_null(obj);
	obj = snmp_registry_next(OID(TEST_BASE, 6), OID_LEN(TEST_BASE, 6), inst, &inst_len, &row);
	zassert_is_null(obj);
}

ZTEST_SUITE(snmp_registry, NULL, NULL, NULL, NULL, NULL);
```

## src/test_objects.h
```c
/*
 * SPDX-FileCopyrightText: Copyright The Zephyr Project Contributors
 * SPDX-License-Identifier: Apache-2.0
 */

#ifndef TESTS_NET_LIB_SNMP_SRC_TEST_OBJECTS_H_
#define TESTS_NET_LIB_SNMP_SRC_TEST_OBJECTS_H_

#include <stddef.h>
#include <stdint.h>

#include <zephyr/net/snmp.h>

/* Everything the tests register lives under an unassigned arc that sorts
 * after every standard object, so that walks end in the test subtree.
 */
#define TEST_BASE 1, 3, 6, 1, 7, 1

/* Scalars: a INTEGER, b OCTET STRING, c writable INTEGER */
#define TEST_OID_A TEST_BASE, 1
#define TEST_OID_B TEST_BASE, 2
#define TEST_OID_C TEST_BASE, 5

/* Table t: single-arc index, columns 1 and 2 */
#define TEST_OID_T_ENTRY TEST_BASE, 3, 1
#define TEST_OID_T_COL1  TEST_OID_T_ENTRY, 1
#define TEST_OID_T_COL2  TEST_OID_T_ENTRY, 2

/* Table u: two-arc index, column 1 */
#define TEST_OID_U_ENTRY TEST_BASE, 4, 1
#define TEST_OID_U_COL1  TEST_OID_U_ENTRY, 1

/* Writable scalars after table u: d with a range check, e whose commit can fail */
#define TEST_OID_D TEST_BASE, 4, 2
#define TEST_OID_E TEST_BASE, 4, 3

/* Value of e that passes the check but fails the commit */
#define TEST_E_COMMIT_FAILS 13

/* An AGENT-CAPABILITIES statement the tests list in sysORTable */
#define TEST_CAPABILITY_OID   1, 3, 6, 1, 4, 1, 99999, 2, 1
#define TEST_CAPABILITY_DESCR "Test agent capabilities"

struct test_row {
	uint32_t idx[2];
	size_t idx_len;
	int32_t value;
};

struct test_table {
	struct snmp_table table;
	struct test_row *rows;
	size_t count;
};

extern struct test_table test_t;
extern struct test_table test_u;

/* Current values of the writable scalars, changed by SET */
int32_t test_c_value(void);
int32_t test_d_value(void);
int32_t test_e_value(void);

/* How the getters of c and e behave */
enum test_get_mode {
	TEST_GET_OK,
	TEST_GET_ENOENT,
	TEST_GET_EIO,
};

void test_set_get_mode(enum test_get_mode mode);

/* Restore the writable values and the getter mode */
void test_c_reset(void);

#endif /* TESTS_NET_LIB_SNMP_SRC_TEST_OBJECTS_H_ */
```
