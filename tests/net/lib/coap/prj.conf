## CMakeLists.txt
```
# SPDX-License-Identifier: Apache-2.0

cmake_minimum_required(VERSION 3.28.0)
find_package(Zephyr REQUIRED HINTS $ENV{ZEPHYR_BASE})
project(coap)

FILE(GLOB app_sources src/*.c)
target_sources(app PRIVATE ${app_sources})
target_include_directories(app PRIVATE ${ZEPHYR_BASE}/subsys/net/ip)
```

## prj.conf
```kconfig
#Testing
CONFIG_TEST=y
CONFIG_ZTEST=y
CONFIG_NET_TEST=y

# Generic networking options
CONFIG_NETWORKING=y

# CoAP Over Sockets
CONFIG_COAP=y
CONFIG_COAP_WELL_KNOWN_BLOCK_WISE=n
CONFIG_COAP_TEST_API_ENABLE=y
CONFIG_COAP_OVER_RELIABLE_TRANSPORT=y

# Kernel options
CONFIG_ENTROPY_GENERATOR=y
CONFIG_TEST_RANDOM_GENERATOR=y

# Logging
CONFIG_NET_LOG=y
CONFIG_COAP_LOG_LEVEL_DBG=y

CONFIG_ZTEST_STACK_SIZE=2048
```

## prj_edhoc.conf
```kconfig
#Testing
CONFIG_TEST=y
CONFIG_ZTEST=y
CONFIG_NET_TEST=y

# Generic networking options
CONFIG_NETWORKING=y

# CoAP Over Sockets
CONFIG_COAP=y
CONFIG_COAP_WELL_KNOWN_BLOCK_WISE=n
CONFIG_COAP_TEST_API_ENABLE=y
CONFIG_COAP_EXTENDED_OPTIONS_LEN=y
CONFIG_COAP_EXTENDED_OPTIONS_LEN_VALUE=32

# CoAP Server
CONFIG_COAP_SERVER=y
CONFIG_COAP_SERVER_WELL_KNOWN_CORE=y

# CoAP Client
CONFIG_COAP_CLIENT=y

# CoAP Server Echo support
CONFIG_COAP_SERVER_ECHO=y
CONFIG_COAP_SERVER_ECHO_MAX_LEN=8
CONFIG_COAP_SERVER_ECHO_LIFETIME_MS=60000
CONFIG_COAP_SERVER_ECHO_CACHE_SIZE=4
CONFIG_COAP_SERVER_ECHO_REQUIRE_FOR_UNSAFE=y
CONFIG_COAP_SERVER_ECHO_AMPLIFICATION_MITIGATION=y
CONFIG_COAP_SERVER_ECHO_AMPLIFICATION_FACTOR=3
CONFIG_COAP_SERVER_ECHO_MAX_INITIAL_RESPONSE_BYTES=136

# Kernel options
CONFIG_ENTROPY_GENERATOR=y
CONFIG_TEST_RANDOM_GENERATOR=y

# Logging
CONFIG_NET_LOG=y
CONFIG_COAP_LOG_LEVEL_DBG=y

CONFIG_ZTEST_STACK_SIZE=2048

# Additional requirements for server
CONFIG_ZVFS=y
CONFIG_ZVFS_EVENTFD=y
CONFIG_ZVFS_POLL_MAX=4

# OSCORE support
CONFIG_COAP_OSCORE=y
CONFIG_UOSCORE=y
CONFIG_ZCBOR=y
CONFIG_ZCBOR_CANONICAL=y
CONFIG_COAP_OSCORE_EXCHANGE_CACHE_SIZE=4
CONFIG_COAP_OSCORE_EXCHANGE_LIFETIME_MS=60000

# EDHOC support
# Note: Full EDHOC support requires UEDHOC which has complex mbedtls dependencies.
# For now, we test the basic EDHOC option and parsing functionality without UEDHOC.
CONFIG_COAP_EDHOC=y
# CONFIG_UEDHOC=y  # Disabled due to mbedtls X.509 dependencies
CONFIG_COAP_EDHOC_COMBINED_REQUEST=y
CONFIG_COAP_EDHOC_MAX_COMBINED_PAYLOAD_LEN=1024
CONFIG_COAP_EDHOC_SESSION_CACHE_SIZE=4
CONFIG_COAP_EDHOC_SESSION_LIFETIME_MS=60000
CONFIG_COAP_OSCORE_CTX_CACHE_SIZE=4
CONFIG_COAP_OSCORE_CTX_LIFETIME_MS=3600000

# EDHOC over CoAP transport (RFC 9528 Appendix A.2)
CONFIG_COAP_SERVER_WELL_KNOWN_EDHOC=y

# Q-Block support
CONFIG_COAP_Q_BLOCK=y
```

## prj_no_oscore.conf
```kconfig
#Testing
CONFIG_TEST=y
CONFIG_ZTEST=y
CONFIG_NET_TEST=y

# Generic networking options
CONFIG_NETWORKING=y

# CoAP Over Sockets
CONFIG_COAP=y
CONFIG_COAP_WELL_KNOWN_BLOCK_WISE=n
CONFIG_COAP_TEST_API_ENABLE=y
CONFIG_COAP_EXTENDED_OPTIONS_LEN=y
CONFIG_COAP_EXTENDED_OPTIONS_LEN_VALUE=32

# CoAP Server
CONFIG_COAP_SERVER=y
CONFIG_COAP_SERVER_WELL_KNOWN_CORE=y

# CoAP Client
CONFIG_COAP_CLIENT=y

# CoAP Server Echo support
CONFIG_COAP_SERVER_ECHO=y
CONFIG_COAP_SERVER_ECHO_MAX_LEN=8
CONFIG_COAP_SERVER_ECHO_LIFETIME_MS=60000
CONFIG_COAP_SERVER_ECHO_CACHE_SIZE=4
CONFIG_COAP_SERVER_ECHO_REQUIRE_FOR_UNSAFE=y
CONFIG_COAP_SERVER_ECHO_AMPLIFICATION_MITIGATION=y
CONFIG_COAP_SERVER_ECHO_AMPLIFICATION_FACTOR=3
CONFIG_COAP_SERVER_ECHO_MAX_INITIAL_RESPONSE_BYTES=136

# Kernel options
CONFIG_ENTROPY_GENERATOR=y
CONFIG_TEST_RANDOM_GENERATOR=y

# Logging
CONFIG_NET_LOG=y
CONFIG_COAP_LOG_LEVEL_DBG=y

CONFIG_ZTEST_STACK_SIZE=2048

# Additional requirements for server
CONFIG_ZVFS=y
CONFIG_ZVFS_EVENTFD=y
CONFIG_ZVFS_POLL_MAX=4

# OSCORE support - DISABLED for this test configuration
CONFIG_COAP_OSCORE=n
CONFIG_UOSCORE=n

# ZCBOR for Q-Block support
CONFIG_ZCBOR=y
CONFIG_ZCBOR_CANONICAL=y

# Q-Block support
CONFIG_COAP_Q_BLOCK=y
```

## src/test_basic_pdu.c
```c
/*
 * Copyright (c) 2018 Intel Corporation
 *
 * SPDX-License-Identifier: Apache-2.0
 */

#include <zephyr/logging/log.h>
LOG_MODULE_DECLARE(net_test, LOG_LEVEL_DBG);

#include "test_common.h"


ZTEST(coap, test_build_empty_pdu)
{
	uint8_t result_pdu[] = { 0x40, 0x01, 0x0, 0x0 };
	struct coap_packet cpkt;
	uint8_t *data = data_buf[0];
	int r;

	r = coap_packet_init(&cpkt, data, COAP_BUF_SIZE,
			     COAP_VERSION_1, COAP_TYPE_CON, 0, NULL,
			     COAP_METHOD_GET, 0);

	zassert_equal(r, 0, "Could not initialize packet");
	zassert_equal(cpkt.offset, sizeof(result_pdu),
		     "Different size from the reference packet");
	zassert_equal(cpkt.hdr_len, COAP_FIXED_HEADER_SIZE,
		      "Invalid header length");
	zassert_equal(cpkt.opt_len, 0, "Invalid options length");
	zassert_mem_equal(result_pdu, cpkt.data, cpkt.offset,
			  "Built packet doesn't match reference packet");
}

ZTEST(coap, test_build_simple_pdu)
{
	uint8_t result_pdu[] = { 0x55, 0xA5, 0x12, 0x34, 't', 'o', 'k', 'e',
				 'n', 0xC0, 0xFF, 'p', 'a', 'y', 'l',
				 'o', 'a', 'd', 0x00 };
	struct coap_packet cpkt;
	const char token[] = "token";
	static const char payload[] = "payload";
	uint8_t *data = data_buf[0];
	const uint8_t *payload_start;
	uint16_t payload_len;
	int r;

	r = coap_packet_init(&cpkt, data, COAP_BUF_SIZE,
			     COAP_VERSION_1, COAP_TYPE_NON_CON,
			     strlen(token), token,
			     COAP_RESPONSE_CODE_PROXYING_NOT_SUPPORTED,
			     0x1234);
	zassert_equal(r, 0, "Could not initialize packet");

	r = coap_append_option_int(&cpkt, COAP_OPTION_CONTENT_FORMAT,
				   COAP_CONTENT_FORMAT_TEXT_PLAIN);
	zassert_equal(r, 0, "Could not append option");

	r = coap_packet_append_payload_marker(&cpkt);
	zassert_equal(r, 0, "Failed to set the payload marker");

	r = coap_packet_append_payload(&cpkt, payload, sizeof(payload));
	zassert_equal(r, 0, "Failed to set the payload");

	zassert_equal(cpkt.offset, sizeof(result_pdu),
		     "Different size from the reference packet");
	zassert_equal(cpkt.hdr_len, COAP_FIXED_HEADER_SIZE + strlen(token),
		      "Invalid header length");
	zassert_equal(cpkt.opt_len, 1, "Invalid options length");
	zassert_mem_equal(result_pdu, cpkt.data, cpkt.offset,
			  "Built packet doesn't match reference packet");

	payload_start = coap_packet_get_payload(&cpkt, &payload_len);

	zassert_equal(payload_len, sizeof(payload), "Invalid payload length");
	zassert_equal_ptr(payload_start, cpkt.data + cpkt.offset - payload_len,
			  "Invalid payload pointer");
}

/* No options, No payload */
ZTEST(coap, test_parse_empty_pdu)
{
	uint8_t pdu[] = { 0x40, 0x01, 0, 0 };
	struct coap_packet cpkt;
	uint8_t *data = data_buf[0];
	uint8_t ver;
	uint8_t type;
	uint8_t code;
	uint16_t id;
	int r;

	memcpy(data, pdu, sizeof(pdu));

	r = coap_packet_parse(&cpkt, data, sizeof(pdu), NULL, 0);
	zassert_equal(r, 0, "Could not parse packet");

	zassert_equal(cpkt.offset, sizeof(pdu),
		     "Different size from the reference packet");
	zassert_equal(cpkt.hdr_len, COAP_FIXED_HEADER_SIZE,
		      "Invalid header length");
	zassert_equal(cpkt.opt_len, 0, "Invalid options length");

	ver = coap_header_get_version(&cpkt);
	type = coap_header_get_type(&cpkt);
	code = coap_header_get_code(&cpkt);
	id = coap_header_get_id(&cpkt);

	zassert_equal(ver, 1U, "Invalid version for parsed packet");
	zassert_equal(type, COAP_TYPE_CON,
		      "Packet type doesn't match reference");
	zassert_equal(code, COAP_METHOD_GET,
		      "Packet code doesn't match reference");
	zassert_equal(id, 0U, "Packet id doesn't match reference");
}

/* 1 option, No payload (No payload marker) */
ZTEST(coap, test_parse_empty_pdu_1)
{
	uint8_t pdu[] = { 0x40, 0x01, 0, 0, 0x40};
	struct coap_packet cpkt;
	uint8_t *data = data_buf[0];
	uint8_t ver;
	uint8_t type;
	uint8_t code;
	uint16_t id;
	int r;

	memcpy(data, pdu, sizeof(pdu));

	r = coap_packet_parse(&cpkt, data, sizeof(pdu), NULL, 0);
	zassert_equal(r, 0, "Could not parse packet");

	zassert_equal(cpkt.offset, sizeof(pdu),
		     "Different size from the reference packet");
	zassert_equal(cpkt.hdr_len, COAP_FIXED_HEADER_SIZE,
		      "Invalid header length");
	zassert_equal(cpkt.opt_len, 1, "Invalid options length");

	ver = coap_header_get_version(&cpkt);
	type = coap_header_get_type(&cpkt);
	code = coap_header_get_code(&cpkt);
	id = coap_header_get_id(&cpkt);

	zassert_equal(ver, 1U, "Invalid version for parsed packet");
	zassert_equal(type, COAP_TYPE_CON,
		      "Packet type doesn't match reference");
	zassert_equal(code, COAP_METHOD_GET,
		      "Packet code doesn't match reference");
	zassert_equal(id, 0U, "Packet id doesn't match reference");
}

ZTEST(coap, test_parse_simple_pdu)
{
	uint8_t pdu[] = { 0x55, 0xA5, 0x12, 0x34, 't', 'o', 'k', 'e', 'n',
		       0x00, 0xc1, 0x00, 0xff, 'p', 'a', 'y', 'l', 'o',
		       'a', 'd', 0x00 };
	struct coap_packet cpkt;
	struct coap_option options[16] = {};
	const uint8_t token[8];
	const uint8_t payload[] = "payload";
	uint8_t *data = data_buf[0];
	uint8_t ver;
	uint8_t type;
	uint8_t code;
	uint8_t tkl;
	uint16_t id;
	const uint8_t *payload_start;
	uint16_t payload_len;
	int r, count = ARRAY_SIZE(options) - 1;

	memcpy(data, pdu, sizeof(pdu));

	r = coap_packet_parse(&cpkt, data, sizeof(pdu), NULL, 0);
	zassert_equal(r, 0, "Could not parse packet");

	zassert_equal(cpkt.offset, sizeof(pdu),
		     "Different size from the reference packet");
	zassert_equal(cpkt.hdr_len, COAP_FIXED_HEADER_SIZE + strlen("token"),
		      "Invalid header length");
	zassert_equal(cpkt.opt_len, 3, "Invalid options length");

	payload_start = coap_packet_get_payload(&cpkt, &payload_len);

	zassert_equal(payload_len, sizeof(payload), "Invalid payload length");
	zassert_equal_ptr(payload_start, cpkt.data + cpkt.offset - payload_len,
			  "Invalid payload pointer");

	ver = coap_header_get_version(&cpkt);
	type = coap_header_get_type(&cpkt);
	code = coap_header_get_code(&cpkt);
	id = coap_header_get_id(&cpkt);

	zassert_equal(ver, 1U, "Invalid version for parsed packet");
	zassert_equal(type, COAP_TYPE_NON_CON,
		      "Packet type doesn't match reference");
	zassert_equal(code, COAP_RESPONSE_CODE_PROXYING_NOT_SUPPORTED,
		      "Packet code doesn't match reference");
	zassert_equal(id, 0x1234, "Packet id doesn't match reference");

	tkl = coap_header_get_token(&cpkt, (uint8_t *)token);

	zassert_equal(tkl, 5U, "Token length doesn't match reference");
	zassert_mem_equal(token, "token", tkl,
			  "Token value doesn't match the reference");

	count = coap_find_options(&cpkt, COAP_OPTION_CONTENT_FORMAT,
				   options, count);

	zassert_equal(count, 1, "Unexpected number of options in the packet");
	zassert_equal(options[0].len, 1U,
		     "Option length doesn't match the reference");
	zassert_equal(((uint8_t *)options[0].value)[0],
		      COAP_CONTENT_FORMAT_TEXT_PLAIN,
		      "Option value doesn't match the reference");

	/* Not existent */
	count = coap_find_options(&cpkt, COAP_OPTION_ETAG, options, count);

	zassert_equal(count, 0,
		      "There shouldn't be any ETAG option in the packet");
}

ZTEST(coap, test_parse_malformed_pkt)
{
	uint8_t opt[] = { 0x55, 0xA5, 0x12 };

	struct coap_packet cpkt;
	uint8_t *data = data_buf[0];
	int r;

	r = coap_packet_parse(&cpkt, NULL, sizeof(opt), NULL, 0);
	zassert_equal(r, -EINVAL, "Should've failed to parse a packet");

	r = coap_packet_parse(&cpkt, data, 0, NULL, 0);
	zassert_equal(r, -EINVAL, "Should've failed to parse a packet");

	memcpy(data, opt, sizeof(opt));
	r = coap_packet_parse(&cpkt, data, sizeof(opt), NULL, 0);
	zassert_equal(r, -EINVAL, "Should've failed to parse a packet");
}

ZTEST(coap, test_parse_malformed_coap_hdr)
{
	uint8_t opt[] = { 0x55, 0x24, 0x49, 0x55, 0xff, 0x66, 0x77, 0x99};

	struct coap_packet cpkt;
	uint8_t *data = data_buf[0];
	int r;

	memcpy(data, opt, sizeof(opt));
	r = coap_packet_parse(&cpkt, data, sizeof(opt), NULL, 0);
	zassert_equal(r, -EBADMSG, "Should've failed to parse a packet");
}

ZTEST(coap, test_parse_malformed_opt)
{
	uint8_t opt[] = { 0x55, 0xA5, 0x12, 0x34, 't', 'o', 'k', 'e', 'n',
		       0xD0 };
	struct coap_packet cpkt;
	uint8_t *data = data_buf[0];
	int r;

	memcpy(data, opt, sizeof(opt));

	r = coap_packet_parse(&cpkt, data, sizeof(opt), NULL, 0);
	zassert_equal(r, -EILSEQ, "Should've failed to parse a packet");
}

ZTEST(coap, test_parse_malformed_opt_len)
{
	uint8_t opt[] = { 0x55, 0xA5, 0x12, 0x34, 't', 'o', 'k', 'e', 'n',
		       0xC1 };
	struct coap_packet cpkt;
	uint8_t *data = data_buf[0];
	int r;

	memcpy(data, opt, sizeof(opt));

	r = coap_packet_parse(&cpkt, data, sizeof(opt), NULL, 0);
	zassert_equal(r, -EILSEQ, "Should've failed to parse a packet");
}

ZTEST(coap, test_parse_malformed_opt_ext)
{
	uint8_t opt[] = { 0x55, 0xA5, 0x12, 0x34, 't', 'o', 'k', 'e', 'n',
		       0xE0, 0x01 };
	struct coap_packet cpkt;
	uint8_t *data = data_buf[0];
	int r;

	memcpy(data, opt, sizeof(opt));

	r = coap_packet_parse(&cpkt, data, sizeof(opt), NULL, 0);
	zassert_equal(r, -EILSEQ, "Should've failed to parse a packet");
}

ZTEST(coap, test_parse_malformed_opt_len_ext)
{
	uint8_t opt[] = { 0x55, 0xA5, 0x12, 0x34, 't', 'o', 'k', 'e', 'n',
		       0xEE, 0x01, 0x02, 0x01};
	struct coap_packet cpkt;
	uint8_t *data = data_buf[0];
	int r;

	memcpy(data, opt, sizeof(opt));

	r = coap_packet_parse(&cpkt, data, sizeof(opt), NULL, 0);
	zassert_equal(r, -EILSEQ, "Should've failed to parse a packet");
}

/* 1 option, No payload (with payload marker) */
ZTEST(coap, test_parse_malformed_marker)
{
	uint8_t pdu[] = { 0x40, 0x01, 0, 0, 0x40, 0xFF};
	struct coap_packet cpkt;
	uint8_t *data = data_buf[0];
	int r;

	memcpy(data, pdu, sizeof(pdu));

	r = coap_packet_parse(&cpkt, data, sizeof(pdu), NULL, 0);
	zassert_not_equal(r, 0, "Should've failed to parse a packet");
}

ZTEST(coap, test_parse_req_build_ack)
{
	uint8_t pdu[] = { 0x45, 0xA5, 0x12, 0x34, 't', 'o', 'k', 'e', 'n',
		       0x00, 0xc1, 0x00, 0xff, 'p', 'a', 'y', 'l', 'o',
		       'a', 'd', 0x00 };
	uint8_t ack_pdu[] = { 0x65, 0x80, 0x12, 0x34, 't', 'o', 'k', 'e', 'n' };
	struct coap_packet cpkt;
	struct coap_packet ack_cpkt;
	uint8_t *data = data_buf[0];
	uint8_t *ack_data = data_buf[1];
	int r;

	memcpy(data, pdu, sizeof(pdu));

	r = coap_packet_parse(&cpkt, data, sizeof(pdu), NULL, 0);
	zassert_equal(r, 0, "Could not parse packet");

	r = coap_ack_init(&ack_cpkt, &cpkt, ack_data, COAP_BUF_SIZE,
			  COAP_RESPONSE_CODE_BAD_REQUEST);
	zassert_equal(r, 0, "Could not initialize ACK packet");

	zassert_equal(ack_cpkt.offset, sizeof(ack_pdu),
		     "Different size from the reference packet");
	zassert_mem_equal(ack_pdu, ack_cpkt.data, ack_cpkt.offset,
			  "Built packet doesn't match reference packet");
}

ZTEST(coap, test_parse_req_build_empty_ack)
{
	uint8_t pdu[] = { 0x45, 0xA5, 0xDE, 0xAD, 't', 'o', 'k', 'e', 'n',
		       0x00, 0xc1, 0x00, 0xff, 'p', 'a', 'y', 'l', 'o',
		       'a', 'd', 0x00 };
	uint8_t ack_pdu[] = { 0x60, 0x00, 0xDE, 0xAD };
	struct coap_packet cpkt;
	struct coap_packet ack_cpkt;
	uint8_t *data = data_buf[0];
	uint8_t *ack_data = data_buf[1];
	int r;

	memcpy(data, pdu, sizeof(pdu));

	r = coap_packet_parse(&cpkt, data, sizeof(pdu), NULL, 0);
	zassert_equal(r, 0, "Could not parse packet");

	r = coap_ack_init(&ack_cpkt, &cpkt, ack_data, COAP_BUF_SIZE,
			  COAP_CODE_EMPTY);
	zassert_equal(r, 0, "Could not initialize ACK packet");

	zassert_equal(ack_cpkt.offset, sizeof(ack_pdu),
		      "Different size from the reference packet");
	zassert_mem_equal(ack_pdu, ack_cpkt.data, ack_cpkt.offset,
			  "Built packet doesn't match reference packet");
}

ZTEST(coap, test_match_path_uri)
{
	const char * const resource_path[] = {
		"s",
		"1",
		"foobar",
		"foobar3a",
		"foobar3",
		"devnull",
		NULL
	};
	const char *uri;
	int r;

	uri = "/k";
	r = _coap_match_path_uri(resource_path, uri, strlen(uri));
	zassert_false(r, "Matching %s failed", uri);

	uri = "/s";
	r = _coap_match_path_uri(resource_path, uri, strlen(uri));
	zassert_true(r, "Matching %s failed", uri);

	uri = "/foobar";
	r = _coap_match_path_uri(resource_path, uri, strlen(uri));
	zassert_true(r, "Matching %s failed", uri);

	uri = "/foobar2";
	r = _coap_match_path_uri(resource_path, uri, strlen(uri));
	zassert_false(r, "Matching %s failed", uri);

	uri = "/foobar*";
	r = _coap_match_path_uri(resource_path, uri, strlen(uri));
	zassert_true(r, "Matching %s failed", uri);

	uri = "/foobar3*";
	r = _coap_match_path_uri(resource_path, uri, strlen(uri));
	zassert_true(r, "Matching %s failed", uri);

	uri = "/devnull*";
	r = _coap_match_path_uri(resource_path, uri, strlen(uri));
	zassert_false(r, "Matching %s failed", uri);
}

#define BLOCK_WISE_TRANSFER_SIZE_GET 150

static void prepare_block1_request(struct coap_packet *req,
				   struct coap_block_context *req_ctx,
				   int *more)
{
	const char token[] = "token";
	uint8_t payload[32] = { 0 };
	uint8_t *data = data_buf[0];
	bool first;
	int r;
	int block_size = coap_block_size_to_bytes(COAP_BLOCK_32);
	int payload_len;

	/* Request Context */
	if (req_ctx->total_size == 0) {
		first = true;
		coap_block_transfer_init(req_ctx, COAP_BLOCK_32,
					 BLOCK_WISE_TRANSFER_SIZE_GET);
	} else {
		first = false;
	}

	r = coap_packet_init(req, data, COAP_BUF_SIZE, COAP_VERSION_1,
			     COAP_TYPE_CON, strlen(token),
			     token, COAP_METHOD_POST,
			     coap_next_id());
	zassert_equal(r, 0, "Unable to initialize request");

	r = coap_append_block1_option(req, req_ctx);
	zassert_equal(r, 0, "Unable to append block1 option");

	if (first) {
		r = coap_append_size1_option(req, req_ctx);
		zassert_equal(r, 0, "Unable to append size1 option");
	}

	r = coap_packet_append_payload_marker(req);
	zassert_equal(r, 0, "Unable to append payload marker");

	payload_len = req_ctx->total_size - req_ctx->current;
	if (payload_len > block_size) {
		payload_len = block_size;
	}

	r = coap_packet_append_payload(req, payload, payload_len);
	zassert_equal(r, 0, "Unable to append payload");

	*more = coap_next_block(req, req_ctx);
}

static void prepare_block1_response(struct coap_packet *rsp,
				    struct coap_block_context *rsp_ctx,
				    struct coap_packet *req)
{
	uint8_t token[8];
	uint8_t *data = data_buf[1];
	uint16_t id;
	uint8_t tkl;
	int r;

	if (rsp_ctx->total_size == 0) {
		coap_block_transfer_init(rsp_ctx, COAP_BLOCK_32,
					 BLOCK_WISE_TRANSFER_SIZE_GET);
	}

	r = coap_update_from_block(req, rsp_ctx);
	zassert_equal(r, 0, "Failed to read block option");

	id = coap_header_get_id(req);
	tkl = coap_header_get_token(req, token);

	r = coap_packet_init(rsp, data, COAP_BUF_SIZE, COAP_VERSION_1,
			     COAP_TYPE_ACK, tkl, token,
			     COAP_RESPONSE_CODE_CREATED, id);
	zassert_equal(r, 0, "Unable to initialize request");

	r = coap_append_block1_option(rsp, rsp_ctx);
	zassert_equal(r, 0, "Unable to append block1 option");
}

#define ITER_COUNT(len, block_len) DIV_ROUND_UP(len, block_len)

static void verify_block1_request(struct coap_block_context *req_ctx,
				  uint8_t iter)
{
	int block_size = coap_block_size_to_bytes(COAP_BLOCK_32);
	int iter_max = ITER_COUNT(BLOCK_WISE_TRANSFER_SIZE_GET, block_size);

	zassert_equal(req_ctx->block_size, COAP_BLOCK_32,
		      "req:%d,Couldn't get block size", iter);

	/* In last iteration "current" must match "total_size" */
	if (iter < iter_max) {
		zassert_equal(
			req_ctx->current, block_size * iter,
			"req:%d,Couldn't get the current block position", iter);
	} else {
		zassert_equal(
			req_ctx->current, req_ctx->total_size,
			"req:%d,Couldn't get the current block position", iter);
	}

	zassert_equal(req_ctx->total_size, BLOCK_WISE_TRANSFER_SIZE_GET,
		      "req:%d,Couldn't packet total size", iter);
}

static void verify_block1_response(struct coap_block_context *rsp_ctx,
				   uint8_t iter)
{
	zassert_equal(rsp_ctx->block_size, COAP_BLOCK_32,
		      "rsp:%d,Couldn't get block size", iter);
	zassert_equal(rsp_ctx->current,
		      coap_block_size_to_bytes(COAP_BLOCK_32) * (iter - 1U),
		      "rsp:%d, Couldn't get the current block position", iter);
	zassert_equal(rsp_ctx->total_size, BLOCK_WISE_TRANSFER_SIZE_GET,
		      "rsp:%d, Couldn't packet total size", iter);
}
```

## src/test_block.c
```c
/*
 * Copyright (c) 2018 Intel Corporation
 *
 * SPDX-License-Identifier: Apache-2.0
 */

#include <zephyr/logging/log.h>
LOG_MODULE_DECLARE(net_test, LOG_LEVEL_DBG);

#include "test_common.h"


#define BLOCK_WISE_TRANSFER_SIZE_GET 150

static void prepare_block1_request(struct coap_packet *req,
				   struct coap_block_context *req_ctx,
				   int *more)
{
	const char token[] = "token";
	uint8_t payload[32] = { 0 };
	uint8_t *data = data_buf[0];
	bool first;
	int r;
	int block_size = coap_block_size_to_bytes(COAP_BLOCK_32);
	int payload_len;

	/* Request Context */
	if (req_ctx->total_size == 0) {
		first = true;
		coap_block_transfer_init(req_ctx, COAP_BLOCK_32,
					 BLOCK_WISE_TRANSFER_SIZE_GET);
	} else {
		first = false;
	}

	r = coap_packet_init(req, data, COAP_BUF_SIZE, COAP_VERSION_1,
			     COAP_TYPE_CON, strlen(token),
			     token, COAP_METHOD_POST,
			     coap_next_id());
	zassert_equal(r, 0, "Unable to initialize request");

	r = coap_append_block1_option(req, req_ctx);
	zassert_equal(r, 0, "Unable to append block1 option");

	if (first) {
		r = coap_append_size1_option(req, req_ctx);
		zassert_equal(r, 0, "Unable to append size1 option");
	}

	r = coap_packet_append_payload_marker(req);
	zassert_equal(r, 0, "Unable to append payload marker");

	payload_len = req_ctx->total_size - req_ctx->current;
	if (payload_len > block_size) {
		payload_len = block_size;
	}

	r = coap_packet_append_payload(req, payload, payload_len);
	zassert_equal(r, 0, "Unable to append payload");

	*more = coap_next_block(req, req_ctx);
}

static void prepare_block1_response(struct coap_packet *rsp,
				    struct coap_block_context *rsp_ctx,
				    struct coap_packet *req)
{
	uint8_t token[8];
	uint8_t *data = data_buf[1];
	uint16_t id;
	uint8_t tkl;
	int r;

	if (rsp_ctx->total_size == 0) {
		coap_block_transfer_init(rsp_ctx, COAP_BLOCK_32,
					 BLOCK_WISE_TRANSFER_SIZE_GET);
	}

	r = coap_update_from_block(req, rsp_ctx);
	zassert_equal(r, 0, "Failed to read block option");

	id = coap_header_get_id(req);
	tkl = coap_header_get_token(req, token);

	r = coap_packet_init(rsp, data, COAP_BUF_SIZE, COAP_VERSION_1,
			     COAP_TYPE_ACK, tkl, token,
			     COAP_RESPONSE_CODE_CREATED, id);
	zassert_equal(r, 0, "Unable to initialize request");

	r = coap_append_block1_option(rsp, rsp_ctx);
	zassert_equal(r, 0, "Unable to append block1 option");
}

#define ITER_COUNT(len, block_len) DIV_ROUND_UP(len, block_len)

static void verify_block1_request(struct coap_block_context *req_ctx,
				  uint8_t iter)
{
	int block_size = coap_block_size_to_bytes(COAP_BLOCK_32);
	int iter_max = ITER_COUNT(BLOCK_WISE_TRANSFER_SIZE_GET, block_size);

	zassert_equal(req_ctx->block_size, COAP_BLOCK_32,
		      "req:%d,Couldn't get block size", iter);

	/* In last iteration "current" must match "total_size" */
	if (iter < iter_max) {
		zassert_equal(
			req_ctx->current, block_size * iter,
			"req:%d,Couldn't get the current block position", iter);
	} else {
		zassert_equal(
			req_ctx->current, req_ctx->total_size,
			"req:%d,Couldn't get the current block position", iter);
	}

	zassert_equal(req_ctx->total_size, BLOCK_WISE_TRANSFER_SIZE_GET,
		      "req:%d,Couldn't packet total size", iter);
}

static void verify_block1_response(struct coap_block_context *rsp_ctx,
				   uint8_t iter)
{
	zassert_equal(rsp_ctx->block_size, COAP_BLOCK_32,
		      "rsp:%d,Couldn't get block size", iter);
	zassert_equal(rsp_ctx->current,
		      coap_block_size_to_bytes(COAP_BLOCK_32) * (iter - 1U),
		      "rsp:%d, Couldn't get the current block position", iter);
	zassert_equal(rsp_ctx->total_size, BLOCK_WISE_TRANSFER_SIZE_GET,
		      "rsp:%d, Couldn't packet total size", iter);
}

ZTEST(coap, test_block1_size)
{
	struct coap_block_context req_ctx;
	struct coap_block_context rsp_ctx;
	struct coap_packet req;
	struct coap_packet rsp;
	int more;
	uint8_t i;

	i = 0U;
	more = 1;
	memset(&req_ctx, 0, sizeof(req_ctx));
	memset(&rsp_ctx, 0, sizeof(rsp_ctx));

	while (more) {
		prepare_block1_request(&req, &req_ctx, &more);
		prepare_block1_response(&rsp, &rsp_ctx, &req);

		i++;

		verify_block1_request(&req_ctx, i);
		verify_block1_response(&rsp_ctx, i);
	}
}

#define BLOCK2_WISE_TRANSFER_SIZE_GET 300

static void prepare_block2_request(struct coap_packet *req,
				   struct coap_block_context *req_ctx,
				   struct coap_packet *rsp)
{
	const char token[] = "token";
	uint8_t *data = data_buf[0];
	int r;

	/* Request Context */
	if (req_ctx->total_size == 0) {
		coap_block_transfer_init(req_ctx, COAP_BLOCK_64,
					 BLOCK2_WISE_TRANSFER_SIZE_GET);
	} else {
		coap_next_block(rsp, req_ctx);
	}

	r = coap_packet_init(req, data, COAP_BUF_SIZE, COAP_VERSION_1,
			     COAP_TYPE_CON, strlen(token),
			     token, COAP_METHOD_GET,
			     coap_next_id());
	zassert_equal(r, 0, "Unable to initialize request");

	r = coap_append_block2_option(req, req_ctx);
	zassert_equal(r, 0, "Unable to append block2 option");
}

static void prepare_block2_response(struct coap_packet *rsp,
				   struct coap_block_context *rsp_ctx,
				   struct coap_packet *req,
				   int *more)
{
	uint8_t payload[64];
	uint8_t token[8];
	uint8_t *data = data_buf[1];
	uint16_t id;
	uint8_t tkl;
	bool first;
	int r;
	int block_size = coap_block_size_to_bytes(COAP_BLOCK_64);
	int payload_len;

	if (rsp_ctx->total_size == 0) {
		first = true;
		coap_block_transfer_init(rsp_ctx, COAP_BLOCK_64,
					 BLOCK2_WISE_TRANSFER_SIZE_GET);
	} else {
		first = false;
	}

	id = coap_header_get_id(req);
	tkl = coap_header_get_token(req, token);

	r = coap_packet_init(rsp, data, COAP_BUF_SIZE, COAP_VERSION_1,
			     COAP_TYPE_ACK, tkl, token,
			     COAP_RESPONSE_CODE_CONTENT, id);
	zassert_equal(r, 0, "Unable to initialize request");

	r = coap_append_block2_option(rsp, rsp_ctx);
	zassert_equal(r, 0, "Unable to append block2 option");

	if (first) {
		r = coap_append_size2_option(rsp, rsp_ctx);
		zassert_equal(r, 0, "Unable to append size2 option");
	}

	r = coap_packet_append_payload_marker(rsp);
	zassert_equal(r, 0, "Unable to append payload marker");

	payload_len = rsp_ctx->total_size - rsp_ctx->current;
	if (payload_len > block_size) {
		payload_len = block_size;
	}

	r = coap_packet_append_payload(rsp, payload, payload_len);
	zassert_equal(r, 0, "Unable to append payload");

	*more = coap_next_block(rsp, rsp_ctx);
}

static void verify_block2_request(struct coap_block_context *req_ctx,
				 uint8_t iter)
{
	zassert_equal(req_ctx->block_size, COAP_BLOCK_64,
		      "req:%d,Couldn't get block size", iter);
	zassert_equal(req_ctx->current,
		      coap_block_size_to_bytes(COAP_BLOCK_64) * (iter - 1U),
		      "req:%d, Couldn't get the current block position", iter);
	zassert_equal(req_ctx->total_size, BLOCK2_WISE_TRANSFER_SIZE_GET,
		      "req:%d,Couldn't packet total size", iter);
}

static void verify_block2_response(struct coap_block_context *rsp_ctx,
				  uint8_t iter)
{
	int block_size = coap_block_size_to_bytes(COAP_BLOCK_64);
	int iter_max = ITER_COUNT(BLOCK2_WISE_TRANSFER_SIZE_GET, block_size);

	zassert_equal(rsp_ctx->block_size, COAP_BLOCK_64,
		      "rsp:%d,Couldn't get block size", iter);

	/* In last iteration "current" must match "total_size" */
	if (iter < iter_max) {
		zassert_equal(
			rsp_ctx->current, block_size * iter,
			"req:%d,Couldn't get the current block position", iter);
	} else {
		zassert_equal(
			rsp_ctx->current, rsp_ctx->total_size,
			"req:%d,Current block position does not match total size", iter);
	}

	zassert_equal(rsp_ctx->total_size, BLOCK2_WISE_TRANSFER_SIZE_GET,
		      "rsp:%d, Couldn't packet total size", iter);
}

ZTEST(coap, test_block2_size)
{
	struct coap_block_context req_ctx;
	struct coap_block_context rsp_ctx;
	struct coap_packet req;
	struct coap_packet rsp;
	int more;
	uint8_t i;

	i = 0U;
	more = 1;
	memset(&req_ctx, 0, sizeof(req_ctx));
	memset(&rsp_ctx, 0, sizeof(rsp_ctx));

	while (more) {
		prepare_block2_request(&req, &req_ctx, &rsp);
		prepare_block2_response(&rsp, &rsp_ctx, &req, &more);

		i++;

		verify_block2_request(&req_ctx, i);
		verify_block2_response(&rsp_ctx, i);
	}
}



/* Helper to build a Block2 response with optional ETag */
static int build_block2_response(struct coap_packet *response, uint8_t *buf, size_t buf_len,
				 const uint8_t *token, uint8_t tkl, uint16_t id,
				 int block_num, bool more, const uint8_t *etag,
				 uint8_t etag_len, const uint8_t *payload, size_t payload_len)
{
	int ret;

	ret = coap_packet_init(response, buf, buf_len, COAP_VERSION_1, COAP_TYPE_ACK,
			       tkl, token, COAP_RESPONSE_CODE_CONTENT, id);
	if (ret < 0) {
		return ret;
	}

	if (etag != NULL && etag_len > 0) {
		ret = coap_packet_append_option(response, COAP_OPTION_ETAG, etag, etag_len);
		if (ret < 0) {
			return ret;
		}
	}

	ret = coap_append_option_int(response, COAP_OPTION_CONTENT_FORMAT,
				     COAP_CONTENT_FORMAT_TEXT_PLAIN);
	if (ret < 0) {
		return ret;
	}

	int block_opt = (block_num << 4) | (more ? 0x08 : 0x00) | COAP_BLOCK_64;
	ret = coap_append_option_int(response, COAP_OPTION_BLOCK2, block_opt);
	if (ret < 0) {
		return ret;
	}

	if (payload != NULL && payload_len > 0) {
		ret = coap_packet_append_payload_marker(response);
		if (ret < 0) {
			return ret;
		}
		ret = coap_packet_append_payload(response, payload, payload_len);
		if (ret < 0) {
			return ret;
		}
	}

	return 0;
}


/* Helper to set up test request state after block 0 */
static void setup_block_state(struct coap_client_internal_request *req,
			      const uint8_t *token, size_t tkl,
			      const uint8_t *etag, size_t etag_len)
{
	req->request_ongoing = true;
	req->last_response_id = -1;
	memcpy(req->request_token, token, tkl);
	req->request_tkl = tkl;
	if (etag && etag_len > 0) {
		memcpy(req->block2_etag, etag, etag_len);
		req->block2_etag_len = etag_len;
	}
	req->recv_blk_ctx.current = 64;
	req->recv_blk_ctx.block_size = COAP_BLOCK_64;
}

/* Test: ETag mismatch aborts Block2 transfer */
ZTEST(coap, test_block2_etag_mismatch_aborts)
{
	struct coap_client client = {0};
	uint8_t token[] = {0x41, 0x42, 0x43, 0x44, 0x45, 0x46, 0x47, 0x48};
	uint8_t etag_a[] = {0x01, 0x02, 0x03, 0x04};
	uint8_t etag_b[] = {0x05, 0x06, 0x07, 0x08};
	uint8_t payload[] = "Test payload data";
	uint8_t response_buf[256];
	struct coap_packet response;
	int ret;

	k_mutex_init(&client.lock);
	client.fd = 1;

	struct coap_client_internal_request *req = &client.requests[0];
	memset(req, 0, sizeof(*req));
	memcpy(req->request_token, token, sizeof(token));
	req->request_tkl = sizeof(token);
	req->request_ongoing = true;
	req->last_response_id = -1;

	/* Inject Block 0 with ETag A */
	ret = build_block2_response(&response, response_buf, sizeof(response_buf),
				    token, sizeof(token), 0x1234,
				    0, true, etag_a, sizeof(etag_a),
				    payload, sizeof(payload));
	zassert_equal(ret, 0, "Failed to build block 0");

	coap_client_test_inject_response(&client, response.data, response.offset);

	/* Restore state after block 0 (send will fail without real socket) */
	setup_block_state(req, token, sizeof(token), etag_a, sizeof(etag_a));

	/* Inject Block 1 with ETag B (mismatch) */
	ret = build_block2_response(&response, response_buf, sizeof(response_buf),
				    token, sizeof(token), 0x1235,
				    1, false, etag_b, sizeof(etag_b),
				    payload, sizeof(payload));
	zassert_equal(ret, 0, "Failed to build block 1");

	ret = coap_client_test_inject_response(&client, response.data, response.offset);
	zassert_equal(ret, -EBADMSG, "ETag mismatch should abort");

	zassert_equal(req->block2_etag_len, 0, "ETag state should be cleared");
	zassert_false(req->request_ongoing, "Request should be released");
}

/* Test: Missing ETag after being available aborts */
ZTEST(coap, test_block2_etag_missing_after_present_aborts)
{
	struct coap_client client = {0};
	uint8_t token[] = {0x41, 0x42, 0x43, 0x44, 0x45, 0x46, 0x47, 0x48};
	uint8_t etag[] = {0x01, 0x02, 0x03, 0x04};
	uint8_t payload[] = "Test payload data";
	uint8_t response_buf[256];
	struct coap_packet response;
	int ret;

	k_mutex_init(&client.lock);
	client.fd = 1;

	struct coap_client_internal_request *req = &client.requests[0];
	memset(req, 0, sizeof(*req));
	memcpy(req->request_token, token, sizeof(token));
	req->request_tkl = sizeof(token);
	req->request_ongoing = true;
	req->last_response_id = -1;

	/* Inject Block 0 with ETag */
	ret = build_block2_response(&response, response_buf, sizeof(response_buf),
				    token, sizeof(token), 0x1234,
				    0, true, etag, sizeof(etag),
				    payload, sizeof(payload));
	zassert_equal(ret, 0, "Failed to build block 0");

	coap_client_test_inject_response(&client, response.data, response.offset);

	/* Restore state after block 0 */
	setup_block_state(req, token, sizeof(token), etag, sizeof(etag));

	/* Inject Block 1 without ETag */
	ret = build_block2_response(&response, response_buf, sizeof(response_buf),
				    token, sizeof(token), 0x1235,
				    1, false, NULL, 0,
				    payload, sizeof(payload));
	zassert_equal(ret, 0, "Failed to build block 1");

	ret = coap_client_test_inject_response(&client, response.data, response.offset);
	zassert_equal(ret, -EBADMSG, "Missing ETag should abort");

	zassert_equal(req->block2_etag_len, 0, "ETag state should be cleared");
	zassert_false(req->request_ongoing, "Request should be released");
}

/* Test: No ETag in any block allows transfer */
ZTEST(coap, test_block2_no_etag_allows_transfer)
{
	struct coap_client client = {0};
	uint8_t token[] = {0x41, 0x42, 0x43, 0x44, 0x45, 0x46, 0x47, 0x48};
	uint8_t payload[] = "Test payload";
	uint8_t response_buf[256];
	struct coap_packet response;
	int ret;

	k_mutex_init(&client.lock);
	client.fd = 1;

	struct coap_client_internal_request *req = &client.requests[0];
	memset(req, 0, sizeof(*req));
	memcpy(req->request_token, token, sizeof(token));
	req->request_tkl = sizeof(token);
	req->request_ongoing = true;
	req->last_response_id = -1;

	/* Inject Block 0 without ETag */
	ret = build_block2_response(&response, response_buf, sizeof(response_buf),
				    token, sizeof(token), 0x1234,
				    0, true, NULL, 0, payload, sizeof(payload));
	zassert_equal(ret, 0, "Failed to build block 0");

	coap_client_test_inject_response(&client, response.data, response.offset);
	zassert_equal(req->block2_etag_len, 0, "No ETag should be stored");

	req->request_ongoing = true;

	/* Inject Block 1 without ETag (should succeed) */
	ret = build_block2_response(&response, response_buf, sizeof(response_buf),
				    token, sizeof(token), 0x1235,
				    1, false, NULL, 0, payload, sizeof(payload));
	zassert_equal(ret, 0, "Failed to build block 1");

	ret = coap_client_test_inject_response(&client, response.data, response.offset);
	zassert_not_equal(ret, -EBADMSG, "Transfer without ETag should not abort");
}

/* Test: Multiple ETag options in response aborts */
ZTEST(coap, test_block2_multiple_etag_aborts)
{
	struct coap_client client = {0};
	uint8_t token[] = {0x41, 0x42, 0x43, 0x44, 0x45, 0x46, 0x47, 0x48};
	uint8_t etag1[] = {0x01, 0x02};
	uint8_t etag2[] = {0x03, 0x04};
	uint8_t payload[] = "Test payload";
	uint8_t response_buf[256];
	struct coap_packet response;
	int ret;

	k_mutex_init(&client.lock);
	client.fd = 1;

	struct coap_client_internal_request *req = &client.requests[0];
	memset(req, 0, sizeof(*req));
	memcpy(req->request_token, token, sizeof(token));
	req->request_tkl = sizeof(token);
	req->request_ongoing = true;
	req->last_response_id = -1;

	/* Build response with multiple ETags (RFC 7252 §5.10.6.1 violation) */
	ret = coap_packet_init(&response, response_buf, sizeof(response_buf),
			       COAP_VERSION_1, COAP_TYPE_ACK, sizeof(token), token,
			       COAP_RESPONSE_CODE_CONTENT, 0x1234);
	zassert_equal(ret, 0, "Failed to init response");

	ret = coap_packet_append_option(&response, COAP_OPTION_ETAG, etag1, sizeof(etag1));
	zassert_equal(ret, 0, "Failed to add first ETag");

	ret = coap_packet_append_option(&response, COAP_OPTION_ETAG, etag2, sizeof(etag2));
	zassert_equal(ret, 0, "Failed to add second ETag");

	ret = coap_append_option_int(&response, COAP_OPTION_CONTENT_FORMAT,
				     COAP_CONTENT_FORMAT_TEXT_PLAIN);
	zassert_equal(ret, 0, "Failed to add Content-Format");

	int block_opt = (0 << 4) | 0x08 | COAP_BLOCK_64;
	ret = coap_append_option_int(&response, COAP_OPTION_BLOCK2, block_opt);
	zassert_equal(ret, 0, "Failed to add Block2");

	ret = coap_packet_append_payload_marker(&response);
	zassert_equal(ret, 0, "Failed to add payload marker");
	ret = coap_packet_append_payload(&response, payload, sizeof(payload));
	zassert_equal(ret, 0, "Failed to add payload");

	ret = coap_client_test_inject_response(&client, response.data, response.offset);
	zassert_equal(ret, -EBADMSG, "Multiple ETags should abort");

	zassert_equal(req->block2_etag_len, 0, "ETag state should be cleared");
	zassert_false(req->request_ongoing, "Request should be released");
}

/* Test: Matching ETag across blocks allows transfer */
ZTEST(coap, test_block2_matching_etag_succeeds)
{
	struct coap_client client = {0};
	uint8_t token[] = {0x41, 0x42, 0x43, 0x44, 0x45, 0x46, 0x47, 0x48};
	uint8_t etag[] = {0x01, 0x02, 0x03, 0x04};
	uint8_t payload[] = "Test payload";
	uint8_t response_buf[256];
	struct coap_packet response;
	int ret;

	k_mutex_init(&client.lock);
	client.fd = 1;

	struct coap_client_internal_request *req = &client.requests[0];
	memset(req, 0, sizeof(*req));
	memcpy(req->request_token, token, sizeof(token));
	req->request_tkl = sizeof(token);
	req->request_ongoing = true;
	req->last_response_id = -1;

	/* Inject Block 0 with ETag */
	ret = build_block2_response(&response, response_buf, sizeof(response_buf),
				    token, sizeof(token), 0x1234,
				    0, true, etag, sizeof(etag),
				    payload, sizeof(payload));
	zassert_equal(ret, 0, "Failed to build block 0");

	coap_client_test_inject_response(&client, response.data, response.offset);

	/* Restore state after block 0 */
	setup_block_state(req, token, sizeof(token), etag, sizeof(etag));

	/* Inject Block 1 with same ETag */
	ret = build_block2_response(&response, response_buf, sizeof(response_buf),
				    token, sizeof(token), 0x1235,
				    1, true, etag, sizeof(etag),
				    payload, sizeof(payload));
	zassert_equal(ret, 0, "Failed to build block 1");

	ret = coap_client_test_inject_response(&client, response.data, response.offset);
	zassert_not_equal(ret, -EBADMSG, "Block 1 with matching ETag should not abort");

	req->request_ongoing = true;

	/* Inject Block 2 (last) with same ETag */
	ret = build_block2_response(&response, response_buf, sizeof(response_buf),
				    token, sizeof(token), 0x1236,
				    2, false, etag, sizeof(etag),
				    payload, sizeof(payload));
	zassert_equal(ret, 0, "Failed to build block 2");

	ret = coap_client_test_inject_response(&client, response.data, response.offset);
	zassert_not_equal(ret, -EBADMSG, "Last block with matching ETag should not abort");

	zassert_equal(req->block2_etag_len, 0, "ETag state should be cleared after last block");
}
```

## src/test_common.h
```c
/*
 * Copyright (c) 2026 Martin Schröder <info@swedishembedded.com>
 *
 * SPDX-License-Identifier: Apache-2.0
 */

#ifndef TEST_COMMON_H_
#define TEST_COMMON_H_

#include <errno.h>
#include <zephyr/types.h>
#include <stdbool.h>
#include <stddef.h>
#include <stdio.h>
#include <string.h>
#include <zephyr/sys/printk.h>
#include <zephyr/kernel.h>
#include <zephyr/sys/util.h>
#include <zephyr/net/coap.h>
#include <zephyr/net/coap_client.h>
#include <zephyr/net/coap/coap_link_format.h>

#include <zephyr/tc_util.h>
#include <zephyr/ztest.h>

#include "net_private.h"

#if defined(CONFIG_COAP_OSCORE)
#include "coap_oscore.h"
#include <zephyr/net/coap/coap_service.h>
#include <oscore.h>
#include <oscore/security_context.h>
#include <common/oscore_edhoc_error.h>
#endif

#if defined(CONFIG_COAP_EDHOC)
#include "coap_edhoc.h"
#include "coap_edhoc_session.h"
#include "coap_oscore_ctx_cache.h"

/* Forward declarations for wrapper functions */
extern int coap_oscore_context_init_wrapper(void *ctx,
					     const uint8_t *master_secret,
					     size_t master_secret_len,
					     const uint8_t *master_salt,
					     size_t master_salt_len,
					     const uint8_t *sender_id,
					     size_t sender_id_len,
					     const uint8_t *recipient_id,
					     size_t recipient_id_len,
					     int aead_alg,
					     int hkdf_alg);
#endif

/* Common macros */
#define COAP_BUF_SIZE 128

#define NUM_PENDINGS 3
#define NUM_OBSERVERS 3
#define NUM_REPLIES 3

#define MY_PORT 12345
#define peer_addr { { { 0x20, 0x01, 0x0d, 0xb8, 0, 0, 0, 0, \
			0, 0, 0, 0, 0, 0, 0, 0x2 } } }

#define COAP_ROLLOVER_AGE (1 << 23)
#define COAP_MAX_AGE      0xffffff
#define COAP_FIRST_AGE    2

/* Shared data declarations */
extern struct coap_pending pendings[NUM_PENDINGS];
extern struct coap_observer observers[NUM_OBSERVERS];
extern struct coap_reply replies[NUM_REPLIES];

extern struct net_sockaddr_in6 dummy_addr;
extern uint8_t data_buf[2][COAP_BUF_SIZE];

extern struct coap_resource server_resources[];
extern const char * const server_resource_1_path[];
extern const char *const server_resource_2_path[];

/* This is exposed for this test in subsys/net/lib/coap/coap_link_format.c */
bool _coap_match_path_uri(const char * const *path,
			  const char *uri, uint16_t len);

/* Exposed from subsys/net/lib/coap */
extern bool coap_age_is_newer(int v1, int v2);

/* Shared helper functions */
bool ipaddr_cmp(const struct net_sockaddr *a, const struct net_sockaddr *b);

#endif /* TEST_COMMON_H_ */
```

## src/test_observer.c
```c
/*
 * Copyright (c) 2018 Intel Corporation
 *
 * SPDX-License-Identifier: Apache-2.0
 */

#include <zephyr/logging/log.h>
LOG_MODULE_DECLARE(net_test, LOG_LEVEL_DBG);

#include "test_common.h"


ZTEST(coap, test_retransmit_second_round)
{
	struct coap_packet cpkt;
	struct coap_packet rsp;
	struct coap_pending *pending;
	struct coap_pending *rsp_pending;
	uint8_t *data = data_buf[0];
	uint8_t *rsp_data = data_buf[1];
	int r;
	uint16_t id;

	id = coap_next_id();

	r = coap_packet_init(&cpkt, data, COAP_BUF_SIZE, COAP_VERSION_1,
			     COAP_TYPE_CON, 0, coap_next_token(),
			     COAP_METHOD_GET, id);
	zassert_equal(r, 0, "Could not initialize packet");

	pending = coap_pending_next_unused(pendings, NUM_PENDINGS);
	zassert_not_null(pending, "No free pending");

	r = coap_pending_init(pending, &cpkt, (struct net_sockaddr *) &dummy_addr,
			      NULL);
	zassert_equal(r, 0, "Could not initialize packet");

	/* We "send" the packet the first time here */
	zassert_true(coap_pending_cycle(pending), "Pending expired too early");

	/* We simulate that the first transmission got lost */
	zassert_true(coap_pending_cycle(pending), "Pending expired too early");

	r = coap_packet_init(&rsp, rsp_data, COAP_BUF_SIZE,
			     COAP_VERSION_1, COAP_TYPE_ACK, 0, NULL,
			     COAP_METHOD_GET, id);
	zassert_equal(r, 0, "Could not initialize packet");

	/* Now we get the ack from the remote side */
	rsp_pending = coap_pending_received(&rsp, pendings, NUM_PENDINGS);
	zassert_equal_ptr(pending, rsp_pending,
			  "Invalid pending %p should be %p",
			  rsp_pending, pending);

	coap_pending_clear(rsp_pending);

	rsp_pending = coap_pending_next_to_expire(pendings, NUM_PENDINGS);
	zassert_is_null(rsp_pending, "There should be no active pendings");
}

static int server_resource_1_get(struct coap_resource *resource,
				 struct coap_packet *request,
				 struct net_sockaddr *addr, net_socklen_t addr_len)
{
	struct coap_packet response;
	struct coap_observer *observer;
	uint8_t *data = data_buf[1];
	char payload[] = "This is the payload";
	uint8_t token[8];
	uint8_t tkl;
	uint16_t id;
	int r;

	zassert_true(coap_request_is_observe(request),
		     "The request should enable observing");

	observer = coap_observer_next_unused(observers, NUM_OBSERVERS);
	zassert_not_null(observer, "There should be an available observer");

	tkl = coap_header_get_token(request, (uint8_t *) token);
	id = coap_header_get_id(request);

	coap_observer_init(observer, request, addr);
	coap_register_observer(resource, observer);

	r = coap_packet_init(&response, data, COAP_BUF_SIZE,
			     COAP_VERSION_1, COAP_TYPE_ACK, tkl, token,
			     COAP_RESPONSE_CODE_OK, id);
	zassert_equal(r, 0, "Unable to initialize packet");

	r = coap_append_option_int(&response, COAP_OPTION_OBSERVE,
				   resource->age);
	zassert_equal(r, 0, "Failed to append observe option");

	r = coap_packet_append_payload_marker(&response);
	zassert_equal(r, 0, "Failed to set the payload marker");

	r = coap_packet_append_payload(&response, (uint8_t *)payload,
				       strlen(payload));
	zassert_equal(r, 0, "Unable to append payload");

	resource->user_data = data;

	return 0;
}

ZTEST(coap, test_observer_server)
{
	uint8_t valid_request_pdu[] = {
		0x45, 0x01, 0x12, 0x34,
		't', 'o', 'k', 'e', 'n',
		0x60, /* enable observe option */
		0x51, 's', 0x01, '1', /* path */
	};
	uint8_t not_found_request_pdu[] = {
		0x45, 0x01, 0x12, 0x34,
		't', 'o', 'k', 'e', 'n',
		0x60, /* enable observe option */
		0x51, 's', 0x01, '3', /* path */
	};
	struct coap_packet req;
	struct coap_option options[4] = {};
	uint8_t *data = data_buf[0];
	uint8_t opt_num = ARRAY_SIZE(options) - 1;
	int r;

	memcpy(data, valid_request_pdu, sizeof(valid_request_pdu));

	r = coap_packet_parse(&req, data, sizeof(valid_request_pdu),
			      options, opt_num);
	zassert_equal(r, 0, "Could not initialize packet");

	r = coap_handle_request(&req, server_resources, options, opt_num,
				(struct net_sockaddr *) &dummy_addr,
				sizeof(dummy_addr));
	zassert_equal(r, 0, "Could not handle packet");

	/* Suppose some time passes */
	r = coap_resource_notify(&server_resources[0]);
	zassert_equal(r, 0, "Could not notify resource");

	memcpy(data, not_found_request_pdu, sizeof(not_found_request_pdu));

	r = coap_packet_parse(&req, data, sizeof(not_found_request_pdu),
			      options, opt_num);
	zassert_equal(r, 0, "Could not initialize packet");

	r = coap_handle_request(&req, server_resources, options, opt_num,
				(struct net_sockaddr *) &dummy_addr,
				sizeof(dummy_addr));
	zassert_equal(r, -ENOENT,
		      "There should be no handler for this resource");
}

static int resource_reply_cb(const struct coap_packet *response,
			     struct coap_reply *reply,
			     const struct net_sockaddr *from)
{
	TC_PRINT("You should see this");

	return 0;
}

ZTEST(coap, test_observer_client)
{
	struct coap_packet req;
	struct coap_packet rsp;
	struct coap_reply *reply;
	struct coap_option options[4] = {};
	const char token[] = "token";
	const char * const *p;
	uint8_t *data = data_buf[0];
	uint8_t *rsp_data = data_buf[1];
	uint8_t opt_num = ARRAY_SIZE(options) - 1;
	int observe = 0;
	int r;

	r = coap_packet_init(&req, data, COAP_BUF_SIZE,
			     COAP_VERSION_1, COAP_TYPE_CON,
			     strlen(token), token,
			     COAP_METHOD_GET, coap_next_id());
	zassert_equal(r, 0, "Unable to initialize request");

	/* Enable observing the resource. */
	r = coap_append_option_int(&req, COAP_OPTION_OBSERVE, observe);
	zassert_equal(r, 0, "Unable to add option to request int");

	for (p = server_resource_1_path; p && *p; p++) {
		r = coap_packet_append_option(&req, COAP_OPTION_URI_PATH,
					      *p, strlen(*p));
		zassert_equal(r, 0, "Unable to add option to request");
	}

	reply = coap_reply_next_unused(replies, NUM_REPLIES);
	zassert_not_null(reply, "No resources for waiting for replies");

	coap_reply_init(reply, &req);
	reply->reply = resource_reply_cb;

	/* Server side, not interesting for this test */
	r = coap_packet_parse(&req, data, req.offset, options, opt_num);
	zassert_equal(r, 0, "Could not parse req packet");

	r = coap_handle_request(&req, server_resources, options, opt_num,
				(struct net_sockaddr *) &dummy_addr,
				sizeof(dummy_addr));
	zassert_equal(r, 0, "Could not handle packet");

	/* We cheat, and communicate using the resource's user_data */
	rsp_data = server_resources[0].user_data;

	/* 'rsp_pkt' contains the response now */

	r = coap_packet_parse(&rsp, rsp_data, COAP_BUF_SIZE, options, opt_num);
	zassert_equal(r, 0, "Could not parse rsp packet");

	reply = coap_response_received(&rsp,
				       (const struct net_sockaddr *) &dummy_addr,
				       replies, NUM_REPLIES);
	zassert_not_null(reply, "Couldn't find a matching waiting reply");
}
```
