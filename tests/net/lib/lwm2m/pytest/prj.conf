## prj.conf
```kconfig
CONFIG_NETWORKING=y
CONFIG_NET_IPV4=y
CONFIG_LWM2M=y
CONFIG_NET_CONFIG_NEED_IPV4=y
CONFIG_NET_CONFIG_SETTINGS=y

CONFIG_LWM2M_COAP_BLOCK_SIZE=512
CONFIG_LOG=y
```

## boards/native_posix.conf
```kconfig
# General config, fine tune when needed
CONFIG_MAIN_STACK_SIZE=2048
CONFIG_HEAP_MEM_POOL_SIZE=16384

# Native posix requirements
CONFIG_ENTROPY_GENERATOR=y
CONFIG_TEST_RANDOM_GENERATOR=y
CONFIG_NATIVE_POSIX_SLOWDOWN_TO_REAL_TIME=y

CONFIG_NET_L2_ETHERNET=y
CONFIG_ETH_NATIVE_POSIX=y
CONFIG_ETH_NATIVE_POSIX_RANDOM_MAC=y

# Network address config
CONFIG_NET_CONFIG_SETTINGS=y
CONFIG_NET_CONFIG_NEED_IPV4=y
CONFIG_NET_CONFIG_MY_IPV4_ADDR="192.0.2.1"
CONFIG_NET_CONFIG_PEER_IPV4_ADDR="192.0.2.2"
CONFIG_NET_CONFIG_MY_IPV4_GW="192.0.2.2"
CONFIG_DNS_RESOLVER=y
CONFIG_DNS_RESOLVER_MAX_SERVERS=1
CONFIG_DNS_SERVER_IP_ADDRESSES=y
CONFIG_DNS_SERVER1="192.0.2.2"
```

## src/main.c
```c
/*
 * Copyright (c) 2022 Nordic Semiconductor
 *
 * SPDX-License-Identifier: Apache-2.0
 */
#include <zephyr.h>
#include <net/lwm2m.h>
#include <unistd.h>
#include <stdlib.h>
#include <time.h>
#include <stdio.h>

#define CLIENT_MANUFACTURER	"Zephyr"

static struct lwm2m_ctx client;

#define ENDPOINT_NAME	"ztest"
#define SERVER_ADDR	"coap://192.0.2.2"

static struct k_sem stop_lock;
static struct k_sem disconnect_lock;


static int device_reboot_cb(uint16_t obj_inst_id,
			    uint8_t *args, uint16_t args_len)
{
	k_sem_give(&stop_lock);
	return 0;
}

static void lwm2m_setup(void)
{
	/* cannot be const because LwM2M engine modifies the URL */
	static char addr[] = SERVER_ADDR;
	/* setup SECURITY object */
	lwm2m_engine_set_res_data("0/0/0", addr, sizeof(SERVER_ADDR), 0);

	/* Security Mode */
	lwm2m_engine_set_u8("0/0/2",
			    IS_ENABLED(CONFIG_LWM2M_DTLS_SUPPORT) ? 0 : 3);

	/* Match Security object instance with a Server object instance with
	 * Short Server ID.
	 */
	lwm2m_engine_set_u16("0/0/10", 101);
	lwm2m_engine_set_u16("1/0/0", 101);

	/* setup SERVER object */

	/* setup DEVICE object */

	lwm2m_engine_set_res_data("3/0/0", CLIENT_MANUFACTURER,
				  sizeof(CLIENT_MANUFACTURER),
				  LWM2M_RES_DATA_FLAG_RO);
	lwm2m_engine_register_exec_callback("3/0/4", device_reboot_cb);
}

static void rd_client_event(struct lwm2m_ctx *client,
			    enum lwm2m_rd_client_event client_event)
{
	switch (client_event) {
	case LWM2M_RD_CLIENT_EVENT_DISCONNECT:
		k_sem_give(&disconnect_lock);
		break;
	default:
		break;
	}
}

void main(void)
{
	if (IS_ENABLED(CONFIG_BOARD_NATIVE_POSIX)) {
		srand(time(NULL) + getpid());
	}
	k_sem_init(&stop_lock, 0, K_SEM_MAX_LIMIT);
	k_sem_init(&disconnect_lock, 0, K_SEM_MAX_LIMIT);
	lwm2m_setup();
	lwm2m_rd_client_start(&client, ENDPOINT_NAME, 0, rd_client_event, NULL);
	printf("running\n");
	k_sem_take(&stop_lock, K_FOREVER);
	printf("stopped\n");
	lwm2m_rd_client_stop(&client, rd_client_event, true);
	k_sem_take(&disconnect_lock, K_SECONDS(10));

	if (IS_ENABLED(CONFIG_ARCH_POSIX)) {
		posix_exit(0);
	}
}
```
