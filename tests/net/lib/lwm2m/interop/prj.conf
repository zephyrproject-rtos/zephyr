## CMakeLists.txt
```
# SPDX-License-Identifier: Apache-2.0

cmake_minimum_required(VERSION 3.28.0)
find_package(Zephyr REQUIRED HINTS $ENV{ZEPHYR_BASE})
project(lwm2m_interop_tests)

FILE(GLOB app_sources src/*.c)
target_sources(app PRIVATE ${app_sources})

include(${ZEPHYR_BASE}/samples/net/common/common.cmake)
```

## prj.conf
```kconfig
CONFIG_NETWORKING=y
CONFIG_LOG=y
CONFIG_TEST_RANDOM_GENERATOR=y
CONFIG_NET_IPV4=y
CONFIG_NET_IPV6=n
CONFIG_NET_DHCPV4=n
CONFIG_NET_PKT_RX_COUNT=4
CONFIG_NET_PKT_TX_COUNT=4
CONFIG_NET_BUF_RX_COUNT=8
CONFIG_NET_BUF_TX_COUNT=8
CONFIG_NET_MAX_CONTEXTS=4
CONFIG_NET_CONFIG_MY_IPV4_ADDR="192.0.2.1"
CONFIG_NET_CONFIG_MY_IPV4_GW="192.0.2.2"
CONFIG_NET_CONFIG_NEED_IPV4=y
CONFIG_NET_CONFIG_SETTINGS=y
CONFIG_NET_NAMESPACE_COMPAT_MODE=n

CONFIG_LWM2M=y
CONFIG_LWM2M_IPSO_SUPPORT=y
CONFIG_LWM2M_SHELL=y

CONFIG_LWM2M_TICKLESS=y
CONFIG_ZVFS_EVENTFD=y

#Enable test objects
CONFIG_LWM2M_PORTFOLIO_OBJ_SUPPORT=y
CONFIG_LWM2M_BINARYAPPDATA_OBJ_SUPPORT=y
CONFIG_LWM2M_FIRMWARE_UPDATE_OBJ_SUPPORT=y
CONFIG_LWM2M_FIRMWARE_UPDATE_PULL_SUPPORT=y

#LwM2M v1.1 configure
CONFIG_LWM2M_VERSION_1_1=y
CONFIG_LWM2M_DTLS_SUPPORT=y
CONFIG_LWM2M_DTLS_CID=y
CONFIG_LWM2M_RD_CLIENT_SUPPORT_BOOTSTRAP=y

#Enable SenML JSON content format
CONFIG_JSON_LIBRARY=y
CONFIG_BASE64=y
CONFIG_LWM2M_RW_SENML_JSON_SUPPORT=y

#Enable SenML CBOR content format
CONFIG_LWM2M_RW_SENML_CBOR_SUPPORT=y
CONFIG_LWM2M_RW_SENML_CBOR_RECORDS=60
CONFIG_ZCBOR_CANONICAL=y

#Enable legacy content formats
CONFIG_LWM2M_RW_JSON_SUPPORT=y
CONFIG_LWM2M_RW_OMA_TLV_SUPPORT=y

# Longer endpoint name might be returned in a registration reply
CONFIG_COAP_EXTENDED_OPTIONS_LEN=y
CONFIG_COAP_EXTENDED_OPTIONS_LEN_VALUE=40

# Speed up testing, we are running in non-lossy network
CONFIG_COAP_INIT_ACK_TIMEOUT_MS=1000
CONFIG_COAP_RANDOMIZE_ACK_TIMEOUT=n
CONFIG_LWM2M_RD_CLIENT_MAX_RETRIES=2

# Use QUEUE mode by default
CONFIG_LWM2M_QUEUE_MODE_ENABLED=y
CONFIG_LWM2M_QUEUE_MODE_UPTIME=20
CONFIG_LWM2M_UPDATE_PERIOD=30
CONFIG_LWM2M_RD_CLIENT_STOP_POLLING_AT_IDLE=y
CONFIG_LWM2M_SECONDS_TO_UPDATE_EARLY=1

# LwM2M configuration as OMA-ETS-LightweightM2M_INT-V1_1-20190912-D Configuration 3
CONFIG_LWM2M_ENGINE_DEFAULT_LIFETIME=30
CONFIG_LWM2M_SERVER_DEFAULT_PMIN=1
CONFIG_LWM2M_SERVER_DEFAULT_PMAX=10

CONFIG_MBEDTLS=y
CONFIG_MBEDTLS_SSL_PROTO_TLS1_2=y
CONFIG_MBEDTLS_SSL_DTLS_CONNECTION_ID=y

# Special MbedTLS changes
CONFIG_MBEDTLS_ENABLE_HEAP=y
# MTU - IPv6 header - UDP header - DTLS header
# 1280 - 40 - 8 - 21
CONFIG_MBEDTLS_SSL_IN_CONTENT_LEN=1211
CONFIG_MBEDTLS_SSL_OUT_CONTENT_LEN=1211
CONFIG_MBEDTLS_HEAP_SIZE=7168
# Enable PSK instead
CONFIG_MBEDTLS_KEY_EXCHANGE_PSK_ENABLED=y
CONFIG_LWM2M_SECURITY_DTLS_TLS_CIPHERSUITE_MAX=3

CONFIG_PSA_CRYPTO=y
CONFIG_PSA_WANT_KEY_TYPE_AES=y
CONFIG_PSA_WANT_ALG_CCM=y
CONFIG_PSA_WANT_ALG_SHA_256=y
CONFIG_PSA_WANT_ALG_TLS12_PRF=y
CONFIG_PSA_WANT_ALG_TLS12_PSK_TO_MS=y

CONFIG_NET_SOCKETS_SOCKOPT_TLS=y
# For testing purposes, limit DTLS contexts to one,
# LwM2M engine should not use more than one on any given time.
CONFIG_NET_SOCKETS_TLS_MAX_CONTEXTS=1
CONFIG_NET_SOCKETS_ENABLE_DTLS=y

# Assume that IPv6 minimum MTU is accepted
# MTU - IPv6 header - UDP header - DTLS header - CoAP header room
# 1280 - 40 - 8 - 21 - 48
CONFIG_LWM2M_COAP_MAX_MSG_SIZE=1163
CONFIG_LWM2M_COAP_BLOCK_SIZE=512
CONFIG_LWM2M_COAP_BLOCK_TRANSFER=y
CONFIG_LWM2M_COAP_ENCODE_BUFFER_SIZE=8192
CONFIG_LWM2M_NUM_OUTPUT_BLOCK_CONTEXT=2
CONFIG_LWM2M_NUM_BLOCK1_CONTEXT=2
CONFIG_SYS_HASH_FUNC32=y
CONFIG_LWM2M_ENGINE_VALIDATION_BUFFER_SIZE=0
CONFIG_LWM2M_ENGINE_MAX_PENDING=2
CONFIG_LWM2M_ENGINE_MAX_REPLIES=2
CONFIG_LWM2M_ENGINE_MAX_MESSAGES=3
CONFIG_LWM2M_ENGINE_MAX_OBSERVER=5
CONFIG_LWM2M_DEVICE_PWRSRC_MAX=2
CONFIG_LWM2M_DEVICE_ERROR_CODE_MAX=2
CONFIG_LWM2M_DEVICE_EXT_DEV_INFO_MAX=2
CONFIG_LWM2M_NUM_ATTR=20

# Configure stack sizes
CONFIG_MAIN_STACK_SIZE=1024
CONFIG_SYSTEM_WORKQUEUE_STACK_SIZE=512
CONFIG_SHELL_STACK_SIZE=1536
CONFIG_LWM2M_ENGINE_STACK_SIZE=2048
```

## boards/native_posix.conf
```kconfig
CONFIG_DNS_RESOLVER=y
CONFIG_DNS_SERVER_IP_ADDRESSES=y
CONFIG_DNS_SERVER1="192.0.2.2"
CONFIG_LWM2M_DNS_SUPPORT=y
CONFIG_NET_CONFIG_MY_IPV4_GW="192.0.2.2"
CONFIG_NATIVE_POSIX_SLOWDOWN_TO_REAL_TIME=y
CONFIG_NATIVE_UART_0_ON_STDINOUT=y
CONFIG_ASAN=y
```

## boards/native_sim.conf
```kconfig
CONFIG_DNS_RESOLVER=y
CONFIG_DNS_SERVER_IP_ADDRESSES=y
CONFIG_DNS_SERVER1="192.0.2.2"
CONFIG_LWM2M_DNS_SUPPORT=y
CONFIG_NATIVE_SIM_SLOWDOWN_TO_REAL_TIME=y
CONFIG_UART_NATIVE_PTY_0_ON_STDINOUT=y
CONFIG_ASAN=y
CONFIG_NATIVE_EXTRA_CMDLINE_ARGS="--seed-random"
CONFIG_HEAP_MEM_POOL_SIZE=32768
CONFIG_ZVFS_OPEN_ADD_SIZE_NET=8
```

## boards/qemu_cortex_m3.conf
```kconfig
CONFIG_NET_L2_ETHERNET=y
CONFIG_ETH_DRIVER=y
CONFIG_ETH_STELLARIS=y
CONFIG_NET_QEMU_ETHERNET=y

# RAM/ROM tuning
CONFIG_IDLE_STACK_SIZE=128
CONFIG_ISR_STACK_SIZE=512
CONFIG_LWM2M_LOG_LEVEL_INF=y
CONFIG_LOG_BUFFER_SIZE=512

# qemu_cortex_m3 have smaller memory so simulate a small
# device and small network where max CoAP packet is 256+headers.
# This excercises the outgoing block-wise module intentionally.
CONFIG_LWM2M_COAP_MAX_MSG_SIZE=256
CONFIG_LWM2M_COAP_BLOCK_SIZE=256
CONFIG_LWM2M_COAP_BLOCK_TRANSFER=y
CONFIG_LWM2M_COAP_ENCODE_BUFFER_SIZE=2048
```

## boards/qemu_x86.conf
```kconfig
CONFIG_FPU=y
CONFIG_NET_QEMU_ETHERNET=y
CONFIG_PCIE=y
```

## src/firmware_update.c
```c
/*
 * Copyright (c) 2024 Nordic Semiconductor
 *
 * SPDX-License-Identifier: Apache-2.0
 */

#define LOG_MODULE_NAME app_fw_update
#define LOG_LEVEL LOG_LEVEL_DBG
#include <zephyr/logging/log.h>
LOG_MODULE_REGISTER(LOG_MODULE_NAME);

#include <zephyr/net/lwm2m.h>
#include <zephyr/sys/crc.h>
#include <lwm2m_engine.h>

static uint8_t firmware_buf[64];
static uint32_t crc;

/* Array with supported PULL firmware update protocols */
static uint8_t supported_protocol[1];

static int firmware_update_cb(uint16_t obj_inst_id,
			      uint8_t *args, uint16_t args_len)
{
	LOG_INF("UPDATE, (CRC %u)", crc);

	lwm2m_set_u8(&LWM2M_OBJ(5, 0, 3), STATE_IDLE);
	lwm2m_set_u8(&LWM2M_OBJ(5, 0, 5), RESULT_SUCCESS);
	return 0;
}

static void *firmware_get_buf(uint16_t obj_inst_id, uint16_t res_id,
			      uint16_t res_inst_id, size_t *data_len)
{
	*data_len = sizeof(firmware_buf);
	return firmware_buf;
}

static int firmware_block_received_cb(uint16_t obj_inst_id, uint16_t res_id,
				      uint16_t res_inst_id, uint8_t *data,
				      uint16_t data_len, bool last_block,
				      size_t total_size, size_t offset)
{
	if (offset == 0) {
		crc = crc32_ieee(data, data_len);
	} else {
		crc = crc32_ieee_update(crc, data, data_len);
	}
	LOG_INF("FIRMWARE: BLOCK RECEIVED: offset:%zd len:%u last_block:%d crc: %u",
		offset, data_len, last_block, crc);

	/* Add extra delay so short block-wise may timeout */
	k_sleep(K_MSEC(100));
	return 0;
}

static int firmware_cancel_cb(const uint16_t obj_inst_id)
{
	LOG_INF("FIRMWARE: Update canceled");
	return 0;
}

static int init_firmware_update(void)
{
	/* setup data buffer for block-wise transfer */
	lwm2m_register_pre_write_callback(&LWM2M_OBJ(5, 0, 0), firmware_get_buf);
	lwm2m_firmware_set_write_cb(firmware_block_received_cb);

	/* register cancel callback */
	lwm2m_firmware_set_cancel_cb(firmware_cancel_cb);
	lwm2m_firmware_set_update_cb(firmware_update_cb);

	lwm2m_create_res_inst(&LWM2M_OBJ(5, 0, 8, 0));
	lwm2m_set_res_buf(&LWM2M_OBJ(5, 0, 8, 0), &supported_protocol[0],
					sizeof(supported_protocol[0]),
					sizeof(supported_protocol[0]), 0);

	return 0;
}
LWM2M_APP_INIT(init_firmware_update);
```

## src/generic_async.c
```c
/*
 * Copyright (c) 2025 Nordic Semiconductor
 *
 * SPDX-License-Identifier: Apache-2.0
 */

#define LOG_MODULE_NAME app_generic_async
#include <zephyr/logging/log.h>
LOG_MODULE_REGISTER(LOG_MODULE_NAME);

#include <lwm2m_resource_ids.h>
#include <lwm2m_engine.h>
#include <zephyr/net/lwm2m.h>

#if defined(CONFIG_LWM2M_ASYNC_RESPONSES)

/* Dummy generic sensor instance demonstrating asynchronous operations. */

static struct k_work_delayable delayed_exec_work;
static struct k_work_delayable delayed_read_work;
static struct k_work_delayable delayed_write_work;

static double sensor_value;
static int64_t value_timestamp;

static void update_sensor_value(void)
{
	sensor_value += 1.0;
	value_timestamp = k_uptime_get();

	lwm2m_set_f64(&LWM2M_OBJ(IPSO_OBJECT_GENERIC_SENSOR_ID, 0,
				 SENSOR_VALUE_RID), sensor_value);
}

/* Asynchronous read example */

static struct k_fifo pending_reads;

static void *value_read_cb(uint16_t obj_inst_id,
			   uint16_t res_id,
			   uint16_t res_inst_id,
			   size_t *data_len)
{
	static void *value_ctx;

	ARG_UNUSED(obj_inst_id);
	ARG_UNUSED(res_id);
	ARG_UNUSED(res_inst_id);
	ARG_UNUSED(data_len);

	/* Assume data is valid for 100 miliseconds second after update */
	if (value_timestamp != 0 && k_uptime_get() < value_timestamp + 100) {
		goto got_data;
	}

	/* Simulate delayed sensor read. */
	k_work_schedule(&delayed_read_work, K_MSEC(500));

	value_ctx = lwm2m_response_postpone(lwm2m_rd_client_ctx());
	if (value_ctx == NULL) {
		LOG_INF("Engine rejected postponed response request, block.");
		goto wait_data;
	}

	if (k_fifo_alloc_put(&pending_reads, value_ctx) < 0) {
		(void)lwm2m_response_resume(lwm2m_rd_client_ctx(), value_ctx, -ENOMEM);
	}

	return NULL;

wait_data:
	lwm2m_acknowledge(lwm2m_rd_client_ctx());
	k_sleep(K_MSEC(500));
	update_sensor_value();

got_data:
	*data_len = sizeof(sensor_value);

	return &sensor_value;
}

static void delayed_read_cb(struct k_work *work)
{
	void *value_ctx;
	int ret;

	ARG_UNUSED(work);

	update_sensor_value();

	/* Resume pending reads. */
	while ((value_ctx = k_fifo_get(&pending_reads, K_NO_WAIT)) != NULL) {
		ret = lwm2m_response_resume(lwm2m_rd_client_ctx(), value_ctx, 0);
		if (ret < 0) {
			LOG_INF("Resuming delayed read failed %d", ret);
		}
	}
}

/* Asynchronous write example */

static void *app_type_ctx;

int app_type_post_write_cb(uint16_t obj_inst_id, uint16_t res_id,
			   uint16_t res_inst_id, uint8_t *data,
			   uint16_t data_len, bool last_block,
			   size_t total_size, size_t offset)
{
	ARG_UNUSED(obj_inst_id);
	ARG_UNUSED(res_id);
	ARG_UNUSED(res_inst_id);
	ARG_UNUSED(data);
	ARG_UNUSED(data_len);
	ARG_UNUSED(last_block);
	ARG_UNUSED(total_size);
	ARG_UNUSED(offset);

	/* In case another write is already pending, return an error. */
	if (app_type_ctx != NULL) {
		return -ECANCELED;
	}

	app_type_ctx = lwm2m_response_postpone(lwm2m_rd_client_ctx());
	if (app_type_ctx != NULL) {
		/* Simulate delayed write processing. */
		k_work_schedule(&delayed_write_work, K_MSEC(500));
	} else {
		LOG_INF("Engine rejected postponed response request, block.");

		/* Simulate delayed write processing. */
		lwm2m_acknowledge(lwm2m_rd_client_ctx());
		k_sleep(K_MSEC(500));
	}

	return 0;
}

static void delayed_write_cb(struct k_work *work)
{
	int ret;

	ARG_UNUSED(work);

	if (app_type_ctx == NULL) {
		return;
	}

	ret = lwm2m_response_resume(lwm2m_rd_client_ctx(), app_type_ctx, 0);
	if (ret < 0) {
		LOG_INF("Resuming delayed write failed %d", ret);
	}

	app_type_ctx = NULL;
}

/* Asynchronous exec example */

static void *min_max_reset_ctx;

static void min_max_reset(void)
{
	lwm2m_set_f64(&LWM2M_OBJ(IPSO_OBJECT_GENERIC_SENSOR_ID, 0,
				 MIN_MEASURED_VALUE_RID), sensor_value);
	lwm2m_set_f64(&LWM2M_OBJ(IPSO_OBJECT_GENERIC_SENSOR_ID, 0,
				 MAX_MEASURED_VALUE_RID), sensor_value);
}

static int min_max_reset_exec_cb(uint16_t obj_inst_id, uint8_t *args,
				 uint16_t args_len)
{
	ARG_UNUSED(obj_inst_id);
	ARG_UNUSED(args);
	ARG_UNUSED(args_len);

	/* In case another exec is already pending, return an error. */
	if (min_max_reset_ctx != NULL) {
		return -ECANCELED;
	}

	min_max_reset_ctx = lwm2m_response_postpone(lwm2m_rd_client_ctx());
	if (min_max_reset_ctx != NULL) {
		/* Simulate delayed exec processing. */
		k_work_schedule(&delayed_exec_work, K_MSEC(500));
	} else {
		LOG_INF("Engine rejected postponed response request, block.");

		/* Simulate delayed exec processing. */
		lwm2m_acknowledge(lwm2m_rd_client_ctx());
		k_sleep(K_MSEC(500));
		min_max_reset();
	}

	return 0;
}

static void delayed_exec_cb(struct k_work *work)
{
	int ret;

	ARG_UNUSED(work);

	if (min_max_reset_ctx == NULL) {
		return;
	}

	min_max_reset();

	ret = lwm2m_response_resume(lwm2m_rd_client_ctx(), min_max_reset_ctx, 0);
	if (ret < 0) {
		LOG_INF("Resuming delayed exec failed %d", ret);
	}

	min_max_reset_ctx = NULL;
}

static int create_generic_async(uint16_t obj_inst_id)
{
	sensor_value = 0.0;

	lwm2m_register_read_callback(&LWM2M_OBJ(IPSO_OBJECT_GENERIC_SENSOR_ID,
						obj_inst_id, SENSOR_VALUE_RID),
				     value_read_cb);
	lwm2m_register_post_write_callback(&LWM2M_OBJ(IPSO_OBJECT_GENERIC_SENSOR_ID,
						      obj_inst_id, APPLICATION_TYPE_RID),
					   app_type_post_write_cb);
	lwm2m_register_exec_callback(&LWM2M_OBJ(IPSO_OBJECT_GENERIC_SENSOR_ID, obj_inst_id,
						RESET_MIN_MAX_MEASURED_VALUES_RID),
				     min_max_reset_exec_cb);

	return 0;
}

static int init_generic_async_object(void)
{
	lwm2m_register_create_callback(IPSO_OBJECT_GENERIC_SENSOR_ID, create_generic_async);

	k_work_init_delayable(&delayed_exec_work, delayed_exec_cb);
	k_work_init_delayable(&delayed_read_work, delayed_read_cb);
	k_work_init_delayable(&delayed_write_work, delayed_write_cb);
	k_fifo_init(&pending_reads);

	return 0;
}

LWM2M_APP_INIT(init_generic_async_object);

#endif /* defined(CONFIG_LWM2M_ASYNC_RESPONSES) */
```

## src/lwm2m-client.c
```c
/*
 * Copyright (c) 2017 Linaro Limited
 * Copyright (c) 2017-2019 Foundries.io
 *
 * SPDX-License-Identifier: Apache-2.0
 */

#define LOG_MODULE_NAME net_lwm2m_client_app
#define LOG_LEVEL LOG_LEVEL_DBG

#include <zephyr/logging/log.h>
LOG_MODULE_REGISTER(LOG_MODULE_NAME);
#include <stdlib.h>
#include <zephyr/kernel.h>
#include <zephyr/drivers/sensor.h>
#include <zephyr/net/lwm2m.h>
#include <zephyr/net/socket.h>
#include "lwm2m_rd_client.h"

#define APP_BANNER "Run LwM2M client"

#define WAIT_TIME	K_SECONDS(10)
#define CONNECT_TIME	K_SECONDS(10)

#define NAME	"Zephyr"
#define MODEL	"client-1"
#define SERIAL	"serial-1"
#define VERSION	"1.2.3"

static struct lwm2m_ctx client;
static void rd_client_event(struct lwm2m_ctx *client,
			    enum lwm2m_rd_client_event client_event);
static void observe_cb(enum lwm2m_observe_event event,
		       struct lwm2m_obj_path *path, void *user_data);

static uint8_t bat_idx = LWM2M_DEVICE_PWR_SRC_TYPE_BAT_INT;
static int bat_mv = 3800;
static int bat_ma = 125;
static uint8_t usb_idx = LWM2M_DEVICE_PWR_SRC_TYPE_USB;
static int usb_mv = 5000;
static int usb_ma = 900;

static void reboot_handler(struct k_work *work)
{
	/* I cannot really restart the client, as we don't know
	 * the endpoint name. Testcase sets that on a command line.
	 * So we only stop.
	 */
	lwm2m_rd_client_stop(&client, rd_client_event, true);
}

K_WORK_DEFINE(reboot_work, reboot_handler);

static int device_reboot_cb(uint16_t obj_inst_id,
			    uint8_t *args, uint16_t args_len)
{
	LOG_INF("DEVICE: REBOOT");
	k_work_submit(&reboot_work);
	return 0;
}

int set_socketoptions(struct lwm2m_ctx *ctx)
{
	if (IS_ENABLED(CONFIG_MBEDTLS_SSL_DTLS_CONNECTION_ID) && ctx->use_dtls) {
		int ret;

		/* Enable CID */
		int cid = ZSOCK_TLS_DTLS_CID_ENABLED;

		ret = zsock_setsockopt(ctx->sock_fd, ZSOCK_SOL_TLS, ZSOCK_TLS_DTLS_CID, &cid,
				       sizeof(cid));
		if (ret) {
			ret = -errno;
			LOG_ERR("Failed to enable TLS_DTLS_CID: %d", ret);
		}

		/* Allow DTLS handshake to timeout much faster.
		 * these tests run on TUN/TAP network, so there should be no network latency.
		 */
		uint32_t min = 100;
		uint32_t max = 500;

		zsock_setsockopt(ctx->sock_fd, ZSOCK_SOL_TLS, ZSOCK_TLS_DTLS_HANDSHAKE_TIMEOUT_MIN,
				 &min, sizeof(min));
		zsock_setsockopt(ctx->sock_fd, ZSOCK_SOL_TLS, ZSOCK_TLS_DTLS_HANDSHAKE_TIMEOUT_MAX,
				 &max, sizeof(max));
	}
	return lwm2m_set_default_sockopt(ctx);
}

static int create_appdata(uint16_t obj_inst_id)
{
	/* Create BinaryAppData object */
	static uint8_t data[4096];
	static char description[16];

	lwm2m_set_res_buf(&LWM2M_OBJ(19, 0, 0, 0), data, sizeof(data), 0, 0);
	lwm2m_set_res_buf(&LWM2M_OBJ(19, 0, 3), description, sizeof(description), 0, 0);

	return 0;
}

static void lwm2m_setup(void)
{
	/* setup DEVICE object */

	lwm2m_set_res_buf(&LWM2M_OBJ(3, 0, 0), NAME, sizeof(NAME),
			  sizeof(NAME), LWM2M_RES_DATA_FLAG_RO);
	lwm2m_set_res_buf(&LWM2M_OBJ(3, 0, 1), MODEL, sizeof(MODEL),
			  sizeof(MODEL), LWM2M_RES_DATA_FLAG_RO);
	lwm2m_set_res_buf(&LWM2M_OBJ(3, 0, 2), SERIAL, sizeof(SERIAL),
			  sizeof(SERIAL), LWM2M_RES_DATA_FLAG_RO);
	lwm2m_set_res_buf(&LWM2M_OBJ(3, 0, 3), VERSION, sizeof(VERSION),
			  sizeof(VERSION), LWM2M_RES_DATA_FLAG_RO);
	lwm2m_register_exec_callback(&LWM2M_OBJ(3, 0, 4), device_reboot_cb);
	lwm2m_set_res_buf(&LWM2M_OBJ(3, 0, 17), CONFIG_BOARD, sizeof(CONFIG_BOARD),
			  sizeof(CONFIG_BOARD), LWM2M_RES_DATA_FLAG_RO);

	/* add power source resource instances */
	lwm2m_create_res_inst(&LWM2M_OBJ(3, 0, 6, 0));
	lwm2m_set_res_buf(&LWM2M_OBJ(3, 0, 6, 0), &bat_idx, sizeof(bat_idx), sizeof(bat_idx), 0);
	lwm2m_create_res_inst(&LWM2M_OBJ(3, 0, 7, 0));
	lwm2m_set_res_buf(&LWM2M_OBJ(3, 0, 7, 0), &bat_mv, sizeof(bat_mv), sizeof(bat_mv), 0);
	lwm2m_create_res_inst(&LWM2M_OBJ(3, 0, 8, 0));
	lwm2m_set_res_buf(&LWM2M_OBJ(3, 0, 8, 0), &bat_ma, sizeof(bat_ma), sizeof(bat_ma), 0);
	lwm2m_create_res_inst(&LWM2M_OBJ(3, 0, 6, 1));
	lwm2m_set_res_buf(&LWM2M_OBJ(3, 0, 6, 1), &usb_idx, sizeof(usb_idx), sizeof(usb_idx), 0);
	lwm2m_create_res_inst(&LWM2M_OBJ(3, 0, 7, 1));
	lwm2m_set_res_buf(&LWM2M_OBJ(3, 0, 7, 1), &usb_mv, sizeof(usb_mv), sizeof(usb_mv), 0);
	lwm2m_create_res_inst(&LWM2M_OBJ(3, 0, 8, 1));
	lwm2m_set_res_buf(&LWM2M_OBJ(3, 0, 8, 1), &usb_ma, sizeof(usb_ma), sizeof(usb_ma), 0);

	lwm2m_register_create_callback(19, create_appdata);
}

static void rd_client_event(struct lwm2m_ctx *client,
			    enum lwm2m_rd_client_event client_event)
{
	switch (client_event) {

	case LWM2M_RD_CLIENT_EVENT_NONE:
		/* do nothing */
		break;

	case LWM2M_RD_CLIENT_EVENT_SERVER_DISABLED:
		LOG_DBG("LwM2M server disabled");
		break;

	case LWM2M_RD_CLIENT_EVENT_BOOTSTRAP_REG_FAILURE:
		LOG_DBG("Bootstrap registration failure!");
		break;

	case LWM2M_RD_CLIENT_EVENT_BOOTSTRAP_REG_COMPLETE:
		LOG_DBG("Bootstrap registration complete");
		break;

	case LWM2M_RD_CLIENT_EVENT_BOOTSTRAP_TRANSFER_COMPLETE:
		LOG_DBG("Bootstrap transfer complete");
		break;

	case LWM2M_RD_CLIENT_EVENT_REGISTRATION_FAILURE:
		LOG_DBG("Registration failure!");
		break;

	case LWM2M_RD_CLIENT_EVENT_REGISTRATION_COMPLETE:
		LOG_DBG("Registration complete");
		break;

	case LWM2M_RD_CLIENT_EVENT_REG_TIMEOUT:
		LOG_DBG("Registration timeout!");
		break;

	case LWM2M_RD_CLIENT_EVENT_REG_UPDATE_COMPLETE:
		LOG_DBG("Registration update complete");
		break;

	case LWM2M_RD_CLIENT_EVENT_DEREGISTER_FAILURE:
		LOG_DBG("Deregister failure!");
		break;

	case LWM2M_RD_CLIENT_EVENT_DISCONNECT:
		LOG_DBG("Disconnected");
		break;

	case LWM2M_RD_CLIENT_EVENT_QUEUE_MODE_RX_OFF:
		LOG_DBG("Queue mode RX window closed");
		break;

	case LWM2M_RD_CLIENT_EVENT_ENGINE_SUSPENDED:
		LOG_DBG("LwM2M engine suspended");
		break;

	case LWM2M_RD_CLIENT_EVENT_NETWORK_ERROR:
		LOG_ERR("LwM2M engine reported a network error.");
		lwm2m_rd_client_stop(client, rd_client_event, true);
		break;

	case LWM2M_RD_CLIENT_EVENT_REG_UPDATE:
		LOG_DBG("Registration update");
		break;
	case LWM2M_RD_CLIENT_EVENT_DEREGISTER:
		LOG_DBG("Deregistration client");
		break;
	}
}

static void observe_cb(enum lwm2m_observe_event event,
		       struct lwm2m_obj_path *path, void *user_data)
{
	char buf[LWM2M_MAX_PATH_STR_SIZE];

	switch (event) {

	case LWM2M_OBSERVE_EVENT_OBSERVER_ADDED:
		LOG_INF("Observer added for %s", lwm2m_path_log_buf(buf, path));
		break;

	case LWM2M_OBSERVE_EVENT_OBSERVER_REMOVED:
		LOG_INF("Observer removed for %s", lwm2m_path_log_buf(buf, path));
		break;

	case LWM2M_OBSERVE_EVENT_NOTIFY_ACK:
		LOG_INF("Notify acknowledged for %s", lwm2m_path_log_buf(buf, path));
		break;

	case LWM2M_OBSERVE_EVENT_NOTIFY_TIMEOUT:
		LOG_INF("Notify timeout for %s, trying registration update",
			lwm2m_path_log_buf(buf, path));

		lwm2m_rd_client_update();
		break;
	}
}

int main(void)
{
	lwm2m_setup();

	client.tls_tag = 1;
	client.set_socketoptions = set_socketoptions;
	client.event_cb = rd_client_event;
	client.observe_cb = observe_cb;
	client.sock_fd = -1;

	lwm2m_rd_client_set_ctx(&client);

	return 0;
}
```
