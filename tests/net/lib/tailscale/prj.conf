## CMakeLists.txt
```
# SPDX-FileCopyrightText: Copyright The Zephyr Project Contributors
# SPDX-License-Identifier: Apache-2.0

cmake_minimum_required(VERSION 3.28.0)
find_package(Zephyr REQUIRED HINTS "$ENV{ZEPHYR_BASE}")
project(tailscale_map_stream)

target_include_directories(app PRIVATE "${ZEPHYR_BASE}/subsys/net/lib/tailscale")
target_sources_ifdef(CONFIG_TAILSCALE_MAP_STREAM app PRIVATE src/map_stream.c)
target_sources_ifdef(CONFIG_TAILSCALE_CONTROL_STREAM app PRIVATE src/control_stream.c)
target_sources_ifdef(CONFIG_TAILSCALE_PEER_INVENTORY app PRIVATE src/peer_inventory.c)
target_sources_ifdef(CONFIG_TAILSCALE_POLICY app PRIVATE src/policy.c)
target_sources_ifdef(CONFIG_TAILSCALE_POLICY app PRIVATE src/dns_policy.c)
target_sources_ifdef(CONFIG_TAILSCALE_POLICY app PRIVATE src/named_filter.c)
```

## prj.conf
```kconfig
# SPDX-FileCopyrightText: Copyright The Zephyr Project Contributors
# SPDX-License-Identifier: Apache-2.0

CONFIG_ZTEST=y
CONFIG_NETWORKING=y
CONFIG_NET_TEST=y
CONFIG_NET_SOCKETS=y
CONFIG_NET_SOCKETPAIR=y
CONFIG_NET_SOCKETPAIR_BUFFER_SIZE=128
CONFIG_NET_SOCKETPAIR_STATIC=y
CONFIG_TAILSCALE_CONTROL_STREAM=y
CONFIG_TAILSCALE_PEER_INVENTORY=y
CONFIG_NET_IPV4=y
CONFIG_NET_IPV6=y
```

## src/control_stream.c
```c
/*
 * SPDX-FileCopyrightText: Copyright The Zephyr Project Contributors
 * SPDX-License-Identifier: Apache-2.0
 */

#include <errno.h>
#include "tailscale_internal.h"
#include <zephyr/ztest.h>

struct control_fixture {
	struct tailscale_control_stream stream;
	uint32_t attempts;
	uint32_t reads;
	uint32_t closed;
	uint32_t applied;
	int reason[2];
};

static int open_response(void *data)
{
	struct control_fixture *fixture = data;

	fixture->attempts++;
	fixture->reads = 0;
	return 0;
}

static int next_chunk(int64_t deadline, const uint8_t **data, size_t *len, void *user_data)
{
	static const uint8_t partial[] = {8, 0, 0, 0, '{'};
	static const uint8_t next_map[] = {2, 0, 0, 0, '{', '}'};
	struct control_fixture *fixture = user_data;

	fixture->reads++;
	if (fixture->attempts == 1U) {
		if (fixture->reads == 1U) {
			*data = partial;
			*len = sizeof(partial);
			return 0;
		}

		k_sleep(K_TIMEOUT_ABS_MS(deadline + 1));
	}
	*data = next_map;
	*len = sizeof(next_map);
	return 0;
}

static void close_response(void *data)
{
	struct control_fixture *fixture = data;

	fixture->closed++;
}

static int apply_map(uint32_t generation, uint8_t *json, size_t len, void *data)
{
	struct control_fixture *fixture = data;

	zassert_equal(generation, 2U);
	zassert_equal(len, 2U);
	zassert_mem_equal(json, "{}", len);
	fixture->applied++;
	tailscale_control_stream_cancel(&fixture->stream);
	return 0;
}

static void receive_event(uint32_t generation, enum tailscale_control_stream_event event,
			  int reason, void *user_data)
{
	struct control_fixture *fixture = user_data;

	if (event == TAILSCALE_CONTROL_STREAM_CLOSED) {
		zassert_equal(generation, fixture->closed);
		zassert_between_inclusive(generation, 1U, ARRAY_SIZE(fixture->reason));
		fixture->reason[generation - 1U] = reason;
	}
}

ZTEST(tailscale_control_stream, test_timeout_discards_partial_map_then_reconnects)
{
	static const struct tailscale_control_stream_ops ops = {
		.open = open_response,
		.read = next_chunk,
		.close = close_response,
		.map = apply_map,
		.event = receive_event,
	};
	struct control_fixture fixture = {0};
	uint8_t frame[8];
	const struct tailscale_control_stream_config config = {
		.frame = frame,
		.capacity = sizeof(frame),
		.idle_ms = 10U,
		.retry_min_ms = 1U,
		.retry_max_ms = 4U,
	};

	tailscale_control_stream_init(&fixture.stream);
	zassert_ok(tailscale_control_stream_run(&fixture.stream, &config, &ops, &fixture));
	zexpect_equal(fixture.attempts, 2U);
	zexpect_equal(fixture.closed, 2U);
	zexpect_equal(fixture.applied, 1U);
	zexpect_equal(fixture.reason[0], -ETIMEDOUT);
	zexpect_equal(fixture.reason[1], -ECANCELED);
}

ZTEST_SUITE(tailscale_control_stream, NULL, NULL, NULL, NULL, NULL);
```

## src/dns_policy.c
```c
/*
 * SPDX-FileCopyrightText: Copyright The Zephyr Project Contributors
 * SPDX-License-Identifier: Apache-2.0
 */

#include <errno.h>
#include <string.h>

#include <zephyr/net/net_ip.h>
#include "tailscale_internal.h"
#include <zephyr/ztest.h>

#define SELF_KEY "nodekey:0101010101010101010101010101010101010101010101010101010101010101"
#define PEER_KEY "nodekey:0202020202020202020202020202020202020202020202020202020202020202"
#define SELF "{\"ID\":1,\"Key\":\"" SELF_KEY "\",\"Name\":\"node.Tail.Example.\"," \
	     "\"Addresses\":[\"100.64.0.1/32\"]}"
#define NAMED_PEER(name, fields) \
	"{\"ID\":2,\"Key\":\"" PEER_KEY "\",\"Name\":\"" name "\",\"Addresses\":[" \
	"\"100.64.0.2/32\",\"fd7a:115c:a1e0::2/128\"]" fields "}"
#define PEER NAMED_PEER("peer.shared.example.", "")
#define SERVER(address) "{\"Addr\":\"" address "\"}"
#define FULL_DNS "{\"Proxied\":true,\"Resolvers\":[" SERVER("192.0.2.53") "]," \
		 "\"Routes\":{\"corp.Example.\":[" SERVER("100.64.0.2") "," \
		 SERVER("[fd7a:115c:a1e0::2]:5353") "],\"private.corp.example\":[]," \
		 "\"dev.private.corp.example\":[" SERVER("100.64.0.3:5354") "]}}"
#define INITIAL "{\"Seq\":1,\"Node\":" SELF ",\"Peers\":[" PEER "],\"DNSConfig\":" FULL_DNS "}"
#define REPLACEMENT "{\"Seq\":2,\"PeersRemoved\":[2],\"PacketFilter\":[],\"DNSConfig\":{}}"

static struct tailscale_policy policy;
static struct {
	const struct tailscale_packet_filter *filter;
	size_t peer_count;
	unsigned int attempts;
	int error;
	bool pause;
} installed;

static K_SEM_DEFINE(install_ready, 0, 1);
static K_SEM_DEFINE(install_release, 0, 1);
static K_SEM_DEFINE(reader_ready, 0, 1);
static K_SEM_DEFINE(reader_done, 0, 1);
static K_THREAD_STACK_DEFINE(installer_stack, CONFIG_ZTEST_STACK_SIZE);
static K_THREAD_STACK_DEFINE(reader_stack, CONFIG_ZTEST_STACK_SIZE);
static struct k_thread installer;
static struct k_thread reader;

static int install(const struct tailscale_peer_snapshot *peers,
		   const struct tailscale_packet_filter *filter, void *context)
{
	ARG_UNUSED(context);

	installed.attempts++;
	if (installed.pause) {
		k_sem_give(&install_ready);
		zassert_ok(k_sem_take(&install_release, K_SECONDS(1)));
	}
	if (installed.error != 0) {
		return installed.error;
	}
	installed.filter = filter;
	installed.peer_count = peers->count;
	return 0;
}

static int apply(uint32_t generation, const char *json)
{
	return tailscale_policy_apply(&policy, generation, (uint8_t *)json, strlen(json),
				      install, NULL, NULL);
}

static void reset(void *fixture)
{
	ARG_UNUSED(fixture);

	tailscale_policy_init(&policy);
	memset(&installed, 0, sizeof(installed));
}

static struct tailscale_dns_selection select_dns(const char *name, uint32_t generation,
						uint64_t revision, enum tailscale_dns_source source)
{
	struct tailscale_dns_selection selection;

	zassert_ok(tailscale_policy_select_dns(&policy, name, &selection));
	zassert_equal(selection.generation, generation);
	zassert_equal(selection.revision, revision);
	zassert_equal(selection.source, source, "Name %s", name);
	return selection;
}

static void expect_server(const struct tailscale_dns_server *server, uint8_t family,
			  const char *address, uint16_t port)
{
	uint8_t bytes[16] = {0};

	zassert_ok(net_addr_pton(family, address, bytes));
	zassert_equal(server->family, family);
	zassert_equal(server->port, port);
	zassert_mem_equal(server->address, bytes, sizeof(bytes));
}

ZTEST(tailscale_dns_policy, test_effective_absolute_dns_selection)
{
	struct tailscale_dns_selection dns;

	zassert_equal(tailscale_policy_select_dns(&policy, "public.example", &dns), -ENODATA);
	zassert_ok(apply(1U, INITIAL));
	dns = select_dns("_dns.Host.CoRP.EXAMPLE.", 1U, 1U, TAILSCALE_DNS_SPLIT);
	zassert_equal(dns.server_count, 2U);
	expect_server(&dns.servers[0], NET_AF_INET, "100.64.0.2", 53U);
	expect_server(&dns.servers[1], NET_AF_INET6, "fd7a:115c:a1e0::2", 5353U);
	dns = select_dns("dev.private.corp.example", 1U, 1U, TAILSCALE_DNS_SPLIT);
	zassert_equal(dns.server_count, 1U);
	expect_server(&dns.servers[0], NET_AF_INET, "100.64.0.3", 5354U);
	dns = select_dns("private.corp.example", 1U, 1U, TAILSCALE_DNS_LOCAL);
	zassert_equal(dns.server_count, 0U);
	dns = select_dns("another.Tail.Example", 1U, 1U, TAILSCALE_DNS_LOCAL);
	zassert_equal(dns.server_count, 0U);
	dns = select_dns("2.0.64.100.in-addr.arpa.", 1U, 1U, TAILSCALE_DNS_LOCAL);
	zassert_equal(dns.server_count, 0U);
	dns = select_dns("0.e.1.a.c.5.1.1.a.7.d.f.ip6.arpa.", 1U, 1U, TAILSCALE_DNS_LOCAL);
	zassert_equal(dns.server_count, 0U);
	dns = select_dns("2.0.63.100.in-addr.arpa.", 1U, 1U, TAILSCALE_DNS_DEFAULT);
	zassert_equal(dns.server_count, 1U);
	dns = select_dns("notcorp.example", 1U, 1U, TAILSCALE_DNS_DEFAULT);
	zassert_equal(dns.server_count, 1U);
	expect_server(&dns.servers[0], NET_AF_INET, "192.0.2.53", 53U);
	zassert_equal(tailscale_policy_select_dns(&policy, "broken..example", &dns), -EINVAL);
}

ZTEST(tailscale_dns_policy, test_stream_inheritance_and_explicit_clear)
{
	zassert_ok(apply(1U, INITIAL));
	zassert_ok(apply(1U, "{\"Seq\":2,\"Peers\":[" PEER "]}"));
	(void)select_dns("tail.example", 1U, 2U, TAILSCALE_DNS_LOCAL);
	zassert_ok(apply(1U, "{\"Seq\":3,\"PacketFilter\":[],\"DNSConfig\":null}"));
	(void)select_dns("a.corp.example", 1U, 3U, TAILSCALE_DNS_SPLIT);
	zassert_ok(apply(1U, "{\"KeepAlive\":true,\"DNSConfig\":{}}"));
	(void)select_dns("public.example", 1U, 3U, TAILSCALE_DNS_DEFAULT);
	zassert_ok(apply(1U, "{\"Seq\":4,\"DNSConfig\":{}}"));
	(void)select_dns("a.corp.example", 1U, 4U, TAILSCALE_DNS_NONE);
	zassert_ok(apply(1U, "{\"Seq\":5,\"DNSConfig\":{\"Proxied\":true}}"));
	(void)select_dns("tail.example", 1U, 5U, TAILSCALE_DNS_LOCAL);
	zassert_ok(apply(2U, "{\"Seq\":1,\"Node\":" SELF ",\"Peers\":[]}"));
	(void)select_dns("tail.example", 2U, 6U, TAILSCALE_DNS_NONE);
}

ZTEST(tailscale_dns_policy, test_magic_dns_uses_active_node_addresses_only)
{
	struct tailscale_dns_answer answer;
	uint8_t ipv6[16];

	zassert_equal(tailscale_policy_resolve_magic_dns(&policy, "peer.shared.example",
							NET_AF_INET, &answer), -ENODATA);
	zassert_ok(apply(1U, INITIAL));
	(void)select_dns("peer.shared.example.", 1U, 1U, TAILSCALE_DNS_LOCAL);
	zassert_ok(tailscale_policy_resolve_magic_dns(&policy, "NODE.tail.example.", NET_AF_INET,
						    &answer));
	zassert_equal(answer.generation, 1U);
	zassert_equal(answer.revision, 1U);
	zassert_true(answer.self);
	zassert_equal(answer.address_count, 1U);
	zassert_mem_equal(answer.addresses[0].address, ((uint8_t[]){100U, 64U, 0U, 1U}), 4U);
	zassert_equal(tailscale_policy_resolve_magic_dns(&policy, "node.tail.example", NET_AF_INET6,
							&answer), -ENOENT);
	zassert_ok(tailscale_policy_resolve_magic_dns(&policy, "PEER.shared.example.", NET_AF_INET6,
						    &answer));
	zassert_false(answer.self);
	zassert_equal(answer.address_count, 1U);
	zassert_ok(net_addr_pton(NET_AF_INET6, "fd7a:115c:a1e0::2", ipv6));
	zassert_mem_equal(answer.addresses[0].address, ipv6, sizeof(ipv6));
	zassert_equal(tailscale_policy_resolve_magic_dns(&policy, "public.example", NET_AF_INET,
							&answer), -ENOENT);
	zassert_ok(apply(1U, "{\"Seq\":2,\"PeersChanged\":["
			   NAMED_PEER("NODE.tail.example", "") "]}"));
	zassert_equal(tailscale_policy_resolve_magic_dns(&policy, "node.tail.example", NET_AF_INET,
							&answer), -EADDRINUSE);
	zassert_ok(apply(1U, "{\"Seq\":3,\"PeersChanged\":["
			   NAMED_PEER("peer.shared.example", ",\"Expired\":true") "]}"));
	zassert_equal(tailscale_policy_resolve_magic_dns(&policy, "peer.shared.example",
							NET_AF_INET6, &answer), -ENOENT);
	zassert_ok(apply(1U, "{\"Seq\":4,\"DNSConfig\":{}}"));
	zassert_equal(tailscale_policy_resolve_magic_dns(&policy, "node.tail.example", NET_AF_INET,
							&answer), -ENOTSUP);
}

ZTEST(tailscale_dns_policy, test_host_search_list_does_not_expand_absolute_names)
{
	struct tailscale_dns_answer answer;

	zassert_ok(apply(1U, INITIAL));
	zassert_ok(apply(1U, "{\"Seq\":2,\"DNSConfig\":{\"Proxied\":true,"
			     "\"Domains\":[\"elsewhere.test\",\"tail.example.\"],"
			     "\"CertDomains\":[\"node.tail.example\"],"
			     "\"ExitNodeFilteredSet\":[\".example.test\"]}}"));
	zassert_ok(tailscale_policy_resolve_magic_dns(&policy, "node", NET_AF_INET, &answer));
	zassert_equal(answer.revision, 2);
	zassert_equal(tailscale_policy_resolve_magic_dns(&policy, "node.", NET_AF_INET, &answer),
		      -ENOENT);
	zassert_equal(apply(1U, "{\"Seq\":3,\"DNSConfig\":{\"Domains\":[\"bad..test\"]}}"),
		      -EBADMSG);
	zassert_ok(tailscale_policy_resolve_magic_dns(&policy, "node", NET_AF_INET, &answer));
	zassert_equal(answer.revision, 2);
}

ZTEST(tailscale_dns_policy, test_rejected_candidates_retain_effective_dns)
{
	zassert_ok(apply(1U, INITIAL));
	const struct tailscale_packet_filter *previous = installed.filter;

	installed.error = -ENOMEM;
	zassert_equal(apply(1U, REPLACEMENT), -ENOMEM);
	zassert_equal(installed.attempts, 2U);
	zassert_equal(installed.peer_count, 1U);
	zassert_equal_ptr(installed.filter, previous);
	(void)select_dns("a.corp.example", 1U, 1U, TAILSCALE_DNS_SPLIT);
	installed.error = 0;

	static const struct {
		const char *config;
		int error;
	} invalid[] = {
		{"{\"Resolvers\":[" SERVER("https://r.example/dns-query") "]}", -ENOTSUP},
		{"{\"Resolvers\":[" SERVER("100.64.0.2") "," SERVER("100.64.0.3") ","
		 SERVER("100.64.0.4") "," SERVER("100.64.0.5") "," SERVER("100.64.0.6") "]}",
		 -E2BIG},
		{"{\"Resolvers\":[" SERVER("12345::1") "]}", -EBADMSG},
		{"{\"Resolvers\":[" SERVER("[1:2:3:4:5:6:7:8:9]:53") "]}", -EBADMSG},
		{"{\"Routes\":{\"corp.Example\":[],\"CORP.example.\":[]}}", -EBADMSG},
		{"{\"Routes\":{\"bad..example\":[]}}", -EBADMSG},
		{"{\"Resolvers\":[{\"Addr\":\"192.0.2.53\",\"UseWithExitNode\":true}]}", -ENOTSUP},
		{"{\"Resolvers\":[{\"Addr\":\"192.0.2.53\",\"NewRequiredField\":true}]}", -ENOTSUP},
		{"[]", -EBADMSG},
	};
	for (size_t i = 0; i < ARRAY_SIZE(invalid); i++) {
		char body[512];
		int len = snprintk(body, sizeof(body), "{\"Seq\":1,\"Node\":%s,\"PacketFilter\":[],"
				   "\"DNSConfig\":%s}", SELF, invalid[i].config);

		zassert_true(len > 0 && len < sizeof(body));
		zassert_equal(apply(i + 2U, body), invalid[i].error, "Case %zu", i);
		zassert_equal(installed.attempts, 2U);
		zassert_equal_ptr(installed.filter, previous);
		(void)select_dns("a.corp.example", 1U, 1U, TAILSCALE_DNS_SPLIT);
	}
}

static void make_reverse_routes(char *body, size_t capacity, unsigned int sequence, size_t count)
{
	size_t used =
		snprintk(body, capacity, "{\"Seq\":%u, \"DNSConfig\":{\"Routes\":{", sequence);

	for (size_t i = 0; i < count; i++) {
		const char *separator = i == 0U ? "" : ", ";
		int length = snprintk(body + used, capacity - used,
				      "%s\"%zu.100.in-addr.arpa\":[]", separator, 64U + i);

		zassert_true(length > 0 && length < capacity - used);
		used += length;
	}
	zassert_true(capacity - used >= sizeof("}}}"));
	strcpy(body + used, "}}}");
}

ZTEST(tailscale_dns_policy, test_headscale_reverse_routes_fit)
{
	static char body[4096];

	zassert_ok(apply(1U, INITIAL));
	make_reverse_routes(body, sizeof(body), 2U, 64U);
	zassert_ok(apply(1U, body));
	(void)select_dns("1.127.100.in-addr.arpa", 1U, 2U, TAILSCALE_DNS_LOCAL);

	/* Rejected replacements leave the accepted DNS policy installed. */
	make_reverse_routes(body, sizeof(body), 3U, TAILSCALE_DNS_MAX_ROUTES + 1U);
	zassert_equal(apply(1U, body), -E2BIG);
	(void)select_dns("1.127.100.in-addr.arpa", 1U, 2U, TAILSCALE_DNS_LOCAL);
}

static void update_policy(void *result, void *unused2, void *unused3)
{
	ARG_UNUSED(unused2);
	ARG_UNUSED(unused3);

	*(int *)result = apply(1U, REPLACEMENT);
}

static void read_selection(void *result, void *unused2, void *unused3)
{
	ARG_UNUSED(unused2);
	ARG_UNUSED(unused3);

	k_sem_give(&reader_ready);
	*(struct tailscale_dns_selection *)result =
		select_dns("corp.example", 1U, 2U, TAILSCALE_DNS_NONE);
	k_sem_give(&reader_done);
}

ZTEST(tailscale_dns_policy, test_selection_waits_for_installation)
{
	struct tailscale_dns_selection selection;
	int result = -EBUSY;

	zassert_ok(apply(1U, INITIAL));
	installed.pause = true;
	k_thread_create(&installer, installer_stack, K_THREAD_STACK_SIZEOF(installer_stack),
			update_policy, &result, NULL, NULL, K_PRIO_PREEMPT(0), 0, K_NO_WAIT);
	zassert_ok(k_sem_take(&install_ready, K_SECONDS(1)));
	k_thread_create(&reader, reader_stack, K_THREAD_STACK_SIZEOF(reader_stack),
			read_selection, &selection, NULL, NULL, K_PRIO_PREEMPT(0), 0, K_NO_WAIT);
	zassert_ok(k_sem_take(&reader_ready, K_SECONDS(1)));
	zassert_equal(k_sem_take(&reader_done, K_MSEC(1)), -EAGAIN);
	k_sem_give(&install_release);
	zassert_ok(k_thread_join(&installer, K_SECONDS(1)));
	zassert_ok(k_thread_join(&reader, K_SECONDS(1)));
	zassert_ok(k_sem_take(&reader_done, K_NO_WAIT));
	zassert_ok(result);
	zassert_equal(installed.peer_count, 0U);
	zassert_equal(selection.server_count, 0U);
}

ZTEST_SUITE(tailscale_dns_policy, NULL, NULL, reset, NULL, NULL);
```

## src/map_stream.c
```c
/*
 * SPDX-FileCopyrightText: Copyright The Zephyr Project Contributors
 * SPDX-License-Identifier: Apache-2.0
 */

#include <errno.h>
#include <string.h>

#include <zephyr/net/socket.h>
#include <zephyr/sys/byteorder.h>
#include <zephyr/sys/util.h>
#include <zephyr/ztest.h>

#include "map_stream.h"

#define STREAM_CAPACITY 260U
#define FIRST_GENERATION 1U
#define NEXT_GENERATION  2U

struct tailscale_map_stream_test_fixture {
	struct tailscale_map_stream stream;
	uint8_t storage[STREAM_CAPACITY];
	const char *const *expected;
	size_t expected_count;
	size_t attempts;
	size_t delivered;
	size_t reject_attempt;
};

static int receive_message(const uint8_t *message, size_t len, void *user_data)
{
	struct tailscale_map_stream_test_fixture *fixture = user_data;
	size_t index = fixture->attempts++;

	zassert_true(index < fixture->expected_count);
	zassert_equal(len, strlen(fixture->expected[index]));
	zassert_mem_equal(message, fixture->expected[index], len);
	if (fixture->attempts == fixture->reject_attempt) {
		return -EACCES;
	}

	fixture->delivered++;
	return 0;
}

static void *suite_setup(void)
{
	static struct tailscale_map_stream_test_fixture fixture;

	return &fixture;
}

static void stream_setup(void *data)
{
	struct tailscale_map_stream_test_fixture *fixture = data;

	fixture->expected = NULL;
	fixture->expected_count = 0U;
	fixture->attempts = 0U;
	fixture->delivered = 0U;
	fixture->reject_attempt = 0U;
	zassert_ok(tailscale_map_stream_init(&fixture->stream, fixture->storage,
					     sizeof(fixture->storage), FIRST_GENERATION,
					     receive_message, fixture));
}

static size_t write_frame(uint8_t *wire, const char *message)
{
	size_t len = strlen(message);

	sys_put_le32((uint32_t)len, wire);
	memcpy(wire + sizeof(uint32_t), message, len);
	return sizeof(uint32_t) + len;
}

static void transfer_chunk(struct tailscale_map_stream_test_fixture *fixture, const int pair[2],
			   const uint8_t *wire, size_t len)
{
	uint8_t received[128];

	zassert_true(len <= sizeof(received));
	zassert_equal(zsock_send(pair[0], wire, len, 0), (ssize_t)len);
	zassert_equal(zsock_recv(pair[1], received, len, 0), (ssize_t)len);
	zassert_ok(tailscale_map_stream_feed(&fixture->stream, FIRST_GENERATION, received, len));
}

ZTEST_F(tailscale_map_stream_test, test_socket_producer_fragments_and_coalesces_frames)
{
	const char *const messages[] = {
		"{\"Node\":{\"ID\":7}}",
		"{\"KeepAlive\":true}",
		"{\"PeersRemoved\":[7]}",
	};
	uint8_t wire[128];
	uint8_t eof;
	int pair[2];
	size_t len = 0U;

	fixture->expected = messages;
	fixture->expected_count = ARRAY_SIZE(messages);
	for (size_t i = 0U; i < ARRAY_SIZE(messages); i++) {
		len += write_frame(wire + len, messages[i]);
	}

	zassert_ok(zsock_socketpair(NET_AF_UNIX, NET_SOCK_STREAM, 0, pair));
	transfer_chunk(fixture, pair, wire, 1U);
	zassert_equal(fixture->delivered, 0U);
	transfer_chunk(fixture, pair, wire + 1U, 4U);
	zassert_equal(fixture->delivered, 0U);
	transfer_chunk(fixture, pair, wire + 5U, len - 5U);
	zassert_equal(fixture->delivered, ARRAY_SIZE(messages));

	zassert_ok(zsock_close(pair[0]));
	zassert_equal(zsock_recv(pair[1], &eof, sizeof(eof), 0), 0);
	zassert_ok(tailscale_map_stream_finish(&fixture->stream, FIRST_GENERATION));
	zassert_ok(tailscale_map_stream_finish(&fixture->stream, FIRST_GENERATION));
	zassert_equal(tailscale_map_stream_feed(&fixture->stream, FIRST_GENERATION, wire, len),
		      -ESHUTDOWN);
	zassert_equal(fixture->delivered, ARRAY_SIZE(messages));
	zassert_ok(zsock_close(pair[1]));
}

ZTEST_F(tailscale_map_stream_test, test_maximum_frame_uses_full_little_endian_length)
{
	const uint8_t header[] = {0x04, 0x01, 0x00, 0x00};
	char message[STREAM_CAPACITY + 1U];
	const char *const messages[] = {message};

	memset(message, ' ', STREAM_CAPACITY);
	message[0] = '{';
	message[1] = '}';
	message[STREAM_CAPACITY] = '\0';
	fixture->expected = messages;
	fixture->expected_count = ARRAY_SIZE(messages);

	zassert_ok(tailscale_map_stream_feed(&fixture->stream, FIRST_GENERATION, header,
					     sizeof(header)));
	zassert_equal(fixture->delivered, 0U);
	zassert_ok(tailscale_map_stream_feed(&fixture->stream, FIRST_GENERATION,
					     (const uint8_t *)message, STREAM_CAPACITY));
	zassert_equal(fixture->delivered, 1U);
	zassert_ok(tailscale_map_stream_finish(&fixture->stream, FIRST_GENERATION));
}

ZTEST_F(tailscale_map_stream_test, test_rejects_invalid_lengths_without_dispatch)
{
	const uint8_t oversized[] = {0x05, 0x01, 0x00, 0x00};
	const uint8_t largest[] = {0xff, 0xff, 0xff, 0xff};
	const uint8_t empty[] = {0x00, 0x00, 0x00, 0x00};

	zassert_equal(tailscale_map_stream_feed(&fixture->stream, FIRST_GENERATION, oversized,
					       sizeof(oversized)), -EMSGSIZE);
	zassert_equal(tailscale_map_stream_finish(&fixture->stream, FIRST_GENERATION), -EMSGSIZE);
	zassert_ok(tailscale_map_stream_reset(&fixture->stream, NEXT_GENERATION));
	zassert_equal(tailscale_map_stream_feed(&fixture->stream, NEXT_GENERATION, largest,
					       sizeof(largest)), -EMSGSIZE);
	zassert_ok(tailscale_map_stream_reset(&fixture->stream, NEXT_GENERATION + 1U));
	zassert_equal(tailscale_map_stream_feed(&fixture->stream, NEXT_GENERATION + 1U, empty,
					       sizeof(empty)), -EBADMSG);
	zassert_equal(fixture->attempts, 0U);
}

ZTEST_F(tailscale_map_stream_test, test_incomplete_header_or_payload_at_eof)
{
	const uint8_t bytes[] = {0x02, 0x00, 0x00, 0x00, '{', '}'};

	for (size_t len = 1U; len < sizeof(bytes); len++) {
		uint32_t generation = NEXT_GENERATION + (uint32_t)len;

		zassert_ok(tailscale_map_stream_reset(&fixture->stream, generation));
		zassert_ok(tailscale_map_stream_feed(&fixture->stream, generation, bytes, len));
		zassert_equal(tailscale_map_stream_finish(&fixture->stream, generation), -EBADMSG);
		zassert_equal(tailscale_map_stream_feed(&fixture->stream, generation, bytes,
						       sizeof(bytes)), -EBADMSG);
	}
	zassert_equal(fixture->attempts, 0U);
}

ZTEST_F(tailscale_map_stream_test, test_dispatch_failure_stops_at_failing_frame)
{
	const char *const messages[] = {"{}", "{\"KeepAlive\":true}", "{}"};
	uint8_t wire[64];
	size_t len = 0U;

	fixture->expected = messages;
	fixture->expected_count = ARRAY_SIZE(messages);
	fixture->reject_attempt = 2U;
	for (size_t i = 0U; i < ARRAY_SIZE(messages); i++) {
		len += write_frame(wire + len, messages[i]);
	}

	zassert_equal(tailscale_map_stream_feed(&fixture->stream, FIRST_GENERATION, wire, len),
		      -EACCES);
	zassert_equal(tailscale_map_stream_feed(&fixture->stream, FIRST_GENERATION, wire, len),
		      -EACCES);
	zassert_equal(tailscale_map_stream_finish(&fixture->stream, FIRST_GENERATION), -EACCES);
	zassert_equal(fixture->attempts, 2U);
	zassert_equal(fixture->delivered, 1U);
}

ZTEST_F(tailscale_map_stream_test, test_generation_reset_discards_incomplete_message)
{
	const uint8_t wire[] = {0x02, 0x00, 0x00, 0x00, '{', '}'};
	const char *const messages[] = {"{}"};

	fixture->expected = messages;
	fixture->expected_count = ARRAY_SIZE(messages);
	zassert_ok(tailscale_map_stream_feed(&fixture->stream, FIRST_GENERATION, wire, 5U));
	zassert_equal(tailscale_map_stream_reset(&fixture->stream, FIRST_GENERATION), -EINVAL);
	zassert_ok(tailscale_map_stream_reset(&fixture->stream, NEXT_GENERATION));
	zassert_equal(tailscale_map_stream_feed(&fixture->stream, FIRST_GENERATION, wire + 5U, 1U),
		      -ESTALE);
	zassert_equal(tailscale_map_stream_finish(&fixture->stream, FIRST_GENERATION), -ESTALE);
	zassert_equal(fixture->attempts, 0U);
	zassert_ok(tailscale_map_stream_feed(&fixture->stream, NEXT_GENERATION, wire,
					     sizeof(wire)));
	zassert_ok(tailscale_map_stream_finish(&fixture->stream, NEXT_GENERATION));
	zassert_equal(fixture->delivered, 1U);
}

ZTEST_F(tailscale_map_stream_test, test_empty_body_ends_cleanly)
{
	zassert_ok(tailscale_map_stream_feed(&fixture->stream, FIRST_GENERATION, NULL, 0U));
	zassert_ok(tailscale_map_stream_finish(&fixture->stream, FIRST_GENERATION));
	zassert_equal(fixture->attempts, 0U);
}

ZTEST_SUITE(tailscale_map_stream_test, NULL, suite_setup, stream_setup, NULL, NULL);
```

## src/named_filter.c
```c
/*
 * SPDX-FileCopyrightText: Copyright The Zephyr Project Contributors
 * SPDX-License-Identifier: Apache-2.0
 */

#include <errno.h>
#include <string.h>

#include <zephyr/net/net_ip.h>
#include "tailscale_internal.h"
#include <zephyr/sys/byteorder.h>
#include <zephyr/ztest.h>

#define KEY "nodekey:0101010101010101010101010101010101010101010101010101010101010101"
#define PEER "{\"ID\":1,\"Key\":\"" KEY "\",\"Addresses\":[\"198.51.100.2/32\"]}"
#define RULE(port, proto) \
	"{\"SrcIPs\":[\"*\"],\"DstPorts\":[{\"IP\":\"*\",\"Ports\":{\"First\":" #port \
	",\"Last\":" #port "}}],\"IPProto\":[" #proto "]}"
#define UDP(port) RULE(port, 17)
#define NAME_32 "01234567890123456789012345678901"

static struct tailscale_policy policy;
static const struct tailscale_packet_filter *installed;
static int install_error;
static size_t install_attempts;

static int install(const struct tailscale_peer_snapshot *peers,
		   const struct tailscale_packet_filter *filter, void *context)
{
	ARG_UNUSED(peers);
	ARG_UNUSED(context);
	install_attempts++;
	if (install_error != 0) {
		return install_error;
	}
	installed = filter;
	return 0;
}

static int apply(uint32_t generation, const char *body, enum tailscale_peer_inventory_frame *effect)
{
	return tailscale_policy_apply(&policy, generation, (uint8_t *)body, strlen(body), install,
				      NULL, effect);
}

static void assert_published(uint32_t generation, uint64_t revision)
{
	struct tailscale_peer_inventory_summary summary;

	zassert_ok(tailscale_policy_get_summary(&policy, &summary));
	zassert_true(summary.valid);
	zassert_equal(summary.generation, generation);
	zassert_equal(summary.revision, revision);
}

static void assert_ports(const uint16_t *ports, size_t count)
{
	zassert_not_null(installed);
	zassert_equal(installed->count, count);
	for (size_t i = 0; i < count; i++) {
		zassert_equal(installed->rules[i].destinations[0].first_port, ports[i]);
	}
}

static bool allows_port(uint16_t port, uint8_t protocol)
{
	uint8_t packet[40] = {0x45U};
	size_t length = protocol == NET_IPPROTO_TCP ? sizeof(packet) : 28U;

	packet[9] = protocol;
	sys_put_be16(length, packet + 2U);
	sys_put_be16(port, packet + 22U);
	if (protocol == NET_IPPROTO_TCP) {
		packet[32] = 0x50U;
	} else {
		sys_put_be16(8U, packet + 24U);
	}
	return tailscale_packet_filter_accept(installed, packet, length);
}

static void reset_policy(void *fixture)
{
	ARG_UNUSED(fixture);
	tailscale_policy_init(&policy);
	installed = NULL;
	install_error = 0;
	install_attempts = 0U;
}

ZTEST(tailscale_named_filter, test_precedence_and_stream_lifetime)
{
	enum tailscale_peer_inventory_frame effect;
	const uint16_t initial[] = {9001U, 9002U, 9003U, 9000U, 9004U};

	zassert_ok(apply(1U, "{\"Seq\":1,\"Peers\":[" PEER "],\"PacketFilter\":[" UDP(9000)
			    "],\"PacketFilters\":{\"z\":[" UDP(9004) "],\"a\":[" UDP(9002) ","
			    RULE(9003, 6) "],\"Base\":[" UDP(9001) "]}}", &effect));
	zassert_equal(effect, TAILSCALE_PEER_INVENTORY_FULL);
	assert_ports(initial, ARRAY_SIZE(initial));
	zassert_true(allows_port(9003U, NET_IPPROTO_TCP));
	zassert_false(allows_port(9003U, NET_IPPROTO_UDP));
	zassert_true(allows_port(9004U, NET_IPPROTO_UDP));
	zassert_false(allows_port(9004U, NET_IPPROTO_TCP));

	zassert_ok(apply(1U, "{\"Seq\":2,\"Peers\":[" PEER "],\"PacketFilters\":null}", &effect));
	zassert_equal(effect, TAILSCALE_PEER_INVENTORY_FULL);
	assert_ports(initial, ARRAY_SIZE(initial));

	zassert_ok(apply(1U, "{\"Seq\":3,\"PacketFilter\":[]}", &effect));
	zassert_equal(effect, TAILSCALE_PEER_INVENTORY_UPDATE);
	assert_ports((uint16_t[]){9001U, 9002U, 9003U, 9004U}, 4U);

	zassert_ok(apply(1U, "{\"Seq\":4,\"PacketFilter\":[" UDP(9010)
			    "],\"PacketFilters\":{\"base\":[" UDP(9011)
			    "],\"a\":[],\"z\":null}}", &effect));
	zassert_equal(effect, TAILSCALE_PEER_INVENTORY_UPDATE);
	assert_ports((uint16_t[]){9001U, 9011U}, 2U);

	zassert_ok(apply(1U, "{\"Seq\":5,\"PacketFilter\":[" UDP(9010)
			    "],\"PacketFilters\":{\"base\":null,\"Base\":[]}}", &effect));
	assert_ports(NULL, 0U);

	zassert_ok(apply(1U, "{\"Seq\":6,\"PacketFilters\":{\"z\":[" UDP(9012) "]}}", NULL));
	zassert_ok(apply(1U, "{\"Seq\":7,\"PacketFilter\":[" UDP(9013)
			    "],\"PacketFilters\":{\"a\":[" UDP(9014) "],\"*\":null}}", NULL));
	assert_ports((uint16_t[]){9014U}, 1U);
	zassert_ok(apply(1U, "{\"Seq\":8,\"PacketFilters\":{\"*\":[" UDP(9015) "],\"x\":null}}",
			 NULL));
	zassert_ok(apply(1U, "{\"Seq\":9,\"PacketFilters\":{}}", NULL));
	zassert_ok(apply(1U, "{\"Seq\":10,\"PacketFilter\":null,\"PacketFilters\":null}", &effect));
	zassert_equal(effect, TAILSCALE_PEER_INVENTORY_OTHER);
	assert_ports((uint16_t[]){9014U}, 1U);
	assert_published(1U, 9U);

	zassert_equal(apply(2U, "{\"Seq\":1,\"PacketFilters\":{\"a\":null}}", NULL), -EBADMSG);
	assert_published(1U, 9U);
	assert_ports((uint16_t[]){9014U}, 1U);
	zassert_ok(apply(3U, "{\"Seq\":1,\"Peers\":[]}", &effect));
	zassert_equal(effect, TAILSCALE_PEER_INVENTORY_FULL);
	assert_published(3U, 10U);
	assert_ports(NULL, 0U);
}

ZTEST(tailscale_named_filter, test_name_decoding_and_case)
{
	zassert_ok(apply(1U, "{\"Peers\":[],\"PacketFilter\":[" UDP(9000)
			    "],\"PacketFilters\":{\"\\u0062ase\":[" UDP(9001)
			    "],\"\\u00e9\":[" UDP(9002) "],\"\\u2e80\":[" UDP(9003)
			    "],\"\\ud83d\\ude00\":[" UDP(9004) "],\"\\u0000\":[" UDP(9005)
			    "],\"\":[" UDP(9006) "]}}", NULL));
	assert_ports((uint16_t[]){9006U, 9005U, 9001U, 9002U, 9003U, 9004U}, 6U);
	zassert_ok(apply(1U, "{\"PacketFilters\":{\"\xc3\xa9\":null,\""
			    "\xe2\xba\x80\":null,\"\xf0\x9f\x98\x80\":null}}", NULL));
	assert_ports((uint16_t[]){9006U, 9005U, 9001U}, 3U);
	zassert_equal(apply(1U, "{\"PacketFilters\":{\"base\\\\\":[" UDP(9007)
			       "],\"base\":\"bad\"}}", NULL), -EBADMSG);
	assert_ports((uint16_t[]){9006U, 9005U, 9001U}, 3U);

	zassert_ok(apply(2U, "{\"Peers\":[],\"PacketFilter\":[" UDP(9000)
			    "],\"PacketFilters\":{\"\\u002a\":null,\"base\\\\\":[" UDP(9008)
			    "],\"base\":[" UDP(9009) "]}}", NULL));
	assert_ports((uint16_t[]){9009U, 9008U}, 2U);
}

ZTEST(tailscale_named_filter, test_chunk_and_edit_limits_use_final_state)
{
	zassert_ok(apply(1U, "{\"Peers\":[],\"PacketFilters\":{\"a\":[],\"b\":[],\"c\":[],"
			    "\"d\":[],\"e\":[],\"f\":[],\"g\":[],\"h\":[]}}", NULL));
	zassert_ok(apply(1U, "{\"PacketFilters\":{\"a\":null,\"b\":null,\"c\":null,\"d\":null,"
			    "\"e\":null,\"f\":null,\"g\":null,\"h\":null,"
			    "\"i\":[" UDP(9001) "],\"j\":[],\"k\":[],\"l\":[],\"m\":[],"
			    "\"n\":[],\"o\":[],\"" NAME_32 "\":[" UDP(9000) "]}}", NULL));
	assert_ports((uint16_t[]){9000U, 9001U}, 2U);

	zassert_equal(apply(1U, "{\"PacketFilters\":{\"p\":[]}}", NULL), -E2BIG);
	assert_published(1U, 2U);
	assert_ports((uint16_t[]){9000U, 9001U}, 2U);
	zassert_equal(apply(2U, "{\"Peers\":[],\"PacketFilters\":{\"a\":null,\"b\":null,"
			    "\"c\":null,\"d\":null,\"e\":null,\"f\":null,\"g\":null,\"h\":null,"
			    "\"i\":null,\"j\":null,\"k\":null,\"l\":null,\"m\":null,\"n\":null,"
			    "\"o\":null,\"p\":null,\"q\":null}}", NULL), -E2BIG);
	assert_published(1U, 2U);
	zassert_equal(install_attempts, 2U);
}

ZTEST(tailscale_named_filter, test_rule_limit_and_installer_rollback)
{
	const uint16_t expected[] = {9000U, 9001U, 9002U, 9003U, 9004U, 9005U, 9006U, 9007U};

	zassert_ok(apply(1U, "{\"Peers\":[],\"PacketFilters\":{\"z\":[" UDP(9010) "," UDP(9011)
			    "],\"a\":[" UDP(9012) "]}}", NULL));
	zassert_ok(apply(1U, "{\"PacketFilters\":{\"a\":[" UDP(9000) "," UDP(9001) "," UDP(9002)
			    "," UDP(9003) "," UDP(9004) "," UDP(9005) "," UDP(9006) "," UDP(9007)
			    "],\"z\":null}}", NULL));
	assert_ports(expected, ARRAY_SIZE(expected));
	const struct tailscale_packet_filter *previous = installed;

	install_error = -ENOMEM;
	zassert_equal(apply(1U, "{\"PacketFilters\":{\"*\":null,\"x\":[" UDP(9010) "]}}", NULL),
		      -ENOMEM);
	zassert_equal_ptr(installed, previous);
	assert_published(1U, 2U);
	assert_ports(expected, ARRAY_SIZE(expected));
	zassert_equal(apply(1U, "{\"PacketFilters\":{\"x\":null}}", NULL), -ESTALE);
	zassert_equal(install_attempts, 3U);

	install_error = 0;
	zassert_ok(apply(2U, "{\"Peers\":[],\"PacketFilters\":{\"z\":[" UDP(9000) "," UDP(9001)
			    "," UDP(9002) "," UDP(9003) "," UDP(9004) "," UDP(9005) "," UDP(9006)
			    "," UDP(9007) "]}}", NULL));
	previous = installed;
	zassert_equal(apply(2U, "{\"PacketFilters\":{\"a\":[" UDP(9010) "]}}", NULL), -E2BIG);
	zassert_equal_ptr(installed, previous);
	assert_published(2U, 3U);
	assert_ports(expected, ARRAY_SIZE(expected));
	zassert_equal(install_attempts, 4U);
}

ZTEST(tailscale_named_filter, test_rejects_invalid_names_types_and_rules)
{
	static const struct {
		const char *json;
		int error;
	} bad[] = {
		{"{\"Peers\":[],\"PacketFilters\":[]}", -EBADMSG},
		{"{\"Peers\":[],\"PacketFilters\":{\"a\":{}}}", -EBADMSG},
		{"{\"Peers\":[],\"PacketFilters\":{\"a\":[],\"a\":null}}", -EBADMSG},
		{"{\"Peers\":[],\"PacketFilters\":{\"a\":[],\"\\u0061\":null}}", -EBADMSG},
		{"{\"Peers\":[],\"PacketFilters\":{\"*\":[],\"\\u002a\":null}}", -EBADMSG},
		{"{\"Peers\":[],\"PacketFilters\":{\"" NAME_32 "0\":null}}", -E2BIG},
		{"{\"Peers\":[],\"PacketFilters\":{\"\xc0\x80\":null}}", -EBADMSG},
		{"{\"Peers\":[],\"PacketFilters\":{\"\\ud800\":null}}", -EBADMSG},
		{"{\"Peers\":[],\"PacketFilters\":{\"\\ud800\\u0000\":null}}", -EBADMSG},
		{"{\"Peers\":[],\"PacketFilters\":{\"x\":[" RULE(9000, 1) "]}}", -ENOTSUP},
		{"{\"Peers\":[], "
		 "\"PacketFilters\":{\"x\":[{\"SrcIPs\":[\"*\"],\"DstPorts\":[],\"IPProto\":true}]}}",
		 -EBADMSG},
		{"{\"Peers\":[],\"PacketFilters\":{\"x\":[{\"SrcIPs\":[\"*\"],\"DstPorts\":[],"
		 "\"IPProto\":[17],\"SrcCaps\":[\"a\"]}]}}", -ENOTSUP},
	};

	zassert_ok(apply(1U, "{\"Peers\":[],\"PacketFilters\":{\"x\":[" UDP(9000) "]}}", NULL));
	for (size_t i = 0U; i < ARRAY_SIZE(bad); i++) {
		zassert_equal(apply(i + 2U, bad[i].json, NULL), bad[i].error, "frame %zu", i);
		assert_published(1U, 1U);
		assert_ports((uint16_t[]){9000U}, 1U);
	}
	zassert_equal(install_attempts, 1U);
}

ZTEST_SUITE(tailscale_named_filter, NULL, NULL, reset_policy, NULL, NULL);
```

## src/peer_inventory.c
```c
/*
 * SPDX-FileCopyrightText: Copyright The Zephyr Project Contributors
 * SPDX-License-Identifier: Apache-2.0
 */

#include <errno.h>
#include <string.h>

#include <zephyr/net/net_ip.h>
#include "tailscale_internal.h"
#include <zephyr/sys/printk.h>
#include <zephyr/ztest.h>

#define KEY1 "nodekey:0101010101010101010101010101010101010101010101010101010101010101"
#define KEY2 "nodekey:0202020202020202020202020202020202020202020202020202020202020202"
#define KEY3 "nodekey:0303030303030303030303030303030303030303030303030303030303030303"
#define DISCO1 "discokey:0101010101010101010101010101010101010101010101010101010101010101"
#define PEER1 "{\"ID\":1,\"Key\":\"" KEY1 "\"}"
#define PEER2 "{\"ID\":2,\"Key\":\"" KEY2 "\"}"

static struct tailscale_peer_inventory inventory;
static struct tailscale_peer peer;

static int apply(uint32_t generation, const char *json)
{
	return tailscale_peer_inventory_apply(&inventory, generation, (uint8_t *)json,
					      strlen(json), NULL);
}

static void expect_frame(uint32_t generation, const char *json,
			 enum tailscale_peer_inventory_frame expected)
{
	enum tailscale_peer_inventory_frame frame;

	zassert_ok(tailscale_peer_inventory_apply(&inventory, generation, (uint8_t *)json,
						 strlen(json), &frame));
	zassert_equal(frame, expected);
}

static struct tailscale_peer_inventory_summary summary(void)
{
	struct tailscale_peer_inventory_summary current;

	zassert_ok(tailscale_peer_inventory_get_summary(&inventory, &current));
	return current;
}

static void reset_inventory(void *fixture)
{
	ARG_UNUSED(fixture);
	tailscale_peer_inventory_init(&inventory);
}

ZTEST(tailscale_peer_inventory, test_authoritative_empty_first_map)
{
	zassert_ok(apply(1, "{\"KeepAlive\":true,\"Peers\":null}"));
	zassert_false(summary().valid);
	zassert_ok(apply(1, "{\"Node\":{\"ID\":9},\"Peers\":null}"));
	zassert_true(summary().valid);
	zassert_equal(summary().peer_count, 0);
	zassert_equal(tailscale_peer_inventory_get_peer(&inventory, 1, &peer), -ENOENT);

	tailscale_peer_inventory_session_lost(&inventory, 1);
	zassert_equal(summary().generation, 1);
	zassert_false(summary().valid);
	zassert_equal(apply(1, "{\"Peers\":[" PEER1 "]}"), -ESTALE);
	zassert_equal(apply(2, "{\"PeersChanged\":[" PEER1 "]}"), -EBADMSG);
	zassert_false(summary().valid);
	zassert_ok(apply(3, "{\"Peers\":[" PEER1 "]}"));
	tailscale_peer_inventory_session_lost(&inventory, 2);
	zassert_true(summary().valid);
	zassert_equal(summary().generation, 3);
}

ZTEST(tailscale_peer_inventory, test_full_and_deltas)
{
	zassert_ok(apply(1, "{\"Peers\":[" PEER1 "," PEER2 "]}"));
	zassert_equal(summary().peer_count, 2);
	zassert_ok(apply(1, "{\"Peers\":[],\"PeersRemoved\":[1],"
			   "\"PeersChanged\":[{\"ID\":3,\"Key\":\"" KEY3 "\"}]}"));
	zassert_equal(summary().peer_count, 2);
	zassert_equal(tailscale_peer_inventory_get_peer(&inventory, 1, &peer), -ENOENT);
	zassert_ok(tailscale_peer_inventory_get_peer(&inventory, 3, &peer));
	zassert_equal(peer.key[31], 3);

	zassert_ok(apply(1, "{\"Peers\":[" PEER1 "],\"PeersRemoved\":[1],"
			   "\"PeersChanged\":[" PEER2 "],\"OnlineChange\":{\"1\":true}}"));
	zassert_equal(summary().peer_count, 1);
	zassert_ok(tailscale_peer_inventory_get_peer(&inventory, 1, &peer));
	zassert_equal(peer.online, TAILSCALE_PEER_ONLINE_UNKNOWN);

	zassert_ok(apply(1, "{\"PeersRemoved\":[1],\"PeersChanged\":[" PEER1 "]}"));
	zassert_ok(tailscale_peer_inventory_get_peer(&inventory, 1, &peer));
	zassert_equal(summary().peer_count, 1);
}

ZTEST(tailscale_peer_inventory, test_first_node_and_deltas_with_empty_peers)
{
	expect_frame(1, "{\"KeepAlive\":true,\"Peers\":[" PEER1 "]}",
		     TAILSCALE_PEER_INVENTORY_KEEPALIVE);
	zassert_false(summary().valid);
	expect_frame(1, "{\"ControlTime\":\"2026-11-24T00:00:00Z\"}",
		     TAILSCALE_PEER_INVENTORY_OTHER);
	expect_frame(1, "{\"Node\":{\"ID\":9},\"Peers\":[],\"PeersChanged\":[" PEER1 "],"
		     "\"OnlineChange\":{\"1\":true}}", TAILSCALE_PEER_INVENTORY_FULL);
	zassert_true(summary().valid);
	zassert_equal(summary().peer_count, 1);
	zassert_ok(tailscale_peer_inventory_get_peer(&inventory, 1, &peer));
	zassert_equal(peer.online, TAILSCALE_PEER_ONLINE);
	expect_frame(1, "{\"Peers\":null,\"PeersRemoved\":[1]}", TAILSCALE_PEER_INVENTORY_UPDATE);
	zassert_equal(summary().peer_count, 0);
}

ZTEST(tailscale_peer_inventory, test_prefix_presence_and_narrowing)
{
	zassert_ok(apply(1, "{\"Peers\":[{\"ID\":1,\"StableID\":\"n123\",\"Key\":\"" KEY1 "\","
			   "\"Addresses\":[\"100.64.0.9/32\",\"fd7a:115c:a1e0::9/128\"],"
			   "\"AllowedIPs\":null},{\"ID\":2,\"Key\":\"" KEY2 "\","
			   "\"Addresses\":[\"100.64.0.2/32\"],\"AllowedIPs\":[]}]}"));

	zassert_ok(tailscale_peer_inventory_get_peer(&inventory, 1, &peer));
	zassert_equal(peer.allowed_ip_count, 2);
	zassert_equal(peer.allowed_ips[0].family, NET_AF_INET);
	zassert_equal(peer.allowed_ips[1].family, NET_AF_INET6);
	zassert_equal(peer.allowed_ips[1].length, 128);
	zassert_equal(peer.allowed_ips[1].address[15], 9);
	zassert_equal(strcmp(peer.stable_id, "n123"), 0);
	zassert_ok(tailscale_peer_inventory_get_peer(&inventory, 2, &peer));
	zassert_equal(peer.allowed_ip_count, 0);

	zassert_ok(apply(1, "{\"PeersChanged\":[{\"ID\":1,\"Key\":\"" KEY1 "\","
			   "\"Addresses\":[\"100.64.0.9/32\"],\"AllowedIPs\":[\"10.1.2.3/8\"]},"
			   "{\"ID\":2,\"Key\":\"" KEY2 "\",\"UnsignedPeerAPIOnly\":true,"
			   "\"Addresses\":[\"100.64.0.2/32\"],\"AllowedIPs\":[\"0.0.0.0/0\"]}]}"));
	zassert_ok(tailscale_peer_inventory_get_peer(&inventory, 1, &peer));
	zassert_equal(peer.allowed_ips[0].length, 8);
	zassert_equal(peer.allowed_ips[0].address[0], 10);
	zassert_equal(peer.allowed_ips[0].address[1], 0);
	zassert_ok(tailscale_peer_inventory_get_peer(&inventory, 2, &peer));
	zassert_equal(peer.allowed_ips[0].length, 32);
	zassert_equal(peer.allowed_ips[0].address[3], 2);
}

ZTEST(tailscale_peer_inventory, test_patch_null_empty_and_online_order)
{
	zassert_ok(apply(1, "{\"Peers\":[{\"ID\":1,\"Key\":\"" KEY1 "\",\"DiscoKey\":\""
			   DISCO1 "\",\"Endpoints\":[\"192.0.2.1:41641\","
			   "\"[2001:db8::1]:41642\"],\"Online\":true}]}"));
	zassert_ok(apply(1, "{\"OnlineChange\":{\"1\":true},\"PeersChangedPatch\":[{\"NodeID\":1,"
			   "\"Endpoints\":null,\"DiscoKey\":null,\"Online\":false,"
			   "\"Key\":\"" KEY3 "\",\"DERPRegion\":3}]}"));
	zassert_ok(tailscale_peer_inventory_get_peer(&inventory, 1, &peer));
	zassert_equal(peer.key[0], 3);
	zassert_equal(peer.disco_key[31], 1);
	zassert_equal(peer.online, TAILSCALE_PEER_OFFLINE);
	zassert_equal(peer.endpoint_count, 2);
	zassert_equal(peer.endpoints[0].family, NET_AF_INET);
	zassert_equal(peer.endpoints[0].port, 41641);
	zassert_equal(peer.endpoints[1].family, NET_AF_INET6);
	zassert_equal(peer.endpoints[1].port, 41642);

	zassert_ok(apply(1, "{\"PeersChangedPatch\":[{\"NodeID\":1,\"Endpoints\":[],"
			   "\"Key\":null,\"Online\":null,\"DERPRegion\":0},"
			   "{\"NodeID\":99,\"Online\":true}]}"));
	zassert_ok(tailscale_peer_inventory_get_peer(&inventory, 1, &peer));
	zassert_equal(peer.endpoint_count, 0);
	zassert_equal(peer.key[0], 3);
	zassert_equal(peer.online, TAILSCALE_PEER_OFFLINE);
	zassert_equal(peer.derp_region, 3);
	zassert_equal(summary().peer_count, 1);
}

ZTEST(tailscale_peer_inventory, test_sequence_and_publication_boundaries)
{
	zassert_ok(apply(20, "{\"Seq\":7,\"Peers\":[" PEER1 "]}"));
	uint64_t revision = summary().revision;

	zassert_ok(apply(20, "{\"KeepAlive\":true,\"Seq\":99}"));
	zassert_equal(summary().revision, revision);
	zassert_ok(tailscale_peer_inventory_get_peer_at(&inventory, revision, 0, &peer));
	zassert_ok(apply(20, "{\"Seq\":8,\"OnlineChange\":{\"1\":true}}"));
	zassert_equal(tailscale_peer_inventory_get_peer_at(&inventory, revision, 0, &peer),
		      -ESTALE);
	zassert_equal(apply(20, "{\"Seq\":10,\"PeersChanged\":[" PEER2 "]}"), -EILSEQ);
	zassert_false(summary().valid);
	zassert_equal(tailscale_peer_inventory_get_peer(&inventory, 1, &peer), -ENODATA);
	zassert_equal(apply(20, "{\"Seq\":9,\"Peers\":[" PEER1 "]}"), -ESTALE);
	zassert_ok(apply(21, "{\"Peers\":[" PEER2 "]}"));
	zassert_equal(tailscale_peer_inventory_get_peer(&inventory, 1, &peer), -ENOENT);
}

ZTEST(tailscale_peer_inventory, test_malformed_updates_invalidate_without_partial_peer)
{
	static const char *const bad[] = {
		"{\"PeersChanged\":[" PEER2 ",{\"ID\":3,\"key\":\"" KEY3 "\",\"Key\":null}]}",
		"{\"PeErs\":null,\"Peers\":[" PEER2 "]}",
		"{\"PeersChanged\":[{\"\\u0049D\":2,\"Key\":\"" KEY2 "\"}]}",
		"{\"Unknown\":[1,{\"bad\":2,}]}",
		"{\"PeersRemoved\":[1,1]}",
		"{\"PeersChanged\":[" PEER2 "," PEER2 "]}",
		"{\"PeersChangedPatch\":[{\"NodeID\":1,\"Endpoints\":[\"192.0.2.1\"]}]}",
		"{\"PeersChanged\":[{\"ID\":2,\"Key\":\"" KEY2 "\","
		"\"AllowedIPs\":[\"192.0.2.1/33\"]}]}",
		"{\"OnlineChange\":{\"1\":true,\"1\":false}}",
		"{\"PeersChanged\":[" PEER2 "]}{}",
	};

	for (size_t i = 0; i < ARRAY_SIZE(bad); i++) {
		uint32_t generation = i + 1;

		zassert_ok(apply(generation, "{\"Peers\":[" PEER1 "]}"));
		zassert_equal(apply(generation, bad[i]), -EBADMSG, "case %zu", i);
		zassert_false(summary().valid);
		zassert_equal(summary().peer_count, 0);
		zassert_equal(tailscale_peer_inventory_get_peer(&inventory, 1, &peer), -ENODATA);
		zassert_equal(tailscale_peer_inventory_get_peer(&inventory, 2, &peer), -ENODATA);
	}
}

ZTEST(tailscale_peer_inventory, test_peer_limit_invalidates_publication)
{
	char update[128];

	zassert_ok(apply(1, "{\"Node\":{\"ID\":99},\"Peers\":[]}"));
	for (size_t i = 1; i <= TAILSCALE_PEER_INVENTORY_CAPACITY + 1U; ++i) {
		int len = snprintk(update, sizeof(update),
				   "{\"PeersChanged\":[{\"ID\":%zu,\"Key\":\"" KEY2 "\"}]}", i);

		zassert_true(len > 0 && len < sizeof(update));
		if (i <= TAILSCALE_PEER_INVENTORY_CAPACITY) {
			zassert_ok(apply(1, update));
			zassert_equal(summary().peer_count, i);
		} else {
			zassert_equal(apply(1, update), -E2BIG);
		}
	}
	zassert_false(summary().valid);
}

ZTEST_SUITE(tailscale_peer_inventory, NULL, NULL, reset_inventory, NULL, NULL);
```
