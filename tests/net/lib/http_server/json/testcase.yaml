## tests/net/lib/http_server/json/testcase.yaml
```yaml
common:
  harness: net
  min_ram: 16
  tags:
    - http
    - net
    - server
    - socket
  integration_platforms:
    - native_posix_64
    - qemu_x86
tests:
  net.http.server.json: {}
```

## tests/net/lib/http_server/prototype/Kconfig
```kconfig
# Config options for http2 server sample application

# Copyright (c) 2023, Emna Rekik
# SPDX-License-Identifier: Apache-2.0

mainmenu "HTTP2 server sample application"

config NET_HTTP2_MAX_CLIENTS
	int "Max number of HTTP/2 clients"
	default 3
	range 1 100
	help
	  This setting determines the maximum number of HTTP/2 clients that the server can handle at once.

config NET_HTTP2_MAX_STREAMS
	int "Max number of HTTP/2 streams"
	default 2
	range 1 10
	help
	  This setting determines the maximum number of HTTP/2 streams for each client.

config NET_HTTP2_CLIENT_BUFFER_SIZE
	int "Client Buffer Size"
	default 256
	range 64 1024
	help
	  This setting determines the buffer size for each client.

config MAX_HTTP_RESPONSE_SIZE
	int "Maximum HTTP Response Size"
	default 128
	range 64 1024
	help
	  This setting determines the maximum size of the HTTP response that the server can handle.

config MAX_HTTP_URL_LENGTH
	int "Maximum HTTP URL Length"
	default 64
	range 32 256
	help
	  This setting determines the maximum length of the HTTP URL that the server can process.

config NET_HTTP2_MAX_FRAME_SIZE
	int "Maximum Frame Size"
	default 2048
	range 1024 4096
	help
	  This setting determines the maximum size of a frame that the server can handle.

config NET_HTTP2_MAX_FRAMES
	int "Maximum Number of Frames"
	default 1000
	range 100 5000
	help
	  This setting determines the maximum number of frames.

source "Kconfig.zephyr"
```

## tests/net/lib/http_server/rest/testcase.yaml
```yaml
common:
  harness: net
  min_ram: 16
  tags:
    - http
    - net
    - server
    - socket
  integration_platforms:
    - native_sim
    - qemu_x86
tests:
  net.http.server.rest: {}
```

## tests/net/lib/http_server/tls/testcase.yaml
```yaml
common:
  depends_on: netif
  min_ram: 192
  tags:
    - http
    - net
    - server
    - socket
tests:
  net.http.server.tls:
    platform_allow:
      - qemu_x86
    integration_platforms:
      - qemu_x86
  net.http.server.tls.toolchain:
    platform_allow:
      - native_sim
    integration_platforms:
      - native_sim
    integration_toolchains:
      - host
      - llvm
```

## tests/net/lib/lwm2m/block_transfer/testcase.yaml
```yaml
tests:
  net.lwm2m.block_transfer:
    platform_key:
      - simulation
    tags:
      - lwm2m
      - net
    integration_platforms:
      - native_sim
```

## tests/net/lib/lwm2m/content_json/testcase.yaml
```yaml
tests:
  net.lwm2m.content_json:
    platform_key:
      - simulation
    tags:
      - lwm2m
      - net
    integration_platforms:
      - native_posix
```

## tests/net/lib/lwm2m/content_link_format/testcase.yaml
```yaml
tests:
  net.lwm2m.content_link_format:
    platform_key:
      - simulation
    tags:
      - lwm2m
      - net
    integration_platforms:
      - native_sim
```

## tests/net/lib/lwm2m/content_oma_tlv/testcase.yaml
```yaml
common:
  depends_on: netif
tests:
  net.lwm2m.content_oma_tlv:
    filter: TOOLCHAIN_HAS_NEWLIB == 1
    tags: lwm2m net
```

## tests/net/lib/lwm2m/content_plain_text/testcase.yaml
```yaml
tests:
  net.lwm2m.content_plain_text:
    platform_key:
      - simulation
    tags:
      - lwm2m
      - net
    integration_platforms:
      - native_sim
```

## tests/net/lib/lwm2m/content_raw_cbor/testcase.yaml
```yaml
common:
  depends_on: netif
tests:
  net.lwm2m.content_raw_cbor:
    platform_allow: native_posix
    tags: lwm2m net
```

## tests/net/lib/lwm2m/content_senml_cbor/testcase.yaml
```yaml
tests:
  net.lwm2m.content_senml_cbor:
    platform_key:
      - simulation
    tags:
      - lwm2m
      - net
    integration_platforms:
      - native_posix
```

## tests/net/lib/lwm2m/engine/testcase.yaml
```yaml
tests:
  net.lwm2m.engine:
    platform_key:
      - simulation
    tags:
      - lwm2m
      - net
    integration_platforms:
      - native_posix
```

## tests/net/lib/lwm2m/interop/boards/native_posix.conf
```kconfig
CONFIG_DNS_RESOLVER=y
CONFIG_DNS_SERVER_IP_ADDRESSES=y
CONFIG_DNS_SERVER1="192.0.2.2"
CONFIG_LWM2M_DNS_SUPPORT=y
CONFIG_NET_CONFIG_MY_IPV4_GW="192.0.2.2"
CONFIG_NATIVE_POSIX_SLOWDOWN_TO_REAL_TIME=y
CONFIG_NATIVE_UART_0_ON_STDINOUT=y
```

## tests/net/lib/lwm2m/interop/boards/native_sim.conf
```kconfig
CONFIG_DNS_RESOLVER=y
CONFIG_DNS_SERVER_IP_ADDRESSES=y
CONFIG_DNS_SERVER1="192.0.2.2"
CONFIG_LWM2M_DNS_SUPPORT=y
CONFIG_NET_CONFIG_MY_IPV4_GW="192.0.2.2"
CONFIG_NATIVE_SIM_SLOWDOWN_TO_REAL_TIME=y
CONFIG_NATIVE_UART_0_ON_STDINOUT=y
CONFIG_ASAN=y
CONFIG_NATIVE_EXTRA_CMDLINE_ARGS="--seed-random"
CONFIG_ZVFS_OPEN_MAX=16
```

## tests/net/lib/lwm2m/interop/boards/qemu_cortex_m3.conf
```kconfig
CONFIG_NET_L2_ETHERNET=y
CONFIG_ETH_DRIVER=y
CONFIG_ETH_STELLARIS=y
CONFIG_NET_QEMU_ETHERNET=y

# RAM/ROM tuning
CONFIG_IDLE_STACK_SIZE=128
CONFIG_ISR_STACK_SIZE=512
CONFIG_LWM2M_LOG_LEVEL_INF=y
CONFIG_LOG_BUFFER_SIZE=512

# qemu_cortex_m3 have smaller memory so simulate a small
# device and small network where max CoAP packet is 256+headers.
# This excercises the outgoing block-wise module intentionally.
CONFIG_LWM2M_COAP_MAX_MSG_SIZE=256
CONFIG_LWM2M_COAP_BLOCK_SIZE=256
CONFIG_LWM2M_COAP_BLOCK_TRANSFER=y
CONFIG_LWM2M_COAP_ENCODE_BUFFER_SIZE=2048
```

## tests/net/lib/lwm2m/interop/testcase.yaml
```yaml
tests:
  net.lwm2m.interop:
    harness: pytest
    timeout: 600
    slow: true
    harness_config:
      pytest_dut_scope: module
    integration_platforms:
      - native_sim
    platform_allow:
      - native_sim
      - qemu_cortex_m3
      - qemu_x86
    tags:
      - testing
      - pytest
      - shell
```

## tests/net/lib/lwm2m/lwm2m_engine/testcase.yaml
```yaml
tests:
  net.lwm2m.lwm2m_engine:
    platform_key:
      - simulation
    tags:
      - fdtable
      - lwm2m
      - net
    integration_platforms:
      - native_sim
```

## tests/net/lib/lwm2m/lwm2m_rd_client/testcase.yaml
```yaml
common:
  platform_key:
    - simulation
  tags:
    - lwm2m
    - net
  platform_allow:
    - native_sim
tests:
  net.lwm2m.lwm2m_rd_client:
    extra_args: EXTRA_CFLAGS=""
  net.lwm2m.lwm2m_rd_client_dtls:
    extra_args: EXTRA_CFLAGS=-DCONFIG_LWM2M_DTLS_SUPPORT
```

## tests/net/lib/lwm2m/lwm2m_registry/Kconfig
```kconfig
# Copyright (c) 2023 Nordic Semiconductor ASA
# SPDX-License-Identifier: Apache-2.0

config TEST_DEPRECATED
	bool "Test also deprecated functions"

source "Kconfig.zephyr"
```

## tests/net/lib/lwm2m/lwm2m_registry/testcase.yaml
```yaml
tests:
  net.lwm2m.lwm2m_registry:
    platform_key:
      - simulation
    tags:
      - lwm2m
      - net
    integration_platforms:
      - native_sim
  net.lwm2m.lwm2m_registry.always_report_obj_version:
    platform_key:
      - simulation
    tags:
      - lwm2m
      - net
    integration_platforms:
      - native_sim
    extra_configs:
      - CONFIG_LWM2M_ENGINE_ALWAYS_REPORT_OBJ_VERSION=y
```

## tests/net/lib/lwm2m/pytest/boards/native_posix.conf
```kconfig
# General config, fine tune when needed
CONFIG_MAIN_STACK_SIZE=2048
CONFIG_HEAP_MEM_POOL_SIZE=16384

# Native posix requirements
CONFIG_ENTROPY_GENERATOR=y
CONFIG_TEST_RANDOM_GENERATOR=y
CONFIG_NATIVE_POSIX_SLOWDOWN_TO_REAL_TIME=y

CONFIG_NET_L2_ETHERNET=y
CONFIG_ETH_NATIVE_POSIX=y
CONFIG_ETH_NATIVE_POSIX_RANDOM_MAC=y

# Network address config
CONFIG_NET_CONFIG_SETTINGS=y
CONFIG_NET_CONFIG_NEED_IPV4=y
CONFIG_NET_CONFIG_MY_IPV4_ADDR="192.0.2.1"
CONFIG_NET_CONFIG_PEER_IPV4_ADDR="192.0.2.2"
CONFIG_NET_CONFIG_MY_IPV4_GW="192.0.2.2"
CONFIG_DNS_RESOLVER=y
CONFIG_DNS_RESOLVER_MAX_SERVERS=1
CONFIG_DNS_SERVER_IP_ADDRESSES=y
CONFIG_DNS_SERVER1="192.0.2.2"
```

## tests/net/lib/mdns_responder/testcase.yaml
```yaml
common:
  tags:
    - dns
    - fdtable
    - net
  depends_on: netif
tests:
  net.mdns:
    min_ram: 21
    timeout: 600
```

## tests/net/lib/mqtt/v3_1_1/mqtt_client/testcase.yaml
```yaml
common:
  tags:
    - net
    - mqtt
  depends_on: netif
  min_ram: 16
tests:
  net.mqtt.client:
    extra_configs:
      - CONFIG_NET_TC_THREAD_COOPERATIVE=y
  net.mqtt.client.preempt:
    extra_configs:
      - CONFIG_NET_TC_THREAD_PREEMPTIVE=y
```

## tests/net/lib/mqtt/v3_1_1/mqtt_packet/testcase.yaml
```yaml
common:
  depends_on: netif
tests:
  net.mqtt.packet:
    min_ram: 16
    tags:
      - mqtt
      - net
      - userspace
```
