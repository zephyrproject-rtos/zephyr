## CMakeLists.txt
```
# SPDX-License-Identifier: Apache-2.0

cmake_minimum_required(VERSION 3.28.0)
find_package(Zephyr REQUIRED HINTS $ENV{ZEPHYR_BASE})
project(coap_client_test)

set(APP_SRC_DIR ${CMAKE_CURRENT_SOURCE_DIR}/src)

# Add test sources
target_sources(app PRIVATE ${APP_SRC_DIR}/main.c)
target_sources(app PRIVATE ${APP_SRC_DIR}/stubs.c)
target_sources(app PRIVATE ${ZEPHYR_BASE}/subsys/net/lib/coap/coap_client.c)
target_sources(app PRIVATE ${ZEPHYR_BASE}/subsys/net/lib/coap/coap.c)

# Add includes directories
target_include_directories(app PRIVATE ${CMAKE_CURRENT_SOURCE_DIR}/src)
target_include_directories(app PRIVATE ${ZEPHYR_BASE}/include/)

target_compile_definitions(app PRIVATE _POSIX_C_SOURCE=200809L)

add_compile_definitions(CONFIG_ZVFS_POLL_MAX=3)
add_compile_definitions(CONFIG_COAP_CLIENT=1)
if(NOT COAP_CLIENT_NO_MULTICAST)
  add_compile_definitions(CONFIG_COAP_CLIENT_MULTICAST=1)
endif()
add_compile_definitions(CONFIG_COAP_CLIENT_BLOCK_SIZE=256)
if(NOT DEFINED COAP_CLIENT_MESSAGE_SIZE)
  set(COAP_CLIENT_MESSAGE_SIZE 256)
endif()
add_compile_definitions(CONFIG_COAP_CLIENT_MESSAGE_SIZE=${COAP_CLIENT_MESSAGE_SIZE})
add_compile_definitions(CONFIG_COAP_CLIENT_MESSAGE_HEADER_SIZE=48)
add_compile_definitions(CONFIG_COAP_CLIENT_MAX_PATH_LENGTH=32)
add_compile_definitions(CONFIG_COAP_CLIENT_MAX_EXTRA_OPTIONS=2)
add_compile_definitions(CONFIG_COAP_CLIENT_STACK_SIZE=1024)
add_compile_definitions(CONFIG_COAP_CLIENT_THREAD_PRIORITY=10)
add_compile_definitions(CONFIG_COAP_LOG_LEVEL=4)
add_compile_definitions(CONFIG_COAP_INIT_ACK_TIMEOUT_MS=1000)
add_compile_definitions(CONFIG_COAP_CLIENT_MAX_REQUESTS=2)
add_compile_definitions(CONFIG_COAP_CLIENT_MAX_INSTANCES=2)
add_compile_definitions(CONFIG_COAP_MAX_RETRANSMIT=4)
add_compile_definitions(CONFIG_COAP_BACKOFF_PERCENT=200)
add_compile_definitions(CONFIG_COAP_LOG_LEVEL=4)
```

## prj.conf
```kconfig
#Testing
CONFIG_ZTEST=y
CONFIG_ZTEST_STACK_SIZE=4096
CONFIG_TEST_RANDOM_GENERATOR=y
```

## boards/native_sim.conf
```kconfig
CONFIG_NATIVE_SIM_SLOWDOWN_TO_REAL_TIME=y
```

## src/stubs.c
```c
/*
 * Copyright (c) 2023 Nordic Semiconductor ASA
 *
 * SPDX-License-Identifier: Apache-2.0
 */

#include <zephyr/logging/log.h>
#include <zephyr/zvfs/eventfd.h>
#include <stubs.h>

LOG_MODULE_DECLARE(coap_client_test, LOG_LEVEL_DBG);

DEFINE_FAKE_VALUE_FUNC(uint32_t, z_impl_sys_rand32_get);
DEFINE_FAKE_VALUE_FUNC(ssize_t, z_impl_zsock_recvfrom, int, void *, size_t, int,
		       struct net_sockaddr *, net_socklen_t *);
DEFINE_FAKE_VALUE_FUNC(ssize_t, z_impl_zsock_sendto, int, void *, size_t, int,
		       const struct net_sockaddr *, net_socklen_t);

struct zvfs_pollfd {
	int fd;
	short events;
	short revents;
};

static short my_events[NUM_FD];

void set_socket_events(int fd, short events)
{
	__ASSERT_NO_MSG(fd < NUM_FD);
	my_events[fd] |= events;
}

void clear_socket_events(int fd, short events)
{
	my_events[fd] &= ~events;
}

int z_impl_zvfs_poll(struct zvfs_pollfd *fds, int nfds, int poll_timeout)
{
	int events = 0;
	k_sleep(K_MSEC(1));
	for (int i = 0; i < nfds; i++) {
		fds[i].revents =
			my_events[fds[i].fd] & (fds[i].events | ZSOCK_POLLERR | ZSOCK_POLLHUP);
		if (fds[i].revents) {
			events++;
		}
	}
	if (events == 0) {
		k_sleep(K_MSEC(poll_timeout));
	}

	return events;
}

/* Mock of the cancel-wakeup eventfd. It is hooked into the same my_events[]
 * table as the sockets so that a write makes the poll() stub report POLLIN on
 * its fd (NUM_FD - 1), exercising the real wakeup/ack path in
 * coap_client_cancel_requests().
 */
static zvfs_eventfd_t eventfd_value;

int zvfs_eventfd(unsigned int initval, int flags)
{
	ARG_UNUSED(flags);
	eventfd_value = initval;
	return NUM_FD - 1;
}

int zvfs_eventfd_read(int fd, zvfs_eventfd_t *value)
{
	*value = eventfd_value;
	eventfd_value = 0;
	clear_socket_events(fd, ZSOCK_POLLIN);
	return 0;
}

int zvfs_eventfd_write(int fd, zvfs_eventfd_t value)
{
	eventfd_value += value;
	set_socket_events(fd, ZSOCK_POLLIN);
	return 0;
}
```

## src/stubs.h
```c
/*
 * Copyright (c) 2023 Nordic Semiconductor ASA
 *
 * SPDX-License-Identifier: Apache-2.0
 */

#ifndef STUBS_H
#define STUBS_H

#include <stdbool.h>
#include <stdint.h>

#include <zephyr/fff.h>
#include <zephyr/ztest.h>

#include <zephyr/net/coap_client.h>


/* Copy from zephyr/include/zephyr/net/socket.h */
/**
 * @name Options for poll()
 * @{
 */
/* ZSOCK_POLL* values are compatible with Linux */
/** zsock_poll: Poll for readability */
#define ZSOCK_POLLIN 1
/** zsock_poll: Poll for exceptional condition */
#define ZSOCK_POLLPRI 2
/** zsock_poll: Poll for writability */
#define ZSOCK_POLLOUT 4
/** zsock_poll: Poll results in error condition (output value only) */
#define ZSOCK_POLLERR 8
/** zsock_poll: Poll detected closed connection (output value only) */
#define ZSOCK_POLLHUP 0x10
/** zsock_poll: Invalid socket (output value only) */
#define ZSOCK_POLLNVAL 0x20
/** @} */

/* Socket fds 0 and 1, plus the cancel-wakeup eventfd at NUM_FD - 1. */
#define NUM_FD 3

void set_socket_events(int fd, short events);
void clear_socket_events(int fd, short events);

DECLARE_FAKE_VALUE_FUNC(uint32_t, z_impl_sys_rand32_get);
DECLARE_FAKE_VALUE_FUNC(ssize_t, z_impl_zsock_recvfrom, int, void *, size_t, int,
			struct net_sockaddr *, net_socklen_t *);
DECLARE_FAKE_VALUE_FUNC(ssize_t, z_impl_zsock_sendto, int, void*, size_t, int,
			const struct net_sockaddr *, net_socklen_t);

#define DO_FOREACH_FAKE(FUNC)                                                                      \
	do {                                                                                       \
		FUNC(z_impl_sys_rand32_get)                                                        \
		FUNC(z_impl_zsock_recvfrom)                                                        \
		FUNC(z_impl_zsock_sendto)                                                          \
	} while (0)

#endif /* STUBS_H */
```
