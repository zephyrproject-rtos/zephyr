## CMakeLists.txt
```
# SPDX-FileCopyrightText: Copyright The Zephyr Project Contributors
# SPDX-License-Identifier: Apache-2.0

cmake_minimum_required(VERSION 3.28.0)

find_package(Zephyr REQUIRED HINTS $ENV{ZEPHYR_BASE})
project(config)

# For the SNTP packet struct definitions
target_include_directories(app PRIVATE ${ZEPHYR_BASE}/subsys/net/lib/sntp)

target_sources(app PRIVATE src/main.c)
```

## prj.conf
```kconfig
# SPDX-FileCopyrightText: Copyright The Zephyr Project Contributors
# SPDX-License-Identifier: Apache-2.0

CONFIG_ZTEST=y

CONFIG_NETWORKING=y
CONFIG_NET_IPV4=y
CONFIG_NET_IPV6=n
CONFIG_NET_UDP=y
CONFIG_NET_SOCKETS=y

# Bounds the test server's wait for a request.
CONFIG_NET_CONTEXT_RCVTIMEO=y

# sntp_simple() resolves the server name through getaddrinfo(), which is
# only built with the resolver. No DNS server is needed, the names
# under test are numeric.
CONFIG_DNS_RESOLVER=y

# Keeps QEMU boards on loopback instead of the SLIP driver, which needs
# a host socket no test runner provides.
CONFIG_NET_TEST=y
CONFIG_NET_DRIVERS=y
CONFIG_NET_LOOPBACK=y
CONFIG_NET_L2_ETHERNET=n

CONFIG_SNTP=y

CONFIG_NET_CONFIG_SETTINGS=y
# The tests drive net_config_init_clock_via_sntp() themselves.
CONFIG_NET_CONFIG_AUTO_INIT=n
CONFIG_NET_CONFIG_CLOCK_SNTP_INIT=y
CONFIG_NET_CONFIG_SNTP_INIT_SERVER_RUNTIME=y
# Short enough that a test can exceed it without an unwieldy literal.
CONFIG_NET_CONFIG_SNTP_INIT_SERVER_MAX_LEN=16
# A name, not an address: the loopback driver answers a datagram whatever
# it is addressed to, so only a server that cannot be resolved at all is
# reliably distinguishable from the served one. No DNS server is
# configured, so resolving this fails.
CONFIG_NET_CONFIG_SNTP_INIT_SERVER="bad.invalid"
CONFIG_NET_CONFIG_SNTP_INIT_TIMEOUT=300
# Keeps the periodic work out of the way of the tests.
CONFIG_NET_CONFIG_SNTP_INIT_RESYNC=n

# Deliver the datagram in the sending context.
CONFIG_NET_TC_RX_COUNT=0

CONFIG_NET_UDP_CHECKSUM=n

CONFIG_MAIN_STACK_SIZE=3072
CONFIG_ZTEST_STACK_SIZE=3072
```

## resync.conf
```kconfig
# SPDX-FileCopyrightText: Copyright The Zephyr Project Contributors
# SPDX-License-Identifier: Apache-2.0
# SPDX-FileCopyrightText: Copyright 2026 inovex GmbH

# Overlay for the resync scenario. The periodic resync is what is under test
# here, so unlike the base configuration it stays on.
CONFIG_NET_CONFIG_SNTP_INIT_RESYNC=y

# The shortest intervals the options allow: one test has to sit out a whole
# interval to see the resync come back on its own.
CONFIG_NET_CONFIG_SNTP_INIT_RESYNC_INTERVAL=15
CONFIG_NET_CONFIG_SNTP_INIT_RESYNC_ON_FAILURE_INTERVAL=15

# Wide enough that a test can reliably get a second request in while a
# silenced query is still waiting on this timeout.
CONFIG_NET_CONFIG_SNTP_INIT_TIMEOUT=500

# The resync runs DNS and socket work on these threads instead of on the test
# thread, and none of the default stacks is sized for it.
CONFIG_SYSTEM_WORKQUEUE_STACK_SIZE=2048
CONFIG_NET_DEDICATED_WORKQUEUE_STACK_SIZE=2048
CONFIG_NET_SOCKETS_SERVICE_STACK_SIZE=2048

# The tests raise no L4 events, so nothing would ever enable the resync.
CONFIG_NET_CONFIG_SNTP_INIT_USE_CONNECTION_MANAGER=n
```

## src/main.c
```c
/*
 * SPDX-FileCopyrightText: Copyright The Zephyr Project Contributors
 * SPDX-License-Identifier: Apache-2.0
 * SPDX-FileCopyrightText: Copyright 2026 inovex GmbH
 */

/*
 * Tests for selecting the net_config SNTP server at runtime.
 *
 * A minimal SNTP server runs on loopback and answers whatever reaches it.
 * The Kconfig server is a name that cannot be resolved, so which server a
 * query went to is visible in whether the clock was set.
 */

#include <errno.h>

#include <zephyr/kernel.h>
#include <zephyr/net/net_config.h>
#include <zephyr/ztest.h>

#include "test_util.h"

/* The Kconfig server does not resolve, so a query that reached a server at
 * all can only have used the runtime setting.
 */
ZTEST(net_config_sntp, test_runtime_server_overrides_kconfig)
{
	zassert_true(sizeof(CONFIG_NET_CONFIG_SNTP_INIT_SERVER) > 1,
		     "the test needs a Kconfig server to be overridden");

	set_clock(UNTOUCHED_TIME);

	zassert_ok(net_config_sntp_set_server("127.0.0.1"), "could not set the server");
	zassert_ok(net_config_init_clock_via_sntp(), "the SNTP query failed");

	zassert_between_inclusive(get_clock(), SERVED_TIME, SERVED_TIME + 1,
				  "the Kconfig server was used instead of the runtime one");
}

/* Clearing the runtime server puts the unresolvable Kconfig server back in
 * charge, so the query fails and the clock keeps the value it had.
 */
ZTEST(net_config_sntp, test_clearing_falls_back_to_kconfig)
{
	zassert_ok(net_config_sntp_set_server("127.0.0.1"), "could not set the server");
	zassert_ok(net_config_sntp_set_server(NULL), "could not clear the server");

	set_clock(UNTOUCHED_TIME);

	zassert_not_equal(net_config_init_clock_via_sntp(), 0,
			  "a query to the unresolvable Kconfig server reported success");
	zassert_between_inclusive(get_clock(), UNTOUCHED_TIME, UNTOUCHED_TIME + 1,
				  "the clock was changed by a failed query");
}

/* The name is rejected whole: a truncated server is worse than no change. */
ZTEST(net_config_sntp, test_too_long_name_is_rejected)
{
	static const char too_long[] = "0123456789abcdef0";

	BUILD_ASSERT(sizeof(too_long) - 1 > CONFIG_NET_CONFIG_SNTP_INIT_SERVER_MAX_LEN,
		     "the test name has to exceed the configured maximum");

	zassert_ok(net_config_sntp_set_server("127.0.0.1"), "could not set the server");

	zassert_equal(net_config_sntp_set_server(too_long), -ENAMETOOLONG,
		      "an over-long server name was accepted");
}

static void before(void *fixture)
{
	ARG_UNUSED(fixture);

	(void)net_config_sntp_set_server(NULL);
}

static void *setup(void)
{
	sntp_test_server_start();

	return NULL;
}

static void teardown(void *fixture)
{
	ARG_UNUSED(fixture);

	sntp_test_server_stop();
}

ZTEST_SUITE(net_config_sntp, NULL, setup, before, NULL, teardown);
```

## src/resync.c
```c
/*
 * SPDX-FileCopyrightText: Copyright The Zephyr Project Contributors
 * SPDX-License-Identifier: Apache-2.0
 * SPDX-FileCopyrightText: Copyright 2026 inovex GmbH
 */

/*
 * Tests for the periodic SNTP resync.
 *
 * The resync runs on the system work queue and reports nothing back, so the
 * tests drive it through the two inputs it has - the runtime server and the
 * server's willingness to answer - and read every outcome off the realtime
 * clock. A resync that ran against the test server leaves the clock at
 * SERVED_TIME; one that did not run, or ran against the unresolvable Kconfig
 * server, leaves it where the test put it.
 *
 * "127.0.0.1" is a numeric name, which the resolver answers from the calling
 * context, so a resync against it needs no DNS server. The Kconfig server is
 * a name and no DNS server is configured, so a resync against it fails
 * outright - which is how the tests get a failing resync.
 */

#include <zephyr/kernel.h>
#include <zephyr/net/net_config.h>
#include <zephyr/ztest.h>

#include "test_util.h"

/* Long enough that a resync arriving on the interval rather than on request
 * is not mistaken for a prompt one.
 */
#define PROMPT_RESYNC_TIMEOUT_SEC 5
#define PROMPT_RESYNC_TIMEOUT     K_SECONDS(PROMPT_RESYNC_TIMEOUT_SEC)

/* The tests raise no L4 events, so the resync has to be enabled from the
 * start, which it only is without the connection manager.
 */
BUILD_ASSERT(!IS_ENABLED(CONFIG_NET_CONFIG_SNTP_INIT_USE_CONNECTION_MANAGER),
	     "the resync tests drive no L4 events, so they cannot run with the connection "
	     "manager holding the resync disabled");

BUILD_ASSERT(CONFIG_NET_CONFIG_SNTP_INIT_RESYNC_ON_FAILURE_INTERVAL > PROMPT_RESYNC_TIMEOUT_SEC,
	     "the failure interval has to outlast the wait, or the tests cannot tell a prompt "
	     "resync from a rescheduled one");
BUILD_ASSERT(CONFIG_NET_CONFIG_SNTP_INIT_RESYNC_INTERVAL > PROMPT_RESYNC_TIMEOUT_SEC,
	     "the resync interval has to outlast the wait, or the tests cannot tell a prompt "
	     "resync from a periodic one");

/* Polls, because what a successful resync does is write the clock and there
 * is no completion the test could wait on instead.
 */
static bool wait_for_resync(k_timeout_t timeout)
{
	k_timepoint_t deadline = sys_timepoint_calc(timeout);

	do {
		if (get_clock() >= SERVED_TIME) {
			return true;
		}

		k_sleep(K_MSEC(10));
	} while (!sys_timepoint_expired(deadline));

	return false;
}

/* Nothing in the test calls net_config_init_clock_via_sntp(): setting the
 * server has to get the clock set on its own.
 */
ZTEST(net_config_sntp_resync, test_setting_the_server_resyncs)
{
	set_clock(UNTOUCHED_TIME);

	zassert_ok(net_config_sntp_set_server("127.0.0.1"), "could not set the server");

	zassert_true(wait_for_resync(PROMPT_RESYNC_TIMEOUT),
		     "setting the server did not resync the clock");
}

/* A resync has to leave its successor scheduled. Only the interval armed by
 * the first one can produce the second, since the test asks for nothing in
 * between.
 */
ZTEST(net_config_sntp_resync, test_resync_repeats_on_the_interval)
{
	set_clock(UNTOUCHED_TIME);
	zassert_ok(net_config_sntp_set_server("127.0.0.1"), "could not set the server");
	zassert_true(wait_for_resync(PROMPT_RESYNC_TIMEOUT), "the first resync did not run");

	set_clock(UNTOUCHED_TIME);

	zassert_true(wait_for_resync(K_SECONDS(CONFIG_NET_CONFIG_SNTP_INIT_RESYNC_INTERVAL + 5)),
		     "a successful resync did not schedule the next one");
}

/* A resync that fails must not leave the resync state machine wedged: the
 * next one still has to run.
 */
ZTEST(net_config_sntp_resync, test_resync_recovers_from_a_failed_query)
{
	/* No runtime server hands the unresolvable Kconfig server the query. */
	zassert_ok(net_config_sntp_set_server(NULL), "could not clear the server");

	set_clock(UNTOUCHED_TIME);
	zassert_false(wait_for_resync(K_MSEC(500)),
		      "a resync against the unresolvable Kconfig server set the clock");

	zassert_ok(net_config_sntp_set_server("127.0.0.1"), "could not set the server");

	zassert_true(wait_for_resync(PROMPT_RESYNC_TIMEOUT),
		     "no resync ran after a failed one");
}

/* A resync requested while one is in flight is deferred, not dropped, and
 * the in-flight one finishing must not push the deferred one out to the
 * failure interval.
 */
ZTEST(net_config_sntp_resync, test_resync_requested_during_a_query_is_not_lost)
{
	set_clock(UNTOUCHED_TIME);

	/* This resync gets no answer, so it is still waiting on its timeout
	 * when the request below arrives.
	 */
	sntp_test_server_set_answering(false);
	zassert_ok(net_config_sntp_set_server("127.0.0.1"), "could not set the server");

	/* Long enough for the query to have gone out, short enough to stay
	 * inside its timeout.
	 */
	k_sleep(K_MSEC(CONFIG_NET_CONFIG_SNTP_INIT_TIMEOUT / 4));

	sntp_test_server_set_answering(true);
	zassert_ok(net_config_sntp_set_server("127.0.0.1"), "could not set the server");

	zassert_true(wait_for_resync(PROMPT_RESYNC_TIMEOUT),
		     "the resync requested during an in-flight one was dropped or deferred to "
		     "the failure interval");
}

static void before(void *fixture)
{
	ARG_UNUSED(fixture);

	sntp_test_server_set_answering(true);

	/* Clearing the server also asks for a resync, which fails against the
	 * Kconfig server and so leaves nothing in flight for the next test.
	 */
	(void)net_config_sntp_set_server(NULL);
	k_sleep(K_MSEC(CONFIG_NET_CONFIG_SNTP_INIT_TIMEOUT * 2));
}

static void *setup(void)
{
	sntp_test_server_start();

	return NULL;
}

static void teardown(void *fixture)
{
	ARG_UNUSED(fixture);

	sntp_test_server_stop();
}

ZTEST_SUITE(net_config_sntp_resync, NULL, setup, before, NULL, teardown);
```

## src/test_util.c
```c
/*
 * SPDX-FileCopyrightText: Copyright The Zephyr Project Contributors
 * SPDX-License-Identifier: Apache-2.0
 * SPDX-FileCopyrightText: Copyright 2026 inovex GmbH
 */

#include <zephyr/kernel.h>
#include <zephyr/net/net_ip.h>
#include <zephyr/net/socket.h>
#include <zephyr/sys/clock.h>
#include <zephyr/ztest.h>

#include "sntp_pkt.h"
#include "test_util.h"

#define MODE_SERVER 4
#define VERSION     4

#define SNTP_SERVER_STACK_SIZE 2048
#define SNTP_SERVER_PRIORITY   K_PRIO_PREEMPT(8)

static int sntp_server_fd = -1;
static struct k_thread sntp_server_thread_data;
static K_THREAD_STACK_DEFINE(sntp_server_stack, SNTP_SERVER_STACK_SIZE);

/* Cleared by sntp_test_server_stop() so the server thread can return on its
 * own. It is aborting a thread parked in a receive that leaves the run
 * without an event to end on.
 */
static volatile bool sntp_server_running;

/* A silent server still consumes the request, so the client sees a lost
 * response rather than an unreachable port.
 */
static volatile bool sntp_server_answering;

/* Answer every request that arrives, echoing the client's transmit
 * timestamp back as the originate timestamp so the client accepts it.
 */
static void sntp_server_thread(void *p1, void *p2, void *p3)
{
	ARG_UNUSED(p1);
	ARG_UNUSED(p2);
	ARG_UNUSED(p3);

	while (sntp_server_running) {
		struct net_sockaddr_in client;
		net_socklen_t client_len = sizeof(client);
		struct sntp_pkt pkt;
		int ret;

		ret = zsock_recvfrom(sntp_server_fd, &pkt, sizeof(pkt), 0,
				     (struct net_sockaddr *)&client, &client_len);
		if (ret != (int)sizeof(pkt)) {
			continue;
		}

		if (!sntp_server_answering) {
			continue;
		}

		pkt.orig_tm_s = pkt.tx_tm_s;
		pkt.orig_tm_f = pkt.tx_tm_f;
		pkt.li = 0;
		pkt.vn = VERSION;
		pkt.mode = MODE_SERVER;
		pkt.stratum = 2;
		pkt.poll = 4;
		pkt.precision = -6;
		pkt.rx_tm_s = net_htonl(OFFSET_1970_JAN_1 + SERVED_TIME);
		pkt.rx_tm_f = 0;
		pkt.tx_tm_s = net_htonl(OFFSET_1970_JAN_1 + SERVED_TIME);
		pkt.tx_tm_f = 0;

		(void)zsock_sendto(sntp_server_fd, &pkt, sizeof(pkt), 0,
				   (struct net_sockaddr *)&client, client_len);
	}
}

void sntp_test_server_start(void)
{
	struct net_sockaddr_in addr = {
		.sin_family = NET_AF_INET,
		.sin_port = net_htons(SNTP_PORT),
		.sin_addr = {{{127, 0, 0, 1}}},
	};
	/* Keeps the server thread out of an unbounded wait, so it notices
	 * the teardown promptly.
	 */
	struct timeval timeout = {.tv_sec = 0, .tv_usec = 100000};

	sntp_server_fd = zsock_socket(NET_AF_INET, NET_SOCK_DGRAM, NET_IPPROTO_UDP);
	zassert_true(sntp_server_fd >= 0, "could not open the server socket");

	zassert_ok(zsock_bind(sntp_server_fd, (struct net_sockaddr *)&addr, sizeof(addr)),
		   "could not bind the server socket");

	zassert_ok(zsock_setsockopt(sntp_server_fd, ZSOCK_SOL_SOCKET, ZSOCK_SO_RCVTIMEO, &timeout,
				    sizeof(timeout)),
		   "could not set the server socket's receive timeout");

	sntp_server_answering = true;
	sntp_server_running = true;

	k_thread_create(&sntp_server_thread_data, sntp_server_stack,
			K_THREAD_STACK_SIZEOF(sntp_server_stack), sntp_server_thread, NULL, NULL,
			NULL, SNTP_SERVER_PRIORITY, 0, K_NO_WAIT);
	k_thread_name_set(&sntp_server_thread_data, "sntp_server");
}

void sntp_test_server_stop(void)
{
	sntp_server_running = false;
	zassert_ok(k_thread_join(&sntp_server_thread_data, K_SECONDS(2)),
		   "the server thread did not stop");

	(void)zsock_close(sntp_server_fd);
	sntp_server_fd = -1;
}

void sntp_test_server_set_answering(bool answering)
{
	sntp_server_answering = answering;
}

void set_clock(time_t seconds)
{
	struct timespec tspec = {.tv_sec = seconds, .tv_nsec = 0};

	zassert_ok(sys_clock_settime(SYS_CLOCK_REALTIME, &tspec),
		   "could not prime the realtime clock");
}

time_t get_clock(void)
{
	struct timespec tspec;

	zassert_ok(sys_clock_gettime(SYS_CLOCK_REALTIME, &tspec),
		   "could not read the realtime clock");

	return tspec.tv_sec;
}
```

## src/test_util.h
```c
/*
 * SPDX-FileCopyrightText: Copyright The Zephyr Project Contributors
 * SPDX-License-Identifier: Apache-2.0
 * SPDX-FileCopyrightText: Copyright 2026 inovex GmbH
 */

/*
 * The pieces both scenarios of this test share: a minimal SNTP server on
 * loopback, and the realtime clock the tests read a query's outcome from.
 */

#ifndef ZEPHYR_TESTS_NET_LIB_CONFIG_TEST_UTIL_H_
#define ZEPHYR_TESTS_NET_LIB_CONFIG_TEST_UTIL_H_

#include <stdbool.h>
#include <time.h>

/* The time the test server serves, and a different one the tests write to
 * the clock beforehand, so "the clock was set" and "the clock was left
 * alone" tell each other apart.
 */
#define SERVED_TIME    1000000000
#define UNTOUCHED_TIME 500000000

/* Runs an SNTP server on 127.0.0.1 that answers whatever reaches it. */
void sntp_test_server_start(void);
void sntp_test_server_stop(void);

/* Whether the server answers at all. A server that takes a request and then
 * stays silent makes the client run into its timeout, which is how a test
 * arranges for a query to still be in flight when it needs one to be.
 */
void sntp_test_server_set_answering(bool answering);

void set_clock(time_t seconds);
time_t get_clock(void);

#endif /* ZEPHYR_TESTS_NET_LIB_CONFIG_TEST_UTIL_H_ */
```
