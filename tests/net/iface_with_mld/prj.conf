## CMakeLists.txt
```
# SPDX-License-Identifier: Apache-2.0

cmake_minimum_required(VERSION 3.20.0)
find_package(Zephyr REQUIRED HINTS $ENV{ZEPHYR_BASE})
project(iface_with_mld)

target_include_directories(app PRIVATE ${ZEPHYR_BASE}/subsys/net/ip)
FILE(GLOB app_sources src/*.c)
target_sources(app PRIVATE ${app_sources})
```

## prj.conf
```kconfig
CONFIG_NETWORKING=y
CONFIG_NET_TEST=y
CONFIG_NET_IPV6=y
CONFIG_NET_IF_MAX_IPV6_COUNT=4

CONFIG_NET_IF_UNICAST_IPV6_ADDR_COUNT=4
CONFIG_NET_IF_MCAST_IPV6_ADDR_COUNT=6
CONFIG_NET_IPV6_ND=y

CONFIG_NET_L2_DUMMY=y
CONFIG_NET_L2_ETHERNET=n

# Make bring-up actually transmit (all-nodes MLD report), so the operational
# state notification runs the packet TX path while the interface is being
# brought up.
CONFIG_NET_IPV6_MLD=y

# The TX path checks whether the destination is one of our own addresses via
# net_if_ipv6_addr_lookup_raw(), which walks and locks every interface in turn.
# That is the cross-interface lock the deadlock test relies on, so keep the
# address check enabled and make sure the dummy L2 loopback short-circuit (in
# check_ip()) is not compiled in.
CONFIG_NET_IP_ADDR_CHECK=y
CONFIG_NET_LOOPBACK=n

CONFIG_ENTROPY_GENERATOR=y
CONFIG_TEST_RANDOM_GENERATOR=y

CONFIG_ZTEST=y
CONFIG_MAIN_STACK_SIZE=2048
CONFIG_ZTEST_STACK_SIZE=2048
```

## src/main.c
```c
/*
 * Copyright (c) 2026 Nordic Semiconductor ASA
 *
 * SPDX-License-Identifier: Apache-2.0
 */

/*
 * Regression test for the ABBA deadlock that could occur when two network
 * interfaces are brought up concurrently.
 *
 * Bringing an interface up runs notify_iface_up(), which transmits packets
 * (e.g. the all-nodes MLD report). The TX path runs check_ip() ->
 * net_ipv6_is_my_addr_raw() -> net_if_ipv6_addr_lookup_raw(), which walks and
 * locks *every* interface in turn. In the buggy code this ran while
 * net_if_lock(iface) of the interface being brought up was still held, so two
 * interfaces coming up concurrently could deadlock.
 *
 * To reproduce this deterministically we give the "slow" dummy interface a
 * driver start() callback that sleeps. net_if_up() invokes start() while
 * holding net_if_lock(slow_iface), so the lock is held for the whole sleep.
 * While the slow interface is parked in start(), the test brings the "fast"
 * interface up from another thread. Its bring-up TX iterates the interfaces
 * and blocks on lock(slow); once the slow interface wakes, its own bring-up TX
 * tries to take lock(fast) -> ABBA.
 *
 */

#include <zephyr/ztest.h>
#include <zephyr/kernel.h>
#include <zephyr/device.h>
#include <zephyr/sys/atomic.h>

#include <zephyr/net/net_if.h>
#include <zephyr/net/net_ip.h>
#include <zephyr/net/dummy.h>

/* How long the slow interface holds net_if_lock() inside its start(). */
#define SLOW_START_SLEEP_MS 300

/*
 * Time allowed for each bring-up thread to finish. The fixed code only blocks
 * for the duration of the slow interface's start() sleep, so this must be
 * larger than SLOW_START_SLEEP_MS, but still finite to catch a real deadlock.
 */
#define BRINGUP_TIMEOUT K_MSEC(SLOW_START_SLEEP_MS + 3000)

static struct net_if *slow_iface;
static struct net_if *fast_iface;

/* Dedicated interface for the solicited-node multicast join regression test,
 * kept separate so it does not perturb the deadlock test above.
 */
static struct net_if *dad_iface;

static struct net_in6_addr slow_addr = { { { 0x20, 0x01, 0x0d, 0xb8, 0xaa, 0, 0, 0,
					     0, 0, 0, 0, 0, 0, 0, 0x1 } } };
static struct net_in6_addr fast_addr = { { { 0x20, 0x01, 0x0d, 0xb8, 0xbb, 0, 0, 0,
					     0, 0, 0, 0, 0, 0, 0, 0x1 } } };
/* Added while dad_iface is up, so addr_add() must join the solicited-node
 * group on its own (rather than relying on the interface bring-up path).
 */
static struct net_in6_addr dad_addr = { { { 0x20, 0x01, 0x0d, 0xb8, 0xcc, 0, 0, 0,
					    0, 0, 0, 0, 0, 0xab, 0xcd, 0xef } } };

static atomic_t slow_start_armed;
static K_SEM_DEFINE(slow_in_start, 0, 1);
static K_SEM_DEFINE(done_slow, 0, 1);
static K_SEM_DEFINE(done_fast, 0, 1);

struct dummy_dev_data {
	uint8_t mac[6];
};

static struct dummy_dev_data slow_data = {
	.mac = { 0x00, 0x00, 0x5e, 0x00, 0x53, 0x01 },
};
static struct dummy_dev_data fast_data = {
	.mac = { 0x00, 0x00, 0x5e, 0x00, 0x53, 0x02 },
};
static struct dummy_dev_data dad_data = {
	.mac = { 0x00, 0x00, 0x5e, 0x00, 0x53, 0x03 },
};

static void dummy_iface_init(struct net_if *iface)
{
	struct dummy_dev_data *data = net_if_get_device(iface)->data;

	net_if_set_link_addr(iface, data->mac, sizeof(data->mac),
			     NET_LINK_DUMMY);

	/* Keep the interface down until the test brings it up explicitly. */
	net_if_flag_set(iface, NET_IF_NO_AUTO_START);
}

static int dummy_dev_send(const struct device *dev, struct net_pkt *pkt)
{
	ARG_UNUSED(dev);
	ARG_UNUSED(pkt);

	return 0;
}

static int slow_dev_start(const struct device *dev)
{
	ARG_UNUSED(dev);

	if (atomic_get(&slow_start_armed)) {
		/*
		 * net_if_up() holds net_if_lock(slow_iface) across this call.
		 * Let the test know we are here (and thus holding the lock),
		 * then keep holding it for a while so the concurrent bring-up
		 * of the other interface runs inside this window.
		 */
		k_sem_give(&slow_in_start);
		k_msleep(SLOW_START_SLEEP_MS);
	}

	return 0;
}

static int dummy_dev_stop(const struct device *dev)
{
	ARG_UNUSED(dev);

	return 0;
}

static DEVICE_API(dummy, slow_api) = {
	.iface_api.init = dummy_iface_init,
	.send = dummy_dev_send,
	.start = slow_dev_start,
	.stop = dummy_dev_stop,
};

static DEVICE_API(dummy, fast_api) = {
	.iface_api.init = dummy_iface_init,
	.send = dummy_dev_send,
	.stop = dummy_dev_stop,
};

static DEVICE_API(dummy, dad_api) = {
	.iface_api.init = dummy_iface_init,
	.send = dummy_dev_send,
	.stop = dummy_dev_stop,
};

NET_DEVICE_INIT(slow_iface_dev, "slow_iface", NULL, NULL, &slow_data, NULL,
		CONFIG_KERNEL_INIT_PRIORITY_DEFAULT, &slow_api, DUMMY_L2,
		NET_L2_GET_CTX_TYPE(DUMMY_L2), 127);

NET_DEVICE_INIT(fast_iface_dev, "fast_iface", NULL, NULL, &fast_data, NULL,
		CONFIG_KERNEL_INIT_PRIORITY_DEFAULT, &fast_api, DUMMY_L2,
		NET_L2_GET_CTX_TYPE(DUMMY_L2), 127);

NET_DEVICE_INIT(dad_iface_dev, "dad_iface", NULL, NULL, &dad_data, NULL,
		CONFIG_KERNEL_INIT_PRIORITY_DEFAULT, &dad_api, DUMMY_L2,
		NET_L2_GET_CTX_TYPE(DUMMY_L2), 127);

static K_THREAD_STACK_DEFINE(slow_stack, 2048);
static K_THREAD_STACK_DEFINE(fast_stack, 2048);
static struct k_thread slow_thread;
static struct k_thread fast_thread;

static void slow_thread_fn(void *p1, void *p2, void *p3)
{
	ARG_UNUSED(p1);
	ARG_UNUSED(p2);
	ARG_UNUSED(p3);

	(void)net_if_up(slow_iface);
	k_sem_give(&done_slow);
}

static void fast_thread_fn(void *p1, void *p2, void *p3)
{
	ARG_UNUSED(p1);
	ARG_UNUSED(p2);
	ARG_UNUSED(p3);

	(void)net_if_up(fast_iface);
	k_sem_give(&done_fast);
}

static void *iface_with_mld_setup(void)
{
	struct net_if_addr *ifaddr;

	slow_iface = net_if_lookup_by_dev(DEVICE_GET(slow_iface_dev));
	fast_iface = net_if_lookup_by_dev(DEVICE_GET(fast_iface_dev));
	dad_iface = net_if_lookup_by_dev(DEVICE_GET(dad_iface_dev));

	zassert_not_null(slow_iface, "slow_iface not found");
	zassert_not_null(fast_iface, "fast_iface not found");
	zassert_not_null(dad_iface, "dad_iface not found");

	ifaddr = net_if_ipv6_addr_add(slow_iface, &slow_addr, NET_ADDR_MANUAL, 0);
	zassert_not_null(ifaddr, "Cannot add IPv6 address to slow_iface");

	ifaddr = net_if_ipv6_addr_add(fast_iface, &fast_addr, NET_ADDR_MANUAL, 0);
	zassert_not_null(ifaddr, "Cannot add IPv6 address to fast_iface");

	return NULL;
}

ZTEST(net_iface_with_mld, test_concurrent_bringup_no_deadlock)
{
	int ret;

	/* Arm the slow interface so its start() holds net_if_lock() and sleeps. */
	atomic_set(&slow_start_armed, 1);

	k_thread_create(&slow_thread, slow_stack,
			K_THREAD_STACK_SIZEOF(slow_stack), slow_thread_fn,
			NULL, NULL, NULL, K_PRIO_PREEMPT(5), 0, K_NO_WAIT);

	/* Wait until the slow interface is inside start() holding its lock. */
	ret = k_sem_take(&slow_in_start, K_SECONDS(1));
	zassert_ok(ret, "slow_iface did not reach start()");

	/* Now bring the fast interface up concurrently. */
	k_thread_create(&fast_thread, fast_stack,
			K_THREAD_STACK_SIZEOF(fast_stack), fast_thread_fn,
			NULL, NULL, NULL, K_PRIO_PREEMPT(6), 0, K_NO_WAIT);

	ret = k_sem_take(&done_fast, BRINGUP_TIMEOUT);
	zassert_ok(ret, "fast_iface bring-up did not finish - deadlock with slow_iface");

	ret = k_sem_take(&done_slow, BRINGUP_TIMEOUT);
	zassert_ok(ret, "slow_iface bring-up did not finish - deadlock with fast_iface");

	zassert_true(net_if_is_up(slow_iface), "slow_iface is not up");
	zassert_true(net_if_is_up(fast_iface), "fast_iface is not up");
}

/*
 * Adding a unicast address to an up, multicast-capable interface must join the
 * corresponding solicited-node multicast group (RFC 4291 ch 2.8) so that the
 * node answers neighbor solicitations for it. This must happen regardless of
 * whether Duplicate Address Detection is enabled (CONFIG_NET_IPV6_DAD); a
 * regression once tied the join to DAD being active, leaving addresses added at
 * runtime with DAD disabled unreachable. The no_dad test variant exercises that
 * case.
 */
ZTEST(net_iface_with_mld, test_addr_add_joins_solicited_node)
{
	struct net_in6_addr solicited;
	struct net_if_addr *ifaddr;
	struct net_if_mcast_addr *maddr;
	int ret;

	/* Bring the interface up first, with no address yet, so the join can
	 * only come from the address add below (not the bring-up path).
	 */
	ret = net_if_up(dad_iface);
	zassert_ok(ret, "Cannot bring dad_iface up");

	net_ipv6_addr_create_solicited_node(&dad_addr, &solicited);

	/* The solicited-node group must not be joined yet. */
	maddr = net_if_ipv6_maddr_lookup(&solicited, &dad_iface);
	zassert_is_null(maddr, "Solicited-node group joined before address add");

	ifaddr = net_if_ipv6_addr_add(dad_iface, &dad_addr, NET_ADDR_MANUAL, 0);
	zassert_not_null(ifaddr, "Cannot add IPv6 address to dad_iface");

	/* Adding the address must have joined the solicited-node group. */
	maddr = net_if_ipv6_maddr_lookup(&solicited, &dad_iface);
	zassert_not_null(maddr,
			 "Solicited-node group not joined on address add");

	if (!IS_ENABLED(CONFIG_NET_IPV6_DAD)) {
		/* Without DAD the address must be usable immediately. */
		zassert_equal(ifaddr->addr_state, NET_ADDR_PREFERRED,
			      "Address not preferred when DAD is disabled");
	}

	ret = net_if_ipv6_addr_rm(dad_iface, &dad_addr);
	zassert_true(ret, "Cannot remove IPv6 address from dad_iface");
}

/*
 * Bringing an interface up must autoconfigure its IPv6 link-local address
 * regardless of whether DAD is enabled. The address generation used to be a
 * side effect of starting DAD, so it was skipped entirely when
 * CONFIG_NET_IPV6_DAD was disabled, leaving the interface with no link-local
 * address. The no_dad test variant exercises that case.
 */
ZTEST(net_iface_with_mld, test_bringup_adds_link_local)
{
	const struct net_in6_addr *ll;

	/* Another test in this suite may have brought the interface up
	 * already; net_if_up() returns -EALREADY in that case.
	 */
	if (!net_if_is_up(dad_iface)) {
		int ret = net_if_up(dad_iface);

		zassert_ok(ret, "Cannot bring dad_iface up");
	}

	ll = net_if_ipv6_get_ll(dad_iface, NET_ADDR_ANY_STATE);
	zassert_not_null(ll, "No link-local address configured on interface bring-up");
}

ZTEST(net_iface_with_mld, test_ipv6_config_put)
{
	const struct net_in6_addr addr = { { { 0x20, 0x01, 0x0d, 0xb8, 0xdd, 0,
					    0, 0, 0, 0, 0, 0, 0, 0, 0, 0x1 } } };
	const struct net_in6_addr maddr = { { { 0xff, 0x02, 0, 0, 0, 0, 0, 0,
					     0, 0, 0, 0, 0, 0, 0, 0x5 } } };
	const struct net_in6_addr prefix = { { { 0x20, 0x01, 0x0d, 0xb8, 0xdd,
					      0, 0, 0, 0, 0, 0, 0, 0, 0, 0,
					      0 } } };
	struct net_if_ipv6 *ipv6, *reused;
	struct net_if *tmp = dad_iface;
	int ret;

	/* Bring the interface up so that the router solicitation state and,
	 * with DAD enabled, the DAD timers are populated for real.
	 */
	if (!net_if_is_up(dad_iface)) {
		ret = net_if_up(dad_iface);
		zassert_ok(ret, "Cannot bring dad_iface up");
	}

	ret = net_if_config_ipv6_get(dad_iface, &ipv6);
	zassert_ok(ret, "Cannot get IPv6 config (%d)", ret);

	zassert_not_null(net_if_ipv6_addr_add(dad_iface, &addr,
					      NET_ADDR_MANUAL, 0),
			 "Cannot add IPv6 address");
	zassert_not_null(net_if_ipv6_maddr_add(dad_iface, &maddr),
			 "Cannot add IPv6 multicast address");
	zassert_not_null(net_if_ipv6_prefix_add(dad_iface, &prefix, 64, 3600),
			 "Cannot add IPv6 prefix");

	net_if_ipv6_set_hop_limit(dad_iface, 42);

	/* The RS state only advances once a solicitation goes out and times
	 * out, which is timing dependent, so set it directly. A slot handed
	 * over with a stale rs_count makes the next interface give up router
	 * discovery early.
	 */
	ipv6->rs_start = 1;
	ipv6->rs_count = 2;

	zassert_equal(net_if_config_ipv6_put(dad_iface), -EBUSY,
		      "IPv6 config released while the interface is up");

	ret = net_if_down(dad_iface);
	zassert_ok(ret, "Cannot bring dad_iface down (%d)", ret);

	ret = net_if_config_ipv6_put(dad_iface);
	zassert_ok(ret, "Cannot release IPv6 config (%d)", ret);
	zassert_is_null(dad_iface->config.ip.ipv6, "IPv6 config not released");

	ARRAY_FOR_EACH(ipv6->unicast, i) {
		zassert_false(ipv6->unicast[i].is_used,
			      "Unicast address %zu still in use", i);
		zassert_equal(atomic_get(&ipv6->unicast[i].atomic_ref), 0,
			      "Unicast address %zu still referenced", i);
	}

	ARRAY_FOR_EACH(ipv6->mcast, i) {
		zassert_false(ipv6->mcast[i].is_used,
			      "Multicast address %zu still in use", i);
		zassert_false(ipv6->mcast[i].is_joined,
			      "Multicast address %zu still joined", i);
	}

	ARRAY_FOR_EACH(ipv6->prefix, i) {
		zassert_false(ipv6->prefix[i].is_used,
			      "Prefix %zu still in use", i);
		zassert_is_null(ipv6->prefix[i].iface,
				"Prefix %zu still bound to an interface", i);
	}

	zassert_equal(ipv6->hop_limit, CONFIG_NET_INITIAL_HOP_LIMIT,
		      "Hop limit not reset (%u)", ipv6->hop_limit);

	zassert_equal(ipv6->rs_count, 0, "RS count not reset (%u)",
		      ipv6->rs_count);
	zassert_equal(ipv6->rs_start, 0, "RS start not reset (%u)",
		      ipv6->rs_start);

	/* The released config goes back to the pool, the next interface
	 * allocating it must not see anything left from this one.
	 */
	ret = net_if_config_ipv6_get(dad_iface, &reused);
	zassert_ok(ret, "Cannot get IPv6 config again (%d)", ret);
	zassert_equal_ptr(reused, ipv6, "Released config was not re-used");
	zassert_is_null(net_if_ipv6_addr_lookup_by_iface(dad_iface, &addr),
			"Stale IPv6 address in re-used config");
	zassert_is_null(net_if_ipv6_maddr_lookup(&maddr, &tmp),
			"Stale IPv6 multicast address in re-used config");
	zassert_equal(net_if_ipv6_get_hop_limit(dad_iface),
		      CONFIG_NET_INITIAL_HOP_LIMIT,
		      "Stale hop limit in re-used config");
}

ZTEST_SUITE(net_iface_with_mld, NULL, iface_with_mld_setup, NULL, NULL, NULL);
```
