## CMakeLists.txt
```
# SPDX-License-Identifier: Apache-2.0

cmake_minimum_required(VERSION 3.28.0)
find_package(Zephyr REQUIRED HINTS $ENV{ZEPHYR_BASE})
project(test_conn_mgr_conn)

target_include_directories(app PRIVATE ${ZEPHYR_BASE}/subsys/net/ip)
FILE(GLOB app_sources src/*.c)
target_sources(app PRIVATE ${app_sources})
```

## prj.conf
```kconfig
CONFIG_NETWORKING=y
CONFIG_NET_TEST=y
CONFIG_NET_IPV6=y
CONFIG_NET_IPV4=y
CONFIG_NET_IPV4_ROUTE=y
CONFIG_NET_IPV4_NBR_CACHE=y
CONFIG_NET_MAX_CONTEXTS=4
CONFIG_NET_L2_DUMMY=y
CONFIG_NET_LOG=y
CONFIG_NET_CONNECTION_MANAGER=y
CONFIG_ENTROPY_GENERATOR=y
CONFIG_TEST_RANDOM_GENERATOR=y
CONFIG_NET_IPV6_DAD=n
CONFIG_NET_IPV6_MLD=n
CONFIG_NET_PKT_TX_COUNT=10
CONFIG_NET_PKT_RX_COUNT=5
CONFIG_NET_BUF_RX_COUNT=10
CONFIG_NET_BUF_TX_COUNT=10
CONFIG_NET_IF_UNICAST_IPV6_ADDR_COUNT=6
CONFIG_NET_IF_UNICAST_IPV4_ADDR_COUNT=2
CONFIG_NET_IPV6_MAX_NEXTHOPS=8
CONFIG_NET_IPV6_MAX_NEIGHBORS=8
CONFIG_NET_IPV6_ND=n
CONFIG_ZTEST=y
CONFIG_NET_IF_MAX_IPV4_COUNT=6
CONFIG_NET_IF_MAX_IPV6_COUNT=6
CONFIG_TEST_USERSPACE=y

# Increased net event queue size needed since this test performs simultaneous events on a
# large number of ifaces.
CONFIG_NET_MGMT_EVENT_QUEUE_SIZE=16
```

## src/test_conn_impl.c
```c
/*
 * Copyright (c) 2023 Nordic Semiconductor ASA
 *
 * SPDX-License-Identifier: Apache-2.0
 */

#include <zephyr/net/net_if.h>
#include <zephyr/net/conn_mgr_connectivity.h>
#include "test_conn_impl.h"

/* Event simulation */
static int simulated_event;
static struct net_if *simulated_event_iface;
static K_MUTEX_DEFINE(simulated_event_mutex);

/* Static storage for fatal error info */
static int fatal_error;

void simulate_event_handler(struct k_work *work)
{
	ARG_UNUSED(*work);

	k_mutex_lock(&simulated_event_mutex, K_FOREVER);

	if (simulated_event == 0) {
		net_mgmt_event_notify(
			NET_EVENT_CONN_IF_TIMEOUT,
			simulated_event_iface
		);
	} else {
		fatal_error = simulated_event;
		net_mgmt_event_notify_with_info(
			NET_EVENT_CONN_IF_FATAL_ERROR,
			simulated_event_iface, &fatal_error, sizeof(fatal_error)
		);
	}

	k_mutex_unlock(&simulated_event_mutex);
}

static K_WORK_DELAYABLE_DEFINE(simulate_event_work, simulate_event_handler);

/**
 * @brief Simulates an event on the target iface.
 *
 * Do not attempt to simulate multiple events simultaneously -- only the last event requested
 * will be fired.
 *
 * @param target - iface to simulate the event on.
 * @param event - Event to simulate.
 *		  If 0, simulate a timeout.
 *		  Otherwise, simulate a fatal error with this value as the reason/info.
 */
static void simulate_event(struct net_if *target, int event)
{
	k_mutex_lock(&simulated_event_mutex, K_FOREVER);

	simulated_event = event;
	simulated_event_iface = target;
	k_work_reschedule(&simulate_event_work, SIMULATED_EVENT_DELAY_TIME);

	k_mutex_unlock(&simulated_event_mutex);
}

static void simulate_timeout(struct net_if *target)
{
	simulate_event(target, 0);
}

void simulate_fatal_error(struct net_if *target, int reason)
{
	simulate_event(target, reason);
}

void simulate_connection_loss(struct net_if *target)
{
	net_if_dormant_on(target);
}

/* Connectivity implementations */

static void inc_call_count(struct test_conn_data *data, bool a)
{
	if (a) {
		data->call_cnt_a += 1;
	} else {
		data->call_cnt_b += 1;
	}
}

static int test_connect(struct conn_mgr_conn_binding *const binding, bool a)
{
	struct test_conn_data *data = binding->ctx;

	inc_call_count(data, a);

	/* Fail immediately if requested */
	if (data->api_err != 0) {
		return data->api_err;
	}

	/* Fail after a delay if requested */
	if (data->fatal_error) {
		simulate_fatal_error(binding->iface, data->fatal_error);
		return 0;
	}

	if (data->timeout) {
		simulate_timeout(binding->iface);
		return 0;
	}

	/* Succeed otherwise */

	data->conn_bal += 1;

	/* Mark iface as connected */
	net_if_dormant_off(binding->iface);
	return 0;
}

static int test_disconnect(struct conn_mgr_conn_binding *const binding, bool a)
{
	struct test_conn_data *data = binding->ctx;

	inc_call_count(data, a);

	if (data->api_err != 0) {
		return data->api_err;
	}

	data->conn_bal -= 1;

	/* Mark iface as dormant (disconnected) */
	net_if_dormant_on(binding->iface);
	return 0;
}

char *opt_pointer(struct test_conn_data *data, int optname)
{
	switch (optname) {
	case TEST_CONN_OPT_X:
		return data->data_x;
	case TEST_CONN_OPT_Y:
		return data->data_y;
	}
	return NULL;
}

int test_set_opt_a(struct conn_mgr_conn_binding *const binding, int optname,
		   const void *optval, size_t optlen)
{
	struct test_conn_data *data = binding->ctx;
	char *target = opt_pointer(data, optname);
	int len = MIN(optlen, TEST_CONN_DATA_LEN);

	/* get/set opt are only implemented for implementation A */
	inc_call_count(data, true);

	if (target == NULL) {
		return -ENOPROTOOPT;
	}

	if (data->api_err) {
		return data->api_err;
	}

	(void)memset(target, 0, TEST_CONN_DATA_LEN);
	(void)memcpy(target, optval, len);

	return 0;
}

int test_get_opt_a(struct conn_mgr_conn_binding *const binding, int optname,
		   void *optval, size_t *optlen)
{
	struct test_conn_data *data = binding->ctx;
	char *target = opt_pointer(data, optname);
	int len;

	/* get/set opt are only implemented for implementation A */
	inc_call_count(data, true);

	if (target == NULL) {
		*optlen = 0;
		return -ENOPROTOOPT;
	}

	len = MIN(strlen(target) + 1, *optlen);

	if (data->api_err) {
		*optlen = 0;
		return data->api_err;
	}
	*optlen = len;
	(void)memset(optval, 0, len);
	(void)memcpy(optval, target, len-1);

	return 0;
}

static void test_init(struct conn_mgr_conn_binding *const binding, bool a)
{
	struct test_conn_data *data = binding->ctx;

	if (a) {
		data->init_calls_a += 1;
	} else {
		data->init_calls_b += 1;
	}

	/* Mark the iface dormant (disconnected) on initialization */
	net_if_dormant_on(binding->iface);
}

static bool test_has_connection_config_a(struct conn_mgr_conn_binding *const binding)
{
	struct test_conn_data *data = binding->ctx;

	return !data->missing_connection_config;
}

static void test_init_a(struct conn_mgr_conn_binding *const binding)
{
	test_init(binding, true);
}

static void test_init_b(struct conn_mgr_conn_binding *const binding)
{
	test_init(binding, false);
}

static int test_connect_a(struct conn_mgr_conn_binding *const binding)
{
	return test_connect(binding, true);
}

static int test_connect_b(struct conn_mgr_conn_binding *const binding)
{
	return test_connect(binding, false);
}

static int test_disconnect_a(struct conn_mgr_conn_binding *const binding)
{
	return test_disconnect(binding, true);
}

static int test_disconnect_b(struct conn_mgr_conn_binding *const binding)
{
	return test_disconnect(binding, false);
}

static struct conn_mgr_conn_api test_conn_api_a = {
	.has_connection_config = test_has_connection_config_a,
	.connect = test_connect_a,
	.disconnect = test_disconnect_a,
	.init = test_init_a,
	.get_opt = test_get_opt_a,
	.set_opt = test_set_opt_a
};

static struct conn_mgr_conn_api test_conn_api_b = {
	.connect = test_connect_b,
	.disconnect = test_disconnect_b,
	.init = test_init_b,
};

static struct conn_mgr_conn_api test_conn_api_ni = {
	.connect = test_connect_a,
	.disconnect = test_disconnect_a,
};

/* Equivalent but distinct implementations */
CONN_MGR_CONN_DEFINE(TEST_L2_CONN_IMPL_A, &test_conn_api_a);
CONN_MGR_CONN_DEFINE(TEST_L2_CONN_IMPL_B, &test_conn_api_b);

/* Implementation without init */
CONN_MGR_CONN_DEFINE(TEST_L2_CONN_IMPL_NI, &test_conn_api_ni);

/* Bad implementation, should be handled gracefully */
CONN_MGR_CONN_DEFINE(TEST_L2_CONN_IMPL_N, NULL);
```

## src/test_conn_impl.h
```c
/*
 * Copyright (c) 2023 Nordic Semiconductor ASA
 *
 * SPDX-License-Identifier: Apache-2.0
 */



/* test_conn_impl is separated into its own file specifically in order to test that
 * CONN_MGR_CONN_DECLARE_PUBLIC functions as expected.
 */


#ifndef ZEPHYR_INCLUDE_TEST_CONN_IMPL_H_
#define ZEPHYR_INCLUDE_TEST_CONN_IMPL_H_

#include <zephyr/net/conn_mgr_connectivity_impl.h>
#include <zephyr/net/net_if.h>

#ifdef __cplusplus
extern "C" {
#endif

#define TEST_CONN_OPT_X 0
#define TEST_CONN_OPT_Y 1
#define TEST_CONN_DATA_LEN 50

struct test_conn_data {
	/* The number of times an A-implementation API func has been called (other than init) */
	int call_cnt_a;

	/* The number of times a B-implementation API func has been called (other than init) */
	int call_cnt_b;

	/* Increases on each connect call, decreases on each disconnect call */
	int conn_bal;

	/* The number of times A-implementation init was called (should always be 1) */
	int init_calls_a;

	/* The number of times B-implementation init was called (should always be 1) */
	int init_calls_b;

	/* If nonzero, an error code the APIs should return. */
	int api_err;

	/* If true, the implementation should time out on connect. */
	bool timeout;

	/* If true, the implementation does not have configuration information to connect */
	bool missing_connection_config;

	/* If nonzero, the implementation should fail to connect and raise this fatal error. */
	int fatal_error;

	/* Places to store data from set_opt calls */
	char data_x[TEST_CONN_DATA_LEN + 1];
	char data_y[TEST_CONN_DATA_LEN + 1];
};

/* Create test L2 connectivity implementations A and B
 *
 * A and B share generic connect/disconnect implementations that differ only in which call counter
 * they increment.
 *
 * Additionally, A has conn_opt callbacks, whereas B does not.
 */
#define TEST_L2_CONN_IMPL_A_CTX_TYPE struct test_conn_data
CONN_MGR_CONN_DECLARE_PUBLIC(TEST_L2_CONN_IMPL_A);

#define TEST_L2_CONN_IMPL_B_CTX_TYPE struct test_conn_data
CONN_MGR_CONN_DECLARE_PUBLIC(TEST_L2_CONN_IMPL_B);

/* Create an invalid L2 connectivity implementation with NULL API */
#define TEST_L2_CONN_IMPL_N_CTX_TYPE struct test_conn_data
CONN_MGR_CONN_DECLARE_PUBLIC(TEST_L2_CONN_IMPL_N);

/* Create an L2 connectivity implementation without the optional init */
#define TEST_L2_CONN_IMPL_NI_CTX_TYPE struct test_conn_data
CONN_MGR_CONN_DECLARE_PUBLIC(TEST_L2_CONN_IMPL_NI);

#define SIMULATED_EVENT_DELAY_MS 100
#define SIMULATED_EVENT_DELAY_TIME K_MSEC(SIMULATED_EVENT_DELAY_MS)
#define SIMULATED_EVENT_WAIT_TIME K_MSEC(SIMULATED_EVENT_DELAY_MS + 10)

/* Helper API for controlling implementations from tests */

/**
 * @brief Simulate a connection loss on the target iface.
 *
 * @param target - iface to simulate connection loss on.
 */
void simulate_connection_loss(struct net_if *target);

/**
 * @brief Simulate a fatal error on the target iface
 *
 * Please do not simulate events on more than one iface at a time.
 *
 * @param target - iface to simulate fatal error on.
 * @param reason - Reason to be given for the fatal error.
 */
void simulate_fatal_error(struct net_if *target, int reason);

#ifdef __cplusplus
}
#endif

#endif /* ZEPHYR_INCLUDE_TEST_CONN_IMPL_H_ */
```

## src/test_ifaces.c
```c
/*
 * Copyright (c) 2023 Nordic Semiconductor ASA
 *
 * SPDX-License-Identifier: Apache-2.0
 */

#include <zephyr/net/net_if.h>
#include <zephyr/net/dummy.h>
#include <zephyr/net/conn_mgr_connectivity.h>
#include "test_conn_impl.h"
#include "test_ifaces.h"

/* Create test ifaces */

/* Generic iface initializer, shared by all three ifaces */
static void test_iface_init(struct net_if *iface)
{
	/* Fake link layer address is needed to silence assertions inside the net core */
	static uint8_t fake_lladdr[] = { 0x00, 0x00, 0x5E, 0x00, 0x53, 0x01 };

	net_if_set_link_addr(iface, fake_lladdr, sizeof(fake_lladdr), NET_LINK_DUMMY);

	/* Do not automatically start the iface */
	net_if_flag_set(iface, NET_IF_NO_AUTO_START);
}

static DEVICE_API(dummy, test_iface_api) = {
	.iface_api.init = test_iface_init,
};

/* Create three ifaces, a1, a2, b such that:
 * iface a1 and a2 share L2 connectivity implementation a
 * iface b uses connectivity implementation b
 */
NET_DEVICE_INIT(test_iface_a1,
		"test_iface_a1",
		NULL,
		NULL,
		NULL,
		NULL,
		CONFIG_KERNEL_INIT_PRIORITY_DEFAULT,
		&test_iface_api,
		DUMMY_L2,
		NET_L2_GET_CTX_TYPE(DUMMY_L2),
		127);
NET_DEVICE_INIT(test_iface_a2,
		"test_iface_a2",
		NULL,
		NULL,
		NULL,
		NULL,
		CONFIG_KERNEL_INIT_PRIORITY_DEFAULT,
		&test_iface_api,
		DUMMY_L2,
		NET_L2_GET_CTX_TYPE(DUMMY_L2),
		127);
NET_DEVICE_INIT(test_iface_b,
		"test_iface_b",
		NULL,
		NULL,
		NULL,
		NULL,
		CONFIG_KERNEL_INIT_PRIORITY_DEFAULT,
		&test_iface_api,
		DUMMY_L2,
		NET_L2_GET_CTX_TYPE(DUMMY_L2),
		127);

/* Create an ifaces with NULL implementation, NULL init, and no connectivity at all */
NET_DEVICE_INIT(test_iface_null,
		"test_iface_null",
		NULL,
		NULL,
		NULL,
		NULL,
		CONFIG_KERNEL_INIT_PRIORITY_DEFAULT,
		&test_iface_api,
		DUMMY_L2,
		NET_L2_GET_CTX_TYPE(DUMMY_L2),
		127);
NET_DEVICE_INIT(test_iface_ni,
		"test_iface_ni",
		NULL,
		NULL,
		NULL,
		NULL,
		CONFIG_KERNEL_INIT_PRIORITY_DEFAULT,
		&test_iface_api,
		DUMMY_L2,
		NET_L2_GET_CTX_TYPE(DUMMY_L2),
		127);
NET_DEVICE_INIT(test_iface_none,
		"test_iface_none",
		NULL,
		NULL,
		NULL,
		NULL,
		CONFIG_KERNEL_INIT_PRIORITY_DEFAULT,
		&test_iface_api,
		DUMMY_L2,
		NET_L2_GET_CTX_TYPE(DUMMY_L2),
		127);

/* Bind L2 connectivity implementations to ifaces */
CONN_MGR_BIND_CONN(test_iface_a1,	TEST_L2_CONN_IMPL_A);
CONN_MGR_BIND_CONN(test_iface_a2,	TEST_L2_CONN_IMPL_A);
CONN_MGR_BIND_CONN(test_iface_b,	TEST_L2_CONN_IMPL_B);

/* Bind edge-case L2 connectivity implementations to ifaces */
CONN_MGR_BIND_CONN(test_iface_null,	TEST_L2_CONN_IMPL_N);
CONN_MGR_BIND_CONN(test_iface_ni,	TEST_L2_CONN_IMPL_NI);

/* Public accessors for static iface structs */
struct net_if *ifa1  = NET_IF_GET(test_iface_a1, 0);
struct net_if *ifa2  = NET_IF_GET(test_iface_a2, 0);
struct net_if *ifb   = NET_IF_GET(test_iface_b,  0);
struct net_if *ifni  = NET_IF_GET(test_iface_ni,  0);
struct net_if *ifnull = NET_IF_GET(test_iface_null, 0);
struct net_if *ifnone = NET_IF_GET(test_iface_none, 0);
```

## src/test_ifaces.h
```c
/*
 * Copyright (c) 2023 Nordic Semiconductor ASA
 *
 * SPDX-License-Identifier: Apache-2.0
 */

#ifndef ZEPHYR_INCLUDE_TEST_IFACES_H_
#define ZEPHYR_INCLUDE_TEST_IFACES_H_

#include <zephyr/net/net_if.h>

#ifdef __cplusplus
extern "C" {
#endif

/* Public accessors for static iface structs */

extern struct net_if *ifa1;
extern struct net_if *ifa2;
extern struct net_if *ifb;
extern struct net_if *ifni;
extern struct net_if *ifnull;
extern struct net_if *ifnone;

#ifdef __cplusplus
}
#endif

#endif /* ZEPHYR_INCLUDE_TEST_IFACES_H_ */
```
