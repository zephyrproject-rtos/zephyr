## tests/net/igmp/testcase.yaml
```yaml
common:
  tags:
    - net
    - igmp
  depends_on: netif
  platform_allow: qemu_x86
tests:
  net.igmp:
    extra_configs:
      - CONFIG_NET_TC_THREAD_COOPERATIVE=y
  net.igmp.preempt:
    extra_configs:
      - CONFIG_NET_TC_THREAD_PREEMPTIVE=y
  net.igmpv3:
    extra_configs:
      - CONFIG_NET_TC_THREAD_COOPERATIVE=y
      - CONFIG_NET_IPV4_IGMPV3=y
  net.igmpv3.preempt:
    extra_configs:
      - CONFIG_NET_TC_THREAD_PREEMPTIVE=y
      - CONFIG_NET_IPV4_IGMPV3=y
```

## tests/net/ip-addr/testcase.yaml
```yaml
common:
  depends_on: netif
  tags:
    - net
    - ip-addr
tests:
  net.ip-addr:
    min_ram: 16
```

## tests/net/ipv4_fragment/testcase.yaml
```yaml
#
# Copyright (c) 2022 Jamie McCrae
#
# SPDX-License-Identifier: Apache-2.0
#
common:
  depends_on: netif
  tags:
    - net
    - ipv4
    - fragment
tests:
  net.ipv4.fragment:
    extra_configs:
      - CONFIG_NET_IPV4_PMTU=n
  net.ipv4.fragment.with_pmtu:
    extra_configs:
      - CONFIG_NET_IPV4_PMTU=y
```

## tests/net/ipv6/testcase.yaml
```yaml
common:
  tags:
    - net
    - ipv6
    - ipv6_pe
  depends_on: netif
tests:
  net.ipv6:
    extra_configs:
      - CONFIG_NET_BUF_FIXED_DATA_SIZE=y
      - CONFIG_NET_IPV6_PE=n
  net.ipv6.variable_buf_size:
    extra_configs:
      - CONFIG_NET_BUF_VARIABLE_DATA_SIZE=y
      - CONFIG_NET_PKT_BUF_RX_DATA_POOL_SIZE=4096
      - CONFIG_NET_PKT_BUF_TX_DATA_POOL_SIZE=4096
      - CONFIG_NET_IPV6_PE=n
      - CONFIG_TEST_EXTRA_STACK_SIZE=1024
  net.ipv6.privacy_extension.prefer_public:
    extra_configs:
      - CONFIG_NET_IPV6_PE=y
      - CONFIG_NET_IPV6_PE_PREFER_PUBLIC_ADDRESSES=y
      - CONFIG_NET_IPV6_PE_FILTER_PREFIX_COUNT=2
      - CONFIG_NET_IF_UNICAST_IPV6_ADDR_COUNT=9
      - CONFIG_NET_IF_MCAST_IPV6_ADDR_COUNT=7
  net.ipv6.privacy_extension.prefer_temporary:
    extra_configs:
      - CONFIG_NET_IPV6_PE=y
      - CONFIG_NET_IPV6_PE_PREFER_PUBLIC_ADDRESSES=n
      - CONFIG_NET_IPV6_PE_FILTER_PREFIX_COUNT=2
      - CONFIG_NET_IF_UNICAST_IPV6_ADDR_COUNT=9
      - CONFIG_NET_IF_MCAST_IPV6_ADDR_COUNT=7
```

## tests/net/ipv6_fragment/testcase.yaml
```yaml
common:
  depends_on: netif
  tags:
    - net
    - ipv6
    - fragment
tests:
  net.ipv6.fragment:
    extra_configs:
      - CONFIG_NET_IPV6_PMTU=n
  net.ipv6.fragment.with_pmtu:
    extra_configs:
      - CONFIG_NET_IPV6_PMTU=y
```

## tests/net/lib/coap/testcase.yaml
```yaml
tests:
  net.coap.simple:
    min_ram: 16
    tags: net
    depends_on: netif
  net.coap.simple_no_oscore:
    extra_conf_files:
      - prj_no_oscore.conf
    min_ram: 16
    tags: net
    depends_on: netif
```

## tests/net/lib/coap_client/testcase.yaml
```yaml
common:
  depends_on: netif
tests:
  net.coap.client:
    platform_allow:
      - native_sim
    tags:
      - coap
      - net
```

## tests/net/lib/coap_server/common/testcase.yaml
```yaml
common:
  min_ram: 16
  tags:
    - net
    - coap
    - server
  integration_platforms:
    - native_sim

tests:
  net.coap.server.common: {}
  net.coap.server.secure:
    tags:
      - tls
    extra_configs:
      - CONFIG_NET_SOCKETS_SOCKOPT_TLS=y
      - CONFIG_NET_SOCKETS_ENABLE_DTLS=y
```

## tests/net/lib/config/testcase.yaml
```yaml
common:
  min_ram: 16
  depends_on: netif
  # eventfd API does not work with native_posix so exclude it here
  platform_exclude:
    - native_sim
    - native_sim/native/64
tests:
  net.config:
    tags:
      - net
      - iface
```

## tests/net/lib/dns_addremove/testcase.yaml
```yaml
common:
  tags:
    - dns
    - net
  depends_on: netif
  min_ram: 16
  timeout: 600
  platform_exclude:
    - native_posix
    - native_posix/native/64
tests:
  net.dns.addremove:
    min_ram: 21
  net.dns.addremove.no_ipv6:
    extra_configs:
      - CONFIG_NET_IPV6=n
  net.dns.no_ipv4:
    extra_configs:
      - CONFIG_NET_IPV4=n
```

## tests/net/lib/dns_cache/testcase.yaml
```yaml
common:
  tags:
    - dns
    - net
  min_ram: 21
  depends_on: netif
  integration_platforms:
    - native_sim
  platform_exclude:
    - native_posix
    - native_posix/native/64
tests:
  net.dns.cache:
    build_only: false
```

## tests/net/lib/dns_dispatcher/testcase.yaml
```yaml
common:
  tags:
    - dns
    - net
  depends_on: netif
  min_ram: 21
  timeout: 600
tests:
  net.dns.dispatch:
    min_ram: 21
  net.dns.dispatch.ctx_cleanup:
    extra_configs:
      - CONFIG_DNS_RECONFIGURE_CLEANUP=y
  net.dns.dispatch.ctx_no_cleanup:
    extra_configs:
      - CONFIG_DNS_RECONFIGURE_CLEANUP=n
```

## tests/net/lib/dns_packet/testcase.yaml
```yaml
tests:
  net.dns:
    platform_exclude:
      - native_posix
      - native_posix/native/64
    min_ram: 16
    tags:
      - dns
      - net
    timeout: 200
    depends_on: netif
```

## tests/net/lib/dns_resolve/testcase.yaml
```yaml
common:
  tags:
    - dns
    - net
  depends_on: netif
  timeout: 600
  min_ram: 21
tests:
  net.dns.resolve:
    extra_configs:
      - CONFIG_NET_TC_THREAD_COOPERATIVE=y
  net.dns.resolve.preempt:
    extra_configs:
      - CONFIG_NET_TC_THREAD_PREEMPTIVE=y
  net.dns.resolve.no_ipv6:
    extra_args: CONF_FILE=prj-no-ipv6.conf
    min_ram: 16
  net.mdns.resolve:
    extra_configs:
      - CONFIG_MDNS_RESOLVER=y
      - CONFIG_MDNS_RESPONDER=n
      - CONFIG_NET_IPV6_MLD=y
      - CONFIG_NET_IPV4_IGMP=y
  net.dns.resolve.hostname:
    extra_configs:
      - CONFIG_NET_HOSTNAME_ENABLE=y
      - CONFIG_NET_HOSTNAME="test-zephyr"
      - CONFIG_NET_IPV6=y
      - CONFIG_NET_IPV4=y
      - CONFIG_NET_SOCKETS_DNS_TIMEOUT=5
      - CONFIG_ZTEST_STACK_SIZE=1280
```

## tests/net/lib/dns_sd/testcase.yaml
```yaml
common:
  tags:
    - dns
    - net
  depends_on: netif
  platform_exclude:
    - native_posix
    - native_posix/native/64
tests:
  net.dns.sd:
    min_ram: 21
    timeout: 600
  net.dns.sd.no_ipv6:
    extra_args: CONF_FILE=prj-no-ipv6.conf
    min_ram: 16
    timeout: 600
```

## tests/net/lib/http_client/testcase.yaml
```yaml
common:
  tags:
    - http
    - net
  depends_on: netif
tests:
  net.http_client:
    min_ram: 64
    min_flash: 192
```

## tests/net/lib/http_header_fields/testcase.yaml
```yaml
common:
  tags: http net
  pre-filter: subsys_dt_compat_enabled("ethernet")
tests:
  net.http:
    min_ram: 16
```

## tests/net/lib/http_server/common/testcase.yaml
```yaml
common:
  depends_on: netif
  min_ram: 40
  tags:
    - net
    - http
    - server
  integration_platforms:
    - native_sim
tests:
  net.http.server.common: {}
```

## tests/net/lib/http_server/core/boards/native_sim.conf
```kconfig
# File system config
CONFIG_FLASH=y
CONFIG_FLASH_MAP=y
CONFIG_FILE_SYSTEM=y
CONFIG_FILE_SYSTEM_LITTLEFS=y
CONFIG_FS_LITTLEFS_FC_HEAP_SIZE=16384
CONFIG_HEAP_MEM_POOL_SIZE=4096
```

## tests/net/lib/http_server/core/testcase.yaml
```yaml
common:
  depends_on: netif
  min_ram: 80
  tags:
    - http
    - net
    - server
    - socket
  integration_platforms:
    - native_sim
    - qemu_x86
  platform_exclude:
    - native_posix
    - native_posix/native/64
tests:
  net.http.server.core: {}
  net.http.server.static.fs:
    extra_args:
      - EXTRA_DTC_OVERLAY_FILE="ramdisk.overlay"
    platform_allow:
      - native_sim
      - qemu_x86
```

## tests/net/lib/http_server/crime/testcase.yaml
```yaml
common:
  filter: TOOLCHAIN_HAS_NEWLIB == 1
  harness: net
  min_ram: 16
  tags:
    - http
    - net
    - server
    - socket
  integration_platforms:
    - native_posix_64
    - qemu_x86
tests:
  net.http.server.crime: {}
```

## tests/net/lib/http_server/hpack/testcase.yaml
```yaml
common:
  depends_on: netif
  min_ram: 60
  tags:
    - http
    - net
    - server
  integration_platforms:
    - native_sim
    - qemu_x86
  platform_exclude:
    - native_posix
    - native_posix/native/64
tests:
  net.http.server.http2_hpack: {}
```
