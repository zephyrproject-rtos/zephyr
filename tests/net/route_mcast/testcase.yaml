## tests/net/route_mcast/testcase.yaml
```yaml
common:
  depends_on: netif
tests:
  net.route_mcast:
    min_ram: 21
    tags:
      - net
      - route_mcast
```

## tests/net/rtp/loopback/testcase.yaml
```yaml
common:
  depends_on: netif
  tags:
    - net
    - rtp

tests:
  net.rtp.loopback: {}
  net.rtp.loopback.csrc:
    extra_configs:
      - CONFIG_RTP_MAX_CSRC_COUNT=4
```

## tests/net/shell/testcase.yaml
```yaml
common:
  pre-filter: subsys_dt_compat_enabled("ethernet")
tests:
  net.shell:
    min_ram: 20
    tags: net net-shell
```

## tests/net/sntp/Kconfig
```kconfig
# Copyright (c) 2024 Embeint Inc

config SNTP_SERVER_ADDRESS
	string "SNTP server address"
	default "pool.ntp.org"

config SNTP_SERVER_PORT
	int "SNTP server port"
	default 123

config SNTP_SERVER_TIMEOUT_MS
	int "Duration to wait for response"
	default 2000

source "Kconfig.zephyr"
```

## tests/net/sntp/testcase.yaml
```yaml
common:
  tags: net sntp
tests:
  net.sntp.native:
    platform_allow:
      - native_sim
    integration_platforms:
      - native_sim
    extra_configs:
      - CONFIG_NATIVE_SIM_SLOWDOWN_TO_REAL_TIME=y
    extra_args:
      - OVERLAY_CONFIG="overlay-nsos.conf"
```

## tests/net/socket/af_inet_raw/testcase.yaml
```yaml
common:
  depends_on: netif
  tags:
    - net
    - socket
tests:
  net.socket.af_inet_raw: {}
  net.socket.af_inet_raw.af_packet:
    extra_configs:
      - CONFIG_NET_SOCKETS_PACKET=y
      - CONFIG_NET_SOCKETS_PACKET_DGRAM=y
```

## tests/net/socket/af_packet/testcase.yaml
```yaml
common:
  depends_on: netif
  tags:
    - net
    - socket
    - af_packet
tests:
  net.socket.af_packet:
    min_ram: 21
```

## tests/net/socket/af_packet_ipproto_raw/testcase.yaml
```yaml
common:
  depends_on: netif
  tags:
    - net
    - socket
    - af_packet
tests:
  net.socket.af_packet.ipproto_raw:
    min_ram: 21
```

## tests/net/socket/can/testcase.yaml
```yaml
tests:
  net.socket.can:
    integration_platforms:
      - native_sim/native
      - native_sim/native/64
    tags:
      - net
      - can
```

## tests/net/socket/getaddrinfo/testcase.yaml
```yaml
common:
  depends_on: netif
  filter: CONFIG_FULL_LIBC_SUPPORTED
  tags:
    - net
    - socket
    - getaddrinfo
    - userspace
tests:
  net.socket.get_addr_info:
    min_ram: 21
  net.socket.get_addr_info.timeout:
    extra_configs:
      - CONFIG_NET_SOCKETS_DNS_TIMEOUT=2000
      - CONFIG_NET_SOCKETS_DNS_BACKOFF_INTERVAL=1000
```

## tests/net/socket/getnameinfo/testcase.yaml
```yaml
common:
  depends_on: netif
  filter: CONFIG_FULL_LIBC_SUPPORTED
  platform_exclude:
    - native_posix
    - native_posix/native/64
tests:
  net.socket.get_name_info:
    min_ram: 21
    tags:
      - net
      - socket
      - userspace
```

## tests/net/socket/misc/testcase.yaml
```yaml
common:
  depends_on: netif
  filter: CONFIG_FULL_LIBC_SUPPORTED
  min_ram: 21
  tags:
    - net
    - socket
    - userspace
tests:
  net.socket.misc:
    extra_configs:
      - CONFIG_TEST_USERSPACE=n
  net.socket.misc.userspace:
    extra_configs:
      - CONFIG_TEST_USERSPACE=y
  net.socket.misc.v4_mapping_to_v6_enabled:
    extra_configs:
      - CONFIG_NET_IPV4_MAPPING_TO_IPV6=y
  net.socket.misc.v4_mapping_to_v6_disabled:
    extra_configs:
      - CONFIG_NET_IPV4_MAPPING_TO_IPV6=n
```

## tests/net/socket/net_mgmt/testcase.yaml
```yaml
common:
  pre-filter: subsys_dt_compat_enabled("ethernet")
  tags: net socket net_mgmt userspace
tests:
  net.socket.mgmt:
    min_ram: 21
```

## tests/net/socket/offload_dispatcher/testcase.yaml
```yaml
common:
  depends_on: netif
  min_flash: 240
tests:
  net.socket.offload.dispatcher:
    tags: net socket
```

## tests/net/socket/poll/testcase.yaml
```yaml
common:
  depends_on: netif
  # FIXME: This test fails very frequently on mps2/an385 due to the system
  #        timer stability issues, so keep it disabled until the root cause
  #        is fixed (GitHub issue zephyrproject-rtos/zephyr#48608).
  platform_exclude:
    - mps2/an385
    - native_posix/native/64
    - native_posix
tests:
  net.socket.poll:
    min_ram: 21
    tags:
      - net
      - socket
      - poll
```

## tests/net/socket/register/testcase.yaml
```yaml
common:
  depends_on: netif
  tags:
    - net
    - socket
    - socket.register
tests:
  net.socket.register:
    extra_configs:
      - CONFIG_NET_SOCKETS_SOCKOPT_TLS=n
  net.socket.register.tls:
    extra_args:
      - EXTRA_CONF_FILE=overlay-tls.conf
```

## tests/net/socket/reuseaddr_reuseport/testcase.yaml
```yaml
common:
  depends_on: netif
  filter: CONFIG_FULL_LIBC_SUPPORTED
  min_ram: 31
  tags:
    - net
    - socket
tests:
  net.socket.reuseaddr_reuseport:
    extra_configs:
      - CONFIG_TEST_USERSPACE=n
  net.socket.reuseaddr_reuseport.userspace:
    extra_configs:
      - CONFIG_TEST_USERSPACE=y
```

## tests/net/socket/select/testcase.yaml
```yaml
common:
  depends_on: netif
  min_ram: 21
  tags:
    - net
    - socket
    - userspace
  filter: CONFIG_FULL_LIBC_SUPPORTED
  # FIXME: This test fails very frequently on mps2/an385 due to the system
  #        timer stability issues, so keep it disabled until the root cause
  #        is fixed (GitHub issue zephyrproject-rtos/zephyr#48608).
  platform_exclude: mps2/an385
tests:
  net.socket.select:
    extra_configs:
      - CONFIG_NET_TC_THREAD_COOPERATIVE=y
  net.socket.select.preempt:
    extra_configs:
      - CONFIG_NET_TC_THREAD_PREEMPTIVE=y
```

## tests/net/socket/service/testcase.yaml
```yaml
common:
  depends_on: netif
  # FIXME: This test fails very frequently on mps2/an385 due to the system
  #        timer stability issues, so keep it disabled until the root cause
  #        is fixed (GitHub issue zephyrproject-rtos/zephyr#48608).
  # eventfd API does not work with native_posix so exclude it here
  platform_exclude:
    - mps2/an385
    - native_posix
    - native_posix/native/64
tests:
  net.socket.service:
    min_ram: 21
    tags:
      - net
      - socket
      - poll
```

## tests/net/socket/socketpair/testcase.yaml
```yaml
common:
  tags:
    - net
    - socket
    - userspace
  depends_on: netif
  min_ram: 21
  platform_exclude:
    - native_posix/native/64
    - native_posix
    # See #61246 for info about these next two excludes
    - vmu_rt1170/mimxrt1176/cm7
    - mimxrt1160_evk/mimxrt1166/cm7
tests:
  net.socket.socketpair: {}
  net.socket.socketpair.newlib:
    filter: CONFIG_FULL_LIBC_SUPPORTED
    extra_configs:
      - CONFIG_REQUIRES_FULL_LIBC=y
  net.socket.socketpair.picolibc:
    filter: CONFIG_PICOLIBC_SUPPORTED
    extra_configs:
      - CONFIG_PICOLIBC=y
  net.socket.socketpair.high_mem:
    min_ram: 64
    extra_configs:
      # Low buffer sizes (e.g., 8192) will verify the crash fix, but tests will still
      # fail due to insufficient memory. So, use high buffer sizes.
      - CONFIG_NET_SOCKETPAIR_BUFFER_SIZE=4096
      - CONFIG_HEAP_MEM_POOL_SIZE=32768
```

## tests/net/socket/tcp/testcase.yaml
```yaml
common:
  depends_on: netif
  min_ram: 32
  tags:
    - net
    - socket
    - userspace
  filter: CONFIG_FULL_LIBC_SUPPORTED
  timeout: 180
  # FIXME: This test fails very frequently on mps2/an385 due to the system
  #        timer stability issues, so keep it disabled until the root cause
  #        is fixed (GitHub issue zephyrproject-rtos/zephyr#48608).
  platform_exclude: mps2/an385
tests:
  net.socket.tcp:
    extra_configs:
      - CONFIG_NET_TC_THREAD_COOPERATIVE=y
  net.socket.tcp.preempt:
    extra_configs:
      - CONFIG_NET_TC_THREAD_PREEMPTIVE=y
      - CONFIG_NET_TCP_RANDOMIZED_RTO=n
```

## tests/net/socket/tcp_rw/testcase.yaml
```yaml
common:
  depends_on: netif
  min_ram: 32
  tags: net socket userspace
tests:
  net.socket.tcp_rw.posix:
    extra_configs:
      - CONFIG_POSIX_API=y
    arch_exclude: posix
```

## tests/net/socket/tls/testcase.yaml
```yaml
common:
  depends_on: netif
  min_ram: 32
  min_flash: 260
  tags:
    - net
    - socket
    - tls
  filter: CONFIG_FULL_LIBC_SUPPORTED
  integration_platforms:
    - qemu_x86
  platform_exclude: vmu_rt1170/mimxrt1176/cm7 # See #61129
tests:
  net.socket.tls:
    extra_configs:
      - CONFIG_NET_TC_THREAD_COOPERATIVE=y
  net.socket.tls.preempt:
    extra_configs:
      - CONFIG_NET_TC_THREAD_PREEMPTIVE=y
    platform_exclude: mps2/an385
```
