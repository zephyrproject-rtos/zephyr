## CMakeLists.txt
```
# SPDX-License-Identifier: Apache-2.0

cmake_minimum_required(VERSION 3.20.0)
find_package(Zephyr REQUIRED HINTS $ENV{ZEPHYR_BASE})
project(iface)

target_include_directories(app PRIVATE ${ZEPHYR_BASE}/subsys/net/ip)
FILE(GLOB app_sources src/*.c)
target_sources(app PRIVATE ${app_sources})
```

## prj.conf
```kconfig
CONFIG_NETWORKING=y
CONFIG_NET_TEST=y
CONFIG_NET_IPV6=y
CONFIG_NET_IPV4=y
CONFIG_NET_L2_ETHERNET=y
CONFIG_NET_MAX_CONTEXTS=4
CONFIG_NET_L2_DUMMY=y
CONFIG_NET_CONNECTION_MANAGER=y
CONFIG_ENTROPY_GENERATOR=y
CONFIG_TEST_RANDOM_GENERATOR=y
CONFIG_NET_IPV6_MLD=n
CONFIG_NET_PKT_TX_COUNT=10
CONFIG_NET_PKT_RX_COUNT=5
CONFIG_NET_BUF_RX_COUNT=10
CONFIG_NET_BUF_TX_COUNT=10
CONFIG_NET_IF_UNICAST_IPV6_ADDR_COUNT=6
CONFIG_NET_IF_UNICAST_IPV4_ADDR_COUNT=2
CONFIG_NET_IPV6_MAX_NEXTHOPS=8
CONFIG_NET_IPV6_MAX_NEIGHBORS=8
CONFIG_NET_IPV6_ND=n
CONFIG_ZTEST=y
CONFIG_NET_IF_MAX_IPV4_COUNT=6
CONFIG_NET_IF_MAX_IPV6_COUNT=6
CONFIG_TEST_USERSPACE=y
CONFIG_NET_MGMT_EVENT_STACK_SIZE=2048
CONFIG_ZTEST_STACK_SIZE=2048

# Enable for help debugging this test suite:
# CONFIG_NET_LOG=y
# CONFIG_NET_CONNECTION_MANAGER_LOG_LEVEL_DBG=y
# CONFIG_NET_IF_LOG_LEVEL_DBG=y
```

## src/test_ifaces.c
```c
/*
 * Copyright (c) 2023 Nordic Semiconductor ASA
 *
 * SPDX-License-Identifier: Apache-2.0
 */
#include <zephyr/net/net_if.h>
#include <zephyr/net/dummy.h>
#include <zephyr/net/conn_mgr_connectivity_impl.h>
#include <zephyr/net/ethernet.h>
#include "test_ifaces.h"

/* Create test ifaces */

/* Generic iface initializer, shared by all test ifaces */
static void test_iface_init_type(struct net_if *iface, enum net_link_type type)
{
	/* Fake link layer address is needed to silence assertions inside the net core */
	static uint8_t fake_lladdr[] = { 0x00, 0x00, 0x5E, 0x00, 0x53, 0x01 };

	net_if_set_link_addr(iface, fake_lladdr, sizeof(fake_lladdr), type);

	/* Do not automatically start the iface */
	net_if_flag_set(iface, NET_IF_NO_AUTO_START);
}

static void test_iface_init(struct net_if *iface)
{
	test_iface_init_type(iface, NET_LINK_DUMMY);
}

static void test_eth_iface_init(struct net_if *iface)
{
	test_iface_init_type(iface, NET_LINK_ETHERNET);
}

/* Mandatory stub for NET_DEVICE_INIT */
static int test_iface_netdev_init(const struct device *dev)
{
	return 0;
}

/* This is needed specifically for IPv6 DAD.
 * DAD tries to send a packet, and the test will hang if send is not implemented.
 */
static int test_iface_send(const struct device *dev, struct net_pkt *pkt)
{
	return 0;
}

static DEVICE_API(dummy, test_iface_api) = {
	.iface_api.init = test_iface_init,
	.send = test_iface_send,
};

static DEVICE_API(ethernet, dummy_eth_api) = {
	.iface_api.init = test_eth_iface_init,
};

NET_DEVICE_INIT(test_if_simple_a,
		"test_if_simple_a",
		test_iface_netdev_init,
		NULL,
		NULL,
		NULL,
		CONFIG_KERNEL_INIT_PRIORITY_DEFAULT,
		&test_iface_api,
		DUMMY_L2,
		NET_L2_GET_CTX_TYPE(DUMMY_L2),
		127);

NET_DEVICE_INIT(test_if_simple_b,
		"test_if_simple_b",
		test_iface_netdev_init,
		NULL,
		NULL,
		NULL,
		CONFIG_KERNEL_INIT_PRIORITY_DEFAULT,
		&test_iface_api,
		DUMMY_L2,
		NET_L2_GET_CTX_TYPE(DUMMY_L2),
		127);

NET_DEVICE_INIT(test_if_connected_a,
		"test_if_connected_a",
		test_iface_netdev_init,
		NULL,
		NULL,
		NULL,
		CONFIG_KERNEL_INIT_PRIORITY_DEFAULT,
		&test_iface_api,
		DUMMY_L2,
		NET_L2_GET_CTX_TYPE(DUMMY_L2),
		127);

NET_DEVICE_INIT(test_if_connected_b,
		"test_if_connected_b",
		test_iface_netdev_init,
		NULL,
		NULL,
		NULL,
		CONFIG_KERNEL_INIT_PRIORITY_DEFAULT,
		&test_iface_api,
		DUMMY_L2,
		NET_L2_GET_CTX_TYPE(DUMMY_L2),
		127);

/* A dummy ETHERNET_L2 iface so that we can test L2 ignore.
 * This iface is not properly defined, do not attempt to use it.
 */
NET_DEVICE_INIT(test_if_dummy_eth,
		"test_if_dummy_eth",
		test_iface_netdev_init,
		NULL,
		NULL,
		NULL,
		CONFIG_ETH_INIT_PRIORITY,
		&dummy_eth_api,
		ETHERNET_L2,
		NET_L2_GET_CTX_TYPE(ETHERNET_L2),
		127);


static void test_conn_api_init(struct conn_mgr_conn_binding *const binding)
{
	/* Mark the iface dormant (disconnected) on initialization */
	net_if_dormant_on(binding->iface);
}

static int test_conn_api_connect(struct conn_mgr_conn_binding *const binding)
{
	/* Mark iface as connected */
	net_if_dormant_off(binding->iface);
	return 0;
}

static int test_conn_api_disconnect(struct conn_mgr_conn_binding *const binding)
{
	/* Mark iface as dormant (disconnected) */
	net_if_dormant_on(binding->iface);
	return 0;
}

static struct conn_mgr_conn_api test_conn_api = {
	.init = test_conn_api_init,
	.connect = test_conn_api_connect,
	.disconnect = test_conn_api_disconnect,
};

/* Dummy struct */
struct test_conn_data {
};

#define TEST_CONN_IMPL_CTX_TYPE struct test_conn_data
CONN_MGR_CONN_DEFINE(TEST_CONN_IMPL, &test_conn_api);

/* Bind connectivity implementation to ifaces */
CONN_MGR_BIND_CONN(test_if_connected_a,	TEST_CONN_IMPL);
CONN_MGR_BIND_CONN(test_if_connected_b,	TEST_CONN_IMPL);


struct net_if *if_simp_a = NET_IF_GET(test_if_simple_a,    0);
struct net_if *if_simp_b = NET_IF_GET(test_if_simple_b,    0);
struct net_if *if_conn_a = NET_IF_GET(test_if_connected_a, 0);
struct net_if *if_conn_b = NET_IF_GET(test_if_connected_b, 0);
struct net_if *if_dummy_eth = NET_IF_GET(test_if_dummy_eth, 0);
```

## src/test_ifaces.h
```c
/*
 * Copyright (c) 2023 Nordic Semiconductor ASA
 *
 * SPDX-License-Identifier: Apache-2.0
 */

#ifndef ZEPHYR_INCLUDE_TEST_IFACES_H_
#define ZEPHYR_INCLUDE_TEST_IFACES_H_

#include <zephyr/net/net_if.h>

#ifdef __cplusplus
extern "C" {
#endif

/* Public accessors for static iface structs */
extern struct net_if *if_simp_a;
extern struct net_if *if_simp_b;
extern struct net_if *if_conn_a;
extern struct net_if *if_conn_b;
extern struct net_if *if_dummy_eth;

#ifdef __cplusplus
}
#endif

#endif /* ZEPHYR_INCLUDE_TEST_IFACES_H_ */
```
