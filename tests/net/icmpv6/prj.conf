## CMakeLists.txt
```
# SPDX-License-Identifier: Apache-2.0

cmake_minimum_required(VERSION 3.28.0)
find_package(Zephyr REQUIRED HINTS $ENV{ZEPHYR_BASE})
project(icmpv6)

target_include_directories(app PRIVATE ${ZEPHYR_BASE}/subsys/net/ip)
FILE(GLOB app_sources src/*.c)
target_sources(app PRIVATE ${app_sources})
```

## prj.conf
```kconfig
CONFIG_NETWORKING=y
CONFIG_NET_TEST=y
CONFIG_NET_IPV6=y
CONFIG_NET_IPV4=n
CONFIG_NET_BUF=y
CONFIG_ZTEST_STACK_SIZE=1024
CONFIG_NET_PKT_RX_COUNT=2
CONFIG_NET_PKT_TX_COUNT=5
CONFIG_NET_BUF_RX_COUNT=5
CONFIG_NET_BUF_TX_COUNT=10
CONFIG_NET_LOG=y
CONFIG_ENTROPY_GENERATOR=y
CONFIG_TEST_RANDOM_GENERATOR=y
CONFIG_ZTEST=y
CONFIG_MAIN_STACK_SIZE=1280
CONFIG_NET_L2_ETHERNET=n
CONFIG_NET_L2_DUMMY=y
CONFIG_NET_IPV6_NBR_CACHE=n
CONFIG_NET_IPV6_ND=n
CONFIG_NET_IPV6_DAD=n
CONFIG_NET_IPV6_MLD=n
```

## prj_x86.conf
```kconfig
CONFIG_NETWORKING=y
CONFIG_NET_IPV6=y
CONFIG_NET_IPV4=y
CONFIG_NET_YAIP=y
CONFIG_NET_BUF=y
CONFIG_MAIN_STACK_SIZE=2048
CONFIG_NET_NBUF_RX_COUNT=2
CONFIG_NET_NBUF_TX_COUNT=2
CONFIG_NET_NBUF_DATA_COUNT=5
CONFIG_NET_LOG=y
CONFIG_SYS_LOG_SHOW_COLOR=y
```

## src/main.c
```c
/* main.c - Application main entry point */

/*
 * Copyright (c) 2016 Intel Corporation
 * Copyright (c) 2023 Nordic Semiconductor ASA
 *
 * SPDX-License-Identifier: Apache-2.0
 */

#include <zephyr/logging/log.h>
LOG_MODULE_REGISTER(net_test, CONFIG_NET_ICMPV6_LOG_LEVEL);

#include <errno.h>
#include <zephyr/types.h>
#include <stddef.h>
#include <string.h>
#include <zephyr/sys/printk.h>
#include <zephyr/linker/sections.h>

#include <zephyr/tc_util.h>

#include <zephyr/net_buf.h>
#include <zephyr/net/dummy.h>
#include <zephyr/net/ethernet.h>
#include <zephyr/net/icmp.h>

#include "ipv6.h"
#include "net_private.h"
#include "icmpv6.h"
#include <zephyr/ztest.h>

static struct net_if *test_iface;
static int handler_called;
static int handler_status;

#define TEST_MSG "foobar devnull"

#define ICMPV6_MSG_SIZE 104

static uint8_t icmpv6_echo_req[] =
	"\x60\x02\xea\x12\x00\x40\x3a\x40\xfe\x80\x00\x00\x00\x00\x00\x00" \
	"\xda\xcb\x8a\xff\xfe\x34\xc8\xf3\xfe\x80\x00\x00\x00\x00\x00\x00" \
	"\xec\x88\x2d\x63\xfd\x67\x31\x66\x80\x00\xa4\x24\x0b\x95\x00\x01" \
	"\x97\x78\x0f\x5c\x00\x00\x00\x00\xf7\x72\x00\x00\x00\x00\x00\x00" \
	"\x10\x11\x12\x13\x14\x15\x16\x17\x18\x19\x1a\x1b\x1c\x1d\x1e\x1f" \
	"\x20\x21\x22\x23\x24\x25\x26\x27\x28\x29\x2a\x2b\x2c\x2d\x2e\x2f" \
	"\x30\x31\x32\x33\x34\x35\x36\x37";

static uint8_t icmpv6_echo_rep[] =
	"\x60\x09\x23\xa0\x00\x40\x3a\x40\xfe\x80\x00\x00\x00\x00\x00\x00" \
	"\xec\x88\x2d\x63\xfd\x67\x31\x66\xfe\x80\x00\x00\x00\x00\x00\x00" \
	"\xda\xcb\x8a\xff\xfe\x34\xc8\xf3\x81\x00\xa3\x24\x0b\x95\x00\x01" \
	"\x97\x78\x0f\x5c\x00\x00\x00\x00\xf7\x72\x00\x00\x00\x00\x00\x00" \
	"\x10\x11\x12\x13\x14\x15\x16\x17\x18\x19\x1a\x1b\x1c\x1d\x1e\x1f" \
	"\x20\x21\x22\x23\x24\x25\x26\x27\x28\x29\x2a\x2b\x2c\x2d\x2e\x2f" \
	"\x30\x31\x32\x33\x34\x35\x36\x37";

static uint8_t icmpv6_inval_chksum[] =
	"\x60\x09\x23\xa0\x00\x40\x3a\x40\xfe\x80\x00\x00\x00\x00\x00\x00" \
	"\xec\x88\x2d\x63\xfd\x67\x31\x66\xfe\x80\x00\x00\x00\x00\x00\x00" \
	"\xda\xcb\x8a\xff\xfe\x34\xc8\xf3\x00\x00\xa3\x24\x0b\x95\x00\x01" \
	"\x97\x78\x0f\x5c\x00\x00\x00\x00\xf7\x72\x00\x00\x00\x00\x00\x00" \
	"\x10\x11\x12\x13\x14\x15\x16\x17\x18\x19\x1a\x1b\x1c\x1d\x1e\x1f" \
	"\x20\x21\x22\x23\x24\x25\x26\x27\x28\x29\x2a\x2b\x2c\x2d\x2e\x2f" \
	"\x30\x31\x32\x33\x34\x35\x36\x37";

struct net_icmpv6_context {
	uint8_t mac_addr[sizeof(struct net_eth_addr)];
	struct net_linkaddr ll_addr;
};

static struct net_icmpv6_context net_icmpv6_context_data;

static int net_icmpv6_dev_init(const struct device *dev)
{
	ARG_UNUSED(dev);

	return 0;
}

static uint8_t *net_icmpv6_get_mac(const struct device *dev)
{
	struct net_icmpv6_context *context = dev->data;

	if (context->mac_addr[2] == 0x00) {
		/* 00-00-5E-00-53-xx Documentation RFC 7042 */
		context->mac_addr[0] = 0x00;
		context->mac_addr[1] = 0x00;
		context->mac_addr[2] = 0x5E;
		context->mac_addr[3] = 0x00;
		context->mac_addr[4] = 0x53;
		context->mac_addr[5] = 0x01;
	}

	return context->mac_addr;
}

static void net_icmpv6_iface_init(struct net_if *iface)
{
	uint8_t *mac = net_icmpv6_get_mac(net_if_get_device(iface));

	net_if_set_link_addr(iface, mac, 6, NET_LINK_ETHERNET);
}

static int tester_send(const struct device *dev, struct net_pkt *pkt)
{
	net_pkt_unref(pkt);
	return 0;
}

static DEVICE_API(dummy, net_icmpv6_if_api) = {
	.iface_api.init = net_icmpv6_iface_init,
	.send = tester_send,
};

NET_DEVICE_INIT(net_icmpv6_test, "net_icmpv6_test",
		net_icmpv6_dev_init, NULL,
		&net_icmpv6_context_data, NULL,
		CONFIG_KERNEL_INIT_PRIORITY_DEFAULT,
		&net_icmpv6_if_api, DUMMY_L2,
		NET_L2_GET_CTX_TYPE(DUMMY_L2), 127);

static enum net_verdict handle_test_msg(struct net_icmp_ctx *ctx,
					struct net_pkt *pkt,
					struct net_icmp_ip_hdr *hdr,
					struct net_icmp_hdr *icmp_hdr,
					void *user_data)
{
	ARG_UNUSED(ctx);
	ARG_UNUSED(hdr);
	ARG_UNUSED(icmp_hdr);
	ARG_UNUSED(user_data);

	struct net_buf *last = net_buf_frag_last(pkt->buffer);

	if (last->len != ICMPV6_MSG_SIZE) {
		handler_status = -EINVAL;
		handler_called++;
		return NET_DROP;
	}

	handler_status = 0;
	handler_called++;

	return NET_OK;
}

static struct net_pkt *create_pkt(uint8_t *data, int len,
				  struct net_ipv6_hdr **hdr)
{
	struct net_pkt *pkt;

	pkt = net_pkt_alloc_with_buffer(NULL, ICMPV6_MSG_SIZE,
					NET_AF_UNSPEC, 0, K_SECONDS(1));
	zassert_not_null(pkt, "Allocation failed");

	net_pkt_set_iface(pkt, test_iface);
	net_pkt_set_family(pkt, NET_AF_INET6);
	net_pkt_set_ip_hdr_len(pkt, sizeof(struct net_ipv6_hdr));

	net_pkt_write(pkt, data, len);

	net_pkt_cursor_init(pkt);
	*hdr = net_pkt_cursor_get_pos(pkt);
	net_pkt_set_overwrite(pkt, true);
	net_pkt_skip(pkt, sizeof(struct net_ipv6_hdr));

	/* The cursor should be at the start of the ICMPv6 header */

	return pkt;
}

ZTEST(icmpv6_fn, test_icmpv6)
{
	struct net_icmp_ctx ctx1;
	struct net_icmp_ctx ctx2;
	struct net_ipv6_hdr *hdr;
	struct net_pkt *pkt;
	int ret;

	ret = net_icmp_init_ctx(&ctx1, NET_AF_INET6, NET_ICMPV6_ECHO_REPLY,
				0, handle_test_msg);
	zassert_equal(ret, 0, "Cannot register %s handler (%d)",
		      STRINGIFY(NET_ICMPV6_ECHO_REPLY), ret);

	ret = net_icmp_init_ctx(&ctx2, NET_AF_INET6, NET_ICMPV6_ECHO_REQUEST,
				0, handle_test_msg);
	zassert_equal(ret, 0, "Cannot register %s handler (%d)",
		      STRINGIFY(NET_ICMPV6_ECHO_REQUEST), ret);

	pkt = create_pkt(icmpv6_inval_chksum, ICMPV6_MSG_SIZE, &hdr);
	zassert_not_null(pkt, "Cannot create pkt");

	ret = net_icmpv6_input(pkt, hdr);

	/**TESTPOINT: Check input*/
	zassert_true(ret == NET_DROP, "Callback not called properly");

	handler_status = -1;

	pkt = create_pkt(icmpv6_echo_rep, ICMPV6_MSG_SIZE, &hdr);
	zassert_not_null(pkt, "Cannot create pkt");

	ret = net_icmpv6_input(pkt, hdr);

	/**TESTPOINT: Check input*/
	zassert_true(!(ret == NET_DROP || handler_status != 0),
		     "Callback not called properly");

	handler_status = -1;

	pkt = create_pkt(icmpv6_echo_req, ICMPV6_MSG_SIZE, &hdr);
	zassert_not_null(pkt, "Cannot create pkt");

	ret = net_icmpv6_input(pkt, hdr);

	/**TESTPOINT: Check input*/
	zassert_true(!(ret == NET_DROP || handler_status != 0),
			"Callback not called properly");

	/**TESTPOINT: Check input*/
	zassert_true(!(handler_called != 2), "Callbacks not called properly");

	ret = net_icmp_cleanup_ctx(&ctx1);
	zassert_equal(ret, 0, "Cannot unregister handler (%d)", ret);

	ret = net_icmp_cleanup_ctx(&ctx2);
	zassert_equal(ret, 0, "Cannot unregister handler (%d)", ret);
}

static void *setup(void)
{
	if (IS_ENABLED(CONFIG_NET_TC_THREAD_COOPERATIVE)) {
		k_thread_priority_set(k_current_get(),
				K_PRIO_COOP(CONFIG_NUM_COOP_PRIORITIES - 1));
	} else {
		k_thread_priority_set(k_current_get(), K_PRIO_PREEMPT(9));
	}

	test_iface = net_if_lookup_by_dev(DEVICE_GET(net_icmpv6_test));

	return NULL;
}

/**test case main entry*/
ZTEST_SUITE(icmpv6_fn, NULL, setup, NULL, NULL, NULL);
```

## src/send_error.c
```c
/*
 * Copyright (c) 2026 Aerlync Labs Inc.
 *
 * SPDX-License-Identifier: Apache-2.0
 */

#include <zephyr/logging/log.h>
LOG_MODULE_REGISTER(net_test_icmpv6_send_error, CONFIG_NET_ICMPV6_LOG_LEVEL);

#include <errno.h>
#include <zephyr/types.h>
#include <zephyr/sys/util.h>
#include <zephyr/net/net_ip.h>
#include <zephyr/net/net_pkt.h>
#include <zephyr/net/net_if.h>
#include <zephyr/net/ethernet.h>
#include <zephyr/net/dummy.h>
#include <zephyr/net/icmp.h>
#include <zephyr/ztest.h>

#include "ipv6.h"
#include "icmpv6.h"

#define TEST_IPPROTO_NONE 59

static struct net_if *test_iface;

static int tester_send(const struct device *dev, struct net_pkt *pkt)
{
	ARG_UNUSED(dev);

	net_pkt_unref(pkt);

	return 0;
}

struct send_error_context {
	uint8_t mac_addr[sizeof(struct net_eth_addr)];
};

static struct send_error_context send_error_context_data;

static int send_error_dev_init(const struct device *dev)
{
	ARG_UNUSED(dev);

	return 0;
}

static uint8_t *send_error_get_mac(const struct device *dev)
{
	struct send_error_context *context = dev->data;

	context->mac_addr[0] = 0x00;
	context->mac_addr[1] = 0x00;
	context->mac_addr[2] = 0x5E;
	context->mac_addr[3] = 0x00;
	context->mac_addr[4] = 0x53;
	context->mac_addr[5] = 0x03;

	return context->mac_addr;
}

static void send_error_iface_init(struct net_if *iface)
{
	uint8_t *mac = send_error_get_mac(net_if_get_device(iface));

	net_if_set_link_addr(iface, mac, sizeof(struct net_eth_addr), NET_LINK_ETHERNET);
}

static DEVICE_API(dummy, send_error_if_api) = {
	.iface_api.init = send_error_iface_init,
	.send = tester_send,
};

NET_DEVICE_INIT(net_send_error_test, "net_send_error_test",
		send_error_dev_init, NULL,
		&send_error_context_data, NULL,
		CONFIG_KERNEL_INIT_PRIORITY_DEFAULT,
		&send_error_if_api, DUMMY_L2,
		NET_L2_GET_CTX_TYPE(DUMMY_L2), 127);

static struct net_pkt *create_orig_pkt(const struct net_in6_addr *src,
					const struct net_in6_addr *dst)
{
	struct net_pkt *pkt;

	pkt = net_pkt_alloc_with_buffer(test_iface, sizeof(struct net_ipv6_hdr),
					NET_AF_INET6, TEST_IPPROTO_NONE,
					K_SECONDS(1));
	zassert_not_null(pkt, "Cannot allocate pkt");

	zassert_ok(net_ipv6_create(pkt, src, dst), "Cannot create IPv6 pkt");

	net_pkt_cursor_init(pkt);
	zassert_ok(net_ipv6_finalize(pkt, TEST_IPPROTO_NONE), "Cannot finalize IPv6 pkt");

	return pkt;
}

static struct net_pkt *create_orig_icmpv6_pkt(const struct net_in6_addr *src,
					      const struct net_in6_addr *dst,
					      uint8_t icmpv6_type)
{
	struct net_pkt *pkt;

	pkt = net_pkt_alloc_with_buffer(test_iface,
					sizeof(struct net_ipv6_hdr) + sizeof(struct net_icmp_hdr),
					NET_AF_INET6, NET_IPPROTO_ICMPV6,
					K_SECONDS(1));
	zassert_not_null(pkt, "Cannot allocate pkt");

	zassert_ok(net_ipv6_create(pkt, src, dst), "Cannot create IPv6 pkt");
	zassert_ok(net_icmpv6_create(pkt, icmpv6_type, 0), "Cannot create ICMPv6 hdr");

	net_pkt_cursor_init(pkt);
	zassert_ok(net_ipv6_finalize(pkt, NET_IPPROTO_ICMPV6), "Cannot finalize IPv6 pkt");

	return pkt;
}

struct send_error_test_case {
	const char *name;
	const char *src;
	const char *dst;
	uint8_t type;
	uint8_t code;
	bool expect_sent;
};

static const struct send_error_test_case send_error_cases[] = {
	{
		.name = "unicast src/dst is sent (baseline)",
		.src = "2001:db8::1",
		.dst = "2001:db8::2",
		.type = NET_ICMPV6_DST_UNREACH,
		.code = NET_ICMPV6_DST_UNREACH_NO_ROUTE,
		.expect_sent = true,
	},
	{
		.name = "unspecified src is dropped (e.6)",
		.src = "::",
		.dst = "2001:db8::2",
		.type = NET_ICMPV6_DST_UNREACH,
		.code = NET_ICMPV6_DST_UNREACH_NO_ROUTE,
		.expect_sent = false,
	},
	{
		.name = "multicast src is dropped (e.6)",
		.src = "ff02::1",
		.dst = "2001:db8::2",
		.type = NET_ICMPV6_DST_UNREACH,
		.code = NET_ICMPV6_DST_UNREACH_NO_ROUTE,
		.expect_sent = false,
	},
	{
		.name = "multicast dst + Dst Unreach is dropped (e.3)",
		.src = "2001:db8::1",
		.dst = "ff02::1",
		.type = NET_ICMPV6_DST_UNREACH,
		.code = NET_ICMPV6_DST_UNREACH_NO_ROUTE,
		.expect_sent = false,
	},
	{
		.name = "multicast dst + Time Exceeded is dropped (e.3)",
		.src = "2001:db8::1",
		.dst = "ff02::1",
		.type = NET_ICMPV6_TIME_EXCEEDED,
		.code = 0,
		.expect_sent = false,
	},
	{
		.name = "multicast dst + Param Problem code 0 is dropped (e.3)",
		.src = "2001:db8::1",
		.dst = "ff02::1",
		.type = NET_ICMPV6_PARAM_PROBLEM,
		.code = NET_ICMPV6_PARAM_PROB_HEADER,
		.expect_sent = false,
	},
	{
		.name = "multicast dst + Param Problem code 1 is dropped (e.3)",
		.src = "2001:db8::1",
		.dst = "ff02::1",
		.type = NET_ICMPV6_PARAM_PROBLEM,
		.code = NET_ICMPV6_PARAM_PROB_NEXTHEADER,
		.expect_sent = false,
	},
	{
		.name = "multicast dst + Packet Too Big is sent (e.3 exception 1)",
		.src = "2001:db8::1",
		.dst = "ff02::1",
		.type = NET_ICMPV6_PACKET_TOO_BIG,
		.code = 0,
		.expect_sent = true,
	},
	{
		.name = "multicast dst + Param Problem code 2 is sent (e.3 exception 2)",
		.src = "2001:db8::1",
		.dst = "ff02::1",
		.type = NET_ICMPV6_PARAM_PROBLEM,
		.code = NET_ICMPV6_PARAM_PROB_OPTION,
		.expect_sent = true,
	},
};

ZTEST(icmpv6_send_error_fn, test_send_error_rfc4443_matrix)
{
	for (size_t i = 0; i < ARRAY_SIZE(send_error_cases); i++) {
		const struct send_error_test_case *tc = &send_error_cases[i];
		struct net_in6_addr src;
		struct net_in6_addr dst;
		struct net_pkt *pkt;
		int ret;

		zassert_ok(net_addr_pton(NET_AF_INET6, tc->src, &src),
			   "%s: bad src address", tc->name);
		zassert_ok(net_addr_pton(NET_AF_INET6, tc->dst, &dst),
			   "%s: bad dst address", tc->name);

		pkt = create_orig_pkt(&src, &dst);

		ret = net_icmpv6_send_error(pkt, tc->type, tc->code, 0);

		if (tc->expect_sent) {
			zassert_equal(ret, 0, "%s: expected send, got %d",
				      tc->name, ret);
		} else {
			zassert_equal(ret, -EINVAL, "%s: expected -EINVAL, got %d",
				      tc->name, ret);
		}

		net_pkt_unref(pkt);
	}
}

struct send_error_icmpv6_orig_test_case {
	const char *name;
	uint8_t orig_icmpv6_type;
	bool expect_sent;
};

static const struct send_error_icmpv6_orig_test_case send_error_icmpv6_orig_cases[] = {
	{
		.name = "orig is an ICMPv6 error is dropped (e.1)",
		.orig_icmpv6_type = NET_ICMPV6_DST_UNREACH,
		.expect_sent = false,
	},
	{
		.name = "orig is an ICMPv6 redirect is dropped (e.2)",
		.orig_icmpv6_type = NET_ICMPV6_REDIRECT,
		.expect_sent = false,
	},
	{
		.name = "orig is an ICMPv6 echo request is sent",
		.orig_icmpv6_type = NET_ICMPV6_ECHO_REQUEST,
		.expect_sent = true,
	},
};

ZTEST(icmpv6_send_error_fn, test_send_error_icmpv6_orig)
{
	struct net_in6_addr src;
	struct net_in6_addr dst;

	zassert_ok(net_addr_pton(NET_AF_INET6, "2001:db8::1", &src), "bad src address");
	zassert_ok(net_addr_pton(NET_AF_INET6, "2001:db8::2", &dst), "bad dst address");

	for (size_t i = 0; i < ARRAY_SIZE(send_error_icmpv6_orig_cases); i++) {
		const struct send_error_icmpv6_orig_test_case *tc =
			&send_error_icmpv6_orig_cases[i];
		struct net_pkt *pkt;
		int ret;

		pkt = create_orig_icmpv6_pkt(&src, &dst, tc->orig_icmpv6_type);

		ret = net_icmpv6_send_error(pkt, NET_ICMPV6_DST_UNREACH,
					    NET_ICMPV6_DST_UNREACH_NO_ROUTE, 0);

		if (tc->expect_sent) {
			zassert_equal(ret, 0, "%s: expected send, got %d", tc->name, ret);
		} else {
			zassert_equal(ret, -EINVAL, "%s: expected -EINVAL, got %d",
				      tc->name, ret);
		}

		net_pkt_unref(pkt);
	}
}

static void *send_error_setup(void)
{
	if (IS_ENABLED(CONFIG_NET_TC_THREAD_COOPERATIVE)) {
		k_thread_priority_set(k_current_get(),
				      K_PRIO_COOP(CONFIG_NUM_COOP_PRIORITIES - 1));
	} else {
		k_thread_priority_set(k_current_get(), K_PRIO_PREEMPT(9));
	}

	test_iface = net_if_lookup_by_dev(DEVICE_GET(net_send_error_test));

	return NULL;
}

ZTEST_SUITE(icmpv6_send_error_fn, NULL, send_error_setup, NULL, NULL, NULL);
```
