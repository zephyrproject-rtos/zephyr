## CMakeLists.txt
```
# SPDX-License-Identifier: Apache-2.0

cmake_minimum_required(VERSION 3.28.0)
find_package(Zephyr REQUIRED HINTS $ENV{ZEPHYR_BASE})
project(dhcpv4_server_conformance)

target_sources(app PRIVATE src/main.c)
```

## prj.conf
```kconfig
CONFIG_NETWORKING=y
CONFIG_NET_UDP=y
CONFIG_NET_IPV4=y
CONFIG_NET_IPV6=y
CONFIG_NET_SOCKETS=y

CONFIG_NET_MGMT=y
CONFIG_NET_MGMT_EVENT=y

CONFIG_NET_DHCPV4_SERVER=y
# Every test case in the suite is a client of its own, and the ones that
# complete an exchange do not give the address back, so the default pool of
# four would run out part way through a run.
CONFIG_NET_DHCPV4_SERVER_ADDR_COUNT=16

CONFIG_NET_CONFIG_SETTINGS=y
CONFIG_NET_CONFIG_NEED_IPV4=y
CONFIG_NET_CONFIG_NEED_IPV6=y
CONFIG_NET_CONFIG_MY_IPV4_ADDR="192.0.2.1"
CONFIG_NET_CONFIG_PEER_IPV4_ADDR="192.0.2.2"
CONFIG_NET_CONFIG_MY_IPV6_ADDR="2001:db8::1"
CONFIG_NET_CONFIG_PEER_IPV6_ADDR="2001:db8::2"
CONFIG_NET_CONFIG_NEED_IPV6_ROUTER=n

CONFIG_LOG=y
CONFIG_NET_LOG=y

CONFIG_ENTROPY_GENERATOR=y
CONFIG_TEST_RANDOM_GENERATOR=y
```

## src/main.c
```c
/*
 * Copyright (c) 2026 Nordic Semiconductor ASA
 *
 * SPDX-License-Identifier: Apache-2.0
 */

/* System under test for the DHCPv4 server conformance suite.
 *
 * The application starts the server on the default interface and then does
 * nothing: everything the suite looks at is the server answering, so there is
 * no traffic to generate here.
 *
 * The pool is deliberately larger than the default. Each test case in the
 * suite appears as a client of its own so that no test depends on what an
 * earlier one left behind, and every one of them that completes an exchange
 * takes an address that is not given back.
 *
 * The suite that drives it lives in the net-tools repository, under
 * ttcn3/suites/dhcpv4_server.
 */

#include <zephyr/logging/log.h>
LOG_MODULE_REGISTER(dhcpv4_server_conformance, LOG_LEVEL_INF);

#include <zephyr/kernel.h>
#include <zephyr/net/dhcpv4_server.h>
#include <zephyr/net/net_if.h>
#include <zephyr/net/net_ip.h>

/* The lowest address the server hands out. Above the addresses the test
 * network itself uses, so that nothing in the pool is already taken.
 */
#define POOL_BASE	"192.0.2.100"

int main(void)
{
	struct net_if *iface = net_if_get_default();
	struct net_in_addr base;
	int ret;

	if (iface == NULL) {
		LOG_ERR("No network interface");
		return -ENODEV;
	}

	if (net_addr_pton(NET_AF_INET, POOL_BASE, &base) < 0) {
		LOG_ERR("Cannot parse the pool base address");
		return -EINVAL;
	}

	/* net_config has already brought the interface up and set its
	 * addresses: it waits for both before main() runs.
	 */

	ret = net_dhcpv4_server_start(iface, &base);
	if (ret < 0) {
		LOG_ERR("Cannot start the DHCPv4 server (%d)", ret);
		return ret;
	}

	LOG_INF("DHCPv4 server ready");

	k_sleep(K_FOREVER);

	return 0;
}
```
