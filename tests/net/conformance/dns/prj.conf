## CMakeLists.txt
```
# SPDX-License-Identifier: Apache-2.0

cmake_minimum_required(VERSION 3.28.0)
find_package(Zephyr REQUIRED HINTS $ENV{ZEPHYR_BASE})
project(dns_conformance)

target_sources(app PRIVATE src/main.c)
```

## prj.conf
```kconfig
CONFIG_NETWORKING=y
CONFIG_NET_UDP=y
CONFIG_NET_IPV4=y
CONFIG_NET_IPV6=y
CONFIG_NET_SOCKETS=y

CONFIG_NET_MGMT=y
CONFIG_NET_MGMT_EVENT=y

CONFIG_DNS_RESOLVER=y
CONFIG_MDNS_RESOLVER=n
CONFIG_LLMNR_RESOLVER=n
CONFIG_DNS_SERVER_IP_ADDRESSES=y
CONFIG_DNS_RESOLVER_MAX_SERVERS=1
CONFIG_DNS_NUM_CONCUR_QUERIES=2

# The suite listens here rather than on port 53, so that it needs no
# privileges and cannot collide with a resolver running on the host.
CONFIG_DNS_SERVER1="192.0.2.2:15353"

CONFIG_NET_CONFIG_SETTINGS=y
CONFIG_NET_CONFIG_NEED_IPV4=y
CONFIG_NET_CONFIG_NEED_IPV6=y
CONFIG_NET_CONFIG_MY_IPV4_ADDR="192.0.2.1"
CONFIG_NET_CONFIG_PEER_IPV4_ADDR="192.0.2.2"
CONFIG_NET_CONFIG_MY_IPV6_ADDR="2001:db8::1"
CONFIG_NET_CONFIG_PEER_IPV6_ADDR="2001:db8::2"
CONFIG_NET_CONFIG_NEED_IPV6_ROUTER=n

CONFIG_LOG=y
CONFIG_NET_LOG=y

CONFIG_ENTROPY_GENERATOR=y
CONFIG_TEST_RANDOM_GENERATOR=y
```

## src/main.c
```c
/*
 * Copyright (c) 2026 Nordic Semiconductor ASA
 *
 * SPDX-License-Identifier: Apache-2.0
 */

/* System under test for the DNS resolver conformance suite.
 *
 * The suite examines the queries the resolver puts on the wire, so this asks
 * for a name over and over rather than once: a suite can then start at any
 * point, collect as many queries as a test case needs, and still finish
 * quickly. One at a time, though, waiting out each lookup before starting the
 * next, which is how an application asks. Whether a query is answered is up to
 * the suite; the resolver does not retransmit, so an unanswered one simply
 * fails here and the next one follows.
 *
 * The suite that drives it lives in the net-tools repository, under
 * ttcn3/suites/dns.
 */

#include <zephyr/logging/log.h>
LOG_MODULE_REGISTER(dns_conformance, LOG_LEVEL_INF);

#include <zephyr/kernel.h>
#include <zephyr/net/dns_resolve.h>
#include <zephyr/net/net_if.h>

#define QUERY_NAME	"conformance.test"
/* One lookup at a time, the way an application asks: the next one starts only
 * after the last has been answered or given up on. Overlapping lookups would
 * be a different thing to test, and would keep the resolver from ever being
 * idle between them.
 */
#define QUERY_TIMEOUT	2000
#define QUERY_INTERVAL	K_MSEC(QUERY_TIMEOUT + 500)

static void result_cb(enum dns_resolve_status status, struct dns_addrinfo *info,
		      void *user_data)
{
	ARG_UNUSED(info);
	ARG_UNUSED(user_data);

	if (status == DNS_EAI_INPROGRESS || status == DNS_EAI_ALLDONE) {
		LOG_INF("Query for %s answered", QUERY_NAME);
	}
}

int main(void)
{
	struct net_if *iface = net_if_get_default();
	uint16_t dns_id;
	int ret;

	if (iface == NULL) {
		LOG_ERR("No network interface");
		return -ENODEV;
	}

	/* net_config has already brought the interface up and set its
	 * addresses: it waits for both before main() runs.
	 */

	LOG_INF("DNS resolver ready");

	while (true) {
		ret = dns_get_addr_info(QUERY_NAME, DNS_QUERY_TYPE_A, &dns_id,
					result_cb, NULL, QUERY_TIMEOUT);
		if (ret < 0 && ret != -EAGAIN && ret != -ENOSPC) {
			LOG_DBG("Cannot start a query (%d)", ret);
		}

		k_sleep(QUERY_INTERVAL);
	}

	return 0;
}
```
