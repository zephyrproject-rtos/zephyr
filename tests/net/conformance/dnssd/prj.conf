## CMakeLists.txt
```
# SPDX-License-Identifier: Apache-2.0

cmake_minimum_required(VERSION 3.28.0)
find_package(Zephyr REQUIRED HINTS $ENV{ZEPHYR_BASE})
project(dnssd_conformance)

target_sources(app PRIVATE src/main.c)
```

## prj.conf
```kconfig
CONFIG_NETWORKING=y
CONFIG_NET_UDP=y
CONFIG_NET_TCP=y
CONFIG_NET_IPV4=y
CONFIG_NET_IPV6=y
CONFIG_NET_SOCKETS=y

CONFIG_NET_MGMT=y
CONFIG_NET_MGMT_EVENT=y

CONFIG_NET_HOSTNAME_ENABLE=y
CONFIG_NET_HOSTNAME_UNIQUE=n
CONFIG_NET_HOSTNAME="zephyr"

CONFIG_MDNS_RESPONDER=y
CONFIG_DNS_SD=y
CONFIG_MDNS_RESPONDER_DNS_SD=y
CONFIG_MDNS_RESPONDER_DNS_SD_SERVICE_TYPE_ENUMERATION=y

CONFIG_NET_IF_UNICAST_IPV6_ADDR_COUNT=3
CONFIG_NET_IF_MCAST_IPV6_ADDR_COUNT=5
CONFIG_NET_IF_MCAST_IPV4_ADDR_COUNT=3

CONFIG_NET_PKT_RX_COUNT=10
CONFIG_NET_PKT_TX_COUNT=10
CONFIG_NET_BUF_RX_COUNT=20
CONFIG_NET_BUF_TX_COUNT=20

CONFIG_NET_CONFIG_SETTINGS=y
CONFIG_NET_CONFIG_NEED_IPV4=y
CONFIG_NET_CONFIG_NEED_IPV6=y
CONFIG_NET_CONFIG_MY_IPV4_ADDR="192.0.2.1"
CONFIG_NET_CONFIG_PEER_IPV4_ADDR="192.0.2.2"
CONFIG_NET_CONFIG_MY_IPV6_ADDR="2001:db8::1"
CONFIG_NET_CONFIG_PEER_IPV6_ADDR="2001:db8::2"

CONFIG_LOG=y
CONFIG_NET_LOG=y

CONFIG_ENTROPY_GENERATOR=y
CONFIG_TEST_RANDOM_GENERATOR=y
```

## src/main.c
```c
/*
 * Copyright (c) 2026 Nordic Semiconductor ASA
 *
 * SPDX-License-Identifier: Apache-2.0
 */

/* System under test for the DNS service discovery conformance suite.
 *
 * The application registers one service and waits. Everything the suite looks
 * at is the responder answering, so there is nothing to drive from here.
 *
 * The socket matters even though nothing ever connects to it. The responder
 * checks that a service is bound before advertising it, so a registration
 * whose port nothing listens on is silently never mentioned. Listening is what
 * makes the service real enough to be advertised.
 *
 * The suite that drives it lives in the net-tools repository, under
 * ttcn3/suites/dnssd.
 */

#include <zephyr/logging/log.h>
LOG_MODULE_REGISTER(dnssd_conformance, LOG_LEVEL_INF);

#include <zephyr/kernel.h>
#include <zephyr/net/dns_sd.h>
#include <zephyr/net/net_if.h>
#include <zephyr/net/socket.h>

#define SERVICE_PORT	4242

DNS_SD_REGISTER_TCP_SERVICE(conformance_service, CONFIG_NET_HOSTNAME, "_zephyr",
			    "local", DNS_SD_EMPTY_TXT, SERVICE_PORT);

/* Bind and listen, so that the responder sees the service as bound. Nothing
 * connects, so there is no accept loop.
 */
static int listen_for_the_service(void)
{
	struct net_sockaddr_in6 addr = {
		.sin6_family = NET_AF_INET6,
		.sin6_addr = NET_IN6ADDR_ANY_INIT,
		.sin6_port = net_htons(SERVICE_PORT),
	};
	int sock;

	sock = zsock_socket(NET_AF_INET6, NET_SOCK_STREAM, NET_IPPROTO_TCP);
	if (sock < 0) {
		return -errno;
	}

	if (zsock_bind(sock, (struct net_sockaddr *)&addr, sizeof(addr)) < 0) {
		(void)zsock_close(sock);
		return -errno;
	}

	if (zsock_listen(sock, 1) < 0) {
		(void)zsock_close(sock);
		return -errno;
	}

	return 0;
}

int main(void)
{
	struct net_if *iface = net_if_get_default();
	int ret;

	if (iface == NULL) {
		LOG_ERR("No network interface");
		return -ENODEV;
	}

	/* net_config has already brought the interface up and set its
	 * addresses: it waits for both before main() runs.
	 */

	ret = listen_for_the_service();
	if (ret < 0) {
		LOG_ERR("Cannot listen on the advertised port (%d)", ret);
		return ret;
	}

	LOG_INF("Service discovery ready");

	k_sleep(K_FOREVER);

	return 0;
}
```
