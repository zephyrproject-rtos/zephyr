## CMakeLists.txt
```
# SPDX-License-Identifier: Apache-2.0

cmake_minimum_required(VERSION 3.28.0)
find_package(Zephyr REQUIRED HINTS $ENV{ZEPHYR_BASE})
project(ndp_conformance)

target_sources(app PRIVATE src/main.c)
```

## prj.conf
```kconfig
CONFIG_NETWORKING=y
CONFIG_NET_UDP=y
CONFIG_NET_IPV4=n
CONFIG_NET_IPV6=y
CONFIG_NET_SOCKETS=y

CONFIG_NET_L2_ETHERNET=y
CONFIG_NET_IPV6_ND=y
CONFIG_NET_IPV6_NBR_CACHE=y
CONFIG_NET_IPV6_DAD=y

# Room for a third address, and for the group that goes with it. The defaults
# leave none, so an address configured from an advertised prefix would have
# nowhere to go and the suite would see it silently not happen.
CONFIG_NET_IF_UNICAST_IPV6_ADDR_COUNT=4
CONFIG_NET_IF_MCAST_IPV6_ADDR_COUNT=5

# The neighbour cache is left at its default. Sending a solicitation takes a
# cache entry even when the address being asked about is the interface's own,
# so a small cache stops duplicate address detection from being sent at all.

CONFIG_NET_CONFIG_SETTINGS=y
CONFIG_NET_CONFIG_NEED_IPV6=y
CONFIG_NET_CONFIG_MY_IPV6_ADDR="2001:db8::1"
CONFIG_NET_CONFIG_PEER_IPV6_ADDR="2001:db8::2"
CONFIG_NET_CONFIG_NEED_IPV6_ROUTER=n

CONFIG_LOG=y
CONFIG_NET_LOG=y

CONFIG_ENTROPY_GENERATOR=y
CONFIG_TEST_RANDOM_GENERATOR=y
```

## src/main.c
```c
/*
 * Copyright (c) 2026 Nordic Semiconductor ASA
 *
 * SPDX-License-Identifier: Apache-2.0
 */

/* System under test for the IPv6 neighbour discovery conformance suite.
 *
 * The application answers for its own addresses, which is what most of the
 * suite looks at, and sends a datagram to a peer every couple of seconds so
 * that there is something for it to resolve. Nothing answers on the link
 * unless the suite chooses to, so an unresolved destination keeps producing
 * solicitations for the suite to look at, the same way the address resolution
 * test does one layer down.
 *
 * The suite that drives it lives in the net-tools repository, under
 * ttcn3/suites/ndp.
 */

#include <zephyr/logging/log.h>
LOG_MODULE_REGISTER(ndp_conformance, LOG_LEVEL_INF);

#include <zephyr/kernel.h>
#include <zephyr/net/net_if.h>
#include <zephyr/net/socket.h>

#define PEER_PORT	9999
#define SEND_INTERVAL	K_SECONDS(2)

static void send_to_peer(void)
{
	static const char payload[] = "ndp";
	struct net_sockaddr_in6 peer = {
		.sin6_family = NET_AF_INET6,
		.sin6_port = net_htons(PEER_PORT),
	};
	int sock;

	if (net_addr_pton(NET_AF_INET6, CONFIG_NET_CONFIG_PEER_IPV6_ADDR,
			  &peer.sin6_addr) < 0) {
		LOG_ERR("Cannot parse the peer address");
		return;
	}

	sock = zsock_socket(NET_AF_INET6, NET_SOCK_DGRAM, NET_IPPROTO_UDP);
	if (sock < 0) {
		LOG_ERR("Cannot create a socket (%d)", -errno);
		return;
	}

	(void)zsock_sendto(sock, payload, sizeof(payload) - 1, 0,
			   (struct net_sockaddr *)&peer, sizeof(peer));

	(void)zsock_close(sock);
}

int main(void)
{
	struct net_if *iface = net_if_get_default();

	if (iface == NULL) {
		LOG_ERR("No network interface");
		return -ENODEV;
	}

	LOG_INF("Neighbour discovery ready");

	while (true) {
		send_to_peer();
		k_sleep(SEND_INTERVAL);
	}

	return 0;
}
```
