## CMakeLists.txt
```
# SPDX-License-Identifier: Apache-2.0

cmake_minimum_required(VERSION 3.28.0)
find_package(Zephyr REQUIRED HINTS $ENV{ZEPHYR_BASE})
project(mld_conformance)

target_sources(app PRIVATE src/main.c)
```

## prj.conf
```kconfig
CONFIG_NETWORKING=y
CONFIG_NET_UDP=y
CONFIG_NET_IPV4=n
CONFIG_NET_IPV6=y
CONFIG_NET_SOCKETS=y

CONFIG_NET_L2_ETHERNET=y

CONFIG_NET_IPV6_MLD=y
# The all-nodes and the two solicited-node addresses take three slots; the
# address under test needs one more.
CONFIG_NET_IF_MCAST_IPV6_ADDR_COUNT=4

CONFIG_NET_CONFIG_SETTINGS=y
CONFIG_NET_CONFIG_NEED_IPV6=y
CONFIG_NET_CONFIG_MY_IPV6_ADDR="2001:db8::1"
CONFIG_NET_CONFIG_PEER_IPV6_ADDR="2001:db8::2"

CONFIG_LOG=y
CONFIG_NET_LOG=y

CONFIG_ENTROPY_GENERATOR=y
CONFIG_TEST_RANDOM_GENERATOR=y
```

## boards/native_sim.overlay
```dts
/*
 * SPDX-FileCopyrightText: Copyright The Zephyr Project Contributors
 * SPDX-License-Identifier: Apache-2.0
 */

/*
 * The suite works below the IP layer, so the device is put on an interface of
 * its own, one with no address on the Linux side, so that nothing but the
 * suite answers on the link. See net-tools/zeth-l2.conf.
 */

&zeth0 {
	host-interface = "zethL2";
};
```

## src/main.c
```c
/*
 * SPDX-FileCopyrightText: Copyright The Zephyr Project Contributors
 * SPDX-License-Identifier: Apache-2.0
 */

/* System under test for the MLD conformance suite.
 *
 * Everything the suite looks at is what the stack does when a multicast
 * address is listened to or left and when a querier asks, and the stack does
 * all of that on its own. What the application has to provide is the joining
 * and leaving: it joins one address, keeps it for a while, leaves it, waits,
 * and starts again, so that a test that wants to see a join or a leave only
 * has to wait for the next.
 *
 * This one runs on its own interface, with no address on the Linux side of it,
 * so that nothing but the suite answers. See net-tools/zeth-l2.conf.
 *
 * The suite that drives it lives in the net-tools repository, under
 * ttcn3/suites/mld.
 */

#include <zephyr/logging/log.h>
LOG_MODULE_REGISTER(mld_conformance, LOG_LEVEL_INF);

#include <zephyr/kernel.h>
#include <zephyr/net/mld.h>
#include <zephyr/net/net_if.h>

/* The address has to agree with tsp_group in the suite's configuration, and
 * the times with what the suite's test cases count on. The address is kept
 * long enough for a test to ask about it and be answered, and left long enough
 * for the tester to see the leave before the next join.
 */
#define GROUP		"ff05::db8:1"
#define JOINED_FOR	K_SECONDS(6)
#define LEFT_FOR	K_SECONDS(4)

int main(void)
{
	struct net_if *iface = net_if_get_default();
	struct net_in6_addr group;
	int ret;

	if (iface == NULL) {
		LOG_ERR("No network interface");
		return -ENODEV;
	}

	if (net_addr_pton(NET_AF_INET6, GROUP, &group) < 0) {
		LOG_ERR("Cannot parse the group address");
		return -EINVAL;
	}

	/* net_config has already brought the interface up and set its global
	 * address. MLD messages are sent from the link-local address, and a
	 * report sent before that address has passed Duplicate Address
	 * Detection goes out from the unspecified address, which is not what
	 * the suite is about, so wait for it.
	 */
	while (net_if_ipv6_get_ll(iface, NET_ADDR_PREFERRED) == NULL) {
		k_sleep(K_MSEC(100));
	}

	LOG_INF("MLD listener ready");

	while (true) {
		ret = net_ipv6_mld_join(iface, &group);
		if (ret < 0) {
			LOG_ERR("Cannot join %s (%d)", GROUP, ret);
		}

		k_sleep(JOINED_FOR);

		ret = net_ipv6_mld_leave(iface, &group);
		if (ret < 0) {
			LOG_ERR("Cannot leave %s (%d)", GROUP, ret);
		}

		k_sleep(LEFT_FOR);
	}

	return 0;
}
```
