## CMakeLists.txt
```
# SPDX-License-Identifier: Apache-2.0

cmake_minimum_required(VERSION 3.28.0)
find_package(Zephyr REQUIRED HINTS $ENV{ZEPHYR_BASE})
project(all)

FILE(GLOB app_sources src/*.c)
target_sources(app PRIVATE ${app_sources})
```

## prj.conf
```kconfig
# Activate all network Kconfig options in order to test that the result
# target compiles ok. Note that the different values in this file are
# just randomly selected, do not use the values in your real life
# applications.

# Generic options that are useful or need to be active
CONFIG_ENTROPY_GENERATOR=y
CONFIG_TEST_RANDOM_GENERATOR=y
CONFIG_ZTEST=y
CONFIG_LOG_DEFAULT_LEVEL=4
CONFIG_MAX_THREAD_BYTES=6
CONFIG_POSIX_AEP_CHOICE_NETAPP=y

# TLS configuration
CONFIG_MBEDTLS=y
CONFIG_MBEDTLS_ENABLE_HEAP=y
CONFIG_MBEDTLS_HEAP_SIZE=60000
CONFIG_MBEDTLS_SSL_IN_CONTENT_LEN=2048
CONFIG_MBEDTLS_SSL_OUT_CONTENT_LEN=2048
CONFIG_MBEDTLS_SSL_DTLS_CONNECTION_ID=y
CONFIG_MBEDTLS_CIPHERSUITE_TLS_ECDHE_ECDSA_WITH_AES_128_GCM_SHA256=y
CONFIG_MBEDTLS_CIPHERSUITE_ECJPAKE_WITH_AES_128_CCM_8=y

# net_buf/pkt options
CONFIG_NET_BUF=y
CONFIG_NET_BUF_LOG=y
CONFIG_NET_BUF_LOG_LEVEL_DBG=y
CONFIG_NET_BUF_WARN_ALLOC_INTERVAL=2
CONFIG_NET_BUF_SIMPLE_LOG=y
CONFIG_NET_BUF_POOL_USAGE=y
#CONFIG_NET_PKT_BUF_RX_DATA_POOL_SIZE=4096
#CONFIG_NET_PKT_BUF_TX_DATA_POOL_SIZE=4096
CONFIG_NET_BUF_FIXED_DATA_SIZE=y
CONFIG_NET_BUF_VARIABLE_DATA_SIZE=n
CONFIG_NET_PKT_RX_COUNT=10
CONFIG_NET_PKT_TX_COUNT=10
CONFIG_NET_BUF_RX_COUNT=15
CONFIG_NET_BUF_TX_COUNT=15
CONFIG_NET_BUF_DATA_SIZE=96
CONFIG_NET_DEBUG_NET_PKT_ALLOC=y
CONFIG_NET_DEBUG_NET_PKT_NON_FRAGILE_ACCESS=y
CONFIG_NET_PKT_TIMESTAMP=y
CONFIG_NET_PKT_TIMESTAMP_STACK_SIZE=1024

# Core IP options
CONFIG_NETWORKING=y
CONFIG_NET_SHELL=y
CONFIG_NET_SHELL_DYN_CMD_COMPLETION=y
CONFIG_NET_SHELL_SHOW_DISABLED_COMMANDS=y
CONFIG_NET_IP_ADDR_CHECK=y
CONFIG_NET_ICMPV4_ACCEPT_BROADCAST=y
CONFIG_NET_PROMISC_LOG_LEVEL_DBG=y
CONFIG_NET_PROMISCUOUS_MODE=y
CONFIG_NET_TEST=y
CONFIG_NET_TX_DEFAULT_PRIORITY=5
CONFIG_NET_IPV6_MAX_NEXTHOPS=20
CONFIG_NET_IPV6_MAX_ROUTES=5

# Hostname
CONFIG_NET_HOSTNAME_ENABLE=y
CONFIG_NET_HOSTNAME_LOG_LEVEL_DBG=y
CONFIG_NET_HOSTNAME_UNIQUE=y

# Statistics
CONFIG_NET_STATISTICS=y
CONFIG_NET_STATISTICS_USER_API=y
CONFIG_NET_STATISTICS_PERIODIC_OUTPUT=y
CONFIG_NET_STATISTICS_IPV4=y
CONFIG_NET_STATISTICS_IPV6=y
CONFIG_NET_STATISTICS_IPV6_ND=y
CONFIG_NET_STATISTICS_ICMP=y
CONFIG_NET_STATISTICS_UDP=y
CONFIG_NET_STATISTICS_TCP=y
CONFIG_NET_STATISTICS_MLD=y
CONFIG_NET_STATISTICS_ETHERNET=y
CONFIG_NET_STATISTICS_ETHERNET_VENDOR=y
CONFIG_NET_STATISTICS_LOG_LEVEL_DBG=y
CONFIG_NET_STATISTICS_PER_INTERFACE=y

# L2 drivers
CONFIG_NET_L2_IEEE802154_RADIO_TX_RETRIES=2
CONFIG_NET_L2_IEEE802154_RADIO_CSMA_CA=y
CONFIG_NET_L2_IEEE802154_RADIO_ALOHA=n
CONFIG_NET_L2_IEEE802154_RADIO_CSMA_CA_MAX_BO=4
CONFIG_NET_L2_IEEE802154_RADIO_CSMA_CA_MIN_BE=3
CONFIG_NET_L2_IEEE802154_RADIO_CSMA_CA_MAX_BE=5
CONFIG_NET_L2_IEEE802154=y
CONFIG_NET_L2_IEEE802154_RFD=y
CONFIG_NET_L2_IEEE802154_SHELL=y
CONFIG_NET_L2_IEEE802154_FRAGMENT=y
CONFIG_NET_L2_IEEE802154_FRAGMENT_REASS_CACHE_SIZE=2
CONFIG_NET_L2_IEEE802154_REASSEMBLY_TIMEOUT=10
CONFIG_NET_L2_IEEE802154_SECURITY=y
CONFIG_NET_L2_IEEE802154_SECURITY_CRYPTO_DEV_NAME="CRYPTO-DEV"
CONFIG_NET_L2_DUMMY=y
CONFIG_NET_L2_ETHERNET=y
CONFIG_NET_L2_CANBUS_RAW=y
CONFIG_NET_L2_ETHERNET_MGMT=y
CONFIG_NET_L2_IEEE802154_RADIO_DFLT_TX_POWER=2
CONFIG_NET_L2_IEEE802154_LOG_LEVEL_DBG=y
CONFIG_NET_L2_ETHERNET_LOG_LEVEL_DBG=y
CONFIG_NET_L2_WIFI_MGMT_LOG_LEVEL_DBG=y
CONFIG_NET_L2_WIFI_MGMT=y
CONFIG_NET_L2_WIFI_SHELL=y
CONFIG_NET_L2_PTP_TIMESTAMPING=y
CONFIG_NET_L2_IPIP=y

# IP offload support
CONFIG_NET_OFFLOAD=y
CONFIG_NET_OFFLOAD_LOG_LEVEL_DBG=y

# Routing table
CONFIG_NET_MAX_ROUTERS=3
#CONFIG_NET_IPV6_ROUTE_MCAST=y
#CONFIG_NET_IPV6_MAX_MCAST_ROUTES=4

# TCP
CONFIG_NET_TCP=y
CONFIG_NET_TCP_LOG_LEVEL_DBG=y
CONFIG_NET_TCP_TIME_WAIT_DELAY=20000
CONFIG_NET_TCP_CHECKSUM=y
CONFIG_NET_TCP_INIT_RETRANSMISSION_TIMEOUT=400
CONFIG_NET_TCP_RETRY_COUNT=10

# UDP
CONFIG_NET_UDP=y
CONFIG_NET_UDP_LOG_LEVEL_DBG=y
CONFIG_NET_UDP_CHECKSUM=y

# Network context
CONFIG_NET_MAX_CONN=10
CONFIG_NET_MAX_CONTEXTS=5
CONFIG_NET_CONTEXT_NET_PKT_POOL=y
CONFIG_NET_CONTEXT_SYNC_RECV=y
CONFIG_NET_CONTEXT_CHECK=y
CONFIG_NET_CONTEXT_PRIORITY=y

# SLIP
CONFIG_NET_SLIP_TAP=y

# Trickle algo
CONFIG_NET_TRICKLE=y
CONFIG_NET_TRICKLE_LOG_LEVEL_DBG=y

# IPv6
CONFIG_NET_IPV6=y
CONFIG_NET_IF_UNICAST_IPV6_ADDR_COUNT=3
CONFIG_NET_IF_MCAST_IPV6_ADDR_COUNT=3
CONFIG_NET_IF_IPV6_PREFIX_COUNT=3
CONFIG_NET_IF_MAX_IPV6_COUNT=10
CONFIG_NET_INITIAL_HOP_LIMIT=64
CONFIG_NET_IPV6_MAX_NEIGHBORS=5
CONFIG_NET_IPV6_FRAGMENT=y
CONFIG_NET_IPV6_FRAGMENT_MAX_COUNT=2
CONFIG_NET_IPV6_FRAGMENT_TIMEOUT=23
CONFIG_NET_IPV6_MLD=y
CONFIG_NET_IPV6_NBR_CACHE=y
CONFIG_NET_IPV6_ND=y
CONFIG_NET_IPV6_DAD=y
CONFIG_NET_IPV6_RA_RDNSS=y
CONFIG_NET_IPV6_LOG_LEVEL_DBG=y
CONFIG_NET_IPV6_ND_LOG_LEVEL_DBG=y
CONFIG_NET_IPV6_NBR_CACHE_LOG_LEVEL_DBG=y
CONFIG_NET_ICMPV6_LOG_LEVEL_DBG=y

# IPv6 privacy extension
CONFIG_NET_IPV6_PE=y
CONFIG_NET_IPV6_PE_PREFER_PUBLIC_ADDRESSES=n
CONFIG_NET_IPV6_PE_FILTER_PREFIX_COUNT=2

# 6lo
CONFIG_NET_6LO=y
CONFIG_NET_6LO_CONTEXT=y
CONFIG_NET_MAX_6LO_CONTEXTS=2
CONFIG_NET_6LO_LOG_LEVEL_DBG=y

# Network configuration for the sample application
CONFIG_NET_CONFIG_SETTINGS=y
CONFIG_NET_CONFIG_MY_IPV6_ADDR="2001:db8::1"
CONFIG_NET_CONFIG_PEER_IPV6_ADDR="2001:db8::2"
CONFIG_NET_CONFIG_MY_IPV4_ADDR="192.0.2.1"
CONFIG_NET_CONFIG_PEER_IPV4_ADDR="192.0.2.2"
CONFIG_NET_CONFIG_IEEE802154_PAN_ID=0x1234
CONFIG_NET_CONFIG_IEEE802154_CHANNEL=15
CONFIG_NET_CONFIG_IEEE802154_SECURITY_KEY="key"
CONFIG_NET_CONFIG_IEEE802154_SECURITY_KEY_MODE=0
CONFIG_NET_CONFIG_IEEE802154_SECURITY_LEVEL=0
CONFIG_NET_CONFIG_AUTO_INIT=y
CONFIG_NET_CONFIG_IEEE802154_RADIO_TX_POWER=10
CONFIG_NET_CONFIG_INIT_PRIO=90
CONFIG_NET_CONFIG_INIT_TIMEOUT=10
CONFIG_NET_CONFIG_LOG_LEVEL_DBG=y
CONFIG_NET_CONFIG_MY_IPV4_GW="1.2.3.4"
CONFIG_NET_CONFIG_MY_IPV4_NETMASK="255.255.255.0"
CONFIG_NET_CONFIG_NEED_IPV4=y
CONFIG_NET_CONFIG_NEED_IPV6_ROUTER=y
CONFIG_NET_CONFIG_NEED_IPV6=y

# Network management
CONFIG_NET_MGMT=y
CONFIG_NET_MGMT_EVENT=y
CONFIG_NET_MGMT_EVENT_STACK_SIZE=800
CONFIG_NET_MGMT_EVENT_QUEUE_SIZE=5
CONFIG_NET_MGMT_EVENT_LOG_LEVEL_DBG=y
CONFIG_NET_DEBUG_MGMT_EVENT_STACK=y
CONFIG_NET_MGMT_EVENT_INFO=y
CONFIG_NET_MGMT_EVENT_MONITOR=y
CONFIG_NET_MGMT_EVENT_MONITOR_AUTO_START=y

# IPv4
CONFIG_NET_IPV4=y
CONFIG_NET_IPV4_ACD=y
CONFIG_NET_INITIAL_TTL=42
CONFIG_NET_IF_UNICAST_IPV4_ADDR_COUNT=2
CONFIG_NET_IF_MCAST_IPV4_ADDR_COUNT=2
CONFIG_NET_IF_MAX_IPV4_COUNT=10
CONFIG_NET_DHCPV4=y
CONFIG_NET_IPV4_AUTO=y
CONFIG_NET_IPV4_LOG_LEVEL_DBG=y
CONFIG_NET_IPV4_AUTO_LOG_LEVEL_DBG=y
CONFIG_NET_ICMPV4_LOG_LEVEL_DBG=y
CONFIG_NET_DHCPV4_LOG_LEVEL_DBG=y
CONFIG_NET_DHCPV4_INITIAL_DELAY_MAX=10

# ARP
CONFIG_NET_ARP=y
CONFIG_NET_ARP_TABLE_SIZE=3
CONFIG_NET_ARP_LOG_LEVEL_DBG=y
CONFIG_NET_ARP_GRATUITOUS=y
CONFIG_NET_ARP_GRATUITOUS_TRANSMISSION=y

# Logging
CONFIG_NET_LOG=y
CONFIG_NET_CORE_LOG_LEVEL_DBG=y
CONFIG_NET_IF_LOG_LEVEL_DBG=y
CONFIG_NET_UTILS_LOG_LEVEL_DBG=y
CONFIG_NET_CONTEXT_LOG_LEVEL_DBG=y
CONFIG_NET_PKT_LOG_LEVEL_DBG=y
CONFIG_NET_DEBUG_NET_PKT_EXTERNALS=4
CONFIG_NET_CONN_LOG_LEVEL_DBG=y
CONFIG_NET_IPV6_ROUTE_LOG_LEVEL_DBG=y

# IP threads stack size
CONFIG_NET_TX_STACK_SIZE=1024
CONFIG_NET_RX_STACK_SIZE=1024

# DNS
CONFIG_DNS_RESOLVER=y
CONFIG_DNS_RESOLVER_ADDITIONAL_BUF_CTR=1
CONFIG_DNS_RESOLVER_ADDITIONAL_QUERIES=2
CONFIG_DNS_RESOLVER_MAX_SERVERS=5
CONFIG_DNS_SERVER_IP_ADDRESSES=y
CONFIG_DNS_SERVER1="2001:db8::33:fe:2c:53"
CONFIG_DNS_SERVER2="[2001:db8::42]:5353"
CONFIG_DNS_SERVER3="192.0.2.42"
CONFIG_DNS_SERVER4="2001:db8::2"
CONFIG_DNS_SERVER5="192.0.2.11:1000"
CONFIG_DNS_NUM_CONCUR_QUERIES=2
CONFIG_DNS_RESOLVER_LOG_LEVEL_DBG=y
CONFIG_MDNS_RESPONDER=y
CONFIG_MDNS_RESPONDER_LOG_LEVEL_DBG=y

# CoAP
CONFIG_COAP=y
CONFIG_COAP_LOG_LEVEL_DBG=y

# MQTT
CONFIG_MQTT_LIB=y
CONFIG_MQTT_KEEPALIVE=60
CONFIG_MQTT_LIB_TLS=y

# LwM2M
CONFIG_LWM2M=y
CONFIG_LWM2M_DTLS_SUPPORT=y
CONFIG_LWM2M_DNS_SUPPORT=y
CONFIG_LWM2M_CANCEL_OBSERVE_BY_PATH=y
CONFIG_LWM2M_QUEUE_MODE_ENABLED=y
CONFIG_LWM2M_CONN_MON_OBJ_SUPPORT=y
CONFIG_LWM2M_FIRMWARE_UPDATE_OBJ_SUPPORT=y
CONFIG_LWM2M_FIRMWARE_UPDATE_PULL_SUPPORT=y
CONFIG_LWM2M_FIRMWARE_UPDATE_PULL_COAP_PROXY_SUPPORT=y
CONFIG_LWM2M_RW_JSON_SUPPORT=y
CONFIG_LWM2M_LOCATION_OBJ_SUPPORT=y
CONFIG_LWM2M_GATEWAY_OBJ_SUPPORT=y
CONFIG_LWM2M_EVENT_LOG_OBJ_SUPPORT=y
CONFIG_LWM2M_IPSO_SUPPORT=y
CONFIG_LWM2M_IPSO_TEMP_SENSOR=y
CONFIG_LWM2M_IPSO_GENERIC_SENSOR=y
CONFIG_LWM2M_IPSO_HUMIDITY_SENSOR=y
CONFIG_LWM2M_IPSO_PRESSURE_SENSOR=y
CONFIG_LWM2M_IPSO_LIGHT_CONTROL=y
CONFIG_LWM2M_IPSO_ACCELEROMETER=y
CONFIG_LWM2M_IPSO_MAGNETOMETER=y
CONFIG_LWM2M_IPSO_TIME=y
CONFIG_LWM2M_IPSO_BUZZER=y
CONFIG_LWM2M_IPSO_TIMER=y
CONFIG_LWM2M_IPSO_ONOFF_SWITCH=y
CONFIG_LWM2M_IPSO_PUSH_BUTTON=y
CONFIG_LWM2M_IPSO_CURRENT_SENSOR=y
CONFIG_LWM2M_IPSO_VOLTAGE_SENSOR=y
CONFIG_LWM2M_IPSO_FILLING_SENSOR=y
CONFIG_LWM2M_RESOURCE_DATA_CACHE_SUPPORT=y
CONFIG_LWM2M_UCIFI_SUPPORT=y
CONFIG_LWM2M_UCIFI_LPWAN=y

# VLAN
CONFIG_NET_VLAN=y
CONFIG_NET_VLAN_COUNT=4

# gPTP
CONFIG_NET_GPTP=y
CONFIG_NET_GPTP_STATISTICS=y
CONFIG_NET_GPTP_LOG_LEVEL_DBG=y
CONFIG_NET_GPTP_ANNOUNCE_RECEIPT_TIMEOUT=10
CONFIG_NET_GPTP_GM_CAPABLE=y
CONFIG_NET_GPTP_INIT_LOG_ANNOUNCE_ITV=2
CONFIG_NET_GPTP_INIT_LOG_PDELAY_REQ_ITV=2
CONFIG_NET_GPTP_INIT_LOG_SYNC_ITV=2
CONFIG_NET_GPTP_NEIGHBOR_PROP_DELAY_THR=100000
CONFIG_NET_GPTP_NUM_PORTS=2
CONFIG_NET_GPTP_PATH_TRACE_ELEMENTS=2
CONFIG_NET_GPTP_PROBE_CLOCK_SOURCE_ON_DEMAND=y
CONFIG_NET_GPTP_SYNC_RECEIPT_TIMEOUT=10
CONFIG_NET_GPTP_USE_DEFAULT_CLOCK_UPDATE=y

# PTP
CONFIG_PTP=y

# LLDP
CONFIG_NET_LLDP_CHASSIS_ID_MAC0=0x01
CONFIG_NET_LLDP_CHASSIS_ID_MAC1=0x02
CONFIG_NET_LLDP_CHASSIS_ID_MAC2=0x03
CONFIG_NET_LLDP_CHASSIS_ID_MAC3=0x04
CONFIG_NET_LLDP_CHASSIS_ID_MAC4=0x05
CONFIG_NET_LLDP_CHASSIS_ID_MAC5=0x06
CONFIG_NET_LLDP_CHASSIS_ID=""
CONFIG_NET_LLDP_CHASSIS_ID_SUBTYPE=4
CONFIG_NET_LLDP_END_LLDPDU_TLV_ENABLED=y
CONFIG_NET_LLDP_LOG_LEVEL_DBG=y
CONFIG_NET_LLDP_PORT_ID_MAC0=0x01
CONFIG_NET_LLDP_PORT_ID_MAC1=0x02
CONFIG_NET_LLDP_PORT_ID_MAC2=0x03
CONFIG_NET_LLDP_PORT_ID_MAC3=0x04
CONFIG_NET_LLDP_PORT_ID_MAC4=0x04
CONFIG_NET_LLDP_PORT_ID_MAC5=0x05
CONFIG_NET_LLDP_PORT_ID=""
CONFIG_NET_LLDP_PORT_ID_SUBTYPE=3
CONFIG_NET_LLDP=y
CONFIG_NET_LLDP_TX_HOLD=2
CONFIG_NET_LLDP_TX_INTERVAL=3

# Loopback
CONFIG_NET_DRIVERS=y
CONFIG_NET_LOOPBACK_LOG_LEVEL_DBG=y
CONFIG_NET_LOOPBACK=y

# Sockets
CONFIG_NET_SOCKETS_CAN=y
CONFIG_NET_SOCKETS_DTLS_TIMEOUT=10
CONFIG_NET_SOCKETS_ENABLE_DTLS=y
CONFIG_NET_SOCKETS_LOG_LEVEL_DBG=y
CONFIG_NET_SOCKETS_OFFLOAD=y
CONFIG_NET_SOCKETS_PACKET=y
CONFIG_ZVFS_OPEN_IGNORE_MIN=y
CONFIG_ZVFS_OPEN_MAX=50
CONFIG_ZVFS_POLL_MAX=50
CONFIG_NET_SOCKETS=y
CONFIG_NET_SOCKETS_SOCKOPT_TLS=y
CONFIG_NET_SOCKETS_TLS_MAX_CIPHERSUITES=10
CONFIG_NET_SOCKETS_TLS_MAX_CONTEXTS=10
CONFIG_NET_SOCKETS_TLS_MAX_CREDENTIALS=10
CONFIG_NET_SOCKETS_INET_RAW=y
CONFIG_NET_SOCKETS_OFFLOAD_DISPATCHER=y

# Network interface defaults
CONFIG_NET_DEFAULT_IF_CANBUS_RAW=y
CONFIG_NET_DEFAULT_IF_DUMMY=y
CONFIG_NET_DEFAULT_IF_ETHERNET=y
CONFIG_NET_DEFAULT_IF_FIRST=y
CONFIG_NET_DEFAULT_IF_IEEE802154=y
CONFIG_NET_DEFAULT_IF_OFFLOAD=y

# Traffic class
CONFIG_NET_TC_LOG_LEVEL_DBG=y
CONFIG_NET_TC_MAPPING_SR_CLASS_A_AND_B=y
CONFIG_NET_TC_MAPPING_SR_CLASS_B_ONLY=y
CONFIG_NET_TC_MAPPING_STRICT=y
CONFIG_NET_TC_RX_COUNT=8
CONFIG_NET_TC_TX_COUNT=8

# QEMU
CONFIG_NET_QEMU_ETHERNET=y
CONFIG_NET_QEMU_SLIP=y

# IEEE 802.15.4
CONFIG_NET_DEBUG_L2_IEEE802154_DISPLAY_PACKET_FULL=y
CONFIG_NET_DEBUG_L2_IEEE802154_DISPLAY_PACKET=y
CONFIG_NET_DEBUG_L2_IEEE802154_DISPLAY_PACKET_RX=y
CONFIG_NET_DEBUG_L2_IEEE802154_DISPLAY_PACKET_TX=y

# Shell MQTT backend
CONFIG_LOG=y
CONFIG_SHELL=y
CONFIG_SHELL_BACKEND_MQTT=y
CONFIG_SHELL_MQTT_SERVER_ADDR="www.zephyrproject.org"
CONFIG_SHELL_MQTT_SERVER_PORT=1884
CONFIG_SHELL_MQTT_SERVER_USERNAME="test"
CONFIG_SHELL_MQTT_SERVER_PASSWORD="test"
CONFIG_SHELL_MQTT_INIT_LOG_LEVEL_ERR=y

# OpenThread needs some extra options and needs specific hardware
# and qemu is not supported
#CONFIG_NET_L2_OPENTHREAD=y
#CONFIG_FLASH=y
#CONFIG_FLASH_PAGE_LAYOUT=y
#CONFIG_FLASH_HAS_PAGE_LAYOUT=y
#CONFIG_NVS=y
#CONFIG_CPP=y
#CONFIG_REBOOT=y

# IEEE 802.15.4, these cannot be compiled atm as qemu does not support these
#CONFIG_IEEE802154_CC1200_CCA_THRESHOLD=10
#CONFIG_IEEE802154_CC1200_INIT_PRIO=90
#CONFIG_IEEE802154_CC1200_MAC4=0x01
#CONFIG_IEEE802154_CC1200_MAC5=0x02
#CONFIG_IEEE802154_CC1200_MAC6=0x03
#CONFIG_IEEE802154_CC1200_MAC7=0x04
#CONFIG_IEEE802154_CC1200_PKTCFG0=0x20
#CONFIG_IEEE802154_CC1200_PKTCFG1=0x03
#CONFIG_IEEE802154_CC1200_PKTCFG2=0x00
#CONFIG_IEEE802154_CC1200_RANDOM_MAC=n
#CONFIG_IEEE802154_CC1200_RFEND_CFG0=0x00
#CONFIG_IEEE802154_CC1200_RFEND_CFG1=0x3F
#CONFIG_IEEE802154_CC1200_RF_PRESET=y
#CONFIG_IEEE802154_CC1200_RF_SET_0=y
#CONFIG_IEEE802154_CC1200_RF_SET_1=y
#CONFIG_IEEE802154_CC1200_RF_SET_2=y
#CONFIG_IEEE802154_CC1200_RSSI_OFFSET=1
#CONFIG_IEEE802154_CC1200=y
#CONFIG_IEEE802154_CC1200_RX_STACK_SIZE=1024
#CONFIG_IEEE802154_CC1200_SETTLING_CFG=0x03
#CONFIG_IEEE802154_CC1200_XOSC=1

#CONFIG_IEEE802154_CC2520_CRYPTO_INIT_PRIO=90
#CONFIG_IEEE802154_CC2520_CRYPTO=y
#CONFIG_IEEE802154_CC2520_INIT_PRIO=90
#CONFIG_IEEE802154_CC2520_MAC4=0x01
#CONFIG_IEEE802154_CC2520_MAC5=0x02
#CONFIG_IEEE802154_CC2520_MAC6=0x03
#CONFIG_IEEE802154_CC2520_MAC7=0x04
#CONFIG_IEEE802154_CC2520_RANDOM_MAC=n
#CONFIG_IEEE802154_CC2520=y
#CONFIG_IEEE802154_CC2520_RX_STACK_SIZE=1024

#CONFIG_IEEE802154_DRIVER_LOG_LEVEL_DBG=y
#CONFIG_IEEE802154_KW41Z_INIT_PRIO=90
#CONFIG_IEEE802154_KW41Z=y

#CONFIG_SPI=y
#CONFIG_IEEE802154_MCR20A_INIT_PRIO=90
#CONFIG_IEEE802154_MCR20A=y
#CONFIG_IEEE802154_MCR20A_RX_STACK_SIZE=1024

#CONFIG_IEEE802154_NRF5_INIT_PRIO=90
#CONFIG_IEEE802154_NRF5=n
#CONFIG_IEEE802154_NRF5_RX_STACK_SIZE=1024

#CONFIG_IEEE802154_RAW_MODE=n
#CONFIG_IEEE802154_UPIPE_HW_FILTER=y
#CONFIG_IEEE802154_UPIPE_MAC4=0x01
#CONFIG_IEEE802154_UPIPE_MAC5=0x02
#CONFIG_IEEE802154_UPIPE_MAC6=0x03
#CONFIG_IEEE802154_UPIPE_MAC7=0x04
#CONFIG_IEEE802154_UPIPE_RANDOM_MAC=n
#CONFIG_IEEE802154_UPIPE=n

# The following options are not used as we have enabled debug log level
# for them. But they need to exist in this file so that
# the ./check_net_options.sh script does not complain about them.
#CONFIG_DNS_RESOLVER_LOG_LEVEL_DEFAULT
#CONFIG_DNS_RESOLVER_LOG_LEVEL_ERR
#CONFIG_DNS_RESOLVER_LOG_LEVEL_INF
#CONFIG_DNS_RESOLVER_LOG_LEVEL_OFF
#CONFIG_DNS_RESOLVER_LOG_LEVEL_WRN
#CONFIG_IEEE802154_DRIVER_LOG_LEVEL_ERR
#CONFIG_IEEE802154_DRIVER_LOG_LEVEL_INF
#CONFIG_IEEE802154_DRIVER_LOG_LEVEL_OFF
#CONFIG_IEEE802154_DRIVER_LOG_LEVEL_WRN
#CONFIG_NET_6LO_LOG_LEVEL_DEFAULT
#CONFIG_NET_6LO_LOG_LEVEL_ERR
#CONFIG_NET_6LO_LOG_LEVEL_INF
#CONFIG_NET_6LO_LOG_LEVEL_OFF
#CONFIG_NET_6LO_LOG_LEVEL_WRN
#CONFIG_NET_ARP_LOG_LEVEL_DEFAULT
#CONFIG_NET_ARP_LOG_LEVEL_ERR
#CONFIG_NET_ARP_LOG_LEVEL_INF
#CONFIG_NET_ARP_LOG_LEVEL_OFF
#CONFIG_NET_ARP_LOG_LEVEL_WRN
#CONFIG_NET_BUF_LOG_LEVEL_ERR
#CONFIG_NET_BUF_LOG_LEVEL_INF
#CONFIG_NET_BUF_LOG_LEVEL_OFF
#CONFIG_NET_BUF_LOG_LEVEL_WRN
#CONFIG_NET_CONFIG_LOG_LEVEL_DEFAULT
#CONFIG_NET_CONFIG_LOG_LEVEL_ERR
#CONFIG_NET_CONFIG_LOG_LEVEL_INF
#CONFIG_NET_CONFIG_LOG_LEVEL_OFF
#CONFIG_NET_CONFIG_LOG_LEVEL_WRN
#CONFIG_NET_CONN_LOG_LEVEL_DEFAULT
#CONFIG_NET_CONN_LOG_LEVEL_ERR
#CONFIG_NET_CONN_LOG_LEVEL_INF
#CONFIG_NET_CONN_LOG_LEVEL_OFF
#CONFIG_NET_CONN_LOG_LEVEL_WRN
#CONFIG_NET_CONTEXT_LOG_LEVEL_DEFAULT
#CONFIG_NET_CONTEXT_LOG_LEVEL_ERR
#CONFIG_NET_CONTEXT_LOG_LEVEL_INF
#CONFIG_NET_CONTEXT_LOG_LEVEL_OFF
#CONFIG_NET_CONTEXT_LOG_LEVEL_WRN
#CONFIG_NET_CORE_LOG_LEVEL_DEFAULT
#CONFIG_NET_CORE_LOG_LEVEL_ERR
#CONFIG_NET_CORE_LOG_LEVEL_INF
#CONFIG_NET_CORE_LOG_LEVEL_OFF
#CONFIG_NET_CORE_LOG_LEVEL_WRN
#CONFIG_NET_DHCPV4_LOG_LEVEL_DEFAULT
#CONFIG_NET_DHCPV4_LOG_LEVEL_ERR
#CONFIG_NET_DHCPV4_LOG_LEVEL_INF
#CONFIG_NET_DHCPV4_LOG_LEVEL_OFF
#CONFIG_NET_DHCPV4_LOG_LEVEL_WRN
#CONFIG_NET_GPTP_LOG_LEVEL_DEFAULT
#CONFIG_NET_GPTP_LOG_LEVEL_ERR
#CONFIG_NET_GPTP_LOG_LEVEL_INF
#CONFIG_NET_GPTP_LOG_LEVEL_OFF
#CONFIG_NET_GPTP_LOG_LEVEL_WRN
#CONFIG_NET_HOSTNAME_LOG_LEVEL_DEFAULT
#CONFIG_NET_HOSTNAME_LOG_LEVEL_ERR
#CONFIG_NET_HOSTNAME_LOG_LEVEL_INF
#CONFIG_NET_HOSTNAME_LOG_LEVEL_OFF
#CONFIG_NET_HOSTNAME_LOG_LEVEL_WRN
#CONFIG_NET_ICMPV4_LOG_LEVEL_DEFAULT
#CONFIG_NET_ICMPV4_LOG_LEVEL_ERR
#CONFIG_NET_ICMPV4_LOG_LEVEL_INF
#CONFIG_NET_ICMPV4_LOG_LEVEL_OFF
#CONFIG_NET_ICMPV4_LOG_LEVEL_WRN
#CONFIG_NET_ICMPV6_LOG_LEVEL_DEFAULT
#CONFIG_NET_ICMPV6_LOG_LEVEL_ERR
#CONFIG_NET_ICMPV6_LOG_LEVEL_INF
#CONFIG_NET_ICMPV6_LOG_LEVEL_OFF
#CONFIG_NET_ICMPV6_LOG_LEVEL_WRN
#CONFIG_NET_IF_LOG_LEVEL_DEFAULT
#CONFIG_NET_IF_LOG_LEVEL_ERR
#CONFIG_NET_IF_LOG_LEVEL_INF
#CONFIG_NET_IF_LOG_LEVEL_OFF
#CONFIG_NET_IF_LOG_LEVEL_WRN
#CONFIG_NET_IPV4_AUTO_LOG_LEVEL_DEFAULT
#CONFIG_NET_IPV4_AUTO_LOG_LEVEL_ERR
#CONFIG_NET_IPV4_AUTO_LOG_LEVEL_INF
#CONFIG_NET_IPV4_AUTO_LOG_LEVEL_OFF
#CONFIG_NET_IPV4_AUTO_LOG_LEVEL_WRN
#CONFIG_NET_IPV4_LOG_LEVEL_DEFAULT
#CONFIG_NET_IPV4_LOG_LEVEL_ERR
#CONFIG_NET_IPV4_LOG_LEVEL_INF
#CONFIG_NET_IPV4_LOG_LEVEL_OFF
#CONFIG_NET_IPV4_LOG_LEVEL_WRN
#CONFIG_NET_IPV6_LOG_LEVEL_DEFAULT
#CONFIG_NET_IPV6_LOG_LEVEL_ERR
#CONFIG_NET_IPV6_LOG_LEVEL_INF
#CONFIG_NET_IPV6_LOG_LEVEL_OFF
#CONFIG_NET_IPV6_LOG_LEVEL_WRN
#CONFIG_NET_IPV6_ND_LOG_LEVEL_DEFAULT
#CONFIG_NET_IPV6_ND_LOG_LEVEL_ERR
#CONFIG_NET_IPV6_ND_LOG_LEVEL_INF
#CONFIG_NET_IPV6_ND_LOG_LEVEL_OFF
#CONFIG_NET_IPV6_ND_LOG_LEVEL_WRN
#CONFIG_NET_IPV6_NBR_CACHE_LOG_LEVEL_DEFAULT
#CONFIG_NET_IPV6_NBR_CACHE_LOG_LEVEL_ERR
#CONFIG_NET_IPV6_NBR_CACHE_LOG_LEVEL_INF
#CONFIG_NET_IPV6_NBR_CACHE_LOG_LEVEL_OFF
#CONFIG_NET_IPV6_NBR_CACHE_LOG_LEVEL_WRN
#CONFIG_NET_L2_ETHERNET_LOG_LEVEL_DEFAULT
#CONFIG_NET_L2_ETHERNET_LOG_LEVEL_ERR
#CONFIG_NET_L2_ETHERNET_LOG_LEVEL_INF
#CONFIG_NET_L2_ETHERNET_LOG_LEVEL_OFF
#CONFIG_NET_L2_ETHERNET_LOG_LEVEL_WRN
#CONFIG_NET_L2_IEEE802154_LOG_LEVEL_DEFAULT
#CONFIG_NET_L2_IEEE802154_LOG_LEVEL_ERR
#CONFIG_NET_L2_IEEE802154_LOG_LEVEL_INF
#CONFIG_NET_L2_IEEE802154_LOG_LEVEL_OFF
#CONFIG_NET_L2_IEEE802154_LOG_LEVEL_WRN
#CONFIG_NET_L2_WIFI_MGMT_LOG_LEVEL_DEFAULT
#CONFIG_NET_L2_WIFI_MGMT_LOG_LEVEL_ERR
#CONFIG_NET_L2_WIFI_MGMT_LOG_LEVEL_INF
#CONFIG_NET_L2_WIFI_MGMT_LOG_LEVEL_OFF
#CONFIG_NET_L2_WIFI_MGMT_LOG_LEVEL_WRN
#CONFIG_NET_LLDP_LOG_LEVEL_DEFAULT
#CONFIG_NET_LLDP_LOG_LEVEL_ERR
#CONFIG_NET_LLDP_LOG_LEVEL_INF
#CONFIG_NET_LLDP_LOG_LEVEL_OFF
#CONFIG_NET_LLDP_LOG_LEVEL_WRN
#CONFIG_NET_LOOPBACK_LOG_LEVEL_DEFAULT
#CONFIG_NET_LOOPBACK_LOG_LEVEL_ERR
#CONFIG_NET_LOOPBACK_LOG_LEVEL_INF
#CONFIG_NET_LOOPBACK_LOG_LEVEL_OFF
#CONFIG_NET_LOOPBACK_LOG_LEVEL_WRN
#CONFIG_NET_MGMT_EVENT_LOG_LEVEL_DEFAULT
#CONFIG_NET_MGMT_EVENT_LOG_LEVEL_ERR
#CONFIG_NET_MGMT_EVENT_LOG_LEVEL_INF
#CONFIG_NET_MGMT_EVENT_LOG_LEVEL_OFF
#CONFIG_NET_MGMT_EVENT_LOG_LEVEL_WRN
#CONFIG_NET_OFFLOAD_LOG_LEVEL_DEFAULT
#CONFIG_NET_OFFLOAD_LOG_LEVEL_ERR
#CONFIG_NET_OFFLOAD_LOG_LEVEL_INF
#CONFIG_NET_OFFLOAD_LOG_LEVEL_OFF
#CONFIG_NET_OFFLOAD_LOG_LEVEL_WRN
#CONFIG_NET_PKT_LOG_LEVEL_DEFAULT
#CONFIG_NET_PKT_LOG_LEVEL_ERR
#CONFIG_NET_PKT_LOG_LEVEL_INF
#CONFIG_NET_PKT_LOG_LEVEL_OFF
#CONFIG_NET_PKT_LOG_LEVEL_WRN
#CONFIG_NET_PROMISC_LOG_LEVEL_DEFAULT
#CONFIG_NET_PROMISC_LOG_LEVEL_ERR
#CONFIG_NET_PROMISC_LOG_LEVEL_INF
#CONFIG_NET_PROMISC_LOG_LEVEL_OFF
#CONFIG_NET_PROMISC_LOG_LEVEL_WRN
#CONFIG_NET_IPV6_ROUTE_LOG_LEVEL_DEFAULT
#CONFIG_NET_IPV6_ROUTE_LOG_LEVEL_ERR
#CONFIG_NET_IPV6_ROUTE_LOG_LEVEL_INF
#CONFIG_NET_IPV6_ROUTE_LOG_LEVEL_OFF
#CONFIG_NET_IPV6_ROUTE_LOG_LEVEL_WRN
#CONFIG_NET_SOCKETS_LOG_LEVEL_DEFAULT
#CONFIG_NET_SOCKETS_LOG_LEVEL_ERR
#CONFIG_NET_SOCKETS_LOG_LEVEL_INF
#CONFIG_NET_SOCKETS_LOG_LEVEL_OFF
#CONFIG_NET_SOCKETS_LOG_LEVEL_WRN
#CONFIG_NET_STATISTICS_LOG_LEVEL_DEFAULT
#CONFIG_NET_STATISTICS_LOG_LEVEL_ERR
#CONFIG_NET_STATISTICS_LOG_LEVEL_INF
#CONFIG_NET_STATISTICS_LOG_LEVEL_OFF
#CONFIG_NET_STATISTICS_LOG_LEVEL_WRN
#CONFIG_NET_TC_LOG_LEVEL_DEFAULT
#CONFIG_NET_TC_LOG_LEVEL_ERR
#CONFIG_NET_TC_LOG_LEVEL_INF
#CONFIG_NET_TC_LOG_LEVEL_OFF
#CONFIG_NET_TC_LOG_LEVEL_WRN
#CONFIG_NET_TCP_LOG_LEVEL_DEFAULT
#CONFIG_NET_TCP_LOG_LEVEL_ERR
#CONFIG_NET_TCP_LOG_LEVEL_INF
#CONFIG_NET_TCP_LOG_LEVEL_OFF
#CONFIG_NET_TCP_LOG_LEVEL_WRN
#CONFIG_NET_TRICKLE_LOG_LEVEL_DEFAULT
#CONFIG_NET_TRICKLE_LOG_LEVEL_ERR
#CONFIG_NET_TRICKLE_LOG_LEVEL_INF
#CONFIG_NET_TRICKLE_LOG_LEVEL_OFF
#CONFIG_NET_TRICKLE_LOG_LEVEL_WRN
#CONFIG_NET_UDP_LOG_LEVEL_DEFAULT
#CONFIG_NET_UDP_LOG_LEVEL_ERR
#CONFIG_NET_UDP_LOG_LEVEL_INF
#CONFIG_NET_UDP_LOG_LEVEL_OFF
#CONFIG_NET_UDP_LOG_LEVEL_WRN
#CONFIG_NET_UTILS_LOG_LEVEL_DEFAULT
#CONFIG_NET_UTILS_LOG_LEVEL_ERR
#CONFIG_NET_UTILS_LOG_LEVEL_INF
#CONFIG_NET_UTILS_LOG_LEVEL_OFF
#CONFIG_NET_UTILS_LOG_LEVEL_WRN

# syslog backend options
CONFIG_LOG_BACKEND_NET=y
CONFIG_LOG_BACKEND_NET_SERVER="192.0.2.2:1514"
CONFIG_LOG_BACKEND_NET_RFC5424_STRUCTURED_DATA=y
CONFIG_LOG_BACKEND_NET_RFC5424_SDATA_SEQID=y
CONFIG_LOG_BACKEND_NET_RFC5424_SDATA_TZKNOWN=y
CONFIG_LOG_BACKEND_NET_RFC5424_SDATA_ISSYNCED=y
CONFIG_LOG_BACKEND_NET_RFC5424_SDATA_UPTIME=y
CONFIG_LOG_BACKEND_NET_RFC5424_SDATA_SOFTWARE=y
CONFIG_LOG_BACKEND_NET_RFC5424_SDATA_SOFTWARE_VERSION=y
CONFIG_LOG_BACKEND_NET_RFC5424_SDATA_SOFTWARE_VALUE="foo-bar"
CONFIG_LOG_BACKEND_NET_SERVER="tcp://[2001:db8::2]:1514"
#CONFIG_LOG_MODE_IMMEDIATE=n
#CONFIG_LOG_MODE_MINIMAL=n
CONFIG_LOG_MODE_DEFERRED=y
CONFIG_LOG_FRONTEND_ONLY=n

CONFIG_MQTT_SN_LIB=y
CONFIG_MQTT_SN_TRANSPORT_UDP=y

CONFIG_COAP=y
CONFIG_COAP_SERVER=y
CONFIG_COAP_CLIENT=y

CONFIG_HTTP_CLIENT=y
CONFIG_NET_SHELL_HTTP_CLIENT_SUPPORTED=y
CONFIG_NET_SHELL_HTTP_CLIENT_URL_LEN=128

CONFIG_SHELL_BACKEND_TELNET=y

CONFIG_TFTP_LIB=y
CONFIG_NET_PKT_FILTER=y

CONFIG_NET_LATMON=y
CONFIG_NET_ZPERF=y
CONFIG_NET_ZPERF_SERVER=y
```

## src/main.c
```c
/* main.c - Application main entry point */

/* We are just testing that this program compiles ok with all possible
 * network related Kconfig options enabled.
 */

/*
 * Copyright (c) 2017 Intel Corporation
 *
 * SPDX-License-Identifier: Apache-2.0
 */

#include <zephyr/logging/log.h>
LOG_MODULE_REGISTER(net_test, LOG_LEVEL_DBG);

#include <zephyr/ztest.h>

#include <zephyr/net/net_if.h>
#include <zephyr/net/net_pkt.h>
#include <zephyr/net/dummy.h>
#include <zephyr/net/offloaded_netdev.h>


/* Create blank dummy and offloaded APIs */
static DEVICE_API(offloaded_if, offload_dev_api) = {};
static DEVICE_API(dummy, dummy_dev_api) = {};
static struct offload_context {
	void *none;
} offload_context_data = {
	.none = NULL
};

/* Create blank dummy and offloaded net devices */
NET_DEVICE_INIT(dummy_dev, "dummy_dev",
		NULL, NULL,
		NULL, NULL,
		CONFIG_KERNEL_INIT_PRIORITY_DEFAULT,
		&dummy_dev_api,
		DUMMY_L2, NET_L2_GET_CTX_TYPE(DUMMY_L2), 0);

NET_DEVICE_OFFLOAD_INIT(net_offload, "net_offload",
			NULL, NULL,
			&offload_context_data, NULL,
			CONFIG_KERNEL_INIT_PRIORITY_DEFAULT,
			&offload_dev_api, 0);

ZTEST(net_compile_all_test, test_ok)
{
	zassert_true(true, "This test should never fail");
}

ZTEST_SUITE(net_compile_all_test, NULL, NULL, NULL, NULL, NULL);
```
