## CMakeLists.txt
```
# SPDX-License-Identifier: Apache-2.0

cmake_minimum_required(VERSION 3.28.0)
find_package(Zephyr REQUIRED HINTS $ENV{ZEPHYR_BASE})
project(test_nsos_socket)

target_sources(app PRIVATE src/main.c)
target_sources_ifdef(CONFIG_NET_SOCKETS_SOCKOPT_TLS app PRIVATE src/tls.c)
```

## prj.conf
```kconfig
CONFIG_NETWORKING=y
CONFIG_NET_IPV4=y
CONFIG_NET_IPV6=n
CONFIG_NET_DRIVERS=y
CONFIG_NET_SOCKETS=y
CONFIG_NET_SOCKETS_OFFLOAD=y
CONFIG_NET_NATIVE_OFFLOADED_SOCKETS=y
CONFIG_ETH_NATIVE_TAP=n
CONFIG_ZTEST=y
```

## overlay-tls.conf
```kconfig
CONFIG_NET_SOCKETS_SOCKOPT_TLS=y
CONFIG_NET_SOCKETS_TLS_MAX_CONTEXTS=2
CONFIG_TLS_CREDENTIALS=y
CONFIG_MBEDTLS=y
CONFIG_MBEDTLS_ENABLE_HEAP=y
CONFIG_MBEDTLS_HEAP_SIZE=30000
CONFIG_MBEDTLS_CIPHERSUITE_TLS_PSK_WITH_AES_256_CBC_SHA384=y
CONFIG_TEST_RANDOM_GENERATOR=y
CONFIG_ZTEST_STACK_SIZE=4096
```

## src/main.c
```c
/*
 * Copyright (c) 2026 Embeint Inc
 *
 * SPDX-License-Identifier: Apache-2.0
 */

#include <zephyr/kernel.h>
#include <zephyr/net/socket.h>
#include <zephyr/ztest.h>

#define STACK_SIZE 4096

K_THREAD_STACK_DEFINE(closed_poll_stack, STACK_SIZE);
K_THREAD_STACK_DEFINE(other_poll_stack, STACK_SIZE);

static struct k_thread closed_poll_thread;
static struct k_thread other_poll_thread;

static int udp_socket(void)
{
	struct net_sockaddr_in addr = {
		.sin_family = NET_AF_INET,
		.sin_addr = NET_INADDR_LOOPBACK_INIT,
	};
	int sock;

	sock = zsock_socket(NET_AF_INET, NET_SOCK_DGRAM, NET_IPPROTO_UDP);
	zassert_true(sock >= 0, "socket() failed (%d)", errno);
	zassert_ok(zsock_bind(sock, (struct net_sockaddr *)&addr, sizeof(addr)));

	return sock;
}

static void poll_in(void *p1, void *p2, void *p3)
{
	struct zsock_pollfd pfd = {
		.fd = POINTER_TO_INT(p1),
		.events = ZSOCK_POLLIN,
	};

	ARG_UNUSED(p3);

	(void)zsock_poll(&pfd, 1, POINTER_TO_INT(p2));
}

/*
 * Replace a socket while another thread polls it, as the DNS resolver does
 * with CONFIG_DNS_RESOLVER_RANDOMIZE_SOURCE_PORT. The replacement gets the
 * same descriptor numbers and, from the host allocator, the same memory as the
 * closed socket. A second poll finishing first must not touch the closed
 * socket's poll registration through that memory, and the first poll must
 * still return cleanly.
 */
ZTEST(nsos, test_close_while_polled)
{
	int closed, other, replacement;

	closed = udp_socket();
	other = udp_socket();

	/* The poll on the socket to be closed is registered first */
	k_thread_create(&closed_poll_thread, closed_poll_stack, STACK_SIZE, poll_in,
			INT_TO_POINTER(closed), INT_TO_POINTER(-1), NULL,
			K_PRIO_PREEMPT(2), 0, K_NO_WAIT);
	k_sleep(K_MSEC(10));
	k_thread_create(&other_poll_thread, other_poll_stack, STACK_SIZE, poll_in,
			INT_TO_POINTER(other), INT_TO_POINTER(50), NULL,
			K_PRIO_PREEMPT(1), 0, K_NO_WAIT);
	k_sleep(K_MSEC(10));

	/*
	 * Let the other poll time out before either poller runs, so that the
	 * higher priority other poller completes its poll first.
	 */
	k_sched_lock();
	zassert_ok(zsock_close(closed));
	replacement = udp_socket();
	k_busy_wait(100 * USEC_PER_MSEC);
	k_sched_unlock();

	zassert_ok(k_thread_join(&other_poll_thread, K_SECONDS(1)));
	zassert_ok(k_thread_join(&closed_poll_thread, K_SECONDS(1)));

	zassert_ok(zsock_close(replacement));
	zassert_ok(zsock_close(other));
}

ZTEST_SUITE(nsos, NULL, NULL, NULL, NULL, NULL);
```

## src/tls.c
```c
/*
 * Copyright (c) 2026 Elyorbek Kholikov
 *
 * SPDX-License-Identifier: Apache-2.0
 */

#include <string.h>

#include <zephyr/kernel.h>
#include <zephyr/net/socket.h>
#include <zephyr/net/tls_credentials.h>
#include <zephyr/ztest.h>

#include <mbedtls/ssl_ciphersuites.h>

#define PSK_TAG 1

static const unsigned char psk[] = {0x01, 0x01, 0x02, 0x03, 0x04, 0x05, 0x06, 0x07,
				    0x08, 0x09, 0x0a, 0x0b, 0x0c, 0x0d, 0x0e, 0x0f};
static const char psk_id[] = "test_identity";

static void config_psk(int sock)
{
	sec_tag_t sec_tag_list[] = {PSK_TAG};
	const int cipher_list[] = {
		MBEDTLS_TLS_PSK_WITH_AES_256_CBC_SHA384,
	};

	zassert_ok(zsock_setsockopt(sock, ZSOCK_SOL_TLS, ZSOCK_TLS_SEC_TAG_LIST, sec_tag_list,
				    sizeof(sec_tag_list)));
	zassert_ok(zsock_setsockopt(sock, ZSOCK_SOL_TLS, ZSOCK_TLS_CIPHERSUITE_LIST, cipher_list,
				    sizeof(cipher_list)));
}

/* A listening TLS socket on a free port of the host's loopback interface that
 * leaves the handshake of the sockets it accepts to the socket calls.
 */
static int deferred_handshake_server(struct net_sockaddr_in *addr)
{
	net_socklen_t addrlen = sizeof(*addr);
	int optval = 0;
	int sock;

	*addr = (struct net_sockaddr_in){
		.sin_family = NET_AF_INET,
		.sin_addr = NET_INADDR_LOOPBACK_INIT,
	};

	sock = zsock_socket(NET_AF_INET, NET_SOCK_STREAM, NET_IPPROTO_TLS_1_2);
	zassert_true(sock >= 0, "socket() failed (%d)", errno);
	config_psk(sock);
	zassert_ok(zsock_setsockopt(sock, ZSOCK_SOL_TLS, ZSOCK_TLS_HANDSHAKE_ON_ACCEPT, &optval,
				    sizeof(optval)));
	zassert_ok(zsock_bind(sock, (struct net_sockaddr *)addr, sizeof(*addr)));
	zassert_ok(zsock_listen(sock, 1));
	zassert_ok(zsock_getsockname(sock, (struct net_sockaddr *)addr, &addrlen));

	return sock;
}

/*
 * poll() on a socket whose handshake is pending must not leave the host
 * descriptor registered when it returns: the next poll() registers it again,
 * and the host refuses a second registration.
 */
ZTEST(nsos_tls, test_deferred_handshake_poll_silent_client)
{
	struct net_sockaddr_in addr;
	struct zsock_pollfd pfd;
	int server, client, accepted;

	server = deferred_handshake_server(&addr);

	/* A client that connects at TCP level and sends nothing */
	client = zsock_socket(NET_AF_INET, NET_SOCK_STREAM, NET_IPPROTO_TCP);
	zassert_true(client >= 0, "socket() failed (%d)", errno);
	zassert_ok(zsock_connect(client, (struct net_sockaddr *)&addr, sizeof(addr)));

	accepted = zsock_accept(server, NULL, NULL);
	zassert_true(accepted >= 0, "accept() failed (%d)", errno);

	pfd.fd = accepted;
	pfd.events = ZSOCK_POLLIN;

	for (int i = 0; i < 3; i++) {
		zassert_equal(zsock_poll(&pfd, 1, 10), 0, "Unexpected poll() event");
	}

	zassert_ok(zsock_close(accepted));
	zassert_ok(zsock_close(client));
	zassert_ok(zsock_close(server));
}

static void *nsos_tls_setup(void)
{
	zassert_ok(tls_credential_add(PSK_TAG, TLS_CREDENTIAL_PSK, psk, sizeof(psk)));
	zassert_ok(tls_credential_add(PSK_TAG, TLS_CREDENTIAL_PSK_ID, psk_id, strlen(psk_id)));

	return NULL;
}

ZTEST_SUITE(nsos_tls, NULL, nsos_tls_setup, NULL, NULL, NULL);
```
