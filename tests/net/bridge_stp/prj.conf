## CMakeLists.txt
```
# SPDX-License-Identifier: Apache-2.0

cmake_minimum_required(VERSION 3.28.0)
find_package(Zephyr REQUIRED HINTS $ENV{ZEPHYR_BASE})
project(bridge_stp)

target_include_directories(app PRIVATE
  ${ZEPHYR_BASE}/subsys/net/l2/ethernet
  ${ZEPHYR_BASE}/subsys/net/l2/ethernet/bridge/stp
)
file(GLOB app_sources src/*.c)
target_sources(app PRIVATE ${app_sources})
```

## prj.conf
```kconfig
CONFIG_ZTEST=y
CONFIG_NETWORKING=y
CONFIG_NET_TEST=y
CONFIG_NET_IPV4=n
CONFIG_NET_IPV6=n
CONFIG_NET_L2_ETHERNET=y
CONFIG_NET_ETHERNET_BRIDGE=y
CONFIG_NET_ETHERNET_BRIDGE_STP=y
CONFIG_NET_ETHERNET_BRIDGE_COUNT=3
CONFIG_NET_ETHERNET_BRIDGE_ETH_INTERFACE_COUNT=3
CONFIG_NET_ETHERNET_BRIDGE_PREFIX_MAC=y
CONFIG_NET_PKT_RX_COUNT=40
CONFIG_NET_PKT_TX_COUNT=40
CONFIG_NET_BUF_RX_COUNT=40
CONFIG_NET_BUF_TX_COUNT=40
CONFIG_NET_LOG=y
CONFIG_ENTROPY_GENERATOR=y
CONFIG_TEST_RANDOM_GENERATOR=y
```

## src/bpdu.c
```c
/*
 * SPDX-FileCopyrightText: Copyright The Zephyr Project Contributors
 * SPDX-License-Identifier: Apache-2.0
 */

#include <errno.h>
#include <string.h>

#include <zephyr/ztest.h>

#include "rstp_internal.h"

/* Reference BPDUs built with Scapy and checked with the tcpdump STP printer:
 *
 * STP 802.1d, Config, Flags [Topology change, Topology change ACK],
 *   bridge-id 9000.66:77:88:99:aa:bb.8002, length 35
 *   message-age 1.00s, max-age 20.00s, hello-time 2.00s, forwarding-delay 15.00s
 *   root-id 8000.00:11:22:33:44:55, root-pathcost 4
 */
static const uint8_t config_bpdu[] = {
	0x00, 0x00, 0x00, 0x00, 0x81, 0x80, 0x00, 0x00, 0x11, 0x22, 0x33, 0x44,
	0x55, 0x00, 0x00, 0x00, 0x04, 0x90, 0x00, 0x66, 0x77, 0x88, 0x99, 0xaa,
	0xbb, 0x80, 0x02, 0x01, 0x00, 0x14, 0x00, 0x02, 0x00, 0x0f, 0x00,
};

/* STP 802.1w, Rapid STP, Flags [Proposal, Learn, Forward, Agreement],
 *   bridge-id 8000.66:77:88:99:aa:bb.8001, length 36
 *   message-age 2.00s, max-age 20.00s, hello-time 2.00s, forwarding-delay 15.00s
 *   root-id 1000.00:11:22:33:44:55, root-pathcost 200000, port-role Designated
 */
static const uint8_t rst_bpdu[] = {
	0x00, 0x00, 0x02, 0x02, 0x7e, 0x10, 0x00, 0x00, 0x11, 0x22, 0x33, 0x44,
	0x55, 0x00, 0x03, 0x0d, 0x40, 0x80, 0x00, 0x66, 0x77, 0x88, 0x99, 0xaa,
	0xbb, 0x80, 0x01, 0x02, 0x00, 0x14, 0x00, 0x02, 0x00, 0x0f, 0x00, 0x00,
};

/* STP 802.1d, Topology Change */
static const uint8_t tcn_bpdu[] = {0x00, 0x00, 0x00, 0x80};

static const struct eth_rstp_bpdu config_decoded = {
	.type = ETH_RSTP_BPDU_CONFIG,
	.flags = ETH_RSTP_FLAG_TC | ETH_RSTP_FLAG_TC_ACK,
	.root_id = 0x8000001122334455ULL,
	.root_path_cost = 4U,
	.bridge_id = 0x900066778899aabbULL,
	.port_id = 0x8002U,
	.times = {.message_age = 1U, .max_age = 20U, .hello_time = 2U, .forward_delay = 15U},
};

static const struct eth_rstp_bpdu rst_decoded = {
	.type = ETH_RSTP_BPDU_RST,
	.flags = ETH_RSTP_FLAG_PROPOSAL |
		 (ETH_RSTP_BPDU_ROLE_DESIGNATED << ETH_RSTP_FLAG_ROLE_SHIFT) |
		 ETH_RSTP_FLAG_LEARNING | ETH_RSTP_FLAG_FORWARDING | ETH_RSTP_FLAG_AGREEMENT,
	.root_id = 0x1000001122334455ULL,
	.root_path_cost = 200000U,
	.bridge_id = 0x800066778899aabbULL,
	.port_id = 0x8001U,
	.times = {.message_age = 2U, .max_age = 20U, .hello_time = 2U, .forward_delay = 15U},
};

static void expect_bpdu(const struct eth_rstp_bpdu *got, const struct eth_rstp_bpdu *want)
{
	zexpect_equal(got->type, want->type);
	zexpect_equal(got->flags, want->flags, "flags 0x%02x", got->flags);
	zexpect_equal(got->root_id, want->root_id);
	zexpect_equal(got->root_path_cost, want->root_path_cost);
	zexpect_equal(got->bridge_id, want->bridge_id);
	zexpect_equal(got->port_id, want->port_id);
	zexpect_equal(got->times.message_age, want->times.message_age);
	zexpect_equal(got->times.max_age, want->times.max_age);
	zexpect_equal(got->times.hello_time, want->times.hello_time);
	zexpect_equal(got->times.forward_delay, want->times.forward_delay);
}

ZTEST(rstp_bpdu, test_decode_config)
{
	struct eth_rstp_bpdu bpdu;

	zassert_ok(eth_rstp_bpdu_decode(config_bpdu, sizeof(config_bpdu), &bpdu));
	expect_bpdu(&bpdu, &config_decoded);
}

ZTEST(rstp_bpdu, test_decode_rst)
{
	struct eth_rstp_bpdu bpdu;

	zassert_ok(eth_rstp_bpdu_decode(rst_bpdu, sizeof(rst_bpdu), &bpdu));
	expect_bpdu(&bpdu, &rst_decoded);
}

ZTEST(rstp_bpdu, test_decode_tcn)
{
	struct eth_rstp_bpdu bpdu;
	uint8_t buf[sizeof(config_bpdu)];

	zassert_ok(eth_rstp_bpdu_decode(tcn_bpdu, sizeof(tcn_bpdu), &bpdu));
	zexpect_equal(bpdu.type, ETH_RSTP_BPDU_TCN);

	/* 14.5 b) checks neither the version nor the octets after the fourth */
	memcpy(buf, config_bpdu, sizeof(buf));
	buf[2] = 0x05;
	buf[3] = 0x80;
	zassert_ok(eth_rstp_bpdu_decode(buf, sizeof(buf), &bpdu));
	zexpect_equal(bpdu.type, ETH_RSTP_BPDU_TCN);
}

/* Flags not defined for the BPDU type are ignored on receipt (14.4 b to g) */
ZTEST(rstp_bpdu, test_decode_ignores_undefined_flags)
{
	struct eth_rstp_bpdu bpdu;
	uint8_t buf[sizeof(rst_bpdu)];

	memcpy(buf, config_bpdu, sizeof(config_bpdu));
	buf[4] = 0xff;
	zassert_ok(eth_rstp_bpdu_decode(buf, sizeof(config_bpdu), &bpdu));
	zexpect_equal(bpdu.flags, ETH_RSTP_FLAG_TC | ETH_RSTP_FLAG_TC_ACK);

	memcpy(buf, rst_bpdu, sizeof(rst_bpdu));
	buf[4] = 0xff;
	zassert_ok(eth_rstp_bpdu_decode(buf, sizeof(rst_bpdu), &bpdu));
	zexpect_equal(bpdu.flags, (uint8_t)~ETH_RSTP_FLAG_TC_ACK);
}

/* An MST BPDU carries an RST BPDU in its first 36 octets */
ZTEST(rstp_bpdu, test_decode_mst_as_rst)
{
	struct eth_rstp_bpdu bpdu;
	uint8_t buf[102] = {0};

	memcpy(buf, rst_bpdu, sizeof(rst_bpdu));
	buf[2] = 3U;
	zassert_ok(eth_rstp_bpdu_decode(buf, sizeof(buf), &bpdu));
	expect_bpdu(&bpdu, &rst_decoded);
}

ZTEST(rstp_bpdu, test_decode_invalid)
{
	struct eth_rstp_bpdu bpdu;
	uint8_t buf[sizeof(rst_bpdu)];

	/* Shorter than any BPDU */
	zexpect_equal(eth_rstp_bpdu_decode(tcn_bpdu, 3U, &bpdu), -EINVAL);

	/* Protocol Identifier other than 0 */
	memcpy(buf, rst_bpdu, sizeof(rst_bpdu));
	buf[1] = 0x01;
	zexpect_equal(eth_rstp_bpdu_decode(buf, sizeof(rst_bpdu), &bpdu), -EINVAL);

	/* Configuration BPDU shorter than 35 octets */
	zexpect_equal(eth_rstp_bpdu_decode(config_bpdu, sizeof(config_bpdu) - 1U, &bpdu), -EINVAL);

	/* RST BPDU shorter than 36 octets */
	zexpect_equal(eth_rstp_bpdu_decode(rst_bpdu, sizeof(rst_bpdu) - 1U, &bpdu), -EINVAL);

	/* BPDU Type 0000 0010 with a Protocol Version below 2 */
	memcpy(buf, rst_bpdu, sizeof(rst_bpdu));
	buf[2] = 1U;
	zexpect_equal(eth_rstp_bpdu_decode(buf, sizeof(rst_bpdu), &bpdu), -EINVAL);

	/* Unknown BPDU Type */
	memcpy(buf, rst_bpdu, sizeof(rst_bpdu));
	buf[3] = 0x01;
	zexpect_equal(eth_rstp_bpdu_decode(buf, sizeof(rst_bpdu), &bpdu), -EINVAL);
}

/* Timer values are units of 1/256 s (14.2.8), held in whole seconds */
ZTEST(rstp_bpdu, test_decode_rounds_times)
{
	struct eth_rstp_bpdu bpdu;
	uint8_t buf[sizeof(rst_bpdu)];

	memcpy(buf, rst_bpdu, sizeof(rst_bpdu));
	buf[27] = 0x01;
	buf[28] = 0x7f;
	buf[29] = 0x13;
	buf[30] = 0x80;
	zassert_ok(eth_rstp_bpdu_decode(buf, sizeof(buf), &bpdu));
	zexpect_equal(bpdu.times.message_age, 1U);
	zexpect_equal(bpdu.times.max_age, 20U);
}

ZTEST(rstp_bpdu, test_encode)
{
	uint8_t buf[ETH_RSTP_BPDU_MAX_LEN];
	struct eth_rstp_bpdu tcn = {.type = ETH_RSTP_BPDU_TCN};

	zassert_equal(eth_rstp_bpdu_encode(&config_decoded, buf, sizeof(buf)), sizeof(config_bpdu));
	zexpect_mem_equal(buf, config_bpdu, sizeof(config_bpdu));

	zassert_equal(eth_rstp_bpdu_encode(&rst_decoded, buf, sizeof(buf)), sizeof(rst_bpdu));
	zexpect_mem_equal(buf, rst_bpdu, sizeof(rst_bpdu));

	zassert_equal(eth_rstp_bpdu_encode(&tcn, buf, sizeof(buf)), sizeof(tcn_bpdu));
	zexpect_mem_equal(buf, tcn_bpdu, sizeof(tcn_bpdu));
}

/* Flags not defined for the BPDU type are transmitted as 0 (14.4 b to g) */
ZTEST(rstp_bpdu, test_encode_clears_undefined_flags)
{
	uint8_t buf[ETH_RSTP_BPDU_MAX_LEN];
	struct eth_rstp_bpdu bpdu = config_decoded;

	bpdu.flags = 0xff;
	zassert_equal(eth_rstp_bpdu_encode(&bpdu, buf, sizeof(buf)), sizeof(config_bpdu));
	zexpect_equal(buf[4], ETH_RSTP_FLAG_TC | ETH_RSTP_FLAG_TC_ACK);

	bpdu = rst_decoded;
	bpdu.flags = 0xff;
	zassert_equal(eth_rstp_bpdu_encode(&bpdu, buf, sizeof(buf)), sizeof(rst_bpdu));
	zexpect_equal(buf[4], (uint8_t)~ETH_RSTP_FLAG_TC_ACK);
}

ZTEST(rstp_bpdu, test_encode_short_buffer)
{
	uint8_t buf[ETH_RSTP_BPDU_MAX_LEN];

	zexpect_equal(eth_rstp_bpdu_encode(&rst_decoded, buf, sizeof(rst_bpdu) - 1U), 0U);
	zexpect_equal(eth_rstp_bpdu_encode(&config_decoded, buf, sizeof(config_bpdu) - 1U), 0U);
}

ZTEST_SUITE(rstp_bpdu, NULL, NULL, NULL, NULL, NULL);
```

## src/rstp.c
```c
/*
 * SPDX-FileCopyrightText: Copyright The Zephyr Project Contributors
 * SPDX-License-Identifier: Apache-2.0
 */

/*
 * The RSTP state machines on a simulated network. Each bridge port is
 * attached to a LAN. A transmitted BPDU is encoded, queued and, when the
 * queue is pumped, decoded and received by every other port on the LAN.
 * Time only passes through sim_ticks().
 */

#include <string.h>

#include <zephyr/ztest.h>

#include "rstp_internal.h"

#define NUM_BRIDGES   3
#define NUM_PORTS     3
#define NUM_LANS      8
#define LAN_MAX_PORTS 3
#define QUEUE_LEN     64
#define MAX_DELIVERED 10000

struct sim_port {
	struct eth_rstp_port rstp;
	int lan;
	uint32_t tx_count;
	uint32_t flush_count;
	struct eth_rstp_bpdu last_tx;
	uint8_t last_tx_raw[ETH_RSTP_BPDU_MAX_LEN];
	size_t last_tx_len;
};

struct sim_bridge {
	struct eth_rstp_bridge rstp;
	struct sim_port port[NUM_PORTS];
	struct eth_rstp_port *ports[NUM_PORTS];
};

struct sim_frame {
	struct sim_port *from;
	uint8_t data[ETH_RSTP_BPDU_MAX_LEN];
	size_t len;
};

static struct sim_bridge bridges[NUM_BRIDGES];
static struct sim_port *lans[NUM_LANS][LAN_MAX_PORTS];
static struct sim_frame queue[QUEUE_LEN];
static size_t queue_head;
static size_t queue_count;
static uint32_t queue_overflows;

#define BRIDGE_A (&bridges[0])
#define BRIDGE_B (&bridges[1])
#define BRIDGE_C (&bridges[2])

static struct sim_port *port_of(struct eth_rstp_port *port)
{
	return CONTAINER_OF(port, struct sim_port, rstp);
}

static void sim_tx_bpdu(struct eth_rstp_port *port, const struct eth_rstp_bpdu *bpdu)
{
	struct sim_port *sp = port_of(port);
	struct sim_frame *frame;

	sp->tx_count++;
	sp->last_tx = *bpdu;
	sp->last_tx_len = eth_rstp_bpdu_encode(bpdu, sp->last_tx_raw, sizeof(sp->last_tx_raw));
	zassert_not_equal(sp->last_tx_len, 0U);

	if (queue_count == QUEUE_LEN) {
		queue_overflows++;
		return;
	}

	frame = &queue[(queue_head + queue_count) % QUEUE_LEN];
	frame->from = sp;
	memcpy(frame->data, sp->last_tx_raw, sp->last_tx_len);
	frame->len = sp->last_tx_len;
	queue_count++;
}

static void sim_set_port_state(struct eth_rstp_port *port, bool learning, bool forwarding)
{
	/* The state machines keep the learning and forwarding variables */
	ARG_UNUSED(port);
	ARG_UNUSED(learning);
	ARG_UNUSED(forwarding);
}

static void sim_flush_fdb(struct eth_rstp_port *port)
{
	port_of(port)->flush_count++;
}

static const struct eth_rstp_ops sim_ops = {
	.tx_bpdu = sim_tx_bpdu,
	.set_port_state = sim_set_port_state,
	.flush_fdb = sim_flush_fdb,
};

static void pump(void)
{
	for (uint32_t delivered = 0U; queue_count > 0U; delivered++) {
		struct sim_frame frame = queue[queue_head];
		struct eth_rstp_bpdu bpdu;

		zassert_true(delivered < MAX_DELIVERED, "BPDUs never settle");

		queue_head = (queue_head + 1U) % QUEUE_LEN;
		queue_count--;

		zassert_ok(eth_rstp_bpdu_decode(frame.data, frame.len, &bpdu));

		ARRAY_FOR_EACH(lans[frame.from->lan], i) {
			struct sim_port *to = lans[frame.from->lan][i];

			if (to != NULL && to != frame.from) {
				eth_rstp_rx(&to->rstp, &bpdu);
			}
		}
	}
}

static void sim_bridge_init(struct sim_bridge *sb, uint8_t id)
{
	const uint8_t mac[6] = {0x02, 0x00, 0x00, 0x00, 0x00, id};

	eth_rstp_bridge_init(&sb->rstp, &sim_ops, sb->ports, NUM_PORTS, mac);

	ARRAY_FOR_EACH(sb->port, i) {
		eth_rstp_port_init(&sb->port[i].rstp, &sb->rstp, (uint16_t)(i + 1U));
		sb->port[i].lan = -1;
		sb->ports[i] = &sb->port[i].rstp;
	}
}

static void attach(struct sim_bridge *sb, size_t port, int lan)
{
	struct sim_port *sp = &sb->port[port];

	ARRAY_FOR_EACH(lans[lan], i) {
		if (lans[lan][i] == NULL) {
			lans[lan][i] = sp;
			sp->lan = lan;
			return;
		}
	}

	zassert_unreachable("LAN %d is full", lan);
}

/* Start all bridges and enable the attached ports. A LAN with more than two
 * ports is a shared LAN, the others are point-to-point links.
 */
static void sim_start(void)
{
	ARRAY_FOR_EACH(bridges, b) {
		eth_rstp_start(&bridges[b].rstp);
	}

	ARRAY_FOR_EACH(lans, lan) {
		size_t n = 0;

		ARRAY_FOR_EACH(lans[lan], i) {
			n += (lans[lan][i] != NULL) ? 1U : 0U;
		}

		ARRAY_FOR_EACH(lans[lan], i) {
			if (lans[lan][i] != NULL) {
				eth_rstp_port_set_p2p(&lans[lan][i]->rstp, n <= 2U);
				eth_rstp_port_set_enabled(&lans[lan][i]->rstp, true);
			}
		}
	}

	pump();
}

static void sim_ticks(uint32_t count)
{
	for (uint32_t t = 0U; t < count; t++) {
		ARRAY_FOR_EACH(bridges, b) {
			eth_rstp_tick(&bridges[b].rstp);
		}

		pump();
	}
}

static void lan_down(int lan)
{
	ARRAY_FOR_EACH(lans[lan], i) {
		if (lans[lan][i] != NULL) {
			eth_rstp_port_set_enabled(&lans[lan][i]->rstp, false);
		}
	}

	pump();
}

/* Receive a BPDU on a port from a bridge that is not simulated */
static void inject(struct sim_port *sp, const struct eth_rstp_bpdu *bpdu)
{
	eth_rstp_rx(&sp->rstp, bpdu);
	pump();
}

static struct eth_rstp_port *P(struct sim_bridge *sb, size_t port)
{
	return &sb->port[port].rstp;
}

static uint64_t bridge_id(struct sim_bridge *sb)
{
	return sb->rstp.bridge_id;
}

static bool is_forwarding(struct sim_bridge *sb, size_t port)
{
	return P(sb, port)->learning && P(sb, port)->forwarding;
}

static bool is_discarding(struct sim_bridge *sb, size_t port)
{
	return !P(sb, port)->learning && !P(sb, port)->forwarding;
}

static uint32_t flushes(struct sim_bridge *sb)
{
	uint32_t count = 0U;

	ARRAY_FOR_EACH(sb->port, i) {
		count += sb->port[i].flush_count;
	}

	return count;
}

static void expect_settled(void)
{
	ARRAY_FOR_EACH(bridges, b) {
		zexpect_equal(bridges[b].rstp.unsettled, 0U, "bridge %zu did not settle", b);
	}

	zexpect_equal(queue_overflows, 0U);
}

/* A designated BPDU from a bridge with the given identifier */
static struct eth_rstp_bpdu designated_bpdu(uint64_t root_id, uint64_t sender_id)
{
	return (struct eth_rstp_bpdu){
		.type = ETH_RSTP_BPDU_RST,
		.flags = ETH_RSTP_BPDU_ROLE_DESIGNATED << ETH_RSTP_FLAG_ROLE_SHIFT,
		.root_id = root_id,
		.root_path_cost = 0U,
		.bridge_id = sender_id,
		.port_id = 0x8001U,
		.times = {.message_age = 0U,
			  .max_age = ETH_RSTP_DEFAULT_MAX_AGE,
			  .hello_time = ETH_RSTP_HELLO_TIME,
			  .forward_delay = ETH_RSTP_DEFAULT_FORWARD_DELAY},
	};
}

/* A bridge identifier better than any simulated bridge */
#define BETTER_ID 0x1000020000000099ULL
/* A bridge identifier worse than any simulated bridge */
#define WORSE_ID  0xf000020000000099ULL

static void before(void *fixture)
{
	ARG_UNUSED(fixture);

	memset(bridges, 0, sizeof(bridges));
	memset(lans, 0, sizeof(lans));
	queue_head = 0U;
	queue_count = 0U;
	queue_overflows = 0U;

	ARRAY_FOR_EACH(bridges, b) {
		sim_bridge_init(&bridges[b], (uint8_t)(b + 1U));
	}
}

/* Two bridges on one link: proposal and agreement make both ports forward
 * without waiting for any timer (13.16).
 */
ZTEST(rstp, test_two_bridges)
{
	attach(BRIDGE_A, 0, 0);
	attach(BRIDGE_B, 0, 0);
	sim_start();

	zexpect_equal(BRIDGE_A->rstp.root_port_id, 0U, "A is not the root");
	zexpect_equal(BRIDGE_B->rstp.root_prio.root_id, bridge_id(BRIDGE_A));
	zexpect_equal(BRIDGE_B->rstp.root_prio.root_path_cost, ETH_RSTP_DEFAULT_PATH_COST);
	zexpect_equal(BRIDGE_B->rstp.root_port_id, P(BRIDGE_B, 0)->port_id);

	zexpect_equal(P(BRIDGE_A, 0)->role, ETH_RSTP_ROLE_DESIGNATED);
	zexpect_equal(P(BRIDGE_B, 0)->role, ETH_RSTP_ROLE_ROOT);
	zexpect_true(is_forwarding(BRIDGE_A, 0));
	zexpect_true(is_forwarding(BRIDGE_B, 0));

	/* The last BPDU of the root port carries the agreement */
	zexpect_equal(BRIDGE_B->port[0].last_tx.type, ETH_RSTP_BPDU_RST);
	zexpect_equal(BRIDGE_B->port[0].last_tx_raw[2], 2U, "Protocol Version Identifier");
	zexpect_equal((BRIDGE_B->port[0].last_tx.flags & ETH_RSTP_FLAG_ROLE_MASK) >>
			      ETH_RSTP_FLAG_ROLE_SHIFT,
		      ETH_RSTP_BPDU_ROLE_ROOT);
	zexpect_true((BRIDGE_B->port[0].last_tx.flags & ETH_RSTP_FLAG_AGREEMENT) != 0U);

	expect_settled();
}

/* Three bridges in a ring: exactly one port blocks the loop */
ZTEST(rstp, test_triangle)
{
	int discarding = 0;

	attach(BRIDGE_A, 0, 0);
	attach(BRIDGE_B, 0, 0);
	attach(BRIDGE_A, 1, 1);
	attach(BRIDGE_C, 0, 1);
	attach(BRIDGE_B, 1, 2);
	attach(BRIDGE_C, 1, 2);
	sim_start();

	zexpect_equal(BRIDGE_B->rstp.root_port_id, P(BRIDGE_B, 0)->port_id);
	zexpect_equal(BRIDGE_C->rstp.root_port_id, P(BRIDGE_C, 0)->port_id);

	/* On the B-C link B has the better bridge identifier */
	zexpect_equal(P(BRIDGE_B, 1)->role, ETH_RSTP_ROLE_DESIGNATED);
	zexpect_equal(P(BRIDGE_C, 1)->role, ETH_RSTP_ROLE_ALTERNATE);

	ARRAY_FOR_EACH(bridges, b) {
		for (size_t i = 0; i < 2U; i++) {
			if (is_discarding(&bridges[b], i)) {
				discarding++;
			} else {
				zexpect_true(is_forwarding(&bridges[b], i), "bridge %zu port %zu",
					     b, i);
			}
		}
	}

	zexpect_equal(discarding, 1);
	zexpect_true(is_discarding(BRIDGE_C, 1));

	/* Nothing changes once the protocol has settled */
	sim_ticks(10U);
	zexpect_equal(P(BRIDGE_C, 1)->role, ETH_RSTP_ROLE_ALTERNATE);
	zexpect_true(is_discarding(BRIDGE_C, 1));
	zexpect_true(is_forwarding(BRIDGE_B, 1));

	expect_settled();
}

/* Two links between the same bridges: the one from the better Designated
 * Port is the Root Port, the other one an Alternate Port.
 */
ZTEST(rstp, test_parallel_links)
{
	attach(BRIDGE_A, 0, 0);
	attach(BRIDGE_B, 0, 0);
	attach(BRIDGE_A, 1, 1);
	attach(BRIDGE_B, 1, 1);
	sim_start();

	zexpect_equal(P(BRIDGE_B, 0)->role, ETH_RSTP_ROLE_ROOT);
	zexpect_equal(P(BRIDGE_B, 1)->role, ETH_RSTP_ROLE_ALTERNATE);
	zexpect_true(is_forwarding(BRIDGE_B, 0));
	zexpect_true(is_discarding(BRIDGE_B, 1));
	zexpect_true(is_forwarding(BRIDGE_A, 1));

	expect_settled();
}

/* Two ports of one bridge on a shared LAN: the worse one is a Backup Port */
ZTEST(rstp, test_backup_port)
{
	attach(BRIDGE_A, 0, 0);
	attach(BRIDGE_A, 1, 0);
	attach(BRIDGE_B, 0, 0);
	sim_start();

	zexpect_false(P(BRIDGE_A, 0)->oper_p2p);
	zexpect_equal(P(BRIDGE_A, 0)->role, ETH_RSTP_ROLE_DESIGNATED);
	zexpect_equal(P(BRIDGE_A, 1)->role, ETH_RSTP_ROLE_BACKUP);
	zexpect_equal(P(BRIDGE_B, 0)->role, ETH_RSTP_ROLE_ROOT);

	/* No agreements on a shared LAN, the Designated Port waits for the
	 * timers.
	 */
	zexpect_false(is_forwarding(BRIDGE_A, 0));

	sim_ticks(2U * ETH_RSTP_DEFAULT_MAX_AGE);
	zexpect_true(is_forwarding(BRIDGE_A, 0));
	zexpect_true(is_forwarding(BRIDGE_B, 0));
	zexpect_true(is_discarding(BRIDGE_A, 1));
	zexpect_equal(P(BRIDGE_A, 1)->role, ETH_RSTP_ROLE_BACKUP);

	expect_settled();
}

/* An AdminEdge port forwards at once, and is no longer an Edge Port once it
 * receives a BPDU.
 */
ZTEST(rstp, test_admin_edge)
{
	struct eth_rstp_bpdu bpdu = designated_bpdu(WORSE_ID, WORSE_ID);

	attach(BRIDGE_A, 0, 0);
	eth_rstp_port_set_edge(P(BRIDGE_A, 0), true, false);
	sim_start();

	zexpect_true(P(BRIDGE_A, 0)->oper_edge);
	zexpect_true(is_forwarding(BRIDGE_A, 0));

	inject(&BRIDGE_A->port[0], &bpdu);
	zexpect_false(P(BRIDGE_A, 0)->oper_edge);

	expect_settled();
}

/* With AutoEdge, a port that receives no BPDU becomes an Edge Port after
 * EdgeDelay, MigrateTime on a point-to-point link (13.28.8).
 */
ZTEST(rstp, test_auto_edge)
{
	attach(BRIDGE_A, 0, 0);
	sim_start();

	zexpect_false(is_forwarding(BRIDGE_A, 0));

	sim_ticks(ETH_RSTP_MIGRATE_TIME - 1U);
	zexpect_false(P(BRIDGE_A, 0)->oper_edge);
	zexpect_false(is_forwarding(BRIDGE_A, 0));

	sim_ticks(1U);
	zexpect_true(P(BRIDGE_A, 0)->oper_edge);
	zexpect_true(is_forwarding(BRIDGE_A, 0));

	expect_settled();
}

/* A failed Root Port is replaced by the Alternate Port, which forwards at
 * once, and the topology change flushes the FDBs of the other bridges.
 */
ZTEST(rstp, test_root_port_failure)
{
	uint32_t a_flushes;
	uint32_t b_flushes;

	attach(BRIDGE_A, 0, 0);
	attach(BRIDGE_B, 0, 0);
	attach(BRIDGE_A, 1, 1);
	attach(BRIDGE_C, 0, 1);
	attach(BRIDGE_B, 1, 2);
	attach(BRIDGE_C, 1, 2);
	sim_start();
	sim_ticks(1U);

	zassert_true(is_discarding(BRIDGE_C, 1));
	a_flushes = flushes(BRIDGE_A);
	b_flushes = flushes(BRIDGE_B);

	lan_down(1);

	zexpect_equal(P(BRIDGE_C, 1)->role, ETH_RSTP_ROLE_ROOT);
	zexpect_true(is_forwarding(BRIDGE_C, 1));
	zexpect_equal(BRIDGE_C->rstp.root_prio.root_id, bridge_id(BRIDGE_A));
	zexpect_equal(BRIDGE_C->rstp.root_prio.root_path_cost, 2U * ETH_RSTP_DEFAULT_PATH_COST);

	zexpect_true(P(BRIDGE_C, 1)->tc_while != 0U, "no topology change detected");
	zexpect_true(flushes(BRIDGE_B) > b_flushes, "B did not flush");
	zexpect_true(flushes(BRIDGE_A) > a_flushes, "A did not flush");

	expect_settled();
}

/* No more than TxHoldCount BPDUs leave a port in one second (13.34) */
ZTEST(rstp, test_tx_hold_count)
{
	attach(BRIDGE_A, 0, 0);
	attach(BRIDGE_B, 0, 0);
	zassert_ok(eth_rstp_set_tx_hold_count(&BRIDGE_A->rstp, 1U));
	zassert_ok(eth_rstp_set_tx_hold_count(&BRIDGE_B->rstp, 1U));
	sim_start();

	zexpect_equal(BRIDGE_A->port[0].tx_count, 1U);
	zexpect_equal(BRIDGE_B->port[0].tx_count, 1U);
	zexpect_false(is_forwarding(BRIDGE_A, 0));

	/* One more BPDU per port and second, and the handshake completes */
	sim_ticks(3U);
	zexpect_true(BRIDGE_A->port[0].tx_count <= 4U);
	zexpect_true(BRIDGE_B->port[0].tx_count <= 4U);
	zexpect_true(is_forwarding(BRIDGE_A, 0));
	zexpect_true(is_forwarding(BRIDGE_B, 0));

	expect_settled();
}

/* A port that hears an STP bridge sends STP BPDUs after MigrateTime, and RST
 * BPDUs again after mcheck once the STP bridge is gone (13.32).
 */
ZTEST(rstp, test_stp_migration)
{
	struct eth_rstp_bpdu config = designated_bpdu(WORSE_ID, WORSE_ID);

	config.type = ETH_RSTP_BPDU_CONFIG;
	config.flags = 0U;

	attach(BRIDGE_A, 0, 0);
	sim_start();

	zexpect_equal(BRIDGE_A->port[0].last_tx.type, ETH_RSTP_BPDU_RST);

	/* Received during the first MigrateTime, the BPDU changes nothing */
	inject(&BRIDGE_A->port[0], &config);
	zexpect_true(P(BRIDGE_A, 0)->send_rstp);

	sim_ticks(ETH_RSTP_MIGRATE_TIME);
	inject(&BRIDGE_A->port[0], &config);
	zexpect_false(P(BRIDGE_A, 0)->send_rstp);

	sim_ticks(ETH_RSTP_HELLO_TIME);
	zexpect_equal(BRIDGE_A->port[0].last_tx.type, ETH_RSTP_BPDU_CONFIG);
	zexpect_equal(BRIDGE_A->port[0].last_tx_len, ETH_RSTP_BPDU_CONFIG_LEN);
	zexpect_equal(BRIDGE_A->port[0].last_tx_raw[2], 0U, "Protocol Version Identifier");

	eth_rstp_port_mcheck(P(BRIDGE_A, 0));
	pump();
	zexpect_true(P(BRIDGE_A, 0)->send_rstp);

	sim_ticks(ETH_RSTP_HELLO_TIME);
	zexpect_equal(BRIDGE_A->port[0].last_tx.type, ETH_RSTP_BPDU_RST);

	expect_settled();
}

/* With Force Protocol Version 0 there are no rapid transitions: ports wait
 * for the Forward Delay timers (13.7.2 d).
 */
ZTEST(rstp, test_force_version_stp)
{
	attach(BRIDGE_A, 0, 0);
	attach(BRIDGE_B, 0, 0);
	zassert_ok(eth_rstp_set_force_version(&BRIDGE_A->rstp, 0U));
	zassert_ok(eth_rstp_set_force_version(&BRIDGE_B->rstp, 0U));
	sim_start();

	zexpect_equal(BRIDGE_A->port[0].last_tx.type, ETH_RSTP_BPDU_CONFIG);
	zexpect_equal(P(BRIDGE_B, 0)->role, ETH_RSTP_ROLE_ROOT);

	sim_ticks(2U * ETH_RSTP_DEFAULT_FORWARD_DELAY);
	zexpect_false(is_forwarding(BRIDGE_A, 0));
	zexpect_false(is_forwarding(BRIDGE_B, 0));

	sim_ticks(ETH_RSTP_DEFAULT_MAX_AGE);
	zexpect_true(is_forwarding(BRIDGE_A, 0));
	zexpect_true(is_forwarding(BRIDGE_B, 0));

	expect_settled();
}

/* A Designated Port that receives an inferior designated BPDU with the
 * Learning flag stops forwarding (13.21, 13.29.16).
 */
ZTEST(rstp, test_dispute)
{
	struct eth_rstp_bpdu bpdu = designated_bpdu(WORSE_ID, WORSE_ID);

	attach(BRIDGE_A, 0, 0);
	sim_start();
	sim_ticks(ETH_RSTP_MIGRATE_TIME);
	zassert_true(is_forwarding(BRIDGE_A, 0));

	inject(&BRIDGE_A->port[0], &bpdu);
	zexpect_true(is_forwarding(BRIDGE_A, 0), "inferior BPDU without Learning flag");

	bpdu.flags |= ETH_RSTP_FLAG_LEARNING;
	inject(&BRIDGE_A->port[0], &bpdu);
	zexpect_equal(P(BRIDGE_A, 0)->role, ETH_RSTP_ROLE_DESIGNATED);
	zexpect_true(is_discarding(BRIDGE_A, 0));

	expect_settled();
}

/* Information whose Message Age reaches Max Age is aged out at once
 * (13.29.33).
 */
ZTEST(rstp, test_message_age)
{
	struct eth_rstp_bpdu bpdu = designated_bpdu(BETTER_ID, BETTER_ID);

	attach(BRIDGE_A, 0, 0);
	sim_start();

	bpdu.times.message_age = ETH_RSTP_DEFAULT_MAX_AGE;
	inject(&BRIDGE_A->port[0], &bpdu);
	zexpect_equal(BRIDGE_A->rstp.root_port_id, 0U, "aged information selected the root");
	zexpect_equal(P(BRIDGE_A, 0)->role, ETH_RSTP_ROLE_DESIGNATED);

	bpdu.times.message_age = ETH_RSTP_DEFAULT_MAX_AGE - 1U;
	inject(&BRIDGE_A->port[0], &bpdu);
	zexpect_equal(BRIDGE_A->rstp.root_port_id, P(BRIDGE_A, 0)->port_id);
	zexpect_equal(BRIDGE_A->rstp.root_times.message_age, ETH_RSTP_DEFAULT_MAX_AGE);

	expect_settled();
}

/* Received information is aged out after three Hello Times without a BPDU
 * (13.29.33).
 */
ZTEST(rstp, test_info_ages_out)
{
	struct eth_rstp_bpdu bpdu = designated_bpdu(BETTER_ID, BETTER_ID);

	attach(BRIDGE_A, 0, 0);
	sim_start();

	inject(&BRIDGE_A->port[0], &bpdu);
	zassert_equal(P(BRIDGE_A, 0)->role, ETH_RSTP_ROLE_ROOT);

	sim_ticks(3U * ETH_RSTP_HELLO_TIME - 1U);
	zexpect_equal(P(BRIDGE_A, 0)->role, ETH_RSTP_ROLE_ROOT);

	sim_ticks(1U);
	zexpect_equal(P(BRIDGE_A, 0)->role, ETH_RSTP_ROLE_DESIGNATED);
	zexpect_equal(BRIDGE_A->rstp.root_port_id, 0U);

	expect_settled();
}

/* A better Bridge Priority makes a bridge the root */
ZTEST(rstp, test_bridge_priority)
{
	attach(BRIDGE_A, 0, 0);
	attach(BRIDGE_B, 0, 0);
	sim_start();
	zassert_equal(P(BRIDGE_B, 0)->role, ETH_RSTP_ROLE_ROOT);

	zexpect_equal(eth_rstp_set_bridge_priority(&BRIDGE_B->rstp, 100U), -EINVAL);
	zassert_ok(eth_rstp_set_bridge_priority(&BRIDGE_B->rstp, 4096U));
	pump();
	sim_ticks(1U);

	zexpect_equal(BRIDGE_B->rstp.root_port_id, 0U);
	zexpect_equal(P(BRIDGE_A, 0)->role, ETH_RSTP_ROLE_ROOT);
	zexpect_equal(BRIDGE_A->rstp.root_prio.root_id, bridge_id(BRIDGE_B));
	zexpect_true(is_forwarding(BRIDGE_A, 0));
	zexpect_true(is_forwarding(BRIDGE_B, 0));

	expect_settled();
}

ZTEST(rstp, test_parameter_ranges)
{
	zexpect_equal(eth_rstp_set_times(&BRIDGE_A->rstp, 5U, 15U), -EINVAL);
	zexpect_equal(eth_rstp_set_times(&BRIDGE_A->rstp, 20U, 3U), -EINVAL);
	/* 2 * (Forward Delay - 1) >= Max Age */
	zexpect_equal(eth_rstp_set_times(&BRIDGE_A->rstp, 20U, 10U), -EINVAL);
	zexpect_ok(eth_rstp_set_times(&BRIDGE_A->rstp, 20U, 11U));
	zexpect_equal(eth_rstp_set_tx_hold_count(&BRIDGE_A->rstp, 0U), -EINVAL);
	zexpect_equal(eth_rstp_set_tx_hold_count(&BRIDGE_A->rstp, 11U), -EINVAL);
	zexpect_equal(eth_rstp_set_force_version(&BRIDGE_A->rstp, 1U), -EINVAL);
	zexpect_equal(eth_rstp_set_force_version(&BRIDGE_A->rstp, 3U), -EINVAL);
	zexpect_equal(eth_rstp_port_set_priority(P(BRIDGE_A, 0), 8U), -EINVAL);
	zexpect_equal(eth_rstp_port_set_path_cost(P(BRIDGE_A, 0), 0U), -EINVAL);
	zexpect_equal(eth_rstp_port_set_path_cost(P(BRIDGE_A, 0), ETH_RSTP_MAX_PATH_COST + 1U),
		      -EINVAL);
}

ZTEST_SUITE(rstp, NULL, NULL, before, NULL, NULL);
```
