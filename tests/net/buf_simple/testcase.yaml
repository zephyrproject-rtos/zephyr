## tests/net/checksum_offload/Kconfig
```kconfig
# SPDX-FileCopyrightText: Copyright The Zephyr Project Contributors
# SPDX-License-Identifier: Apache-2.0

# This normally would be selected in the Kconfig of the driver, but since this is a test, we want
# to enable it, so we set the default here. We can't use the prj.conf file to enable it, because
# it is promptless.
configdefault NET_CHECKSUM_OFFLOAD_SUPPORTED
	default y

source "Kconfig.zephyr"
```

## tests/net/checksum_offload/testcase.yaml
```yaml
common:
  depends_on: netif
tests:
  net.offload:
    min_ram: 16
    tags:
      - net
      - checksum_offload
```

## tests/net/conn_mgr_conn/testcase.yaml
```yaml
common:
  min_ram: 16
  depends_on: netif
tests:
  net.conn_mgr_conn:
    tags:
      - net
      - iface
```

## tests/net/conn_mgr_monitor/testcase.yaml
```yaml
common:
  min_ram: 16
  depends_on: netif
  tags: net iface
tests:
  net.conn_mgr.nodad:
    extra_configs:
      - CONFIG_NET_IPV6_DAD=n
  net.conn_mgr.dad:
    extra_configs:
      - CONFIG_NET_IPV6_DAD=y
```

## tests/net/conn_mgr_nsos/testcase.yaml
```yaml
common:
  min_ram: 16
  depends_on: netif
tests:
  net.conn_mgr.nsos:
    platform_allow:
      - native_sim
    tags:
      - net
      - iface
```

## tests/net/context/testcase.yaml
```yaml
common:
  pre-filter: subsys_dt_compat_enabled("ethernet")
tests:
  net.context:
    min_ram: 16
    extra_configs:
      - CONFIG_ASSERT_LEVEL=0
    tags: net net_context
```

## tests/net/dhcpv4/client/testcase.yaml
```yaml
common:
  depends_on: netif
  tags:
    - net
    - dhcpv4
tests:
  net.dhcpv4_client:
    extra_configs:
      - CONFIG_NET_TC_THREAD_COOPERATIVE=y
  net.dhcpv4_client.preempt:
    extra_configs:
      - CONFIG_NET_TC_THREAD_PREEMPTIVE=y
  net.dhcpv4_client.optioncbs:
    extra_configs:
      - CONFIG_NET_DHCPV4_OPTION_CALLBACKS=y
  net.dhcpv4_client.optioncbs_vendor_specific:
    extra_configs:
      - CONFIG_NET_DHCPV4_OPTION_CALLBACKS=y
      - CONFIG_NET_DHCPV4_OPTION_CALLBACKS_VENDOR_SPECIFIC=y
  net.dhcpv4_client.ignored_options:
    extra_configs:
      - CONFIG_NET_DHCPV4_OPTION_PRINT_IGNORED=y
```

## tests/net/dhcpv4/server/testcase.yaml
```yaml
common:
  depends_on: netif
  tags:
    - net
    - dhcpv4
tests:
  net.dhcpv4_server:
    extra_configs:
      - CONFIG_NET_TC_THREAD_COOPERATIVE=y
  net.dhcpv4_server.preempt:
    extra_configs:
      - CONFIG_NET_TC_THREAD_PREEMPTIVE=y
  net.dhcpv4_server.no_probe:
    extra_configs:
      - CONFIG_NET_DHCPV4_SERVER_ICMP_PROBE_TIMEOUT=0
```

## tests/net/dhcpv4/testcase.yaml
```yaml
common:
  depends_on: netif
  tags:
    - net
    - dhcpv4
tests:
  net.dhcp:
    extra_configs:
      - CONFIG_NET_TC_THREAD_COOPERATIVE=y
  net.dhcp.preempt:
    extra_configs:
      - CONFIG_NET_TC_THREAD_PREEMPTIVE=y
  net.dhcp.optioncbs:
    extra_configs:
      - CONFIG_NET_DHCPV4_OPTION_CALLBACKS=y
```

## tests/net/dhcpv6/testcase.yaml
```yaml
common:
  depends_on: netif
  tags: net dhcpv6
tests:
  net.dhcpv6:
    extra_configs:
      - CONFIG_NET_TC_THREAD_COOPERATIVE=y
  net.dhcpv6.preempt:
    extra_configs:
      - CONFIG_NET_TC_THREAD_PREEMPTIVE=y
```

## tests/net/ethernet_mgmt/testcase.yaml
```yaml
common:
  depends_on: netif
tests:
  net.ethernet_mgmt:
    min_ram: 32
    tags:
      - net
      - ethernet_mgmt
```

## tests/net/hostname/testcase.yaml
```yaml
common:
  min_ram: 16
  tags:
    - net
    - hostname
  depends_on: netif
tests:
  net.hostname:
    extra_configs:
      - CONFIG_NET_HOSTNAME_UNIQUE=n
      - CONFIG_NET_HOSTNAME_DYNAMIC=n
  net.hostname.unique:
    extra_configs:
      - CONFIG_NET_HOSTNAME_UNIQUE=y
      - CONFIG_NET_HOSTNAME_DYNAMIC=n
  net.hostname.dynamic:
    extra_configs:
      - CONFIG_NET_HOSTNAME_UNIQUE=n
      - CONFIG_NET_HOSTNAME_DYNAMIC=y
  net.hostname.unique.dynamic:
    extra_configs:
      - CONFIG_NET_HOSTNAME_UNIQUE=y
      - CONFIG_NET_HOSTNAME_DYNAMIC=y
  net.hostname.event:
    extra_configs:
      - CONFIG_NET_MGMT=y
      - CONFIG_NET_MGMT_EVENT_INFO=y
  net.hostname.event.unique:
    extra_configs:
      - CONFIG_NET_HOSTNAME_UNIQUE=y
      - CONFIG_NET_MGMT=y
      - CONFIG_NET_MGMT_EVENT=y
      - CONFIG_NET_MGMT_EVENT_INFO=n
```

## tests/net/icmp/testcase.yaml
```yaml
common:
  depends_on: netif
  tags:
    - net
    - icmp
tests:
  net.icmp.offloaded:
    extra_configs:
      - CONFIG_NET_OFFLOAD=y
      - CONFIG_NET_IF_MAX_IPV6_COUNT=2
      - CONFIG_NET_IF_MAX_IPV4_COUNT=2
  net.icmp.socket_offloaded:
    extra_configs:
      - CONFIG_NET_SOCKETS_OFFLOAD=y
      - CONFIG_NET_IF_MAX_IPV6_COUNT=2
      - CONFIG_NET_IF_MAX_IPV4_COUNT=2
  net.icmp.coop:
    extra_configs:
      - CONFIG_NET_TC_THREAD_COOPERATIVE=y
      - CONFIG_NET_IF_MAX_IPV6_COUNT=2
      - CONFIG_NET_IF_MAX_IPV4_COUNT=2
  net.icmp.preempt:
    extra_configs:
      - CONFIG_NET_TC_THREAD_PREEMPTIVE=y
      - CONFIG_NET_IF_MAX_IPV6_COUNT=2
      - CONFIG_NET_IF_MAX_IPV4_COUNT=2
  net.icmp.no_ipv4:
    extra_configs:
      - CONFIG_NET_IPV4=n
      - CONFIG_NET_IF_MAX_IPV6_COUNT=2
  net.icmp.no_ipv6:
    extra_configs:
      - CONFIG_NET_IPV6=n
      - CONFIG_NET_IF_MAX_IPV4_COUNT=2
```

## tests/net/icmpv4/testcase.yaml
```yaml
common:
  pre-filter: subsys_dt_compat_enabled("ethernet")
tests:
  net.icmpv6:
    min_ram: 16
    tags: net icmpv4
```

## tests/net/icmpv6/testcase.yaml
```yaml
common:
  depends_on: netif
tests:
  net.icmpv6:
    min_ram: 16
    tags: net icmpv6
```

## tests/net/ieee802154/6lo_fragment/testcase.yaml
```yaml
tests:
  net.ieee802154.fragment:
    platform_allow:
      - native_posix/native
      - native_posix/native/64
      - native_sim/native
      - native_sim/native/64
    integration_platforms:
      - native_sim/native
    tags:
      - net
      - ieee802154
      - fragment
    min_ram: 48
```

## tests/net/ieee802154/crypto/testcase.yaml
```yaml
common:
  depends_on: ieee802154
  platform_whitelist: quark_se_c1000_devboard
tests:
  net.ieee802154.crypto:
    tags: net crypto
    harness: console
    harness_config:
      type: multi_line
      regex:
        - ".*ds_test: Authentication only test: PASSED"
        - ".*ds_test: Encryption only test: PASSED"
        - ".*Authentication and encryption test: PASSED"
```

## tests/net/ieee802154/custom_l2/testcase.yaml
```yaml
tests:
  net.ieee802154.custom_l2:
    platform_allow:
      - native_posix
      - native_posix_64
      - native_sim
      - native_sim_64
    integration_platforms:
      - native_sim
    tags:
      - net
      - ieee802154
      - l2
    min_ram: 16
```

## tests/net/ieee802154/fragment/testcase.yaml
```yaml
common:
  depends_on: ieee802154
  min_ram: 48
tests:
  net.ieee802154.fragment:
    tags: net ieee802154 fragment
```

## tests/net/ieee802154/l2/Kconfig
```kconfig
# Copyright 2023, Florian Grandel, Zephyr Project
#
# SPDX-License-Identifier: Apache-2.0

config IEEE802154_FAKE_DRIVER
	bool "A fake driver for IEEE 802.15.4 L2 tests"
	select NET_TIME_REFERENCE_CLOCK
	default y

source "Kconfig.zephyr"
```

## tests/net/ieee802154/l2/testcase.yaml
```yaml
common:
  platform_allow:
    - native_sim
    - native_sim/native/64
  integration_platforms:
    - native_sim
  tags:
    - net
    - ieee802154
    - l2
  min_ram: 16
tests:
  net.ieee802154.l2:
    extra_configs:
      - CONFIG_NET_SOCKETS=n
  net.ieee802154.l2.sockets:
    extra_configs:
      - CONFIG_NET_SOCKETS=y
```

## tests/net/iface/testcase.yaml
```yaml
common:
  min_ram: 16
  depends_on: netif
tests:
  net.iface:
    tags: net iface userspace
```

## tests/net/iface_conn/testcase.yaml
```yaml
common:
  min_ram: 16
  depends_on: netif
tests:
  net.iface_conn:
    tags: net iface
```

## tests/net/iface_with_mld/testcase.yaml
```yaml
common:
  min_ram: 16
  depends_on: netif
  tags:
    - net
    - iface
tests:
  net.iface.with_mld: {}
  net.iface.with_mld.no_dad:
    extra_configs:
      - CONFIG_NET_IPV6_DAD=n
```
