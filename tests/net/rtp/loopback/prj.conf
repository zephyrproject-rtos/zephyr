## CMakeLists.txt
```
# SPDX-License-Identifier: Apache-2.0

cmake_minimum_required(VERSION 3.28.0)
find_package(Zephyr REQUIRED HINTS $ENV{ZEPHYR_BASE})
project(rtp_loopback)

target_include_directories(app PRIVATE ${ZEPHYR_BASE}/subsys/net/ip)
target_sources(app PRIVATE
  src/main.c
)
```

## Kconfig
```
# SPDX-FileCopyrightText: 2026 Basalte bv
# SPDX-License-Identifier: Apache-2.0

config RTP_LOOPBACK_TEST_SRTP_GCM
	bool "Use AES-GCM for the SRTP loopback permutations"
	help
	  Protect the loopback session with AES-128-GCM instead of
	  AES-128-CM with HMAC-SHA1-80.

config RTP_LOOPBACK_TEST_SRTP_GCM_256
	bool "Use AES-256-GCM for the SRTP loopback permutations"
	help
	  Protect the loopback session with AES-256-GCM instead of
	  AES-128-CM with HMAC-SHA1-80. Takes precedence over
	  RTP_LOOPBACK_TEST_SRTP_GCM.

source "Kconfig.zephyr"
```

## prj.conf
```kconfig
CONFIG_ZTEST=y
CONFIG_LOG=y

CONFIG_ZTEST_STACK_SIZE=4096

CONFIG_NETWORKING=y
CONFIG_NET_L2_ETHERNET=y
CONFIG_NET_IPV4=y
CONFIG_NET_IPV6=n
CONFIG_NET_TCP=n
CONFIG_NET_UDP=y
CONFIG_NET_CONFIG_SETTINGS=y
CONFIG_NET_IPV4_IGMP=y

CONFIG_NET_DRIVERS=y
CONFIG_NET_LOOPBACK=y
CONFIG_NET_LOOPBACK_MTU=1500

CONFIG_RTP=y

CONFIG_NET_LOG=y
CONFIG_RTP_LOG_LEVEL_DBG=y

CONFIG_NET_BUF_DATA_SIZE=1500
CONFIG_NET_RX_STACK_SIZE=4096
```

## src/main.c
```c
/*
 *  SPDX-FileCopyrightText: 2026 Basalte bv
 *
 *  SPDX-License-Identifier: Apache-2.0
 */

#include <zephyr/device.h>
#include <zephyr/kernel.h>
#include <zephyr/net/net_context.h>
#include <zephyr/net/rtp.h>
#ifdef CONFIG_SRTP
#include <zephyr/net/srtp.h>
#endif
#include <zephyr/sys/byteorder.h>
#include <zephyr/ztest.h>

#include "sine.h"

#define LOCALHOST_ADDR  "127.0.0.1"
#define LOCALHOST_ADDR6 "::1"
#define RTP_PORT        5004

#define PAYLOAD_TYPE 97

#define N_PACKETS  20
#define RX_TIMEOUT K_MSEC(5)

#define RTP_HDR_X_DATA_LEN 8
#define N_PADDING          4
#if CONFIG_RTP_MAX_CSRC_COUNT > 0
#define CSRC 0x12345678
#endif

static RTP_SESSION_DEFINE(test_rtp_session, 0);

#ifdef CONFIG_SRTP
/* clang-format off */
static uint8_t srtp_master_key[SRTP_AES_256_KEY_LEN] = {
	0x10, 0x11, 0x12, 0x13, 0x14, 0x15, 0x16, 0x17,
	0x18, 0x19, 0x1a, 0x1b, 0x1c, 0x1d, 0x1e, 0x1f,
	0x20, 0x21, 0x22, 0x23, 0x24, 0x25, 0x26, 0x27,
	0x28, 0x29, 0x2a, 0x2b, 0x2c, 0x2d, 0x2e, 0x2f,
};
static const uint8_t srtp_master_salt[SRTP_MASTER_SALT_LEN] = {
	0x30, 0x31, 0x32, 0x33, 0x34, 0x35, 0x36, 0x37,
	0x38, 0x39, 0x3a, 0x3b, 0x3c, 0x3d,
};
/* clang-format on */
static struct srtp_session_ctx srtp_ctx;
#endif /* CONFIG_SRTP */

K_SEM_DEFINE(rtp_rx_sem, 0, 1);

#ifdef CONFIG_RTP_TRANSPORT_NET_PKT
#define TRANSPORT_TYPE RTP_TRANSPORT_NET_PKT
#else
#define TRANSPORT_TYPE RTP_TRANSPORT_SOCKET
#endif

static int n_received;
static void *payload = (void *)sine_100_48000_8_mono;
#ifdef CONFIG_SRTP
/* Keep room for the SRTP trailer within the loopback MTU */
static size_t payload_len = sizeof(sine_100_48000_8_mono) - SRTP_TRAILER_MAX_LEN;
#else
static size_t payload_len = sizeof(sine_100_48000_8_mono);
#endif

/* Data is mono and 8bit, so payload_len equals number of samples */
#define DELTA_TS payload_len

static uint8_t x_data[RTP_HDR_X_DATA_LEN];
static struct rtp_header_extension x_hdr;

static uint16_t prev_seq_num;
static uint32_t prev_ts;
static bool first_packet = true;

static bool padding;
static bool header_extension;
static bool marker;
static bool zero_payload;

static void rtp_cb(struct rtp_session *session, struct rtp_packet *packet, void *user_data)
{
	ARG_UNUSED(session);
	ARG_UNUSED(user_data);

	if (!first_packet) {
		zassert_equal(packet->header.seq - 1, prev_seq_num);
		zassert_equal(packet->header.ts - DELTA_TS, prev_ts);
	}
	first_packet = false;
	prev_seq_num = packet->header.seq;
	prev_ts = packet->header.ts;

	zassert_equal(rtp_header_get_v(&packet->header), RTP_VERSION);
	zassert_equal(rtp_header_get_m(&packet->header), marker ? RTP_MARKER : 0);
	if (padding > 0) {
		zassert_equal(rtp_header_get_p(&packet->header), 1);
	} else {
		zassert_equal(rtp_header_get_p(&packet->header), 0);
	}

	if (header_extension) {
		zassert_equal(rtp_header_get_x(&packet->header), 1);
		zassert_equal(x_hdr.definition, packet->header.header_extension.definition);
		zassert_equal(x_hdr.length, packet->header.header_extension.length);
		zassert_mem_equal(x_hdr.data, packet->header.header_extension.data,
				  packet->header.header_extension.length * sizeof(uint32_t));
	} else {
		zassert_equal(rtp_header_get_x(&packet->header), 0);
	}

#if CONFIG_RTP_MAX_CSRC_COUNT > 0
	zassert_equal(rtp_header_get_cc(&packet->header), 1);
	zassert_equal(packet->header.csrc[0], CSRC);
#endif
	zassert_equal(rtp_header_get_pt(&packet->header), PAYLOAD_TYPE);

	if (zero_payload) {
		zassert_equal(packet->payload_len, 0);
	} else {
		zassert_equal(packet->payload_len, payload_len);
		zassert_mem_equal(packet->payload, payload, payload_len);
	}

	n_received++;
	k_sem_give(&rtp_rx_sem);
}

ZTEST(rtp_tests, test_api)
{
	/* Initialising NULL */
	zassert_not_ok(
		rtp_session_init(NULL, NULL, NULL, RTP_ROLE_BOTH, 0, NULL, NULL, TRANSPORT_TYPE));
	zassert_not_ok(rtp_session_start(NULL));
	zassert_not_ok(rtp_session_stop(NULL));
	zassert_not_ok(rtp_session_send(NULL, NULL, 0, 0, 0, 0, NULL, NULL));
	zassert_not_ok(rtp_session_send_simple(NULL, NULL, 0, 0));

	/* Initialise header extension with data not aligned to uint32_t */
	zassert_not_ok(rtp_init_header_extension(&x_hdr, 0xBEEF, x_data, 1));

#if CONFIG_RTP_MAX_CSRC_COUNT > 0
	for (size_t i = 0; i < CONFIG_RTP_MAX_CSRC_COUNT; i++) {
		zassert_ok(rtp_session_add_csrc(&test_rtp_session, CSRC + i));
	}

	/* Can't add more than CONFIG_RTP_MAX_CSRC_COUNT csrcs */
	zassert_not_ok(rtp_session_add_csrc(&test_rtp_session, CSRC - 1));

	zassert_ok(rtp_session_remove_csrc(&test_rtp_session, CSRC));
	zassert_not_ok(rtp_session_remove_csrc(&test_rtp_session, CSRC - 1));
#endif

	/* Starting rx session twice */
	zassert_ok(rtp_session_start(&test_rtp_session));
	zassert_not_ok(rtp_session_start(&test_rtp_session));

	/* Stopping session and restarting it */
	zassert_ok(rtp_session_stop(&test_rtp_session));
	zassert_ok(rtp_session_start(&test_rtp_session));
}

ZTEST(rtp_tests, test_loopback)
{
	uint32_t timestamp;

	zassert_ok(rtp_session_start(&test_rtp_session));

#if CONFIG_RTP_MAX_CSRC_COUNT > 0
	zassert_ok(rtp_session_add_csrc(&test_rtp_session, CSRC));
#endif

	/* Send simple RTP packets */

	k_sem_reset(&rtp_rx_sem);
	for (size_t i = 0; i < N_PACKETS; i++) {
		zassert_ok(rtp_session_send_simple(&test_rtp_session, (void *)payload, payload_len,
						   DELTA_TS));

		zassert_ok(k_sem_take(&rtp_rx_sem, RX_TIMEOUT));
	}

	zassert_equal(n_received, N_PACKETS);

	/* Send RTP packets with a header extension and padding */

	zassert_ok(rtp_init_header_extension(&x_hdr, 0xBEEF, x_data, sizeof(x_data)));

	k_sem_reset(&rtp_rx_sem);
	n_received = 0;
	padding = true;
	header_extension = true;
	marker = true;
	for (size_t i = 0; i < N_PACKETS; i++) {
		zassert_ok(rtp_session_send(&test_rtp_session, (void *)payload, payload_len,
					    DELTA_TS, N_PADDING, RTP_MARKER, &x_hdr, &timestamp));
		zassert_equal(timestamp, test_rtp_session.timestamp - DELTA_TS);
		zassert_ok(k_sem_take(&rtp_rx_sem, RX_TIMEOUT));
	}

	zassert_equal(n_received, N_PACKETS);

	/* Send zero-payload RTP packets */
	zero_payload = true;
	zassert_ok(rtp_session_send(&test_rtp_session, NULL, 0, 0, N_PADDING, RTP_MARKER, &x_hdr,
				    NULL));
	zassert_ok(k_sem_take(&rtp_rx_sem, RX_TIMEOUT));
}

static struct net_sockaddr_storage test_sockaddr;

/* Initialize the session (and SRTP when enabled); also used to verify
 * re-initialization of an SRTP protected session.
 */
static void test_session_init(void)
{
	struct net_if *iface;

	iface = net_if_lookup_by_dev(device_get_binding("lo"));
	zassert_not_null(iface);

	zassert_ok(rtp_session_init(&test_rtp_session, iface, (struct net_sockaddr *)&test_sockaddr,
				    RTP_ROLE_BOTH, PAYLOAD_TYPE, rtp_cb, NULL, TRANSPORT_TYPE));

#ifdef CONFIG_SRTP
	struct srtp_policy policy = {
#if defined(CONFIG_RTP_LOOPBACK_TEST_SRTP_GCM_256)
		.cipher = SRTP_CIPHER_AES_256_GCM,
		.auth = SRTP_AUTH_NULL,
		.master_key_len = SRTP_AES_256_KEY_LEN,
		.master_salt_len = SRTP_AES_GCM_SALT_LEN,
#elif defined(CONFIG_RTP_LOOPBACK_TEST_SRTP_GCM)
		.cipher = SRTP_CIPHER_AES_128_GCM,
		.auth = SRTP_AUTH_NULL,
		.master_key_len = SRTP_AES_128_KEY_LEN,
		.master_salt_len = SRTP_AES_GCM_SALT_LEN,
#else
		.cipher = SRTP_CIPHER_AES_128_CM,
		.auth = SRTP_AUTH_HMAC_SHA1_80,
		.master_key_len = SRTP_AES_128_KEY_LEN,
		.master_salt_len = SRTP_MASTER_SALT_LEN,
#endif
		.master_key = srtp_master_key,
		.master_salt = srtp_master_salt,
	};

	zassert_ok(rtp_session_set_srtp(&test_rtp_session, &policy, &policy, &srtp_ctx));
#endif /* CONFIG_SRTP */
}

#ifdef CONFIG_SRTP
ZTEST(rtp_tests, test_srtp_lifecycle)
{
	uint16_t seq_before;

	zassert_ok(rtp_session_start(&test_rtp_session));

	k_sem_reset(&rtp_rx_sem);
	n_received = 0;
	first_packet = true;
	padding = false;
	header_extension = false;
	marker = false;
	zero_payload = false;

	zassert_ok(rtp_session_send_simple(&test_rtp_session, payload, payload_len, DELTA_TS));
	zassert_ok(k_sem_take(&rtp_rx_sem, RX_TIMEOUT));

	/* Restarting without re-initialization preserves the sequence number,
	 * keeping the SRTP packet index monotonic under the same master key.
	 */
	seq_before = test_rtp_session.sequence_number;
	zassert_ok(rtp_session_stop(&test_rtp_session));
	zassert_ok(rtp_session_start(&test_rtp_session));
	zassert_equal(test_rtp_session.sequence_number, seq_before);

	first_packet = true;
	zassert_ok(rtp_session_send_simple(&test_rtp_session, payload, payload_len, DELTA_TS));
	zassert_ok(k_sem_take(&rtp_rx_sem, RX_TIMEOUT));

	/* SRTP is cleared before re-initialization, then installed again
	 * with a fresh master key for the new SSRC.
	 */
	zassert_ok(rtp_session_stop(&test_rtp_session));
	zassert_ok(rtp_session_clear_srtp(&test_rtp_session));
	srtp_master_key[0]++;
	test_session_init();
	zassert_ok(rtp_session_start(&test_rtp_session));

	first_packet = true;
	zassert_ok(rtp_session_send_simple(&test_rtp_session, payload, payload_len, DELTA_TS));
	zassert_ok(k_sem_take(&rtp_rx_sem, RX_TIMEOUT));
}

static void inject_datagram(const uint8_t *data, size_t len)
{
	struct net_sockaddr_storage local = test_sockaddr;
	struct net_context *ctx;
	size_t addrlen;

	/* Any local port, in the family rtp_tests_setup() picked */
	if (IS_ENABLED(CONFIG_NET_IPV4)) {
		net_sin(net_sad(&local))->sin_port = 0;
		addrlen = sizeof(struct net_sockaddr_in);
	} else {
		net_sin6(net_sad(&local))->sin6_port = 0;
		addrlen = sizeof(struct net_sockaddr_in6);
	}

	zassert_ok(net_context_get(local.ss_family, NET_SOCK_DGRAM, NET_IPPROTO_UDP, &ctx));
	zassert_ok(net_context_bind(ctx, net_sad(&local), addrlen));
	zassert_equal(net_context_sendto(ctx, data, len, net_sad(&test_sockaddr), addrlen, NULL,
					 K_NO_WAIT, NULL),
		      len);
	zassert_ok(net_context_put(ctx));
}

/* Datagrams that are not valid SRTP for the session are dropped without
 * reaching the application, and reception continues afterwards.
 */
ZTEST(rtp_tests, test_srtp_rx_hostile)
{
	static uint8_t junk[1024];

	zassert_ok(rtp_session_start(&test_rtp_session));

	k_sem_reset(&rtp_rx_sem);
	n_received = 0;
	first_packet = true;
	padding = false;
	header_extension = false;
	marker = false;
	zero_payload = false;

	/* Shorter than an RTP header */
	memset(junk, 0xa5, sizeof(junk));
	inject_datagram(junk, 4);

	/* An RTP header from an unknown source with a bogus tag */
	junk[0] = 0x80;
	junk[1] = PAYLOAD_TYPE;
	inject_datagram(junk, 200);

	/* The session's own source with a CSRC count past the end */
	junk[0] = 0x8f;
	sys_put_be32(test_rtp_session.ssrc, &junk[8]);
	inject_datagram(junk, 40);

#if defined(CONFIG_SRTP_NET_PKT_BUF_SIZE) && CONFIG_SRTP_NET_PKT_BUF_SIZE < 1024
	/* Larger than the net_pkt transport staging buffer */
	junk[0] = 0x80;
	inject_datagram(junk, sizeof(junk));
#endif

	zassert_equal(k_sem_take(&rtp_rx_sem, RX_TIMEOUT), -EAGAIN);
	zassert_equal(n_received, 0);

	zassert_ok(rtp_session_send_simple(&test_rtp_session, payload, payload_len, DELTA_TS));
	zassert_ok(k_sem_take(&rtp_rx_sem, RX_TIMEOUT));
}
#endif /* CONFIG_SRTP */

static void *rtp_tests_setup(void)
{
	if (IS_ENABLED(CONFIG_NET_IPV4)) {
		struct net_sockaddr_in *sockaddr_in = (struct net_sockaddr_in *)&test_sockaddr;
		struct net_in_addr test_in_addr;

		zassert_ok(net_addr_pton(NET_AF_INET, LOCALHOST_ADDR, &test_in_addr));

		sockaddr_in->sin_family = NET_AF_INET;
		sockaddr_in->sin_addr = test_in_addr;
		sockaddr_in->sin_port = net_htons(RTP_PORT);
	} else {
		struct net_sockaddr_in6 *sockaddr_in6 = (struct net_sockaddr_in6 *)&test_sockaddr;
		struct net_in6_addr test_in6_addr;

		zassert_ok(net_addr_pton(NET_AF_INET6, LOCALHOST_ADDR6, &test_in6_addr));

		sockaddr_in6->sin6_family = NET_AF_INET6;
		sockaddr_in6->sin6_addr = test_in6_addr;
		sockaddr_in6->sin6_port = net_htons(RTP_PORT);
	}

	test_session_init();

	return NULL;
}

static void rtp_tests_after(void *f)
{
	ARG_UNUSED(f);

	zassert_ok(rtp_session_stop(&test_rtp_session));
}

ZTEST_SUITE(rtp_tests, NULL, rtp_tests_setup, NULL, rtp_tests_after, NULL);
```

## src/sine.h
```c
/*
 *  SPDX-FileCopyrightText: 2026 Basalte bv
 *
 *  SPDX-License-Identifier: Apache-2.0
 */

#ifndef TESTS_NET_RTP_LOOPBACK_SINE_H_
#define TESTS_NET_RTP_LOOPBACK_SINE_H_

#include <zephyr/kernel.h>

/** IPv6 header does not allow 1440B payloads due to its larger IP header. A smaller payload of only
 * 1 period (480B) instead of 3 (1440B) is used when IPv6 is selected
 */
#ifdef CONFIG_NET_IPV4
static int8_t sine_100_48000_8_mono[] = {
	0,    1,    3,    4,    6,    8,    9,    11,   13,   14,   16,   18,   19,   21,   23,
	24,   26,   28,   29,   31,   32,   34,   36,   37,   39,   40,   42,   43,   45,   47,
	48,   50,   51,   53,   54,   56,   57,   59,   60,   62,   63,   64,   66,   67,   69,
	70,   71,   73,   74,   75,   77,   78,   79,   81,   82,   83,   84,   86,   87,   88,
	89,   90,   92,   93,   94,   95,   96,   97,   98,   99,   100,  101,  102,  103,  104,
	105,  106,  107,  108,  109,  109,  110,  111,  112,  113,  113,  114,  115,  116,  116,
	117,  117,  118,  119,  119,  120,  120,  121,  121,  122,  122,  123,  123,  123,  124,
	124,  124,  125,  125,  125,  125,  126,  126,  126,  126,  126,  126,  126,  126,  126,
	127,  126,  126,  126,  126,  126,  126,  126,  126,  126,  125,  125,  125,  125,  124,
	124,  124,  123,  123,  123,  122,  122,  121,  121,  120,  120,  119,  119,  118,  117,
	117,  116,  116,  115,  114,  113,  113,  112,  111,  110,  109,  109,  108,  107,  106,
	105,  104,  103,  102,  101,  100,  99,   98,   97,   96,   95,   94,   93,   92,   90,
	89,   88,   87,   86,   84,   83,   82,   81,   79,   78,   77,   75,   74,   73,   71,
	70,   69,   67,   66,   64,   63,   62,   60,   59,   57,   56,   54,   53,   51,   50,
	48,   47,   45,   43,   42,   40,   39,   37,   36,   34,   32,   31,   29,   28,   26,
	24,   23,   21,   19,   18,   16,   14,   13,   11,   9,    8,    6,    4,    3,    1,
	0,    -1,   -3,   -4,   -6,   -8,   -9,   -11,  -13,  -14,  -16,  -18,  -19,  -21,  -23,
	-24,  -26,  -28,  -29,  -31,  -32,  -34,  -36,  -37,  -39,  -40,  -42,  -43,  -45,  -47,
	-48,  -50,  -51,  -53,  -54,  -56,  -57,  -59,  -60,  -62,  -63,  -64,  -66,  -67,  -69,
	-70,  -71,  -73,  -74,  -75,  -77,  -78,  -79,  -81,  -82,  -83,  -84,  -86,  -87,  -88,
	-89,  -90,  -92,  -93,  -94,  -95,  -96,  -97,  -98,  -99,  -100, -101, -102, -103, -104,
	-105, -106, -107, -108, -109, -109, -110, -111, -112, -113, -113, -114, -115, -116, -116,
	-117, -117, -118, -119, -119, -120, -120, -121, -121, -122, -122, -123, -123, -123, -124,
	-124, -124, -125, -125, -125, -125, -126, -126, -126, -126, -126, -126, -126, -126, -126,
	-127, -126, -126, -126, -126, -126, -126, -126, -126, -126, -125, -125, -125, -125, -124,
	-124, -124, -123, -123, -123, -122, -122, -121, -121, -120, -120, -119, -119, -118, -117,
	-117, -116, -116, -115, -114, -113, -113, -112, -111, -110, -109, -109, -108, -107, -106,
	-105, -104, -103, -102, -101, -100, -99,  -98,  -97,  -96,  -95,  -94,  -93,  -92,  -90,
	-89,  -88,  -87,  -86,  -84,  -83,  -82,  -81,  -79,  -78,  -77,  -75,  -74,  -73,  -71,
	-70,  -69,  -67,  -66,  -64,  -63,  -62,  -60,  -59,  -57,  -56,  -54,  -53,  -51,  -50,
	-48,  -47,  -45,  -43,  -42,  -40,  -39,  -37,  -36,  -34,  -32,  -31,  -29,  -28,  -26,
	-24,  -23,  -21,  -19,  -18,  -16,  -14,  -13,  -11,  -9,   -8,   -6,   -4,   -3,   -1,
	0,    1,    3,    4,    6,    8,    9,    11,   13,   14,   16,   18,   19,   21,   23,
	24,   26,   28,   29,   31,   32,   34,   36,   37,   39,   40,   42,   43,   45,   47,
	48,   50,   51,   53,   54,   56,   57,   59,   60,   62,   63,   64,   66,   67,   69,
	70,   71,   73,   74,   75,   77,   78,   79,   81,   82,   83,   84,   86,   87,   88,
	89,   90,   92,   93,   94,   95,   96,   97,   98,   99,   100,  101,  102,  103,  104,
	105,  106,  107,  108,  109,  109,  110,  111,  112,  113,  113,  114,  115,  116,  116,
	117,  117,  118,  119,  119,  120,  120,  121,  121,  122,  122,  123,  123,  123,  124,
	124,  124,  125,  125,  125,  125,  126,  126,  126,  126,  126,  126,  126,  126,  126,
	127,  126,  126,  126,  126,  126,  126,  126,  126,  126,  125,  125,  125,  125,  124,
	124,  124,  123,  123,  123,  122,  122,  121,  121,  120,  120,  119,  119,  118,  117,
	117,  116,  116,  115,  114,  113,  113,  112,  111,  110,  109,  109,  108,  107,  106,
	105,  104,  103,  102,  101,  100,  99,   98,   97,   96,   95,   94,   93,   92,   90,
	89,   88,   87,   86,   84,   83,   82,   81,   79,   78,   77,   75,   74,   73,   71,
	70,   69,   67,   66,   64,   63,   62,   60,   59,   57,   56,   54,   53,   51,   50,
	48,   47,   45,   43,   42,   40,   39,   37,   36,   34,   32,   31,   29,   28,   26,
	24,   23,   21,   19,   18,   16,   14,   13,   11,   9,    8,    6,    4,    3,    1,
	0,    -1,   -3,   -4,   -6,   -8,   -9,   -11,  -13,  -14,  -16,  -18,  -19,  -21,  -23,
	-24,  -26,  -28,  -29,  -31,  -32,  -34,  -36,  -37,  -39,  -40,  -42,  -43,  -45,  -47,
	-48,  -50,  -51,  -53,  -54,  -56,  -57,  -59,  -60,  -62,  -63,  -64,  -66,  -67,  -69,
	-70,  -71,  -73,  -74,  -75,  -77,  -78,  -79,  -81,  -82,  -83,  -84,  -86,  -87,  -88,
	-89,  -90,  -92,  -93,  -94,  -95,  -96,  -97,  -98,  -99,  -100, -101, -102, -103, -104,
	-105, -106, -107, -108, -109, -109, -110, -111, -112, -113, -113, -114, -115, -116, -116,
	-117, -117, -118, -119, -119, -120, -120, -121, -121, -122, -122, -123, -123, -123, -124,
	-124, -124, -125, -125, -125, -125, -126, -126, -126, -126, -126, -126, -126, -126, -126,
	-127, -126, -126, -126, -126, -126, -126, -126, -126, -126, -125, -125, -125, -125, -124,
	-124, -124, -123, -123, -123, -122, -122, -121, -121, -120, -120, -119, -119, -118, -117,
	-117, -116, -116, -115, -114, -113, -113, -112, -111, -110, -109, -109, -108, -107, -106,
	-105, -104, -103, -102, -101, -100, -99,  -98,  -97,  -96,  -95,  -94,  -93,  -92,  -90,
	-89,  -88,  -87,  -86,  -84,  -83,  -82,  -81,  -79,  -78,  -77,  -75,  -74,  -73,  -71,
	-70,  -69,  -67,  -66,  -64,  -63,  -62,  -60,  -59,  -57,  -56,  -54,  -53,  -51,  -50,
	-48,  -47,  -45,  -43,  -42,  -40,  -39,  -37,  -36,  -34,  -32,  -31,  -29,  -28,  -26,
	-24,  -23,  -21,  -19,  -18,  -16,  -14,  -13,  -11,  -9,   -8,   -6,   -4,   -3,   -1,
	0,    1,    3,    4,    6,    8,    9,    11,   13,   14,   16,   18,   19,   21,   23,
	24,   26,   28,   29,   31,   32,   34,   36,   37,   39,   40,   42,   43,   45,   47,
	48,   50,   51,   53,   54,   56,   57,   59,   60,   62,   63,   64,   66,   67,   69,
	70,   71,   73,   74,   75,   77,   78,   79,   81,   82,   83,   84,   86,   87,   88,
	89,   90,   92,   93,   94,   95,   96,   97,   98,   99,   100,  101,  102,  103,  104,
	105,  106,  107,  108,  109,  109,  110,  111,  112,  113,  113,  114,  115,  116,  116,
	117,  117,  118,  119,  119,  120,  120,  121,  121,  122,  122,  123,  123,  123,  124,
	124,  124,  125,  125,  125,  125,  126,  126,  126,  126,  126,  126,  126,  126,  126,
	127,  126,  126,  126,  126,  126,  126,  126,  126,  126,  125,  125,  125,  125,  124,
	124,  124,  123,  123,  123,  122,  122,  121,  121,  120,  120,  119,  119,  118,  117,
	117,  116,  116,  115,  114,  113,  113,  112,  111,  110,  109,  109,  108,  107,  106,
	105,  104,  103,  102,  101,  100,  99,   98,   97,   96,   95,   94,   93,   92,   90,
	89,   88,   87,   86,   84,   83,   82,   81,   79,   78,   77,   75,   74,   73,   71,
	70,   69,   67,   66,   64,   63,   62,   60,   59,   57,   56,   54,   53,   51,   50,
	48,   47,   45,   43,   42,   40,   39,   37,   36,   34,   32,   31,   29,   28,   26,
	24,   23,   21,   19,   18,   16,   14,   13,   11,   9,    8,    6,    4,    3,    1,
	0,    -1,   -3,   -4,   -6,   -8,   -9,   -11,  -13,  -14,  -16,  -18,  -19,  -21,  -23,
	-24,  -26,  -28,  -29,  -31,  -32,  -34,  -36,  -37,  -39,  -40,  -42,  -43,  -45,  -47,
	-48,  -50,  -51,  -53,  -54,  -56,  -57,  -59,  -60,  -62,  -63,  -64,  -66,  -67,  -69,
	-70,  -71,  -73,  -74,  -75,  -77,  -78,  -79,  -81,  -82,  -83,  -84,  -86,  -87,  -88,
	-89,  -90,  -92,  -93,  -94,  -95,  -96,  -97,  -98,  -99,  -100, -101, -102, -103, -104,
	-105, -106, -107, -108, -109, -109, -110, -111, -112, -113, -113, -114, -115, -116, -116,
	-117, -117, -118, -119, -119, -120, -120, -121, -121, -122, -122, -123, -123, -123, -124,
	-124, -124, -125, -125, -125, -125, -126, -126, -126, -126, -126, -126, -126, -126, -126,
	-127, -126, -126, -126, -126, -126, -126, -126, -126, -126, -125, -125, -125, -125, -124,
	-124, -124, -123, -123, -123, -122, -122, -121, -121, -120, -120, -119, -119, -118, -117,
	-117, -116, -116, -115, -114, -113, -113, -112, -111, -110, -109, -109, -108, -107, -106,
	-105, -104, -103, -102, -101, -100, -99,  -98,  -97,  -96,  -95,  -94,  -93,  -92,  -90,
	-89,  -88,  -87,  -86,  -84,  -83,  -82,  -81,  -79,  -78,  -77,  -75,  -74,  -73,  -71,
	-70,  -69,  -67,  -66,  -64,  -63,  -62,  -60,  -59,  -57,  -56,  -54,  -53,  -51,  -50,
	-48,  -47,  -45,  -43,  -42,  -40,  -39,  -37,  -36,  -34,  -32,  -31,  -29,  -28,  -26,
	-24,  -23,  -21,  -19,  -18,  -16,  -14,  -13,  -11,  -9,   -8,   -6,   -4,   -3,   -1,
};
#else
static int8_t sine_100_48000_8_mono[] = {
	0,    1,    3,    4,    6,    8,    9,    11,   13,   14,   16,   18,   19,   21,   23,
	24,   26,   28,   29,   31,   32,   34,   36,   37,   39,   40,   42,   43,   45,   47,
	48,   50,   51,   53,   54,   56,   57,   59,   60,   62,   63,   64,   66,   67,   69,
	70,   71,   73,   74,   75,   77,   78,   79,   81,   82,   83,   84,   86,   87,   88,
	89,   90,   92,   93,   94,   95,   96,   97,   98,   99,   100,  101,  102,  103,  104,
	105,  106,  107,  108,  109,  109,  110,  111,  112,  113,  113,  114,  115,  116,  116,
	117,  117,  118,  119,  119,  120,  120,  121,  121,  122,  122,  123,  123,  123,  124,
	124,  124,  125,  125,  125,  125,  126,  126,  126,  126,  126,  126,  126,  126,  126,
	127,  126,  126,  126,  126,  126,  126,  126,  126,  126,  125,  125,  125,  125,  124,
	124,  124,  123,  123,  123,  122,  122,  121,  121,  120,  120,  119,  119,  118,  117,
	117,  116,  116,  115,  114,  113,  113,  112,  111,  110,  109,  109,  108,  107,  106,
	105,  104,  103,  102,  101,  100,  99,   98,   97,   96,   95,   94,   93,   92,   90,
	89,   88,   87,   86,   84,   83,   82,   81,   79,   78,   77,   75,   74,   73,   71,
	70,   69,   67,   66,   64,   63,   62,   60,   59,   57,   56,   54,   53,   51,   50,
	48,   47,   45,   43,   42,   40,   39,   37,   36,   34,   32,   31,   29,   28,   26,
	24,   23,   21,   19,   18,   16,   14,   13,   11,   9,    8,    6,    4,    3,    1,
	0,    -1,   -3,   -4,   -6,   -8,   -9,   -11,  -13,  -14,  -16,  -18,  -19,  -21,  -23,
	-24,  -26,  -28,  -29,  -31,  -32,  -34,  -36,  -37,  -39,  -40,  -42,  -43,  -45,  -47,
	-48,  -50,  -51,  -53,  -54,  -56,  -57,  -59,  -60,  -62,  -63,  -64,  -66,  -67,  -69,
	-70,  -71,  -73,  -74,  -75,  -77,  -78,  -79,  -81,  -82,  -83,  -84,  -86,  -87,  -88,
	-89,  -90,  -92,  -93,  -94,  -95,  -96,  -97,  -98,  -99,  -100, -101, -102, -103, -104,
	-105, -106, -107, -108, -109, -109, -110, -111, -112, -113, -113, -114, -115, -116, -116,
	-117, -117, -118, -119, -119, -120, -120, -121, -121, -122, -122, -123, -123, -123, -124,
	-124, -124, -125, -125, -125, -125, -126, -126, -126, -126, -126, -126, -126, -126, -126,
	-127, -126, -126, -126, -126, -126, -126, -126, -126, -126, -125, -125, -125, -125, -124,
	-124, -124, -123, -123, -123, -122, -122, -121, -121, -120, -120, -119, -119, -118, -117,
	-117, -116, -116, -115, -114, -113, -113, -112, -111, -110, -109, -109, -108, -107, -106,
	-105, -104, -103, -102, -101, -100, -99,  -98,  -97,  -96,  -95,  -94,  -93,  -92,  -90,
	-89,  -88,  -87,  -86,  -84,  -83,  -82,  -81,  -79,  -78,  -77,  -75,  -74,  -73,  -71,
	-70,  -69,  -67,  -66,  -64,  -63,  -62,  -60,  -59,  -57,  -56,  -54,  -53,  -51,  -50,
	-48,  -47,  -45,  -43,  -42,  -40,  -39,  -37,  -36,  -34,  -32,  -31,  -29,  -28,  -26,
	-24,  -23,  -21,  -19,  -18,  -16,  -14,  -13,  -11,  -9,   -8,   -6,   -4,   -3,   -1,
};
#endif

#endif /* TESTS_NET_RTP_LOOPBACK_SINE_H_ */
```
