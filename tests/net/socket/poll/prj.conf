## CMakeLists.txt
```
# SPDX-License-Identifier: Apache-2.0

cmake_minimum_required(VERSION 3.28.0)
find_package(Zephyr REQUIRED HINTS $ENV{ZEPHYR_BASE})
project(socket_poll)

target_include_directories(app PRIVATE ${ZEPHYR_BASE}/subsys/net/ip)
FILE(GLOB app_sources src/*.c)
target_sources(app PRIVATE ${app_sources})
```

## prj.conf
```kconfig
# Networking config
CONFIG_NETWORKING=y
CONFIG_NET_IPV4=n
CONFIG_NET_IPV6=y
CONFIG_NET_UDP=y
CONFIG_NET_TCP=y
CONFIG_NET_SOCKETS=y
CONFIG_ZVFS_OPEN_ADD_SIZE_NET=5
CONFIG_NET_PKT_TX_COUNT=8
CONFIG_NET_PKT_RX_COUNT=8
CONFIG_NET_MAX_CONN=5

# Network driver config
CONFIG_TEST_RANDOM_GENERATOR=y

CONFIG_MAIN_STACK_SIZE=2048
CONFIG_ZTEST_STACK_SIZE=1280

CONFIG_NET_TCP_INIT_RETRANSMISSION_TIMEOUT=100

CONFIG_ZTEST=y

CONFIG_NET_TEST=y
CONFIG_NET_DRIVERS=y
CONFIG_NET_LOOPBACK=y
CONFIG_NET_TCP_MAX_RECV_WINDOW_SIZE=128
```

## src/main.c
```c
/*
 * Copyright (c) 2019 Linaro Limited
 *
 * SPDX-License-Identifier: Apache-2.0
 */

#include <zephyr/logging/log.h>
LOG_MODULE_REGISTER(net_test, CONFIG_NET_SOCKETS_LOG_LEVEL);

#include <stdio.h>
#include <zephyr/ztest_assert.h>

#include <zephyr/net/socket.h>
#include <zephyr/sys/fdtable.h>

#include "../../socket_helpers.h"

#define BUF_AND_SIZE(buf) buf, sizeof(buf) - 1
#define STRLEN(buf) (sizeof(buf) - 1)

#define TEST_STR_SMALL "test"

#define MY_IPV6_ADDR "::1"

#define ANY_PORT 0
#define SERVER_PORT 4242
#define CLIENT_PORT 9898

/* On QEMU, poll() which waits takes +10ms from the requested time. */
#define FUZZ 10

#define TCP_TEARDOWN_TIMEOUT K_SECONDS(3)

ZTEST(net_socket_poll, test_poll)
{
	int res;
	int c_sock;
	int s_sock;
	int c_sock_tcp;
	int s_sock_tcp;
	struct net_sockaddr_in6 c_addr;
	struct net_sockaddr_in6 s_addr;
	struct zsock_pollfd pollfds[2];
	struct zsock_pollfd pollout[1];
	uint32_t tstamp;
	ssize_t len;
	char buf[10];

	prepare_sock_udp_v6(MY_IPV6_ADDR, CLIENT_PORT, &c_sock, &c_addr);
	prepare_sock_udp_v6(MY_IPV6_ADDR, SERVER_PORT, &s_sock, &s_addr);
	prepare_sock_tcp_v6(MY_IPV6_ADDR, CLIENT_PORT, &c_sock_tcp, &c_addr);
	prepare_sock_tcp_v6(MY_IPV6_ADDR, SERVER_PORT, &s_sock_tcp, &s_addr);

	res = zsock_bind(s_sock, (struct net_sockaddr *)&s_addr, sizeof(s_addr));
	zassert_equal(res, 0, "bind failed");

	res = zsock_connect(c_sock, (struct net_sockaddr *)&s_addr, sizeof(s_addr));
	zassert_equal(res, 0, "connect failed");

	memset(pollfds, 0, sizeof(pollfds));
	pollfds[0].fd = c_sock;
	pollfds[0].events = ZSOCK_POLLIN;
	pollfds[1].fd = s_sock;
	pollfds[1].events = ZSOCK_POLLIN;

	/* Poll non-ready fd's with timeout of 0 */
	tstamp = k_uptime_get_32();
	res = zsock_poll(pollfds, ARRAY_SIZE(pollfds), 0);
	zassert_true(k_uptime_get_32() - tstamp <= FUZZ, "");
	zassert_equal(res, 0, "");

	zassert_equal(pollfds[0].fd, c_sock, "");
	zassert_equal(pollfds[0].events, ZSOCK_POLLIN, "");
	zassert_equal(pollfds[0].revents, 0, "");
	zassert_equal(pollfds[1].fd, s_sock, "");
	zassert_equal(pollfds[1].events, ZSOCK_POLLIN, "");
	zassert_equal(pollfds[1].revents, 0, "");


	/* Poll non-ready fd's with timeout of 30 */
	tstamp = k_uptime_get_32();
	res = zsock_poll(pollfds, ARRAY_SIZE(pollfds), 30);
	tstamp = k_uptime_get_32() - tstamp;
	zassert_true(tstamp >= 30U && tstamp <= 30 + FUZZ * 2, "tstamp %d",
		     tstamp);
	zassert_equal(res, 0, "");

	/* Send pkt for s_sock and poll with timeout of 10 */
	len = zsock_send(c_sock, BUF_AND_SIZE(TEST_STR_SMALL), 0);
	zassert_equal(len, STRLEN(TEST_STR_SMALL), "invalid send len");

	tstamp = k_uptime_get_32();
	res = zsock_poll(pollfds, ARRAY_SIZE(pollfds), 30);
	tstamp = k_uptime_get_32() - tstamp;
	zassert_true(tstamp <= FUZZ, "");
	zassert_equal(res, 1, "");

	zassert_equal(pollfds[0].fd, c_sock, "");
	zassert_equal(pollfds[0].events, ZSOCK_POLLIN, "");
	zassert_equal(pollfds[0].revents, 0, "");
	zassert_equal(pollfds[1].fd, s_sock, "");
	zassert_equal(pollfds[1].events, ZSOCK_POLLIN, "");
	zassert_equal(pollfds[1].revents, ZSOCK_POLLIN, "");


	/* Recv pkt from s_sock and ensure no poll events happen */
	len = zsock_recv(s_sock, BUF_AND_SIZE(buf), 0);
	zassert_equal(len, STRLEN(TEST_STR_SMALL), "invalid recv len");

	tstamp = k_uptime_get_32();
	res = zsock_poll(pollfds, ARRAY_SIZE(pollfds), 0);
	zassert_true(k_uptime_get_32() - tstamp <= FUZZ, "");
	zassert_equal(res, 0, "");
	zassert_equal(pollfds[1].revents, 0, "");

	/* Make sure that POLLOUT does not wait if not really needed */
	memset(pollout, 0, sizeof(pollout));
	pollout[0].fd = c_sock;
	pollout[0].events = ZSOCK_POLLOUT;

	res = zsock_connect(c_sock, (const struct net_sockaddr *)&s_addr,
			    sizeof(s_addr));
	zassert_equal(res, 0, "");

	tstamp = k_uptime_get_32();
	res = zsock_poll(pollout, ARRAY_SIZE(pollout), 200);
	zassert_true(k_uptime_get_32() - tstamp < 100, "");
	zassert_equal(res, 1, "");
	zassert_equal(pollout[0].revents, ZSOCK_POLLOUT, "");

	/* First test that TCP POLLOUT will not wait if there is enough
	 * room in TCP window
	 */
	memset(pollout, 0, sizeof(pollout));
	pollout[0].fd = c_sock_tcp;
	pollout[0].events = ZSOCK_POLLOUT;

	res = zsock_bind(s_sock_tcp, (struct net_sockaddr *)&s_addr, sizeof(s_addr));
	zassert_equal(res, 0, "");
	res = zsock_listen(s_sock_tcp, 0);
	zassert_equal(res, 0, "");

	res = zsock_connect(c_sock_tcp, (const struct net_sockaddr *)&s_addr,
			    sizeof(s_addr));
	zassert_equal(res, 0, "");

	tstamp = k_uptime_get_32();
	res = zsock_poll(pollout, ARRAY_SIZE(pollout), 200);
	zassert_true(k_uptime_get_32() - tstamp < 100, "");
	zassert_equal(res, 1, "");
	zassert_equal(pollout[0].revents, ZSOCK_POLLOUT, "");

	res = zsock_close(c_sock_tcp);
	zassert_equal(res, 0, "close failed");

	res = zsock_close(s_sock_tcp);
	zassert_equal(res, 0, "close failed");

	/* Close one socket and ensure POLLNVAL happens */
	res = zsock_close(c_sock);
	zassert_equal(res, 0, "close failed");

	tstamp = k_uptime_get_32();
	res = zsock_poll(pollfds, ARRAY_SIZE(pollfds), 0);
	zassert_true(k_uptime_get_32() - tstamp <= FUZZ, "");
	zassert_equal(res, 1, "");
	zassert_equal(pollfds[0].revents, ZSOCK_POLLNVAL, "");
	zassert_equal(pollfds[1].revents, 0, "");

	res = zsock_close(s_sock);
	zassert_equal(res, 0, "close failed");

	k_sleep(TCP_TEARDOWN_TIMEOUT);
}

#define TEST_SNDBUF_SIZE CONFIG_NET_TCP_MAX_RECV_WINDOW_SIZE

ZTEST(net_socket_poll, test_pollout_tcp)
{
	int res;
	int c_sock;
	int s_sock;
	int new_sock;
	struct net_sockaddr_in6 c_addr;
	struct net_sockaddr_in6 s_addr;
	struct zsock_pollfd pollout[1];
	char buf[TEST_SNDBUF_SIZE] = { };

	prepare_sock_tcp_v6(MY_IPV6_ADDR, CLIENT_PORT, &c_sock, &c_addr);
	prepare_sock_tcp_v6(MY_IPV6_ADDR, SERVER_PORT, &s_sock, &s_addr);

	res = zsock_bind(s_sock, (struct net_sockaddr *)&s_addr, sizeof(s_addr));
	zassert_equal(res, 0, "");
	res = zsock_listen(s_sock, 0);
	zassert_equal(res, 0, "");
	res = zsock_connect(c_sock, (const struct net_sockaddr *)&s_addr,
			    sizeof(s_addr));
	zassert_equal(res, 0, "");
	new_sock = zsock_accept(s_sock, NULL, NULL);
	zassert_true(new_sock >= 0, "");

	k_msleep(10);

	/* POLLOUT should be reported after connecting */
	memset(pollout, 0, sizeof(pollout));
	pollout[0].fd = c_sock;
	pollout[0].events = ZSOCK_POLLOUT;

	res = zsock_poll(pollout, ARRAY_SIZE(pollout), 10);
	zassert_equal(res, 1, "");
	zassert_equal(pollout[0].revents, ZSOCK_POLLOUT, "");

	/* POLLOUT should not be reported after filling the window */
	res = zsock_send(c_sock, buf, sizeof(buf), 0);
	zassert_equal(res, sizeof(buf), "");

	memset(pollout, 0, sizeof(pollout));
	pollout[0].fd = c_sock;
	pollout[0].events = ZSOCK_POLLOUT;

	res = zsock_poll(pollout, ARRAY_SIZE(pollout), 10);
	zassert_equal(res, 0, "%d", pollout[0].revents);
	zassert_equal(pollout[0].revents, 0, "");

	/* POLLOUT should be reported again after consuming the data server
	 * side.
	 */
	res = zsock_recv(new_sock, buf, sizeof(buf), 0);
	zassert_equal(res, sizeof(buf), "");

	memset(pollout, 0, sizeof(pollout));
	pollout[0].fd = c_sock;
	pollout[0].events = ZSOCK_POLLOUT;

	/* Wait longer this time to give TCP stack a chance to send ZWP. */
	res = zsock_poll(pollout, ARRAY_SIZE(pollout), 500);
	zassert_equal(res, 1, "");
	zassert_equal(pollout[0].revents, ZSOCK_POLLOUT, "");

	k_msleep(10);

	/* Finalize the test */
	res = zsock_close(c_sock);
	zassert_equal(res, 0, "close failed");
	res = zsock_close(s_sock);
	zassert_equal(res, 0, "close failed");
	res = zsock_close(new_sock);
	zassert_equal(res, 0, "close failed");
}

#define CLOSE_POLL_TIMEOUT_MS 2000
#define CLOSE_POLL_WAKE_MS 1000U
#define CLOSE_POLL_SETTLE_MS 20
#define CLOSE_POLL_STACK_SIZE 2048

struct close_poller {
	int sock;
	int res;
	uint32_t elapsed;
};

static struct close_poller close_pollers[2];
static struct k_thread close_poll_threads[2];
static K_THREAD_STACK_ARRAY_DEFINE(close_poll_stacks, 2, CLOSE_POLL_STACK_SIZE);

static void close_poller_thread(void *p1, void *p2, void *p3)
{
	struct close_poller *poller = p1;
	struct zsock_pollfd pfd = {
		.fd = poller->sock,
		.events = ZSOCK_POLLIN,
	};
	uint32_t start = k_uptime_get_32();

	ARG_UNUSED(p2);
	ARG_UNUSED(p3);

	poller->res = zsock_poll(&pfd, 1, CLOSE_POLL_TIMEOUT_MS);
	poller->elapsed = k_uptime_get_32() - start;
}

ZTEST(net_socket_poll, test_poll_close_wakes_every_poller)
{
	int res;
	int sock;
	struct net_sockaddr_in6 addr;

	prepare_sock_udp_v6(MY_IPV6_ADDR, ANY_PORT, &sock, &addr);
	res = zsock_bind(sock, (struct net_sockaddr *)&addr, sizeof(addr));
	zassert_equal(res, 0, "bind failed");

	for (size_t i = 0; i < ARRAY_SIZE(close_pollers); i++) {
		close_pollers[i].sock = sock;
		close_pollers[i].res = -1;
		(void)k_thread_create(&close_poll_threads[i], close_poll_stacks[i],
				      K_THREAD_STACK_SIZEOF(close_poll_stacks[i]),
				      close_poller_thread, &close_pollers[i], NULL, NULL,
				      K_PRIO_PREEMPT(1), 0, K_NO_WAIT);
	}

	(void)k_sleep(K_MSEC(CLOSE_POLL_SETTLE_MS));
	res = zsock_close(sock);

	for (size_t i = 0; i < ARRAY_SIZE(close_poll_threads); i++) {
		zassert_equal(k_thread_join(&close_poll_threads[i], K_FOREVER), 0);
	}

	zassert_equal(res, 0, "close failed");

	for (size_t i = 0; i < ARRAY_SIZE(close_pollers); i++) {
		zassert_true(close_pollers[i].res >= 0, "poller %zu: %d", i,
			     close_pollers[i].res);
		zassert_true(close_pollers[i].elapsed < CLOSE_POLL_WAKE_MS,
			     "poller %zu woke after %u ms", i, close_pollers[i].elapsed);
	}
}

ZTEST_SUITE(net_socket_poll, NULL, NULL, NULL, NULL, NULL);
```
