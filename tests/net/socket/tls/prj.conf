## CMakeLists.txt
```
# SPDX-License-Identifier: Apache-2.0

cmake_minimum_required(VERSION 3.28.0)
find_package(Zephyr REQUIRED HINTS $ENV{ZEPHYR_BASE})
project(socket_tls)

target_include_directories(app PRIVATE ${ZEPHYR_BASE}/subsys/net/ip)
target_include_directories(app PRIVATE ${ZEPHYR_BASE}/subsys/net/lib/sockets)
FILE(GLOB app_sources src/*.c)
target_sources(app PRIVATE ${app_sources})
```

## prj.conf
```kconfig
# Setup for self-contained net testing without requiring a SLIP driver
CONFIG_SMP=n
CONFIG_NET_TEST=y

# General config
CONFIG_REQUIRES_FULL_LIBC=y

# Networking config
CONFIG_NETWORKING=y
CONFIG_NET_IPV4=y
CONFIG_NET_IPV6=y
CONFIG_NET_TCP=y
CONFIG_NET_UDP=y
CONFIG_NET_SOCKETS=y
CONFIG_NET_SOCKETS_SOCKOPT_TLS=y
CONFIG_NET_SOCKETS_ENABLE_DTLS=y
CONFIG_NET_SOCKETS_DTLS_SENDMSG_BUF_SIZE=128
CONFIG_NET_SOCKETS_TLS_MAX_CONTEXTS=4
CONFIG_TLS_MAX_CREDENTIALS_NUMBER=32
CONFIG_NET_CONTEXT_RCVTIMEO=y
CONFIG_NET_CONTEXT_SNDTIMEO=y
CONFIG_NET_CONTEXT_RCVBUF=y
CONFIG_ZVFS_OPEN_ADD_SIZE_NET=10

# Keep timings short for the test
CONFIG_NET_TCP_TIME_WAIT_DELAY=10
CONFIG_NET_SOCKETS_CONNECT_TIMEOUT=200
CONFIG_NET_SOCKETS_TLS_CONNECT_TIMEOUT=200
CONFIG_NET_SOCKETS_DTLS_TIMEOUT=1000

# Network driver config
CONFIG_NET_DRIVERS=y
CONFIG_NET_LOOPBACK=y
CONFIG_NET_LOOPBACK_SIMULATE_PACKET_DROP=y
CONFIG_TEST_RANDOM_GENERATOR=y

CONFIG_MAIN_STACK_SIZE=4096
CONFIG_TEST_USERSPACE=y

# The test requires lot of bufs
CONFIG_NET_MAX_CONTEXTS=20
CONFIG_NET_PKT_TX_COUNT=24
CONFIG_NET_PKT_RX_COUNT=24
CONFIG_NET_BUF_TX_COUNT=32
CONFIG_NET_BUF_RX_COUNT=32

CONFIG_ZTEST=y
CONFIG_ZTEST_STACK_SIZE=4096

CONFIG_MBEDTLS_ENABLE_HEAP=y
CONFIG_MBEDTLS_HEAP_SIZE=30000
CONFIG_MBEDTLS_SSL_DTLS_CONNECTION_ID=y
CONFIG_MBEDTLS_PSA_KEY_SLOT_COUNT=32
CONFIG_MBEDTLS_CIPHERSUITE_TLS_PSK_WITH_AES_256_CBC_SHA384=y

# For tests verifying certificate validation
CONFIG_MBEDTLS_X509_CRT_PARSE_C=y
CONFIG_PSA_WANT_KEY_TYPE_RSA_PUBLIC_KEY=y
CONFIG_PSA_WANT_KEY_TYPE_RSA_KEY_PAIR_IMPORT=y
CONFIG_PSA_WANT_ALG_RSA_PKCS1V15_SIGN=y
```

## overlay-wolfssl.conf
```kconfig
CONFIG_MBEDTLS=n
CONFIG_POSIX_API=y
CONFIG_POSIX_CLOCK=y
CONFIG_PTHREAD_IPC=y
CONFIG_WOLFSSL=y
CONFIG_WOLFSSL_DTLS=y
CONFIG_COMMON_LIBC_MALLOC_ARENA_SIZE=65536
CONFIG_WOLFSSL_ALPN=y
CONFIG_WOLFSSL_PSK=y
CONFIG_WOLFSSL_ALPN=y
```

## src/certificates.h
```c
/*
 * Copyright (c) 2024 Nordic Semiconductor
 *
 * SPDX-License-Identifier: Apache-2.0
 */

/* Default certificates used in tests, inherited from the echo samples. */

static const unsigned char ca[] = {
#include "ca.inc"
};

static const unsigned char server[] = {
#include "server.inc"
};

static const unsigned char server_privkey[] = {
#include "server_privkey.inc"
};
```

## src/certificates_with_policy.h
```c
/*
 * Copyright (c) 2024 Nordic Semiconductor
 *
 * SPDX-License-Identifier: Apache-2.0
 */

/* Credentials specifically generated for the TLS certificate extension callback
 * test case. The root CA certificate contains certificate policy extension
 * (generated with '-addext "certificatePolicies=critical,1.2.3.4"' option), not
 * handled by mbed TLS.
 */

static const unsigned char ca_ext[] = {
	0x30, 0x82, 0x03, 0x20, 0x30, 0x82, 0x02, 0x08,
	0xa0, 0x03, 0x02, 0x01, 0x02, 0x02, 0x14, 0x6c,
	0x86, 0x38, 0x44, 0x61, 0x98, 0x6f, 0x2d, 0xe6,
	0x39, 0x3e, 0x24, 0xaa, 0x1f, 0x48, 0xcd, 0x39,
	0xb0, 0xea, 0x09, 0x30, 0x0d, 0x06, 0x09, 0x2a,
	0x86, 0x48, 0x86, 0xf7, 0x0d, 0x01, 0x01, 0x0b,
	0x05, 0x00, 0x30, 0x14, 0x31, 0x12, 0x30, 0x10,
	0x06, 0x03, 0x55, 0x04, 0x03, 0x0c, 0x09, 0x65,
	0x78, 0x61, 0x6d, 0x70, 0x6c, 0x65, 0x43, 0x41,
	0x30, 0x20, 0x17, 0x0d, 0x32, 0x34, 0x31, 0x31,
	0x32, 0x31, 0x31, 0x35, 0x34, 0x31, 0x32, 0x38,
	0x5a, 0x18, 0x0f, 0x32, 0x31, 0x32, 0x34, 0x31,
	0x30, 0x32, 0x38, 0x31, 0x35, 0x34, 0x31, 0x32,
	0x38, 0x5a, 0x30, 0x14, 0x31, 0x12, 0x30, 0x10,
	0x06, 0x03, 0x55, 0x04, 0x03, 0x0c, 0x09, 0x65,
	0x78, 0x61, 0x6d, 0x70, 0x6c, 0x65, 0x43, 0x41,
	0x30, 0x82, 0x01, 0x22, 0x30, 0x0d, 0x06, 0x09,
	0x2a, 0x86, 0x48, 0x86, 0xf7, 0x0d, 0x01, 0x01,
	0x01, 0x05, 0x00, 0x03, 0x82, 0x01, 0x0f, 0x00,
	0x30, 0x82, 0x01, 0x0a, 0x02, 0x82, 0x01, 0x01,
	0x00, 0xdc, 0x8c, 0x3c, 0x92, 0x4d, 0xb5, 0xbd,
	0x02, 0x9e, 0x02, 0x5a, 0xb0, 0x11, 0x32, 0x98,
	0x82, 0x80, 0xc9, 0x99, 0x7c, 0x31, 0xde, 0xec,
	0xc0, 0x4e, 0xfe, 0xaf, 0xcf, 0x78, 0x9e, 0x0b,
	0x16, 0x6d, 0x2c, 0xb2, 0x94, 0x03, 0x57, 0x67,
	0x29, 0x20, 0x27, 0x54, 0x37, 0x62, 0xcf, 0x7f,
	0xda, 0xec, 0x66, 0xd7, 0xe6, 0xe6, 0xda, 0xf6,
	0x31, 0x7f, 0x2c, 0x81, 0x91, 0x06, 0x0f, 0x97,
	0x91, 0xfe, 0xd9, 0x6b, 0x83, 0x85, 0xd3, 0x23,
	0x41, 0x7d, 0x75, 0xea, 0x63, 0xf4, 0x7a, 0x9b,
	0xec, 0x6c, 0xd3, 0xd0, 0x84, 0x05, 0x9f, 0xcf,
	0xe0, 0x32, 0xe4, 0x0c, 0x67, 0x6e, 0x80, 0x65,
	0x33, 0x6a, 0xba, 0xa8, 0xd5, 0x49, 0xd2, 0x23,
	0x79, 0x46, 0xf4, 0x37, 0xf7, 0x70, 0x01, 0x04,
	0x7e, 0xc3, 0xb5, 0x70, 0x58, 0xd9, 0x44, 0xa7,
	0xf0, 0x14, 0xfd, 0x6e, 0xcf, 0xfb, 0xb0, 0x7d,
	0xa7, 0x47, 0xb5, 0xed, 0xd0, 0x24, 0xb8, 0xea,
	0x30, 0x9f, 0xca, 0xb9, 0xb7, 0x8c, 0xdb, 0x4b,
	0x1b, 0xa3, 0x5c, 0x72, 0xca, 0x4a, 0x60, 0xb0,
	0x19, 0xc2, 0x05, 0xf8, 0x43, 0xe2, 0x3d, 0x65,
	0xba, 0x9f, 0xab, 0x6c, 0xfd, 0x2a, 0x44, 0x87,
	0x04, 0x43, 0xb0, 0x8e, 0x4d, 0x35, 0x00, 0x65,
	0x57, 0x80, 0xb8, 0x82, 0x75, 0xf7, 0xdc, 0x78,
	0x74, 0x58, 0xda, 0x42, 0x8c, 0xc3, 0x5b, 0x2d,
	0xb3, 0x64, 0xc0, 0x8f, 0x57, 0xfe, 0x89, 0x57,
	0x9e, 0x8c, 0x1e, 0x62, 0x82, 0xcd, 0x9a, 0xc8,
	0x4c, 0xe6, 0x37, 0x5c, 0xd1, 0xb0, 0xce, 0x4f,
	0x67, 0xb6, 0x49, 0x96, 0xec, 0x74, 0x0a, 0x1f,
	0x11, 0xbb, 0xb1, 0xa1, 0x50, 0x08, 0xcd, 0x00,
	0x64, 0xe1, 0x1e, 0xeb, 0x85, 0xe7, 0x57, 0xf0,
	0xad, 0xb3, 0xb1, 0x27, 0x1e, 0xd7, 0xd8, 0x4a,
	0xa5, 0x29, 0x8b, 0x6a, 0x76, 0x80, 0x8c, 0x24,
	0xb5, 0x02, 0x03, 0x01, 0x00, 0x01, 0xa3, 0x68,
	0x30, 0x66, 0x30, 0x1d, 0x06, 0x03, 0x55, 0x1d,
	0x0e, 0x04, 0x16, 0x04, 0x14, 0x4a, 0x5e, 0x57,
	0x87, 0x81, 0x07, 0xb1, 0x90, 0x81, 0x76, 0xb9,
	0x2a, 0x84, 0xbf, 0xa8, 0x45, 0x94, 0x87, 0xed,
	0xd3, 0x30, 0x1f, 0x06, 0x03, 0x55, 0x1d, 0x23,
	0x04, 0x18, 0x30, 0x16, 0x80, 0x14, 0x4a, 0x5e,
	0x57, 0x87, 0x81, 0x07, 0xb1, 0x90, 0x81, 0x76,
	0xb9, 0x2a, 0x84, 0xbf, 0xa8, 0x45, 0x94, 0x87,
	0xed, 0xd3, 0x30, 0x0f, 0x06, 0x03, 0x55, 0x1d,
	0x13, 0x01, 0x01, 0xff, 0x04, 0x05, 0x30, 0x03,
	0x01, 0x01, 0xff, 0x30, 0x13, 0x06, 0x03, 0x55,
	0x1d, 0x20, 0x01, 0x01, 0xff, 0x04, 0x09, 0x30,
	0x07, 0x30, 0x05, 0x06, 0x03, 0x2a, 0x03, 0x04,
	0x30, 0x0d, 0x06, 0x09, 0x2a, 0x86, 0x48, 0x86,
	0xf7, 0x0d, 0x01, 0x01, 0x0b, 0x05, 0x00, 0x03,
	0x82, 0x01, 0x01, 0x00, 0x3c, 0xea, 0x33, 0x34,
	0xc8, 0xbb, 0xf1, 0x2c, 0xfc, 0xb1, 0xea, 0x9e,
	0x58, 0x63, 0xd0, 0x58, 0xab, 0x87, 0x12, 0x27,
	0xd2, 0x75, 0x32, 0x60, 0x02, 0xe9, 0x79, 0x63,
	0x7a, 0x0a, 0xd6, 0xe9, 0x3b, 0xb4, 0xbf, 0x0f,
	0xd8, 0xaa, 0xed, 0xbd, 0xf9, 0xc5, 0x52, 0x25,
	0x35, 0x83, 0xb9, 0x8e, 0x5b, 0x1c, 0x52, 0xcd,
	0xa4, 0x28, 0xa1, 0x08, 0xd1, 0x62, 0xea, 0x40,
	0x17, 0x48, 0x8a, 0xbc, 0xb9, 0x76, 0x04, 0x40,
	0x10, 0xae, 0xca, 0x51, 0x20, 0x03, 0x47, 0x21,
	0x1d, 0x9f, 0x5d, 0x28, 0xdc, 0xc1, 0x07, 0x84,
	0x0f, 0xd8, 0x4c, 0x3b, 0xe4, 0x9d, 0x59, 0xf3,
	0x33, 0x67, 0xeb, 0x4f, 0x54, 0x02, 0x3a, 0x7f,
	0x48, 0xcc, 0xf1, 0x39, 0xd4, 0xa7, 0xa7, 0x25,
	0x6d, 0x9f, 0xab, 0x80, 0xf8, 0xa0, 0x27, 0x50,
	0x3d, 0x37, 0x40, 0x20, 0xf4, 0x5f, 0x53, 0xef,
	0xd5, 0xd3, 0x1c, 0x6b, 0x1d, 0xb8, 0x62, 0x89,
	0xdc, 0x19, 0x45, 0x04, 0x85, 0x1a, 0xae, 0x6b,
	0x02, 0x8b, 0x80, 0xc5, 0x03, 0x0f, 0x59, 0x11,
	0xe3, 0xea, 0xa2, 0x8f, 0x67, 0xac, 0xee, 0xed,
	0x9c, 0xea, 0x4f, 0x79, 0x5e, 0x59, 0x61, 0x7b,
	0x91, 0xca, 0x51, 0xb5, 0x8c, 0x66, 0x4d, 0x36,
	0x60, 0xfb, 0x83, 0xe2, 0x0f, 0xcb, 0x51, 0xa8,
	0xfc, 0x7b, 0x0d, 0xe0, 0x03, 0x36, 0xcf, 0xef,
	0x48, 0x8c, 0xaf, 0xbf, 0xb4, 0x15, 0x6b, 0x51,
	0x8a, 0x97, 0xee, 0x38, 0x24, 0x6a, 0xa3, 0xac,
	0xba, 0x2b, 0x39, 0x54, 0xb1, 0xb3, 0x9f, 0x69,
	0x5e, 0x55, 0x82, 0x67, 0x8f, 0xe3, 0xa8, 0x54,
	0xad, 0x44, 0xe2, 0x9a, 0x42, 0x7a, 0xad, 0x84,
	0x68, 0xcb, 0xe8, 0x2f, 0xa1, 0x0a, 0x84, 0x9a,
	0xd1, 0x64, 0xe6, 0x65, 0x79, 0x8d, 0x99, 0xaa,
	0xff, 0x4c, 0x37, 0xa2, 0x08, 0x6c, 0xb7, 0xb6,
	0x40, 0xdc, 0x00, 0x43,
};

static const unsigned char server_ext[] = {
	0x30, 0x82, 0x02, 0xfa, 0x30, 0x82, 0x01, 0xe2,
	0xa0, 0x03, 0x02, 0x01, 0x02, 0x02, 0x14, 0x56,
	0x69, 0x67, 0x7b, 0x32, 0x72, 0x51, 0x74, 0xf9,
	0x3f, 0xa0, 0x31, 0x05, 0xf2, 0x5d, 0x77, 0xc9,
	0x56, 0xd4, 0x13, 0x30, 0x0d, 0x06, 0x09, 0x2a,
	0x86, 0x48, 0x86, 0xf7, 0x0d, 0x01, 0x01, 0x0b,
	0x05, 0x00, 0x30, 0x14, 0x31, 0x12, 0x30, 0x10,
	0x06, 0x03, 0x55, 0x04, 0x03, 0x0c, 0x09, 0x65,
	0x78, 0x61, 0x6d, 0x70, 0x6c, 0x65, 0x43, 0x41,
	0x30, 0x20, 0x17, 0x0d, 0x32, 0x34, 0x31, 0x31,
	0x32, 0x31, 0x31, 0x35, 0x34, 0x32, 0x33, 0x37,
	0x5a, 0x18, 0x0f, 0x32, 0x31, 0x32, 0x34, 0x31,
	0x30, 0x32, 0x38, 0x31, 0x35, 0x34, 0x32, 0x33,
	0x37, 0x5a, 0x30, 0x14, 0x31, 0x12, 0x30, 0x10,
	0x06, 0x03, 0x55, 0x04, 0x03, 0x0c, 0x09, 0x6c,
	0x6f, 0x63, 0x61, 0x6c, 0x68, 0x6f, 0x73, 0x74,
	0x30, 0x82, 0x01, 0x22, 0x30, 0x0d, 0x06, 0x09,
	0x2a, 0x86, 0x48, 0x86, 0xf7, 0x0d, 0x01, 0x01,
	0x01, 0x05, 0x00, 0x03, 0x82, 0x01, 0x0f, 0x00,
	0x30, 0x82, 0x01, 0x0a, 0x02, 0x82, 0x01, 0x01,
	0x00, 0xdf, 0xed, 0x8e, 0x7d, 0x49, 0x50, 0xf8,
	0xaf, 0xc2, 0xea, 0x24, 0xeb, 0xcc, 0x61, 0xc1,
	0x76, 0x51, 0xc0, 0x2c, 0x85, 0xfc, 0x04, 0xca,
	0xc2, 0x03, 0xf7, 0x97, 0xcd, 0x6c, 0xef, 0x44,
	0x17, 0x1b, 0xf0, 0xc0, 0x0d, 0x94, 0xdf, 0xa5,
	0x84, 0x6d, 0x7c, 0x3d, 0xa7, 0x19, 0x79, 0x5e,
	0xc7, 0xb2, 0xb3, 0x46, 0x09, 0x1b, 0x04, 0xae,
	0xb2, 0x72, 0x3d, 0xa9, 0xb6, 0x29, 0xf5, 0xd7,
	0xd3, 0x38, 0x40, 0xa3, 0x45, 0x14, 0xe3, 0xc3,
	0x06, 0x64, 0xc1, 0xe6, 0xee, 0xcf, 0x6b, 0xfd,
	0x6b, 0xa7, 0x2c, 0xf4, 0x61, 0x98, 0xb1, 0xf9,
	0x15, 0x3c, 0xa2, 0x6b, 0x31, 0xa7, 0x65, 0xea,
	0xe5, 0x78, 0x59, 0x52, 0x28, 0x7b, 0x58, 0xd5,
	0x92, 0xa9, 0xa7, 0xf9, 0xba, 0x56, 0x30, 0x3f,
	0x6f, 0xd7, 0x4b, 0xf8, 0xe0, 0x0c, 0x6a, 0x4b,
	0x74, 0x7f, 0x74, 0x48, 0x8d, 0x50, 0x5b, 0xd2,
	0x75, 0x28, 0x24, 0xff, 0x32, 0xec, 0xa4, 0xac,
	0xda, 0x1a, 0x13, 0x84, 0xce, 0xc9, 0x7a, 0xd2,
	0x08, 0x0b, 0x2c, 0xeb, 0x50, 0x1f, 0x69, 0x30,
	0x7f, 0xa8, 0xa5, 0x27, 0x77, 0xa0, 0x6e, 0xd4,
	0xc8, 0x98, 0xc2, 0x89, 0x59, 0xc5, 0xaf, 0x8e,
	0xce, 0x79, 0xfe, 0x95, 0x6c, 0x58, 0x6f, 0x03,
	0x9f, 0xb6, 0xd3, 0xcf, 0x20, 0x18, 0xce, 0x69,
	0xd4, 0xf0, 0xba, 0xfa, 0xae, 0xe1, 0x3f, 0xe6,
	0x2f, 0x23, 0x3a, 0xe9, 0x0d, 0x69, 0xa5, 0x7d,
	0x30, 0xca, 0x35, 0x7f, 0x64, 0x61, 0x11, 0x37,
	0x4b, 0x90, 0x3c, 0x04, 0xee, 0x6e, 0xec, 0x6c,
	0x2f, 0xfa, 0x4d, 0xcd, 0x20, 0x9a, 0x22, 0xeb,
	0x61, 0x3d, 0xc3, 0xf6, 0xa2, 0x97, 0xa8, 0x5b,
	0x7f, 0x78, 0x9a, 0x6c, 0x30, 0x81, 0x36, 0x40,
	0x62, 0x30, 0xad, 0xde, 0x81, 0xc4, 0xf5, 0x4b,
	0x97, 0xcc, 0x11, 0xed, 0x34, 0x1b, 0x50, 0x89,
	0x31, 0x02, 0x03, 0x01, 0x00, 0x01, 0xa3, 0x42,
	0x30, 0x40, 0x30, 0x1d, 0x06, 0x03, 0x55, 0x1d,
	0x0e, 0x04, 0x16, 0x04, 0x14, 0x07, 0xb2, 0x54,
	0xd3, 0xef, 0xc7, 0x25, 0xfc, 0xd0, 0xe5, 0x1d,
	0x05, 0x0b, 0x1c, 0xaa, 0x6f, 0x46, 0x10, 0xcc,
	0xfc, 0x30, 0x1f, 0x06, 0x03, 0x55, 0x1d, 0x23,
	0x04, 0x18, 0x30, 0x16, 0x80, 0x14, 0x4a, 0x5e,
	0x57, 0x87, 0x81, 0x07, 0xb1, 0x90, 0x81, 0x76,
	0xb9, 0x2a, 0x84, 0xbf, 0xa8, 0x45, 0x94, 0x87,
	0xed, 0xd3, 0x30, 0x0d, 0x06, 0x09, 0x2a, 0x86,
	0x48, 0x86, 0xf7, 0x0d, 0x01, 0x01, 0x0b, 0x05,
	0x00, 0x03, 0x82, 0x01, 0x01, 0x00, 0x44, 0xef,
	0x53, 0x09, 0xf8, 0xdf, 0x0f, 0x31, 0x24, 0xce,
	0xb5, 0xd4, 0x45, 0xfb, 0xdc, 0xd4, 0x00, 0xb0,
	0x52, 0x06, 0x84, 0x4f, 0x12, 0x8d, 0x06, 0x7a,
	0x0e, 0x2f, 0x99, 0x4b, 0x45, 0xd7, 0x6a, 0x19,
	0x9e, 0x45, 0x74, 0x76, 0x57, 0xcf, 0x5f, 0x54,
	0xf4, 0x5b, 0x8d, 0x17, 0xdb, 0x9f, 0x66, 0x6f,
	0x5d, 0xa5, 0x11, 0x3f, 0x76, 0x70, 0xc3, 0x2f,
	0xef, 0x9e, 0xe9, 0x62, 0x0e, 0xe1, 0xaa, 0xb9,
	0xf2, 0xd2, 0x2a, 0x95, 0x8c, 0x1e, 0xc9, 0x6c,
	0x2b, 0xbf, 0x36, 0xcd, 0xd1, 0x24, 0x2d, 0x56,
	0x96, 0xf0, 0xb7, 0xeb, 0x14, 0xc1, 0x24, 0x49,
	0xbd, 0xa4, 0xba, 0xe2, 0x1d, 0xa7, 0x66, 0xa3,
	0x7e, 0xca, 0xf2, 0xb6, 0xd1, 0x37, 0xb6, 0x7b,
	0x22, 0x39, 0xe1, 0x7d, 0xe2, 0xc0, 0x06, 0xb7,
	0x9a, 0x66, 0xfb, 0x83, 0xcf, 0xc6, 0x87, 0xf9,
	0x10, 0xbe, 0xd8, 0x5e, 0x76, 0xf6, 0x90, 0x4c,
	0xa3, 0x71, 0x97, 0xab, 0x22, 0xb1, 0xe9, 0xa4,
	0xda, 0x6e, 0xa5, 0x57, 0x3f, 0x48, 0xb6, 0x4d,
	0xc2, 0x08, 0x51, 0x5d, 0xcb, 0x19, 0xd7, 0xea,
	0x27, 0xdd, 0x39, 0x68, 0x9a, 0xac, 0x08, 0xd8,
	0x05, 0x89, 0x93, 0xcf, 0x88, 0xab, 0xd2, 0xa0,
	0x29, 0x47, 0x23, 0xa1, 0xc1, 0x06, 0x3c, 0xa0,
	0x5c, 0xde, 0x60, 0x33, 0x06, 0x82, 0x25, 0xcf,
	0xfb, 0x5b, 0x28, 0x16, 0xa3, 0x28, 0xe6, 0xf9,
	0x58, 0xaa, 0x79, 0xb3, 0x11, 0xd5, 0xfc, 0x11,
	0x3c, 0x85, 0x4f, 0x6e, 0xdd, 0xe3, 0x49, 0x31,
	0x1c, 0x25, 0x3e, 0x0f, 0xa2, 0xb4, 0x93, 0x11,
	0x32, 0xfd, 0xfe, 0x08, 0x3d, 0x0c, 0x35, 0xd4,
	0x9b, 0xcb, 0xa4, 0xca, 0xdb, 0x37, 0xc4, 0x48,
	0xdd, 0xc2, 0x24, 0x26, 0xa7, 0xa3, 0xe5, 0x70,
	0x17, 0x7c, 0x2e, 0xed, 0x6f, 0xfe, 0x94, 0x28,
	0x1a, 0xce, 0xff, 0x9a, 0x43, 0x3c,
};

static const unsigned char server_privkey_ext[] = {
	0x30, 0x82, 0x04, 0xbf, 0x02, 0x01, 0x00, 0x30,
	0x0d, 0x06, 0x09, 0x2a, 0x86, 0x48, 0x86, 0xf7,
	0x0d, 0x01, 0x01, 0x01, 0x05, 0x00, 0x04, 0x82,
	0x04, 0xa9, 0x30, 0x82, 0x04, 0xa5, 0x02, 0x01,
	0x00, 0x02, 0x82, 0x01, 0x01, 0x00, 0xdf, 0xed,
	0x8e, 0x7d, 0x49, 0x50, 0xf8, 0xaf, 0xc2, 0xea,
	0x24, 0xeb, 0xcc, 0x61, 0xc1, 0x76, 0x51, 0xc0,
	0x2c, 0x85, 0xfc, 0x04, 0xca, 0xc2, 0x03, 0xf7,
	0x97, 0xcd, 0x6c, 0xef, 0x44, 0x17, 0x1b, 0xf0,
	0xc0, 0x0d, 0x94, 0xdf, 0xa5, 0x84, 0x6d, 0x7c,
	0x3d, 0xa7, 0x19, 0x79, 0x5e, 0xc7, 0xb2, 0xb3,
	0x46, 0x09, 0x1b, 0x04, 0xae, 0xb2, 0x72, 0x3d,
	0xa9, 0xb6, 0x29, 0xf5, 0xd7, 0xd3, 0x38, 0x40,
	0xa3, 0x45, 0x14, 0xe3, 0xc3, 0x06, 0x64, 0xc1,
	0xe6, 0xee, 0xcf, 0x6b, 0xfd, 0x6b, 0xa7, 0x2c,
	0xf4, 0x61, 0x98, 0xb1, 0xf9, 0x15, 0x3c, 0xa2,
	0x6b, 0x31, 0xa7, 0x65, 0xea, 0xe5, 0x78, 0x59,
	0x52, 0x28, 0x7b, 0x58, 0xd5, 0x92, 0xa9, 0xa7,
	0xf9, 0xba, 0x56, 0x30, 0x3f, 0x6f, 0xd7, 0x4b,
	0xf8, 0xe0, 0x0c, 0x6a, 0x4b, 0x74, 0x7f, 0x74,
	0x48, 0x8d, 0x50, 0x5b, 0xd2, 0x75, 0x28, 0x24,
	0xff, 0x32, 0xec, 0xa4, 0xac, 0xda, 0x1a, 0x13,
	0x84, 0xce, 0xc9, 0x7a, 0xd2, 0x08, 0x0b, 0x2c,
	0xeb, 0x50, 0x1f, 0x69, 0x30, 0x7f, 0xa8, 0xa5,
	0x27, 0x77, 0xa0, 0x6e, 0xd4, 0xc8, 0x98, 0xc2,
	0x89, 0x59, 0xc5, 0xaf, 0x8e, 0xce, 0x79, 0xfe,
	0x95, 0x6c, 0x58, 0x6f, 0x03, 0x9f, 0xb6, 0xd3,
	0xcf, 0x20, 0x18, 0xce, 0x69, 0xd4, 0xf0, 0xba,
	0xfa, 0xae, 0xe1, 0x3f, 0xe6, 0x2f, 0x23, 0x3a,
	0xe9, 0x0d, 0x69, 0xa5, 0x7d, 0x30, 0xca, 0x35,
	0x7f, 0x64, 0x61, 0x11, 0x37, 0x4b, 0x90, 0x3c,
	0x04, 0xee, 0x6e, 0xec, 0x6c, 0x2f, 0xfa, 0x4d,
	0xcd, 0x20, 0x9a, 0x22, 0xeb, 0x61, 0x3d, 0xc3,
	0xf6, 0xa2, 0x97, 0xa8, 0x5b, 0x7f, 0x78, 0x9a,
	0x6c, 0x30, 0x81, 0x36, 0x40, 0x62, 0x30, 0xad,
	0xde, 0x81, 0xc4, 0xf5, 0x4b, 0x97, 0xcc, 0x11,
	0xed, 0x34, 0x1b, 0x50, 0x89, 0x31, 0x02, 0x03,
	0x01, 0x00, 0x01, 0x02, 0x82, 0x01, 0x00, 0x06,
	0x52, 0xa4, 0x5b, 0xd8, 0x46, 0x9f, 0x87, 0x02,
	0xf7, 0x6e, 0x8c, 0x73, 0xec, 0x6c, 0xb4, 0x85,
	0x11, 0x6a, 0x90, 0x6b, 0xf1, 0xcc, 0xb1, 0xd6,
	0xbf, 0xd6, 0x7a, 0xf7, 0xf0, 0xf7, 0x98, 0xb9,
	0x72, 0xbe, 0x51, 0x83, 0xdb, 0x1e, 0xc6, 0xd2,
	0xfa, 0x97, 0x99, 0x10, 0xc8, 0x93, 0x0b, 0x0b,
	0x7a, 0x31, 0x67, 0x8f, 0x6a, 0x3d, 0xee, 0x8e,
	0xf8, 0x3b, 0xc3, 0x07, 0x83, 0x48, 0x11, 0x50,
	0x3c, 0xce, 0xff, 0x63, 0xdc, 0x1c, 0x85, 0x21,
	0x32, 0x32, 0x6d, 0x9a, 0xd0, 0xbf, 0x4a, 0x9b,
	0x61, 0x53, 0x13, 0x30, 0x67, 0x12, 0x13, 0xed,
	0xee, 0xde, 0x1c, 0xfc, 0x4f, 0x8d, 0xe6, 0xe5,
	0xd3, 0x8b, 0xd4, 0xd5, 0xca, 0xc7, 0xd9, 0x08,
	0xce, 0x53, 0xe8, 0x55, 0x87, 0xae, 0x3a, 0xdf,
	0xb6, 0xe6, 0xf3, 0x98, 0x96, 0x25, 0xc4, 0x47,
	0xd7, 0x06, 0x37, 0x6b, 0x45, 0xf4, 0x76, 0xc9,
	0xe0, 0x9c, 0x55, 0xcf, 0x05, 0x8f, 0xef, 0x22,
	0x43, 0x1f, 0x17, 0x2c, 0x3b, 0xb4, 0xfb, 0x8c,
	0x8d, 0xc2, 0x13, 0x74, 0xf6, 0x36, 0x61, 0x88,
	0x39, 0x23, 0xd1, 0x42, 0xae, 0x48, 0xc9, 0x84,
	0x71, 0xd0, 0x8b, 0xd3, 0x9e, 0x6b, 0x47, 0xc4,
	0x1f, 0xf3, 0xcb, 0xfb, 0x3e, 0x1e, 0x47, 0x72,
	0x01, 0x28, 0x03, 0xa8, 0xf8, 0x63, 0xda, 0x6e,
	0x3b, 0xca, 0x9c, 0xc7, 0xf7, 0xe2, 0xc9, 0xf3,
	0xfa, 0x44, 0x43, 0x54, 0xad, 0xcc, 0x46, 0xa7,
	0x1e, 0x31, 0x16, 0x07, 0xdf, 0x20, 0x1e, 0xf5,
	0xe0, 0x46, 0xce, 0x17, 0xd5, 0x54, 0x31, 0xb8,
	0x35, 0xbe, 0x6e, 0x74, 0x93, 0x43, 0x5a, 0x94,
	0x0a, 0x04, 0x43, 0x6f, 0x94, 0xfc, 0xee, 0x35,
	0x29, 0xaa, 0x1e, 0x75, 0x1d, 0xa3, 0x6d, 0x93,
	0x60, 0xe8, 0x1d, 0x3a, 0x55, 0x91, 0x01, 0xac,
	0x4b, 0x58, 0x81, 0x0d, 0xe8, 0x1f, 0x3b, 0x02,
	0x81, 0x81, 0x00, 0xf7, 0x6f, 0xfd, 0x69, 0x68,
	0x76, 0x4f, 0x00, 0x41, 0xd5, 0xdb, 0x11, 0x61,
	0x39, 0xcf, 0xfc, 0x98, 0xa2, 0x6b, 0x4c, 0x59,
	0x46, 0x41, 0xc6, 0x10, 0x85, 0x45, 0x49, 0xea,
	0xd2, 0xf1, 0xbe, 0x2c, 0xb0, 0x36, 0xbe, 0x79,
	0xa5, 0x49, 0x7c, 0xf4, 0xdc, 0x51, 0xc7, 0xa5,
	0xb6, 0x65, 0xc4, 0x91, 0x43, 0x26, 0x51, 0x7e,
	0xf6, 0x07, 0x86, 0xf7, 0xf6, 0x6e, 0xd4, 0xfc,
	0x85, 0x0b, 0x41, 0x61, 0x72, 0xc8, 0x49, 0xc9,
	0x43, 0x51, 0x72, 0x55, 0x22, 0xa5, 0x90, 0x0e,
	0x72, 0x23, 0x99, 0xac, 0x7f, 0x11, 0x1e, 0x06,
	0x8a, 0x10, 0x1a, 0x8b, 0xd2, 0xed, 0x90, 0xab,
	0x1e, 0xef, 0x10, 0x13, 0xab, 0x31, 0xd5, 0x38,
	0xfe, 0xa8, 0x88, 0x37, 0x8a, 0xa3, 0xf9, 0xe0,
	0x3a, 0x9d, 0x00, 0xd2, 0xf8, 0x53, 0x19, 0x0f,
	0x76, 0x18, 0x2d, 0xe3, 0xe4, 0xcd, 0x8d, 0x16,
	0x93, 0x59, 0x27, 0x02, 0x81, 0x81, 0x00, 0xe7,
	0xad, 0x4c, 0xb5, 0xc0, 0xdc, 0x8b, 0x44, 0xd3,
	0x04, 0x8c, 0x70, 0xa7, 0x02, 0x1a, 0x26, 0x59,
	0x87, 0x29, 0x73, 0xe4, 0xe4, 0xd6, 0xd3, 0xcb,
	0xa1, 0xfc, 0xd2, 0xae, 0x68, 0xb4, 0x84, 0x33,
	0x07, 0x76, 0xd5, 0x19, 0xc9, 0xd1, 0x5c, 0xf2,
	0x41, 0x31, 0xbc, 0xc3, 0x95, 0xc0, 0x6e, 0xb7,
	0xa3, 0x9c, 0x09, 0x30, 0xc4, 0xb1, 0xe0, 0x1d,
	0xf3, 0x65, 0x61, 0xdf, 0x1a, 0x9e, 0xe9, 0x39,
	0x58, 0xde, 0x58, 0xd5, 0xd5, 0x9f, 0x67, 0x62,
	0xe7, 0x3e, 0xc9, 0x9b, 0x6f, 0xb2, 0x38, 0xc5,
	0xc1, 0x25, 0x90, 0xd2, 0x28, 0x1d, 0x45, 0x2c,
	0x26, 0x88, 0xee, 0xe7, 0x60, 0x68, 0x3e, 0xb5,
	0xf2, 0x44, 0xa2, 0xc8, 0x3a, 0x43, 0x81, 0x4e,
	0x38, 0xc2, 0xde, 0xd1, 0xaa, 0x6d, 0x0d, 0x48,
	0x0f, 0xac, 0xbb, 0x07, 0x6c, 0x56, 0xdd, 0x72,
	0xff, 0xb4, 0xdd, 0xf3, 0xc4, 0x91, 0xe7, 0x02,
	0x81, 0x81, 0x00, 0x86, 0x7f, 0xf1, 0x97, 0xe2,
	0x98, 0xac, 0xc8, 0xcf, 0x00, 0x98, 0x5c, 0x12,
	0x25, 0x82, 0xd1, 0x23, 0x86, 0xe6, 0x1c, 0x52,
	0x4a, 0xc6, 0x66, 0x0b, 0x84, 0xe5, 0xed, 0x10,
	0x20, 0x2a, 0x17, 0xdd, 0xe2, 0xcb, 0x5f, 0x2e,
	0x70, 0x92, 0x49, 0xc2, 0x30, 0x20, 0xa4, 0x0d,
	0x87, 0xe0, 0x39, 0xc1, 0x5c, 0x66, 0xef, 0xd5,
	0xbb, 0x96, 0xcb, 0xde, 0xed, 0xad, 0xc1, 0x48,
	0xa2, 0x69, 0x43, 0xd8, 0xdc, 0xb3, 0xd2, 0xa7,
	0xfc, 0x57, 0xc1, 0x76, 0x55, 0xa6, 0xf9, 0x6f,
	0x60, 0xcb, 0xc9, 0x34, 0xe2, 0xbd, 0x43, 0x3c,
	0xfa, 0xbf, 0x56, 0x2e, 0xbb, 0x31, 0x37, 0x7a,
	0x4d, 0x0e, 0x56, 0x06, 0xda, 0xff, 0xf3, 0x8f,
	0x4f, 0x9d, 0xfc, 0xad, 0x74, 0x47, 0x3e, 0x04,
	0x8c, 0xd7, 0xdb, 0x22, 0xd2, 0xa9, 0x18, 0xee,
	0x36, 0x9b, 0x5e, 0x16, 0x8a, 0xc0, 0xd0, 0xf8,
	0x7c, 0x8f, 0xf1, 0x02, 0x81, 0x81, 0x00, 0xe5,
	0xc4, 0x9d, 0x10, 0xa1, 0x1e, 0xd9, 0xcc, 0xbf,
	0x4f, 0x82, 0x8d, 0x73, 0x45, 0x05, 0x74, 0x45,
	0x54, 0x64, 0x8b, 0x39, 0x56, 0xaf, 0xac, 0xcc,
	0x07, 0x72, 0xbb, 0xec, 0x17, 0x91, 0xf8, 0x8e,
	0xb7, 0x77, 0x66, 0x6f, 0xb6, 0x15, 0xbb, 0x0d,
	0xd4, 0x14, 0xa4, 0xf6, 0x80, 0xfd, 0xa1, 0x90,
	0xe5, 0x65, 0xaa, 0x43, 0xc0, 0xbf, 0xfc, 0xdb,
	0x17, 0x7a, 0xd3, 0xef, 0x35, 0xf2, 0xa6, 0xb1,
	0xa6, 0x6e, 0x96, 0x42, 0x35, 0x24, 0x6b, 0x9f,
	0xce, 0x62, 0x1a, 0x06, 0xdb, 0x67, 0x31, 0x21,
	0x07, 0xa6, 0xdf, 0x13, 0x5e, 0x8f, 0x70, 0xfc,
	0x11, 0x97, 0xbb, 0x00, 0xa4, 0x3f, 0x9e, 0xfa,
	0x4a, 0x35, 0x42, 0x10, 0x3c, 0xa0, 0x98, 0x8c,
	0x60, 0x84, 0xfc, 0x01, 0x8a, 0xf9, 0xae, 0xb3,
	0x6a, 0x40, 0x50, 0x19, 0x53, 0x9c, 0x6e, 0xf2,
	0x4f, 0xa2, 0x2c, 0x82, 0x47, 0xd0, 0xbf, 0x02,
	0x81, 0x81, 0x00, 0xe6, 0x02, 0x4b, 0xc1, 0xb2,
	0xad, 0xc7, 0x83, 0xdc, 0x1a, 0xf7, 0xcb, 0x50,
	0x2d, 0x71, 0x73, 0x8e, 0xc6, 0x35, 0x07, 0x2f,
	0x7b, 0x4d, 0x99, 0x37, 0x35, 0x50, 0xb0, 0x97,
	0x8f, 0x3a, 0x9a, 0x2d, 0xb8, 0x34, 0x1c, 0x64,
	0x29, 0x3a, 0x9c, 0x6a, 0x5b, 0x20, 0x31, 0xd3,
	0x22, 0x69, 0x3f, 0x7e, 0xb8, 0xce, 0x7e, 0x21,
	0x25, 0xc8, 0x81, 0x40, 0xca, 0x8b, 0x8e, 0x6e,
	0x1d, 0x24, 0xc8, 0x81, 0x32, 0x47, 0x7f, 0xd6,
	0x76, 0x81, 0x6f, 0xd3, 0x8b, 0x6b, 0xc1, 0x58,
	0x9c, 0x13, 0x9d, 0x91, 0x6d, 0x0c, 0xb2, 0x49,
	0x2d, 0x83, 0x22, 0xa5, 0x6d, 0x35, 0x63, 0xfb,
	0xf3, 0x05, 0x17, 0x67, 0x8d, 0x53, 0xb1, 0xf5,
	0xa4, 0x2e, 0x92, 0xca, 0xfe, 0xfc, 0xe8, 0x98,
	0xad, 0x6e, 0x55, 0xf4, 0x61, 0xb2, 0x0b, 0xcb,
	0x68, 0xd5, 0x89, 0x9f, 0xb8, 0x2e, 0x2d, 0xb8,
	0xe9, 0x2b, 0x4b,
};
```
