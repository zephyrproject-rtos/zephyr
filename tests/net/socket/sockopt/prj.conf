## prj.conf
```kconfig
# Setup for self-contained net testing without requiring a SLIP driver
CONFIG_NET_TEST=y

# General config
CONFIG_NEWLIB_LIBC=y

# Networking config
CONFIG_NETWORKING=y
CONFIG_NET_IPV4=y
CONFIG_NET_IPV6=y
CONFIG_NET_TCP=y
CONFIG_NET_SOCKETS=y
CONFIG_NET_SOCKETS_POSIX_NAMES=y
CONFIG_NET_SOCKETS_SOCKOPT_TLS=y
CONFIG_MBEDTLS=y
CONFIG_NET_TLS=y
CONFIG_NET_DTLS=y

# Network driver config
CONFIG_NET_LOOPBACK=y
CONFIG_TEST_RANDOM_GENERATOR=y

# Network address config
CONFIG_NET_APP_SETTINGS=y
CONFIG_NET_APP_NEED_IPV4=y
CONFIG_NET_APP_NEED_IPV6=y
CONFIG_NET_APP_MY_IPV4_ADDR="192.0.2.1"
CONFIG_NET_APP_MY_IPV6_ADDR="2001:db8::1"

CONFIG_NET_BUF_TX_COUNT=2
CONFIG_NET_BUF_RX_COUNT=2
CONFIG_MAIN_STACK_SIZE=4096

# Required:
# Net pkt will be reused since src and dst address are the same.
# It takes at least 3 tx pkt to establish TCP connection (syn/syn-ack/ack)
CONFIG_NET_PKT_TX_COUNT=6

CONFIG_ZTEST=y
CONFIG_ZTEST_STACKSIZE=2048
```

## src/main.c
```c
/*
 * Copyright (c) 2017 Linaro Limited
 *
 * SPDX-License-Identifier: Apache-2.0
 */

#include <ztest_assert.h>
#include <net/socket.h>

#define TEST_STR_SMALL "test"

#define ANY_PORT 0
#define SERVER_PORT 4242

#define MAX_CONNS 5

#define TCP_TEARDOWN_TIMEOUT K_SECONDS(1)

static void prepare_tcp_sock_v6(const char *addr, u16_t port, int *sock,
				struct sockaddr_in6 *sockaddr)
{
	int rv;

	zassert_not_null(addr, "null addr");
	zassert_not_null(sock, "null sock");
	zassert_not_null(sockaddr, "null sockaddr");

	*sock = socket(AF_INET6, SOCK_STREAM, IPPROTO_TCP);
	zassert_true(*sock >= 0, "socket open failed");

	sockaddr->sin6_family = AF_INET6;
	sockaddr->sin6_port = htons(port);
	rv = inet_pton(AF_INET6, addr, &sockaddr->sin6_addr);
	zassert_equal(rv, 1, "inet_pton failed");
}

static void prepare_udp_sock_v6(const char *addr, u16_t port, int *sock,
				struct sockaddr_in6 *sockaddr)
{
	int rv;

	zassert_not_null(addr, "null addr");
	zassert_not_null(sock, "null sock");
	zassert_not_null(sockaddr, "null sockaddr");

	*sock = socket(AF_INET6, SOCK_DGRAM, IPPROTO_UDP);
	zassert_true(*sock >= 0, "socket open failed");

	sockaddr->sin6_family = AF_INET6;
	sockaddr->sin6_port = htons(port);
	rv = inet_pton(AF_INET6, addr, &sockaddr->sin6_addr);
	zassert_equal(rv, 1, "inet_pton failed");
}

static void test_getsockopt(void)
{
	int enable;
	socklen_t size;
	int s6_tcp, s6_udp;
	struct sockaddr_in6 addr6;

	prepare_tcp_sock_v6(CONFIG_NET_APP_MY_IPV6_ADDR, ANY_PORT,
			    &s6_tcp, &addr6);

	errno = 0;
	zassert_equal(getsockopt(0, 0, 0, NULL, NULL), -1, "getsockopt");
	zassert_equal(errno, ENOTSOCK, "getsockopt errno");

	errno = 0;
	zassert_equal(getsockopt(s6_tcp, 0, 0, NULL, NULL), -1, "getsockopt");
	zassert_equal(errno, EOPNOTSUPP, "getsockopt errno");

	errno = 0;
	zassert_equal(getsockopt(s6_tcp, SOL_TLS, 0, NULL, NULL), -1,
		      "getsockopt");
	zassert_equal(errno, EFAULT, "getsockopt errno");

	prepare_udp_sock_v6(CONFIG_NET_APP_MY_IPV6_ADDR, ANY_PORT,
			    &s6_udp, &addr6);

	errno = 0;
	zassert_equal(getsockopt(s6_udp, SOL_TLS, 0, &enable, &size), -1,
		      "getsockopt");
	zassert_equal(errno, EBADF, "getsockopt errno");

	errno = 0;
	zassert_equal(getsockopt(s6_tcp, SOL_TLS, 0, &enable, NULL), -1,
		      "getsockopt");
	zassert_equal(errno, EFAULT, "getsockopt errno");

	errno = 0;
	zassert_equal(getsockopt(s6_tcp, SOL_TLS, 0, NULL, &size), -1,
		      "getsockopt");
	zassert_equal(errno, EFAULT, "getsockopt errno");

	errno = 0;
	zassert_equal(getsockopt(s6_tcp, SOL_TLS, 0, &enable, NULL), -1,
		      "getsockopt");
	zassert_equal(errno, EFAULT, "getsockopt errno");

	errno = 0;
	size = 0;
	zassert_equal(getsockopt(s6_tcp, SOL_TLS, 0, &enable, &size), -1,
		      "getsockopt");
	zassert_equal(errno, EFAULT, "getsockopt errno");

	size = 0;
	errno = 0;
	zassert_equal(getsockopt(s6_tcp, SOL_TLS, 0, &enable, &size), -1,
		      "getsockopt");
	zassert_equal(errno, EFAULT, "getsockopt errno");

	size = sizeof(enable);
	errno = 0;
	zassert_equal(getsockopt(s6_tcp, SOL_TLS, 0, &enable, &size),
		      -1, "getsockopt");
	zassert_equal(errno, ENOPROTOOPT, "getsockopt errno");
	zassert_equal(size, sizeof(enable), "getsockopt errno");

	errno = 0;
	zassert_equal(getsockopt(s6_tcp, SOL_TLS, TLS_ENABLE, &enable, &size),
		      0, "getsockopt");
	zassert_equal(errno, 0, "getsockopt errno");
	zassert_equal(size, sizeof(enable), "getsockopt errno");

	zassert_equal(close(s6_tcp), 0, "close failed");
	zassert_equal(close(s6_udp), 0, "close failed");
}

static void test_setsockopt(void)
{
	int enable = 1;
	int s6_tcp, s6_udp;
	struct sockaddr_in6 addr6;

	prepare_tcp_sock_v6(CONFIG_NET_APP_MY_IPV6_ADDR, ANY_PORT,
			    &s6_tcp, &addr6);

	zassert_equal(setsockopt(0, 0, 0, NULL, 0), -1, "setsockopt");
	zassert_equal(errno, ENOTSOCK, "setsockopt errno");

	errno = 0;
	zassert_equal(setsockopt(s6_tcp, 0, 0, NULL, 0), -1, "setsockopt");
	zassert_equal(errno, EOPNOTSUPP, "setsockopt errno");

	errno = 0;
	zassert_equal(setsockopt(s6_tcp, SOL_TLS, 0, NULL, 0), -1,
		      "setsockopt");
	zassert_equal(errno, EFAULT, "setsockopt errno");

	errno = 0;
	zassert_equal(setsockopt(s6_tcp, SOL_TLS, 0, &enable, 0), -1,
		      "setsockopt");
	zassert_equal(errno, EFAULT, "setsockopt errno");

	errno = 0;
	zassert_equal(setsockopt(s6_tcp, SOL_TLS, 0, &enable, sizeof(enable)),
		      -1, "setsockopt");
	zassert_equal(errno, ENOPROTOOPT, "setsockopt errno");

	prepare_udp_sock_v6(CONFIG_NET_APP_MY_IPV6_ADDR, ANY_PORT,
			    &s6_udp, &addr6);

	errno = 0;
	zassert_equal(setsockopt(s6_udp, SOL_TLS, 0, &enable, sizeof(enable)),
		      -1, "setsockopt");
	zassert_equal(errno, EBADF, "setsockopt errno");

	errno = 0;
	zassert_equal(setsockopt(s6_tcp, SOL_TLS, TLS_ENABLE,
				 &enable, sizeof(enable)), 0, "setsockopt");
	zassert_equal(errno, 0, "setsockopt errno");

	zassert_equal(close(s6_tcp), 0, "close failed");
	zassert_equal(close(s6_udp), 0, "close failed");
}

void test_main(void)
{
	ztest_test_suite(socket_sockopt,
			 ztest_unit_test(test_getsockopt),
			 ztest_unit_test(test_setsockopt));

	ztest_run_test_suite(socket_sockopt);
}
```
