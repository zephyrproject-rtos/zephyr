## CMakeLists.txt
```
# SPDX-License-Identifier: Apache-2.0

cmake_minimum_required(VERSION 3.20.0)

find_package(Zephyr REQUIRED HINTS $ENV{ZEPHYR_BASE})
project(tls_keygen_handshake)

target_sources(app PRIVATE src/main.c)
```

## prj.conf
```kconfig
CONFIG_ZTEST=y
CONFIG_MAIN_STACK_SIZE=4096
CONFIG_ZTEST_STACK_SIZE=8192
# The protected storage backend loads the credentials into the heap.
CONFIG_HEAP_MEM_POOL_SIZE=16384

# TLS sockets over the loopback interface.
CONFIG_NETWORKING=y
CONFIG_NET_TEST=y
CONFIG_NET_DRIVERS=y
CONFIG_NET_LOOPBACK=y
CONFIG_NET_IPV4=y
CONFIG_NET_IPV6=n
CONFIG_NET_TCP=y
CONFIG_NET_TCP_TIME_WAIT_DELAY=0
CONFIG_NET_SOCKETS=y
CONFIG_NET_SOCKETS_SOCKOPT_TLS=y
CONFIG_NET_SOCKETS_TLS_MAX_CONTEXTS=3
CONFIG_ZVFS_OPEN_ADD_SIZE_NET=5
CONFIG_NET_BUF_TX_COUNT=64
CONFIG_NET_PKT_TX_COUNT=64
CONFIG_NET_BUF_RX_COUNT=64
CONFIG_NET_PKT_RX_COUNT=64

# PSA crypto (software backend) with an external RNG.
CONFIG_MBEDTLS=y
CONFIG_MBEDTLS_PSA_CRYPTO_EXTERNAL_RNG=y
CONFIG_MBEDTLS_PSA_CRYPTO_EXTERNAL_RNG_ALLOW_NON_CSPRNG=y
CONFIG_MBEDTLS_ENABLE_HEAP=y
CONFIG_MBEDTLS_HEAP_SIZE=60000
CONFIG_ENTROPY_GENERATOR=y
CONFIG_TEST_RANDOM_GENERATOR=y
CONFIG_PSA_CRYPTO=y
CONFIG_MBEDTLS_X509_CRT_WRITE_C=y
CONFIG_MBEDTLS_CIPHERSUITE_TLS_ECDHE_ECDSA_WITH_AES_128_GCM_SHA256=y

# Persistent PSA keys, kept in settings on native_sim.
CONFIG_SECURE_STORAGE=y
CONFIG_SECURE_STORAGE_PS_IMPLEMENTATION_ITS=y
CONFIG_SECURE_STORAGE_ITS_STORE_IMPLEMENTATION_SETTINGS=y
CONFIG_SETTINGS=y
CONFIG_SETTINGS_NVS=y
CONFIG_NVS=y
CONFIG_FLASH=y
CONFIG_FLASH_MAP=y
# Large enough for a certificate.
CONFIG_SECURE_STORAGE_ITS_MAX_DATA_SIZE=1024

# Two sec tags, each with a certificate, a CA certificate and a PSA key.
CONFIG_TLS_CREDENTIALS=y
CONFIG_TLS_MAX_CREDENTIALS_NUMBER=6
CONFIG_TLS_CREDENTIALS_BACKEND_PROTECTED_STORAGE=y
CONFIG_TLS_CREDENTIALS_KEYGEN=y
CONFIG_TLS_CREDENTIALS_KEYGEN_SECP384R1=y
```

## src/main.c
```c
/*
 * Copyright (c) 2026 Nordic Semiconductor ASA
 *
 * SPDX-License-Identifier: Apache-2.0
 */

/* TLS handshake with keys generated by tls_credential_keygen_generate(). The server and the client
 * each use a generated key and a self-signed certificate for it, and each trusts the certificate
 * of the peer. The server requires a client certificate, so both keys sign in the handshake.
 */

#include <string.h>
#include <zephyr/kernel.h>
#include <zephyr/ztest.h>
#include <zephyr/net/socket.h>
#include <zephyr/net/tls_credentials.h>
#include <zephyr/net/tls_credentials_keygen.h>

#include <psa/crypto.h>
#include <mbedtls/pk.h>
#include <mbedtls/x509_crt.h>

#define SERVER_TAG 10
#define CLIENT_TAG 11

#define SERVER_ADDR "127.0.0.1"
#define PORT        4243
#define HOSTNAME    "localhost"
#define SECRET      "forty-two"
#define SECRET_SIZE (sizeof(SECRET) - 1)

#define CERT_BUF_SIZE 1024
#define STACK_SIZE    8192

#if defined(CONFIG_MBEDTLS_SSL_PROTO_TLS1_3)
#define TLS_PROTO NET_IPPROTO_TLS_1_3
#else
#define TLS_PROTO NET_IPPROTO_TLS_1_2
#endif

static uint8_t server_cert[CERT_BUF_SIZE];
static size_t server_cert_len;
static uint8_t client_cert[CERT_BUF_SIZE];
static size_t client_cert_len;

static K_THREAD_STACK_DEFINE(server_stack, STACK_SIZE);
static struct k_thread server_thread;
static K_SEM_DEFINE(server_ready, 0, 1);

/* Create a self-signed certificate for the generated key of the tag. PSA makes the signature. */
static void self_signed_cert_create(sec_tag_t tag, const char *subject, mbedtls_md_type_t md,
				    uint8_t *out, size_t *out_len)
{
	static const uint8_t serial[] = {0x01};
	mbedtls_x509write_cert crt;
	mbedtls_pk_context pk;
	psa_key_id_t key_id;
	int ret;

	zassert_ok(tls_credential_keygen_key_id_get(tag, &key_id));

	mbedtls_pk_init(&pk);
	mbedtls_x509write_crt_init(&crt);

	zassert_ok(mbedtls_pk_wrap_psa(&pk, mbedtls_svc_key_id_make(0, key_id)));

	mbedtls_x509write_crt_set_version(&crt, MBEDTLS_X509_CRT_VERSION_3);
	mbedtls_x509write_crt_set_md_alg(&crt, md);
	mbedtls_x509write_crt_set_subject_key(&crt, &pk);
	mbedtls_x509write_crt_set_issuer_key(&crt, &pk);
	zassert_ok(mbedtls_x509write_crt_set_serial_raw(&crt, (uint8_t *)serial, sizeof(serial)));
	zassert_ok(mbedtls_x509write_crt_set_subject_name(&crt, subject));
	zassert_ok(mbedtls_x509write_crt_set_issuer_name(&crt, subject));
	zassert_ok(mbedtls_x509write_crt_set_validity(&crt, "20260101000000", "20991231235959"));

	ret = mbedtls_x509write_crt_der(&crt, out, CERT_BUF_SIZE);
	zassert_true(ret > 0, "Certificate writing failed: -0x%04x", (unsigned int)-ret);

	/* The DER writer writes at the end of the buffer. */
	*out_len = ret;
	memmove(out, out + CERT_BUF_SIZE - ret, ret);

	mbedtls_x509write_crt_free(&crt);
	mbedtls_pk_free(&pk);
}

static void credentials_delete(sec_tag_t tag)
{
	(void)tls_credential_keygen_delete(tag);
	(void)tls_credential_delete(tag, TLS_CREDENTIAL_PUBLIC_CERTIFICATE);
	(void)tls_credential_delete(tag, TLS_CREDENTIAL_CA_CERTIFICATE);
}

static void *setup(void)
{
	zassert_equal(psa_crypto_init(), PSA_SUCCESS);

	credentials_delete(SERVER_TAG);
	credentials_delete(CLIENT_TAG);

	/* A different curve on each side, so that both key types are used for TLS. */
	zassert_ok(
		tls_credential_keygen_generate(SERVER_TAG, TLS_CREDENTIAL_KEYGEN_ECDSA_SECP256R1));
	zassert_ok(
		tls_credential_keygen_generate(CLIENT_TAG, TLS_CREDENTIAL_KEYGEN_ECDSA_SECP384R1));

	self_signed_cert_create(SERVER_TAG, "CN=" HOSTNAME, MBEDTLS_MD_SHA256, server_cert,
				&server_cert_len);
	self_signed_cert_create(CLIENT_TAG, "CN=client", MBEDTLS_MD_SHA384, client_cert,
				&client_cert_len);

	zassert_ok(tls_credential_add(SERVER_TAG, TLS_CREDENTIAL_PUBLIC_CERTIFICATE, server_cert,
				      server_cert_len));
	zassert_ok(tls_credential_add(SERVER_TAG, TLS_CREDENTIAL_CA_CERTIFICATE, client_cert,
				      client_cert_len));
	zassert_ok(tls_credential_add(CLIENT_TAG, TLS_CREDENTIAL_PUBLIC_CERTIFICATE, client_cert,
				      client_cert_len));
	zassert_ok(tls_credential_add(CLIENT_TAG, TLS_CREDENTIAL_CA_CERTIFICATE, server_cert,
				      server_cert_len));

	return NULL;
}

static void teardown(void *fixture)
{
	ARG_UNUSED(fixture);

	credentials_delete(SERVER_TAG);
	credentials_delete(CLIENT_TAG);
}

/* Accept one client and echo the secret back. */
static void server_fn(void *arg0, void *arg1, void *arg2)
{
	int server_fd = POINTER_TO_INT(arg0);
	char buf[SECRET_SIZE];
	int client_fd;
	int ret;

	ARG_UNUSED(arg1);
	ARG_UNUSED(arg2);

	k_sem_give(&server_ready);

	client_fd = zsock_accept(server_fd, NULL, NULL);
	zassert_true(client_fd >= 0, "accept() failed (%d)", errno);

	ret = zsock_recv(client_fd, buf, sizeof(buf), ZSOCK_MSG_WAITALL);
	zassert_equal(ret, SECRET_SIZE, "recv() failed (%d)", errno);

	ret = zsock_send(client_fd, buf, ret, 0);
	zassert_equal(ret, SECRET_SIZE, "send() failed (%d)", errno);

	zassert_ok(zsock_close(client_fd));
}

static int server_start(void)
{
	static const sec_tag_t tags[] = {SERVER_TAG};
	struct net_sockaddr_in addr = {
		.sin_family = NET_AF_INET,
		.sin_port = net_htons(PORT),
		.sin_addr.s_addr = NET_INADDR_ANY,
	};
	int verify = ZSOCK_TLS_PEER_VERIFY_REQUIRED;
	int yes = 1;
	int fd;

	fd = zsock_socket(NET_AF_INET, NET_SOCK_STREAM, TLS_PROTO);
	zassert_true(fd >= 0, "socket() failed (%d)", errno);

	zassert_ok(zsock_setsockopt(fd, ZSOCK_SOL_SOCKET, ZSOCK_SO_REUSEADDR, &yes, sizeof(yes)));
	zassert_ok(zsock_setsockopt(fd, ZSOCK_SOL_TLS, ZSOCK_TLS_SEC_TAG_LIST, tags, sizeof(tags)));
	zassert_ok(zsock_setsockopt(fd, ZSOCK_SOL_TLS, ZSOCK_TLS_PEER_VERIFY, &verify,
				    sizeof(verify)));
	zassert_ok(zsock_bind(fd, (struct net_sockaddr *)&addr, sizeof(addr)));
	zassert_ok(zsock_listen(fd, 1));

	k_thread_create(&server_thread, server_stack, K_THREAD_STACK_SIZEOF(server_stack),
			server_fn, INT_TO_POINTER(fd), NULL, NULL, K_PRIO_PREEMPT(8), 0, K_NO_WAIT);
	zassert_ok(k_sem_take(&server_ready, K_SECONDS(1)));

	return fd;
}

ZTEST(tls_keygen_handshake, test_mutual_tls)
{
	static const sec_tag_t tags[] = {CLIENT_TAG};
	struct net_sockaddr_in addr = {
		.sin_family = NET_AF_INET,
		.sin_port = net_htons(PORT),
	};
	char buf[SECRET_SIZE];
	int server_fd;
	int fd;
	int ret;

	server_fd = server_start();

	zassert_equal(zsock_inet_pton(NET_AF_INET, SERVER_ADDR, &addr.sin_addr), 1);

	fd = zsock_socket(NET_AF_INET, NET_SOCK_STREAM, TLS_PROTO);
	zassert_true(fd >= 0, "socket() failed (%d)", errno);

	zassert_ok(zsock_setsockopt(fd, ZSOCK_SOL_TLS, ZSOCK_TLS_SEC_TAG_LIST, tags, sizeof(tags)));
	zassert_ok(zsock_setsockopt(fd, ZSOCK_SOL_TLS, ZSOCK_TLS_HOSTNAME, HOSTNAME,
				    sizeof(HOSTNAME)));
	zassert_ok(zsock_connect(fd, (struct net_sockaddr *)&addr, sizeof(addr)),
		   "connect() failed (%d)", errno);

	ret = zsock_send(fd, SECRET, SECRET_SIZE, 0);
	zassert_equal(ret, SECRET_SIZE, "send() failed (%d)", errno);

	ret = zsock_recv(fd, buf, sizeof(buf), ZSOCK_MSG_WAITALL);
	zassert_equal(ret, SECRET_SIZE, "recv() failed (%d)", errno);
	zassert_mem_equal(buf, SECRET, SECRET_SIZE);

	zassert_ok(zsock_close(fd));
	zassert_ok(k_thread_join(&server_thread, K_SECONDS(5)));
	zassert_ok(zsock_close(server_fd));
}

ZTEST_SUITE(tls_keygen_handshake, NULL, setup, NULL, NULL, teardown);
```
