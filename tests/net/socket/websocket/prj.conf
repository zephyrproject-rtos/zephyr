## CMakeLists.txt
```
# SPDX-License-Identifier: Apache-2.0

cmake_minimum_required(VERSION 3.28.0)
find_package(Zephyr REQUIRED HINTS $ENV{ZEPHYR_BASE})
project(websocket)

target_include_directories(app PRIVATE
  ${ZEPHYR_BASE}/subsys/net/lib/websocket
)
target_sources(app PRIVATE src/handshake.c src/poll_offload.c)
target_sources_ifdef(CONFIG_NET_TEST app PRIVATE src/main.c)
target_sources_ifndef(CONFIG_NET_TEST app PRIVATE src/loopback.c)
```

## prj.conf
```kconfig
# Networking config
CONFIG_NETWORKING=y
CONFIG_NET_TEST=y
CONFIG_NET_IPV4=y
CONFIG_NET_IPV6=y
CONFIG_NET_TCP=y
CONFIG_NET_STATISTICS=y
CONFIG_NET_DRIVERS=y
CONFIG_NET_LOOPBACK=y

# Sockets
CONFIG_NET_SOCKETS=y

# Network driver config
CONFIG_TEST_RANDOM_GENERATOR=y

# Network address config
CONFIG_NET_CONFIG_SETTINGS=n

# HTTP & Websocket
CONFIG_HTTP_CLIENT=y
CONFIG_WEBSOCKET_CLIENT=y

# Each handshake test uses a listening, a client and an accepted socket, and
# they linger in TIME_WAIT afterwards, so the default pool of six contexts runs
# out part way through the suite.
CONFIG_NET_MAX_CONTEXTS=10
CONFIG_NET_MAX_CONN=10
CONFIG_NET_TCP_TIME_WAIT_DELAY=250

# Network debug config
CONFIG_NET_LOG=y
#CONFIG_NET_WEBSOCKET_LOG_LEVEL_DBG=y

# Generic options
CONFIG_MAIN_STACK_SIZE=2048
CONFIG_HEAP_MEM_POOL_SIZE=1500

# Test options
CONFIG_ZTEST=y
CONFIG_ZTEST_STACK_SIZE=2048
```

## src/main.c
```c
/*
 * Copyright (c) 2020 Intel Corporation
 *
 * SPDX-License-Identifier: Apache-2.0
 */

#include <zephyr/logging/log.h>
LOG_MODULE_REGISTER(net_test, CONFIG_NET_WEBSOCKET_LOG_LEVEL);

#include <zephyr/ztest_assert.h>

#include <zephyr/misc/lorem_ipsum.h>
#include <zephyr/net/net_ip.h>
#include <zephyr/net/net_log.h>
#include <zephyr/net/socket.h>
#include <zephyr/net/websocket.h>
#include <zephyr/sys/fdtable.h>

#include "websocket_internal.h"

/* Generated by http://www.lipsum.com/
 * 2 paragraphs, 178 words, 1160 bytes of Lorem Ipsum
 */
static const char lorem_ipsum[] = LOREM_IPSUM;

#define MAX_RECV_BUF_LEN 256
static uint8_t recv_buf[MAX(sizeof(lorem_ipsum), MAX_RECV_BUF_LEN)];

/* We need to allocate bigger buffer for the websocket data we receive so that
 * the websocket header fits into it.
 */
#define EXTRA_BUF_SPACE 30

static uint8_t temp_recv_buf[MAX_RECV_BUF_LEN + EXTRA_BUF_SPACE];
static uint8_t feed_buf[MAX_RECV_BUF_LEN + EXTRA_BUF_SPACE];
static size_t test_msg_len;

static int test_fd_alloc(void *obj)
{
	int fd;

	fd = zvfs_reserve_fd();
	zassert_not_equal(fd, -1, "Failed to allocate FD");
	zvfs_finalize_fd(fd, obj, NULL);

	return fd;
}

static int test_recv_buf(uint8_t *input_buf, size_t input_len,
			 struct websocket_context *ctx,
			 uint32_t *msg_type, uint64_t *remaining,
			 uint8_t *recv_buffer, size_t recv_len)
{
	static struct test_data test_data;
	int fd, ret;

	test_data.ctx = ctx;
	test_data.input_buf = input_buf;
	test_data.input_len = input_len;
	test_data.input_pos = 0;

	fd = test_fd_alloc(&test_data);

	ret = websocket_recv_msg(fd, recv_buffer, recv_len,
				 msg_type, remaining, 0);

	zvfs_free_fd(fd);

	return ret;
}

/* Websocket frame, header is 6 bytes, FIN bit is set, opcode is text (1),
 * payload length is 12, masking key is e17e8eb9,
 * unmasked data is "test message"
 */
static const unsigned char frame1[] = {
	0x81, 0x8c, 0xe1, 0x7e, 0x8e, 0xb9, 0x95, 0x1b,
	0xfd, 0xcd, 0xc1, 0x13, 0xeb, 0xca, 0x92, 0x1f,
	0xe9, 0xdc
};

static const unsigned char frame1_msg[] = {
	/* Null added for printing purposes */
	't', 'e', 's', 't', ' ', 'm', 'e', 's', 's', 'a', 'g', 'e', '\0'
};

/* The frame2 has frame1 + frame1. The idea is to test a case where we
 * read full frame1 and then part of second frame
 */
static const unsigned char frame2[] = {
	0x81, 0x8c, 0xe1, 0x7e, 0x8e, 0xb9, 0x95, 0x1b,
	0xfd, 0xcd, 0xc1, 0x13, 0xeb, 0xca, 0x92, 0x1f,
	0xe9, 0xdc,
	0x81, 0x8c, 0xe1, 0x7e, 0x8e, 0xb9, 0x95, 0x1b,
	0xfd, 0xcd, 0xc1, 0x13, 0xeb, 0xca, 0x92, 0x1f,
	0xe9, 0xdc
};

/* Empty websocket frame, opcode is ping, without mask */
static const unsigned char ping[] = {0x89, 0x00};

#define FRAME1_HDR_SIZE (sizeof(frame1) - (sizeof(frame1_msg) - 1))

static void test_recv(int count)
{
	struct websocket_context ctx;
	uint32_t msg_type = -1;
	uint64_t remaining = -1;
	int total_read = 0;
	int ret, i, left;

	memset(&ctx, 0, sizeof(ctx));

	ctx.recv_buf.buf = temp_recv_buf;
	ctx.recv_buf.size = sizeof(temp_recv_buf);
	ctx.recv_buf.count = 0;

	memcpy(feed_buf, &frame1, sizeof(frame1));

	NET_DBG("Reading %d bytes at a time, frame %zd hdr %zd", count,
		sizeof(frame1), FRAME1_HDR_SIZE);

	/* We feed the frame N byte(s) at a time */
	for (i = 0; i < sizeof(frame1) / count; i++) {
		ret = test_recv_buf(&feed_buf[i * count], count,
				    &ctx, &msg_type, &remaining,
				    recv_buf + total_read,
				    sizeof(recv_buf) - total_read);
		if (count < 7 && (i * count) < FRAME1_HDR_SIZE) {
			zassert_equal(ret, -EAGAIN,
				      "[%d] Header parse failed (ret %d)",
				      i * count, ret);
		} else {
			total_read += ret;
		}
	}

	/* Read any remaining data */
	left = sizeof(frame1) % count;
	if (left > 0) {
		/* Some leftover bytes are still there */
		ret = test_recv_buf(&feed_buf[sizeof(frame1) - left], left,
				    &ctx, &msg_type, &remaining,
				    recv_buf + total_read,
				    sizeof(recv_buf) - total_read);
		zassert_true(ret <= (sizeof(recv_buf) - total_read),
			     "Invalid number of bytes read (%d)", ret);
		total_read += ret;
		zassert_equal(total_read, sizeof(frame1) - FRAME1_HDR_SIZE,
			      "Invalid amount of data read (%d)", ret);

	} else if (total_read < (sizeof(frame1) - FRAME1_HDR_SIZE)) {
		/* We read the whole message earlier, but we have parsed
		 * only part of the message. Parse the reset of the message
		 * here.
		 */
		ret = test_recv_buf(&feed_buf[FRAME1_HDR_SIZE + total_read],
			    sizeof(frame1) - FRAME1_HDR_SIZE - total_read,
				    &ctx, &msg_type, &remaining,
				    recv_buf + total_read,
				    sizeof(recv_buf) - total_read);
		total_read += ret;
		zassert_equal(total_read, sizeof(frame1) - FRAME1_HDR_SIZE,
			      "Invalid amount of data read (%d)", ret);
	}

	zassert_mem_equal(recv_buf, frame1_msg, sizeof(frame1_msg) - 1,
			  "Invalid message, should be '%s' was '%s'",
			  frame1_msg, recv_buf);

	zassert_equal(remaining, 0, "Msg not empty");
	zassert_equal(msg_type & WEBSOCKET_FLAG_TEXT, WEBSOCKET_FLAG_TEXT, "Msg is not text");
}

ZTEST(net_websocket, test_recv_1_byte)
{
	test_recv(1);
}

ZTEST(net_websocket, test_recv_2_byte)
{
	test_recv(2);
}

ZTEST(net_websocket, test_recv_3_byte)
{
	test_recv(3);
}

ZTEST(net_websocket, test_recv_6_byte)
{
	test_recv(6);
}

ZTEST(net_websocket, test_recv_7_byte)
{
	test_recv(7);
}

ZTEST(net_websocket, test_recv_8_byte)
{
	test_recv(8);
}

ZTEST(net_websocket, test_recv_9_byte)
{
	test_recv(9);
}

ZTEST(net_websocket, test_recv_10_byte)
{
	test_recv(10);
}

ZTEST(net_websocket, test_recv_12_byte)
{
	test_recv(12);
}

ZTEST(net_websocket, test_recv_whole_msg)
{
	test_recv(sizeof(frame1));
}

ZTEST(net_websocket, test_recv_empty_ping)
{
	struct websocket_context ctx;
	int total_read = 0;
	uint32_t msg_type = -1;
	uint64_t remaining = -1;

	memset(&ctx, 0, sizeof(ctx));

	ctx.recv_buf.buf = temp_recv_buf;
	ctx.recv_buf.size = sizeof(temp_recv_buf);
	ctx.recv_buf.count = 0;

	memcpy(feed_buf, &ping, sizeof(ping));

	total_read = test_recv_buf(&feed_buf[0], sizeof(ping), &ctx, &msg_type, &remaining,
				   recv_buf, sizeof(recv_buf));

	zassert_equal(total_read, 0, "Msg not empty (ret %d)", total_read);
	zassert_equal(msg_type & WEBSOCKET_FLAG_PING, WEBSOCKET_FLAG_PING, "Msg is not ping");
}

static void test_recv_2(int count)
{
	struct websocket_context ctx;
	uint32_t msg_type = -1;
	uint64_t remaining = -1;
	int total_read = 0;
	int ret;

	memset(&ctx, 0, sizeof(ctx));

	ctx.recv_buf.buf = temp_recv_buf;
	ctx.recv_buf.size = sizeof(temp_recv_buf);

	memcpy(feed_buf, &frame2, sizeof(frame2));

	NET_DBG("Reading %d bytes at a time, frame %zu hdr %zu", count,
		sizeof(frame2), FRAME1_HDR_SIZE);

	total_read = test_recv_buf(&feed_buf[0], count, &ctx, &msg_type,
				   &remaining, recv_buf, sizeof(recv_buf));

	zassert_mem_equal(recv_buf, frame1_msg, sizeof(frame1_msg) - 1,
			  "Invalid message, should be '%s' was '%s'",
			  frame1_msg, recv_buf);

	zassert_equal(remaining, 0, "Msg not empty");
	zassert_equal(msg_type & WEBSOCKET_FLAG_TEXT, WEBSOCKET_FLAG_TEXT, "Msg is not text");

	/* Then read again. Take in account that part of second frame
	 * have read from tx buffer to rx buffer.
	 */
	ret = test_recv_buf(&feed_buf[count], sizeof(frame2) - count, &ctx, &msg_type, &remaining,
			    recv_buf, sizeof(recv_buf));

	zassert_mem_equal(recv_buf, frame1_msg, sizeof(frame1_msg) - 1,
			  "Invalid 2nd message, should be '%s' was '%s'", frame1_msg, recv_buf);

	zassert_equal(remaining, 0, "Msg not empty");
	zassert_equal(msg_type & WEBSOCKET_FLAG_TEXT, WEBSOCKET_FLAG_TEXT, "Msg is not text");
}

ZTEST(net_websocket, test_recv_two_msg)
{
	test_recv_2(sizeof(frame1) + FRAME1_HDR_SIZE / 2);
}

int verify_sent_and_received_msg(struct net_msghdr *msg, bool split_msg)
{
	static struct websocket_context ctx;
	uint32_t msg_type = -1;
	uint64_t remaining = -1;
	size_t split_len = 0, total_read = 0;
	int ret;

	/* The handshake tests close their socket when they are done, which
	 * sends an empty CLOSE frame through here. There is no payload to feed
	 * back for that one.
	 */
	if ((((uint8_t *)msg->msg_iov[0].iov_base)[0] & 0x0f) ==
	    WEBSOCKET_OPCODE_CLOSE) {
		return msg->msg_iov[0].iov_len;
	}

	memset(&ctx, 0, sizeof(ctx));

	ctx.recv_buf.buf = temp_recv_buf;
	ctx.recv_buf.size = sizeof(temp_recv_buf);

	/* Read first the header */
	ret = test_recv_buf(msg->msg_iov[0].iov_base,
			    msg->msg_iov[0].iov_len,
			    &ctx, &msg_type, &remaining,
			    recv_buf, sizeof(recv_buf));
	if (remaining > 0) {
		zassert_equal(ret, -EAGAIN, "Msg header not found");
	} else {
		zassert_equal(ret, 0, "Msg header read error (ret %d)", ret);
	}

	/* Then the first split if it is enabled */
	if (split_msg) {
		split_len = msg->msg_iov[1].iov_len / 2;

		ret = test_recv_buf(msg->msg_iov[1].iov_base,
				    split_len,
				    &ctx, &msg_type, &remaining,
				    recv_buf, sizeof(recv_buf));
		zassert_true(ret > 0, "Cannot read data (%d)", ret);

		total_read = ret;
	}

	/* Then the data */
	while (remaining > 0) {
		ret = test_recv_buf((uint8_t *)msg->msg_iov[1].iov_base +
								total_read,
				    msg->msg_iov[1].iov_len - total_read,
				    &ctx, &msg_type, &remaining,
				    recv_buf, sizeof(recv_buf));
		zassert_true(ret > 0, "Cannot read data (%d)", ret);

		if (memcmp(recv_buf, lorem_ipsum + total_read, ret) != 0) {
			LOG_HEXDUMP_ERR(lorem_ipsum + total_read, ret,
					"Received message should be");
			LOG_HEXDUMP_ERR(recv_buf, ret, "but it was instead");
			zassert_true(false, "Invalid received message "
				     "after %zu bytes", total_read);
		}

		total_read += ret;
	}

	zassert_equal(total_read, test_msg_len,
		      "Msg body not valid, received %zu instead of %zu",
		      total_read, test_msg_len);

	NET_DBG("Received %zu header and %zu body",
		msg->msg_iov[0].iov_len, total_read);

	return msg->msg_iov[0].iov_len + total_read;
}

ZTEST(net_websocket, test_send_and_recv_lorem_ipsum)
{
	static struct websocket_context ctx;
	int fd, ret;

	memset(&ctx, 0, sizeof(ctx));

	ctx.recv_buf.buf = temp_recv_buf;
	ctx.recv_buf.size = sizeof(temp_recv_buf);

	test_msg_len = sizeof(lorem_ipsum) - 1;

	fd = test_fd_alloc(&ctx);
	ret = websocket_send_msg(fd, lorem_ipsum, test_msg_len,
				 WEBSOCKET_OPCODE_DATA_TEXT, true, true,
				 SYS_FOREVER_MS);
	zassert_equal(ret, test_msg_len,
		      "Should have sent %zd bytes but sent %d instead",
		      test_msg_len, ret);

	zvfs_free_fd(fd);
}

ZTEST(net_websocket, test_recv_two_large_split_msg)
{
	static struct websocket_context ctx;
	int fd, ret;

	memset(&ctx, 0, sizeof(ctx));

	ctx.recv_buf.buf = temp_recv_buf;
	ctx.recv_buf.size = sizeof(temp_recv_buf);

	test_msg_len = sizeof(lorem_ipsum) - 1;

	fd = test_fd_alloc(&ctx);
	ret = websocket_send_msg(fd, lorem_ipsum, test_msg_len,
				 WEBSOCKET_OPCODE_DATA_TEXT, false, true,
				 SYS_FOREVER_MS);
	zassert_equal(ret, test_msg_len,
		      "1st should have sent %zd bytes but sent %d instead",
		      test_msg_len, ret);

	zvfs_free_fd(fd);
}

ZTEST(net_websocket, test_send_and_recv_empty_pong)
{
	static struct websocket_context ctx;
	int fd, ret;

	memset(&ctx, 0, sizeof(ctx));

	ctx.recv_buf.buf = temp_recv_buf;
	ctx.recv_buf.size = sizeof(temp_recv_buf);

	test_msg_len = 0;

	fd = test_fd_alloc(&ctx);
	ret = websocket_send_msg(fd, NULL, test_msg_len, WEBSOCKET_OPCODE_PING,
				 true, true, SYS_FOREVER_MS);
	zassert_equal(ret, test_msg_len, "Should have sent %zd bytes but sent %d instead",
		      test_msg_len, ret);

	zvfs_free_fd(fd);
}

ZTEST(net_websocket, test_recv_in_small_buffer)
{
	struct websocket_context ctx;
	uint32_t msg_type = -1;
	uint64_t remaining = -1;
	int total_read = 0;
	int ret;
	const size_t frame1_msg_size = sizeof(frame1_msg) - 1;
	const size_t recv_buf_size = 7;

	memset(&ctx, 0, sizeof(ctx));

	ctx.recv_buf.buf = temp_recv_buf;
	ctx.recv_buf.size = sizeof(temp_recv_buf);

	memcpy(feed_buf, &frame1, sizeof(frame1));

	/* Receive first part of message */
	ret = test_recv_buf(&feed_buf[0], sizeof(frame1), &ctx, &msg_type, &remaining, recv_buf,
			    recv_buf_size);
	zassert_equal(ret, recv_buf_size, "Should have received %zd bytes but ret %d",
		      recv_buf_size, ret);
	total_read += ret;

	/* Receive second part of message */
	ret = test_recv_buf(&feed_buf[sizeof(frame1)], 0, &ctx, &msg_type, &remaining,
			    &recv_buf[recv_buf_size], recv_buf_size);
	zassert_equal(ret, frame1_msg_size - recv_buf_size,
		      "Should have received %zd bytes but ret %d", frame1_msg_size - recv_buf_size,
		      ret);
	total_read += ret;

	/* Check receiving whole message */
	zassert_equal(total_read, frame1_msg_size, "Received not whole message");
	zassert_mem_equal(recv_buf, frame1_msg, frame1_msg_size,
			  "Invalid message, should be '%s' was '%s'", frame1_msg, recv_buf);
}

ZTEST(net_websocket, test_partial_receive_reports_metadata)
{
	struct websocket_context ctx = {0};
	uint32_t msg_type = 0;
	uint64_t remaining = UINT64_MAX;
	const size_t first_payload_len = 4;
	const size_t first_input_len = FRAME1_HDR_SIZE + first_payload_len;
	int ret;

	ctx.recv_buf.buf = temp_recv_buf;
	ctx.recv_buf.size = sizeof(temp_recv_buf);
	memcpy(feed_buf, frame1, sizeof(frame1));

	/* Input ends mid-frame before the caller's receive buffer is full. */
	ret = test_recv_buf(feed_buf, first_input_len, &ctx, &msg_type, &remaining, recv_buf,
			    sizeof(recv_buf));
	zassert_equal(ret, first_payload_len, "Partial payload was not returned");
	zassert_equal(remaining, sizeof(frame1_msg) - 1 - first_payload_len,
		      "Remaining length was not updated after timeout");
	zassert_equal(msg_type, WEBSOCKET_FLAG_TEXT | WEBSOCKET_FLAG_FINAL,
		      "Message type was not updated after timeout");
	zassert_mem_equal(recv_buf, frame1_msg, first_payload_len,
			  "Partial payload was not unmasked");

	ret = test_recv_buf(feed_buf + first_input_len, sizeof(frame1) - first_input_len, &ctx,
			    &msg_type, &remaining, recv_buf + first_payload_len,
			    sizeof(recv_buf) - first_payload_len);
	zassert_equal(ret, sizeof(frame1_msg) - 1 - first_payload_len);
	zassert_equal(remaining, 0);
	zassert_equal(msg_type, WEBSOCKET_FLAG_TEXT | WEBSOCKET_FLAG_FINAL);
	zassert_mem_equal(recv_buf, frame1_msg, sizeof(frame1_msg) - 1,
			  "Payload did not resume correctly after timeout");
}

static void *setup(void)
{
	k_thread_system_pool_assign(k_current_get());
	return NULL;
}

ZTEST_SUITE(net_websocket, NULL, setup, NULL, NULL, NULL);
```

## src/handshake.c
```c
/*
 * SPDX-FileCopyrightText: Copyright The Zephyr Project Contributors
 * SPDX-License-Identifier: Apache-2.0
 */

/* Tests for the WebSocket client handshake.
 *
 * RFC 6455 section 4.1 says the client must fail the connection unless the
 * Sec-WebSocket-Accept value is exactly the base64 of the SHA-1 of the key it
 * offered concatenated with the magic GUID. Unlike the frame tests in main.c,
 * these need the real handshake, so they run a server on the loopback
 * interface that returns that value either intact or corrupted.
 */

#include <zephyr/logging/log.h>
LOG_MODULE_DECLARE(net_test, CONFIG_NET_WEBSOCKET_LOG_LEVEL);

#include <zephyr/kernel.h>
#include <zephyr/ztest.h>
#include <zephyr/net/socket.h>
#include <zephyr/net/websocket.h>
#include <zephyr/sys/base64.h>

#include <mbedtls/sha1.h>

#include "websocket_internal.h"

#define SERVER_ADDR "::1"

/* base64 of a SHA-1 digest */
#define ACCEPT_KEY_LEN 28

/* The client always offers a base64 encoded 16 byte key */
#define CLIENT_KEY_LEN 24

#define HS_STACK_SIZE 4096
#define HS_DONE_TIMEOUT K_SECONDS(5)
#define SEGMENT_GAP_MS 50
#define CONNECT_TIMEOUT_MS 2000

/* The receive buffer the client parses the response in. One of the cases below
 * deliberately lands a header value on its last byte.
 */
#define TMP_BUF_LEN 256

static const char rsp_head[] =
	"HTTP/1.1 101 Switching Protocols\r\n"
	"Upgrade: websocket\r\n"
	"Connection: Upgrade\r\n";

static const char accept_hdr[] = "Sec-WebSocket-Accept: ";

/* How the server fills in the Sec-WebSocket-Accept header */
enum accept_mode {
	ACCEPT_CORRECT,		/* the value RFC 6455 asks for */
	ACCEPT_PREFIX,		/* only the first few characters of it */
	ACCEPT_EMPTY,		/* no value at all */
	ACCEPT_WRONG,		/* right length, one character changed */
	ACCEPT_SPLIT,		/* correct, but split across two segments */
	ACCEPT_WRONG_AT_END,	/* wrong, and ending on the last byte of tmp_buf */
};

static enum accept_mode hs_mode;

static K_SEM_DEFINE(hs_done, 0, 1);
static K_THREAD_STACK_DEFINE(hs_stack, HS_STACK_SIZE);
static struct k_thread hs_thread;

static int hs_listen_sock = -1;
static int hs_client_sock = -1;
static bool hs_saw_request;

/* Each test uses its own port so a lingering connection from the previous one
 * cannot make bind() fail.
 */
static uint16_t hs_port = 9001;

static uint8_t tmp_buf[TMP_BUF_LEN];

/* Derive the Sec-WebSocket-Accept value from the key the client offered, the
 * way RFC 6455 section 4.2.2 describes it.
 */
static int compute_accept(const char *request, char *out, size_t out_len)
{
	static const char key_hdr[] = "Sec-WebSocket-Key: ";
	char buf[CLIENT_KEY_LEN + sizeof(WS_MAGIC) - 1];
	uint8_t digest[WS_SHA1_OUTPUT_LEN];
	size_t olen;
	const char *key;

	key = strstr(request, key_hdr);
	if (key == NULL) {
		return -ENOENT;
	}

	key += sizeof(key_hdr) - 1;

	memcpy(buf, key, CLIENT_KEY_LEN);
	memcpy(buf + CLIENT_KEY_LEN, WS_MAGIC, sizeof(WS_MAGIC) - 1);

	if (mbedtls_sha1((const unsigned char *)buf, sizeof(buf),
			 digest) != 0) {
		return -EIO;
	}

	if (base64_encode(out, out_len, &olen, digest, sizeof(digest)) != 0) {
		return -ENOMEM;
	}

	return 0;
}

/* Assemble the 101 response, corrupting the accept value as the mode asks.
 * Returns the length, and reports where a split should fall.
 */
static size_t build_response(char *rsp, size_t rsp_len, const char *accept,
			     size_t *split_at)
{
	char value[ACCEPT_KEY_LEN + 1];
	size_t pad = 0;
	size_t len;

	strncpy(value, accept, sizeof(value) - 1);
	value[sizeof(value) - 1] = '\0';

	switch (hs_mode) {
	case ACCEPT_PREFIX:
		value[8] = '\0';
		break;
	case ACCEPT_EMPTY:
		value[0] = '\0';
		break;
	case ACCEPT_WRONG:
	case ACCEPT_WRONG_AT_END:
		value[ACCEPT_KEY_LEN - 1] =
			(value[ACCEPT_KEY_LEN - 1] == 'A') ? 'B' : 'A';
		break;
	default:
		break;
	}

	if (hs_mode == ACCEPT_WRONG_AT_END) {
		/* Pad the response so the last character of the accept value
		 * lands on the last byte of the client's receive buffer, and
		 * make the whole thing longer than that buffer so the first
		 * read fills it exactly. The parser then hands the value over
		 * as a slice that reaches the end of the buffer, with no
		 * terminator behind it.
		 */
		pad = TMP_BUF_LEN - (sizeof(rsp_head) - 1) -
		      strlen("X-Pad: \r\n") - (sizeof(accept_hdr) - 1) -
		      ACCEPT_KEY_LEN;
	}

	len = snprintk(rsp, rsp_len, "%s", rsp_head);

	if (pad > 0) {
		len += snprintk(rsp + len, rsp_len - len, "X-Pad: ");
		memset(rsp + len, 'x', pad);
		len += pad;
		len += snprintk(rsp + len, rsp_len - len, "\r\n");
	}

	len += snprintk(rsp + len, rsp_len - len, "%s%s\r\n\r\n", accept_hdr,
			value);

	/* Split in the middle of the accept value, so the client has to match
	 * it across two calls of its header value callback.
	 */
	*split_at = sizeof(rsp_head) - 1 + sizeof(accept_hdr) - 1 +
		    (ACCEPT_KEY_LEN / 2);

	return len;
}

static void hs_server_thread(void *p1, void *p2, void *p3)
{
	char request[512];
	char response[TMP_BUF_LEN + 128];
	char accept[ACCEPT_KEY_LEN + 1];
	size_t split_at;
	size_t rsp_len;
	int received = 0;
	int sock;
	int ret;

	ARG_UNUSED(p1);
	ARG_UNUSED(p2);
	ARG_UNUSED(p3);

	sock = zsock_accept(hs_listen_sock, NULL, NULL);
	if (sock < 0) {
		goto out;
	}

	/* Read until the end of the request headers */
	while (received < (int)sizeof(request) - 1) {
		ret = zsock_recv(sock, request + received,
				 sizeof(request) - 1 - received, 0);
		if (ret <= 0) {
			goto close;
		}

		received += ret;
		request[received] = '\0';

		if (strstr(request, "\r\n\r\n") != NULL) {
			break;
		}
	}

	hs_saw_request = true;

	if (compute_accept(request, accept, sizeof(accept)) < 0) {
		goto close;
	}

	rsp_len = build_response(response, sizeof(response), accept, &split_at);

	if (hs_mode == ACCEPT_SPLIT) {
		int nodelay = 1;

		(void)zsock_setsockopt(sock, IPPROTO_TCP,
				       TCP_NODELAY, &nodelay,
				       sizeof(nodelay));
		(void)zsock_send(sock, response, split_at, 0);
		k_msleep(SEGMENT_GAP_MS);
		(void)zsock_send(sock, response + split_at,
				 rsp_len - split_at, 0);
	} else {
		(void)zsock_send(sock, response, rsp_len, 0);
	}

	/* Let the client finish the handshake before the connection goes away
	 * underneath it.
	 */
	k_msleep(SEGMENT_GAP_MS * 4);

close:
	(void)zsock_close(sock);
out:
	k_sem_give(&hs_done);
}

static void hs_server_start(struct sockaddr_in6 *addr)
{
	int ret;

	memset(addr, 0, sizeof(*addr));
	addr->sin6_family = AF_INET6;
	addr->sin6_port = htons(hs_port);
	zassert_equal(zsock_inet_pton(AF_INET6, SERVER_ADDR,
				      &addr->sin6_addr), 1,
		      "inet_pton failed");

	hs_listen_sock = zsock_socket(AF_INET6, SOCK_STREAM,
				      IPPROTO_TCP);
	zassert_true(hs_listen_sock >= 0, "server socket failed (%d)", errno);

	ret = zsock_bind(hs_listen_sock, (struct sockaddr *)addr,
			 sizeof(*addr));
	zassert_equal(ret, 0, "server bind failed (%d)", errno);

	ret = zsock_listen(hs_listen_sock, 1);
	zassert_equal(ret, 0, "server listen failed (%d)", errno);

	(void)k_thread_create(&hs_thread, hs_stack,
			      K_THREAD_STACK_SIZEOF(hs_stack),
			      hs_server_thread, NULL, NULL, NULL,
			      k_thread_priority_get(k_current_get()), 0,
			      K_NO_WAIT);
}

/* Run one handshake and report what websocket_connect() made of it */
static int do_handshake(enum accept_mode mode)
{
	struct websocket_request wreq = { 0 };
	struct sockaddr_in6 addr;
	int ret;

	hs_mode = mode;
	hs_server_start(&addr);

	hs_client_sock = zsock_socket(AF_INET6, SOCK_STREAM,
				      IPPROTO_TCP);
	zassert_true(hs_client_sock >= 0, "client socket failed (%d)", errno);

	ret = zsock_connect(hs_client_sock, (struct sockaddr *)&addr,
			    sizeof(addr));
	zassert_equal(ret, 0, "client connect failed (%d)", errno);

	wreq.host = SERVER_ADDR;
	wreq.url = "/ws";
	wreq.tmp_buf = tmp_buf;
	wreq.tmp_buf_len = sizeof(tmp_buf);

	ret = websocket_connect(hs_client_sock, &wreq, CONNECT_TIMEOUT_MS,
				NULL);

	zassert_equal(k_sem_take(&hs_done, HS_DONE_TIMEOUT), 0,
		      "server thread did not finish");
	zexpect_true(hs_saw_request, "server never saw the request");

	return ret;
}

static void expect_rejected(int ws, const char *what)
{
	zexpect_true(ws < 0, "handshake accepted %s (%d)", what, ws);

	if (ws >= 0) {
		(void)websocket_disconnect(ws);
	}
}

ZTEST(net_websocket_handshake, test_accept_correct)
{
	int ws = do_handshake(ACCEPT_CORRECT);

	zassert_true(ws >= 0, "handshake rejected a correct key (%d)", ws);

	(void)websocket_disconnect(ws);
}

/* The value is only a prefix of the expected one. Matching just the bytes the
 * server chose to send would let this through.
 */
ZTEST(net_websocket_handshake, test_accept_prefix_rejected)
{
	expect_rejected(do_handshake(ACCEPT_PREFIX), "a truncated key");
}

/* An empty value means nothing was compared at all */
ZTEST(net_websocket_handshake, test_accept_empty_rejected)
{
	expect_rejected(do_handshake(ACCEPT_EMPTY), "an empty key");
}

ZTEST(net_websocket_handshake, test_accept_wrong_rejected)
{
	expect_rejected(do_handshake(ACCEPT_WRONG), "a wrong key");
}

/* The parser hands a header value over in as many pieces as the segment
 * boundaries dictate, so a correct value that arrives split must still be
 * accepted.
 */
ZTEST(net_websocket_handshake, test_accept_split_across_segments)
{
	int ws = do_handshake(ACCEPT_SPLIT);

	zassert_true(ws >= 0, "handshake rejected a split correct key (%d)",
		     ws);

	(void)websocket_disconnect(ws);
}

/* A mismatching value that reaches the end of the receive buffer. The parser
 * gives the client a pointer and a length with no terminator behind it, so
 * logging the mismatch reads past the buffer unless the length is respected.
 * Only an allocation checker such as CONFIG_ASAN sees the difference.
 */
ZTEST(net_websocket_handshake, test_accept_wrong_at_buffer_end)
{
	expect_rejected(do_handshake(ACCEPT_WRONG_AT_END),
			"a wrong key at the buffer end");
}

static void hs_before(void *arg)
{
	ARG_UNUSED(arg);

	k_sem_reset(&hs_done);
	hs_saw_request = false;
	hs_mode = ACCEPT_CORRECT;
	hs_port++;

	/* Keep the cases independent of what the previous one left behind */
	memset(tmp_buf, 0, sizeof(tmp_buf));
}

static void hs_after(void *arg)
{
	ARG_UNUSED(arg);

	/* websocket_disconnect() releases the websocket fd only, the socket it
	 * was handed stays with us.
	 */
	if (hs_client_sock >= 0) {
		(void)zsock_close(hs_client_sock);
		hs_client_sock = -1;
	}

	if (hs_listen_sock >= 0) {
		(void)zsock_close(hs_listen_sock);
		hs_listen_sock = -1;
	}

	(void)k_thread_join(&hs_thread, K_SECONDS(1));
}

static void *hs_setup(void)
{
	k_thread_system_pool_assign(k_current_get());

	return NULL;
}

ZTEST_SUITE(net_websocket_handshake, NULL, hs_setup, hs_before, hs_after, NULL);
```

## src/loopback.c
```c
/*
 * Copyright (c) 2026 Nordic Semiconductor ASA
 * SPDX-License-Identifier: Apache-2.0
 */

/* Websocket client tests over a real TCP connection on the loopback
 * interface. The frame tests in main.c feed data straight into the parser
 * with CONFIG_NET_TEST, which stubs out the socket I/O of the websocket
 * library; the cases here need that I/O, so they build only in the scenario
 * that turns CONFIG_NET_TEST off. A server thread completes the handshake and
 * then drives the connection.
 */

#include <zephyr/logging/log.h>
LOG_MODULE_REGISTER(net_test, CONFIG_NET_WEBSOCKET_LOG_LEVEL);

#include <zephyr/kernel.h>
#include <zephyr/ztest.h>
#include <zephyr/net/socket.h>
#include <zephyr/net/websocket.h>
#include <zephyr/sys/base64.h>

#include <psa/crypto.h>

#include "websocket_internal.h"

#define SERVER_ADDR "::1"

/* base64 of a SHA-1 digest */
#define ACCEPT_KEY_LEN 28

/* The client always offers a base64 encoded 16 byte key */
#define CLIENT_KEY_LEN 24

#define SRV_STACK_SIZE 4096
#define SRV_DONE_TIMEOUT K_SECONDS(5)
#define SRV_REPLY_TIMEOUT_MS 1000
#define CONNECT_TIMEOUT_MS 2000
#define RECV_TIMEOUT_MS 2000

#define TMP_BUF_LEN 256
#define RECV_BUF_LEN 64

static const char rsp_fmt[] =
	"HTTP/1.1 101 Switching Protocols\r\n"
	"Upgrade: websocket\r\n"
	"Connection: Upgrade\r\n"
	"Sec-WebSocket-Accept: %s\r\n\r\n";

/* What the server does once the handshake is complete */
enum srv_mode {
	SRV_SILENT,		/* nothing, wait for the client to go away */
	SRV_CLOSE,		/* send an empty CLOSE frame */
	SRV_CLOSE_FRAGMENTED,	/* send a CLOSE frame with the FIN bit clear */
};

/* FIN + CLOSE, no payload, unmasked */
static const uint8_t close_frame[] = { 0x88, 0x00 };

/* CLOSE without FIN. RFC 6455 5.5 forbids fragmenting control frames, but a
 * peer may send one anyway and the client must not come apart over it.
 */
static const uint8_t close_frame_fragmented[] = { 0x08, 0x00 };

static enum srv_mode srv_mode;

static K_SEM_DEFINE(srv_done, 0, 1);
static K_THREAD_STACK_DEFINE(srv_stack, SRV_STACK_SIZE);
static struct k_thread srv_thread;

static int srv_listen_sock = -1;
static int client_sock = -1;

/* How many CLOSE frames the server read back from the client */
static int srv_close_frames;

/* Each test uses its own port so a lingering connection from the previous one
 * cannot make bind() fail.
 */
static uint16_t srv_port = 9101;

static uint8_t tmp_buf[TMP_BUF_LEN];
static uint8_t recv_buf[RECV_BUF_LEN];

/* Derive the Sec-WebSocket-Accept value from the key the client offered, the
 * way RFC 6455 section 4.2.2 describes it.
 */
static int compute_accept(const char *request, char *out, size_t out_len)
{
	static const char key_hdr[] = "Sec-WebSocket-Key: ";
	char buf[CLIENT_KEY_LEN + sizeof(WS_MAGIC) - 1];
	uint8_t digest[WS_SHA1_OUTPUT_LEN];
	size_t digest_len;
	size_t olen;
	const char *key;

	key = strstr(request, key_hdr);
	if (key == NULL) {
		return -ENOENT;
	}

	key += sizeof(key_hdr) - 1;

	memcpy(buf, key, CLIENT_KEY_LEN);
	memcpy(buf + CLIENT_KEY_LEN, WS_MAGIC, sizeof(WS_MAGIC) - 1);

	if (psa_hash_compute(PSA_ALG_SHA_1, (const uint8_t *)buf, sizeof(buf),
			     digest, sizeof(digest),
			     &digest_len) != PSA_SUCCESS) {
		return -EIO;
	}

	if (base64_encode(out, out_len, &olen, digest, digest_len) != 0) {
		return -ENOMEM;
	}

	return 0;
}

/* Count the CLOSE frames in a byte run of client frames. Client frames are
 * masked, so each carries four mask bytes after the length.
 */
static int count_close_frames(const uint8_t *buf, size_t len)
{
	size_t pos = 0;
	int count = 0;

	while (pos + 2 <= len) {
		uint8_t opcode = buf[pos] & 0x0f;
		size_t plen = buf[pos + 1] & 0x7f;
		size_t hdr = 2 + ((buf[pos + 1] & 0x80) ? 4 : 0);

		if (plen >= 126) {
			/* Not expected from the cases here */
			break;
		}

		if (opcode == WEBSOCKET_OPCODE_CLOSE) {
			count++;
		}

		pos += hdr + plen;
	}

	return count;
}

/* Read whatever the client sends until it closes the connection or goes
 * quiet, and count the CLOSE frames in it.
 */
static void srv_read_reply(int sock)
{
	struct zsock_timeval tv = {
		.tv_sec = SRV_REPLY_TIMEOUT_MS / 1000,
		.tv_usec = (SRV_REPLY_TIMEOUT_MS % 1000) * 1000,
	};
	uint8_t buf[64];
	size_t received = 0;
	int ret;

	(void)zsock_setsockopt(sock, ZSOCK_SOL_SOCKET, ZSOCK_SO_RCVTIMEO, &tv,
			       sizeof(tv));

	while (received < sizeof(buf)) {
		ret = zsock_recv(sock, buf + received, sizeof(buf) - received, 0);
		if (ret <= 0) {
			break;
		}

		received += ret;
	}

	srv_close_frames = count_close_frames(buf, received);
}

static void srv_thread_fn(void *p1, void *p2, void *p3)
{
	char request[512];
	char response[256];
	char accept[ACCEPT_KEY_LEN + 1];
	int received = 0;
	int sock;
	int ret;

	ARG_UNUSED(p1);
	ARG_UNUSED(p2);
	ARG_UNUSED(p3);

	sock = zsock_accept(srv_listen_sock, NULL, NULL);
	if (sock < 0) {
		goto out;
	}

	/* Read until the end of the request headers */
	while (received < (int)sizeof(request) - 1) {
		ret = zsock_recv(sock, request + received,
				 sizeof(request) - 1 - received, 0);
		if (ret <= 0) {
			goto close;
		}

		received += ret;
		request[received] = '\0';

		if (strstr(request, "\r\n\r\n") != NULL) {
			break;
		}
	}

	if (compute_accept(request, accept, sizeof(accept)) < 0) {
		goto close;
	}

	ret = snprintk(response, sizeof(response), rsp_fmt, accept);
	(void)zsock_send(sock, response, ret, 0);

	switch (srv_mode) {
	case SRV_CLOSE:
		(void)zsock_send(sock, close_frame, sizeof(close_frame), 0);
		break;
	case SRV_CLOSE_FRAGMENTED:
		(void)zsock_send(sock, close_frame_fragmented,
				 sizeof(close_frame_fragmented), 0);
		break;
	default:
		break;
	}

	srv_read_reply(sock);

close:
	(void)zsock_close(sock);
out:
	k_sem_give(&srv_done);
}

static void srv_start(struct net_sockaddr_in6 *addr)
{
	int ret;

	memset(addr, 0, sizeof(*addr));
	addr->sin6_family = NET_AF_INET6;
	addr->sin6_port = net_htons(srv_port);
	zassert_equal(zsock_inet_pton(NET_AF_INET6, SERVER_ADDR,
				      &addr->sin6_addr), 1,
		      "inet_pton failed");

	srv_listen_sock = zsock_socket(NET_AF_INET6, NET_SOCK_STREAM,
				       NET_IPPROTO_TCP);
	zassert_true(srv_listen_sock >= 0, "server socket failed (%d)", errno);

	ret = zsock_bind(srv_listen_sock, (struct net_sockaddr *)addr,
			 sizeof(*addr));
	zassert_equal(ret, 0, "server bind failed (%d)", errno);

	ret = zsock_listen(srv_listen_sock, 1);
	zassert_equal(ret, 0, "server listen failed (%d)", errno);

	k_sem_reset(&srv_done);
	srv_close_frames = 0;

	(void)k_thread_create(&srv_thread, srv_stack,
			      K_THREAD_STACK_SIZEOF(srv_stack),
			      srv_thread_fn, NULL, NULL, NULL,
			      k_thread_priority_get(k_current_get()), 0,
			      K_NO_WAIT);
}

static void srv_stop(void)
{
	zassert_equal(k_sem_take(&srv_done, SRV_DONE_TIMEOUT), 0,
		      "server thread did not finish");

	if (srv_listen_sock >= 0) {
		(void)zsock_close(srv_listen_sock);
		srv_listen_sock = -1;
	}

	(void)k_thread_join(&srv_thread, K_SECONDS(1));

	/* Let the connection leave TIME_WAIT so the rounds do not pile up
	 * TCP contexts.
	 */
	k_msleep(CONFIG_NET_TCP_TIME_WAIT_DELAY + 50);
}

/* Start a server in the given mode and complete a handshake against it.
 * Returns the websocket fd.
 */
static int ws_connect(enum srv_mode mode)
{
	struct websocket_request wreq = { 0 };
	struct net_sockaddr_in6 addr;
	int ws;
	int ret;

	srv_mode = mode;
	srv_port++;
	srv_start(&addr);

	client_sock = zsock_socket(NET_AF_INET6, NET_SOCK_STREAM,
				   NET_IPPROTO_TCP);
	zassert_true(client_sock >= 0, "client socket failed (%d)", errno);

	ret = zsock_connect(client_sock, (struct net_sockaddr *)&addr,
			    sizeof(addr));
	zassert_equal(ret, 0, "client connect failed (%d)", errno);

	wreq.host = SERVER_ADDR;
	wreq.url = "/ws";
	wreq.tmp_buf = tmp_buf;
	wreq.tmp_buf_len = sizeof(tmp_buf);

	ws = websocket_connect(client_sock, &wreq, CONNECT_TIMEOUT_MS, NULL);

	return ws;
}

static void client_close(void)
{
	/* websocket_disconnect() releases the websocket fd only, the socket it
	 * was handed stays with us.
	 */
	if (client_sock >= 0) {
		(void)zsock_close(client_sock);
		client_sock = -1;
	}
}

/* Receive the peer's CLOSE, hang up, and check that the client answered it
 * with exactly one CLOSE frame of its own.
 */
static void peer_close_round(enum srv_mode mode)
{
	uint32_t msg_type = 0;
	uint64_t remaining = 0;
	int ws;
	int ret;

	ws = ws_connect(mode);
	zassert_true(ws >= 0, "websocket_connect() failed (%d)", ws);

	ret = websocket_recv_msg(ws, recv_buf, sizeof(recv_buf), &msg_type,
				 &remaining, RECV_TIMEOUT_MS);
	zassert_equal(ret, 0, "expected an empty CLOSE, got %d", ret);
	zassert_true((msg_type & WEBSOCKET_FLAG_CLOSE) != 0,
		     "message type 0x%x is not CLOSE", msg_type);

	ret = websocket_disconnect(ws);
	zassert_equal(ret, 0, "websocket_disconnect() failed (%d)", ret);

	client_close();
	srv_stop();

	zassert_equal(srv_close_frames, 1,
		      "client sent %d CLOSE frames, expected 1",
		      srv_close_frames);
}

/* Every connection must hand its context back, so running more rounds than
 * there are contexts fails on a leaked slot.
 */
#define ROUNDS (CONFIG_WEBSOCKET_MAX_CONTEXTS + 1)

ZTEST(net_websocket_loopback, test_peer_close_releases_context)
{
	for (int i = 0; i < ROUNDS; i++) {
		peer_close_round(SRV_CLOSE);
	}
}

ZTEST(net_websocket_loopback, test_peer_fragmented_close_releases_context)
{
	for (int i = 0; i < ROUNDS; i++) {
		peer_close_round(SRV_CLOSE_FRAGMENTED);
	}
}

static void lb_before(void *arg)
{
	ARG_UNUSED(arg);

	memset(tmp_buf, 0, sizeof(tmp_buf));
	memset(recv_buf, 0, sizeof(recv_buf));
}

static void lb_after(void *arg)
{
	ARG_UNUSED(arg);

	client_close();

	if (srv_listen_sock >= 0) {
		(void)zsock_close(srv_listen_sock);
		srv_listen_sock = -1;
	}

	(void)k_thread_join(&srv_thread, K_SECONDS(1));
}

static void *lb_setup(void)
{
	k_thread_system_pool_assign(k_current_get());

	zassert_equal(psa_crypto_init(), PSA_SUCCESS, "psa_crypto_init failed");

	return NULL;
}

ZTEST_SUITE(net_websocket_loopback, NULL, lb_setup, lb_before, lb_after, NULL);
```

## src/poll_offload.c
```c
/*
 * Copyright The Zephyr Project Contributors
 *
 * SPDX-License-Identifier: Apache-2.0
 */

#include <errno.h>

#include <zephyr/net/socket.h>
#include <zephyr/net/websocket.h>
#include <zephyr/sys/fdtable.h>
#include <zephyr/ztest.h>

/* Transport mock whose poll_prepare returns -EXDEV, as an offloaded socket's
 * does. poll() on a websocket registered over it goes through the websocket
 * poll offload wrapper, which then calls poll_offload here.
 */

static bool offload_poll_called;
static int offload_poll_nfds;
static int ws_sock = -1;

static int offload_close(void *obj, int fd)
{
	ARG_UNUSED(obj);
	ARG_UNUSED(fd);

	return 0;
}

static int offload_poll_prepare(void *obj, struct zvfs_pollfd *pfd, struct k_poll_event **pev,
				struct k_poll_event *pev_end)
{
	ARG_UNUSED(obj);
	ARG_UNUSED(pfd);
	ARG_UNUSED(pev);
	ARG_UNUSED(pev_end);

	return -EXDEV;
}

static int offload_poll_offload(void *obj, struct zvfs_pollfd *fds, int nfds, int timeout)
{
	ARG_UNUSED(obj);
	ARG_UNUSED(fds);
	ARG_UNUSED(timeout);

	offload_poll_nfds = nfds;
	offload_poll_called = true;

	return 0;
}

/* Accept the CLOSE frame sent when the websocket is closed. */
static ssize_t offload_sendmsg(void *obj, const struct net_msghdr *msg, int flags)
{
	ssize_t len = 0;

	ARG_UNUSED(obj);
	ARG_UNUSED(flags);

	for (size_t i = 0; i < msg->msg_iovlen; i++) {
		len += msg->msg_iov[i].iov_len;
	}

	return len;
}

static const struct socket_op_vtable offload_fd_op_vtable = {
	.fd_vtable = {
			.close2 = offload_close,
			.poll_prepare = offload_poll_prepare,
			.poll_offload = offload_poll_offload,
		},
	.sendmsg = offload_sendmsg,
};

static void prepare_fds(struct zsock_pollfd *fds, size_t count)
{
	for (size_t i = 0; i < count; i++) {
		fds[i].fd = -1;
		fds[i].events = 0;
		fds[i].revents = 0;
	}

	fds[0].fd = ws_sock;
	fds[0].events = ZSOCK_POLLOUT;
}

/* Up to CONFIG_ZVFS_POLL_MAX entries reach the offloaded poll. */
ZTEST(net_websocket_poll_offload, test_poll_max_nfds)
{
	struct zsock_pollfd fds[CONFIG_ZVFS_POLL_MAX];
	int ret;

	prepare_fds(fds, ARRAY_SIZE(fds));

	ret = zsock_poll(fds, ARRAY_SIZE(fds), 0);
	zassert_equal(ret, 0, "poll() failed (%d, errno %d)", ret, errno);
	zassert_true(offload_poll_called, "Offloaded poll was not called");
	zassert_equal(offload_poll_nfds, ARRAY_SIZE(fds), "Wrong nfds passed to offload");
	zassert_equal(fds[0].fd, ws_sock, "Descriptor was not restored");
}

/* One entry more than CONFIG_ZVFS_POLL_MAX fails with EINVAL before the
 * offloaded poll is called or the caller's descriptors are touched.
 */
ZTEST(net_websocket_poll_offload, test_poll_nfds_too_large)
{
	struct zsock_pollfd fds[CONFIG_ZVFS_POLL_MAX + 1];
	int ret;

	prepare_fds(fds, ARRAY_SIZE(fds));

	ret = zsock_poll(fds, ARRAY_SIZE(fds), 0);
	zassert_equal(ret, -1, "poll() should fail");
	zassert_equal(errno, EINVAL, "Wrong errno (%d)", errno);
	zassert_false(offload_poll_called, "Offloaded poll should not be called");
	zassert_equal(fds[0].fd, ws_sock, "Descriptor was modified");
}

static void poll_offload_before(void *fixture)
{
	static int offload_obj;
	static uint8_t recv_buf[32];
	int sock;

	ARG_UNUSED(fixture);

	offload_poll_called = false;
	offload_poll_nfds = 0;

	sock = zvfs_reserve_fd();
	zassert_true(sock >= 0, "zvfs_reserve_fd() failed (%d)", sock);

	zvfs_finalize_typed_fd(sock, &offload_obj,
			       (const struct fd_op_vtable *)&offload_fd_op_vtable,
			       ZVFS_MODE_IFSOCK);

	ws_sock = websocket_register(sock, recv_buf, sizeof(recv_buf));
	if (ws_sock < 0) {
		(void)zsock_close(sock);
	}

	zassert_true(ws_sock >= 0, "websocket_register() failed (%d)", ws_sock);
}

static void poll_offload_after(void *fixture)
{
	ARG_UNUSED(fixture);

	if (ws_sock >= 0) {
		(void)websocket_unregister(ws_sock);
		ws_sock = -1;
	}
}

ZTEST_SUITE(net_websocket_poll_offload, NULL, NULL, poll_offload_before, poll_offload_after,
	    NULL);
```
