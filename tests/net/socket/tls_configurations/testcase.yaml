## tests/net/socket/tls_configurations/testcase.yaml
```yaml
common:
  tags:
    - crypto.mbedtls
    - net.socket
  platform_allow:
    - native_sim
  integration_platforms:
    - native_sim
  harness: pytest
tests:
  net.sockets.tls12.psk_kex:
    extra_configs:
      - CONFIG_MBEDTLS_CIPHERSUITE_TLS_PSK_WITH_AES_256_CBC_SHA384=y
      - CONFIG_SERVER_PORT=4001
    harness_config:
      pytest_args: ["--server-type", "1.2-psk", "--port", "4001"]
  net.sockets.tls12.ec_kex:
    extra_configs:
      - CONFIG_MBEDTLS_CIPHERSUITE_TLS_ECDHE_ECDSA_WITH_AES_128_GCM_SHA256=y
      - CONFIG_SERVER_PORT=4002
    harness_config:
      pytest_args: ["--server-type", "1.2-ec", "--port", "4002"]
  net.sockets.tls13.ephemeral_kex:
    extra_configs:
      - CONFIG_MBEDTLS_CIPHERSUITE_TLS1_3_AES_256_GCM_SHA384=y
      - CONFIG_MBEDTLS_SSL_TLS1_3_KEY_EXCHANGE_MODE_EPHEMERAL_ENABLED=y
      - CONFIG_PSA_WANT_ALG_SHA_256=y # for certificate verification
      - CONFIG_SERVER_PORT=4003
    harness_config:
      pytest_args: ["--server-type", "1.3-ephemeral", "--port", "4003"]
  net.sockets.tls13.ephemeral_kex.tickets:
    extra_configs:
      - CONFIG_MBEDTLS_SSL_SESSION_TICKETS=y
      - CONFIG_MBEDTLS_CIPHERSUITE_TLS1_3_AES_256_GCM_SHA384=y
      - CONFIG_MBEDTLS_SSL_TLS1_3_KEY_EXCHANGE_MODE_EPHEMERAL_ENABLED=y
      - CONFIG_PSA_WANT_ALG_SHA_256=y # for certificate verification
      - CONFIG_SERVER_PORT=4004
    harness_config:
      pytest_args: ["--server-type", "1.3-ephemeral-tickets", "--port", "4004"]
  net.sockets.tls13.psk_kex.tickets:
    extra_configs:
      - CONFIG_MBEDTLS_SSL_SESSION_TICKETS=y
      - CONFIG_MBEDTLS_CIPHERSUITE_TLS1_3_AES_256_GCM_SHA384=y
      - CONFIG_MBEDTLS_SSL_TLS1_3_KEY_EXCHANGE_MODE_PSK_ENABLED=y
      - CONFIG_PSA_WANT_ECC_SECP_R1_256=y # for certificate verification
      - CONFIG_PSA_WANT_ALG_SHA_256=y # for certificate verification
      - CONFIG_SERVER_PORT=4005
    harness_config:
      pytest_args: ["--server-type", "1.3-psk-tickets", "--port", "4005"]
```

## tests/net/socket/tls_ext/testcase.yaml
```yaml
common:
  tags:
    - net
    - socket
    - tls
tests:
  net.socket.tls.ext:
    platform_allow: qemu_x86
    integration_platforms:
      - qemu_x86
```

## tests/net/socket/udp/testcase.yaml
```yaml
common:
  depends_on: netif
  tags:
    - net
    - socket
    - udp
  min_ram: 21
  min_flash: 194
  filter: CONFIG_FULL_LIBC_SUPPORTED
tests:
  net.socket.udp:
    extra_configs:
      - CONFIG_NET_TC_THREAD_COOPERATIVE=y
  net.socket.udp.preempt:
    extra_configs:
      - CONFIG_NET_TC_THREAD_PREEMPTIVE=y
  net.socket.udp.ipv6_fragment:
    extra_configs:
      - CONFIG_NET_IPV6_FRAGMENT=y
  net.socket.udp.pktinfo:
    extra_configs:
      - CONFIG_NET_CONTEXT_RECV_PKTINFO=y
  net.socket.udp.port_range:
    extra_configs:
      - CONFIG_NET_CONTEXT_CLAMP_PORT_RANGE=y
  net.socket.udp.ttl:
    extra_configs:
      - CONFIG_NET_SOCKETS_PACKET=y
      - CONFIG_NET_STATISTICS=y
      - CONFIG_NET_STATISTICS_IPV4=y
      - CONFIG_NET_STATISTICS_IPV6=y
      - CONFIG_NET_STATISTICS_USER_API=y
      - CONFIG_NET_MGMT_EVENT=y
      - CONFIG_NET_MGMT=y
  net.socket.udp.tracing:
    platform_allow:
      - native_sim
      - native_sim/native/64
    extra_configs:
      - CONFIG_TRACING=y
      - CONFIG_TRACING_CTF=y
      - CONFIG_TRACING_BACKEND_POSIX=y
      - CONFIG_TRACING_PACKET_MAX_SIZE=256
      - CONFIG_TRACING_SYNC=y
```

## tests/net/socket/websocket/testcase.yaml
```yaml
common:
  depends_on: netif
  # The websocket library uses int for pointers for testing and does not work
  # reliably on 64 bit architectures.
  # See: https://github.com/zephyrproject-rtos/zephyr/issues/56542
  filter: not CONFIG_64BIT
tests:
  net.socket.websocket:
    min_ram: 21
    tags: net websocket
```

## tests/net/tcp2/testcase.yaml
```yaml
common:
  depends_on: netif
  tags: net tcp2
tests:
  net.tcp2.simple:
    extra_configs:
      - CONFIG_NET_TCP_RECV_QUEUE_TIMEOUT=1000
  net.tcp2.no_recv_queue:
    extra_configs:
      - CONFIG_NET_TCP_RECV_QUEUE_TIMEOUT=0
```

## tests/net/traffic_class/testcase.yaml
```yaml
common:
  platform_whitelist: native_posix native_posix_64
  tags: net traffic_class
tests:
  net.traffic_class.1:
    extra_configs:
      - CONFIG_NET_TC_TX_COUNT=1
      - CONFIG_NET_TC_RX_COUNT=1
  net.traffic_class.2:
    extra_configs:
      - CONFIG_NET_TC_TX_COUNT=2
      - CONFIG_NET_TC_RX_COUNT=2
  net.traffic_class.3:
    extra_configs:
      - CONFIG_NET_TC_TX_COUNT=3
      - CONFIG_NET_TC_RX_COUNT=3
  net.traffic_class.4:
    extra_configs:
      - CONFIG_NET_TC_TX_COUNT=4
      - CONFIG_NET_TC_RX_COUNT=4
  net.traffic_class.5:
    extra_configs:
      - CONFIG_NET_TC_TX_COUNT=5
      - CONFIG_NET_TC_RX_COUNT=5
  net.traffic_class.6:
    extra_configs:
      - CONFIG_NET_TC_TX_COUNT=6
      - CONFIG_NET_TC_RX_COUNT=6
  net.traffic_class.7:
    extra_configs:
      - CONFIG_NET_TC_TX_COUNT=7
      - CONFIG_NET_TC_RX_COUNT=7
  net.traffic_class.8:
    extra_configs:
      - CONFIG_NET_TC_TX_COUNT=8
      - CONFIG_NET_TC_RX_COUNT=8
# TX multi queue, RX one queue
  net.traffic_class.2_no_rx:
    extra_configs:
      - CONFIG_NET_TC_TX_COUNT=2
      - CONFIG_NET_TC_RX_COUNT=1
  net.traffic_class.3_no_rx:
    extra_configs:
      - CONFIG_NET_TC_TX_COUNT=3
      - CONFIG_NET_TC_RX_COUNT=1
  net.traffic_class.4_no_rx:
    extra_configs:
      - CONFIG_NET_TC_TX_COUNT=4
      - CONFIG_NET_TC_RX_COUNT=1
  net.traffic_class.5_no_rx:
    extra_configs:
      - CONFIG_NET_TC_TX_COUNT=5
      - CONFIG_NET_TC_RX_COUNT=1
  net.traffic_class.6_no_rx:
    extra_configs:
      - CONFIG_NET_TC_TX_COUNT=6
      - CONFIG_NET_TC_RX_COUNT=1
  net.traffic_class.7_no_rx:
    extra_configs:
      - CONFIG_NET_TC_TX_COUNT=7
      - CONFIG_NET_TC_RX_COUNT=1
  net.traffic_class.8_no_rx:
    extra_configs:
      - CONFIG_NET_TC_TX_COUNT=8
      - CONFIG_NET_TC_RX_COUNT=1
# TX one queue, RX multi queue
  net.traffic_class.2_no_tx:
    extra_configs:
      - CONFIG_NET_TC_RX_COUNT=2
      - CONFIG_NET_TC_TX_COUNT=1
  net.traffic_class.3_no_tx:
    extra_configs:
      - CONFIG_NET_TC_RX_COUNT=3
      - CONFIG_NET_TC_TX_COUNT=1
  net.traffic_class.4_no_tx:
    extra_configs:
      - CONFIG_NET_TC_RX_COUNT=4
      - CONFIG_NET_TC_TX_COUNT=1
  net.traffic_class.5_no_tx:
    extra_configs:
      - CONFIG_NET_TC_RX_COUNT=5
      - CONFIG_NET_TC_TX_COUNT=1
  net.traffic_class.6_no_tx:
    extra_configs:
      - CONFIG_NET_TC_RX_COUNT=6
      - CONFIG_NET_TC_TX_COUNT=1
  net.traffic_class.7_no_tx:
    extra_configs:
      - CONFIG_NET_TC_RX_COUNT=7
      - CONFIG_NET_TC_TX_COUNT=1
  net.traffic_class.8_no_tx:
    extra_configs:
      - CONFIG_NET_TC_RX_COUNT=8
      - CONFIG_NET_TC_TX_COUNT=1
# Then test some hybrid combinations.
  net.traffic_class.tx_2_rx_3:
    extra_configs:
      - CONFIG_NET_TC_RX_COUNT=3
      - CONFIG_NET_TC_TX_COUNT=2
  net.traffic_class.tx_3_rx_8:
    extra_configs:
      - CONFIG_NET_TC_RX_COUNT=8
      - CONFIG_NET_TC_TX_COUNT=3
  net.traffic_class.rx_4_tx_8:
    extra_configs:
      - CONFIG_NET_TC_RX_COUNT=4
      - CONFIG_NET_TC_TX_COUNT=8
  net.traffic_class.rx_5_tx_7:
    extra_configs:
      - CONFIG_NET_TC_RX_COUNT=5
      - CONFIG_NET_TC_TX_COUNT=7
  net.traffic_class.tx_6_rx_2:
    extra_configs:
      - CONFIG_NET_TC_RX_COUNT=2
      - CONFIG_NET_TC_TX_COUNT=6
  net.traffic_class.tx_7_rx_5:
    extra_configs:
      - CONFIG_NET_TC_RX_COUNT=5
      - CONFIG_NET_TC_TX_COUNT=7
  net.traffic_class.tx_8_rx_7:
    extra_configs:
      - CONFIG_NET_TC_RX_COUNT=7
      - CONFIG_NET_TC_TX_COUNT=8
  net.traffic_class.2_sr_ab:
    extra_configs:
      - CONFIG_NET_TC_MAPPING_SR_CLASS_A_AND_B=y
      - CONFIG_NET_TC_TX_COUNT=2
      - CONFIG_NET_TC_RX_COUNT=2
  net.traffic_class.3_sr_ab:
    extra_configs:
      - CONFIG_NET_TC_MAPPING_SR_CLASS_A_AND_B=y
      - CONFIG_NET_TC_TX_COUNT=3
      - CONFIG_NET_TC_RX_COUNT=3
  net.traffic_class.4_sr_ab:
    extra_configs:
      - CONFIG_NET_TC_MAPPING_SR_CLASS_A_AND_B=y
      - CONFIG_NET_TC_TX_COUNT=4
      - CONFIG_NET_TC_RX_COUNT=4
  net.traffic_class.5_sr_ab:
    extra_configs:
      - CONFIG_NET_TC_MAPPING_SR_CLASS_A_AND_B=y
      - CONFIG_NET_TC_TX_COUNT=5
      - CONFIG_NET_TC_RX_COUNT=5
  net.traffic_class.6_sr_ab:
    extra_configs:
      - CONFIG_NET_TC_MAPPING_SR_CLASS_A_AND_B=y
      - CONFIG_NET_TC_TX_COUNT=6
      - CONFIG_NET_TC_RX_COUNT=6
  net.traffic_class.7_sr_ab:
    extra_configs:
      - CONFIG_NET_TC_MAPPING_SR_CLASS_A_AND_B=y
      - CONFIG_NET_TC_TX_COUNT=7
      - CONFIG_NET_TC_RX_COUNT=7
  net.traffic_class.8_sr_ab:
    extra_configs:
      - CONFIG_NET_TC_MAPPING_SR_CLASS_A_AND_B=y
      - CONFIG_NET_TC_TX_COUNT=8
      - CONFIG_NET_TC_RX_COUNT=8
  net.traffic_class.tx_2_rx_3_sr_ab:
    extra_configs:
      - CONFIG_NET_TC_MAPPING_SR_CLASS_A_AND_B=y
      - CONFIG_NET_TC_RX_COUNT=3
      - CONFIG_NET_TC_TX_COUNT=2
  net.traffic_class.tx_3_rx_8_sr_ab:
    extra_configs:
      - CONFIG_NET_TC_MAPPING_SR_CLASS_A_AND_B=y
      - CONFIG_NET_TC_RX_COUNT=8
      - CONFIG_NET_TC_TX_COUNT=3
  net.traffic_class.rx_4_tx_8_sr_ab:
    extra_configs:
      - CONFIG_NET_TC_MAPPING_SR_CLASS_A_AND_B=y
      - CONFIG_NET_TC_RX_COUNT=4
      - CONFIG_NET_TC_TX_COUNT=8
  net.traffic_class.rx_5_tx_7_sr_ab:
    extra_configs:
      - CONFIG_NET_TC_MAPPING_SR_CLASS_A_AND_B=y
      - CONFIG_NET_TC_RX_COUNT=5
      - CONFIG_NET_TC_TX_COUNT=7
  net.traffic_class.tx_6_rx_2_sr_ab:
    extra_configs:
      - CONFIG_NET_TC_MAPPING_SR_CLASS_A_AND_B=y
      - CONFIG_NET_TC_RX_COUNT=2
      - CONFIG_NET_TC_TX_COUNT=6
  net.traffic_class.tx_7_rx_5_sr_ab:
    extra_configs:
      - CONFIG_NET_TC_MAPPING_SR_CLASS_A_AND_B=y
      - CONFIG_NET_TC_RX_COUNT=5
      - CONFIG_NET_TC_TX_COUNT=7
  net.traffic_class.tx_8_rx_7_sr_ab:
    extra_configs:
      - CONFIG_NET_TC_MAPPING_SR_CLASS_A_AND_B=y
      - CONFIG_NET_TC_RX_COUNT=7
      - CONFIG_NET_TC_TX_COUNT=8
  net.traffic_class.2_sr_b:
    extra_configs:
      - CONFIG_NET_TC_MAPPING_SR_CLASS_B_ONLY=y
      - CONFIG_NET_TC_TX_COUNT=2
      - CONFIG_NET_TC_RX_COUNT=2
  net.traffic_class.3_sr_b:
    extra_configs:
      - CONFIG_NET_TC_MAPPING_SR_CLASS_B_ONLY=y
      - CONFIG_NET_TC_TX_COUNT=3
      - CONFIG_NET_TC_RX_COUNT=3
  net.traffic_class.4_sr_b:
    extra_configs:
      - CONFIG_NET_TC_MAPPING_SR_CLASS_B_ONLY=y
      - CONFIG_NET_TC_TX_COUNT=4
      - CONFIG_NET_TC_RX_COUNT=4
  net.traffic_class.5_sr_b:
    extra_configs:
      - CONFIG_NET_TC_MAPPING_SR_CLASS_B_ONLY=y
      - CONFIG_NET_TC_TX_COUNT=5
      - CONFIG_NET_TC_RX_COUNT=5
  net.traffic_class.6_sr_b:
    extra_configs:
      - CONFIG_NET_TC_MAPPING_SR_CLASS_B_ONLY=y
      - CONFIG_NET_TC_TX_COUNT=6
      - CONFIG_NET_TC_RX_COUNT=6
  net.traffic_class.7_sr_b:
    extra_configs:
      - CONFIG_NET_TC_MAPPING_SR_CLASS_B_ONLY=y
      - CONFIG_NET_TC_TX_COUNT=7
      - CONFIG_NET_TC_RX_COUNT=7
  net.traffic_class.8_sr_b:
    extra_configs:
      - CONFIG_NET_TC_MAPPING_SR_CLASS_B_ONLY=y
      - CONFIG_NET_TC_TX_COUNT=8
      - CONFIG_NET_TC_RX_COUNT=8
  net.traffic_class.tx_2_rx_3_sr_b:
    extra_configs:
      - CONFIG_NET_TC_MAPPING_SR_CLASS_B_ONLY=y
      - CONFIG_NET_TC_RX_COUNT=3
      - CONFIG_NET_TC_TX_COUNT=2
  net.traffic_class.tx_3_rx_8_sr_b:
    extra_configs:
      - CONFIG_NET_TC_MAPPING_SR_CLASS_B_ONLY=y
      - CONFIG_NET_TC_RX_COUNT=8
      - CONFIG_NET_TC_TX_COUNT=3
  net.traffic_class.rx_4_tx_8_sr_b:
    extra_configs:
      - CONFIG_NET_TC_MAPPING_SR_CLASS_B_ONLY=y
      - CONFIG_NET_TC_RX_COUNT=4
      - CONFIG_NET_TC_TX_COUNT=8
  net.traffic_class.rx_5_tx_7_sr_b:
    extra_configs:
      - CONFIG_NET_TC_MAPPING_SR_CLASS_B_ONLY=y
      - CONFIG_NET_TC_RX_COUNT=5
      - CONFIG_NET_TC_TX_COUNT=7
  net.traffic_class.tx_6_rx_2_sr_b:
    extra_configs:
      - CONFIG_NET_TC_MAPPING_SR_CLASS_B_ONLY=y
      - CONFIG_NET_TC_RX_COUNT=2
      - CONFIG_NET_TC_TX_COUNT=6
  net.traffic_class.tx_7_rx_5_sr_b:
    extra_configs:
      - CONFIG_NET_TC_MAPPING_SR_CLASS_B_ONLY=y
      - CONFIG_NET_TC_RX_COUNT=5
      - CONFIG_NET_TC_TX_COUNT=7
  net.traffic_class.tx_8_rx_7_sr_b:
    extra_configs:
      - CONFIG_NET_TC_MAPPING_SR_CLASS_B_ONLY=y
      - CONFIG_NET_TC_RX_COUNT=7
      - CONFIG_NET_TC_TX_COUNT=8
```

## tests/net/trickle/testcase.yaml
```yaml
common:
  depends_on: netif
  tags:
    - net
    - trickle
tests:
  net.trickle:
    min_ram: 12
```

## tests/net/tx_timestamp/testcase.yaml
```yaml
common:
  tags: net tx_timestamp gptp
tests:
  net.timestamp:
    min_ram: 16
    depends_on: netif
```

## tests/net/udp/testcase.yaml
```yaml
common:
  depends_on: netif
  min_ram: 20
  tags: net
tests:
  net.udp:
    extra_configs:
      - CONFIG_NET_TC_THREAD_COOPERATIVE=y
  net.udp.preempt:
    extra_configs:
      - CONFIG_NET_TC_THREAD_PREEMPTIVE=y
```

## tests/net/utils/testcase.yaml
```yaml
common:
  pre-filter: subsys_dt_compat_enabled("ethernet")
tests:
  net.util:
    min_ram: 24
    tags: net userspace
```

## tests/net/virtual/Kconfig
```kconfig
# Private config options for virtual network interface test app

# Copyright (c) 2021 Intel Corporation
# SPDX-License-Identifier: Apache-2.0

mainmenu "Virtual network interface test application"

config NET_TEST_TUNNEL_PEER_ADDR
	string "Remote IP address of the tunnel interface"
	depends on NET_L2_IPIP
	help
	  The value depends on your network setup.

config NET_TEST_TUNNEL_MY_ADDR
	string "My address for tunnel interface"
	depends on NET_L2_IPIP
	help
	  The value depends on your network setup.

config NET_TEST_TUNNEL_NAME
	string "Name of the tunnel interface"
	depends on NET_L2_IPIP
	help
	  The value depends on your network setup.

source "Kconfig.zephyr"
```

## tests/net/vlan/testcase.yaml
```yaml
common:
  depends_on: netif
  min_ram: 32
  tags:
    - net
    - vlan
tests:
  net.vlan.separate_net_buf:
    extra_configs:
      - CONFIG_NET_L2_ETHERNET_RESERVE_HEADER=n
  net.vlan.header_reserved:
    extra_configs:
      - CONFIG_NET_L2_ETHERNET_RESERVE_HEADER=y
  net.vlan.header_reserved.variable_size:
    extra_configs:
      - CONFIG_NET_L2_ETHERNET_RESERVE_HEADER=y
      - CONFIG_NET_BUF_VARIABLE_DATA_SIZE=y
```

## tests/net/websocket/testcase.yaml
```yaml
common:
  depends_on: netif
  platform_whitelist: native_posix qemu_x86 qemu_cortex_m3
tests:
  net.websocket:
      min_ram: 46
      tags: net http websocket
```
