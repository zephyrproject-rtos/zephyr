## tests/net/wifi/configs/testcase.yaml
```yaml
common:
  build_only: true
  tags:
    - drivers
    - wifi
    - net
    - hostap
    - posix
  platform_allow:
    - native_sim
tests:
  net.wifi.build.crypto_alt:
    extra_configs: []
  net.wifi.build.crypto_none:
    extra_configs:
      - CONFIG_WIFI_NM_WPA_SUPPLICANT_CRYPTO_NONE=y
  net.wifi.build.crypto_psa:
    extra_configs:
      - CONFIG_WIFI_NM_WPA_SUPPLICANT_CRYPTO_ALT=y
      - CONFIG_WIFI_NM_WPA_SUPPLICANT_CRYPTO_MBEDTLS_PSA=y
  net.wifi.build.crypto_enterprise:
    extra_configs:
      - CONFIG_WIFI_NM_WPA_SUPPLICANT_CRYPTO_ENTERPRISE=y
      - CONFIG_MBEDTLS_SSL_PROTO_TLS1_2=y
      - CONFIG_EAP_TLS=y
      - CONFIG_EAP_TTLS=y
      - CONFIG_EAP_PEAP=y
      - CONFIG_EAP_MSCHAPV2=y
      - CONFIG_EAP_PSK=y
      - CONFIG_EAP_PAX=y
      - CONFIG_EAP_SAKE=y
      - CONFIG_EAP_GPSK=y
      - CONFIG_EAP_PWD=y
      - CONFIG_EAP_EKE=y
      - CONFIG_EAP_IKEV2=y
      - CONFIG_EAP_SIM=y
      - CONFIG_EAP_AKA=y
  net.wifi.build.wpa3:
    extra_configs:
      - CONFIG_WIFI_NM_WPA_SUPPLICANT_WPA3_IMPLEMENTATION_INT=y
      - CONFIG_MBEDTLS_SSL_PROTO_TLS1_2=y
  net.wifi.build.ap:
    extra_configs:
      - CONFIG_WIFI_NM_WPA_SUPPLICANT_AP=y
  net.wifi.build.wps:
    extra_configs:
      - CONFIG_WIFI_NM_WPA_SUPPLICANT_WPS=y
      - CONFIG_WIFI_NM_WPA_SUPPLICANT_EAPOL=y
  net.wifi.build.p2p:
    extra_configs:
      - CONFIG_WIFI_NM_WPA_SUPPLICANT_P2P=y
  net.wifi.build.hostapd_ap:
    extra_configs:
      - CONFIG_WIFI_NM_HOSTAPD_AP=y
      - CONFIG_WIFI_NM_WPA_SUPPLICANT_INF_MON=n
  net.wifi.build.hostapd_ap_enterprise:
    extra_configs:
      - CONFIG_WIFI_NM_HOSTAPD_AP=y
      - CONFIG_WIFI_NM_WPA_SUPPLICANT_INF_MON=n
      - CONFIG_WIFI_NM_WPA_SUPPLICANT_CRYPTO_ENTERPRISE=y
      - CONFIG_WIFI_NM_HOSTAPD_CRYPTO_ENTERPRISE=y
  net.wifi.build.hostapd_wps:
    extra_configs:
      - CONFIG_WIFI_NM_HOSTAPD_AP=y
      - CONFIG_WIFI_NM_WPA_SUPPLICANT_INF_MON=n
      - CONFIG_WIFI_NM_HOSTAPD_WPS=y
      - CONFIG_WIFI_NM_WPA_SUPPLICANT_WPS=y
      - CONFIG_WIFI_NM_WPA_SUPPLICANT_EAPOL=y
  net.wifi.build.hostapd_dpp:
    extra_configs:
      - CONFIG_WIFI_NM_HOSTAPD_AP=y
      - CONFIG_WIFI_NM_WPA_SUPPLICANT_INF_MON=n
      - CONFIG_WIFI_NM_WPA_SUPPLICANT_DPP=y
  net.wifi.build.roaming:
    extra_configs:
      - CONFIG_WIFI_NM_WPA_SUPPLICANT_ROAMING=y
      - CONFIG_WIFI_NM_WPA_SUPPLICANT_SKIP_DHCP_ON_ROAMING=y
  net.wifi.build.dpp:
    extra_configs:
      - CONFIG_WIFI_NM_WPA_SUPPLICANT_DPP=y
  net.wifi.build.disable_advanced_feat:
    extra_configs:
      - CONFIG_WIFI_NM_WPA_SUPPLICANT_ADVANCED_FEATURES=n
  net.wifi.build.enterprise_runtime:
    extra_configs:
      - CONFIG_WIFI_SHELL_RUNTIME_CERTIFICATES=y
    extra_args:
      - SNIPPET="wifi-enterprise"
  wifi.build.nan:
    extra_configs:
      - CONFIG_WIFI_NM_WPA_SUPPLICANT_NAN=y
```

## tests/net/wifi/hostap/testcase.yaml
```yaml
common:
  harness: ztest
  platform_allow:
    - native_sim
  tags:
    - wifi
    - hostap
    - net
tests:
  net.wifi.hostap.cmd_wq: {}
```

## tests/net/wifi/interop/boards/native_sim.conf
```kconfig
# The native_sim Wi-Fi driver is enabled by the "zephyr,native-sim-wifi" node in
# native_sim.overlay (which also sets the host interface name); it just needs
# the Zephyr supplicant.
CONFIG_WIFI_NM_WPA_SUPPLICANT=y

# The supplicant allocates scan results / connection state from the system
# heap; without a sufficiently large heap scans come back empty and connect
# fails with "AP not found".
CONFIG_HEAP_MEM_POOL_SIZE=65535

# The 4-way handshake and the AP/beacon timers are wall-clock driven on the
# host, so run the simulation in real time to keep them in sync.
CONFIG_NATIVE_SIM_SLOWDOWN_TO_REAL_TIME=y

# Put the shell UART on the process stdin/stdout (instead of a separate pty) so
# the pytest twister harness can read the prompt and send commands.
CONFIG_UART_NATIVE_PTY_0_ON_STDINOUT=y

# Network application options and configuration (dual stack). The Wi-Fi
# interface only comes up after "wifi connect", so disable the net_config
# "need address" waits: otherwise net_config blocks for up to
# CONFIG_NET_CONFIG_INIT_TIMEOUT (30s) at boot waiting for the interface and
# logs a spurious initialization failure.
CONFIG_NET_CONFIG_SETTINGS=y
CONFIG_NET_CONFIG_NEED_IPV4=n
CONFIG_NET_CONFIG_NEED_IPV6=n
CONFIG_NET_CONFIG_MY_IPV6_ADDR="2001:db8::1"
CONFIG_NET_CONFIG_PEER_IPV6_ADDR="2001:db8::2"
CONFIG_NET_CONFIG_MY_IPV4_ADDR="192.0.2.1"
CONFIG_NET_CONFIG_PEER_IPV4_ADDR="192.0.2.2"
```

## tests/net/wifi/interop/testcase.yaml
```yaml
tests:
  net.wifi.interop:
    harness: pytest
    slow: true
    timeout: 300
    # The driver compiles third-party hostap sources that trip -Wpedantic
    # (variadic macros, zero-size arrays), so do not treat warnings as errors.
    extra_args:
      - CONFIG_COMPILER_WARNINGS_AS_ERRORS=n
    platform_allow:
      - native_sim
    integration_platforms:
      - native_sim
    harness_config:
      pytest_dut_scope: module
      pytest_root:
        - "pytest/test_wifi.py"
    tags:
      - net
      - wifi
      - pytest
      - shell
```

## tests/net/wifi/wifi_nm/Kconfig
```kconfig
# Configuration options for Wi-Fi test

# Copyright (c) 2023 Nordic Semiconductor ASA
# SPDX-License-Identifier: Apache-2.0


source "Kconfig.zephyr"

# The purpose of this Kconfig is to select the hidden symbol
config WIFI_TEST_ENABLE
	bool "Enable Wi-Fi test"
	default y
	select WIFI
	select WIFI_USE_NATIVE_NETWORKING
```

## tests/net/wifi/wifi_nm/boards/arduino_portenta_h7_stm32h747xx_m7.conf
```kconfig
# Copyright (c) 2022 Benjamin Björnsson <benjamin.bjornsson@gmail.com>.
# SPDX-License-Identifier: Apache-2.0

CONFIG_HEAP_MEM_POOL_SIZE=8192
CONFIG_SDHC_INIT_PRIORITY=75
```

## tests/net/wifi/wifi_nm/testcase.yaml
```yaml
common:
  depends_on: netif
tests:
  net.wifi:
    min_ram: 32
    extra_args:
      # Will be ignored for other platforms
      - CONFIG_BUILD_ONLY_NO_BLOBS=y
    tags:
      - wifi
      - net
    platform_exclude:
      - native_sim/native/64 # hostap supplicant has 64-bit -Wformat warnings
      - rd_rw612_bga/rw612/ethernet # Requires binary blobs to build
      - frdm_rw612 # Requires binary blobs to build
      - arduino_giga_r1/stm32h747xx/m7 # Requires binary blobs to build
      - arduino_nicla_vision/stm32h747xx/m7 # Requires binary blobs to build
      - arduino_portenta_h7/stm32h747xx/m7 # Requires binary blobs to build
      - arduino_portenta_h7@4.10.0/stm32h747xx/m7 # Requires binary blobs to build
```

## tests/portability/cmsis_rtos_v1/testcase.yaml
```yaml
tests:
  portability.cmsis_rtos_v1:
    tags: cmsis_rtos
    min_ram: 32
    min_flash: 34
```

## tests/portability/cmsis_rtos_v2/testcase.yaml
```yaml
tests:
  portability.cmsis_rtos_v2:
    # qemu_x86_64 and up_squared need bigger stack
    # but CMSIS limits the stack size, resulting
    # in stack overflow.
    platform_exclude: qemu_x86_64 m2gl025_miv up_squared
    tags: cmsis_rtos
    min_ram: 32
    min_flash: 34
```

## tests/posix/barriers/testcase.yaml
```yaml
common:
  filter: not CONFIG_NATIVE_LIBC
  tags:
    - posix
    - barriers
  # 1 tier0 platform per supported architecture
  platform_key:
    - arch
    - simulation
  integration_platforms:
    - qemu_cortex_a53
  min_flash: 64
  min_ram: 32
  # FVP SMP has unresolved issues
  platform_exclude:
    - fvp_base_revc_2xaem/v8a/smp
    - fvp_base_revc_2xaem/v8a/smp/ns
    - fvp_base_revc_2xaem/v9a/smp
    - fvp_base_revc_2xaem/v9a/smp/ns
tests:
  portability.posix.barriers: {}
  portability.posix.barriers.minimal:
    extra_configs:
      - CONFIG_MINIMAL_LIBC=y
  portability.posix.barriers.newlib:
    filter: TOOLCHAIN_HAS_NEWLIB == 1
    extra_configs:
      - CONFIG_NEWLIB_LIBC=y
  portability.posix.barriers.picolibc:
    tags: picolibc
    filter: CONFIG_PICOLIBC_SUPPORTED
    extra_configs:
      - CONFIG_PICOLIBC=y
```

## tests/posix/c_lib_ext/testcase.yaml
```yaml
common:
  filter: dt_chosen_enabled("zephyr,entropy") and CONFIG_ENTROPY_HAS_DRIVER and
    not CONFIG_NATIVE_LIBC
  tags:
    - posix
    - c_lib_ext
  # 1 tier0 platform per supported architecture
  platform_key:
    - arch
    - simulation
  min_flash: 64
  min_ram: 32
tests:
  portability.posix.c_lib_ext:
    extra_configs:
      - CONFIG_COMMON_LIBC_MALLOC_ARENA_SIZE=256
  portability.posix.c_lib_ext.armclang_std_libc:
    toolchain_allow: armclang
    extra_configs:
      - CONFIG_ARMCLANG_STD_LIBC=y
  portability.posix.c_lib_ext.arcmwdtlib:
    toolchain_allow: arcmwdt
    extra_configs:
      - CONFIG_ARCMWDT_LIBC=y
  portability.posix.c_lib_ext.minimal:
    extra_configs:
      - CONFIG_MINIMAL_LIBC=y
      - CONFIG_COMMON_LIBC_MALLOC_ARENA_SIZE=256
  portability.posix.c_lib_ext.newlib:
    filter: TOOLCHAIN_HAS_NEWLIB == 1
    extra_configs:
      - CONFIG_NEWLIB_LIBC=y
  portability.posix.c_lib_ext.picolibc:
    tags: picolibc
    filter: CONFIG_PICOLIBC_SUPPORTED
    extra_configs:
      - CONFIG_PICOLIBC=y
```
