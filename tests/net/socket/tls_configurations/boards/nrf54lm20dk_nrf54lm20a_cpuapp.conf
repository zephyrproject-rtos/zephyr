## tests/net/tcp/testcase.yaml
```yaml
common:
  depends_on: netif
  tags:
    - net
    - tcp
tests:
  net.tcp.simple:
    extra_configs:
      - CONFIG_NET_TCP_RECV_QUEUE_TIMEOUT=1000
  net.tcp.no_recv_queue:
    extra_configs:
      - CONFIG_NET_TCP_RECV_QUEUE_TIMEOUT=0
  net.tcp.variable_buf_size:
    extra_configs:
      - CONFIG_NET_BUF_VARIABLE_DATA_SIZE=y
      - CONFIG_NET_PKT_BUF_RX_DATA_POOL_SIZE=4096
      - CONFIG_NET_PKT_BUF_TX_DATA_POOL_SIZE=4096
  net.tcp.isn_rfc6528:
    # Without a CSPRNG the ISN secret key cannot be generated
    filter: CONFIG_ENTROPY_HAS_DRIVER
    extra_configs:
      - CONFIG_MBEDTLS=y
      - CONFIG_MBEDTLS_PSA_CRYPTO_C=y
      - CONFIG_PSA_WANT_ALG_SHA_256=y
```

## tests/net/wifi/pmksa/Kconfig
```kconfig
# SPDX-FileCopyrightText: Copyright (c) 2026 Siddhant Modi
# SPDX-License-Identifier: Apache-2.0

source "Kconfig.zephyr"

config WIFI_TEST_ENABLE
	bool "Enable Wi-Fi test"
	default y
	select WIFI
	select WIFI_USE_NATIVE_NETWORKING
```

## tests/posix/pthread_np/testcase.yaml
```yaml
# SPDX-FileCopyrightText: Copyright The Zephyr Project Contributors
# SPDX-License-Identifier: Apache-2.0

tests:
  portability.posix.pthread_np:
    tags: posix
    depends_on: posix
```

## tests/secure_call/tz/boards/kit_pse84_eval_pse846gps2dbzc4a_m33_ns.conf
```kconfig
# SPDX-FileCopyrightText: Copyright (c) 2026 Infineon Technologies AG,
# SPDX-FileCopyrightText: or an affiliate of Infineon Technologies AG. All rights reserved.
#
# SPDX-License-Identifier: Apache-2.0

CONFIG_BUILD_WITH_TFM=n
CONFIG_APPLICATION_DEFINED_SYSCALL=y
CONFIG_ARM_FIRMWARE_USES_SECURE_CALLS=y
```

## tests/secure_call/tz_s/Kconfig
```kconfig
# SPDX-FileCopyrightText: Copyright (c) 2026 Infineon Technologies AG,
# SPDX-FileCopyrightText: or an affiliate of Infineon Technologies AG. All rights reserved.
#
# SPDX-License-Identifier: Apache-2.0

mainmenu "Secure Call TrustZone Secure Image"

config SECURE_CALL_NS_IMAGE_BASE
	hex "Non-Secure image vector table base (Non-Secure alias)"
	help
	  Address of the Non-Secure image's vector table in the Non-Secure
	  address alias. The Secure image points the Non-Secure VTOR here and
	  reads the Non-Secure initial SP/PC from it. Board-specific; set in the
	  per-board Kconfig fragment.

config SECURE_CALL_NS_IMAGE_BASE_SECURE_ALIAS
	hex "Non-Secure image vector table base (Secure alias)"
	help
	  The same physical location as SECURE_CALL_NS_IMAGE_BASE but reached
	  through the Secure address alias. The Secure image reads the Non-Secure
	  vector table through this alias before the MPC restricts Secure access
	  to the region.

source "Kconfig.zephyr"
```

## tests/subsys/applet/Kconfig
```kconfig
# Copyright (c) 2026 Intel Corporation
# SPDX-License-Identifier: Apache-2.0

mainmenu "Applet subsystem test"

config TEST_APPLET_HALT_SYSTEM
	bool "Cover APPLET_HALT_ON_FAULT_SYSTEM"
	depends on APPLET_FATAL_HANDLER
	help
	  Run the halt-on-fault SYSTEM case instead of the main ztest suite.
	  That mode ends in k_fatal_halt(), so the image never returns to the
	  test runner and the result has to be matched on the console.

source "Kconfig.zephyr"
```

## tests/subsys/canbus/canopen/eds/Kconfig
```kconfig
# SPDX-FileCopyrightText: Copyright (c) 2026 Linumiz
#
# SPDX-License-Identifier: Apache-2.0

config TEST_OD_FROM_EDS
	bool "Generate the object dictionary from test.eds"

source "Kconfig.zephyr"
```

## tests/subsys/canbus/canopen/leds/Kconfig
```kconfig
# SPDX-FileCopyrightText: Copyright (c) 2026 Linumiz
#
# SPDX-License-Identifier: Apache-2.0

config TEST_LED_BICOLOR
	bool "Drive the RUN and ERR LEDs as one bicolor LED"

source "Kconfig.zephyr"
```

## tests/subsys/canbus/isotp/conformance/boards/rtl8721f_evb.conf
```kconfig
#
# Copyright (c) 2025 Realtek Semiconductor Corp.
#
# SPDX-License-Identifier: Apache-2.0
#
CONFIG_CAN_FD_MODE=n
```

## tests/subsys/cpu_freq/cpu_freq_soc/boards/mimxrt2660_evk_mimxrt2663_cm85.conf
```kconfig
# SPDX-FileCopyrightText: Copyright 2026 NXP
# SPDX-License-Identifier: Apache-2.0

CONFIG_CPU_FREQ_PSTATE_SET_SOC=y
```

## tests/subsys/cpu_freq/cpu_freq_soc/boards/nucleo_n657x0_q_stm32n657xx_sb.conf
```kconfig
# SPDX-FileCopyrightText: Copyright The Zephyr Project Contributors
# SPDX-License-Identifier: Apache-2.0

CONFIG_CPU_FREQ_PSTATE_SET_SOC=y
CONFIG_CPU_FREQ_POLICY_ON_DEMAND=n
CONFIG_CPU_FREQ_POLICY_PRESSURE=y
CONFIG_CLOCK_STM32_N6_CPU_SCALING=y
CONFIG_CORTEX_M_SYSTICK=n
CONFIG_STM32_LPTIM_TIMER=y
CONFIG_SYS_CLOCK_HW_CYCLES_PER_SEC=32768
CONFIG_SYS_CLOCK_TICKS_PER_SEC=4096
CONFIG_PM=n
```

## tests/subsys/debug/coredump_backends/Kconfig
```kconfig
# Copyright (c) 2023 Intel Corporation
#
# SPDX-License-Identifier: Apache-2.0

source "Kconfig.zephyr"

config TEST_STORED_COREDUMP
	bool "Expected backend has coredump storage."
	help
	  Set if the test expects coredump backend with storage.

config TEST_STORED_DUMP_SIZE
	int "Expected backend's coredump storage size."
	default 0
	help
	  Test expects coredump backend storage with the size given.
	  If zero, then it is ignored and not compared with the actual size.

config TEST_BACKEND_ERROR
	bool "Expect the backend to report an error"
	help
	  Set if the backend is expected to fail, e.g. because it is
	  misconfigured, and to report it through COREDUMP_QUERY_GET_ERROR.
```

## tests/subsys/display/console/dts/bindings/display/vnd,display-fake.yaml
```yaml
# SPDX-FileCopyrightText: 2026 Muhammad Waleed Badar
# SPDX-License-Identifier: Apache-2.0

description: Display that counts the writes it receives and checks their size, for tests

compatible: "vnd,display-fake"

include: display-controller.yaml

properties:
  x-alignment-width:
    type: boolean
    description: Accept full-width writes only, as reported with SCREEN_INFO_X_ALIGNMENT_WIDTH.

  pixel-format:
    type: string
    default: "rgb565"
    enum:
      - "rgb565"
      - "rgb888"
      - "argb8888"
      - "l8"
      - "mono01"
      - "mono10"
    description: Pixel format reported and expected in the writes.

  mono-vtiled:
    type: boolean
    description: Report SCREEN_INFO_MONO_VTILED with a monochrome format.
```

## tests/subsys/fs/littlefs/boards/am62l_evm_am62l3_a53.conf
```kconfig
#
# SPDX-FileCopyrightText: 2026 Texas Instruments Incorporated
#
# SPDX-License-Identifier: Apache-2.0
#

CONFIG_FS_LITTLEFS_PROG_SIZE=256
CONFIG_FS_LITTLEFS_CACHE_SIZE=256
```

## tests/subsys/fs/littlefs/boards/nrf7120dk_nrf7120_cpuapp.conf
```kconfig
#
# Copyright (c) 2026 Nordic Semiconductor ASA
#
# SPDX-License-Identifier: Apache-2.0
#

CONFIG_FLASH_MSPI_NOR_LAYOUT_PAGE_SIZE=4096
```

## tests/subsys/ipc/ipc_link_spi/Kconfig
```kconfig
# SPDX-FileCopyrightText: Copyright (c) 2026 Basalte bv
# SPDX-License-Identifier: Apache-2.0

config TEST_IPC_LINK_SPI_MISMATCH
	bool "Test a peripheral with another frame size"
	help
	  Build the test of a controller facing a peripheral that runs
	  another frame size, with the mismatch overlay, instead of the
	  tests of a matching pair.

source "Kconfig.zephyr"
```

## tests/subsys/ipc/ipc_link_spi/dts/bindings/vnd,test-gpio-link.yaml
```yaml
# SPDX-FileCopyrightText: Copyright (c) 2026 Basalte bv
# SPDX-License-Identifier: Apache-2.0

description: |
  Test GPIO port whose pins are wires between two drivers in one image: a level written by one
  is read by the other, and fires its edge interrupts.

compatible: "vnd,test-gpio-link"

include: [gpio-controller.yaml, base.yaml]

properties:
  "#gpio-cells":
    const: 2

gpio-cells:
  - pin
  - flags
```

## tests/subsys/ipc/ipc_link_spi/dts/bindings/vnd,test-spi-link.yaml
```yaml
# SPDX-FileCopyrightText: Copyright (c) 2026 Basalte bv
# SPDX-License-Identifier: Apache-2.0

description: |
  Test SPI bus of a pair: a transfer on the controller bus runs against the transfer armed on
  its peer, the peripheral bus.

compatible: "vnd,test-spi-link"

include: spi-controller.yaml

properties:
  peer:
    type: phandle
    description: The peripheral bus, only set on the controller bus.
```

## tests/subsys/ipc/ipc_sessions/remote/boards/max78000fthr_max78000_rv32.conf
```kconfig
# Copyright (c) 2025 Analog Devices, Inc.
# SPDX-License-Identifier: Apache-2.0

CONFIG_BOOT_DELAY=300
```
