## tests/net/mld/testcase.yaml
```yaml
common:
  tags:
    - net
    - mld
  depends_on: netif
tests:
  net.mld:
    extra_configs:
      - CONFIG_NET_TC_THREAD_COOPERATIVE=y
  net.mld.preempt:
    extra_configs:
      - CONFIG_NET_TC_THREAD_PREEMPTIVE=y
  net.mld.mcast_routes:
    extra_configs:
      - CONFIG_NET_ROUTE_MCAST=y
      - CONFIG_NET_MAX_MCAST_ROUTES=5
      - CONFIG_NET_MCAST_ROUTE_MLD_REPORTS=y
```

## tests/net/neighbor/testcase.yaml
```yaml
common:
  depends_on: netif
  min_ram: 16
  tags: net neighbour
tests:
  net.neighbour:
    extra_configs:
      - CONFIG_NET_TC_THREAD_COOPERATIVE=y
  net.neighbor.preempt:
    extra_configs:
      - CONFIG_NET_TC_THREAD_PREEMPTIVE=y
```

## tests/net/net_pkt/testcase.yaml
```yaml
common:
  depends_on: netif
  min_ram: 20
  tags: net
tests:
  net.packet:
    extra_configs:
      - CONFIG_NET_TC_THREAD_COOPERATIVE=y
  net.packet.preempt:
    extra_configs:
      - CONFIG_NET_TC_THREAD_PREEMPTIVE=y
  net.packet.large_buffer:
    extra_configs:
      - CONFIG_NET_BUF_FIXED_DATA_SIZE=y
      - CONFIG_NET_BUF_DATA_SIZE=512
```

## tests/net/net_pkt_new/testcase.yaml
```yaml
common:
  depends_on: netif
  platform_whitelist: native_posix qemu_x86 qemu_cortex_m3
tests:
  net.packet:
    min_ram: 20
    tags: net
```

## tests/net/npf/testcase.yaml
```yaml
tests:
  net.pkt_filter:
    min_ram: 16
    tags:
      - net
      - npf
    depends_on: netif
```

## tests/net/offloaded_netdev/testcase.yaml
```yaml
common:
  min_ram: 16
  depends_on: netif
  tags:
    - net
    - iface
    - userspace
tests:
  net.offloaded_netdev: {}
  net.offloaded_netdev.no_native:
    extra_configs:
      - CONFIG_NET_NATIVE=n
```

## tests/net/pm/Kconfig
```kconfig
# Private config options for net pm test

# Copyright (c) 2020 Intel Corporation
# SPDX-License-Identifier: Apache-2.0

mainmenu "Network Power-Management test"

config FAKE_DEV
	def_bool y
	select NET_POWER_MANAGEMENT if DEVICE_POWER_MANAGEMENT

source "Kconfig.zephyr"
```

## tests/net/pm/testcase.yaml
```yaml
common:
  # There is nothing hw specific to be tested here
  # so let's limit the test to a few platforms.
  platform_allow:
    - qemu_x86
    - qemu_leon3
    - qemu_riscv/qemu_virt_riscv/rv32
    - qemu_riscv/qemu_virt_riscv/rv64
  integration_platforms:
    - qemu_x86
  depends_on: netif
tests:
  net.pm:
    tags: net
```

## tests/net/pmtu/testcase.yaml
```yaml
common:
  tags:
    - net
    - pmtu
  depends_on: netif
  platform_allow: qemu_x86
tests:
  net.pmtu.ipv4:
    extra_configs:
      - CONFIG_NET_IPV4_PMTU=y
  net.pmtu.ipv6:
    extra_configs:
      - CONFIG_NET_IPV6_PMTU=y
  net.pmtu.all:
    extra_configs:
      - CONFIG_NET_IPV4_PMTU=y
      - CONFIG_NET_IPV6_PMTU=y
```

## tests/net/ppp/driver/testcase.yaml
```yaml
common:
  depends_on: serial-net
  tags:
    - net
    - ppp
tests:
  net.ppp:
    min_ram: 21
  net.ppp.statistics:
    extra_args:
      - CONFIG_NET_STATISTICS=y
      - CONFIG_NET_STATISTICS_PPP=y
      - CONFIG_NET_STATISTICS_USER_API=y
```

## tests/net/promiscuous/testcase.yaml
```yaml
tests:
  net.promisc:
    min_ram: 16
    tags: net promisc
    pre-filter: subsys_dt_compat_enabled("ethernet")
```

## tests/net/ptp/Kconfig.unit
```kconfig
# Copyright (c) 2026 Philipp Steiner <philipp.steiner1987@gmail.com>
# SPDX-License-Identifier: Apache-2.0

# These white-box unit tests compile selected PTP implementation files
# directly, without enabling CONFIG_PTP and linking the full subsystem.
# Per-test Kconfig files intentionally redeclare selected PTP Kconfig entries
# so tests can provide defaults while CONFIG_PTP and its dependencies remain
# disabled. Keep those redeclarations test-local.
# Provide common PTP Kconfig defaults needed by those files here.

config PTP_LOG_LEVEL
	default 3
```

## tests/net/ptp/clock/testcase.yaml
```yaml
common:
  depends_on: netif
  # We can only run this in platforms that support PTP clock
  platform_allow:
    - frdm_k64f
    - sam_e70_xplained/same70q21
    - native_sim
  integration_platforms:
    - native_sim
tests:
  net.ptp.clock:
    min_ram: 32
    tags:
      - net
      - ptp
      - gptp
      - userspace
```

## tests/net/ptp/clock_decision/Kconfig
```kconfig
# Copyright (c) 2026 Philipp Steiner <philipp.steiner1987@gmail.com>
# SPDX-License-Identifier: Apache-2.0

rsource "../Kconfig.unit"

# See ../Kconfig.unit for why selected PTP Kconfig entries are redeclared here.

config PTP_NUM_PORTS
	default 8

config PTP_CLOCK_TYPE
	default 0x00

config PTP_CLOCK_ACCURACY
	default 0x31

config PTP_PRIORITY1
	default 128

config PTP_PRIORITY2
	default 128

source "Kconfig.zephyr"
```

## tests/net/ptp/clock_decision/testcase.yaml
```yaml
common:
  tags:
    - net
    - ptp
    - unit
  platform_allow:
    - native_sim
  integration_platforms:
    - native_sim
  depends_on: netif
tests:
  net.ptp.clock_decision:
    min_ram: 32
```

## tests/net/ptp/clock_wakeup/testcase.yaml
```yaml
common:
  tags:
    - net
    - ptp
    - unit
  platform_allow:
    - native_sim
  integration_platforms:
    - native_sim
  depends_on: netif
tests:
  net.ptp.clock_wakeup:
    min_ram: 32
```

## tests/net/ptp/foreign_master/testcase.yaml
```yaml
common:
  tags:
    - net
    - ptp
    - unit
  integration_platforms:
    - native_sim/native/64
  depends_on: netif
tests:
  net.ptp.foreign_master: {}
```

## tests/net/ptp/msg_parse/testcase.yaml
```yaml
common:
  tags:
    - net
    - ptp
    - unit
  platform_allow:
    - native_sim
    - native_sim/native/64
  integration_platforms:
    - native_sim/native/64
  depends_on: netif
tests:
  net.ptp.msg_parse: {}
  net.ptp.msg_parse.custom_peer_delay_max:
    extra_configs:
      - CONFIG_PTP_PEER_DELAY_MAX_NS=20000000
```

## tests/net/ptp/msg_post_recv/testcase.yaml
```yaml
common:
  tags:
    - net
    - ptp
    - unit
  platform_allow:
    - native_sim
  integration_platforms:
    - native_sim
  depends_on: netif
tests:
  net.ptp.msg_post_recv:
    min_ram: 32
```

## tests/net/ptp/state_matrix/Kconfig
```kconfig
# Copyright (c) 2026 Philipp Steiner <philipp.steiner1987@gmail.com>
# SPDX-License-Identifier: Apache-2.0

rsource "../Kconfig.unit"

# See ../Kconfig.unit for why selected PTP Kconfig entries are redeclared here.

config PTP_DISABLED_PRESENT
	default y

config PTP_FAULTY_PRESENT
	default y

config PTP_LISTENING_PRESENT
	default y

config PTP_PRE_TIME_TRANSMITTER_PRESENT
	default y

config PTP_UNCALIBRATED_PRESENT
	default y

source "Kconfig.zephyr"
```

## tests/net/ptp/state_matrix/testcase.yaml
```yaml
common:
  tags:
    - net
    - ptp
    - unit
  platform_allow:
    - native_sim
  integration_platforms:
    - native_sim
  depends_on: netif
tests:
  net.ptp.state_matrix:
    min_ram: 32
```

## tests/net/ptp/transport_retry/Kconfig
```kconfig
# Copyright (c) 2026 Philipp Steiner <philipp.steiner1987@gmail.com>
# SPDX-License-Identifier: Apache-2.0

rsource "../Kconfig.unit"

# See ../Kconfig.unit for why selected PTP Kconfig entries are redeclared here.

config PTP_DSCP_VALUE
	default 0

choice PTP_NETWORKING_PROTOCOL
	bool "PTP transport retry test protocol"
	default PTP_IEEE_802_3_PROTOCOL
endchoice

source "Kconfig.zephyr"
```

## tests/net/ptp/transport_retry/testcase.yaml
```yaml
common:
  tags:
    - net
    - ptp
    - unit
  platform_allow:
    - native_sim
    - native_sim/native/64
  integration_platforms:
    - native_sim/native/64
  depends_on: netif
tests:
  net.ptp.transport_retry: {}
  net.ptp.transport_retry.ipv4:
    extra_configs:
      - CONFIG_NET_IPV4=y
      - CONFIG_PTP_UDP_IPV4_PROTOCOL=y
  net.ptp.transport_retry.ipv6:
    extra_configs:
      - CONFIG_NET_IPV6=y
      - CONFIG_PTP_UDP_IPV6_PROTOCOL=y
```

## tests/net/route/ipv4/testcase.yaml
```yaml
common:
  depends_on: netif
  min_ram: 16
  tags:
    - net
    - route
tests:
  net.route.ipv4: {}
```

## tests/net/route/ipv6/testcase.yaml
```yaml
common:
  depends_on: netif
  min_ram: 16
  tags:
    - net
    - route
tests:
  net.route.ipv6: {}
  net.route.ipv6.forwarding:
    extra_configs:
      - CONFIG_NET_IPV6_FORWARDING=y
```
