## CMakeLists.txt
```
# SPDX-License-Identifier: Apache-2.0

cmake_minimum_required(VERSION 3.28.0)
find_package(Zephyr REQUIRED HINTS $ENV{ZEPHYR_BASE})
project(net_context)

target_include_directories(app PRIVATE ${ZEPHYR_BASE}/subsys/net/ip)
FILE(GLOB app_sources src/*.c)
target_sources(app PRIVATE ${app_sources})
```

## prj.conf
```kconfig
CONFIG_NETWORKING=y
CONFIG_NET_TEST=y
CONFIG_NET_IPV6=y
CONFIG_NET_UDP=y
CONFIG_NET_TCP=n
CONFIG_NET_IPV4=y
CONFIG_NET_MAX_CONTEXTS=10
CONFIG_NET_CONTEXT_CHECK=y
CONFIG_NET_CONTEXT_SYNC_RECV=y
CONFIG_NET_L2_DUMMY=y
CONFIG_NET_L2_ETHERNET=n
CONFIG_NET_LOG=y
CONFIG_ENTROPY_GENERATOR=y
CONFIG_TEST_RANDOM_GENERATOR=y
CONFIG_NET_IPV6_ND=n
CONFIG_NET_IPV6_DAD=n
CONFIG_NET_IPV6_NBR_CACHE=n
CONFIG_NET_IPV6_MLD=n
CONFIG_NET_PKT_TX_COUNT=10
CONFIG_NET_PKT_RX_COUNT=5
CONFIG_NET_BUF_RX_COUNT=10
CONFIG_NET_BUF_TX_COUNT=10
CONFIG_ZTEST=y
```

## src/attachment.c
```c
/*
 * Copyright The Zephyr Project Contributors
 * SPDX-License-Identifier: Apache-2.0
 */

#include <zephyr/kernel.h>
#include <zephyr/net/net_if.h>
#include <zephyr/ztest.h>

static bool attachment_processed(struct net_if *iface)
{
	bool processed;

	net_if_lock(iface);
	processed = iface->attachment_notified && !iface->attachment_pending;
	net_if_unlock(iface);
	return processed;
}

ZTEST(net_context, test_attachment_work_without_event_delivery)
{
	struct net_if *iface = net_if_get_default();

	zassert_not_null(iface);
	zassert_true(net_if_is_up(iface));
	net_if_lock(iface);
	iface->attachment_notified = false;
	net_if_unlock(iface);
	net_if_attachment_changed(iface);
	zassert_true(WAIT_FOR(attachment_processed(iface), 100000, k_msleep(1)));

	/* Reports inside the interval must remain deferred even without events. */
	net_if_attachment_changed(iface);
	k_msleep(50);
	zassert_false(attachment_processed(iface));
	zassert_true(WAIT_FOR(attachment_processed(iface), 1100000, k_msleep(1)));

	/* A report one interval after the previous notification is not deferred. */
	net_if_lock(iface);
	iface->attachment_last_notify = k_uptime_get_32() - 1000U;
	net_if_unlock(iface);
	net_if_attachment_changed(iface);
	zassert_true(WAIT_FOR(attachment_processed(iface), 100000, k_msleep(1)));
}
```
