## CMakeLists.txt
```
# SPDX-FileCopyrightText: Copyright The Zephyr Project Contributors
#
# SPDX-License-Identifier: Apache-2.0

cmake_minimum_required(VERSION 3.20.0)

find_package(Zephyr REQUIRED HINTS $ENV{ZEPHYR_BASE})
project(wifi_interop)

target_sources(app PRIVATE src/main.c)
```

## prj.conf
```kconfig
CONFIG_EARLY_CONSOLE=y

CONFIG_NETWORKING=y
CONFIG_TEST_RANDOM_GENERATOR=y

CONFIG_MAIN_STACK_SIZE=5200
CONFIG_SHELL_STACK_SIZE=5200
CONFIG_NET_TX_STACK_SIZE=2048
CONFIG_NET_RX_STACK_SIZE=2048

CONFIG_NET_PKT_RX_COUNT=10
CONFIG_NET_PKT_TX_COUNT=10
CONFIG_NET_BUF_RX_COUNT=20
CONFIG_NET_BUF_TX_COUNT=20
CONFIG_NET_MAX_CONTEXTS=10

CONFIG_NET_IPV4=y
CONFIG_NET_IPV6=y

CONFIG_NET_LOG=y
CONFIG_INIT_STACKS=y

CONFIG_NET_SHELL=y

CONFIG_NET_STATISTICS=y
CONFIG_NET_STATISTICS_WIFI=y
CONFIG_NET_STATISTICS_USER_API=y

CONFIG_WIFI=y
CONFIG_WIFI_LOG_LEVEL_ERR=y
CONFIG_NET_L2_WIFI_SHELL=y

# Printing of scan results puts pressure on the net_mgmt event queue, so use a
# higher timeout / larger queue for a crowded environment.
CONFIG_NET_MGMT_EVENT_QUEUE_TIMEOUT=5000
CONFIG_NET_MGMT_EVENT_QUEUE_SIZE=16
```

## boards/native_sim.conf
```kconfig
# Pull in the native_sim Wi-Fi driver and the Zephyr supplicant it needs.
CONFIG_WIFI_NATIVE_SIM=y
CONFIG_WIFI_NM_WPA_SUPPLICANT=y

# The supplicant allocates scan results / connection state from the system
# heap; without a sufficiently large heap scans come back empty and connect
# fails with "AP not found".
CONFIG_HEAP_MEM_POOL_SIZE=65535

# Host interface the driver binds to: CONFIG_WIFI_NATIVE_SIM_DRV_NAME (the host
# setup must create the STA interface with this exact name, see README.md).
CONFIG_WIFI_NATIVE_SIM_DRV_NAME="zwifi"

# The 4-way handshake and the AP/beacon timers are wall-clock driven on the
# host, so run the simulation in real time to keep them in sync.
CONFIG_NATIVE_SIM_SLOWDOWN_TO_REAL_TIME=y

# Put the shell UART on the process stdin/stdout (instead of a separate pty) so
# the pytest twister harness can read the prompt and send commands.
CONFIG_UART_NATIVE_PTY_0_ON_STDINOUT=y

# Network application options and configuration (dual stack). The Wi-Fi
# interface only comes up after "wifi connect", so disable the net_config
# "need address" waits: otherwise net_config blocks for up to
# CONFIG_NET_CONFIG_INIT_TIMEOUT (30s) at boot waiting for the interface and
# logs a spurious initialization failure.
CONFIG_NET_CONFIG_SETTINGS=y
CONFIG_NET_CONFIG_NEED_IPV4=n
CONFIG_NET_CONFIG_NEED_IPV6=n
CONFIG_NET_CONFIG_MY_IPV6_ADDR="2001:db8::1"
CONFIG_NET_CONFIG_PEER_IPV6_ADDR="2001:db8::2"
CONFIG_NET_CONFIG_MY_IPV4_ADDR="192.0.2.1"
CONFIG_NET_CONFIG_PEER_IPV4_ADDR="192.0.2.2"
```

## boards/native_sim_native_64.conf
```kconfig
# SPDX-FileCopyrightText: Copyright The Zephyr Project Contributors
#
# SPDX-License-Identifier: Apache-2.0

# Same options as native_sim.conf, for the 64-bit native_sim target.
CONFIG_WIFI_NM_WPA_SUPPLICANT=y

# The supplicant allocates scan results / connection state from the system
# heap; without a sufficiently large heap scans come back empty and connect
# fails with "AP not found".
CONFIG_HEAP_MEM_POOL_SIZE=65535

# Put the shell UART on the process stdin/stdout (instead of a separate pty) so
# the pytest twister harness can read the prompt and send commands.
CONFIG_UART_NATIVE_PTY_0_ON_STDINOUT=y

# Network application options and configuration (dual stack). The Wi-Fi
# interface only comes up after "wifi connect", so disable the net_config
# "need address" waits: otherwise net_config blocks for up to
# CONFIG_NET_CONFIG_INIT_TIMEOUT (30s) at boot waiting for the interface and
# logs a spurious initialization failure.
CONFIG_NET_CONFIG_SETTINGS=y
CONFIG_NET_CONFIG_NEED_IPV4=n
CONFIG_NET_CONFIG_NEED_IPV6=n
CONFIG_NET_CONFIG_MY_IPV6_ADDR="2001:db8::1"
CONFIG_NET_CONFIG_PEER_IPV6_ADDR="2001:db8::2"
CONFIG_NET_CONFIG_MY_IPV4_ADDR="192.0.2.1"
CONFIG_NET_CONFIG_PEER_IPV4_ADDR="192.0.2.2"
```

## boards/native_sim.overlay
```dts
/*
 * SPDX-FileCopyrightText: Copyright The Zephyr Project Contributors
 *
 * SPDX-License-Identifier: Apache-2.0
 */

/* Enable the native_sim Wi-Fi driver and bind it to the host "zwifi"
 * interface created by the net-tools mac80211_hwsim setup.
 */
/ {
	wifi0: wifi {
		compatible = "zephyr,native-sim-wifi";
		host-interface = "zwifi";
		zephyr,random-mac-address;
	};
};
```

## boards/native_sim_native_64.overlay
```dts
/*
 * SPDX-FileCopyrightText: Copyright The Zephyr Project Contributors
 *
 * SPDX-License-Identifier: Apache-2.0
 */

#include "native_sim.overlay"
```

## src/main.c
```c
/*
 * SPDX-FileCopyrightText: Copyright The Zephyr Project Contributors
 *
 * SPDX-License-Identifier: Apache-2.0
 */

/*
 * The interop test is driven entirely from the Wi-Fi shell by the pytest
 * harness, so the application itself does nothing. The shell, networking and
 * the native_sim Wi-Fi driver are all started by their own init hooks.
 */

int main(void)
{
	return 0;
}
```
