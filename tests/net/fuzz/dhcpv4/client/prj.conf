## CMakeLists.txt
```
# SPDX-FileCopyrightText: Copyright The Zephyr Project Contributors
# SPDX-FileCopyrightText: Copyright (c) 2026 Dev It Wise
# SPDX-License-Identifier: Apache-2.0

cmake_minimum_required(VERSION 3.28.0)

find_package(Zephyr REQUIRED HINTS $ENV{ZEPHYR_BASE})
project(dhcpv4_fuzz)

target_include_directories(app PRIVATE "${ZEPHYR_BASE}/subsys/net/ip")
target_include_directories(app PRIVATE "${ZEPHYR_BASE}/subsys/net/lib")

target_sources(app PRIVATE src/main.c)

# UBSan reports and continues by default, so an input that triggers
# undefined behaviour would be recorded by libFuzzer as a clean run.
zephyr_compile_options(-fno-sanitize-recover=all)
```

## prj.conf
```kconfig
# SPDX-FileCopyrightText: Copyright The Zephyr Project Contributors
# SPDX-FileCopyrightText: Copyright (c) 2026 Dev It Wise
# SPDX-License-Identifier: Apache-2.0

CONFIG_ARCH_POSIX_LIBFUZZER=y

CONFIG_ASAN=y
CONFIG_ASAN_RECOVER=n
CONFIG_UBSAN=y

CONFIG_NETWORKING=y
CONFIG_NET_TEST=y
CONFIG_NET_L2_DUMMY=y
CONFIG_NET_UDP=y
CONFIG_NET_DHCPV4=y

# Register callbacks so the option-callback decode surface (a second
# path into the parser, distinct from the switch-based one) is fuzzed
# too.
CONFIG_NET_DHCPV4_OPTION_CALLBACKS=y
CONFIG_NET_DHCPV4_OPTION_CALLBACKS_VENDOR_SPECIFIC=y
CONFIG_NET_BUF=y
CONFIG_NET_PKT_RX_COUNT=5
CONFIG_NET_PKT_TX_COUNT=5
CONFIG_NET_BUF_RX_COUNT=12
CONFIG_NET_BUF_TX_COUNT=12
CONFIG_ENTROPY_GENERATOR=y
CONFIG_TEST_RANDOM_GENERATOR=y
CONFIG_NET_IF_UNICAST_IPV4_ADDR_COUNT=1
CONFIG_NET_IPV4=y
CONFIG_NET_IPV6=n

# net_recv_data() hands the packet to a receive thread unless there are
# no receive queues at all. A case parsed after the harness has moved on
# would be attributed to whichever input libFuzzer executed next, and a
# crash found that way would not replay, so the packet is processed in
# the caller's context instead.
CONFIG_NET_TC_RX_COUNT=0

CONFIG_NET_MGMT=y
CONFIG_NET_MGMT_EVENT=y

# A case is bounded by a fixed window of simulated time, so nothing in
# it may be deferred to a logging thread and land in the next case.
CONFIG_LOG=n

CONFIG_MAIN_STACK_SIZE=3072
```

## src/main.c
```c
/*
 * SPDX-FileCopyrightText: Copyright The Zephyr Project Contributors
 * SPDX-FileCopyrightText: Copyright (c) 2026 Dev It Wise
 * SPDX-License-Identifier: Apache-2.0
 */

/*
 * libFuzzer harness for the DHCPv4 client's receive path.
 *
 * The harness registers a dummy interface the way
 * tests/net/dhcpv4/client/src/main.c does, starts the real client with
 * net_dhcpv4_start(), builds a full IPv4 + UDP + DHCP packet around the
 * fuzz case and hands it to the stack with net_recv_data() - the same
 * entry point a real driver uses for an inbound frame.
 *
 * Each case is injected twice, once with the client placed in SELECTING
 * and once in REQUESTING - the two states its OFFER and ACK handlers act
 * in. Left where net_dhcpv4_start() puts it the client sits in INIT,
 * where both handlers fall out of their state switch and nothing past
 * the option parser is reached.
 *
 * The fuzz case is the DHCP message body (fixed header, SNAME, FILE,
 * cookie, options). xid and chaddr are visible to any on-LAN attacker in
 * the client's DISCOVER but are runtime values (entropy, MAC), so the
 * harness patches them into the case before injection - otherwise
 * dhcpv4.c's xid/chaddr check would drop nearly every case before the
 * option parser runs.
 *
 * The option decoder's plain and vendor-specific (option 43) callbacks
 * are also registered, so that decode surface is fuzzed too.
 *
 * The reply is decoded on a Zephyr thread, not in the caller's context
 * (net_dhcpv4_start() arms a delayable work item under a lock), so each
 * case is handed off via interrupt the way
 * samples/subsys/debug/fuzz/src/main.c does: stash the case, raise a
 * "hardware" interrupt, let the simulator run for a fixed tick count.
 *
 * See README.rst for how to build and run it.
 */

#include <stddef.h>
#include <stdint.h>
#include <string.h>

#include <zephyr/kernel.h>
#include <zephyr/device.h>
#include <zephyr/irq.h>
#include <zephyr/net/net_core.h>
#include <zephyr/net/net_pkt.h>
#include <zephyr/net/net_ip.h>
#include <zephyr/net/net_if.h>
#include <zephyr/net/dhcpv4.h>
#include <zephyr/net/dummy.h>
#include <zephyr/sys/printk.h>
#include <zephyr/toolchain.h>

#include "ipv4.h"
#include "udp_internal.h"
#include "dhcpv4/dhcpv4_internal.h"

#if defined(CONFIG_BOARD_NATIVE_SIM)
#include <irq_ctrl.h>
#include <nsi_cpu_if.h>
#include <nsi_main_semipublic.h>
#else
#error "Platform not supported"
#endif

/* The fuzz case: DHCP body (struct dhcp_msg, SNAME, FILE, cookie,
 * options) appended after the IPv4/UDP headers. Anything shorter than
 * the fixed header is skipped, not padded - padding would report a
 * state no server can produce.
 */
#define FUZZ_MAX_INPUT 512

/* IRQ used to hand a case to main(). Native sim has 32 lines and none
 * are claimed here, so any is free; matches the fuzz sample's default.
 */
#define FUZZ_IRQ 31

/* Ticks the simulator runs per case. A case completes in one shot on
 * the woken thread, so this only covers the ISR hand-off; every seed
 * already reaches the parser at the debug-fuzz sample's default of 2.
 * The larger value is headroom for a mutated case.
 */
#define FUZZ_TICKS 100

static const struct net_in_addr server_addr = { { { 192, 0, 2, 1 } } };
static const struct net_in_addr client_addr = { { { 255, 255, 255, 255 } } };

/* Stands in for the address an OFFER would have put in requested_ip, for
 * the run that starts in REQUESTING. Same RFC 5737 documentation range as
 * the server address above.
 */
static const struct net_in_addr offered_ip = { { { 192, 0, 2, 2 } } };

#define SERVER_PORT 67
#define CLIENT_PORT 68

static int dhcpv4_fuzz_dev_init(const struct device *dev)
{
	ARG_UNUSED(dev);

	return 0;
}

static uint8_t dhcpv4_fuzz_mac[6] = { 0x00, 0x00, 0x5e, 0x00, 0x53, 0x01 };

static void dhcpv4_fuzz_iface_init(struct net_if *iface)
{
	net_if_set_link_addr(iface, dhcpv4_fuzz_mac, sizeof(dhcpv4_fuzz_mac), NET_LINK_ETHERNET);
}

static int dhcpv4_fuzz_send(const struct device *dev, struct net_pkt *pkt)
{
	/* Not part of the fuzz surface: the harness controls what is sent.
	 * Nothing answers it; the harness supplies the reply itself.
	 */
	ARG_UNUSED(dev);
	ARG_UNUSED(pkt);

	return 0;
}

static const struct dummy_api dhcpv4_fuzz_if_api = {
	.iface_api.init = dhcpv4_fuzz_iface_init,
	.send = dhcpv4_fuzz_send,
};

NET_DEVICE_INIT(dhcpv4_fuzz, "dhcpv4_fuzz", dhcpv4_fuzz_dev_init, NULL, NULL, NULL,
		CONFIG_KERNEL_INIT_PRIORITY_DEFAULT, &dhcpv4_fuzz_if_api, DUMMY_L2,
		NET_L2_GET_CTX_TYPE(DUMMY_L2), 127);

/* Deliberately smaller than several seed option values, so a handler
 * must rely on the clamp below rather than a buffer that happens to fit.
 */
#define FUZZ_CB_BUF_SIZE 4

static uint8_t fuzz_plain_cb_buf[FUZZ_CB_BUF_SIZE];
static uint8_t fuzz_vendor_cb_buf[FUZZ_CB_BUF_SIZE];
static struct net_dhcpv4_option_callback fuzz_plain_cb;
static struct net_dhcpv4_option_callback fuzz_vendor_cb;

/* Routed by dhcpv4_parse_options() whenever option 15 (domain name) is
 * seen, ahead of - and independent from - the switch that decodes it
 * a second time.
 */
#define FUZZ_PLAIN_CB_OPTION DHCPV4_OPTIONS_DOMAIN_NAME

/* Neither offer's nor ack's malformed vendor option claims this inner
 * code, so reaching this handler means the well-formed path is being
 * exercised.
 */
#define FUZZ_VENDOR_CB_OPTION 0x09

static void fuzz_option_cb(struct net_dhcpv4_option_callback *cb, size_t length,
			   enum net_dhcpv4_msg_type msg_type, struct net_if *iface)
{
	size_t n = MIN(cb->max_length, length);
	volatile uint8_t sink = 0;

	ARG_UNUSED(msg_type);
	ARG_UNUSED(iface);

	/* Handlers get the unclamped `length`, but only MIN(cb->max_length,
	 * length) bytes were written into cb->data - re-derive the clamp
	 * instead of trusting `length`.
	 */
	for (size_t i = 0; i < n; i++) {
		sink ^= ((uint8_t *)cb->data)[i];
	}
	(void)sink;
}

static void fuzz_register_option_callbacks(void)
{
	net_dhcpv4_init_option_callback(&fuzz_plain_cb, fuzz_option_cb, FUZZ_PLAIN_CB_OPTION,
					fuzz_plain_cb_buf, sizeof(fuzz_plain_cb_buf));
	net_dhcpv4_init_option_vendor_callback(&fuzz_vendor_cb, fuzz_option_cb,
					       FUZZ_VENDOR_CB_OPTION, fuzz_vendor_cb_buf,
					       sizeof(fuzz_vendor_cb_buf));

	if (net_dhcpv4_add_option_callback(&fuzz_plain_cb) != 0) {
		printk("dhcpv4 fuzz harness is broken: option callback registration failed "
		       "(not a DHCPv4 defect)\n");
		k_panic();
	}

	if (net_dhcpv4_add_option_vendor_callback(&fuzz_vendor_cb) != 0) {
		printk("dhcpv4 fuzz harness is broken: option callback registration failed "
		       "(not a DHCPv4 defect)\n");
		k_panic();
	}
}

/* Fuzz input, handed to main()'s thread via "interrupt" rather than
 * called directly from LLVMFuzzerTestOneInput().
 */
static uint8_t fuzz_case[FUZZ_MAX_INPUT];
static size_t fuzz_sz;

K_SEM_DEFINE(fuzz_sem, 0, K_SEM_MAX_LIMIT);

static void fuzz_isr(const void *arg)
{
	ARG_UNUSED(arg);

	k_sem_give(&fuzz_sem);
}

/* Patch xid and chaddr - the only fields dhcpv4.c checks before handing
 * off to the option parser. Both are visible to any on-LAN attacker in
 * the client's DISCOVER, so this costs the fuzzer nothing realistic.
 */
static void patch_header(uint8_t *body, size_t len, uint32_t xid, const uint8_t *chaddr,
			  uint8_t chaddr_len)
{
	struct dhcp_msg msg;

	__ASSERT_NO_MSG(len >= sizeof(msg));

	memcpy(&msg, body, sizeof(msg));
	msg.xid = net_htonl(xid);
	memcpy(msg.chaddr, chaddr, chaddr_len);
	memcpy(body, &msg, sizeof(msg));
}

static void run_one(struct net_if *iface, const uint8_t *data, size_t size,
		    enum net_dhcpv4_state state)
{
	uint8_t body[FUZZ_MAX_INPUT];
	struct net_pkt *pkt;
	uint32_t xid;

	net_dhcpv4_start(iface);

	/* net_dhcpv4_start() leaves the client in INIT and defers SELECTING
	 * to a work item armed CONFIG_NET_DHCPV4_INITIAL_DELAY_MAX seconds
	 * out at most, far beyond the window a case runs in. Both
	 * dhcpv4_handle_msg_offer() and dhcpv4_handle_msg_ack() fall straight
	 * out of their state switch while the state is INIT, so a case
	 * injected there never reaches the code that reads the offered
	 * address and the server id out of the message. Put the client in the
	 * state the message under test is answered in.
	 */
	iface->config.dhcpv4.state = state;

	/* REQUESTING is only ever entered from an OFFER, which is what fills
	 * requested_ip and request_server_addr in. An ACK handled with
	 * requested_ip still zero stops at net_if_ipv4_addr_add() instead of
	 * reaching dhcpv4_enter_bound(), and a NAK from a server other than
	 * request_server_addr is dropped before its handler.
	 */
	if (state == NET_DHCPV4_REQUESTING) {
		iface->config.dhcpv4.requested_ip = offered_ip;
		iface->config.dhcpv4.request_server_addr = server_addr;
	}

	xid = iface->config.dhcpv4.xid;

	memcpy(body, data, size);
	patch_header(body, size, xid, net_if_get_link_addr(iface)->addr,
		     net_if_get_link_addr(iface)->len);

	/* The checks below are unreachable by fuzz input (bounded by
	 * FUZZ_MAX_INPUT, pool sized for it); reaching one means the
	 * harness itself is broken. Panic so the failure is loud rather
	 * than silently under-reporting coverage.
	 */
	pkt = net_pkt_alloc_with_buffer(iface, size, NET_AF_INET, NET_IPPROTO_UDP, K_FOREVER);
	if (pkt == NULL) {
		printk("dhcpv4 fuzz harness is broken: net_pkt_alloc_with_buffer() failed "
		       "(not a DHCPv4 defect)\n");
		k_panic();
	}

	net_pkt_set_ipv4_ttl(pkt, 0xFF);

	if (net_ipv4_create(pkt, &server_addr, &client_addr) != 0 ||
	    net_udp_create(pkt, net_htons(SERVER_PORT), net_htons(CLIENT_PORT)) != 0 ||
	    net_pkt_write(pkt, body, size) != 0) {
		net_pkt_unref(pkt);
		printk("dhcpv4 fuzz harness is broken: packet build failed "
		       "(not a DHCPv4 defect)\n");
		k_panic();
	}

	net_pkt_cursor_init(pkt);
	if (net_ipv4_finalize(pkt, NET_IPPROTO_UDP) != 0) {
		net_pkt_unref(pkt);
		printk("dhcpv4 fuzz harness is broken: net_ipv4_finalize() failed "
		       "(not a DHCPv4 defect)\n");
		k_panic();
	}

	/* Unlike the panics above, net_recv_data() failing is the stack
	 * rejecting the packet - exactly what this harness is fuzzing for.
	 */
	if (net_recv_data(iface, pkt) != 0) {
		net_pkt_unref(pkt);
	}

	/* Reset before the next case: net_dhcpv4_stop() leaves these in
	 * place, and whether the next case is accepted, and what it binds
	 * with, would depend on what this one left in them.
	 */
	net_dhcpv4_stop(iface);
	iface->config.dhcpv4.requested_ip.s_addr = NET_INADDR_ANY;
	iface->config.dhcpv4.server_id.s_addr = NET_INADDR_ANY;
	iface->config.dhcpv4.request_server_addr.s_addr = NET_INADDR_ANY;
	iface->config.dhcpv4.netmask.s_addr = NET_INADDR_ANY;
	iface->config.dhcpv4.lease_time = 0U;
	iface->config.dhcpv4.renewal_time = 0U;
	iface->config.dhcpv4.rebinding_time = 0U;
}

int main(void)
{
	struct net_if *iface = net_if_get_first_by_type(&NET_L2_GET_NAME(DUMMY));

	__ASSERT_NO_MSG(iface != NULL);

	fuzz_register_option_callbacks();

	IRQ_CONNECT(FUZZ_IRQ, 0, fuzz_isr, NULL, 0);
	irq_enable(FUZZ_IRQ);

	while (true) {
		/* Not K_FOREVER: net_dhcpv4_stop() disarms the client's own
		 * work item at the end of a case, so nothing is left armed
		 * and an idle CPU asks the tick driver for its maximum. The
		 * native simulator runs whole events rather than bounded
		 * time and takes that timeout in one step, so uptime gains
		 * INT32_MAX ticks per case and the client decodes lease
		 * times against a clock no device reaches. Waiting for the
		 * window LLVMFuzzerTestOneInput() gives the simulator keeps
		 * the next event inside it.
		 */
		if (k_sem_take(&fuzz_sem, K_TICKS(FUZZ_TICKS)) != 0) {
			continue;
		}

		/* Run the case handed off via interrupt, once in each of the
		 * two states the client answers a server message in: SELECTING,
		 * where an OFFER is handled, and REQUESTING, where an ACK is.
		 * One state alone leaves the other handler unreached for every
		 * case.
		 */
		run_one(iface, fuzz_case, fuzz_sz, NET_DHCPV4_SELECTING);
		run_one(iface, fuzz_case, fuzz_sz, NET_DHCPV4_REQUESTING);
	}

	return 0;
}

/**
 * Entry point for fuzzing: place data into known symbols, trigger an
 * interrupt, then run the simulator long enough to reach quiescence.
 */
#if defined(CONFIG_BOARD_NATIVE_SIM)
NATIVE_SIMULATOR_IF /* We expose this function to the final runner link stage */
#endif
int LLVMFuzzerTestOneInput(const uint8_t *data, size_t size)
{
	static bool runner_initialized;

	if (!runner_initialized) {
		nsi_init(0, NULL);
		runner_initialized = true;
	}

	if (size < sizeof(struct dhcp_msg) || size > FUZZ_MAX_INPUT) {
		/* Skip rather than truncate/pad: keeps a kept case
		 * identical to what ran, and the patched header intact.
		 */
		return 0;
	}

	/* Hand the fuzz data to the embedded OS as an interrupt. */
	memcpy(fuzz_case, data, size);
	fuzz_sz = size;

	hw_irq_ctrl_set_irq(FUZZ_IRQ);

	/* Let the OS process the interrupt and reach idle. */
	nsi_exec_for(k_ticks_to_us_ceil64(FUZZ_TICKS));

	return 0;
}
```
