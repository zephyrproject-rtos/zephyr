## tests/lib/cmsis_dsp/matrix/Kconfig
```kconfig
# Copyright (c) 2021 Stephanos Ioannidis <root@stephanos.io>
# SPDX-License-Identifier: Apache-2.0

config CMSIS_DSP_TEST_MATRIX_UNARY_Q7
	bool "Test: Matrix Unary Q7"

config CMSIS_DSP_TEST_MATRIX_UNARY_Q15
	bool "Test: Matrix Unary Q15"

config CMSIS_DSP_TEST_MATRIX_UNARY_Q31
	bool "Test: Matrix Unary Q31"

config CMSIS_DSP_TEST_MATRIX_UNARY_F16
	bool "Test: Matrix Unary F16"
	depends on CMSIS_DSP_FLOAT16

config CMSIS_DSP_TEST_MATRIX_UNARY_F32
	bool "Test: Matrix Unary F32"

config CMSIS_DSP_TEST_MATRIX_UNARY_F64
	bool "Test: Matrix Unary F64"

config CMSIS_DSP_TEST_MATRIX_BINARY_Q7
	bool "Test: Matrix Binary Q7"

config CMSIS_DSP_TEST_MATRIX_BINARY_Q15
	bool "Test: Matrix Binary Q15"

config CMSIS_DSP_TEST_MATRIX_BINARY_Q31
	bool "Test: Matrix Binary Q31"

config CMSIS_DSP_TEST_MATRIX_BINARY_F16
	bool "Test: Matrix Binary F16"
	depends on CMSIS_DSP_FLOAT16

config CMSIS_DSP_TEST_MATRIX_BINARY_F32
	bool "Test: Matrix Binary F32"

config CMSIS_DSP_TEST_MATRIX_BINARY_F64
	bool "Test: Matrix Binary F64"

source "Kconfig"
```

## tests/lib/cmsis_dsp/matrix/testcase.yaml
```yaml
common:
  arch_allow:
    - arm
    - posix
tests:
  libraries.cmsis_dsp.matrix:
    filter: ((CONFIG_CPU_AARCH32_CORTEX_R or CONFIG_CPU_CORTEX_M) and CONFIG_FULL_LIBC_SUPPORTED
      ) or CONFIG_ARCH_POSIX
    tags: cmsis-dsp
    platform_allow:
      - mps2/an521/cpu0
      - native_sim/native
      - mps2/an385
      - qemu_cortex_r5/zynqmp_rpu
    integration_platforms:
      - native_sim/native
  libraries.cmsis_dsp.matrix.unary_q7:
    filter: ((CONFIG_CPU_AARCH32_CORTEX_R or CONFIG_CPU_CORTEX_M) and CONFIG_FULL_LIBC_SUPPORTED
      ) or CONFIG_ARCH_POSIX
    integration_platforms:
      - frdm_k64f
      - sam_e70_xplained/same70q21
      - mps2/an521/cpu0
      - native_sim
    tags: cmsis-dsp
    min_flash: 128
    min_ram: 64
    extra_args: CONF_FILE=prj_base.conf
    extra_configs:
      - CONFIG_CMSIS_DSP_TEST_MATRIX_UNARY_Q7=y
  libraries.cmsis_dsp.matrix.unary_q7.fpu:
    filter: ((CONFIG_CPU_AARCH32_CORTEX_R or CONFIG_CPU_CORTEX_M) and CONFIG_CPU_HAS_FPU
      and CONFIG_FULL_LIBC_SUPPORTED) or CONFIG_ARCH_POSIX
    integration_platforms:
      - mps2/an521/cpu1
      - mps3/corstone300/an547
    tags:
      - cmsis-dsp
      - fpu
    min_flash: 128
    min_ram: 64
    extra_args: CONF_FILE=prj_base.conf
    extra_configs:
      - CONFIG_CMSIS_DSP_TEST_MATRIX_UNARY_Q7=y
      - CONFIG_FPU=y
  libraries.cmsis_dsp.matrix.unary_q15:
    filter: ((CONFIG_CPU_AARCH32_CORTEX_R or CONFIG_CPU_CORTEX_M) and CONFIG_FULL_LIBC_SUPPORTED
      ) or CONFIG_ARCH_POSIX
    integration_platforms:
      - frdm_k64f
      - sam_e70_xplained/same70q21
      - mps2/an521/cpu0
      - native_sim
    tags: cmsis-dsp
    min_flash: 128
    min_ram: 64
    extra_args: CONF_FILE=prj_base.conf
    extra_configs:
      - CONFIG_CMSIS_DSP_TEST_MATRIX_UNARY_Q15=y
  libraries.cmsis_dsp.matrix.unary_q15.fpu:
    filter: ((CONFIG_CPU_AARCH32_CORTEX_R or CONFIG_CPU_CORTEX_M) and CONFIG_CPU_HAS_FPU
      and CONFIG_FULL_LIBC_SUPPORTED) or CONFIG_ARCH_POSIX
    integration_platforms:
      - mps2/an521/cpu1
      - mps3/corstone300/an547
    tags:
      - cmsis-dsp
      - fpu
    min_flash: 128
    min_ram: 64
    extra_args: CONF_FILE=prj_base.conf
    extra_configs:
      - CONFIG_CMSIS_DSP_TEST_MATRIX_UNARY_Q15=y
      - CONFIG_FPU=y
  libraries.cmsis_dsp.matrix.unary_q31:
    filter: ((CONFIG_CPU_AARCH32_CORTEX_R or CONFIG_CPU_CORTEX_M) and CONFIG_FULL_LIBC_SUPPORTED
      ) or CONFIG_ARCH_POSIX
    integration_platforms:
      - frdm_k64f
      - sam_e70_xplained/same70q21
      - mps2/an521/cpu0
      - native_sim
    tags: cmsis-dsp
    min_flash: 128
    min_ram: 64
    extra_args: CONF_FILE=prj_base.conf
    extra_configs:
      - CONFIG_CMSIS_DSP_TEST_MATRIX_UNARY_Q31=y
  libraries.cmsis_dsp.matrix.unary_q31.fpu:
    filter: ((CONFIG_CPU_AARCH32_CORTEX_R or CONFIG_CPU_CORTEX_M) and CONFIG_CPU_HAS_FPU
      and CONFIG_FULL_LIBC_SUPPORTED) or CONFIG_ARCH_POSIX
    integration_platforms:
      - mps2/an521/cpu1
      - mps3/corstone300/an547
    tags:
      - cmsis-dsp
      - fpu
    min_flash: 128
    min_ram: 64
    extra_args: CONF_FILE=prj_base.conf
    extra_configs:
      - CONFIG_CMSIS_DSP_TEST_MATRIX_UNARY_Q31=y
      - CONFIG_FPU=y
  libraries.cmsis_dsp.matrix.unary_f16:
    filter: (CONFIG_CMSIS_DSP_FLOAT16 and (CONFIG_CPU_AARCH32_CORTEX_R or CONFIG_CPU_CORTEX_M)
      and CONFIG_FULL_LIBC_SUPPORTED)
    integration_platforms:
      - frdm_k64f
      - sam_e70_xplained/same70q21
      - mps2/an521/cpu0
    tags: cmsis-dsp
    min_flash: 128
    min_ram: 64
    extra_args: CONF_FILE=prj_base.conf
    extra_configs:
      - CONFIG_CMSIS_DSP_TEST_MATRIX_UNARY_F16=y
  libraries.cmsis_dsp.matrix.unary_f16.fpu:
    filter: (CONFIG_CMSIS_DSP_FLOAT16 and (CONFIG_CPU_AARCH32_CORTEX_R or CONFIG_CPU_CORTEX_M)
      and CONFIG_CPU_HAS_FPU and CONFIG_FULL_LIBC_SUPPORTED)
    integration_platforms:
      - mps2/an521/cpu1
      - mps3/corstone300/an547
    tags:
      - cmsis-dsp
      - fpu
    min_flash: 128
    min_ram: 64
    extra_args: CONF_FILE=prj_base.conf
    extra_configs:
      - CONFIG_CMSIS_DSP_TEST_MATRIX_UNARY_F16=y
      - CONFIG_FPU=y
  libraries.cmsis_dsp.matrix.unary_f32:
    filter: ((CONFIG_CPU_AARCH32_CORTEX_R or CONFIG_CPU_CORTEX_M) and CONFIG_FULL_LIBC_SUPPORTED
      ) or CONFIG_ARCH_POSIX
    integration_platforms:
      - frdm_k64f
      - sam_e70_xplained/same70q21
      - mps2/an521/cpu0
      - native_sim
    tags: cmsis-dsp
    min_flash: 128
    min_ram: 64
    extra_args: CONF_FILE=prj_base.conf
    extra_configs:
      - CONFIG_CMSIS_DSP_TEST_MATRIX_UNARY_F32=y
  libraries.cmsis_dsp.matrix.unary_f32.fpu:
    filter: ((CONFIG_CPU_AARCH32_CORTEX_R or CONFIG_CPU_CORTEX_M) and CONFIG_CPU_HAS_FPU
      and CONFIG_FULL_LIBC_SUPPORTED) or CONFIG_ARCH_POSIX
    integration_platforms:
      - mps2/an521/cpu1
      - mps3/corstone300/an547
    tags:
      - cmsis-dsp
      - fpu
    min_flash: 128
    min_ram: 64
    extra_args: CONF_FILE=prj_base.conf
    extra_configs:
      - CONFIG_CMSIS_DSP_TEST_MATRIX_UNARY_F32=y
      - CONFIG_FPU=y
  libraries.cmsis_dsp.matrix.unary_f64:
    filter: ((CONFIG_CPU_AARCH32_CORTEX_R or CONFIG_CPU_CORTEX_M) and CONFIG_FULL_LIBC_SUPPORTED
      ) or CONFIG_ARCH_POSIX
    integration_platforms:
      - frdm_k64f
      - sam_e70_xplained/same70q21
      - mps2/an521/cpu0
      - native_sim
    tags: cmsis-dsp
    min_flash: 128
    min_ram: 72
    extra_args: CONF_FILE=prj_base.conf
    extra_configs:
      - CONFIG_CMSIS_DSP_TEST_MATRIX_UNARY_F64=y
  libraries.cmsis_dsp.matrix.unary_f64.fpu:
    filter: ((CONFIG_CPU_AARCH32_CORTEX_R or CONFIG_CPU_CORTEX_M) and CONFIG_CPU_HAS_FPU
      and CONFIG_FULL_LIBC_SUPPORTED) or CONFIG_ARCH_POSIX
    integration_platforms:
      - mps2/an521/cpu1
      - mps3/corstone300/an547
    tags:
      - cmsis-dsp
      - fpu
    min_flash: 128
    min_ram: 72
    extra_args: CONF_FILE=prj_base.conf
    extra_configs:
      - CONFIG_CMSIS_DSP_TEST_MATRIX_UNARY_F64=y
      - CONFIG_FPU=y
  libraries.cmsis_dsp.matrix.binary_q7:
    filter: ((CONFIG_CPU_AARCH32_CORTEX_R or CONFIG_CPU_CORTEX_M) and CONFIG_FULL_LIBC_SUPPORTED
      ) or CONFIG_ARCH_POSIX
    integration_platforms:
      - frdm_k64f
      - sam_e70_xplained/same70q21
      - mps2/an521/cpu0
      - native_sim
    tags: cmsis-dsp
    platform_exclude: frdm_kw41z
    min_flash: 128
    min_ram: 128
    extra_args: CONF_FILE=prj_base.conf
    extra_configs:
      - CONFIG_CMSIS_DSP_TEST_MATRIX_BINARY_Q7=y
  libraries.cmsis_dsp.matrix.binary_q7.fpu:
    filter: ((CONFIG_CPU_AARCH32_CORTEX_R or CONFIG_CPU_CORTEX_M) and CONFIG_CPU_HAS_FPU
      and CONFIG_FULL_LIBC_SUPPORTED) or CONFIG_ARCH_POSIX
    integration_platforms:
      - mps2/an521/cpu1
      - mps3/corstone300/an547
    tags:
      - cmsis-dsp
      - fpu
    platform_exclude: frdm_kw41z
    min_flash: 128
    min_ram: 128
    extra_args: CONF_FILE=prj_base.conf
    extra_configs:
      - CONFIG_CMSIS_DSP_TEST_MATRIX_BINARY_Q7=y
      - CONFIG_FPU=y
  libraries.cmsis_dsp.matrix.binary_q15:
    filter: ((CONFIG_CPU_AARCH32_CORTEX_R or CONFIG_CPU_CORTEX_M) and CONFIG_FULL_LIBC_SUPPORTED
      ) or CONFIG_ARCH_POSIX
    integration_platforms:
      - frdm_k64f
      - sam_e70_xplained/same70q21
      - mps2/an521/cpu0
      - native_sim
    tags: cmsis-dsp
    platform_exclude: frdm_kw41z
    min_flash: 128
    min_ram: 144
    extra_args: CONF_FILE=prj_base.conf
    extra_configs:
      - CONFIG_CMSIS_DSP_TEST_MATRIX_BINARY_Q15=y
  libraries.cmsis_dsp.matrix.binary_q15.fpu:
    filter: ((CONFIG_CPU_AARCH32_CORTEX_R or CONFIG_CPU_CORTEX_M) and CONFIG_CPU_HAS_FPU
      and CONFIG_FULL_LIBC_SUPPORTED) or CONFIG_ARCH_POSIX
    integration_platforms:
      - mps2/an521/cpu1
      - mps3/corstone300/an547
    tags:
      - cmsis-dsp
      - fpu
    platform_exclude: frdm_kw41z
    min_flash: 128
    min_ram: 144
    extra_args: CONF_FILE=prj_base.conf
    extra_configs:
      - CONFIG_CMSIS_DSP_TEST_MATRIX_BINARY_Q15=y
      - CONFIG_FPU=y
  libraries.cmsis_dsp.matrix.binary_q31:
    filter: ((CONFIG_CPU_AARCH32_CORTEX_R or CONFIG_CPU_CORTEX_M) and CONFIG_FULL_LIBC_SUPPORTED
      ) or CONFIG_ARCH_POSIX
    integration_platforms:
      - frdm_k64f
      - sam_e70_xplained/same70q21
      - mps2/an521/cpu0
      - native_sim
    tags: cmsis-dsp
    platform_exclude: frdm_kw41z
    min_flash: 128
    min_ram: 128
    extra_args: CONF_FILE=prj_base.conf
    extra_configs:
      - CONFIG_CMSIS_DSP_TEST_MATRIX_BINARY_Q31=y
  libraries.cmsis_dsp.matrix.binary_q31.fpu:
    filter: ((CONFIG_CPU_AARCH32_CORTEX_R or CONFIG_CPU_CORTEX_M) and CONFIG_CPU_HAS_FPU
      and CONFIG_FULL_LIBC_SUPPORTED) or CONFIG_ARCH_POSIX
    integration_platforms:
      - mps2/an521/cpu1
      - mps3/corstone300/an547
    tags:
      - cmsis-dsp
      - fpu
    platform_exclude: frdm_kw41z
    min_flash: 128
    min_ram: 128
    extra_args: CONF_FILE=prj_base.conf
    extra_configs:
      - CONFIG_CMSIS_DSP_TEST_MATRIX_BINARY_Q31=y
      - CONFIG_FPU=y
  libraries.cmsis_dsp.matrix.binary_f16:
    filter: (CONFIG_CMSIS_DSP_FLOAT16 and (CONFIG_CPU_AARCH32_CORTEX_R or CONFIG_CPU_CORTEX_M)
      and CONFIG_FULL_LIBC_SUPPORTED)
    integration_platforms:
      - frdm_k64f
      - sam_e70_xplained/same70q21
      - mps2/an521/cpu0
    tags: cmsis-dsp
    min_flash: 128
    min_ram: 144
    extra_args: CONF_FILE=prj_base.conf
    extra_configs:
      - CONFIG_CMSIS_DSP_TEST_MATRIX_BINARY_F16=y
  libraries.cmsis_dsp.matrix.binary_f16.fpu:
    filter: (CONFIG_CMSIS_DSP_FLOAT16 and (CONFIG_CPU_AARCH32_CORTEX_R or CONFIG_CPU_CORTEX_M)
      and CONFIG_CPU_HAS_FPU and CONFIG_FULL_LIBC_SUPPORTED)
    integration_platforms:
      - mps2/an521/cpu1
      - mps3/corstone300/an547
    tags:
      - cmsis-dsp
      - fpu
    min_flash: 128
    min_ram: 144
    extra_args: CONF_FILE=prj_base.conf
    extra_configs:
      - CONFIG_CMSIS_DSP_TEST_MATRIX_BINARY_F16=y
      - CONFIG_FPU=y
  libraries.cmsis_dsp.matrix.binary_f32:
    filter: ((CONFIG_CPU_AARCH32_CORTEX_R or CONFIG_CPU_CORTEX_M) and CONFIG_FULL_LIBC_SUPPORTED
      ) or CONFIG_ARCH_POSIX
    integration_platforms:
      - frdm_k64f
      - sam_e70_xplained/same70q21
      - mps2/an521/cpu0
      - native_sim
    tags: cmsis-dsp
    platform_exclude: frdm_kw41z
    min_flash: 128
    min_ram: 128
    extra_args: CONF_FILE=prj_base.conf
    extra_configs:
      - CONFIG_CMSIS_DSP_TEST_MATRIX_BINARY_F32=y
  libraries.cmsis_dsp.matrix.binary_f32.fpu:
    filter: ((CONFIG_CPU_AARCH32_CORTEX_R or CONFIG_CPU_CORTEX_M) and CONFIG_CPU_HAS_FPU
      and CONFIG_FULL_LIBC_SUPPORTED) or CONFIG_ARCH_POSIX
    integration_platforms:
      - mps2/an521/cpu1
      - mps3/corstone300/an547
    tags:
      - cmsis-dsp
      - fpu
    platform_exclude: frdm_kw41z
    min_flash: 128
    min_ram: 128
    extra_args: CONF_FILE=prj_base.conf
    extra_configs:
      - CONFIG_CMSIS_DSP_TEST_MATRIX_BINARY_F32=y
      - CONFIG_FPU=y
  libraries.cmsis_dsp.matrix.binary_f64:
    filter: ((CONFIG_CPU_AARCH32_CORTEX_R or CONFIG_CPU_CORTEX_M) and CONFIG_FULL_LIBC_SUPPORTED
      ) or CONFIG_ARCH_POSIX
    integration_platforms:
      - frdm_k64f
      - sam_e70_xplained/same70q21
      - mps2/an521/cpu0
      - native_sim
    tags: cmsis-dsp
    platform_exclude: frdm_kw41z
    min_flash: 128
    min_ram: 128
    extra_args: CONF_FILE=prj_base.conf
    extra_configs:
      - CONFIG_CMSIS_DSP_TEST_MATRIX_BINARY_F64=y
  libraries.cmsis_dsp.matrix.binary_f64.fpu:
    filter: ((CONFIG_CPU_AARCH32_CORTEX_R or CONFIG_CPU_CORTEX_M) and CONFIG_CPU_HAS_FPU
      and CONFIG_FULL_LIBC_SUPPORTED) or CONFIG_ARCH_POSIX
    integration_platforms:
      - mps2/an521/cpu1
      - mps3/corstone300/an547
    tags:
      - cmsis-dsp
      - fpu
    platform_exclude: frdm_kw41z
    min_flash: 128
    min_ram: 128
    extra_args: CONF_FILE=prj_base.conf
    extra_configs:
      - CONFIG_CMSIS_DSP_TEST_MATRIX_BINARY_F64=y
      - CONFIG_FPU=y
```

## tests/lib/cmsis_dsp/statistics/testcase.yaml
```yaml
tests:
  libraries.cmsis_dsp.statistics:
    arch_whitelist: arm
    tags: cmsis_dsp
    min_flash: 128
    min_ram: 64
```

## tests/lib/cmsis_dsp/support/testcase.yaml
```yaml
tests:
  libraries.cmsis_dsp.support:
    arch_whitelist: arm
    tags: cmsis_dsp
    min_flash: 128
    min_ram: 64
```

## tests/lib/cmsis_dsp/svm/testcase.yaml
```yaml
tests:
  libraries.cmsis_dsp.svm:
    filter: ((CONFIG_CPU_CORTEX_R or CONFIG_CPU_CORTEX_M) and TOOLCHAIN_HAS_NEWLIB == 1) or CONFIG_ARCH_POSIX
    integration_platforms:
      - frdm_k64f
      - sam_e70_xplained
      - mps2_an521
      - native_posix
    tags: cmsis_dsp
    min_flash: 128
    min_ram: 64
```

## tests/lib/cmsis_dsp/transform/Kconfig
```kconfig
# Copyright (c) 2021 Stephanos Ioannidis <root@stephanos.io>
# SPDX-License-Identifier: Apache-2.0

config CMSIS_DSP_TEST_TRANSFORM_CQ15
	bool "Test: Transform CQ15"

config CMSIS_DSP_TEST_TRANSFORM_RQ15
	bool "Test: Transform RQ15"

config CMSIS_DSP_TEST_TRANSFORM_CQ31
	bool "Test: Transform CQ31"

config CMSIS_DSP_TEST_TRANSFORM_RQ31
	bool "Test: Transform RQ31"

config CMSIS_DSP_TEST_TRANSFORM_CF16
	bool "Test: Transform CF16"
	depends on CMSIS_DSP_FLOAT16

config CMSIS_DSP_TEST_TRANSFORM_RF16
	bool "Test: Transform RF16"
	depends on CMSIS_DSP_FLOAT16

config CMSIS_DSP_TEST_TRANSFORM_CF32
	bool "Test: Transform CF32"

config CMSIS_DSP_TEST_TRANSFORM_RF32
	bool "Test: Transform RF32"

config CMSIS_DSP_TEST_TRANSFORM_CF64
	bool "Test: Transform CF64"

config CMSIS_DSP_TEST_TRANSFORM_RF64
	bool "Test: Transform RF64"

source "Kconfig"
```
