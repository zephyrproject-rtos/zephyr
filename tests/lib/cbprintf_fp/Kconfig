## tests/lib/cbprintf_fp/Kconfig
```kconfig
# Copyright (c) 2020 Nordic Semiconductor ASA
# SPDX-License-Identifier: Apache-2.0

choice APP_FORMATTER
	prompt "Select print formatter"
	default APP_FORMATTER_PRINTK

config APP_FORMATTER_PRINTK
	bool "Emit with printk"

config APP_FORMATTER_PRINTF
	bool "Emit with printf"

config APP_FORMATTER_PRINTFCB
	bool "Emit with printfcb"

config APP_FORMATTER_FPRINTF
	bool "Emit with fprintf"

config APP_FORMATTER_FPRINTFCB
	bool "Emit with fprintfcb"

endchoice # APP_FORMATTER

source "Kconfig.zephyr"
```

## tests/lib/cbprintf_fp/testcase.yaml
```yaml
common:
  harness: console
  arch_exclude: posix
  tags: cbprintf
  integration_platforms:
    - qemu_x86
    - qemu_x86_64
  filter: CONFIG_CONSOLE_HAS_DRIVER
tests:
  libraries.cbprintf_fp.printk:
    extra_configs:
      - CONFIG_APP_FORMATTER_PRINTK=y
    harness_config:
      type: multi_line
      ordered: true
      regex:
        - "Hello with printk"
        - "Complete"
  libraries.cbprintf_fp.printf:
    extra_configs:
      - CONFIG_APP_FORMATTER_PRINTF=y
    harness_config:
      type: multi_line
      ordered: true
      regex:
        - "Hello with printf"
        - "Complete"
  libraries.cbprintf_fp.printf_nl:
    filter: TOOLCHAIN_HAS_NEWLIB == 1
    extra_configs:
      - CONFIG_APP_FORMATTER_PRINTF=y
      - CONFIG_NEWLIB_LIBC=y
    harness_config:
      type: multi_line
      ordered: true
      regex:
        - "Hello with printf/newlib"
        - "Complete"
  libraries.cbprintf_fp.printfcb:
    extra_configs:
      - CONFIG_APP_FORMATTER_PRINTFCB=y
    harness_config:
      type: multi_line
      ordered: true
      regex:
        - "Hello with printfcb"
        - "Complete"
  libraries.cbprintf_fp.printfcb_nl:
    filter: TOOLCHAIN_HAS_NEWLIB == 1
    extra_configs:
      - CONFIG_APP_FORMATTER_PRINTFCB=y
      - CONFIG_NEWLIB_LIBC=y
    harness_config:
      type: multi_line
      ordered: true
      regex:
        - "Hello with printfcb/newlib"
        - "Complete"
  libraries.cbprintf_fp.fprintf:
    extra_configs:
      - CONFIG_APP_FORMATTER_FPRINTF=y
    harness_config:
      type: multi_line
      ordered: true
      regex:
        - "Hello with fprintf"
        - "Complete"
  libraries.cbprintf_fp.fprintfcb:
    extra_configs:
      - CONFIG_APP_FORMATTER_FPRINTFCB=y
    harness_config:
      type: multi_line
      ordered: true
      regex:
        - "Hello with fprintfcb"
        - "Complete"
  libraries.cbprintf_fp.printf.picolibc:
    filter: CONFIG_PICOLIBC_SUPPORTED
    tags: picolibc
    extra_configs:
      - CONFIG_APP_FORMATTER_PRINTF=y
      - CONFIG_PICOLIBC=y
    harness_config:
      type: multi_line
      ordered: true
      regex:
        - "Hello with printf"
        - "Complete"
  libraries.cbprintf_fp.printfcb.picolibc:
    filter: CONFIG_PICOLIBC_SUPPORTED
    tags: picolibc
    extra_configs:
      - CONFIG_APP_FORMATTER_PRINTFCB=y
      - CONFIG_PICOLIBC=y
    harness_config:
      type: multi_line
      ordered: true
      regex:
        - "Hello with printfcb"
        - "Complete"
```

## tests/lib/cbprintf_package/testcase.yaml
```yaml
common:
  platform_type:
    - qemu
    - native
  tags: cbprintf
  min_flash: 48
tests:
  libraries.cbprintf.package:
    extra_configs:
      - CONFIG_CBPRINTF_COMPLETE=y
    integration_platforms:
      - native_posix

  libraries.cbprintf.package_no_generic:
    extra_configs:
      - CONFIG_CBPRINTF_COMPLETE=y
      - CONFIG_COMPILER_OPT="-DZ_C_GENERIC=0"
    integration_platforms:
      - native_posix

  libraries.cbprintf.package_fp:
    filter: CONFIG_CPU_HAS_FPU
    extra_configs:
      - CONFIG_CBPRINTF_FP_SUPPORT=y
      - CONFIG_CBPRINTF_COMPLETE=y
      - CONFIG_FPU=y
    integration_platforms:
      - native_posix

  libraries.cbprintf.package_fp_align_offset:
    filter: CONFIG_CPU_HAS_FPU
    extra_configs:
      - CONFIG_CBPRINTF_FP_SUPPORT=y
      - CONFIG_CBPRINTF_COMPLETE=y
      - CONFIG_COMPILER_OPT="-DCBPRINTF_PACKAGE_ALIGN_OFFSET=1"
      - CONFIG_FPU=y
    integration_platforms:
      - native_posix

  libraries.cbprintf.package_long_double:
    filter: CONFIG_CPU_HAS_FPU
    extra_configs:
      - CONFIG_CBPRINTF_FP_SUPPORT=y
      - CONFIG_CBPRINTF_COMPLETE=y
      - CONFIG_CBPRINTF_PACKAGE_LONGDOUBLE=y
      - CONFIG_FPU=y
      - CONFIG_MINIMAL_LIBC=y
    integration_platforms:
      - native_posix

  libraries.cbprintf.package_long_double_align_offset:
    filter: CONFIG_CPU_HAS_FPU
    extra_configs:
      - CONFIG_CBPRINTF_FP_SUPPORT=y
      - CONFIG_CBPRINTF_COMPLETE=y
      - CONFIG_CBPRINTF_PACKAGE_LONGDOUBLE=y
      - CONFIG_COMPILER_OPT="-DCBPRINTF_PACKAGE_ALIGN_OFFSET=1"
      - CONFIG_FPU=y
      - CONFIG_MINIMAL_LIBC=y
    integration_platforms:
      - native_posix

  libraries.cbprintf.package_nano:
    extra_configs:
      - CONFIG_CBPRINTF_NANO=y
    integration_platforms:
      - native_posix

  # Same test but with test compiled as C++
  libraries.cbprintf.package_cpp:
    extra_configs:
      - CONFIG_CPP=y
      - CONFIG_CBPRINTF_COMPLETE=y
    integration_platforms:
      - native_posix

  libraries.cbprintf.package_no_generic_cpp:
    extra_configs:
      - CONFIG_CPP=y
      - CONFIG_CBPRINTF_COMPLETE=y
      - CONFIG_COMPILER_OPT="-DZ_C_GENERIC=0"
    integration_platforms:
      - native_posix

  libraries.cbprintf.package_fp_cpp:
    filter: CONFIG_CPU_HAS_FPU
    extra_configs:
      - CONFIG_CPP=y
      - CONFIG_CBPRINTF_FP_SUPPORT=y
      - CONFIG_CBPRINTF_COMPLETE=y
      - CONFIG_FPU=y
    integration_platforms:
      - native_posix

  libraries.cbprintf.package_fp_align_offset_cpp:
    filter: CONFIG_CPU_HAS_FPU
    extra_configs:
      - CONFIG_CPP=y
      - CONFIG_CBPRINTF_FP_SUPPORT=y
      - CONFIG_CBPRINTF_COMPLETE=y
      - CONFIG_COMPILER_OPT="-DCBPRINTF_PACKAGE_ALIGN_OFFSET=1"
      - CONFIG_FPU=y
    integration_platforms:
      - native_posix

  libraries.cbprintf.package_long_double_cpp:
    filter: CONFIG_CPU_HAS_FPU
    extra_configs:
      - CONFIG_CPP=y
      - CONFIG_CBPRINTF_FP_SUPPORT=y
      - CONFIG_CBPRINTF_COMPLETE=y
      - CONFIG_CBPRINTF_PACKAGE_LONGDOUBLE=y
      - CONFIG_FPU=y
      - CONFIG_MINIMAL_LIBC=y
    integration_platforms:
      - native_posix

  libraries.cbprintf.package_long_double_align_offset_cpp:
    filter: CONFIG_CPU_HAS_FPU
    extra_configs:
      - CONFIG_CPP=y
      - CONFIG_CBPRINTF_FP_SUPPORT=y
      - CONFIG_CBPRINTF_COMPLETE=y
      - CONFIG_CBPRINTF_PACKAGE_LONGDOUBLE=y
      - CONFIG_COMPILER_OPT="-DCBPRINTF_PACKAGE_ALIGN_OFFSET=1"
      - CONFIG_FPU=y
      - CONFIG_MINIMAL_LIBC=y
    integration_platforms:
      - native_posix

  libraries.cbprintf.package_nano_cpp:
    extra_configs:
      - CONFIG_CPP=y
      - CONFIG_CBPRINTF_NANO=y
    integration_platforms:
      - native_posix

  libraries.cbprintf.package.picolibc:
    filter: CONFIG_PICOLIBC_SUPPORTED
    tags: picolibc
    extra_configs:
      - CONFIG_CBPRINTF_COMPLETE=y
      - CONFIG_PICOLIBC=y
    integration_platforms:
      - qemu_x86

  libraries.cbprintf.package_no_generic.picolibc:
    filter: CONFIG_PICOLIBC_SUPPORTED
    tags: picolibc
    extra_configs:
      - CONFIG_CBPRINTF_COMPLETE=y
      - CONFIG_COMPILER_OPT="-DZ_C_GENERIC=0"
      - CONFIG_PICOLIBC=y
    integration_platforms:
      - qemu_x86

  libraries.cbprintf.package_fp.picolibc:
    filter: CONFIG_CPU_HAS_FPU and CONFIG_PICOLIBC_SUPPORTED
    tags: picolibc
    extra_configs:
      - CONFIG_CBPRINTF_FP_SUPPORT=y
      - CONFIG_CBPRINTF_COMPLETE=y
      - CONFIG_FPU=y
      - CONFIG_PICOLIBC=y
    integration_platforms:
      - qemu_x86

  # Same test but with test compiled as C++
  libraries.cbprintf.package_cpp.picolibc:
    filter: CONFIG_PICOLIBC_SUPPORTED
    tags: picolibc
    extra_configs:
      - CONFIG_CPP=y
      - CONFIG_CBPRINTF_COMPLETE=y
      - CONFIG_PICOLIBC=y
    integration_platforms:
      - qemu_x86

  libraries.cbprintf.package_no_generic_cpp.picolibc:
    filter: CONFIG_PICOLIBC_SUPPORTED
    tags: picolibc
    extra_configs:
      - CONFIG_CPP=y
      - CONFIG_CBPRINTF_COMPLETE=y
      - CONFIG_COMPILER_OPT="-DZ_C_GENERIC=0"
      - CONFIG_PICOLIBC=y
    integration_platforms:
      - qemu_x86

  libraries.cbprintf.package_fp_cpp.picolibc:
    filter: CONFIG_CPU_HAS_FPU and CONFIG_PICOLIBC_SUPPORTED
    tags: picolibc
    extra_configs:
      - CONFIG_CPP=y
      - CONFIG_CBPRINTF_FP_SUPPORT=y
      - CONFIG_CBPRINTF_COMPLETE=y
      - CONFIG_FPU=y
      - CONFIG_PICOLIBC=y
    integration_platforms:
      - qemu_x86
```

## tests/lib/cmsis_dsp/basicmath/testcase.yaml
```yaml
tests:
  libraries.cmsis_dsp.basicmath:
    arch_whitelist: arm
    tags: cmsis_dsp
    min_flash: 128
    min_ram: 64
```

## tests/lib/cmsis_dsp/bayes/testcase.yaml
```yaml
tests:
  libraries.cmsis_dsp.bayes:
    filter: ((CONFIG_CPU_AARCH32_CORTEX_R or CONFIG_CPU_CORTEX_M) and TOOLCHAIN_HAS_NEWLIB == 1) or CONFIG_ARCH_POSIX
    integration_platforms:
      - frdm_k64f
      - sam_e70_xplained
      - mps2_an521
      - native_posix
    tags: cmsis_dsp
    min_flash: 64
    min_ram: 32
  libraries.cmsis_dsp.bayes.fpu:
    filter: ((CONFIG_CPU_AARCH32_CORTEX_R or CONFIG_CPU_CORTEX_M) and CONFIG_CPU_HAS_FPU and TOOLCHAIN_HAS_NEWLIB == 1) or CONFIG_ARCH_POSIX
    integration_platforms:
      - mps2_an521_remote
      - mps3_an547
    tags: cmsis_dsp fpu
    extra_configs:
      - CONFIG_FPU=y
    min_flash: 64
    min_ram: 32
```

## tests/lib/cmsis_dsp/complexmath/testcase.yaml
```yaml
common:
  arch_allow:
    - arm
    - posix
tests:
  libraries.cmsis_dsp.complexmath:
    filter: ((CONFIG_CPU_AARCH32_CORTEX_R or CONFIG_CPU_CORTEX_M) and CONFIG_FULL_LIBC_SUPPORTED
      ) or CONFIG_ARCH_POSIX
    integration_platforms:
      - frdm_k64f
      - sam_e70_xplained/same70q21
      - mps2/an521/cpu0
      - native_sim
    tags: cmsis-dsp
    min_flash: 128
    min_ram: 144
  libraries.cmsis_dsp.complexmath.fpu:
    filter: ((CONFIG_CPU_AARCH32_CORTEX_R or CONFIG_CPU_CORTEX_M) and CONFIG_CPU_HAS_FPU
      and CONFIG_FULL_LIBC_SUPPORTED) or CONFIG_ARCH_POSIX
    integration_platforms:
      - mps2/an521/cpu1
      - mps3/corstone300/an547
    tags:
      - cmsis-dsp
      - fpu
    extra_configs:
      - CONFIG_FPU=y
    min_flash: 128
    min_ram: 144
```

## tests/lib/cmsis_dsp/distance/testcase.yaml
```yaml
tests:
  libraries.cmsis_dsp.distance:
    filter: CONFIG_CPU_CORTEX_R or CONFIG_CPU_CORTEX_M
    integration_platforms:
      - frdm_k64f
      - sam_e70_xplained
      - mps2_an521
    tags: cmsis_dsp
    min_flash: 64
    min_ram: 32
```

## tests/lib/cmsis_dsp/filtering/Kconfig
```kconfig
# Copyright (c) 2021 Stephanos Ioannidis <root@stephanos.io>
# SPDX-License-Identifier: Apache-2.0

config CMSIS_DSP_TEST_FILTERING_BIQUAD
	bool "Test: Filtering BIQUAD"

config CMSIS_DSP_TEST_FILTERING_DECIM
	bool "Test: Filtering DECIM"

config CMSIS_DSP_TEST_FILTERING_FIR
	bool "Test: Filtering FIR"

config CMSIS_DSP_TEST_FILTERING_MISC
	bool "Test: Filtering MISC"

config CMSIS_DSP_TEST_FILTERING_MISC_CONV_PARTIAL
	bool "Test: Filtering MISC - Partial Convolution"

source "Kconfig"
```

## tests/lib/cmsis_dsp/filtering/testcase.yaml
```yaml
common:
  toolchain_exclude: llvm
  arch_allow:
    - arm
    - posix
tests:
  libraries.cmsis_dsp.filtering:
    filter: ((CONFIG_CPU_AARCH32_CORTEX_R or CONFIG_CPU_CORTEX_M) and CONFIG_FULL_LIBC_SUPPORTED
      ) or CONFIG_ARCH_POSIX
    tags: cmsis-dsp
    skip: true
  libraries.cmsis_dsp.filtering.biquad:
    filter: ((CONFIG_CPU_AARCH32_CORTEX_R or CONFIG_CPU_CORTEX_M) and CONFIG_FULL_LIBC_SUPPORTED
      ) or CONFIG_ARCH_POSIX
    integration_platforms:
      - frdm_k64f
      - sam_e70_xplained/same70q21
      - mps2/an521/cpu0
      - native_sim
    tags: cmsis_dsp
    min_flash: 128
    min_ram: 64
    extra_args: CONF_FILE=prj_base.conf
    extra_configs:
      - CONFIG_CMSIS_DSP_TEST_FILTERING_BIQUAD=y
  libraries.cmsis_dsp.filtering.biquad.fpu:
    filter: ((CONFIG_CPU_AARCH32_CORTEX_R or CONFIG_CPU_CORTEX_M) and CONFIG_CPU_HAS_FPU
      and CONFIG_FULL_LIBC_SUPPORTED) or CONFIG_ARCH_POSIX
    integration_platforms:
      - mps2/an521/cpu1
      - mps3/corstone300/an547
    tags:
      - cmsis-dsp
      - fpu
    min_flash: 128
    min_ram: 64
    extra_args: CONF_FILE=prj_base.conf
    extra_configs:
      - CONFIG_CMSIS_DSP_TEST_FILTERING_BIQUAD=y
      - CONFIG_FPU=y
  libraries.cmsis_dsp.filtering.decim:
    filter: ((CONFIG_CPU_AARCH32_CORTEX_R or CONFIG_CPU_CORTEX_M) and CONFIG_FULL_LIBC_SUPPORTED
      ) or CONFIG_ARCH_POSIX
    integration_platforms:
      - frdm_k64f
      - sam_e70_xplained/same70q21
      - mps2/an521/cpu0
      - native_sim
    tags: cmsis-dsp
    min_flash: 128
    min_ram: 64
    extra_args: CONF_FILE=prj_base.conf
    extra_configs:
      - CONFIG_CMSIS_DSP_TEST_FILTERING_DECIM=y
  libraries.cmsis_dsp.filtering.decim.fpu:
    filter: ((CONFIG_CPU_AARCH32_CORTEX_R or CONFIG_CPU_CORTEX_M) and CONFIG_CPU_HAS_FPU
      and CONFIG_FULL_LIBC_SUPPORTED) or CONFIG_ARCH_POSIX
    integration_platforms:
      - mps2/an521/cpu1
      - mps3/corstone300/an547
    tags:
      - cmsis-dsp
      - fpu
    min_flash: 128
    min_ram: 64
    extra_args: CONF_FILE=prj_base.conf
    extra_configs:
      - CONFIG_CMSIS_DSP_TEST_FILTERING_DECIM=y
      - CONFIG_FPU=y
  libraries.cmsis_dsp.filtering.fir:
    filter: ((CONFIG_CPU_AARCH32_CORTEX_R or CONFIG_CPU_CORTEX_M) and CONFIG_FULL_LIBC_SUPPORTED
      ) or CONFIG_ARCH_POSIX
    integration_platforms:
      - frdm_k64f
      - sam_e70_xplained/same70q21
      - mps2/an521/cpu0
      - native_sim
    tags: cmsis-dsp
    min_flash: 128
    min_ram: 64
    extra_args: CONF_FILE=prj_base.conf
    extra_configs:
      - CONFIG_CMSIS_DSP_TEST_FILTERING_FIR=y
  libraries.cmsis_dsp.filtering.fir.fpu:
    filter: ((CONFIG_CPU_AARCH32_CORTEX_R or CONFIG_CPU_CORTEX_M) and CONFIG_CPU_HAS_FPU
      and CONFIG_FULL_LIBC_SUPPORTED) or CONFIG_ARCH_POSIX
    integration_platforms:
      - mps2/an521/cpu1
      - mps3/corstone300/an547
      - mps3/corstone300/an552
    tags:
      - cmsis-dsp
      - fpu
    min_flash: 128
    min_ram: 64
    extra_args: CONF_FILE=prj_base.conf
    extra_configs:
      - CONFIG_CMSIS_DSP_TEST_FILTERING_FIR=y
      - CONFIG_FPU=y
  libraries.cmsis_dsp.filtering.misc:
    filter: ((CONFIG_CPU_AARCH32_CORTEX_R or CONFIG_CPU_CORTEX_M) and CONFIG_FULL_LIBC_SUPPORTED
      ) or CONFIG_ARCH_POSIX
    integration_platforms:
      - frdm_k64f
      - sam_e70_xplained/same70q21
      - mps2/an521/cpu0
      - native_sim
    tags: cmsis-dsp
    min_flash: 256
    min_ram: 64
    extra_args: CONF_FILE=prj_base.conf
    extra_configs:
      - CONFIG_CMSIS_DSP_TEST_FILTERING_MISC=y
  libraries.cmsis_dsp.filtering.misc.fpu:
    filter: ((CONFIG_CPU_AARCH32_CORTEX_R or CONFIG_CPU_CORTEX_M) and CONFIG_CPU_HAS_FPU
      and CONFIG_FULL_LIBC_SUPPORTED) or CONFIG_ARCH_POSIX
    integration_platforms:
      - mps2/an521/cpu1
    platform_exclude:
      - mps3/corstone300/an547
      - mps3/corstone300/an552
    tags:
      - cmsis-dsp
      - fpu
    min_flash: 256
    min_ram: 64
    extra_args: CONF_FILE=prj_base.conf
    extra_configs:
      - CONFIG_CMSIS_DSP_TEST_FILTERING_MISC=y
      - CONFIG_FPU=y
```

## tests/lib/cmsis_dsp/interpolation/testcase.yaml
```yaml
tests:
  libraries.cmsis_dsp.interpolation:
    filter: ((CONFIG_CPU_AARCH32_CORTEX_R or CONFIG_CPU_CORTEX_M) and CONFIG_FULL_LIBC_SUPPORTED
      ) or CONFIG_ARCH_POSIX
    integration_platforms:
      - frdm_k64f
      - sam_e70_xplained
      - mps2_an521
      - native_sim
    tags: cmsis-dsp
    min_flash: 128
    min_ram: 64
  libraries.cmsis_dsp.interpolation.fpu:
    filter: ((CONFIG_CPU_AARCH32_CORTEX_R or CONFIG_CPU_CORTEX_M) and CONFIG_CPU_HAS_FPU
      and CONFIG_FULL_LIBC_SUPPORTED) or CONFIG_ARCH_POSIX
    integration_platforms:
      - mps2_an521_remote
      - mps3_an547
    tags:
      - cmsis-dsp
      - fpu
    extra_configs:
      - CONFIG_FPU=y
    min_flash: 128
    min_ram: 64
```
