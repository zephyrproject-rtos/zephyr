## tests/lib/cmsis_dsp/transform/testcase.yaml
```yaml
tests:
  libraries.cmsis_dsp.transform:
    filter: ((CONFIG_CPU_AARCH32_CORTEX_R or CONFIG_CPU_CORTEX_M) and CONFIG_FULL_LIBC_SUPPORTED
      ) or CONFIG_ARCH_POSIX
    tags: cmsis-dsp
    skip: true
  libraries.cmsis_dsp.transform.cq15:
    filter: ((CONFIG_CPU_AARCH32_CORTEX_R or CONFIG_CPU_CORTEX_M) and CONFIG_FULL_LIBC_SUPPORTED
      ) or CONFIG_ARCH_POSIX
    integration_platforms:
      - frdm_k64f
      - sam_e70_xplained/same70q21
      - mps2/an521/cpu0
      - native_sim
    tags: cmsis-dsp
    min_flash: 512
    min_ram: 64
    extra_args: CONF_FILE=prj_base.conf
    extra_configs:
      - CONFIG_CMSIS_DSP_TEST_TRANSFORM_CQ15=y
  libraries.cmsis_dsp.transform.cq15.fpu:
    filter: ((CONFIG_CPU_AARCH32_CORTEX_R or CONFIG_CPU_CORTEX_M) and CONFIG_CPU_HAS_FPU
      and CONFIG_FULL_LIBC_SUPPORTED) or CONFIG_ARCH_POSIX
    integration_platforms:
      - mps3/corstone300/an547
    tags:
      - cmsis-dsp
      - fpu
    min_flash: 512
    min_ram: 64
    extra_args: CONF_FILE=prj_base.conf
    extra_configs:
      - CONFIG_CMSIS_DSP_TEST_TRANSFORM_CQ15=y
      - CONFIG_FPU=y
  libraries.cmsis_dsp.transform.rq15:
    filter: ((CONFIG_CPU_AARCH32_CORTEX_R or CONFIG_CPU_CORTEX_M) and CONFIG_FULL_LIBC_SUPPORTED
      ) or CONFIG_ARCH_POSIX
    integration_platforms:
      - frdm_k64f
      - sam_e70_xplained/same70q21
      - mps2/an521/cpu0
      - native_sim
    tags: cmsis-dsp
    min_flash: 512
    min_ram: 64
    extra_args: CONF_FILE=prj_base.conf
    extra_configs:
      - CONFIG_CMSIS_DSP_TEST_TRANSFORM_RQ15=y
  libraries.cmsis_dsp.transform.rq15.fpu:
    filter: ((CONFIG_CPU_AARCH32_CORTEX_R or CONFIG_CPU_CORTEX_M) and CONFIG_CPU_HAS_FPU
      and CONFIG_FULL_LIBC_SUPPORTED) or CONFIG_ARCH_POSIX
    integration_platforms:
      - mps3/corstone300/an547
    tags:
      - cmsis-dsp
      - fpu
    min_flash: 512
    min_ram: 64
    extra_args: CONF_FILE=prj_base.conf
    extra_configs:
      - CONFIG_CMSIS_DSP_TEST_TRANSFORM_RQ15=y
      - CONFIG_FPU=y
  libraries.cmsis_dsp.transform.cq31:
    filter: ((CONFIG_CPU_AARCH32_CORTEX_R or CONFIG_CPU_CORTEX_M) and CONFIG_FULL_LIBC_SUPPORTED
      ) or CONFIG_ARCH_POSIX
    integration_platforms:
      - frdm_k64f
      - sam_e70_xplained/same70q21
      - mps2/an521/cpu0
      - native_sim
    tags: cmsis-dsp
    min_flash: 1024
    min_ram: 64
    extra_args: CONF_FILE=prj_base.conf
    extra_configs:
      - CONFIG_CMSIS_DSP_TEST_TRANSFORM_CQ31=y
  libraries.cmsis_dsp.transform.cq31.fpu:
    filter: ((CONFIG_CPU_AARCH32_CORTEX_R or CONFIG_CPU_CORTEX_M) and CONFIG_CPU_HAS_FPU
      and CONFIG_FULL_LIBC_SUPPORTED) or CONFIG_ARCH_POSIX
    tags:
      - cmsis-dsp
      - fpu
    min_flash: 1024
    min_ram: 64
    extra_args: CONF_FILE=prj_base.conf
    extra_configs:
      - CONFIG_CMSIS_DSP_TEST_TRANSFORM_CQ31=y
      - CONFIG_FPU=y
  libraries.cmsis_dsp.transform.rq31:
    filter: ((CONFIG_CPU_AARCH32_CORTEX_R or CONFIG_CPU_CORTEX_M) and CONFIG_FULL_LIBC_SUPPORTED
      ) or CONFIG_ARCH_POSIX
    integration_platforms:
      - frdm_k64f
      - sam_e70_xplained/same70q21
      - mps2/an521/cpu0
      - native_sim
    tags: cmsis-dsp
    min_flash: 1024
    min_ram: 64
    extra_args: CONF_FILE=prj_base.conf
    extra_configs:
      - CONFIG_CMSIS_DSP_TEST_TRANSFORM_RQ31=y
  libraries.cmsis_dsp.transform.rq31.fpu:
    filter: ((CONFIG_CPU_AARCH32_CORTEX_R or CONFIG_CPU_CORTEX_M) and CONFIG_CPU_HAS_FPU
      and CONFIG_FULL_LIBC_SUPPORTED) or CONFIG_ARCH_POSIX
    tags:
      - cmsis-dsp
      - fpu
    min_flash: 1024
    min_ram: 64
    extra_args: CONF_FILE=prj_base.conf
    extra_configs:
      - CONFIG_CMSIS_DSP_TEST_TRANSFORM_RQ31=y
      - CONFIG_FPU=y
  libraries.cmsis_dsp.transform.cf16:
    filter: (CMSIS_DSP_FLOAT16 and (CONFIG_CPU_AARCH32_CORTEX_R or CONFIG_CPU_CORTEX_M)
      and CONFIG_FULL_LIBC_SUPPORTED)
    integration_platforms:
      - frdm_k64f
      - sam_e70_xplained/same70q21
      - mps2/an521/cpu0
    tags: cmsis-dsp
    min_flash: 512
    min_ram: 64
    extra_args: CONF_FILE=prj_base.conf
    extra_configs:
      - CONFIG_CMSIS_DSP_TEST_TRANSFORM_CF16=y
  libraries.cmsis_dsp.transform.cf16.fpu:
    filter: (CMSIS_DSP_FLOAT16 and (CONFIG_CPU_AARCH32_CORTEX_R or CONFIG_CPU_CORTEX_M)
      and CONFIG_CPU_HAS_FPU and CONFIG_FULL_LIBC_SUPPORTED)
    integration_platforms:
      - mps3/corstone300/an547
    tags:
      - cmsis-dsp
      - fpu
    min_flash: 512
    min_ram: 64
    extra_args: CONF_FILE=prj_base.conf
    extra_configs:
      - CONFIG_CMSIS_DSP_TEST_TRANSFORM_CF16=y
      - CONFIG_FPU=y
  libraries.cmsis_dsp.transform.rf16:
    filter: (CMSIS_DSP_FLOAT16 and (CONFIG_CPU_AARCH32_CORTEX_R or CONFIG_CPU_CORTEX_M)
      and CONFIG_FULL_LIBC_SUPPORTED)
    integration_platforms:
      - frdm_k64f
      - sam_e70_xplained/same70q21
      - mps2/an521/cpu0
    tags: cmsis-dsp
    min_flash: 512
    min_ram: 64
    extra_args: CONF_FILE=prj_base.conf
    extra_configs:
      - CONFIG_CMSIS_DSP_TEST_TRANSFORM_RF16=y
  libraries.cmsis_dsp.transform.rf16.fpu:
    filter: (CMSIS_DSP_FLOAT16 and (CONFIG_CPU_AARCH32_CORTEX_R or CONFIG_CPU_CORTEX_M)
      and CONFIG_CPU_HAS_FPU and CONFIG_FULL_LIBC_SUPPORTED)
    integration_platforms:
      - mps3/corstone300/an547
    tags:
      - cmsis-dsp
      - fpu
    min_flash: 512
    min_ram: 64
    extra_args: CONF_FILE=prj_base.conf
    extra_configs:
      - CONFIG_CMSIS_DSP_TEST_TRANSFORM_RF16=y
      - CONFIG_FPU=y
  libraries.cmsis_dsp.transform.cf32:
    filter: ((CONFIG_CPU_AARCH32_CORTEX_R or CONFIG_CPU_CORTEX_M) and CONFIG_FULL_LIBC_SUPPORTED
      ) or CONFIG_ARCH_POSIX
    integration_platforms:
      - frdm_k64f
      - sam_e70_xplained/same70q21
      - mps2/an521/cpu0
      - native_sim
    tags: cmsis-dsp
    min_flash: 1024
    min_ram: 64
    extra_args: CONF_FILE=prj_base.conf
    extra_configs:
      - CONFIG_CMSIS_DSP_TEST_TRANSFORM_CF32=y
  libraries.cmsis_dsp.transform.cf32.fpu:
    filter: ((CONFIG_CPU_AARCH32_CORTEX_R or CONFIG_CPU_CORTEX_M) and CONFIG_CPU_HAS_FPU
      and CONFIG_FULL_LIBC_SUPPORTED) or CONFIG_ARCH_POSIX
    tags:
      - cmsis-dsp
      - fpu
    min_flash: 1024
    min_ram: 64
    extra_args: CONF_FILE=prj_base.conf
    extra_configs:
      - CONFIG_CMSIS_DSP_TEST_TRANSFORM_CF32=y
      - CONFIG_FPU=y
  libraries.cmsis_dsp.transform.rf32:
    filter: ((CONFIG_CPU_AARCH32_CORTEX_R or CONFIG_CPU_CORTEX_M) and CONFIG_FULL_LIBC_SUPPORTED
      ) or CONFIG_ARCH_POSIX
    integration_platforms:
      - frdm_k64f
      - sam_e70_xplained/same70q21
      - mps2/an521/cpu0
      - native_sim
    tags: cmsis-dsp
    min_flash: 512
    min_ram: 64
    extra_args: CONF_FILE=prj_base.conf
    extra_configs:
      - CONFIG_CMSIS_DSP_TEST_TRANSFORM_RF32=y
  libraries.cmsis_dsp.transform.rf32.fpu:
    filter: ((CONFIG_CPU_AARCH32_CORTEX_R or CONFIG_CPU_CORTEX_M) and CONFIG_CPU_HAS_FPU
      and CONFIG_FULL_LIBC_SUPPORTED) or CONFIG_ARCH_POSIX
    integration_platforms:
      - mps3/corstone300/an547
    tags:
      - cmsis-dsp
      - fpu
    min_flash: 512
    min_ram: 64
    extra_args: CONF_FILE=prj_base.conf
    extra_configs:
      - CONFIG_CMSIS_DSP_TEST_TRANSFORM_RF32=y
      - CONFIG_FPU=y
  libraries.cmsis_dsp.transform.cf64:
    filter: ((CONFIG_CPU_AARCH32_CORTEX_R or CONFIG_CPU_CORTEX_M) and CONFIG_FULL_LIBC_SUPPORTED
      ) or CONFIG_ARCH_POSIX
    integration_platforms:
      - frdm_k64f
      - sam_e70_xplained/same70q21
      - mps2/an521/cpu0
      - native_sim
    tags: cmsis-dsp
    min_flash: 1024
    min_ram: 160
    extra_args: CONF_FILE=prj_base.conf
    extra_configs:
      - CONFIG_CMSIS_DSP_TEST_TRANSFORM_CF64=y
  libraries.cmsis_dsp.transform.cf64.fpu:
    filter: ((CONFIG_CPU_AARCH32_CORTEX_R or CONFIG_CPU_CORTEX_M) and CONFIG_CPU_HAS_FPU
      and CONFIG_FULL_LIBC_SUPPORTED) or CONFIG_ARCH_POSIX
    tags:
      - cmsis-dsp
      - fpu
    min_flash: 1024
    min_ram: 160
    extra_args: CONF_FILE=prj_base.conf
    extra_configs:
      - CONFIG_CMSIS_DSP_TEST_TRANSFORM_CF64=y
      - CONFIG_FPU=y
  libraries.cmsis_dsp.transform.rf64:
    filter: ((CONFIG_CPU_AARCH32_CORTEX_R or CONFIG_CPU_CORTEX_M) and CONFIG_FULL_LIBC_SUPPORTED
      ) or CONFIG_ARCH_POSIX
    integration_platforms:
      - frdm_k64f
      - sam_e70_xplained/same70q21
      - mps2/an521/cpu0
      - native_sim
    tags: cmsis-dsp
    min_flash: 1024
    min_ram: 64
    extra_args: CONF_FILE=prj_base.conf
    extra_configs:
      - CONFIG_CMSIS_DSP_TEST_TRANSFORM_RF64=y
  libraries.cmsis_dsp.transform.rf64.fpu:
    filter: ((CONFIG_CPU_AARCH32_CORTEX_R or CONFIG_CPU_CORTEX_M) and CONFIG_CPU_HAS_FPU
      and CONFIG_FULL_LIBC_SUPPORTED) or CONFIG_ARCH_POSIX
    tags:
      - cmsis-dsp
      - fpu
    min_flash: 1024
    min_ram: 64
    extra_args: CONF_FILE=prj_base.conf
    extra_configs:
      - CONFIG_CMSIS_DSP_TEST_TRANSFORM_RF64=y
      - CONFIG_FPU=y
```

## tests/lib/cmsis_nn/testcase.yaml
```yaml
tests:
  libraries.cmsis_nn:
    filter: CONFIG_CPU_CORTEX_M and CONFIG_FULL_LIBC_SUPPORTED
    integration_platforms:
      - frdm_k64f
      - sam_e70_xplained/same70q21
      - mps2/an521/cpu0
    tags: cmsis_nn
    min_flash: 64
    min_ram: 32
```

## tests/lib/cpp/atomics_c/testcase.yaml
```yaml
# Copyright (c) 2025 Google LLC
# SPDX-License-Identifier: Apache-2.0

tests:
  cpp.atomics_c:
    tags: cpp kernel
    arch_exclude: posix
    build_only: true
    filter: CONFIG_ATOMIC_OPERATIONS_C and not CONFIG_CPU_ARM9
    integration_platforms:
      - rpi_pico
      - robokit1
```

## tests/lib/cpp/cxx/dts/bindings/test-device.yaml
```yaml
# Copyright (c) 2024, Intel Corporation
# SPDX-License-Identifier: Apache-2.0

include: [base.yaml]

description: |
    When this file is missing _or_ the include above is missing, then
    test coverage is _quietly_ reduced! Code that should fail turns
    green. Nasty.

compatible: "fake-cpp-driver"
```

## tests/lib/cpp/cxx/testcase.yaml
```yaml
common:
  tags: cpp
  toolchain_exclude: xcc
  integration_platforms:
    - mps2/an385
    - qemu_cortex_a53

tests:
  cpp.main.minimal:
    extra_configs:
      - CONFIG_MINIMAL_LIBC=y
  cpp.main.newlib:
    filter: TOOLCHAIN_HAS_NEWLIB == 1
    min_ram: 32
    extra_configs:
      - CONFIG_NEWLIB_LIBC=y
  cpp.main.newlib_nano:
    filter: TOOLCHAIN_HAS_NEWLIB == 1 and CONFIG_HAS_NEWLIB_LIBC_NANO
    min_ram: 24
    extra_configs:
      - CONFIG_NEWLIB_LIBC=y
      - CONFIG_NEWLIB_LIBC_NANO=y
  cpp.main.picolibc:
    tags: picolibc
    filter: CONFIG_PICOLIBC_SUPPORTED
    extra_configs:
      - CONFIG_PICOLIBC=y

  # Note: the -std= variants below exclude the host compilers, which
  # aren't part of the SDK and can't be managed as part of the test
  # suite. (e.g. as of commit time the g++ used in CI didn't support
  # C++20/2B and emits a command line error when presented with
  # -Wno-pointer-sign or -Werror=implicit-int in C++ mode with
  # -std=c++98)
  cpp.main.cpp98:
    arch_exclude: posix
    # Exclude ARM cores from nRF54H, nRF92n and RF54L series as Nordic HAL is not
    # compatible with C++98.
    # Exclude CONFIG_HAS_RENESAS_RA_FSP and CONFIG_HAS_RENESAS_RZ_FSP as Renesas HALs are not
    # compatible with C++98.
    filter: not CONFIG_HAS_RENESAS_RA_FSP and not CONFIG_HAS_RENESAS_RZ_FSP and
            not (CONFIG_CPU_CORTEX_M and (CONFIG_NRF_PLATFORM_HALTIUM or CONFIG_SOC_SERIES_NRF54LX))
    build_only: true
    extra_configs:
      - CONFIG_STD_CPP98=y
  # Note: no "cpp.main.cpp11" as that's the default standard tested above
  cpp.main.cpp14:
    arch_exclude: posix
    build_only: true
    extra_configs:
      - CONFIG_STD_CPP14=y
  cpp.main.cpp17:
    arch_exclude: posix
    build_only: true
    extra_configs:
      - CONFIG_STD_CPP17=y
  cpp.main.cpp2A:
    arch_exclude: posix
    build_only: true
    extra_configs:
      - CONFIG_STD_CPP2A=y
  cpp.main.cpp20:
    arch_exclude: posix
    build_only: true
    extra_configs:
      - CONFIG_STD_CPP20=y
  cpp.main.cpp2B:
    arch_exclude: posix
    toolchain_exclude:
      - xt-clang
    build_only: true
    extra_configs:
      - CONFIG_STD_CPP2B=y
```

## tests/lib/cpp/libcxx/testcase.yaml
```yaml
tests:
  cpp.libcxx.glibcxx.newlib:
    filter: TOOLCHAIN_HAS_NEWLIB == 1
    toolchain_exclude: xcc
    min_flash: 54
    min_ram: 24
    tags: cpp
    extra_configs:
      - CONFIG_NEWLIB_LIBC=y
      - CONFIG_GLIBCXX_LIBCPP=y
      - CONFIG_CPP_EXCEPTIONS=y
    integration_platforms:
      - mps2/an385
  cpp.libcxx.glibcxx.newlib_nano:
    filter: TOOLCHAIN_HAS_NEWLIB == 1
    toolchain_exclude: xcc
    min_flash: 54
    tags: cpp
    timeout: 60
    extra_configs:
      - CONFIG_NEWLIB_LIBC=y
      - CONFIG_NEWLIB_LIBC_NANO=y
      - CONFIG_GLIBCXX_LIBCPP=y
    integration_platforms:
      - mps2/an385
  cpp.libcxx.glibcxx.picolibc:
    filter: TOOLCHAIN_HAS_PICOLIBC == 1
    toolchain_exclude: xcc
    tags: cpp
    timeout: 60
    extra_configs:
      - CONFIG_PICOLIBC=y
      - CONFIG_GLIBCXX_LIBCPP=y
      - CONFIG_CPP_EXCEPTIONS=y
    integration_platforms:
      - mps2/an385
  cpp.libcxx.arcmwdtlib:
    toolchain_allow: arcmwdt
    min_flash: 54
    tags: cpp
    extra_configs:
      - CONFIG_ARCMWDT_LIBC=y
      - CONFIG_ARCMWDT_LIBCPP=y
  cpp.libcxx.host:
    arch_allow: posix
    tags: cpp
    extra_configs:
      - CONFIG_EXTERNAL_LIBCPP=y
      - CONFIG_CPP_EXCEPTIONS=y
    integration_platforms:
      - native_sim
      - native_sim/native/64
```

## tests/lib/cpp/std/thread/testcase.yaml
```yaml
common:
  tags: cpp
  filter: CONFIG_FULL_LIBCPP_SUPPORTED
  integration_platforms:
    - qemu_cortex_a53
    - mps2/an385
    - qemu_riscv32
    - qemu_riscv64
    - qemu_x86
    - qemu_x86_64
  # llvm currently excluded due to 'inttypes.h' file not found
  toolchain_exclude:
    - llvm
tests:
  cpp.thread.newlib.except:
    tags: newlib
    filter: CONFIG_NEWLIB_LIBC_SUPPORTED
    extra_configs:
      - CONFIG_NEWLIB_LIBC=y
      - CONFIG_CPP_EXCEPTIONS=y
  cpp.thread.newlib.noexcept:
    tags: newlib
    filter: CONFIG_NEWLIB_LIBC_SUPPORTED
    extra_configs:
      - CONFIG_NEWLIB_LIBC=y
```
