/*
 * Copyright (c) 2022, Carlo Caione <ccaione@baylibre.com>
 */

 / {
	test {
		#address-cells = < 0x1 >;
		#size-cells = < 0x1 >;

		test_sram: sram@20010000 {
			compatible = "zephyr,memory-region", "mmio-sram";
			reg = < 0x20010000 0x1000 >;
			zephyr,memory-region = "SRAM_REGION";
		};
	};
};
