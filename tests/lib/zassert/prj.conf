## CMakeLists.txt
```
# SPDX-License-Identifier: Apache-2.0

cmake_minimum_required(VERSION 3.20.0)
find_package(Zephyr REQUIRED HINTS $ENV{ZEPHYR_BASE})
project(zassert)

FILE(GLOB app_sources src/*.c)
target_sources(app PRIVATE ${app_sources})
```

## Kconfig
```
# Copyright (c) 2026 Måns Ansgariusson <mansgariusson@gmail.com>
# SPDX-License-Identifier: Apache-2.0

menu "Zephyr"
source "Kconfig.zephyr"
endmenu

# Generate CONFIG_ASSERT_MODULE_MYMODULE_LEVEL (Off/On/Verbose choice plus the
# derived level integer) consumed by ZASSERT_MODULE(MYMODULE) in src/main.c.
module = MYMODULE
module-str = the MYMODULE assert module
source "lib/os/zassert/Kconfig.template.assert"
```

## prj.conf
```kconfig
CONFIG_ZTEST=y
CONFIG_ZASSERT=y
```

## src/main.c
```c
/*
 * Copyright (c) 2026 Måns Ansgariusson <mansgariusson@gmail.com>
 *
 * SPDX-License-Identifier: Apache-2.0
 */

#include <zephyr/ztest.h>
#include <zephyr/sys/zassert.h>

#include "harness.h"

ZASSERT_MODULE(MYMODULE);

ZTEST(zassert_mymodule, test_passing_assert_is_noop)
{
	HARNESS_EXPECT(ZASSERT(1 == 1, "must not fire %d", harness_counting_arg()));
	zassert_false(harness_fired(), "passing ZASSERT fired");
	zassert_false(harness_printed(), "passing ZASSERT printed");
	zassert_equal(harness_arg_evals(), 0, "passing ZASSERT evaluated its message args");
}

ZTEST(zassert_mymodule, test_failing_assert_fires)
{
	HARNESS_EXPECT(ZASSERT(1 == 2, "boom"));

	if (CONFIG_ASSERT_MODULE_MYMODULE_LEVEL == ZASSERT_OFF) {
		zassert_false(harness_fired(), "OFF must be compiled out");
		zassert_false(harness_printed(), "OFF must not print");
	} else {
		zassert_true(harness_fired(), "assert did not fire");
		zassert_true(harness_contains("ASSERTION FAIL"), "location not printed");
		if (CONFIG_ASSERT_MODULE_MYMODULE_LEVEL == ZASSERT_VERBOSE) {
			zassert_true(harness_contains("1 == 2"),
				"condition not printed at VERBOSE");
		} else {
			zassert_false(harness_contains("1 == 2"), "condition printed at ON");
		}
	}
}

ZTEST(zassert_mymodule, test_failing_assert_message)
{
	HARNESS_EXPECT(ZASSERT(1 == 2, "boom %d", harness_counting_arg()));

	if (CONFIG_ASSERT_MODULE_MYMODULE_LEVEL == ZASSERT_VERBOSE) {
		zassert_true(harness_contains("boom 1"), "message not printed at VERBOSE");
		zassert_equal(harness_arg_evals(), 1, "message args not evaluated at VERBOSE");
	} else {
		zassert_false(harness_contains("boom"), "message printed below VERBOSE");
		zassert_equal(harness_arg_evals(), 0, "message args evaluated below VERBOSE");
	}
}

ZTEST(zassert_mymodule, test_failing_assert_no_message)
{
	HARNESS_EXPECT(ZASSERT(1 == 2));

	if (CONFIG_ASSERT_MODULE_MYMODULE_LEVEL == ZASSERT_OFF) {
		zassert_false(harness_fired(), "OFF must be compiled out");
		zassert_false(harness_printed(), "OFF must not print");
	} else {
		zassert_true(harness_fired(), "no-message assert did not fire");
		zassert_true(harness_contains("ASSERTION FAIL"), "location not printed");
	}
}

ZTEST_SUITE(zassert_mymodule, NULL, NULL, harness_reset, harness_reset, NULL);
```

## src/default_group.c
```c
/*
 * Copyright (c) 2026 Måns Ansgariusson <mansgariusson@gmail.com>
 *
 * SPDX-License-Identifier: Apache-2.0
 */

#include <zephyr/ztest.h>
#include <zephyr/sys/zassert.h>

#include "harness.h"

ZASSERT_GROUP(DEFAULT);

ZTEST(zassert_default, test_passing_assert_is_noop)
{
	HARNESS_EXPECT(ZASSERT(1 == 1, "must not fire %d", harness_counting_arg()));
	zassert_false(harness_fired(), "passing ZASSERT fired");
	zassert_false(harness_printed(), "passing ZASSERT printed");
	zassert_equal(harness_arg_evals(), 0, "passing ZASSERT evaluated its message args");
}

ZTEST(zassert_default, test_failing_assert_fires)
{
	HARNESS_EXPECT(ZASSERT(1 == 2, "boom"));

	if (CONFIG_DEFAULT_ZASSERT_LEVEL == ZASSERT_OFF) {
		zassert_false(harness_fired(), "OFF must be compiled out");
		zassert_false(harness_printed(), "OFF must not print");
	} else {
		zassert_true(harness_fired(), "assert did not fire");
		zassert_true(harness_contains("ASSERTION FAIL"), "location not printed");
	}
}

ZTEST(zassert_default, test_failing_assert_message)
{
	HARNESS_EXPECT(ZASSERT(1 == 2, "boom %d", harness_counting_arg()));

	if (CONFIG_DEFAULT_ZASSERT_LEVEL == ZASSERT_VERBOSE) {
		zassert_true(harness_contains("boom 1"), "message not printed at VERBOSE");
		zassert_equal(harness_arg_evals(), 1, "message args not evaluated at VERBOSE");
	} else {
		zassert_false(harness_contains("boom"), "message printed below VERBOSE");
		zassert_equal(harness_arg_evals(), 0, "message args evaluated below VERBOSE");
	}
}

ZTEST(zassert_default, test_failing_assert_no_message)
{
	HARNESS_EXPECT(ZASSERT(1 == 2));

	if (CONFIG_DEFAULT_ZASSERT_LEVEL == ZASSERT_OFF) {
		zassert_false(harness_fired(), "OFF must be compiled out");
		zassert_false(harness_printed(), "OFF must not print");
	} else {
		zassert_true(harness_fired(), "no-message assert did not fire");
		zassert_true(harness_contains("ASSERTION FAIL"), "location not printed");
	}
}

ZTEST_SUITE(zassert_default, NULL, NULL, harness_reset, harness_reset, NULL);
```

## src/default_module.c
```c
/*
 * Copyright (c) 2026 Måns Ansgariusson <mansgariusson@gmail.com>
 *
 * SPDX-License-Identifier: Apache-2.0
 */

#include <zephyr/ztest.h>
#include <zephyr/sys/zassert.h>

#include "harness.h"

ZASSERT_MODULE(DEFAULT);

ZTEST(zassert_default, test_passing_assert_is_noop)
{
	HARNESS_EXPECT(ZASSERT(1 == 1, "must not fire %d", harness_counting_arg()));
	zassert_false(harness_fired(), "passing ZASSERT fired");
	zassert_false(harness_printed(), "passing ZASSERT printed");
	zassert_equal(harness_arg_evals(), 0, "passing ZASSERT evaluated its message args");
}

ZTEST(zassert_default, test_failing_assert_fires)
{
	HARNESS_EXPECT(ZASSERT(1 == 2, "boom"));

	if (CONFIG_ASSERT_MODULE_DEFAULT_LEVEL == ZASSERT_OFF) {
		zassert_false(harness_fired(), "OFF must be compiled out");
		zassert_false(harness_printed(), "OFF must not print");
	} else {
		zassert_true(harness_fired(), "assert did not fire");
		zassert_true(harness_contains("ASSERTION FAIL"), "location not printed");
		if (CONFIG_ASSERT_MODULE_DEFAULT_LEVEL == ZASSERT_VERBOSE) {
			zassert_true(harness_contains("1 == 2"),
				"condition not printed at VERBOSE");
		} else {
			zassert_false(harness_contains("1 == 2"), "condition printed at ON");
		}
	}
}

ZTEST(zassert_default, test_failing_assert_message)
{
	HARNESS_EXPECT(ZASSERT(1 == 2, "boom %d", harness_counting_arg()));

	if (CONFIG_ASSERT_MODULE_DEFAULT_LEVEL == ZASSERT_VERBOSE) {
		zassert_true(harness_contains("boom 1"), "message not printed at VERBOSE");
		zassert_equal(harness_arg_evals(), 1, "message args not evaluated at VERBOSE");
	} else {
		zassert_false(harness_contains("boom"), "message printed below VERBOSE");
		zassert_equal(harness_arg_evals(), 0, "message args evaluated below VERBOSE");
	}
}

ZTEST(zassert_default, test_failing_assert_no_message)
{
	HARNESS_EXPECT(ZASSERT(1 == 2));

	if (CONFIG_ASSERT_MODULE_DEFAULT_LEVEL == ZASSERT_OFF) {
		zassert_false(harness_fired(), "OFF must be compiled out");
		zassert_false(harness_printed(), "OFF must not print");
	} else {
		zassert_true(harness_fired(), "no-message assert did not fire");
		zassert_true(harness_contains("ASSERTION FAIL"), "location not printed");
	}
}

ZTEST_SUITE(zassert_default, NULL, NULL, harness_reset, harness_reset, NULL);
```

## src/harness.c
```c
/*
 * Copyright (c) 2026 Måns Ansgariusson <mansgariusson@gmail.com>
 *
 * SPDX-License-Identifier: Apache-2.0
 */

#include <zephyr/sys/zassert.h>
#include <zephyr/sys/printk.h>
#include <stdarg.h>
#include <string.h>

#include "harness.h"

static char captured[256];
static bool fired;
static int arg_evals;

jmp_buf harness_escape;

void harness_reset(void *fixture)
{
	ARG_UNUSED(fixture);
	captured[0] = '\0';
	fired = false;
	arg_evals = 0;
}

int harness_counting_arg(void)
{
	return ++arg_evals;
}

bool harness_fired(void)
{
	return fired;
}

bool harness_printed(void)
{
	return captured[0] != '\0';
}

bool harness_contains(const char *needle)
{
	return strstr(captured, needle) != NULL;
}

int harness_arg_evals(void)
{
	return arg_evals;
}

FUNC_NORETURN void zassert_fail(const char *cond, const char *file,
				unsigned int line, const char *fmt, ...)
{
	size_t len = strlen(captured);

	len += snprintk(captured + len, sizeof(captured) - len,
			"ASSERTION FAIL [%s] @ %s:%d\n", cond, file, line);

	if (fmt != NULL) {
		va_list ap;

		va_start(ap, fmt);
		vsnprintk(captured + len, sizeof(captured) - len, fmt, ap);
		va_end(ap);
	}

	fired = true;
	longjmp(harness_escape, 1);
}
```

## src/inline.c
```c
/*
 * Copyright (c) 2026 Måns Ansgariusson <mansgariusson@gmail.com>
 *
 * SPDX-License-Identifier: Apache-2.0
 */

#include <zephyr/ztest.h>
#include <zephyr/sys/zassert.h>

#include "harness.h"
#include "inline_fn.h"

static void expect_mymodule_level(void (*fn)(void), const char *needle)
{
	HARNESS_EXPECT(fn());

	switch (CONFIG_ASSERT_MODULE_MYMODULE_LEVEL) {
	case ZASSERT_OFF:
		zassert_false(harness_fired(), "OFF must be compiled out");
		zassert_false(harness_printed(), "OFF must not print");
		break;
	case ZASSERT_ON:
		zassert_true(harness_fired(), "ON did not fire");
		zassert_true(harness_contains("ASSERTION FAIL"), "location not printed");
		zassert_false(harness_contains("1 == 2"), "condition printed at ON");
		zassert_false(harness_contains(needle), "message printed below VERBOSE");
		break;
	default:
		zassert_true(harness_fired(), "VERBOSE did not fire");
		zassert_true(harness_contains("1 == 2"), "condition not printed at VERBOSE");
		zassert_true(harness_contains(needle), "message not printed at VERBOSE");
		break;
	}
}

ZTEST(zassert_inline, test_inline_block_module_follows_kconfig)
{
	expect_mymodule_level(inline_block_module_fn, "block module");
}

ZTEST(zassert_inline, test_inline_stateless_module_follows_kconfig)
{
	expect_mymodule_level(inline_stateless_module_fn, "stateless module");
}

ZTEST(zassert_inline, test_inline_forced_off_is_noop)
{
	HARNESS_EXPECT(inline_forced_off_fn());
	zassert_false(harness_fired(), "forced OFF fired");
	zassert_false(harness_printed(), "forced OFF printed");
}

ZTEST(zassert_inline, test_inline_forced_verbose)
{
	HARNESS_EXPECT(inline_forced_verbose_fn());

	if (IS_ENABLED(CONFIG_ASSERT)) {
		zassert_true(harness_fired(), "forced VERBOSE did not fire");
		zassert_true(harness_contains("forced verbose"), "forced VERBOSE message missing");
	} else {
		zassert_false(harness_fired(), "master switch off must silence ZASSERT_L");
		zassert_false(harness_printed(), "master switch off must not print");
	}
}

ZTEST_SUITE(zassert_inline, NULL, NULL, harness_reset, harness_reset, NULL);
```

## src/inline_fn.h
```c
/*
 * Copyright (c) 2026 Måns Ansgariusson <mansgariusson@gmail.com>
 *
 * SPDX-License-Identifier: Apache-2.0
 */

#ifndef _A_INLINE_FN_H_
#define _A_INLINE_FN_H_

#include <zephyr/sys/zassert.h>

static inline void inline_block_module_fn(void)
{
	ZASSERT_MODULE(MYMODULE);
	ZASSERT(1 == 2, "block module");
}

static inline void inline_stateless_module_fn(void)
{
	ZASSERT_M(MYMODULE, 1 == 2, "stateless module");
}

static inline void inline_forced_off_fn(void)
{
	ZASSERT_L(ZASSERT_OFF, 1 == 2, "forced off");
}

static inline void inline_forced_verbose_fn(void)
{
	ZASSERT_L(ZASSERT_VERBOSE, 1 == 2, "forced verbose");
}

#endif /* _A_INLINE_FN_H_ */
```
