## CMakeLists.txt
```
# SPDX-License-Identifier: Apache-2.0

cmake_minimum_required(VERSION 3.28.0)
find_package(Zephyr REQUIRED HINTS $ENV{ZEPHYR_BASE})
project(smf)

target_sources(app PRIVATE src/main.c)

if(CONFIG_SMF_INITIAL_TRANSITION)
  target_sources(app PRIVATE src/test_lib_self_transition_smf.c)
elseif(CONFIG_SMF_ANCESTOR_SUPPORT)
  target_sources(app PRIVATE src/test_lib_hierarchical_smf.c
    src/test_lib_hierarchical_5_ancestor_smf.c)
else()
  target_sources(app PRIVATE src/test_lib_flat_smf.c)
endif()
```

## prj.conf
```kconfig
CONFIG_ZTEST=y
CONFIG_LOG=y
CONFIG_SMF=y
CONFIG_SMF_INSTRUMENTATION=y
CONFIG_SMF_TRANSITION_TABLE=y
```

## src/main.c
```c
/*
 * Copyright 2021 The Chromium OS Authors
 *
 * SPDX-License-Identifier: Apache-2.0
 */

#include <zephyr/kernel.h>
#include <zephyr/ztest.h>

#include <zephyr/smf.h>
#include "test_lib_smf.h"


ZTEST_SUITE(smf_tests, NULL, NULL, NULL, NULL, NULL);
```

## src/test_instrumentation_common.h
```c
/*
 * SPDX-FileCopyrightText: Copyright The Zephyr Project Contributors
 *
 * SPDX-License-Identifier: Apache-2.0
 *
 * Common test instrumentation infrastructure for SMF instrumented tests.
 * Provides action/transition logging hooks used to verify state machine behavior.
 */

#ifndef TEST_INSTRUMENTATION_COMMON_H
#define TEST_INSTRUMENTATION_COMMON_H

#ifndef TEST_MAX_ACTION_RECORDS
#define TEST_MAX_ACTION_RECORDS 64
#endif

#ifndef TEST_MAX_TRANSITION_RECORDS
#define TEST_MAX_TRANSITION_RECORDS 16
#endif

struct action_record {
	const struct smf_state *state;
	enum smf_action_type action;
};

struct transition_record {
	const struct smf_state *source;
	const struct smf_state *dest;
	/* Number of actions logged before the transition */
	int action_count;
};

static struct action_record action_log[TEST_MAX_ACTION_RECORDS];
static int action_log_count;

static struct transition_record transition_log[TEST_MAX_TRANSITION_RECORDS];
static int transition_log_count;

static int error_log_count;

static void reset_logs(void)
{
	action_log_count = 0;
	transition_log_count = 0;
	error_log_count = 0;
}

static void on_action(struct smf_ctx *ctx, const struct smf_state *state,
		      enum smf_action_type action_type)
{
	(void)ctx;
	if (action_log_count < TEST_MAX_ACTION_RECORDS) {
		action_log[action_log_count].state = state;
		action_log[action_log_count].action = action_type;
		action_log_count++;
	}
}

static void on_transition(struct smf_ctx *ctx, const struct smf_state *source,
			  const struct smf_state *dest)
{
	(void)ctx;
	if (transition_log_count < TEST_MAX_TRANSITION_RECORDS) {
		transition_log[transition_log_count].source = source;
		transition_log[transition_log_count].dest = dest;
		transition_log[transition_log_count].action_count = action_log_count;
		transition_log_count++;
	}
}

static void on_error(struct smf_ctx *ctx, int error_code)
{
	(void)ctx;
	(void)error_code;
	error_log_count++;
}

static const struct smf_hooks test_hooks = {
	.on_transition = on_transition,
	.on_action = on_action,
	.on_error = on_error,
};

#endif /* TEST_INSTRUMENTATION_COMMON_H */
```

## src/test_lib_esmf.c
```c
/*
 * Copyright (c) 2026 Demant A/S
 *
 * SPDX-License-Identifier: Apache-2.0
 */

#include <zephyr/esmf.h>
#include <zephyr/ztest.h>

enum test_state {
	STATE_A,
	STATE_B,
	STATE_C,
	STATE_COUNT,
};

enum test_event {
	EVENT_TO_B = 1,
	EVENT_TO_C,
	EVENT_RESET,
	EVENT_INTERNAL,
	EVENT_SELF,
	EVENT_PRIORITY_LOWEST,
	EVENT_PRIORITY_TIE,
};

static const struct smf_state test_states[STATE_COUNT];

struct test_object {
	struct esmf_ctx esmf;
	bool allow_to_c;
	uint32_t action_count;
	uint32_t entry_count[STATE_COUNT];
	uint32_t exit_count[STATE_COUNT];
};

static struct test_object test_obj;

static void state_a_entry(void *obj)
{
	struct test_object *o = obj;

	o->entry_count[STATE_A]++;
}

static void state_a_exit(void *obj)
{
	struct test_object *o = obj;

	o->exit_count[STATE_A]++;
}

static void state_b_entry(void *obj)
{
	struct test_object *o = obj;

	o->entry_count[STATE_B]++;
}

static void state_b_exit(void *obj)
{
	struct test_object *o = obj;

	o->exit_count[STATE_B]++;
}

static void state_c_entry(void *obj)
{
	struct test_object *o = obj;

	o->entry_count[STATE_C]++;
}

static void state_c_exit(void *obj)
{
	struct test_object *o = obj;

	o->exit_count[STATE_C]++;
}

static bool guard_allow_to_c(struct esmf_ctx *ctx, uint32_t trigger)
{
	struct test_object *o = (struct test_object *)ctx;

	ARG_UNUSED(trigger);

	return o->allow_to_c;
}

static void action_increment(struct esmf_ctx *ctx, uint32_t trigger)
{
	struct test_object *o = (struct test_object *)ctx;

	ARG_UNUSED(trigger);

	o->action_count++;
}

/*
 * Test state machine diagram (PlantUML):
 *
 * @startuml
 * [*] --> A
 *
 * A --> B : EVENT_TO_B
 * B --> C : EVENT_TO_C\n[guard_allow_to_c]\naction_increment
 * A --> B : EVENT_PRIORITY_LOWEST\nprio=5
 * A --> C : EVENT_PRIORITY_LOWEST\nprio=1 (selected)
 * A --> B : EVENT_PRIORITY_TIE\nprio=3 (first found, selected)
 * A --> C : EVENT_PRIORITY_TIE\nprio=3
 *
 * A --> A : EVENT_RESET
 * B --> A : EVENT_RESET
 * C --> A : EVENT_RESET
 *
 * A : EVENT_INTERNAL / action_increment
 * B : EVENT_INTERNAL / action_increment
 * C : EVENT_INTERNAL / action_increment
 *
 * B --> B : EVENT_SELF / action_increment
 * @enduml
 */

static const struct esmf_transition transitions[] = {
	ESMF_CREATE_TRANSITION(&test_states[STATE_A], EVENT_TO_B, NULL, NULL,
			       &test_states[STATE_B]),
	ESMF_CREATE_TRANSITION(&test_states[STATE_B], EVENT_TO_C, guard_allow_to_c,
			       action_increment, &test_states[STATE_C]),
	ESMF_CREATE_TRANSITION(NULL, EVENT_RESET, NULL, NULL, &test_states[STATE_A]),
	ESMF_CREATE_TRANSITION(NULL, EVENT_INTERNAL, NULL, action_increment, NULL),
	ESMF_CREATE_TRANSITION(&test_states[STATE_B], EVENT_SELF, NULL, action_increment,
			       &test_states[STATE_B]),
	ESMF_CREATE_TRANSITION_PRIO(&test_states[STATE_A], EVENT_PRIORITY_LOWEST, NULL, NULL,
				    &test_states[STATE_B], 5),
	ESMF_CREATE_TRANSITION_PRIO(&test_states[STATE_A], EVENT_PRIORITY_LOWEST, NULL, NULL,
				    &test_states[STATE_C], 1),
	ESMF_CREATE_TRANSITION_PRIO(&test_states[STATE_A], EVENT_PRIORITY_TIE, NULL, NULL,
				    &test_states[STATE_B], 3),
	ESMF_CREATE_TRANSITION_PRIO(&test_states[STATE_A], EVENT_PRIORITY_TIE, NULL, NULL,
				    &test_states[STATE_C], 3),
};

/* clang-format off */
static const struct smf_state test_states[STATE_COUNT] = {
	[STATE_A] = SMF_CREATE_STATE(state_a_entry, NULL, state_a_exit, NULL, NULL),
	[STATE_B] = SMF_CREATE_STATE(state_b_entry, NULL, state_b_exit, NULL, NULL),
	[STATE_C] = SMF_CREATE_STATE(state_c_entry, NULL, state_c_exit, NULL, NULL),
};
/* clang-format on */

static void *esmf_setup(void)
{
	memset(&test_obj, 0, sizeof(test_obj));
	esmf_init(ESMF_CTX(&test_obj), transitions, ARRAY_SIZE(transitions));

	return NULL;
}

static void esmf_before(void *fixture)
{
	ARG_UNUSED(fixture);

	memset(test_obj.entry_count, 0, sizeof(test_obj.entry_count));
	memset(test_obj.exit_count, 0, sizeof(test_obj.exit_count));
	test_obj.allow_to_c = false;
	test_obj.action_count = 0U;
	smf_set_initial(SMF_CTX(&test_obj), &test_states[STATE_A]);
}

ZTEST(esmf_tests, test_transition_and_state_tracking)
{
	int rc;

	rc = esmf_handle_event(ESMF_CTX(&test_obj), EVENT_TO_B);
	zassert_equal(rc, 0, "transition to B should succeed");
	zassert_equal(smf_get_current_leaf_state(SMF_CTX(&test_obj)), &test_states[STATE_B],
		      "current state should be B");
	zassert_equal(test_obj.exit_count[STATE_A], 1, "A exit must run once");
	zassert_equal(test_obj.entry_count[STATE_B], 1, "B entry must run once");
}

ZTEST(esmf_tests, test_guard_block_and_then_allow)
{
	int rc;

	rc = esmf_handle_event(ESMF_CTX(&test_obj), EVENT_TO_B);
	zassert_equal(rc, 0, "transition to B should succeed");

	test_obj.allow_to_c = false;
	rc = esmf_handle_event(ESMF_CTX(&test_obj), EVENT_TO_C);
	zassert_equal(rc, -EACCES, "guard should block transition");
	zassert_equal(smf_get_current_leaf_state(SMF_CTX(&test_obj)), &test_states[STATE_B],
		      "state should remain B");

	test_obj.allow_to_c = true;
	rc = esmf_handle_event(ESMF_CTX(&test_obj), EVENT_TO_C);
	zassert_equal(rc, 0, "guard should allow transition");
	zassert_equal(test_obj.action_count, 1, "action should run once");
	zassert_equal(smf_get_current_leaf_state(SMF_CTX(&test_obj)), &test_states[STATE_C],
		      "current state should be C");
}

ZTEST(esmf_tests, test_wildcard_and_internal_transition)
{
	int rc;
	const struct smf_state *before;

	rc = esmf_handle_event(ESMF_CTX(&test_obj), EVENT_TO_B);
	zassert_equal(rc, 0, "transition to B should succeed");

	before = smf_get_current_leaf_state(SMF_CTX(&test_obj));
	rc = esmf_handle_event(ESMF_CTX(&test_obj), EVENT_INTERNAL);
	zassert_equal(rc, 0, "internal transition event should be handled");
	zassert_equal(test_obj.action_count, 1, "action should run once");
	zassert_equal(smf_get_current_leaf_state(SMF_CTX(&test_obj)), before,
		      "state should not change for internal transition");

	rc = esmf_handle_event(ESMF_CTX(&test_obj), EVENT_RESET);
	zassert_equal(rc, 0, "wildcard reset should be handled");
	zassert_equal(smf_get_current_leaf_state(SMF_CTX(&test_obj)), &test_states[STATE_A],
		      "reset should return to A");
}

ZTEST(esmf_tests, test_no_match)
{
	int rc;

	rc = esmf_handle_event(ESMF_CTX(&test_obj), 999U);
	zassert_equal(rc, -ENOENT, "unknown event should not match");
}

ZTEST(esmf_tests, test_self_transition)
{
	int rc;

	/* Move to state B first */
	rc = esmf_handle_event(ESMF_CTX(&test_obj), EVENT_TO_B);
	zassert_equal(rc, 0, "transition to B should succeed");

	/* Check exit and entry counts */
	zassert_equal(test_obj.exit_count[STATE_A], 1, "A exit must run once");
	zassert_equal(test_obj.entry_count[STATE_B], 1, "B entry must run once");

	/* Self-transition: smf_set_state is called, so exit and entry re-run */
	rc = esmf_handle_event(ESMF_CTX(&test_obj), EVENT_SELF);
	zassert_equal(rc, 0, "self-transition event should be handled");
	zassert_equal(smf_get_current_leaf_state(SMF_CTX(&test_obj)), &test_states[STATE_B],
		      "state should remain B after self-transition");
	zassert_equal(test_obj.action_count, 1, "action should run once");
	zassert_equal(test_obj.entry_count[STATE_B], 2, "entry must re-run on self-transition");
	zassert_equal(test_obj.exit_count[STATE_B], 1, "exit must re-run on self-transition");
}

ZTEST(esmf_tests, test_priority_lowest_value_wins)
{
	int rc;

	rc = esmf_handle_event(ESMF_CTX(&test_obj), EVENT_PRIORITY_LOWEST);
	zassert_equal(rc, 0, "priority event should be handled");
	zassert_equal(smf_get_current_leaf_state(SMF_CTX(&test_obj)), &test_states[STATE_C],
		      "transition with lower priority value should be selected");
}

ZTEST(esmf_tests, test_priority_tie_keeps_first_found)
{
	int rc;

	rc = esmf_handle_event(ESMF_CTX(&test_obj), EVENT_PRIORITY_TIE);
	zassert_equal(rc, 0, "priority tie event should be handled");
	zassert_equal(smf_get_current_leaf_state(SMF_CTX(&test_obj)), &test_states[STATE_B],
		      "first matching transition should win when priorities are equal");
}

ZTEST_SUITE(esmf_tests, NULL, esmf_setup, esmf_before, NULL, NULL);
```

## src/test_lib_flat_smf.c
```c
/*
 * Copyright 2021 The Chromium OS Authors
 *
 * SPDX-License-Identifier: Apache-2.0
 */

#include <zephyr/ztest.h>
#include <zephyr/smf.h>
#include "test_instrumentation_common.h"

/*
 * Flat Test Transition:
 *
 * A_ENTRY --> A_RUN --> A_EXIT --> B_ENTRY --> B_RUN --|
 *                                                      |
 * |----------------------------------------------------|
 * |
 * |--> B_EXIT --> C_ENTRY --> C_RUN --> C_EXIT --> D_ENTRY
 *
 * This version uses the instrumentation hooks to verify the exact
 * sequence of actions and transitions, replacing the bitmask pattern.
 *
 * Note: smf_set_initial() clears ctx->hooks, so hooks are installed
 * after initialisation.  Initial entry actions are therefore NOT
 * captured in the trace.
 */

#define TEST_OBJECT(o) ((struct test_object *)o)

#define SMF_RUN 3

/* Forward declaration of test_states */
static const struct smf_state test_states[];

/* List of all TypeC-level states */
enum test_state {
	STATE_A,
	STATE_B,
	STATE_C,
	STATE_D
};

enum terminate_action {
	NONE,
	ENTRY,
	RUN,
	EXIT
};

static struct test_object {
	struct smf_ctx ctx;
	enum terminate_action terminate;
} test_obj;

/* State A handlers */
static void state_a_entry(void *obj)
{
	struct test_object *o = TEST_OBJECT(obj);

	if (o->terminate == ENTRY) {
		smf_set_terminate(SMF_CTX(obj), -1);
	}
}

static enum smf_state_result state_a_run(void *obj)
{
	smf_set_state(SMF_CTX(obj), &test_states[STATE_B]);
	return SMF_EVENT_HANDLED;
}

static void state_a_exit(void *obj)
{
	(void)obj;
}

/* State B handlers */
static void state_b_entry(void *obj)
{
	(void)obj;
}

static enum smf_state_result state_b_run(void *obj)
{
	struct test_object *o = TEST_OBJECT(obj);

	if (o->terminate == RUN) {
		smf_set_terminate(SMF_CTX(obj), -1);
		return SMF_EVENT_HANDLED;
	}

	smf_set_state(SMF_CTX(obj), &test_states[STATE_C]);
	return SMF_EVENT_HANDLED;
}

static void state_b_exit(void *obj)
{
	(void)obj;
}

/* State C handlers */
static void state_c_entry(void *obj)
{
	(void)obj;
}

static enum smf_state_result state_c_run(void *obj)
{
	smf_set_state(SMF_CTX(obj), &test_states[STATE_D]);
	return SMF_EVENT_HANDLED;
}

static void state_c_exit(void *obj)
{
	struct test_object *o = TEST_OBJECT(obj);

	if (o->terminate == EXIT) {
		smf_set_terminate(SMF_CTX(obj), -1);
	}
}

/* State D handlers */
static void state_d_entry(void *obj)
{
	(void)obj;
}

static enum smf_state_result state_d_run(void *obj)
{
	(void)obj;
	return SMF_EVENT_HANDLED;
}

static void state_d_exit(void *obj)
{
	(void)obj;
}

/* clang-format off */
static const struct smf_state test_states[] = {
	[STATE_A] = SMF_CREATE_STATE(state_a_entry, state_a_run, state_a_exit, NULL, NULL),
	[STATE_B] = SMF_CREATE_STATE(state_b_entry, state_b_run, state_b_exit, NULL, NULL),
	[STATE_C] = SMF_CREATE_STATE(state_c_entry, state_c_run, state_c_exit, NULL, NULL),
	[STATE_D] = SMF_CREATE_STATE(state_d_entry, state_d_run, state_d_exit, NULL, NULL),
};
/* clang-format on */

/*
 * Helper to run the FSM with hooks installed after smf_set_initial().
 * Because smf_set_initial() clears ctx->hooks, hooks must be set
 * afterwards.  Initial entry actions are therefore NOT captured.
 *
 * Returns the index of the run that returned the terminate value,
 * or SMF_RUN if no run did.
 */
static int run_fsm(enum test_state initial, enum terminate_action term)
{
	reset_logs();
	test_obj.terminate = term;
	smf_set_initial(SMF_CTX(&test_obj), &test_states[initial]);
	smf_set_hooks(SMF_CTX(&test_obj), &test_hooks);

	for (int i = 0; i < SMF_RUN; i++) {
		if (smf_run_state(SMF_CTX(&test_obj))) {
			return i;
		}
	}

	return SMF_RUN;
}

/*
 * Flat test: normal transitions A -> B -> C -> D
 *
 * set_initial(A): A_ENTRY (not captured — hooks installed after init)
 *
 * Run 0: A_RUN -> [A transitions to B] -> A_EXIT, transition(A,B), B_ENTRY
 * Run 1: B_RUN -> [B transitions to C] -> B_EXIT, transition(B,C), C_ENTRY
 * Run 2: C_RUN -> [C transitions to D] -> C_EXIT, transition(C,D), D_ENTRY
 */
ZTEST(smf_tests, test_smf_flat_instrumented_normal)
{
	zassert_equal(run_fsm(STATE_A, NONE), SMF_RUN, "No run should return a terminate value");

	/* Verify action sequence (initial A_ENTRY not captured) */
	zassert_equal(action_log_count, 9, "Expected 9 action hooks");

	/* Run 0: A_RUN, A_EXIT, B_ENTRY */
	zassert_equal(action_log[0].state, &test_states[STATE_A]);
	zassert_equal(action_log[0].action, SMF_ACTION_RUN);

	zassert_equal(action_log[1].state, &test_states[STATE_A]);
	zassert_equal(action_log[1].action, SMF_ACTION_EXIT);

	zassert_equal(action_log[2].state, &test_states[STATE_B]);
	zassert_equal(action_log[2].action, SMF_ACTION_ENTRY);

	/* Run 1: B_RUN, B_EXIT, C_ENTRY */
	zassert_equal(action_log[3].state, &test_states[STATE_B]);
	zassert_equal(action_log[3].action, SMF_ACTION_RUN);

	zassert_equal(action_log[4].state, &test_states[STATE_B]);
	zassert_equal(action_log[4].action, SMF_ACTION_EXIT);

	zassert_equal(action_log[5].state, &test_states[STATE_C]);
	zassert_equal(action_log[5].action, SMF_ACTION_ENTRY);

	/* Run 2: C_RUN, C_EXIT, D_ENTRY */
	zassert_equal(action_log[6].state, &test_states[STATE_C]);
	zassert_equal(action_log[6].action, SMF_ACTION_RUN);

	zassert_equal(action_log[7].state, &test_states[STATE_C]);
	zassert_equal(action_log[7].action, SMF_ACTION_EXIT);

	zassert_equal(action_log[8].state, &test_states[STATE_D]);
	zassert_equal(action_log[8].action, SMF_ACTION_ENTRY);

	/* Verify transition sequence */
	zassert_equal(transition_log_count, 3, "Expected 3 transitions");

	zassert_equal(transition_log[0].source, &test_states[STATE_A]);
	zassert_equal(transition_log[0].dest, &test_states[STATE_B]);

	zassert_equal(transition_log[1].source, &test_states[STATE_B]);
	zassert_equal(transition_log[1].dest, &test_states[STATE_C]);

	zassert_equal(transition_log[2].source, &test_states[STATE_C]);
	zassert_equal(transition_log[2].dest, &test_states[STATE_D]);

	/* Verify no errors */
	zassert_equal(error_log_count, 0);

	/* Verify final state */
	zassert_equal(smf_get_current_leaf_state(SMF_CTX(&test_obj)), &test_states[STATE_D]);
}

/*
 * Flat test: terminate in entry action of State A
 *
 * set_initial(A): state_a_entry terminates (hooks not installed yet).
 * run_state returns immediately due to terminate flag.
 * No actions or transitions are captured.
 */
ZTEST(smf_tests, test_smf_flat_instrumented_entry_terminate)
{
	zassert_equal(run_fsm(STATE_A, ENTRY), 0, "Run 0 should return the terminate value");

	zassert_equal(action_log_count, 0, "No actions captured — terminate during init");

	zassert_equal(transition_log_count, 0, "No transitions should occur");

	zassert_equal(error_log_count, 0);
}

/*
 * Flat test: terminate in run action of State B
 *
 * set_initial(A): A_ENTRY (not captured)
 * Run 0: A_RUN -> [A transitions to B] -> A_EXIT, transition(A,B), B_ENTRY
 * Run 1: B_RUN (terminates), returns the terminate value
 */
ZTEST(smf_tests, test_smf_flat_instrumented_run_terminate)
{
	zassert_equal(run_fsm(STATE_A, RUN), 1, "Run 1 should return the terminate value");

	/* A_RUN, A_EXIT, B_ENTRY, B_RUN = 4 actions (initial A_ENTRY not captured) */
	zassert_equal(action_log_count, 4, "Expected 4 action hooks before termination");

	zassert_equal(action_log[0].state, &test_states[STATE_A]);
	zassert_equal(action_log[0].action, SMF_ACTION_RUN);

	zassert_equal(action_log[1].state, &test_states[STATE_A]);
	zassert_equal(action_log[1].action, SMF_ACTION_EXIT);

	zassert_equal(action_log[2].state, &test_states[STATE_B]);
	zassert_equal(action_log[2].action, SMF_ACTION_ENTRY);

	zassert_equal(action_log[3].state, &test_states[STATE_B]);
	zassert_equal(action_log[3].action, SMF_ACTION_RUN);

	zassert_equal(transition_log_count, 1);
	zassert_equal(transition_log[0].source, &test_states[STATE_A]);
	zassert_equal(transition_log[0].dest, &test_states[STATE_B]);

	zassert_equal(error_log_count, 0);
}

/*
 * Flat test: terminate in exit action of State C
 *
 * set_initial(A): A_ENTRY (not captured)
 * Run 0: A_RUN, A_EXIT, transition(A,B), B_ENTRY
 * Run 1: B_RUN, B_EXIT, transition(B,C), C_ENTRY
 * Run 2: C_RUN, C_EXIT (terminates during exit), returns the terminate value
 */
ZTEST(smf_tests, test_smf_flat_instrumented_exit_terminate)
{
	zassert_equal(run_fsm(STATE_A, EXIT), 2, "Run 2 should return the terminate value");

	zassert_equal(action_log_count, 8, "Expected 8 action hooks before termination");

	zassert_equal(action_log[0].state, &test_states[STATE_A]);
	zassert_equal(action_log[0].action, SMF_ACTION_RUN);

	zassert_equal(action_log[1].state, &test_states[STATE_A]);
	zassert_equal(action_log[1].action, SMF_ACTION_EXIT);

	zassert_equal(action_log[2].state, &test_states[STATE_B]);
	zassert_equal(action_log[2].action, SMF_ACTION_ENTRY);

	zassert_equal(action_log[3].state, &test_states[STATE_B]);
	zassert_equal(action_log[3].action, SMF_ACTION_RUN);

	zassert_equal(action_log[4].state, &test_states[STATE_B]);
	zassert_equal(action_log[4].action, SMF_ACTION_EXIT);

	zassert_equal(action_log[5].state, &test_states[STATE_C]);
	zassert_equal(action_log[5].action, SMF_ACTION_ENTRY);

	zassert_equal(action_log[6].state, &test_states[STATE_C]);
	zassert_equal(action_log[6].action, SMF_ACTION_RUN);

	zassert_equal(action_log[7].state, &test_states[STATE_C]);
	zassert_equal(action_log[7].action, SMF_ACTION_EXIT);

	/* Two transitions completed before the third was aborted by terminate in exit */
	zassert_equal(transition_log_count, 2);
	zassert_equal(transition_log[0].source, &test_states[STATE_A]);
	zassert_equal(transition_log[0].dest, &test_states[STATE_B]);

	zassert_equal(transition_log[1].source, &test_states[STATE_B]);
	zassert_equal(transition_log[1].dest, &test_states[STATE_C]);

	zassert_equal(error_log_count, 0);
}
```

## src/test_lib_hierarchical_5_ancestor_smf.c
```c
/*
 * Copyright 2021 The Chromium OS Authors
 *
 * SPDX-License-Identifier: Apache-2.0
 */

#include <zephyr/ztest.h>
#include <zephyr/smf.h>
#include "test_instrumentation_common.h"

/*
 * Hierarchical 5-ancestor test:
 *
 * Hierarchy: P05 > P04 > P03 > P02 > P01 > {A, B}, C (root), D (root)
 *
 * set_initial(A): P05_ENTRY .. P01_ENTRY, A_ENTRY (not captured — hooks
 * installed after init)
 *
 * Run 0: A_RUN (transitions to B, sibling under P01)
 *         -> A_EXIT, transition(A,B), B_ENTRY
 * Run 1: B_RUN (propagate), P01_RUN..P05_RUN (P05 transitions to C)
 *         -> B_EXIT, P01_EXIT..P05_EXIT, transition(B,C), C_ENTRY
 * Run 2: C_RUN (transitions to D)
 *         -> C_EXIT, transition(C,D), D_ENTRY
 */

#define TEST_OBJECT(o) ((struct test_object *)o)

#define SMF_RUN 3

/* Forward declaration of test_states */
static const struct smf_state test_states[];

enum test_state {
	P05,
	P04,
	P03,
	P02,
	P01,
	A,
	B,
	C,
	D,
};

static struct test_object {
	struct smf_ctx ctx;
} test_obj;

/* Parent handlers — all propagate, P05 transitions to C */
static void p05_entry(void *obj)
{
	(void)obj;
}
static enum smf_state_result p05_run(void *obj)
{
	smf_set_state(SMF_CTX(obj), &test_states[C]);
	return SMF_EVENT_PROPAGATE;
}
static void p05_exit(void *obj)
{
	(void)obj;
}

static void p04_entry(void *obj)
{
	(void)obj;
}
static enum smf_state_result p04_run(void *obj)
{
	(void)obj;
	return SMF_EVENT_PROPAGATE;
}
static void p04_exit(void *obj)
{
	(void)obj;
}

static void p03_entry(void *obj)
{
	(void)obj;
}
static enum smf_state_result p03_run(void *obj)
{
	(void)obj;
	return SMF_EVENT_PROPAGATE;
}
static void p03_exit(void *obj)
{
	(void)obj;
}

static void p02_entry(void *obj)
{
	(void)obj;
}
static enum smf_state_result p02_run(void *obj)
{
	(void)obj;
	return SMF_EVENT_PROPAGATE;
}
static void p02_exit(void *obj)
{
	(void)obj;
}

static void p01_entry(void *obj)
{
	(void)obj;
}
static enum smf_state_result p01_run(void *obj)
{
	(void)obj;
	return SMF_EVENT_PROPAGATE;
}
static void p01_exit(void *obj)
{
	(void)obj;
}

/* Leaf state A — transitions to sibling B */
static void a_entry(void *obj)
{
	(void)obj;
}
static enum smf_state_result a_run(void *obj)
{
	smf_set_state(SMF_CTX(obj), &test_states[B]);
	return SMF_EVENT_PROPAGATE;
}
static void a_exit(void *obj)
{
	(void)obj;
}

/* Leaf state B — propagates (ancestors handle) */
static void b_entry(void *obj)
{
	(void)obj;
}
static enum smf_state_result b_run(void *obj)
{
	(void)obj;
	return SMF_EVENT_PROPAGATE;
}
static void b_exit(void *obj)
{
	(void)obj;
}

/* Root state C — transitions to D */
static void c_entry(void *obj)
{
	(void)obj;
}
static enum smf_state_result c_run(void *obj)
{
	smf_set_state(SMF_CTX(obj), &test_states[D]);
	return SMF_EVENT_PROPAGATE;
}
static void c_exit(void *obj)
{
	(void)obj;
}

/* Root state D — terminal, has entry only */
static void d_entry(void *obj)
{
	(void)obj;
}

/* clang-format off */
static const struct smf_state test_states[] = {
	[P05] = SMF_CREATE_STATE(p05_entry, p05_run, p05_exit, NULL, NULL),
	[P04] = SMF_CREATE_STATE(p04_entry, p04_run, p04_exit, &test_states[P05], NULL),
	[P03] = SMF_CREATE_STATE(p03_entry, p03_run, p03_exit, &test_states[P04], NULL),
	[P02] = SMF_CREATE_STATE(p02_entry, p02_run, p02_exit, &test_states[P03], NULL),
	[P01] = SMF_CREATE_STATE(p01_entry, p01_run, p01_exit, &test_states[P02], NULL),
	[A]   = SMF_CREATE_STATE(a_entry, a_run, a_exit, &test_states[P01], NULL),
	[B]   = SMF_CREATE_STATE(b_entry, b_run, b_exit, &test_states[P01], NULL),
	[C]   = SMF_CREATE_STATE(c_entry, c_run, c_exit, NULL, NULL),
	[D]   = SMF_CREATE_STATE(d_entry, NULL, NULL, NULL, NULL),
};
/* clang-format on */

ZTEST(smf_tests, test_smf_hierarchical_5_ancestors_instrumented)
{
	reset_logs();
	smf_set_initial(SMF_CTX(&test_obj), &test_states[A]);
	smf_set_hooks(SMF_CTX(&test_obj), &test_hooks);

	for (int i = 0; i < SMF_RUN; i++) {
		if (smf_run_state(SMF_CTX(&test_obj)) < 0) {
			break;
		}
	}

	/*
	 * Expected action trace (initial entries not captured):
	 *
	 * Run 0: A_RUN (transitions to B, sibling under P01)
	 *   A_RUN, A_EXIT, B_ENTRY
	 *
	 * Run 1: B_RUN (propagate), then ancestor runs bubble up,
	 *   P05_RUN transitions to C
	 *   B_RUN, P01_RUN, P02_RUN, P03_RUN, P04_RUN, P05_RUN
	 *   then exits: B_EXIT, P01_EXIT, P02_EXIT, P03_EXIT, P04_EXIT, P05_EXIT
	 *   then entry: C_ENTRY
	 *
	 * Run 2: C_RUN (transitions to D)
	 *   C_RUN, C_EXIT, D_ENTRY
	 */
	const struct action_record expected[] = {
		/* Run 0 */
		{&test_states[A], SMF_ACTION_RUN},
		{&test_states[A], SMF_ACTION_EXIT},
		{&test_states[B], SMF_ACTION_ENTRY},
		/* Run 1: leaf + ancestor runs */
		{&test_states[B], SMF_ACTION_RUN},
		{&test_states[P01], SMF_ACTION_RUN},
		{&test_states[P02], SMF_ACTION_RUN},
		{&test_states[P03], SMF_ACTION_RUN},
		{&test_states[P04], SMF_ACTION_RUN},
		{&test_states[P05], SMF_ACTION_RUN},
		/* Run 1: exit chain (current=B, up to NULL) */
		{&test_states[B], SMF_ACTION_EXIT},
		{&test_states[P01], SMF_ACTION_EXIT},
		{&test_states[P02], SMF_ACTION_EXIT},
		{&test_states[P03], SMF_ACTION_EXIT},
		{&test_states[P04], SMF_ACTION_EXIT},
		{&test_states[P05], SMF_ACTION_EXIT},
		/* Run 1: entry into C */
		{&test_states[C], SMF_ACTION_ENTRY},
		/* Run 2 */
		{&test_states[C], SMF_ACTION_RUN},
		{&test_states[C], SMF_ACTION_EXIT},
		{&test_states[D], SMF_ACTION_ENTRY},
	};
	int expected_count = ARRAY_SIZE(expected);

	zassert_equal(action_log_count, expected_count, "Expected %d action hooks", expected_count);

	for (int i = 0; i < expected_count; i++) {
		zassert_equal(action_log[i].state, expected[i].state, "Action %d: wrong state", i);
		zassert_equal(action_log[i].action, expected[i].action,
			      "Action %d: wrong action type", i);
	}

	/* Verify transitions */
	zassert_equal(transition_log_count, 3);

	zassert_equal(transition_log[0].source, &test_states[A]);
	zassert_equal(transition_log[0].dest, &test_states[B]);

	zassert_equal(transition_log[1].source, &test_states[B]);
	zassert_equal(transition_log[1].dest, &test_states[C]);

	zassert_equal(transition_log[2].source, &test_states[C]);
	zassert_equal(transition_log[2].dest, &test_states[D]);

	zassert_equal(smf_get_current_leaf_state(SMF_CTX(&test_obj)), &test_states[D]);

	zassert_equal(error_log_count, 0);
}
```

## src/test_lib_hierarchical_esmf.c
```c
/*
 * Copyright (c) 2026 Demant A/S
 *
 * SPDX-License-Identifier: Apache-2.0
 */

#include <zephyr/esmf.h>
#include <zephyr/ztest.h>

enum hier_state {
	STATE_PARENT,
	STATE_CHILD_A,
	STATE_CHILD_B,
	STATE_ROOT,
	STATE_COUNT,
};

enum hier_event {
	EVENT_TO_CHILD_B = 1,
	EVENT_TO_ROOT,
};

static const struct smf_state hier_states[STATE_COUNT];

struct hier_test_object {
	struct esmf_ctx esmf;
	bool allow_parent_transition;
	uint32_t action_count;
};

static struct hier_test_object hier_test_obj;

static bool guard_parent_to_child_b(struct esmf_ctx *ctx, uint32_t trigger)
{
	struct hier_test_object *obj = (struct hier_test_object *)ctx;

	ARG_UNUSED(trigger);

	return obj->allow_parent_transition;
}

static void action_count_transition(struct esmf_ctx *ctx, uint32_t trigger)
{
	struct hier_test_object *obj = (struct hier_test_object *)ctx;

	ARG_UNUSED(trigger);

	obj->action_count++;
}

/*
 * Test state machine diagram (PlantUML):
 *
 * @startuml
 * state PARENT {
 *   [*] --> CHILD_A
 *   CHILD_A --> CHILD_B : EVENT_TO_CHILD_B\n[allow_parent_transition]\naction_count_transition
 *   CHILD_B --> [*]
 * }
 *
 * PARENT --> ROOT : EVENT_TO_ROOT\naction_count_transition
 * @enduml
 */

static const struct esmf_transition hier_transitions[] = {
	/*
	 * Match from parent while current state is CHILD_A.
	 * This validates ancestor matching in ESMF with SMF ancestor support.
	 */
	ESMF_CREATE_TRANSITION(&hier_states[STATE_PARENT], EVENT_TO_CHILD_B,
			       guard_parent_to_child_b, action_count_transition,
			       &hier_states[STATE_CHILD_B]),
	ESMF_CREATE_TRANSITION(&hier_states[STATE_CHILD_B], EVENT_TO_ROOT, NULL,
			       action_count_transition, &hier_states[STATE_ROOT]),
};

/* clang-format off */
static const struct smf_state hier_states[STATE_COUNT] = {
	[STATE_PARENT]  = SMF_CREATE_STATE(NULL, NULL, NULL, NULL, NULL),
	[STATE_CHILD_A] = SMF_CREATE_STATE(NULL, NULL, NULL, &hier_states[STATE_PARENT], NULL),
	[STATE_CHILD_B] = SMF_CREATE_STATE(NULL, NULL, NULL, &hier_states[STATE_PARENT], NULL),
	[STATE_ROOT]    = SMF_CREATE_STATE(NULL, NULL, NULL, NULL, NULL),
};
/* clang-format on */

static void *esmf_hierarchical_setup(void)
{
	memset(&hier_test_obj, 0, sizeof(hier_test_obj));
	esmf_init(ESMF_CTX(&hier_test_obj), hier_transitions, ARRAY_SIZE(hier_transitions));

	return NULL;
}

static void esmf_hierarchical_before(void *fixture)
{
	ARG_UNUSED(fixture);

	hier_test_obj.allow_parent_transition = true;
	hier_test_obj.action_count = 0U;
	smf_set_initial(SMF_CTX(&hier_test_obj), &hier_states[STATE_CHILD_A]);
}

ZTEST(esmf_hierarchical_tests, test_ancestor_match_and_transition)
{
	int rc;

	rc = esmf_handle_event(ESMF_CTX(&hier_test_obj), EVENT_TO_CHILD_B);
	zassert_equal(rc, 0, "parent-scope transition should match from child state");
	zassert_equal(hier_test_obj.action_count, 1, "transition action should run once");
	zassert_equal(smf_get_current_leaf_state(SMF_CTX(&hier_test_obj)),
		      &hier_states[STATE_CHILD_B], "current state should be CHILD_B");

	rc = esmf_handle_event(ESMF_CTX(&hier_test_obj), EVENT_TO_ROOT);
	zassert_equal(rc, 0, "transition from CHILD_B to ROOT should succeed");
	zassert_equal(hier_test_obj.action_count, 2, "second transition action should run");
	zassert_equal(smf_get_current_leaf_state(SMF_CTX(&hier_test_obj)), &hier_states[STATE_ROOT],
		      "current state should be ROOT");
}

ZTEST(esmf_hierarchical_tests, test_ancestor_guard_reject)
{
	int rc;

	hier_test_obj.allow_parent_transition = false;

	rc = esmf_handle_event(ESMF_CTX(&hier_test_obj), EVENT_TO_CHILD_B);
	zassert_equal(rc, -EACCES, "guard rejection should return -EACCES");
	zassert_equal(hier_test_obj.action_count, 0, "action must not run when guard rejects");
	zassert_equal(smf_get_current_leaf_state(SMF_CTX(&hier_test_obj)),
		      &hier_states[STATE_CHILD_A], "state should remain CHILD_A");
}

ZTEST_SUITE(esmf_hierarchical_tests, NULL, esmf_hierarchical_setup, esmf_hierarchical_before, NULL,
	    NULL);
```

## src/test_lib_hierarchical_smf.c
```c
/*
 * Copyright 2021 The Chromium OS Authors
 *
 * SPDX-License-Identifier: Apache-2.0
 */

#include <zephyr/ztest.h>
#include <zephyr/smf.h>
#include "test_instrumentation_common.h"

/*
 * Hierarchical Test Transition:
 *
 * Hierarchy: PARENT_AB{A, B}, PARENT_C{C}, D (all parents are roots)
 *
 * Normal flow after set_initial(A) (PARENT_AB_ENTRY, A_ENTRY during init,
 * not captured — hooks installed after init):
 *
 * Run 0: A_RUN (propagate) --> PARENT_AB_RUN (transitions to B)
 *         --> A_EXIT, transition(A,B), B_ENTRY
 * Run 1: B_RUN (transitions to C)
 *         --> B_EXIT, PARENT_AB_EXIT, transition(B,C), PARENT_C_ENTRY, C_ENTRY
 * Run 2: C_RUN (transitions to D, returns HANDLED so PARENT_C_RUN not called)
 *         --> C_EXIT, PARENT_C_EXIT, transition(C,D), D_ENTRY
 *
 * This version uses instrumentation hooks to verify action ordering.
 */

#define TEST_OBJECT(o) ((struct test_object *)o)

#define SMF_RUN 3

/* Forward declaration of test_states */
static const struct smf_state test_states[];

enum test_state {
	PARENT_AB,
	PARENT_C,
	STATE_A,
	STATE_B,
	STATE_C,
	STATE_D
};

enum terminate_action {
	NONE,
	PARENT_ENTRY,
	PARENT_RUN,
	PARENT_EXIT,
	ENTRY,
	RUN,
	EXIT
};

static struct test_object {
	struct smf_ctx ctx;
	enum terminate_action terminate;
} test_obj;

/* Parent AB handlers */
static void parent_ab_entry(void *obj)
{
	struct test_object *o = TEST_OBJECT(obj);

	if (o->terminate == PARENT_ENTRY) {
		smf_set_terminate(SMF_CTX(obj), -1);
	}
}

static enum smf_state_result parent_ab_run(void *obj)
{
	struct test_object *o = TEST_OBJECT(obj);

	if (o->terminate == PARENT_RUN) {
		smf_set_terminate(SMF_CTX(obj), -1);
		return SMF_EVENT_PROPAGATE;
	}

	smf_set_state(SMF_CTX(obj), &test_states[STATE_B]);
	return SMF_EVENT_PROPAGATE;
}

static void parent_ab_exit(void *obj)
{
	struct test_object *o = TEST_OBJECT(obj);

	if (o->terminate == PARENT_EXIT) {
		smf_set_terminate(SMF_CTX(obj), -1);
	}
}

/* Parent C handlers */
static void parent_c_entry(void *obj)
{
	(void)obj;
}

static enum smf_state_result parent_c_run(void *obj)
{
	(void)obj;
	/* Should not be reached in the normal flow since C handles event */
	return SMF_EVENT_PROPAGATE;
}

static void parent_c_exit(void *obj)
{
	(void)obj;
}

/* State A handlers */
static void state_a_entry(void *obj)
{
	struct test_object *o = TEST_OBJECT(obj);

	if (o->terminate == ENTRY) {
		smf_set_terminate(SMF_CTX(obj), -1);
	}
}

static enum smf_state_result state_a_run(void *obj)
{
	(void)obj;
	/* Propagate to parent (PARENT_AB_RUN will handle) */
	return SMF_EVENT_PROPAGATE;
}

static void state_a_exit(void *obj)
{
	(void)obj;
}

/* State B handlers */
static void state_b_entry(void *obj)
{
	(void)obj;
}

static enum smf_state_result state_b_run(void *obj)
{
	struct test_object *o = TEST_OBJECT(obj);

	if (o->terminate == RUN) {
		smf_set_terminate(SMF_CTX(obj), -1);
		return SMF_EVENT_PROPAGATE;
	}

	smf_set_state(SMF_CTX(obj), &test_states[STATE_C]);
	return SMF_EVENT_PROPAGATE;
}

static void state_b_exit(void *obj)
{
	(void)obj;
}

/* State C handlers */
static void state_c_entry(void *obj)
{
	(void)obj;
}

static enum smf_state_result state_c_run(void *obj)
{
	smf_set_state(SMF_CTX(obj), &test_states[STATE_D]);
	return SMF_EVENT_HANDLED;
}

static void state_c_exit(void *obj)
{
	struct test_object *o = TEST_OBJECT(obj);

	if (o->terminate == EXIT) {
		smf_set_terminate(SMF_CTX(obj), -1);
	}
}

/* State D handlers */
static void state_d_entry(void *obj)
{
	(void)obj;
}

static enum smf_state_result state_d_run(void *obj)
{
	(void)obj;
	return SMF_EVENT_PROPAGATE;
}

static void state_d_exit(void *obj)
{
	(void)obj;
}

/* clang-format off */
static const struct smf_state test_states[] = {
	[PARENT_AB] = SMF_CREATE_STATE(parent_ab_entry, parent_ab_run, parent_ab_exit,
				       NULL, NULL),
	[PARENT_C]  = SMF_CREATE_STATE(parent_c_entry, parent_c_run, parent_c_exit,
				       NULL, NULL),
	[STATE_A]   = SMF_CREATE_STATE(state_a_entry, state_a_run, state_a_exit,
				       &test_states[PARENT_AB], NULL),
	[STATE_B]   = SMF_CREATE_STATE(state_b_entry, state_b_run, state_b_exit,
				       &test_states[PARENT_AB], NULL),
	[STATE_C]   = SMF_CREATE_STATE(state_c_entry, state_c_run, state_c_exit,
				       &test_states[PARENT_C], NULL),
	[STATE_D]   = SMF_CREATE_STATE(state_d_entry, state_d_run, state_d_exit,
				       NULL, NULL),
};
/* clang-format on */

static void run_fsm(enum test_state initial, enum terminate_action term)
{
	reset_logs();
	test_obj.terminate = term;
	smf_set_initial(SMF_CTX(&test_obj), &test_states[initial]);
	smf_set_hooks(SMF_CTX(&test_obj), &test_hooks);

	for (int i = 0; i < SMF_RUN; i++) {
		if (smf_run_state(SMF_CTX(&test_obj)) < 0) {
			break;
		}
	}
}

/*
 * Normal hierarchical transitions: init(A), A propagates to PARENT_AB which
 * transitions to B, B transitions to C (cross-parent), C transitions to D.
 *
 * Initial PARENT_AB_ENTRY, A_ENTRY not captured (hooks installed after init).
 */
ZTEST(smf_tests, test_smf_hierarchical_instrumented_normal)
{
	run_fsm(STATE_A, NONE);

	/* Expected action sequence (initial entries not captured) */
	const struct action_record expected_actions[] = {
		/* Run 0 */
		{&test_states[STATE_A], SMF_ACTION_RUN},
		{&test_states[PARENT_AB], SMF_ACTION_RUN},
		{&test_states[STATE_A], SMF_ACTION_EXIT},
		{&test_states[STATE_B], SMF_ACTION_ENTRY},
		/* Run 1 */
		{&test_states[STATE_B], SMF_ACTION_RUN},
		{&test_states[STATE_B], SMF_ACTION_EXIT},
		{&test_states[PARENT_AB], SMF_ACTION_EXIT},
		{&test_states[PARENT_C], SMF_ACTION_ENTRY},
		{&test_states[STATE_C], SMF_ACTION_ENTRY},
		/* Run 2 */
		{&test_states[STATE_C], SMF_ACTION_RUN},
		{&test_states[STATE_C], SMF_ACTION_EXIT},
		{&test_states[PARENT_C], SMF_ACTION_EXIT},
		{&test_states[STATE_D], SMF_ACTION_ENTRY},
	};
	int expected_count = ARRAY_SIZE(expected_actions);

	zassert_equal(action_log_count, expected_count, "Expected %d action hooks", expected_count);

	for (int i = 0; i < expected_count; i++) {
		zassert_equal(action_log[i].state, expected_actions[i].state,
			      "Action %d: wrong state", i);
		zassert_equal(action_log[i].action, expected_actions[i].action,
			      "Action %d: wrong action type", i);
	}

	/* Verify transitions */
	zassert_equal(transition_log_count, 3);

	zassert_equal(transition_log[0].source, &test_states[STATE_A]);
	zassert_equal(transition_log[0].dest, &test_states[STATE_B]);

	zassert_equal(transition_log[1].source, &test_states[STATE_B]);
	zassert_equal(transition_log[1].dest, &test_states[STATE_C]);

	zassert_equal(transition_log[2].source, &test_states[STATE_C]);
	zassert_equal(transition_log[2].dest, &test_states[STATE_D]);

	zassert_equal(smf_get_current_leaf_state(SMF_CTX(&test_obj)), &test_states[STATE_D]);

	zassert_equal(error_log_count, 0);
}

/*
 * Terminate in parent entry — terminates during set_initial, hooks not
 * installed yet.  No actions or transitions captured.
 */
ZTEST(smf_tests, test_smf_hierarchical_instrumented_parent_entry_terminate)
{
	run_fsm(STATE_A, PARENT_ENTRY);

	zassert_equal(action_log_count, 0);

	zassert_equal(transition_log_count, 0);

	zassert_equal(error_log_count, 0);
}

/*
 * Terminate in child entry — terminates during set_initial, hooks not
 * installed yet.  No actions or transitions captured.
 */
ZTEST(smf_tests, test_smf_hierarchical_instrumented_child_entry_terminate)
{
	run_fsm(STATE_A, ENTRY);

	zassert_equal(action_log_count, 0);

	zassert_equal(transition_log_count, 0);

	zassert_equal(error_log_count, 0);
}

/*
 * Terminate in parent run: A_RUN propagates, PARENT_AB_RUN terminates
 * (initial entries not captured)
 */
ZTEST(smf_tests, test_smf_hierarchical_instrumented_parent_run_terminate)
{
	run_fsm(STATE_A, PARENT_RUN);

	zassert_equal(action_log_count, 2);
	zassert_equal(action_log[0].state, &test_states[STATE_A]);
	zassert_equal(action_log[0].action, SMF_ACTION_RUN);
	zassert_equal(action_log[1].state, &test_states[PARENT_AB]);
	zassert_equal(action_log[1].action, SMF_ACTION_RUN);

	zassert_equal(transition_log_count, 0);

	zassert_equal(error_log_count, 0);
}

/*
 * Terminate in parent exit (initial entries not captured)
 */
ZTEST(smf_tests, test_smf_hierarchical_instrumented_parent_exit_terminate)
{
	run_fsm(STATE_A, PARENT_EXIT);

	zassert_equal(action_log_count, 7);

	zassert_equal(action_log[0].state, &test_states[STATE_A]);
	zassert_equal(action_log[0].action, SMF_ACTION_RUN);
	zassert_equal(action_log[1].state, &test_states[PARENT_AB]);
	zassert_equal(action_log[1].action, SMF_ACTION_RUN);
	zassert_equal(action_log[2].state, &test_states[STATE_A]);
	zassert_equal(action_log[2].action, SMF_ACTION_EXIT);
	zassert_equal(action_log[3].state, &test_states[STATE_B]);
	zassert_equal(action_log[3].action, SMF_ACTION_ENTRY);
	zassert_equal(action_log[4].state, &test_states[STATE_B]);
	zassert_equal(action_log[4].action, SMF_ACTION_RUN);
	zassert_equal(action_log[5].state, &test_states[STATE_B]);
	zassert_equal(action_log[5].action, SMF_ACTION_EXIT);
	zassert_equal(action_log[6].state, &test_states[PARENT_AB]);
	zassert_equal(action_log[6].action, SMF_ACTION_EXIT);

	/* First transition (A->B) completed, second aborted during exit */
	zassert_equal(transition_log_count, 1);
	zassert_equal(transition_log[0].source, &test_states[STATE_A]);
	zassert_equal(transition_log[0].dest, &test_states[STATE_B]);

	zassert_equal(error_log_count, 0);
}

/*
 * Terminate in child run (B_RUN) (initial entries not captured)
 */
ZTEST(smf_tests, test_smf_hierarchical_instrumented_child_run_terminate)
{
	run_fsm(STATE_A, RUN);

	zassert_equal(action_log_count, 5);

	zassert_equal(action_log[0].state, &test_states[STATE_A]);
	zassert_equal(action_log[0].action, SMF_ACTION_RUN);
	zassert_equal(action_log[1].state, &test_states[PARENT_AB]);
	zassert_equal(action_log[1].action, SMF_ACTION_RUN);
	zassert_equal(action_log[2].state, &test_states[STATE_A]);
	zassert_equal(action_log[2].action, SMF_ACTION_EXIT);
	zassert_equal(action_log[3].state, &test_states[STATE_B]);
	zassert_equal(action_log[3].action, SMF_ACTION_ENTRY);
	zassert_equal(action_log[4].state, &test_states[STATE_B]);
	zassert_equal(action_log[4].action, SMF_ACTION_RUN);

	zassert_equal(transition_log_count, 1);
	zassert_equal(transition_log[0].source, &test_states[STATE_A]);
	zassert_equal(transition_log[0].dest, &test_states[STATE_B]);

	zassert_equal(error_log_count, 0);
}

/*
 * Terminate in child exit (C_EXIT) (initial entries not captured)
 */
ZTEST(smf_tests, test_smf_hierarchical_instrumented_child_exit_terminate)
{
	run_fsm(STATE_A, EXIT);

	zassert_equal(action_log_count, 11);

	/* Run 0 */
	zassert_equal(action_log[0].state, &test_states[STATE_A]);
	zassert_equal(action_log[0].action, SMF_ACTION_RUN);
	zassert_equal(action_log[1].state, &test_states[PARENT_AB]);
	zassert_equal(action_log[1].action, SMF_ACTION_RUN);
	zassert_equal(action_log[2].state, &test_states[STATE_A]);
	zassert_equal(action_log[2].action, SMF_ACTION_EXIT);
	zassert_equal(action_log[3].state, &test_states[STATE_B]);
	zassert_equal(action_log[3].action, SMF_ACTION_ENTRY);

	/* Run 1 */
	zassert_equal(action_log[4].state, &test_states[STATE_B]);
	zassert_equal(action_log[4].action, SMF_ACTION_RUN);
	zassert_equal(action_log[5].state, &test_states[STATE_B]);
	zassert_equal(action_log[5].action, SMF_ACTION_EXIT);
	zassert_equal(action_log[6].state, &test_states[PARENT_AB]);
	zassert_equal(action_log[6].action, SMF_ACTION_EXIT);
	zassert_equal(action_log[7].state, &test_states[PARENT_C]);
	zassert_equal(action_log[7].action, SMF_ACTION_ENTRY);
	zassert_equal(action_log[8].state, &test_states[STATE_C]);
	zassert_equal(action_log[8].action, SMF_ACTION_ENTRY);

	/* Run 2 */
	zassert_equal(action_log[9].state, &test_states[STATE_C]);
	zassert_equal(action_log[9].action, SMF_ACTION_RUN);
	zassert_equal(action_log[10].state, &test_states[STATE_C]);
	zassert_equal(action_log[10].action, SMF_ACTION_EXIT);

	/* Two transitions completed, third aborted */
	zassert_equal(transition_log_count, 2);
	zassert_equal(transition_log[0].source, &test_states[STATE_A]);
	zassert_equal(transition_log[0].dest, &test_states[STATE_B]);
	zassert_equal(transition_log[1].source, &test_states[STATE_B]);
	zassert_equal(transition_log[1].dest, &test_states[STATE_C]);

	zassert_equal(error_log_count, 0);
}
```

## src/test_lib_smf.h
```c
/*
 * Copyright 2021 The Chromium OS Authors
 *
 * SPDX-License-Identifier: Apache-2.0
 */

#ifndef ZEPHYR_TEST_LIB_SMF_H_
#define ZEPHYR_TEST_LIB_SMF_H_

void test_smf_flat(void);
void test_smf_hierarchical(void);
void test_smf_hierarchical_5_ancestors(void);
void test_smf_self_transition(void);

#endif /* ZEPHYR_TEST_LIB_SMF_H_ */
```
