## tests/lib/spsc_pbuf/testcase.yaml
```yaml
tests:
  libraries.spsc_pbuf:
    integration_platforms:
      - native_posix
    # Exclude platform which does not link with cache functions
    platform_exclude: ast1030_evb
    timeout: 120

  libraries.spsc_pbuf.cache:
    integration_platforms:
      - native_posix
    # Exclude platform which does not link with cache functions
    platform_exclude: ast1030_evb
    timeout: 120
    extra_configs:
      - CONFIG_SPSC_PBUF_CACHE_ALWAYS=y

  libraries.spsc_pbuf.nocache.:
    integration_platforms:
      - native_posix
    # Exclude platform which does not link with cache functions
    platform_exclude: ast1030_evb
    timeout: 120
    extra_configs:
      - CONFIG_SPSC_PBUF_CACHE_NEVER=y

  libraries.spsc_pbuf.utilization:
    integration_platforms:
      - native_posix
    # Exclude platform which does not link with cache functions
    platform_exclude: ast1030_evb
    timeout: 120
    extra_configs:
      - CONFIG_SPSC_PBUF_UTILIZATION=y

  libraries.spsc_pbuf.stress:
    platform_allow: qemu_x86
    timeout: 120
    extra_configs:
      - CONFIG_SYS_CLOCK_TICKS_PER_SEC=100000
    integration_platforms:
      - qemu_x86
```

## tests/lib/string_conv/testcase.yaml
```yaml
tests:
  libraries.string_conv:
    tags: string to numeric conversion
    integration_platforms:
      - native_posix
  libraries.string_conv_double:
    tags: string to double numeric conversion
    integration_platforms:
      - native_posix
    filter: CONFIG_CPU_HAS_FPU
    extra_configs:
      - CONFIG_FPU=y
```

## tests/lib/sys_realtime/convert/testcase.yaml
```yaml
# Copyright (c) 2024 Bjarki Arge Andreasen
# SPDX-License-Identifier: Apache-2.0

tests:
  sys_realtime.convert:
    tags: sys_realtime
```

## tests/lib/sys_realtime/realtime/testcase.yaml
```yaml
# Copyright (c) 2024 Bjarki Arge Andreasen
# SPDX-License-Identifier: Apache-2.0

tests:
  sys_realtime.realtime:
    tags: sys_realtime
```

## tests/lib/sys_regmap/testcase.yaml
```yaml
# Copyright (c) 2026 Nordic Semiconductor ASA
# SPDX-License-Identifier: Apache-2.0

tests:
  libraries.sys_regmap:
    integration_platforms:
      - native_sim
      - native_sim/native/64
```

## tests/lib/sys_util/testcase.yaml
```yaml
tests:
  libraries.sys_util:
    tags: sys_util
    integration_platforms:
      - native_posix
```

## tests/lib/sys_util_expr/testcase.yaml
```yaml
tests:
  libraries.sys_util_expr:
    tags: sys_util_expr
    integration_platforms:
      - native_sim
```

## tests/lib/thrift/ThriftTest/testcase.yaml
```yaml
common:
  tags:
    - thrift
    - cpp
    - newlib
  modules:
    - thrift
  filter: TOOLCHAIN_HAS_NEWLIB == 1
  # qemu_x86 exluded due to missing long double functions in SDK
  # See https://github.com/zephyrproject-rtos/sdk-ng/issues/603
  platform_allow:
    - mps2_an385
    - qemu_cortex_a53
    - qemu_riscv32
    - qemu_riscv64
    - qemu_x86_64
tests:
  thrift.ThriftTest.newlib.binaryProtocol: {}
  thrift.ThriftTest.newlib.compactProtocol:
    extra_configs:
      - CONFIG_THRIFT_COMPACT_PROTOCOL=y
  thrift.ThriftTest.newlib.tlsTransport:
    extra_args: OVERLAY_CONFIG="overlay-tls.conf"
```

## tests/lib/time/testcase.yaml
```yaml
tests:
  libraries.libc.time:
    tags: libc
    timeout: 180
    integration_platforms:
      - mps2/an385
```

## tests/lib/time_units/testcase.yaml
```yaml
tests:
  libraries.time_units:
    tags: time_units
    integration_platforms:
      - native_posix
```

## tests/lib/timespec_util/testcase.yaml
```yaml
# FIXME: this should be under tests/unit/timeutil but will not work due to #90029
common:
  filter: not CONFIG_NATIVE_LIBC
  tags:
    - timeutils
  # 1 tier0 platform per supported architecture
  platform_key:
    - arch
    - simulation
  integration_platforms:
    - native_sim/native/64
tests:
  libraries.timespec_utils: {}
  libraries.timespec_utils.speed:
    extra_configs:
      - CONFIG_SPEED_OPTIMIZATIONS=y
  libraries.timespec_utils.armclang_std_libc:
    toolchain_allow: armclang
    extra_configs:
      - CONFIG_ARMCLANG_STD_LIBC=y
  libraries.timespec_utils.arcmwdtlib:
    toolchain_allow: arcmwdt
    extra_configs:
      - CONFIG_ARCMWDT_LIBC=y
  libraries.timespec_utils.minimal:
    extra_configs:
      - CONFIG_MINIMAL_LIBC=y
  libraries.timespec_utils.newlib:
    filter: TOOLCHAIN_HAS_NEWLIB == 1
    extra_configs:
      - CONFIG_NEWLIB_LIBC=y
  libraries.timespec_utils.picolibc:
    tags: picolibc
    filter: CONFIG_PICOLIBC_SUPPORTED
    extra_configs:
      - CONFIG_PICOLIBC=y
```

## tests/lib/topological/testcase.yaml
```yaml
tests:
  libraries.topological:
    platform_allow: native_posix
    tags: topological
```

## tests/lib/uoscore/testcase.yaml
```yaml
tests:
  libraries.uoscore:
    min_flash: 240
    tags: net crypto uoscore
    integration_platforms:
      - qemu_x86
```

## tests/lib/util/getopt/testcase.yaml
```yaml
tests:
  libraries.util.getopt:
    tags: getopt
    integration_platforms:
      - native_posix
    min_flash: 64
    min_ram: 32
    filter: ( CONFIG_GETOPT )
```

## tests/lib/uuid/testcase.yaml
```yaml
common:
  tags: uuid
  integration_platforms:
    - native_sim

tests:
  libraries.uuid.base:
    extra_configs:
      - CONFIG_UUID_V5=y
      - CONFIG_MBEDTLS=y
      - CONFIG_MBEDTLS_PSA_CRYPTO_C=y
      - CONFIG_PSA_WANT_ALG_SHA_1=y
      - CONFIG_UUID_BASE64=y
      - CONFIG_BASE64=y
      # UUID utilities need some heap, but MINIMAL_LIBC has none by default.
      - CONFIG_COMMON_LIBC_MALLOC_ARENA_SIZE=256
  libraries.uuid.v4:
    extra_configs:
      - CONFIG_UUID_V4=y
      - CONFIG_ENTROPY_GENERATOR=y
    filter: CONFIG_ENTROPY_HAS_DRIVER
```

## tests/lib/word_granular_access/Kconfig
```kconfig
# Copyright (c) 2026 Intel Corporation.
# SPDX-License-Identifier: Apache-2.0

mainmenu "Word granular library tests"

source "Kconfig.zephyr"

config TEST_WORD_GRANULAR_ACCESS_SECTION
	string "Section name for the test's buffer in word granular access memory"
	default ".iram.data"
	help
	  The section name to place the test's word granular access memory buffer.
	  This section should be placed in word granular access memory by the
	  linker script.
```

## tests/lib/zassert/testcase.yaml
```yaml
common:
  tags:
    - zassert
    - assert
  integration_platforms:
    - native_sim
  platform_allow:
    - native_sim

tests:
  # Both groups left at their Kconfig default (unset -> OFF).
  os.zassert.all_off:
    extra_configs: []
  # Only MYGROUP raised; DEFAULT stays OFF.
  os.zassert.mygroup_verbose:
    extra_configs:
      - CONFIG_MYGROUP_ZASSERT_LEVEL_VERBOSE=y
  # Only DEFAULT raised; MYGROUP stays OFF.
  os.zassert.default_verbose:
    extra_configs:
      - CONFIG_DEFAULT_ZASSERT_LEVEL_VERBOSE=y
  # Both groups On (checked, no message).
  os.zassert.both_on:
    extra_configs:
      - CONFIG_MYGROUP_ZASSERT_LEVEL_ON=y
      - CONFIG_DEFAULT_ZASSERT_LEVEL_ON=y
  # Different level per group.
  os.zassert.mixed:
    extra_configs:
      - CONFIG_MYGROUP_ZASSERT_LEVEL_ON=y
      - CONFIG_DEFAULT_ZASSERT_LEVEL_VERBOSE=y
  # Master switch off: every group forced OFF regardless of its config.
  os.zassert.disabled:
    extra_configs:
      - CONFIG_ZASSERT=n
```

## tests/lib/zvfs_eventfd/Kconfig
```kconfig
# Copyright (c) 2026 Nordic Semiconductor ASA
# SPDX-License-Identifier: Apache-2.0

# Two dummy subsystem requirements used to exercise the additive
# CONFIG_ZVFS_EVENTFD_ADD_SIZE_* sizing mechanism.

config ZVFS_EVENTFD_ADD_SIZE_TEST_A
	int
	default 2

config ZVFS_EVENTFD_ADD_SIZE_TEST_B
	int
	default 3

source "Kconfig.zephyr"
```

## tests/location/disabled/testcase.yaml
```yaml
tests:
  location.api:
    tags: location_api_only
    platform_allow: native_posix
```

## tests/location/enabled/testcase.yaml
```yaml
tests:
  location.api:
    tags: location_api_subsystem
    platform_allow: native_posix
```

## tests/misc/arm_mpu_regions/testcase.yaml
```yaml
tests:
  misc.arm_mpu_regions:
    platform_allow: mps2_an385
    tags: sample board sram mpu
```

## tests/misc/check_init_priorities/testcase.yaml
```yaml
# SPDX-License-Identifier: Apache-2.0

tests:
  init.check_init_priorities:
    build_only: true
    platform_allow:
      - native_sim
      - native_sim/native/64
    integration_platforms:
      - native_sim
      - native_sim/native/64
```
