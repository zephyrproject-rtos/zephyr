## CMakeLists.txt
```
# SPDX-License-Identifier: Apache-2.0

cmake_minimum_required(VERSION 3.28.0)
find_package(Zephyr REQUIRED HINTS $ENV{ZEPHYR_BASE})
project(libc_common)

FILE(GLOB app_sources src/*.c)
target_sources(app PRIVATE ${app_sources})
```

## prj.conf
```kconfig
CONFIG_ZTEST=y
CONFIG_TEST_USERSPACE=y
CONFIG_ZTEST_FATAL_HOOK=y
CONFIG_MINIMAL_LIBC_NON_REENTRANT_FUNCTIONS=y
CONFIG_MINIMAL_LIBC_RAND=y
CONFIG_POSIX_C_LANG_SUPPORT_R=y
CONFIG_SYS_HEAP_RUNTIME_STATS=y
```

## src/test_fp_classify.c
```c
/*
 * SPDX-FileCopyrightText: Copyright (c) 2026 BayLibre SAS
 *
 * SPDX-License-Identifier: Apache-2.0
 */

#include <float.h>
#include <math.h>
#include <zephyr/ztest.h>

/* Classify v, of class cls and with sign bit sign. volatile keeps the
 * compiler from folding the classification.
 */
#define CHECK(v, cls, sign)                                                                        \
	do {                                                                                       \
		volatile __typeof__(v) x = (v);                                                    \
                                                                                                   \
		zassert_equal(fpclassify(x), (cls), #v);                                           \
		zassert_equal(isfinite(x) != 0, ((cls) != FP_NAN) && ((cls) != FP_INFINITE), #v);  \
		zassert_equal(isinf(x) != 0, (cls) == FP_INFINITE, #v);                            \
		zassert_equal(isnan(x) != 0, (cls) == FP_NAN, #v);                                 \
		zassert_equal(isnormal(x) != 0, (cls) == FP_NORMAL, #v);                           \
		zassert_equal(signbit(x) != 0, (sign), #v);                                        \
	} while (false)

ZTEST(libc_common, test_fp_classify_float)
{
	CHECK(0.0f, FP_ZERO, false);
	CHECK(-0.0f, FP_ZERO, true);
	CHECK(1.5f, FP_NORMAL, false);
	CHECK(-FLT_MIN, FP_NORMAL, true);
	CHECK(FLT_MIN / 2.0f, FP_SUBNORMAL, false);
	CHECK(-FLT_MIN / 2.0f, FP_SUBNORMAL, true);
	CHECK(INFINITY, FP_INFINITE, false);
	CHECK(-INFINITY, FP_INFINITE, true);
	CHECK(NAN, FP_NAN, false);
	CHECK(-NAN, FP_NAN, true);
}

ZTEST(libc_common, test_fp_classify_double)
{
	CHECK(0.0, FP_ZERO, false);
	CHECK(-0.0, FP_ZERO, true);
	CHECK(1.5, FP_NORMAL, false);
	CHECK(-DBL_MIN, FP_NORMAL, true);
	CHECK(DBL_MIN / 2.0, FP_SUBNORMAL, false);
	CHECK(-DBL_MIN / 2.0, FP_SUBNORMAL, true);
	CHECK((double)INFINITY, FP_INFINITE, false);
	CHECK(-(double)INFINITY, FP_INFINITE, true);
	CHECK((double)NAN, FP_NAN, false);
	CHECK(-(double)NAN, FP_NAN, true);
}
```

## src/test_fp_compare.c
```c
/*
 * SPDX-FileCopyrightText: Copyright (c) 2026 BayLibre SAS
 *
 * SPDX-License-Identifier: Apache-2.0
 */

#include <math.h>
#include <zephyr/ztest.h>

/* Compare x and y, where gt, eq, lt and un say whether x > y, x == y,
 * x < y or either is a NaN. volatile keeps the compiler from folding the
 * comparisons.
 */
#define CHECK_CMP(a, b, gt, eq, lt, un)                                                            \
	do {                                                                                       \
		volatile double x = (a);                                                           \
		volatile double y = (b);                                                           \
                                                                                                   \
		zassert_equal(isgreater(x, y) != 0, (gt), #a ", " #b);                             \
		zassert_equal(isgreaterequal(x, y) != 0, (gt) || (eq), #a ", " #b);                \
		zassert_equal(isless(x, y) != 0, (lt), #a ", " #b);                                \
		zassert_equal(islessequal(x, y) != 0, (lt) || (eq), #a ", " #b);                   \
		zassert_equal(islessgreater(x, y) != 0, (lt) || (gt), #a ", " #b);                 \
		zassert_equal(isunordered(x, y) != 0, (un), #a ", " #b);                           \
	} while (false)

ZTEST(libc_common, test_fp_compare)
{
	CHECK_CMP(2.0, 1.0, true, false, false, false);
	CHECK_CMP(1.0, 2.0, false, false, true, false);
	CHECK_CMP(1.0, 1.0, false, true, false, false);
	CHECK_CMP(0.0, -0.0, false, true, false, false);
	CHECK_CMP(-(double)INFINITY, (double)INFINITY, false, false, true, false);
	CHECK_CMP((double)NAN, 1.0, false, false, false, true);
	CHECK_CMP(1.0, (double)NAN, false, false, false, true);
	CHECK_CMP((double)NAN, (double)NAN, false, false, false, true);
}

ZTEST(libc_common, test_fabs_copysign)
{
	volatile double neg_zero = -0.0;
	volatile double neg_inf = -(double)INFINITY;
	volatile double neg_nan = -(double)NAN;
	volatile float neg_zero_f = -0.0f;
	volatile float neg_nan_f = -NAN;

	zassert_equal(fabs(-1.5), 1.5);
	zassert_equal(fabs(neg_inf), (double)INFINITY);
	zassert_false(signbit(fabs(neg_zero)));
	zassert_false(signbit(fabs(neg_nan)));
	zassert_true(fabsf(-1.5f) == 1.5f);
	zassert_false(signbit(fabsf(neg_zero_f)));
	zassert_false(signbit(fabsf(neg_nan_f)));

	zassert_equal(copysign(1.5, -2.0), -1.5);
	zassert_equal(copysign(-1.5, 2.0), 1.5);
	zassert_true(signbit(copysign(0.0, neg_zero)));
	zassert_false(signbit(copysign(neg_zero, 1.0)));
	zassert_true(signbit(copysign((double)NAN, -1.0)));
	zassert_true(isnan(copysign(neg_nan, 1.0)) && !signbit(copysign(neg_nan, 1.0)));
	zassert_equal(copysign((double)INFINITY, -1.0), -(double)INFINITY);
	zassert_true(copysignf(1.5f, -2.0f) == -1.5f);
	zassert_true(signbit(copysignf(0.0f, neg_zero_f)));
	zassert_false(signbit(copysignf(neg_nan_f, 1.0f)));
}
```

## src/test_isfinite.c
```c
/*
 * SPDX-FileCopyrightText: Copyright (c) 2026 Axonne Inc.
 * SPDX-License-Identifier: Apache-2.0
 */

#include <float.h>
#include <math.h>
#include <stdbool.h>

#include <zephyr/sys/util.h>
#include <zephyr/ztest.h>

struct isfinite_test_case {
	long double long_double_value;
	double double_value;
	float float_value;
	bool expected;
};

static const struct isfinite_test_case cases[] = {
	{0.0L, 0.0, 0.0f, true},
	{-0.0L, -0.0, -0.0f, true},
	{1.0L, 1.0, 1.0f, true},
	{-1.0L, -1.0, -1.0f, true},
	{LDBL_MIN, DBL_MIN, FLT_MIN, true},
	{-LDBL_MIN, -DBL_MIN, -FLT_MIN, true},
	{LDBL_MAX, DBL_MAX, FLT_MAX, true},
	{-LDBL_MAX, -DBL_MAX, -FLT_MAX, true},
	{LDBL_MIN / 2.0L, DBL_MIN / 2.0, FLT_MIN / 2.0f, true},
	{-LDBL_MIN / 2.0L, -DBL_MIN / 2.0, -FLT_MIN / 2.0f, true},
	{__builtin_infl(), __builtin_inf(), __builtin_inff(), false},
	{-__builtin_infl(), -__builtin_inf(), -__builtin_inff(), false},
	{__builtin_nanl(""), __builtin_nan(""), __builtin_nanf(""), false},
	{-__builtin_nanl(""), -__builtin_nan(""), -__builtin_nanf(""), false},
};

ZTEST(libc_common, test_isfinite_float)
{
	volatile float value;

	for (size_t i = 0; i < ARRAY_SIZE(cases); i++) {
		value = cases[i].float_value;
		zassert_equal(isfinite(value) != 0, cases[i].expected, "float case %zu", i);
	}

	value = 1.0f;
	zassert_true(isfinite(value++));
	zassert_equal(value, 2.0f, "isfinite must evaluate its argument once");
}

ZTEST(libc_common, test_isfinite_double)
{
	volatile double value;

	for (size_t i = 0; i < ARRAY_SIZE(cases); i++) {
		value = cases[i].double_value;
		zassert_equal(isfinite(value) != 0, cases[i].expected, "double case %zu", i);
	}

	value = 1.0;
	zassert_true(isfinite(value++));
	zassert_equal(value, 2.0, "isfinite must evaluate its argument once");
}

#ifdef TEST_LONG_DOUBLE
ZTEST(libc_common, test_isfinite_long_double)
{
	volatile long double value;

	for (size_t i = 0; i < ARRAY_SIZE(cases); i++) {
		value = cases[i].long_double_value;
		zassert_equal(isfinite(value) != 0, cases[i].expected, "long double case %zu", i);
	}

	value = 1.0L;
	zassert_true(isfinite(value++));
	zassert_equal(value, 2.0L, "isfinite must evaluate its argument once");
}
#endif
```

## src/test_qsort.c
```c
/*
 * Copyright (c) 2021 Friedt Professional Engineering Services, Inc
 *
 * SPDX-License-Identifier: Apache-2.0
 */

#define _GNU_SOURCE
#include <stdbool.h>
#include <stdlib.h>
#include <zephyr/ztest.h>

static int compare_ints(const void *a, const void *b)
{
	int aa = *(const int *)a;
	int bb = *(const int *)b;

	return (aa > bb) - (aa < bb);
}

/**
 *
 * @brief Test qsort function
 *
 */
ZTEST(libc_common, test_qsort)
{
	{
		int actual_int[] = { 1, 3, 2 };
		const int expect_int[] = { 1, 3, 2 };

		qsort(actual_int + 1, 0, sizeof(int), compare_ints);
		zassert_mem_equal(actual_int, expect_int, sizeof(expect_int),
				  "out-of-bounds modifications detected");
	}

	{
		int actual_int[] = { 42 };
		const int expect_int[] = { 42 };

		qsort(actual_int, ARRAY_SIZE(actual_int), sizeof(int), compare_ints);
		zassert_mem_equal(actual_int, expect_int, sizeof(expect_int),
				  "size 1 not sorted");
	}

	{
		int actual_int[] = { 42, -42 };
		const int expect_int[] = { -42, 42 };

		qsort(actual_int, ARRAY_SIZE(actual_int), sizeof(int), compare_ints);
		zassert_mem_equal(actual_int, expect_int, sizeof(expect_int),
				  "size 2 not sorted");
	}

	{
		int actual_int[] = { 42, -42, 0 };
		const int expect_int[] = { -42, 0, 42 };

		qsort(actual_int, ARRAY_SIZE(actual_int), sizeof(int), compare_ints);
		zassert_mem_equal(actual_int, expect_int, sizeof(expect_int),
				  "size 3 not sorted");
	}

	{
		int actual_int[] = { 42, -42, 0, -42 };
		const int expect_int[] = { -42, -42, 0, 42 };

		qsort(actual_int, ARRAY_SIZE(actual_int), sizeof(int), compare_ints);
		zassert_mem_equal(actual_int, expect_int, sizeof(expect_int),
				  "error handling duplicates");
	}

	{
		/*
		 * NUMS="$(for i in `seq 0 63`; do echo -n "$(((RANDOM - 16384) % 100)), "; done)"
		 * slightly modified to ensure that there were 0, -ve and +ve duplicates
		 */
		static int actual_int[] = {
			1,   18,  -78, 35,  -67, -71, -12, -69, -60, 91,  -15, -99, -33,
			-52, 52,  -4,  -89, -7,	 22,  -52, -87, 32,  -23, 30,  -35, -9,
			15,  -61, 36,  -49, 24,	 -72, -63, 77,	88,  -93, 13,  49,  41,
			35,  -5,  -72, -46, 64,	 -46, -97, -88, 90,  63,  49,  12,  -58,
			-76, 54,  75,  49,  11,	 61,  42,  0,	-42, 42,  -42,
		};

		/* echo $(echo "$NUMS" | sed -e 's/,/\n/g' | sort -n | sed -e 's/\(.*\)/\1,\ /g') */
		static const int expect_int[] = {
			-99, -97, -93, -89, -88, -87, -78, -76, -72, -72, -71, -69, -67,
			-63, -61, -60, -58, -52, -52, -49, -46, -46, -42, -42, -35, -33,
			-23, -15, -12, -9,  -7,	 -5,  -4,  0,	1,   11,  12,  13,  15,
			18,  22,  24,  30,  32,	 35,  35,  36,	41,  42,  42,  49,  49,
			49,  52,  54,  61,  63,	 64,  75,  77,	88,  90,  91,
		};

		qsort(actual_int, ARRAY_SIZE(actual_int), sizeof(int), compare_ints);
		zassert_mem_equal(actual_int, expect_int, sizeof(expect_int),
				  "size 64 not sorted");
	}

	{
		/*
		 * NUMS="$(for i in `seq 0 92`; do echo -n "$(((RANDOM - 16384) % 100)), "; done)"
		 * slightly modified to ensure that there were 0, -ve and +ve duplicates
		 */
		static int actual_int[] = {
			1,   18,  -78, 35,  -67, -71, -12, -69, -60, 91,  -15, -99, -33, -52,
			52,  -4,  -89, -7,  22,	 -52, -87, 32,	-23, 30,  -35, -9,  15,	 -61,
			36,  -49, 24,  -72, -63, 77,  88,  -93, 13,  49,  41,  35,  -5,	 -72,
			-46, 64,  -46, -97, 90,	 63,  49,  12,	-58, -76, 54,  75,  49,	 11,
			61,  -45, 92,  7,   74,	 -3,  -9,  96,	83,  33,  15,  -40, -84, -57,
			40,  -93, -27, 38,  24,	 41,  -70, -51, -88, 27,  94,  51,  -11, -2,
			-21, -70, -6,  77,  42,	 0,   -42, 42,	-42,
		};

		/* echo $(echo "$NUMS" | sed -e 's/,/\n/g' | sort -n | sed -e 's/\(.*\)/\1,\ /g') */
		static const int expect_int[] = {
			-99, -97, -93, -93, -89, -88, -87, -84, -78, -76, -72, -72, -71, -70,
			-70, -69, -67, -63, -61, -60, -58, -57, -52, -52, -51, -49, -46, -46,
			-45, -42, -42, -40, -35, -33, -27, -23, -21, -15, -12, -11, -9,	 -9,
			-7,  -6,  -5,  -4,  -3,	 -2,  0,   1,	7,   11,  12,  13,  15,	 15,
			18,  22,  24,  24,  27,	 30,  32,  33,	35,  35,  36,  38,  40,	 41,
			41,  42,  42,  49,  49,	 49,  51,  52,	54,  61,  63,  64,  74,	 75,
			77,  77,  83,  88,  90,	 91,  92,  94,	96,
		};

		qsort(actual_int, ARRAY_SIZE(actual_int), sizeof(int), compare_ints);
		zassert_mem_equal(actual_int, expect_int, sizeof(expect_int),
				  "size 93 not sorted");
	}
}

static int compare_ints_with_boolp_arg(const void *a, const void *b, void *argp)
{
	int aa = *(const int *)a;
	int bb = *(const int *)b;

	*(bool *)argp = true;

	return (aa > bb) - (aa < bb);
}

ZTEST(libc_common, test_qsort_r)
{
	bool arg = false;

	const int expect_int[] = { 1, 5, 7 };
	int actual_int[] = { 1, 7, 5 };

	qsort_r(actual_int, ARRAY_SIZE(actual_int), sizeof(actual_int[0]),
		compare_ints_with_boolp_arg, &arg);

	zassert_mem_equal(actual_int, expect_int, sizeof(expect_int), "array not sorted");
	zassert_true(arg, "arg not modified");
}
```

## src/test_sqrt.c
```c
/*
 * Copyright (c) 2023 Lawrence King
 *
 * SPDX-License-Identifier: Apache-2.0
 *
 */

#include <math.h>
#include <zephyr/kernel.h>
#include <zephyr/ztest.h>

#define local_abs(x) (((x) < 0) ? -(x) : (x))

#ifndef NAN
#define NAN	(__builtin_nansf(""))
#endif

#ifndef INFINITY
#define INFINITY	(__builtin_inff())
#endif

static float test_floats[] = {
	1.0f, 2.0f, 3.0f, 4.0f,
	5.0f, 6.0f, 7.0f, 8.0f, 9.0f,	/* numbers across the decade */
	3.14159265359f, 2.718281828f,	/* irrational numbers pi and e */
	123.4f,	0.025f,	0.10f,	1.875f	/* numbers with infinite */
					/* repeating binary representation */
	};
#define	NUM_TEST_FLOATS	(sizeof(test_floats)/sizeof(float))

static double test_doubles[] = {
	1.0, 2.0, 3.0, 4.0,
	5.0, 6.0, 7.0, 8.0, 9.0,	/* numbers across the decade */
	3.14159265359, 2.718281828,	/* irrational numbers pi and e */
	123.4,	0.025,	0.10,	1.875	/* numbers with infinite */
					/* repeating binary representationa */
};
#define	NUM_TEST_DOUBLES	(sizeof(test_floats)/sizeof(float))

#ifndef	isinf
static int isinf(double x)
{
	union { uint64_t u; double d; } ieee754;
	ieee754.d = x;
	ieee754.u &= ~0x8000000000000000;	/* ignore the sign */
	return ((ieee754.u >> 52) == 0x7FF) &&
		((ieee754.u & 0x000fffffffffffff) == 0);
}
#endif

#ifndef	isnan
static int isnan(double x)
{
	union { uint64_t u; double d; } ieee754;
	ieee754.d = x;
	ieee754.u &= ~0x8000000000000000;	/* ignore the sign */
	return ((ieee754.u >> 52) == 0x7FF) &&
		((ieee754.u & 0x000fffffffffffff) != 0);
}
#endif

#ifndef	isinff
static int isinff(float x)
{
	union { uint32_t u; float f; } ieee754;
	ieee754.f = x;
	ieee754.u &= ~0x80000000;		/* ignore the sign */
	return ((ieee754.u >> 23) == 0xFF) &&
		((ieee754.u & 0x7FFFFF) == 0);
}
#endif

#ifndef	isnanf
static int isnanf(float x)
{
	union { uint32_t u; float f; } ieee754;
	ieee754.f = x;
	ieee754.u &= ~0x80000000;		/* ignore the sign */
	return ((ieee754.u >> 23) == 0xFF) &&
		((ieee754.u & 0x7FFFFF) != 0);
}
#endif

/* small errors are expected, computed as percentage error */
#define MAX_FLOAT_ERROR_PERCENT		(3.5e-5f)
#define MAX_DOUBLE_ERROR_PERCENT	(4.5e-14)

ZTEST(libc_common, test_sqrtf)
{
	int i;
	float exponent, resf, square, root_squared, error;
	uint32_t max_error;
	int32_t ierror;
	int32_t *p_square = (int32_t *)&square;
	int32_t *p_root_squared = (int32_t *)&root_squared;

	max_error = 0;

	/* test the special cases of 0.0, NAN, -NAN, INFINITY, -INFINITY,  and -10.0 */
	zassert_true(sqrtf(0.0f) == 0.0f, "sqrtf(0.0)");
	zassert_true(isnanf(sqrtf(NAN)), "sqrt(nan)");
#ifdef issignallingf
	zassert_true(issignallingf(sqrtf(NAN)), "ssignalingf(sqrtf(nan))");
/*	printf("issignallingf();\n"); */
#endif
	zassert_true(isnanf(sqrtf(-NAN)), "isnanf(sqrtf(-nan))");
	zassert_true(isinff(sqrtf(INFINITY)), "isinff(sqrt(inf))");
	zassert_true(isnanf(sqrtf(-INFINITY)), "isnanf(sqrt(-inf))");
	zassert_true(isnanf(sqrtf(-10.0f)), "isnanf(sqrt(-10.0))");

	for (exponent = 1.0e-10f; exponent < 1.0e10f; exponent *= 10.0f) {
		for (i = 0; i < NUM_TEST_FLOATS; i++) {
			square = test_floats[i] * exponent;
			resf = sqrtf(square);
			root_squared = resf * resf;
			zassert_true((resf > 0.0f) && (resf < INFINITY),
					"sqrtf out of range");
			if ((resf > 0.0f) && (resf < INFINITY)) {
				error = (square - root_squared) /
					square * 100;
				if (error < 0.0f) {
					error = -error;
				}
				/* square and root_squared should be almost identical
				 * except the last few bits, the EXOR will only set
				 * the bits that are different
				 */
				ierror = (*p_square - *p_root_squared);
				ierror = local_abs(ierror);
				if (ierror > max_error) {
					max_error = ierror;
				}
			} else {
				/* negative, +NaN, -NaN, inf or -inf */
				error = 0.0f;
			}
			zassert_true(error < MAX_FLOAT_ERROR_PERCENT,
					"max sqrtf error exceeded");
		}
	}
	zassert_true(max_error < 0x03, "huge errors in sqrt implementation");
	/* print the max error *
 * @verifies ZEP-SRS-18-2
 */
	TC_PRINT("test_sqrtf max error %d counts\n", max_error);
}

ZTEST(libc_common, test_sqrt)
{
	if (sizeof(double) != 8) {
		ztest_test_skip();
	}

	int i;
	double resd, error, square, root_squared, exponent;
	uint64_t max_error;
	int64_t ierror;
	int64_t *p_square = (int64_t *)&square;
	int64_t *p_root_squared = (int64_t *)&root_squared;

	max_error = 0;

	/* test the special cases of 0.0, NAN, -NAN, INFINITY, -INFINITY,  and -10.0 */
	zassert_true(sqrt(0.0) == 0.0, "sqrt(0.0)");
	zassert_true(isnan(sqrt((double)NAN)), "sqrt(nan)");
#ifdef issignalling
	zassert_true(issignalling(sqrt((double)NAN)), "ssignaling(sqrt(nan))");
/*	printf("issignalling();\n"); */
#endif
	zassert_true(isnan(sqrt((double)-NAN)), "isnan(sqrt(-nan))");
	zassert_true(isinf(sqrt((double)INFINITY)), "isinf(sqrt(inf))");
	zassert_true(isnan(sqrt((double)-INFINITY)), "isnan(sqrt(-inf))");
	zassert_true(isnan(sqrt(-10.0)), "isnan(sqrt(-10.0))");

	for (exponent = 1.0e-10; exponent < 1.0e10; exponent *= 10.0) {
		for (i = 0; i < NUM_TEST_DOUBLES; i++) {
			square = test_doubles[i] * exponent;
			resd = sqrt(square);
			root_squared = resd * resd;
			zassert_true((resd > 0.0) && (resd < (double)INFINITY),
					"sqrt out of range");
			if ((resd > 0.0) && (resd < (double)INFINITY)) {
				error = (square - root_squared) /
					square * 100;
				if (error < 0.0) {
					error = -error;
				}
				/* square and root_squared should be almost identical
				 * except the last few bits, the EXOR will only set
				 * the bits that are different
				 */
				ierror = (*p_square - *p_root_squared);
				ierror = local_abs(ierror);
				if (ierror > max_error) {
					max_error = ierror;
				}
			} else {
				/* negative, +NaN, -NaN, inf or -inf */
				error = 0.0;
			}
			zassert_true(error < MAX_DOUBLE_ERROR_PERCENT,
					"max sqrt error exceeded");
		}
	}
	zassert_true(max_error < 0x04, "huge errors in sqrt implementation");
	/* print the max error */
	TC_PRINT("test_sqrt max error %d counts\n", (uint32_t)max_error);
}
```
