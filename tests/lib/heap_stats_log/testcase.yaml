## tests/lib/heap_stats_log/testcase.yaml
```yaml
common:
  tags: heap heap_stats
  timeout: 120
  integration_platforms:
    - native_sim
    - qemu_x86
tests:
  libraries.heap_stats_log:
    filter: CONFIG_SYS_HEAP_STATS_LOGGING

  libraries.heap_stats_log.no_thread_name:
    extra_configs:
      - CONFIG_THREAD_NAME=n
    filter: CONFIG_SYS_HEAP_STATS_LOGGING

  libraries.heap_stats_log.no_caller:
    extra_configs:
      - CONFIG_SYS_HEAP_CALLER_POINTER=n
    filter: CONFIG_SYS_HEAP_STATS_LOGGING

  libraries.heap_stats_log.no_thread_stats:
    extra_configs:
      - CONFIG_SYS_HEAP_THREAD_STATS=n
    filter: CONFIG_SYS_HEAP_STATS_LOGGING

  libraries.heap_stats_log.random_canary:
    extra_configs:
      - CONFIG_SYS_HEAP_CANARIES_RANDOM=y
    filter: CONFIG_SYS_HEAP_STATS_LOGGING

  libraries.heap_stats_log.no_runtime_stats:
    extra_configs:
      - CONFIG_SYS_HEAP_RUNTIME_STATS=n
    filter: CONFIG_SYS_HEAP_STATS_LOGGING
```

## tests/lib/icmsg/testcase.yaml
```yaml
tests:
  libraries.icmsg:
    integration_platforms:
      - nrf5340dk_nrf5340_cpuapp
    platform_exclude: qemu_xtensa qemu_malta
```

## tests/lib/json/testcase.yaml
```yaml
tests:
  libraries.encoding.json:
    filter: not CONFIG_NEWLIB_LIBC
    min_flash: 34
    tags: json
    integration_platforms:
      - native_posix
```

## tests/lib/libmp/build_all/boards/mimxrt685_evk_mimxrt685s_cm33.conf
```kconfig
#
# Copyright 2025 NXP
#
# SPDX-License-Identifier: Apache-2.0
#

CONFIG_I3C=y
CONFIG_AUDIO=y
CONFIG_AUDIO_CODEC=y
```

## tests/lib/libmp/build_all/testcase.yaml
```yaml
tests:
  libmp.core.build:
    tags:
      - lib
    platform_allow:
      - native_sim
      - native_sim/native/64
      - mimxrt1170_evk@B/mimxrt1176/cm7
      - mimxrt685_evk/mimxrt685s/cm33
    build_only: true
    extra_args:
      - CONFIG_MP_CAPSFILTER=y

  libmp.video_plugin.build:
    tags:
      - lib
    build_only: true
    platform_allow:
      - mimxrt1170_evk@B/mimxrt1176/cm7
    extra_args:
      - SHIELD=rk055hdmipi4ma0
      - CONFIG_VIDEO=y
      - CONFIG_DISPLAY=y
      - CONFIG_MP_PLUGIN_ZVID=y
      - CONFIG_MP_PLUGIN_ZDISP=y

  libmp.audio_plugin.build:
    tags:
      - lib
    build_only: true
    platform_allow:
      - mimxrt685_evk/mimxrt685s/cm33
    extra_args:
      - CONFIG_I2S=y
      - CONFIG_AUDIO=y
      - CONFIG_AUDIO_DMIC=y
      - CONFIG_AUDIO_CODEC=y
      - CONFIG_MP_PLUGIN_ZAUD=y
```

## tests/lib/libmp/core/testcase.yaml
```yaml
tests:
  libmp.core:
    platform_allow:
      - native_sim/native/64
      - mimxrt1170_evk/mimxrt1176/cm7
    tags:
      - libmp
```

## tests/lib/linear_range/testcase.yaml
```yaml
# Copyright (c) 2022 Nordic Semiconductor ASA
# SPDX-License-Identifier: Apache-2.0

tests:
  libraries.linear_range:
    integration_platforms:
      - native_sim
```

## tests/lib/lockfree/boards/qemu_cortex_a53_qemu_cortex_a53_smp.conf
```kconfig
# Configuration overlay for 4-CPU testing on QEMU Cortex-A53
CONFIG_MP_MAX_NUM_CPUS=4
```

## tests/lib/lockfree/testcase.yaml
```yaml
tests:
  libraries.lockfree:
    platform_exclude:
      - m2gl025_miv # renode times out
    tags:
      - lockfree
```

## tests/lib/math/interpolation/testcase.yaml
```yaml
# Copyright (c) 2024 Embeint Inc
# SPDX-License-Identifier: Apache-2.0

tests:
  utilities.math.interpolation:
    integration_platforms:
      - native_sim
```

## tests/lib/mem_alloc/testcase.yaml
```yaml
common:
  arch_exclude: posix
  tags:
    - clib
    - userspace
  integration_platforms:
    - qemu_x86
tests:
  libraries.libc.minimal.mem_alloc:
    extra_args: CONF_FILE=prj.conf
    tags:
      - minimal_libc
  libraries.libc.minimal.mem_alloc_negative_testing:
    extra_args: CONF_FILE=prj_negative_testing.conf
    tags:
      - minimal_libc
  libraries.libc.newlib.mem_alloc:
    extra_args: CONF_FILE=prj_newlib.conf
    filter: TOOLCHAIN_HAS_NEWLIB == 1
    min_ram: 16
    tags:
      - newlib
  libraries.libc.newlib_nano.mem_alloc:
    extra_args: CONF_FILE=prj_newlibnano.conf
    filter: CONFIG_HAS_NEWLIB_LIBC_NANO
    tags:
      - newlib
  libraries.libc.picolibc.mem_alloc:
    extra_args: CONF_FILE=prj_picolibc.conf
    filter: CONFIG_PICOLIBC_SUPPORTED
    tags:
      - picolibc
```

## tests/lib/mem_blocks/boards/intel_adsp_cavs15.conf
```kconfig
CONFIG_DMA=y
CONFIG_ASSERT=y
CONFIG_LOG=y
CONFIG_LOG_MODE_IMMEDIATE=y
CONFIG_LOG_BACKEND_ADSP=n
CONFIG_LOG_BACKEND_ADSP_HDA=y
CONFIG_LOG_BACKEND_ADSP_HDA_SIZE=8192
CONFIG_LOG_BACKEND_ADSP_HDA_PADDING=y
CONFIG_LOG_BACKEND_ADSP_HDA_CAVSTOOL=y
CONFIG_LOG_BACKEND_ADSP_HDA_FLUSH_TIME=100
CONFIG_XTENSA_ENABLE_BACKTRACE=n
```

## tests/lib/mem_blocks/testcase.yaml
```yaml
tests:
  libraries.mem_blocks:
    tags:
      - heap
      - mem_blocks
    integration_platforms:
      - native_posix
```

## tests/lib/mem_blocks_stats/testcase.yaml
```yaml
tests:
  libraries.mem_blocks.stats:
    tags:
      - heap
      - mem_blocks.stats
    integration_platforms:
      - native_posix
```

## tests/lib/midi2/testcase.yaml
```yaml
tests:
  libraries.midi2.ump_stream_responder:
    tags:
      - midi
    integration_platforms:
      - native_sim
```

## tests/lib/mpsc_pbuf/testcase.yaml
```yaml
tests:
  libraries.mpsc_pbuf:
    tags: mpsc_pbuf
    platform_allow:
      - qemu_arc/qemu_arc_em
      - qemu_arc/qemu_arc_hs
      - qemu_cortex_a53/qemu_cortex_a53
      - qemu_cortex_m0/nrf51822
      - qemu_cortex_m3/ti_lm3s6965
      - qemu_cortex_r5/zynqmp_rpu
      - qemu_leon3/leon3
      - qemu_nios2/qemu_nios2
      - qemu_riscv32/qemu_virt_riscv32
      - qemu_riscv64/qemu_virt_riscv64
      - qemu_x86/atom
      - qemu_x86_64/atom
      - qemu_xtensa/dc233c
      - native_posix/native
      - native_sim/native
    integration_platforms:
      - native_sim/native

  libraries.mpsc_pbuf.concurrent:
    tags: mpsc_pbuf
    platform_allow:
      - qemu_cortex_m3/ti_lm3s6965
      - qemu_x86/atom
      - qemu_x86_64/atom
    extra_configs:
      - CONFIG_SYS_CLOCK_TICKS_PER_SEC=100000
    timeout: 120
    integration_platforms:
      - qemu_x86/atom
      - qemu_x86_64/atom
```

## tests/lib/multi_heap/testcase.yaml
```yaml
tests:
  libraries.multi_heap:
    tags:
      - multi_heap
    extra_configs:
      - CONFIG_IRQ_OFFLOAD=y
  libraries.multi_heap.no_mt:
    tags:
      - multi_heap
    platform_allow:
      - qemu_cortex_m3
      - qemu_cortex_m0
      - nsim/nsim_em
      - nsim/nsim_em7d_v22
      - nsim/nsim_hs
      - nsim/nsim_hs/mpuv6
      - nsim/nsim_hs5x
      - nsim/nsim_hs6x
      - qemu_arc/qemu_arc_em
      - qemu_arc/qemu_arc_hs
      - qemu_arc/qemu_arc_hs6x
      - qemu_riscv/qemu_virt_riscv/rv32
      - qemu_riscv/qemu_virt_riscv/rv32e
      - qemu_riscv/qemu_virt_riscv/rv64
      - qemu_leon3
    integration_platforms:
      - qemu_cortex_m3
    extra_configs:
      - CONFIG_MULTITHREADING=n
```

## tests/lib/navigation/testcase.yaml
```yaml
# Copyright 2024 Bjarki Arge Andreasen
# SPDX-License-Identifier: Apache-2.0

tests:
  lib.navigation:
    tags:
      - navigation
```

## tests/lib/net_buf/buf/testcase.yaml
```yaml
tests:
  libraries.net_buf.buf:
    min_ram: 16
    tags:
      - net_buf
  libraries.net_buf.large_buf:
    min_ram: 32
    extra_configs:
      - CONFIG_NET_BUF_LARGE_SIZE=y
    tags:
      - net_buf
```

## tests/lib/net_buf/buf_simple/testcase.yaml
```yaml
common:
  tags:
    - net_buf
tests:
  libraries.net_buf.buf_simple:
    type: unit
```

## tests/lib/newlib/heap_listener/boards/nucleo_c031c6.conf
```kconfig
# SPDX-FileCopyrightText: Copyright The Zephyr Project Contributors
# SPDX-License-Identifier: Apache-2.0

CONFIG_NEWLIB_LIBC_MIN_REQUIRED_HEAP_SIZE=4096
```

## tests/lib/newlib/heap_listener/testcase.yaml
```yaml
common:
  platform_exclude:
    - intel_adsp/cavs25
    - intel_adsp/cavs25/tgph
    - intel_adsp/ace15_mtpm
    - intel_adsp/ace15_mtpm/sim
    - intel_adsp/ace20_lnl
    - intel_adsp/ace20_lnl/sim
    - intel_adsp/ace30/ptl
    - intel_adsp/ace30/ptl/sim
    - intel_adsp/ace30/wcl
    - intel_adsp/ace30/wcl/sim
    - intel_adsp/ace40/nvl
    - intel_adsp/ace40/nvl/sim
    - intel_adsp/ace40/nvls
tests:
  libraries.libc.newlib.heap_listener:
    tags:
      - clib
      - newlib
    filter: TOOLCHAIN_HAS_NEWLIB == 1
    arch_exclude: posix
    integration_platforms:
      - mps2/an385
      - qemu_x86
```

## tests/lib/newlib/newlib_hook/testcase.yaml
```yaml
common:
  filter: TOOLCHAIN_HAS_NEWLIB == 1
  min_ram: 64

tests:
  libraries.libc.newlib:
    tags: clib newlib
  libraries.libc.newlib_nano:
    tags: clib newlib
    filter: CONFIG_HAS_NEWLIB_LIBC_NANO
    extra_configs:
      - CONFIG_NEWLIB_LIBC_NANO=y
  libraries.libc.newlib.userspace:
    filter: CONFIG_ARCH_HAS_USERSPACE
    tags: clib newlib userspace
    extra_configs:
      - CONFIG_TEST_USERSPACE=y
  libraries.libc.newlib_nano.userspace:
    tags: clib newlib userspace
    filter: CONFIG_ARCH_HAS_USERSPACE and CONFIG_HAS_NEWLIB_LIBC_NANO
    extra_configs:
      - CONFIG_TEST_USERSPACE=y
      - CONFIG_NEWLIB_LIBC_NANO=y
```
