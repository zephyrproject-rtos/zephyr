## CMakeLists.txt
```
# SPDX-License-Identifier: Apache-2.0

cmake_minimum_required(VERSION 3.20.0)
find_package(Zephyr REQUIRED HINTS $ENV{ZEPHYR_BASE})
project(heap_asan_demo)

FILE(GLOB app_sources src/*.c)
target_sources(app PRIVATE ${app_sources})
```

## Kconfig
```
# Copyright (c) 2025
#
# SPDX-License-Identifier: Apache-2.0

config HEAP_ASAN_DEMO_CRASH_USE_AFTER_FREE
	bool "Enable use-after-free crash test"
	help
	  Demonstrates ASAN detection of use-after-free errors in the heap
	  allocator test suite.

	  This crash test is part of the comprehensive heap_asan_demo test that
	  validates ASAN memory poisoning integration. When enabled, it includes
	  a test case that deliberately accesses freed memory to verify ASAN
	  correctly detects and reports the error.

	  Test scenario:
	  1. Allocate memory block
	  2. Free the memory block (heap poisons it)
	  3. Attempt to read from the freed block
	  4. ASAN detects the access and terminates with error

	  Expected result: AddressSanitizer: use-after-poison on address 0x...

	  WARNING: This test will intentionally crash the program!
	  Only enable ONE crash test configuration at a time.

config HEAP_ASAN_DEMO_CRASH_UNALLOCATED
	bool "Enable unallocated memory access crash test"
	help
	  Demonstrates ASAN detection of accessing never-allocated memory in the
	  heap allocator test suite.

	  This crash test is part of the comprehensive heap_asan_demo test that
	  validates ASAN memory poisoning integration. When enabled, it includes
	  a test case that deliberately accesses heap memory that was never
	  allocated to verify ASAN correctly detects and reports the error.

	  Test scenario:
	  1. Identify address within heap bounds but never allocated
	  2. Verify the memory is poisoned using ASAN API
	  3. Attempt to read from the unallocated region
	  4. ASAN detects the access and terminates with error

	  Expected result: AddressSanitizer: use-after-poison on address 0x...

	  WARNING: This test will intentionally crash the program!
	  Only enable ONE crash test configuration at a time.

config HEAP_ASAN_DEMO_CRASH_BUFFER_OVERFLOW
	bool "Enable buffer overflow crash test"
	help
	  Demonstrates ASAN detection of buffer overflow errors in the heap
	  allocator test suite.

	  This crash test is part of the comprehensive heap_asan_demo test that
	  validates ASAN memory poisoning integration. When enabled, it includes
	  a test case that deliberately writes beyond allocated buffer boundaries
	  to verify ASAN correctly detects and reports the error when the overflow
	  reaches a poisoned adjacent region.

	  Test scenario:
	  1. Allocate two adjacent memory blocks
	  2. Free the second block (heap poisons it)
	  3. Write beyond first block's boundary into freed region
	  4. ASAN detects the overflow and terminates with error

	  Expected result: AddressSanitizer: use-after-poison on address 0x...
	  (if the overflow reaches the poisoned adjacent region)

	  WARNING: This test will intentionally crash the program!
	  Only enable ONE crash test configuration at a time.

config HEAP_ASAN_DEMO_CRASH_USE_AFTER_REALLOC
	bool "Enable use-after-realloc crash test"
	help
	  Demonstrates ASAN detection of use-after-realloc errors in the heap
	  allocator test suite.

	  This crash test is part of the comprehensive heap_asan_demo test that
	  validates ASAN memory poisoning integration. When enabled, it includes
	  a test case that demonstrates detection of accessing the old memory
	  location after realloc() has moved the allocation to a new address.

	  Test scenario:
	  1. Allocate memory at address A
	  2. Call realloc() to expand, forcing relocation to address B
	  3. The old address A is freed and poisoned
	  4. Attempt to access the old address A
	  5. ASAN detects the access and terminates with error

	  This demonstrates a common programming error where code maintains
	  multiple pointers to the same memory, and only one pointer is updated
	  after realloc(), leaving stale references to the freed memory.

	  Expected result: AddressSanitizer: use-after-poison on address 0x...

	  WARNING: This test will intentionally crash the program!
	  Only enable ONE crash test configuration at a time.

source "Kconfig.zephyr"
```

## prj.conf
```kconfig
#
# ASAN Heap Poisoning Demo - Project Configuration
#
# This configuration enables ASAN integration with sys_heap allocator.
# Uncomment specific crash test options below to demonstrate ASAN detection.
#

# Test framework
CONFIG_ZTEST=y
CONFIG_ZTEST_STACK_SIZE=2048

# Heap validation and debugging
CONFIG_SYS_HEAP_VALIDATE=y
CONFIG_ASSERT=y
CONFIG_SYS_HEAP_RUNTIME_STATS=y

# Logging
CONFIG_DEBUG=y
CONFIG_LOG=y
CONFIG_LOG_DEFAULT_LEVEL=3

# Address Sanitizer
CONFIG_ASAN=y
CONFIG_SYS_HEAP_ASAN_POISONING=y

# =============================================================================
# ASAN Memory Poisoning Demonstration Tests
# =============================================================================
# These tests are part of the heap_asan_demo comprehensive validation suite.
# Each test deliberately triggers a specific type of memory error to demonstrate
# ASAN's detection capabilities.
#
# USAGE:
#   1. Uncomment ONE crash test configuration below
#   2. Build: west build -p -b native_sim tests/lib/heap_asan_demo
#   3. Run: ./build/zephyr/zephyr.exe
#   4. Observe ASAN error message demonstrating detection
#
# WARNING: These tests will intentionally crash! Only enable ONE at a time.
#

# Crash Test 1: Use-After-Free Detection
# Demonstrates ASAN detection when accessing freed memory.
# Test allocates memory, frees it, then attempts to read the freed block.
# Expected result: AddressSanitizer: use-after-poison on address 0x...
#CONFIG_HEAP_ASAN_DEMO_CRASH_USE_AFTER_FREE=y

# Crash Test 2: Unallocated Memory Access Detection
# Demonstrates ASAN detection when accessing never-allocated heap memory.
# Test identifies a poisoned heap region and attempts to read from it.
# Expected result: AddressSanitizer: use-after-poison on address 0x...
#CONFIG_HEAP_ASAN_DEMO_CRASH_UNALLOCATED=y

# Crash Test 3: Buffer Overflow Detection
# Demonstrates ASAN detection when writing beyond allocation boundaries.
# Test allocates adjacent blocks, frees one, then overflows into freed region.
# Expected result: AddressSanitizer: use-after-poison on address 0x...
# (if the overflow reaches the poisoned adjacent memory)
#CONFIG_HEAP_ASAN_DEMO_CRASH_BUFFER_OVERFLOW=y

# Crash Test 4: Use-After-Realloc Detection
# Demonstrates ASAN detection when accessing old pointer after realloc relocation.
# Test allocates memory, forces realloc to relocate it, then accesses old address.
# This is a variant of use-after-free specific to realloc() operations.
# Expected result: AddressSanitizer: use-after-poison on address 0x...
#CONFIG_HEAP_ASAN_DEMO_CRASH_USE_AFTER_REALLOC=y
```

## src/main.c
```c
/*
 * Copyright (c) 2025 Zephyr Project
 *
 * SPDX-License-Identifier: Apache-2.0
 *
 */

#include <zephyr/kernel.h>
#include <zephyr/ztest.h>
#include <zephyr/sys/sys_heap.h>
#include <string.h>

#define HEAP_SIZE 4096

static uint8_t heap_mem[HEAP_SIZE];
static struct sys_heap test_heap;

static void *test_setup(void)
{
	sys_heap_init(&test_heap, heap_mem, HEAP_SIZE);
	return NULL;
}

ZTEST(heap_asan_demo, test_heap_basic_operations)
{
	void *ptr1;
	void *ptr2;
	void *ptr3;
	void *ptr4;

	TC_PRINT("\n=== Heap ASAN Demo Test ===\n");

#if CONFIG_HEAP_ASAN_DEMO_CRASH_UNALLOCATED
	TC_PRINT("\n[CRASH TEST] Accessing unallocated memory\n");
	void *ptr = (void *)&heap_mem[HEAP_SIZE/2];

	TC_PRINT("Attempting to write to unallocated address %p\n", ptr);
	TC_PRINT("Expected: ASAN crash\n");
	memset(ptr, 0xAA, 16);
	zassert_unreachable("Accessed unallocated heap memory without crashing");
#endif /* CONFIG_HEAP_ASAN_DEMO_CRASH_UNALLOCATED */

	TC_PRINT("\nStep 1: Allocate 100 bytes\n");
	ptr1 = sys_heap_alloc(&test_heap, 100);
	zassert_not_null(ptr1, "Failed to allocate memory from heap");
	TC_PRINT("  Allocated at %p\n", ptr1);

	memset(ptr1, 0xA1, 100);
	TC_PRINT("  Wrote pattern 0xA1\n");

#if CONFIG_HEAP_ASAN_DEMO_CRASH_BUFFER_OVERFLOW
	TC_PRINT("\n[CRASH TEST] Buffer overflow\n");
	size_t usable_size = sys_heap_usable_size(&test_heap, ptr1);

	TC_PRINT("Usable size: %zu bytes\n", usable_size);
	TC_PRINT("Attempting to write %zu bytes (overflow by 16)\n", usable_size + 16);
	TC_PRINT("Expected: ASAN crash\n");
	memset(ptr1, 0x41, usable_size + 16);
	zassert_unreachable("Buffer overflow did not crash as expected");
#endif /* CONFIG_HEAP_ASAN_DEMO_CRASH_BUFFER_OVERFLOW */

	TC_PRINT("\nStep 2: Allocate 200 bytes\n");
	ptr2 = sys_heap_alloc(&test_heap, 200);
	zassert_not_null(ptr2, "Failed to allocate memory from heap");
	TC_PRINT("  Allocated at %p\n", ptr2);

	memset(ptr2, 0xA2, 200);
	TC_PRINT("  Wrote pattern 0xA2\n");

	TC_PRINT("\nStep 3: Allocate aligned (32-byte) 100 bytes\n");
	ptr3 = sys_heap_aligned_alloc(&test_heap, 32, 100);
	zassert_not_null(ptr3, "Failed to allocate aligned memory");
	TC_PRINT("  Allocated at %p\n", ptr3);

	zassert_equal((uintptr_t)ptr3 & 0x1F, 0, "Memory not properly aligned");
	TC_PRINT("  Alignment verified\n");

	memset(ptr3, 0xA3, 100);
	TC_PRINT("  Wrote pattern 0xA3\n");

	TC_PRINT("\nStep 4: Realloc ptr1 to 200 bytes\n");
	TC_PRINT("  Original ptr1: %p\n", ptr1);
	ptr4 = sys_heap_realloc(&test_heap, ptr1, 200);
	zassert_not_null(ptr4, "Failed to reallocate memory");
	TC_PRINT("  Reallocated at %p\n", ptr4);

#if CONFIG_HEAP_ASAN_DEMO_CRASH_USE_AFTER_REALLOC
	if (ptr4 != ptr1) {
		TC_PRINT("\n[CRASH TEST] Use after realloc\n");
		TC_PRINT("Memory was relocated: old=%p, new=%p\n", ptr1, ptr4);
		TC_PRINT("Attempting to access old pointer\n");
		TC_PRINT("Expected: ASAN crash\n");
		memset(ptr1, 0x55, 16);
		zassert_unreachable("Use after realloc did not crash as expected");
	} else {
		TC_PRINT("\n[SKIP] Realloc did not relocate, skipping crash test\n");
	}
#endif /* CONFIG_HEAP_ASAN_DEMO_CRASH_USE_AFTER_REALLOC */

	TC_PRINT("\nStep 5: Verify data preserved during realloc\n");
	for (int i = 0; i < 100; i++) {
		zassert_equal(((uint8_t *)ptr4)[i], 0xA1, "Data not preserved during realloc");
	}
	TC_PRINT("  First 100 bytes preserved\n");

	memset((uint8_t *)ptr4 + 100, 0xB1, 100);
	TC_PRINT("  Extended area writable\n");

	TC_PRINT("\nStep 6: Free allocated memory\n");
	sys_heap_free(&test_heap, ptr2);
	TC_PRINT("  Freed ptr2\n");

	sys_heap_free(&test_heap, ptr3);
	TC_PRINT("  Freed ptr3\n");

	sys_heap_free(&test_heap, ptr4);
	TC_PRINT("  Freed ptr4\n");

#if CONFIG_HEAP_ASAN_DEMO_CRASH_USE_AFTER_FREE
	TC_PRINT("\n[CRASH TEST] Use after free\n");
	TC_PRINT("Attempting to access freed ptr2 at %p\n", ptr2);
	TC_PRINT("Expected: ASAN crash\n");
	memset(ptr2, 0x55, 16);
	zassert_unreachable("Use after free did not crash as expected");
#endif /* CONFIG_HEAP_ASAN_DEMO_CRASH_USE_AFTER_FREE */

	TC_PRINT("\n=== Test Complete ===\n");
}

ZTEST_SUITE(heap_asan_demo, NULL, test_setup, NULL, NULL, NULL);
```
