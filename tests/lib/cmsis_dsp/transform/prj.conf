## CMakeLists.txt
```
# SPDX-License-Identifier: Apache-2.0

cmake_minimum_required(VERSION 3.28.0)
find_package(Zephyr REQUIRED HINTS $ENV{ZEPHYR_BASE})
project(cmsis_dsp_transform)

target_sources(app PRIVATE src/main.c)

target_sources_ifdef(
  CONFIG_CMSIS_DSP_TEST_TRANSFORM_CQ15
  app PRIVATE src/cq15.c
  )

target_sources_ifdef(
  CONFIG_CMSIS_DSP_TEST_TRANSFORM_RQ15
  app PRIVATE src/rq15.c
  )

target_sources_ifdef(
  CONFIG_CMSIS_DSP_TEST_TRANSFORM_CQ31
  app PRIVATE src/cq31.c
  )

target_sources_ifdef(
  CONFIG_CMSIS_DSP_TEST_TRANSFORM_RQ31
  app PRIVATE src/rq31.c
  )

target_sources_ifdef(
  CONFIG_CMSIS_DSP_TEST_TRANSFORM_CF16
  app PRIVATE src/cf16.c
  )

target_sources_ifdef(
  CONFIG_CMSIS_DSP_TEST_TRANSFORM_RF16
  app PRIVATE src/rf16.c
  )

target_sources_ifdef(
  CONFIG_CMSIS_DSP_TEST_TRANSFORM_CF32
  app PRIVATE src/cf32.c
  )

target_sources_ifdef(
  CONFIG_CMSIS_DSP_TEST_TRANSFORM_RF32
  app PRIVATE src/rf32.c
  )

target_sources_ifdef(
  CONFIG_CMSIS_DSP_TEST_TRANSFORM_CF64
  app PRIVATE src/cf64.c
  )

target_sources_ifdef(
  CONFIG_CMSIS_DSP_TEST_TRANSFORM_RF64
  app PRIVATE src/rf64.c
  )
```

## Kconfig
```
# Copyright (c) 2021 Stephanos Ioannidis <root@stephanos.io>
# SPDX-License-Identifier: Apache-2.0

config CMSIS_DSP_TEST_TRANSFORM_CQ15
	bool "Test: Transform CQ15"

config CMSIS_DSP_TEST_TRANSFORM_RQ15
	bool "Test: Transform RQ15"

config CMSIS_DSP_TEST_TRANSFORM_CQ31
	bool "Test: Transform CQ31"

config CMSIS_DSP_TEST_TRANSFORM_RQ31
	bool "Test: Transform RQ31"

config CMSIS_DSP_TEST_TRANSFORM_CF16
	bool "Test: Transform CF16"
	depends on CMSIS_DSP_FLOAT16

config CMSIS_DSP_TEST_TRANSFORM_RF16
	bool "Test: Transform RF16"
	depends on CMSIS_DSP_FLOAT16

config CMSIS_DSP_TEST_TRANSFORM_CF32
	bool "Test: Transform CF32"

config CMSIS_DSP_TEST_TRANSFORM_RF32
	bool "Test: Transform RF32"

config CMSIS_DSP_TEST_TRANSFORM_CF64
	bool "Test: Transform CF64"

config CMSIS_DSP_TEST_TRANSFORM_RF64
	bool "Test: Transform RF64"

source "Kconfig"
```

## prj.conf
```kconfig
CONFIG_ZTEST=y
CONFIG_REQUIRES_FULL_LIBC=y
CONFIG_CMSIS_DSP=y

# Test Options
CONFIG_CMSIS_DSP_TEST_TRANSFORM_CQ15=y
CONFIG_CMSIS_DSP_TEST_TRANSFORM_RQ15=y
CONFIG_CMSIS_DSP_TEST_TRANSFORM_CQ31=y
CONFIG_CMSIS_DSP_TEST_TRANSFORM_RQ31=y
CONFIG_CMSIS_DSP_TEST_TRANSFORM_CF16=y
CONFIG_CMSIS_DSP_TEST_TRANSFORM_RF16=y
CONFIG_CMSIS_DSP_TEST_TRANSFORM_CF32=y
CONFIG_CMSIS_DSP_TEST_TRANSFORM_RF32=y
CONFIG_CMSIS_DSP_TEST_TRANSFORM_CF64=y
CONFIG_CMSIS_DSP_TEST_TRANSFORM_RF64=y
```

## prj_base.conf
```kconfig
CONFIG_ZTEST=y
CONFIG_REQUIRES_FULL_LIBC=y
CONFIG_CMSIS_DSP=y
CONFIG_CMSIS_DSP_TRANSFORM=y
```

## src/main.c
```c
/*
 * Copyright (c) 2020 Stephanos Ioannidis <root@stephanos.io>
 *
 * SPDX-License-Identifier: Apache-2.0
 */
```

## src/cf16.c
```c
/*
 * Copyright (c) 2021 Stephanos Ioannidis <root@stephanos.io>
 * Copyright (C) 2010-2021 ARM Limited or its affiliates. All rights reserved.
 *
 * SPDX-License-Identifier: Apache-2.0
 */

#include <zephyr/ztest.h>
#include <zephyr/kernel.h>
#include <stdlib.h>
#include <arm_math_f16.h>
#include <arm_const_structs.h>
#include "../../common/test_common.h"

#include "cf16.pat"

#define SNR_ERROR_THRESH	((float32_t)58)

static void test_arm_cfft_f16_cmplx_backend(
	bool inverse, const uint16_t *input, const uint16_t *ref, size_t length)
{
	arm_cfft_instance_f16 inst;
	float16_t *output;
	arm_status status;

	/* Initialise instance */
	status = arm_cfft_init_f16(&inst, length / 2);

	zassert_equal(status, ARM_MATH_SUCCESS,
		      ASSERT_MSG_INCORRECT_COMP_RESULT);

	/* Allocate output buffer */
	output = malloc(length * sizeof(float16_t));
	zassert_not_null(output, ASSERT_MSG_BUFFER_ALLOC_FAILED);

	/* Load data in place */
	memcpy(output, input, length * sizeof(float16_t));

	/* Run test function */
	arm_cfft_f16(&inst, output, inverse, true);

	/* Validate output */
	zassert_true(
		test_snr_error_f16(length, output, (float16_t *)ref,
			SNR_ERROR_THRESH),
		ASSERT_MSG_SNR_LIMIT_EXCEED);

	/* Free output buffer */
	free(output);
}

static void test_arm_cfft_f16_cmplx(
	const uint16_t *input, const uint16_t *ref, size_t length)
{
	test_arm_cfft_f16_cmplx_backend(false, input, ref, length);
}

DEFINE_TEST_VARIANT3(transform_cf16,
	arm_cfft_f16_cmplx, noisy_16,
	in_cfft_noisy_16, ref_cfft_noisy_16, 32);

DEFINE_TEST_VARIANT3(transform_cf16,
	arm_cfft_f16_cmplx, noisy_32,
	in_cfft_noisy_32, ref_cfft_noisy_32, 64);

DEFINE_TEST_VARIANT3(transform_cf16,
	arm_cfft_f16_cmplx, noisy_64,
	in_cfft_noisy_64, ref_cfft_noisy_64, 128);

DEFINE_TEST_VARIANT3(transform_cf16,
	arm_cfft_f16_cmplx, noisy_128,
	in_cfft_noisy_128, ref_cfft_noisy_128, 256);

DEFINE_TEST_VARIANT3(transform_cf16,
	arm_cfft_f16_cmplx, noisy_256,
	in_cfft_noisy_256, ref_cfft_noisy_256, 512);

DEFINE_TEST_VARIANT3(transform_cf16,
	arm_cfft_f16_cmplx, noisy_512,
	in_cfft_noisy_512, ref_cfft_noisy_512, 1024);

DEFINE_TEST_VARIANT3(transform_cf16,
	arm_cfft_f16_cmplx, noisy_1024,
	in_cfft_noisy_1024, ref_cfft_noisy_1024, 2048);

DEFINE_TEST_VARIANT3(transform_cf16,
	arm_cfft_f16_cmplx, noisy_2048,
	in_cfft_noisy_2048, ref_cfft_noisy_2048, 4096);

DEFINE_TEST_VARIANT3(transform_cf16,
	arm_cfft_f16_cmplx, noisy_4096,
	in_cfft_noisy_4096, ref_cfft_noisy_4096, 8192);

DEFINE_TEST_VARIANT3(transform_cf16,
	arm_cfft_f16_cmplx, step_16,
	in_cfft_step_16, ref_cfft_step_16, 32);

DEFINE_TEST_VARIANT3(transform_cf16,
	arm_cfft_f16_cmplx, step_32,
	in_cfft_step_32, ref_cfft_step_32, 64);

DEFINE_TEST_VARIANT3(transform_cf16,
	arm_cfft_f16_cmplx, step_64,
	in_cfft_step_64, ref_cfft_step_64, 128);

DEFINE_TEST_VARIANT3(transform_cf16,
	arm_cfft_f16_cmplx, step_128,
	in_cfft_step_128, ref_cfft_step_128, 256);

DEFINE_TEST_VARIANT3(transform_cf16,
	arm_cfft_f16_cmplx, step_256,
	in_cfft_step_256, ref_cfft_step_256, 512);

DEFINE_TEST_VARIANT3(transform_cf16,
	arm_cfft_f16_cmplx, step_512,
	in_cfft_step_512, ref_cfft_step_512, 1024);

DEFINE_TEST_VARIANT3(transform_cf16,
	arm_cfft_f16_cmplx, step_1024,
	in_cfft_step_1024, ref_cfft_step_1024, 2048);

DEFINE_TEST_VARIANT3(transform_cf16,
	arm_cfft_f16_cmplx, step_2048,
	in_cfft_step_2048, ref_cfft_step_2048, 4096);

DEFINE_TEST_VARIANT3(transform_cf16,
	arm_cfft_f16_cmplx, step_4096,
	in_cfft_step_4096, ref_cfft_step_4096, 8192);

static void test_arm_cifft_f16_cmplx(
	const uint16_t *input, const uint16_t *ref, size_t length)
{
	test_arm_cfft_f16_cmplx_backend(true, input, ref, length);
}

DEFINE_TEST_VARIANT3(transform_cf16,
	arm_cifft_f16_cmplx, noisy_16,
	in_cifft_noisy_16, in_cfft_noisy_16, 32);

DEFINE_TEST_VARIANT3(transform_cf16,
	arm_cifft_f16_cmplx, noisy_32,
	in_cifft_noisy_32, in_cfft_noisy_32, 64);

DEFINE_TEST_VARIANT3(transform_cf16,
	arm_cifft_f16_cmplx, noisy_64,
	in_cifft_noisy_64, in_cfft_noisy_64, 128);

DEFINE_TEST_VARIANT3(transform_cf16,
	arm_cifft_f16_cmplx, noisy_128,
	in_cifft_noisy_128, in_cfft_noisy_128, 256);

DEFINE_TEST_VARIANT3(transform_cf16,
	arm_cifft_f16_cmplx, noisy_256,
	in_cifft_noisy_256, in_cfft_noisy_256, 512);

DEFINE_TEST_VARIANT3(transform_cf16,
	arm_cifft_f16_cmplx, noisy_512,
	in_cifft_noisy_512, in_cfft_noisy_512, 1024);

DEFINE_TEST_VARIANT3(transform_cf16,
	arm_cifft_f16_cmplx, noisy_1024,
	in_cifft_noisy_1024, in_cfft_noisy_1024, 2048);

DEFINE_TEST_VARIANT3(transform_cf16,
	arm_cifft_f16_cmplx, noisy_2048,
	in_cifft_noisy_2048, in_cfft_noisy_2048, 4096);

DEFINE_TEST_VARIANT3(transform_cf16,
	arm_cifft_f16_cmplx, noisy_4096,
	in_cifft_noisy_4096, in_cfft_noisy_4096, 8192);

DEFINE_TEST_VARIANT3(transform_cf16,
	arm_cifft_f16_cmplx, step_16,
	in_cifft_step_16, in_cfft_step_16, 32);

DEFINE_TEST_VARIANT3(transform_cf16,
	arm_cifft_f16_cmplx, step_32,
	in_cifft_step_32, in_cfft_step_32, 64);

DEFINE_TEST_VARIANT3(transform_cf16,
	arm_cifft_f16_cmplx, step_64,
	in_cifft_step_64, in_cfft_step_64, 128);

DEFINE_TEST_VARIANT3(transform_cf16,
	arm_cifft_f16_cmplx, step_128,
	in_cifft_step_128, in_cfft_step_128, 256);

DEFINE_TEST_VARIANT3(transform_cf16,
	arm_cifft_f16_cmplx, step_256,
	in_cifft_step_256, in_cfft_step_256, 512);

DEFINE_TEST_VARIANT3(transform_cf16,
	arm_cifft_f16_cmplx, step_512,
	in_cifft_step_512, in_cfft_step_512, 1024);

DEFINE_TEST_VARIANT3(transform_cf16,
	arm_cifft_f16_cmplx, step_1024,
	in_cifft_step_1024, in_cfft_step_1024, 2048);

DEFINE_TEST_VARIANT3(transform_cf16,
	arm_cifft_f16_cmplx, step_2048,
	in_cifft_step_2048, in_cfft_step_2048, 4096);

DEFINE_TEST_VARIANT3(transform_cf16,
	arm_cifft_f16_cmplx, step_4096,
	in_cifft_step_4096, in_cfft_step_4096, 8192);

ZTEST_SUITE(transform_cf16, NULL, NULL, NULL, NULL, NULL);
```

## src/cf32.c
```c
/*
 * Copyright (c) 2021 Stephanos Ioannidis <root@stephanos.io>
 * Copyright (C) 2010-2021 ARM Limited or its affiliates. All rights reserved.
 *
 * SPDX-License-Identifier: Apache-2.0
 */

#include <zephyr/ztest.h>
#include <zephyr/kernel.h>
#include <stdlib.h>
#include <arm_math.h>
#include <arm_const_structs.h>
#include "../../common/test_common.h"

#include "cf32.pat"

#define SNR_ERROR_THRESH	((float32_t)120)

static void test_arm_cfft_f32_cmplx_backend(
	bool inverse, const uint32_t *input, const uint32_t *ref, size_t length)
{
	arm_cfft_instance_f32 inst;
	float32_t *output;
	arm_status status;

	/* Initialise instance */
	status = arm_cfft_init_f32(&inst, length / 2);

	zassert_equal(status, ARM_MATH_SUCCESS,
		      ASSERT_MSG_INCORRECT_COMP_RESULT);

	/* Allocate output buffer */
	output = malloc(length * sizeof(float32_t));
	zassert_not_null(output, ASSERT_MSG_BUFFER_ALLOC_FAILED);

	/* Load data in place */
	memcpy(output, input, length * sizeof(float32_t));

	/* Run test function */
	arm_cfft_f32(&inst, output, inverse, true);

	/* Validate output */
	zassert_true(
		test_snr_error_f32(length, output, (float32_t *)ref,
			SNR_ERROR_THRESH),
		ASSERT_MSG_SNR_LIMIT_EXCEED);

	/* Free output buffer */
	free(output);
}

static void test_arm_cfft_f32_cmplx(
	const uint32_t *input, const uint32_t *ref, size_t length)
{
	test_arm_cfft_f32_cmplx_backend(false, input, ref, length);
}

DEFINE_TEST_VARIANT3(transform_cf32,
	arm_cfft_f32_cmplx, noisy_16,
	in_cfft_noisy_16, ref_cfft_noisy_16, 32);

DEFINE_TEST_VARIANT3(transform_cf32,
	arm_cfft_f32_cmplx, noisy_32,
	in_cfft_noisy_32, ref_cfft_noisy_32, 64);

DEFINE_TEST_VARIANT3(transform_cf32,
	arm_cfft_f32_cmplx, noisy_64,
	in_cfft_noisy_64, ref_cfft_noisy_64, 128);

DEFINE_TEST_VARIANT3(transform_cf32,
	arm_cfft_f32_cmplx, noisy_128,
	in_cfft_noisy_128, ref_cfft_noisy_128, 256);

DEFINE_TEST_VARIANT3(transform_cf32,
	arm_cfft_f32_cmplx, noisy_256,
	in_cfft_noisy_256, ref_cfft_noisy_256, 512);

DEFINE_TEST_VARIANT3(transform_cf32,
	arm_cfft_f32_cmplx, noisy_512,
	in_cfft_noisy_512, ref_cfft_noisy_512, 1024);

DEFINE_TEST_VARIANT3(transform_cf32,
	arm_cfft_f32_cmplx, noisy_1024,
	in_cfft_noisy_1024, ref_cfft_noisy_1024, 2048);

DEFINE_TEST_VARIANT3(transform_cf32,
	arm_cfft_f32_cmplx, noisy_2048,
	in_cfft_noisy_2048, ref_cfft_noisy_2048, 4096);

DEFINE_TEST_VARIANT3(transform_cf32,
	arm_cfft_f32_cmplx, noisy_4096,
	in_cfft_noisy_4096, ref_cfft_noisy_4096, 8192);

DEFINE_TEST_VARIANT3(transform_cf32,
	arm_cfft_f32_cmplx, step_16,
	in_cfft_step_16, ref_cfft_step_16, 32);

DEFINE_TEST_VARIANT3(transform_cf32,
	arm_cfft_f32_cmplx, step_32,
	in_cfft_step_32, ref_cfft_step_32, 64);

DEFINE_TEST_VARIANT3(transform_cf32,
	arm_cfft_f32_cmplx, step_64,
	in_cfft_step_64, ref_cfft_step_64, 128);

DEFINE_TEST_VARIANT3(transform_cf32,
	arm_cfft_f32_cmplx, step_128,
	in_cfft_step_128, ref_cfft_step_128, 256);

DEFINE_TEST_VARIANT3(transform_cf32,
	arm_cfft_f32_cmplx, step_256,
	in_cfft_step_256, ref_cfft_step_256, 512);

DEFINE_TEST_VARIANT3(transform_cf32,
	arm_cfft_f32_cmplx, step_512,
	in_cfft_step_512, ref_cfft_step_512, 1024);

DEFINE_TEST_VARIANT3(transform_cf32,
	arm_cfft_f32_cmplx, step_1024,
	in_cfft_step_1024, ref_cfft_step_1024, 2048);

DEFINE_TEST_VARIANT3(transform_cf32,
	arm_cfft_f32_cmplx, step_2048,
	in_cfft_step_2048, ref_cfft_step_2048, 4096);

DEFINE_TEST_VARIANT3(transform_cf32,
	arm_cfft_f32_cmplx, step_4096,
	in_cfft_step_4096, ref_cfft_step_4096, 8192);

static void test_arm_cifft_f32_cmplx(
	const uint32_t *input, const uint32_t *ref, size_t length)
{
	test_arm_cfft_f32_cmplx_backend(true, input, ref, length);
}

DEFINE_TEST_VARIANT3(transform_cf32,
	arm_cifft_f32_cmplx, noisy_16,
	in_cifft_noisy_16, in_cfft_noisy_16, 32);

DEFINE_TEST_VARIANT3(transform_cf32,
	arm_cifft_f32_cmplx, noisy_32,
	in_cifft_noisy_32, in_cfft_noisy_32, 64);

DEFINE_TEST_VARIANT3(transform_cf32,
	arm_cifft_f32_cmplx, noisy_64,
	in_cifft_noisy_64, in_cfft_noisy_64, 128);

DEFINE_TEST_VARIANT3(transform_cf32,
	arm_cifft_f32_cmplx, noisy_128,
	in_cifft_noisy_128, in_cfft_noisy_128, 256);

DEFINE_TEST_VARIANT3(transform_cf32,
	arm_cifft_f32_cmplx, noisy_256,
	in_cifft_noisy_256, in_cfft_noisy_256, 512);

DEFINE_TEST_VARIANT3(transform_cf32,
	arm_cifft_f32_cmplx, noisy_512,
	in_cifft_noisy_512, in_cfft_noisy_512, 1024);

DEFINE_TEST_VARIANT3(transform_cf32,
	arm_cifft_f32_cmplx, noisy_1024,
	in_cifft_noisy_1024, in_cfft_noisy_1024, 2048);

DEFINE_TEST_VARIANT3(transform_cf32,
	arm_cifft_f32_cmplx, noisy_2048,
	in_cifft_noisy_2048, in_cfft_noisy_2048, 4096);

DEFINE_TEST_VARIANT3(transform_cf32,
	arm_cifft_f32_cmplx, noisy_4096,
	in_cifft_noisy_4096, in_cfft_noisy_4096, 8192);

DEFINE_TEST_VARIANT3(transform_cf32,
	arm_cifft_f32_cmplx, step_16,
	in_cifft_step_16, in_cfft_step_16, 32);

DEFINE_TEST_VARIANT3(transform_cf32,
	arm_cifft_f32_cmplx, step_32,
	in_cifft_step_32, in_cfft_step_32, 64);

DEFINE_TEST_VARIANT3(transform_cf32,
	arm_cifft_f32_cmplx, step_64,
	in_cifft_step_64, in_cfft_step_64, 128);

DEFINE_TEST_VARIANT3(transform_cf32,
	arm_cifft_f32_cmplx, step_128,
	in_cifft_step_128, in_cfft_step_128, 256);

DEFINE_TEST_VARIANT3(transform_cf32,
	arm_cifft_f32_cmplx, step_256,
	in_cifft_step_256, in_cfft_step_256, 512);

DEFINE_TEST_VARIANT3(transform_cf32,
	arm_cifft_f32_cmplx, step_512,
	in_cifft_step_512, in_cfft_step_512, 1024);

DEFINE_TEST_VARIANT3(transform_cf32,
	arm_cifft_f32_cmplx, step_1024,
	in_cifft_step_1024, in_cfft_step_1024, 2048);

DEFINE_TEST_VARIANT3(transform_cf32,
	arm_cifft_f32_cmplx, step_2048,
	in_cifft_step_2048, in_cfft_step_2048, 4096);

DEFINE_TEST_VARIANT3(transform_cf32,
	arm_cifft_f32_cmplx, step_4096,
	in_cifft_step_4096, in_cfft_step_4096, 8192);

ZTEST_SUITE(transform_cf32, NULL, NULL, NULL, NULL, NULL);
```

## src/cf64.c
```c
/*
 * Copyright (c) 2021 Stephanos Ioannidis <root@stephanos.io>
 * Copyright (C) 2010-2021 ARM Limited or its affiliates. All rights reserved.
 *
 * SPDX-License-Identifier: Apache-2.0
 */

#include <zephyr/ztest.h>
#include <zephyr/kernel.h>
#include <stdlib.h>
#include <arm_math.h>
#include <arm_const_structs.h>
#include "../../common/test_common.h"

#include "cf64.pat"

#define SNR_ERROR_THRESH	((float64_t)250)

static void test_arm_cfft_f64_cmplx_backend(
	bool inverse, const uint64_t *input, const uint64_t *ref, size_t length)
{
	arm_cfft_instance_f64 inst;
	float64_t *output;
	arm_status status;

	/* Initialise instance */
	status = arm_cfft_init_f64(&inst, length / 2);

	zassert_equal(status, ARM_MATH_SUCCESS,
		      ASSERT_MSG_INCORRECT_COMP_RESULT);

	/* Allocate output buffer */
	output = malloc(length * sizeof(float64_t));
	zassert_not_null(output, ASSERT_MSG_BUFFER_ALLOC_FAILED);

	/* Load data in place */
	memcpy(output, input, length * sizeof(float64_t));

	/* Run test function */
	arm_cfft_f64(&inst, output, inverse, true);

	/* Validate output */
	zassert_true(
		test_snr_error_f64(length, output, (float64_t *)ref,
			SNR_ERROR_THRESH),
		ASSERT_MSG_SNR_LIMIT_EXCEED);

	/* Free output buffer */
	free(output);
}

static void test_arm_cfft_f64_cmplx(
	const uint64_t *input, const uint64_t *ref, size_t length)
{
	test_arm_cfft_f64_cmplx_backend(false, input, ref, length);
}

DEFINE_TEST_VARIANT3(transform_cf64,
	arm_cfft_f64_cmplx, noisy_16,
	in_cfft_noisy_16, ref_cfft_noisy_16, 32);

DEFINE_TEST_VARIANT3(transform_cf64,
	arm_cfft_f64_cmplx, noisy_32,
	in_cfft_noisy_32, ref_cfft_noisy_32, 64);

DEFINE_TEST_VARIANT3(transform_cf64,
	arm_cfft_f64_cmplx, noisy_64,
	in_cfft_noisy_64, ref_cfft_noisy_64, 128);

DEFINE_TEST_VARIANT3(transform_cf64,
	arm_cfft_f64_cmplx, noisy_128,
	in_cfft_noisy_128, ref_cfft_noisy_128, 256);

DEFINE_TEST_VARIANT3(transform_cf64,
	arm_cfft_f64_cmplx, noisy_256,
	in_cfft_noisy_256, ref_cfft_noisy_256, 512);

DEFINE_TEST_VARIANT3(transform_cf64,
	arm_cfft_f64_cmplx, noisy_512,
	in_cfft_noisy_512, ref_cfft_noisy_512, 1024);

DEFINE_TEST_VARIANT3(transform_cf64,
	arm_cfft_f64_cmplx, noisy_1024,
	in_cfft_noisy_1024, ref_cfft_noisy_1024, 2048);

DEFINE_TEST_VARIANT3(transform_cf64,
	arm_cfft_f64_cmplx, noisy_2048,
	in_cfft_noisy_2048, ref_cfft_noisy_2048, 4096);

DEFINE_TEST_VARIANT3(transform_cf64,
	arm_cfft_f64_cmplx, noisy_4096,
	in_cfft_noisy_4096, ref_cfft_noisy_4096, 8192);

DEFINE_TEST_VARIANT3(transform_cf64,
	arm_cfft_f64_cmplx, step_16,
	in_cfft_step_16, ref_cfft_step_16, 32);

DEFINE_TEST_VARIANT3(transform_cf64,
	arm_cfft_f64_cmplx, step_32,
	in_cfft_step_32, ref_cfft_step_32, 64);

DEFINE_TEST_VARIANT3(transform_cf64,
	arm_cfft_f64_cmplx, step_64,
	in_cfft_step_64, ref_cfft_step_64, 128);

DEFINE_TEST_VARIANT3(transform_cf64,
	arm_cfft_f64_cmplx, step_128,
	in_cfft_step_128, ref_cfft_step_128, 256);

DEFINE_TEST_VARIANT3(transform_cf64,
	arm_cfft_f64_cmplx, step_256,
	in_cfft_step_256, ref_cfft_step_256, 512);

DEFINE_TEST_VARIANT3(transform_cf64,
	arm_cfft_f64_cmplx, step_512,
	in_cfft_step_512, ref_cfft_step_512, 1024);

DEFINE_TEST_VARIANT3(transform_cf64,
	arm_cfft_f64_cmplx, step_1024,
	in_cfft_step_1024, ref_cfft_step_1024, 2048);

DEFINE_TEST_VARIANT3(transform_cf64,
	arm_cfft_f64_cmplx, step_2048,
	in_cfft_step_2048, ref_cfft_step_2048, 4096);

DEFINE_TEST_VARIANT3(transform_cf64,
	arm_cfft_f64_cmplx, step_4096,
	in_cfft_step_4096, ref_cfft_step_4096, 8192);

static void test_arm_cifft_f64_cmplx(
	const uint64_t *input, const uint64_t *ref, size_t length)
{
	test_arm_cfft_f64_cmplx_backend(true, input, ref, length);
}

DEFINE_TEST_VARIANT3(transform_cf64,
	arm_cifft_f64_cmplx, noisy_16,
	in_cifft_noisy_16, in_cfft_noisy_16, 32);

DEFINE_TEST_VARIANT3(transform_cf64,
	arm_cifft_f64_cmplx, noisy_32,
	in_cifft_noisy_32, in_cfft_noisy_32, 64);

DEFINE_TEST_VARIANT3(transform_cf64,
	arm_cifft_f64_cmplx, noisy_64,
	in_cifft_noisy_64, in_cfft_noisy_64, 128);

DEFINE_TEST_VARIANT3(transform_cf64,
	arm_cifft_f64_cmplx, noisy_128,
	in_cifft_noisy_128, in_cfft_noisy_128, 256);

DEFINE_TEST_VARIANT3(transform_cf64,
	arm_cifft_f64_cmplx, noisy_256,
	in_cifft_noisy_256, in_cfft_noisy_256, 512);

DEFINE_TEST_VARIANT3(transform_cf64,
	arm_cifft_f64_cmplx, noisy_512,
	in_cifft_noisy_512, in_cfft_noisy_512, 1024);

DEFINE_TEST_VARIANT3(transform_cf64,
	arm_cifft_f64_cmplx, noisy_1024,
	in_cifft_noisy_1024, in_cfft_noisy_1024, 2048);

DEFINE_TEST_VARIANT3(transform_cf64,
	arm_cifft_f64_cmplx, noisy_2048,
	in_cifft_noisy_2048, in_cfft_noisy_2048, 4096);

DEFINE_TEST_VARIANT3(transform_cf64,
	arm_cifft_f64_cmplx, noisy_4096,
	in_cifft_noisy_4096, in_cfft_noisy_4096, 8192);

DEFINE_TEST_VARIANT3(transform_cf64,
	arm_cifft_f64_cmplx, step_16,
	in_cifft_step_16, in_cfft_step_16, 32);

DEFINE_TEST_VARIANT3(transform_cf64,
	arm_cifft_f64_cmplx, step_32,
	in_cifft_step_32, in_cfft_step_32, 64);

DEFINE_TEST_VARIANT3(transform_cf64,
	arm_cifft_f64_cmplx, step_64,
	in_cifft_step_64, in_cfft_step_64, 128);

DEFINE_TEST_VARIANT3(transform_cf64,
	arm_cifft_f64_cmplx, step_128,
	in_cifft_step_128, in_cfft_step_128, 256);

DEFINE_TEST_VARIANT3(transform_cf64,
	arm_cifft_f64_cmplx, step_256,
	in_cifft_step_256, in_cfft_step_256, 512);

DEFINE_TEST_VARIANT3(transform_cf64,
	arm_cifft_f64_cmplx, step_512,
	in_cifft_step_512, in_cfft_step_512, 1024);

DEFINE_TEST_VARIANT3(transform_cf64,
	arm_cifft_f64_cmplx, step_1024,
	in_cifft_step_1024, in_cfft_step_1024, 2048);

DEFINE_TEST_VARIANT3(transform_cf64,
	arm_cifft_f64_cmplx, step_2048,
	in_cifft_step_2048, in_cfft_step_2048, 4096);

DEFINE_TEST_VARIANT3(transform_cf64,
	arm_cifft_f64_cmplx, step_4096,
	in_cifft_step_4096, in_cfft_step_4096, 8192);

ZTEST_SUITE(transform_cf64, NULL, NULL, NULL, NULL, NULL);
```

## src/cq15.c
```c
/*
 * Copyright (c) 2021 Stephanos Ioannidis <root@stephanos.io>
 * Copyright (C) 2010-2021 ARM Limited or its affiliates. All rights reserved.
 *
 * SPDX-License-Identifier: Apache-2.0
 */

#include <zephyr/ztest.h>
#include <zephyr/kernel.h>
#include <zephyr/test_toolchain.h>
#include <stdlib.h>
#include <arm_math.h>
#include <arm_const_structs.h>
#include "../../common/test_common.h"

#include "cq15.pat"

#define SNR_ERROR_THRESH_FFT	((float32_t)30)
#define SNR_ERROR_THRESH_IFFT	((float32_t)5)

static void test_arm_cfft_q15(
	const q15_t *input, const q15_t *ref, size_t length)
{
	arm_cfft_instance_q15 inst;
	q15_t *output;
	arm_status status;

	/* Initialise instance */
	status = arm_cfft_init_q15(&inst, length / 2);

	zassert_equal(status, ARM_MATH_SUCCESS,
		      ASSERT_MSG_INCORRECT_COMP_RESULT);

	/* Allocate output buffer */
	output = malloc(length * sizeof(q15_t));
	zassert_not_null(output, ASSERT_MSG_BUFFER_ALLOC_FAILED);

	/* Load data in place */
	memcpy(output, input, length * sizeof(q15_t));

	/* Run test function */
	arm_cfft_q15(&inst, output, false, true);

	/* Validate output */
	zassert_true(
		test_snr_error_q15(length, output, ref, SNR_ERROR_THRESH_FFT),
		ASSERT_MSG_SNR_LIMIT_EXCEED);

	/* Free output buffer */
	free(output);
}

DEFINE_TEST_VARIANT3(transform_cq15,
	arm_cfft_q15, noisy_16,
	in_cfft_noisy_16, ref_cfft_noisy_16, 32);

DEFINE_TEST_VARIANT3(transform_cq15,
	arm_cfft_q15, noisy_32,
	in_cfft_noisy_32, ref_cfft_noisy_32, 64);

DEFINE_TEST_VARIANT3(transform_cq15,
	arm_cfft_q15, noisy_64,
	in_cfft_noisy_64, ref_cfft_noisy_64, 128);

DEFINE_TEST_VARIANT3(transform_cq15,
	arm_cfft_q15, noisy_128,
	in_cfft_noisy_128, ref_cfft_noisy_128, 256);

DEFINE_TEST_VARIANT3(transform_cq15,
	arm_cfft_q15, noisy_256,
	in_cfft_noisy_256, ref_cfft_noisy_256, 512);

DEFINE_TEST_VARIANT3(transform_cq15,
	arm_cfft_q15, noisy_512,
	in_cfft_noisy_512, ref_cfft_noisy_512, 1024);

DEFINE_TEST_VARIANT3(transform_cq15,
	arm_cfft_q15, noisy_1024,
	in_cfft_noisy_1024, ref_cfft_noisy_1024, 2048);

DEFINE_TEST_VARIANT3(transform_cq15,
	arm_cfft_q15, noisy_2048,
	in_cfft_noisy_2048, ref_cfft_noisy_2048, 4096);

DEFINE_TEST_VARIANT3(transform_cq15,
	arm_cfft_q15, noisy_4096,
	in_cfft_noisy_4096, ref_cfft_noisy_4096, 8192);

DEFINE_TEST_VARIANT3(transform_cq15,
	arm_cfft_q15, step_16,
	in_cfft_step_16, ref_cfft_step_16, 32);

DEFINE_TEST_VARIANT3(transform_cq15,
	arm_cfft_q15, step_32,
	in_cfft_step_32, ref_cfft_step_32, 64);

DEFINE_TEST_VARIANT3(transform_cq15,
	arm_cfft_q15, step_64,
	in_cfft_step_64, ref_cfft_step_64, 128);

DEFINE_TEST_VARIANT3(transform_cq15,
	arm_cfft_q15, step_128,
	in_cfft_step_128, ref_cfft_step_128, 256);

DEFINE_TEST_VARIANT3(transform_cq15,
	arm_cfft_q15, step_256,
	in_cfft_step_256, ref_cfft_step_256, 512);

DEFINE_TEST_VARIANT3(transform_cq15,
	arm_cfft_q15, step_512,
	in_cfft_step_512, ref_cfft_step_512, 1024);

DEFINE_TEST_VARIANT3(transform_cq15,
	arm_cfft_q15, step_1024,
	in_cfft_step_1024, ref_cfft_step_1024, 2048);

DEFINE_TEST_VARIANT3(transform_cq15,
	arm_cfft_q15, step_2048,
	in_cfft_step_2048, ref_cfft_step_2048, 4096);

DEFINE_TEST_VARIANT3(transform_cq15,
	arm_cfft_q15, step_4096,
	in_cfft_step_4096, ref_cfft_step_4096, 8192);

static void test_arm_cifft_q15(
	int scale_factor, const q15_t *input, const q15_t *ref, size_t length)
{
	arm_cfft_instance_q15 inst;
	size_t index;
	q15_t *output, *scaled_ref;
	arm_status status;

	/* Initialise instance */
	status = arm_cfft_init_q15(&inst, length / 2);

	zassert_equal(status, ARM_MATH_SUCCESS,
		      ASSERT_MSG_INCORRECT_COMP_RESULT);

	/* Allocate buffers */
	output = malloc(length * sizeof(q15_t));
	zassert_not_null(output, ASSERT_MSG_BUFFER_ALLOC_FAILED);

	scaled_ref = malloc(length * sizeof(q15_t));
	zassert_not_null(scaled_ref, ASSERT_MSG_BUFFER_ALLOC_FAILED);

	/* Load data in place */
	memcpy(output, input, length * sizeof(q15_t));

	/* Run test function */
	arm_cfft_q15(&inst, output, true, true);

	/* Scale reference data */
	for (index = 0; index < length; index++) {
		scaled_ref[index] = ref[index] >> scale_factor;
	}

	/* Validate output */
	zassert_true(
		test_snr_error_q15(length, output, scaled_ref,
			SNR_ERROR_THRESH_IFFT),
		ASSERT_MSG_SNR_LIMIT_EXCEED);

	/* Free output buffer */
	free(output);
	free(scaled_ref);
}

DEFINE_TEST_VARIANT4(transform_cq15,
	arm_cifft_q15, noisy_16, 4,
	in_cifft_noisy_16, in_cfft_noisy_16, 32);

DEFINE_TEST_VARIANT4(transform_cq15,
	arm_cifft_q15, noisy_32, 5,
	in_cifft_noisy_32, in_cfft_noisy_32, 64);

DEFINE_TEST_VARIANT4(transform_cq15,
	arm_cifft_q15, noisy_64, 6,
	in_cifft_noisy_64, in_cfft_noisy_64, 128);

DEFINE_TEST_VARIANT4(transform_cq15,
	arm_cifft_q15, noisy_128, 7,
	in_cifft_noisy_128, in_cfft_noisy_128, 256);

DEFINE_TEST_VARIANT4(transform_cq15,
	arm_cifft_q15, noisy_256, 8,
	in_cifft_noisy_256, in_cfft_noisy_256, 512);

DEFINE_TEST_VARIANT4(transform_cq15,
	arm_cifft_q15, noisy_512, 9,
	in_cifft_noisy_512, in_cfft_noisy_512, 1024);

DEFINE_TEST_VARIANT4(transform_cq15,
	arm_cifft_q15, noisy_1024, 10,
	in_cifft_noisy_1024, in_cfft_noisy_1024, 2048);

DEFINE_TEST_VARIANT4(transform_cq15,
	arm_cifft_q15, noisy_2048, 11,
	in_cifft_noisy_2048, in_cfft_noisy_2048, 4096);

DEFINE_TEST_VARIANT4(transform_cq15,
	arm_cifft_q15, noisy_4096, 12,
	in_cifft_noisy_4096, in_cfft_noisy_4096, 8192);

DEFINE_TEST_VARIANT4(transform_cq15,
	arm_cifft_q15, step_16, 4,
	in_cifft_step_16, in_cfft_step_16, 32);

DEFINE_TEST_VARIANT4(transform_cq15,
	arm_cifft_q15, step_32, 5,
	in_cifft_step_32, in_cfft_step_32, 64);

DEFINE_TEST_VARIANT4(transform_cq15,
	arm_cifft_q15, step_64, 6,
	in_cifft_step_64, in_cfft_step_64, 128);

DEFINE_TEST_VARIANT4(transform_cq15,
	arm_cifft_q15, step_128, 7,
	in_cifft_step_128, in_cfft_step_128, 256);

DEFINE_TEST_VARIANT4(transform_cq15,
	arm_cifft_q15, step_256, 8,
	in_cifft_step_256, in_cfft_step_256, 512);

DEFINE_TEST_VARIANT4(transform_cq15,
	arm_cifft_q15, step_512, 9,
	in_cifft_step_512, in_cfft_step_512, 1024);

DEFINE_TEST_VARIANT4(transform_cq15,
	arm_cifft_q15, step_1024, 10,
	in_cifft_step_1024, in_cfft_step_1024, 2048);

DEFINE_TEST_VARIANT4(transform_cq15,
	arm_cifft_q15, step_2048, 11,
	in_cifft_step_2048, in_cfft_step_2048, 4096);

DEFINE_TEST_VARIANT4(transform_cq15,
	arm_cifft_q15, step_4096, 12,
	in_cifft_step_4096, in_cfft_step_4096, 8192);

ZTEST_SUITE(transform_cq15, NULL, NULL, NULL, NULL, NULL);
```

## src/cq31.c
```c
/*
 * Copyright (c) 2021 Stephanos Ioannidis <root@stephanos.io>
 * Copyright (C) 2010-2021 ARM Limited or its affiliates. All rights reserved.
 *
 * SPDX-License-Identifier: Apache-2.0
 */

#include <zephyr/ztest.h>
#include <zephyr/kernel.h>
#include <stdlib.h>
#include <arm_math.h>
#include <arm_const_structs.h>
#include "../../common/test_common.h"

#include "cq31.pat"

#define SNR_ERROR_THRESH	((float32_t)90)

static void test_arm_cfft_q31(
	const q31_t *input, const q31_t *ref, size_t length)
{
	arm_cfft_instance_q31 inst;
	q31_t *output;
	arm_status status;

	/* Initialise instance */
	status = arm_cfft_init_q31(&inst, length / 2);

	zassert_equal(status, ARM_MATH_SUCCESS,
		      ASSERT_MSG_INCORRECT_COMP_RESULT);

	/* Allocate output buffer */
	output = malloc(length * sizeof(q31_t));
	zassert_not_null(output, ASSERT_MSG_BUFFER_ALLOC_FAILED);

	/* Load data in place */
	memcpy(output, input, length * sizeof(q31_t));

	/* Run test function */
	arm_cfft_q31(&inst, output, false, true);

	/* Validate output */
	zassert_true(
		test_snr_error_q31(length, output, ref, SNR_ERROR_THRESH),
		ASSERT_MSG_SNR_LIMIT_EXCEED);

	/* Free output buffer */
	free(output);
}

DEFINE_TEST_VARIANT3(transform_cq31,
	arm_cfft_q31, noisy_16,
	in_cfft_noisy_16, ref_cfft_noisy_16, 32);

DEFINE_TEST_VARIANT3(transform_cq31,
	arm_cfft_q31, noisy_32,
	in_cfft_noisy_32, ref_cfft_noisy_32, 64);

DEFINE_TEST_VARIANT3(transform_cq31,
	arm_cfft_q31, noisy_64,
	in_cfft_noisy_64, ref_cfft_noisy_64, 128);

DEFINE_TEST_VARIANT3(transform_cq31,
	arm_cfft_q31, noisy_128,
	in_cfft_noisy_128, ref_cfft_noisy_128, 256);

DEFINE_TEST_VARIANT3(transform_cq31,
	arm_cfft_q31, noisy_256,
	in_cfft_noisy_256, ref_cfft_noisy_256, 512);

DEFINE_TEST_VARIANT3(transform_cq31,
	arm_cfft_q31, noisy_512,
	in_cfft_noisy_512, ref_cfft_noisy_512, 1024);

DEFINE_TEST_VARIANT3(transform_cq31,
	arm_cfft_q31, noisy_1024,
	in_cfft_noisy_1024, ref_cfft_noisy_1024, 2048);

DEFINE_TEST_VARIANT3(transform_cq31,
	arm_cfft_q31, noisy_2048,
	in_cfft_noisy_2048, ref_cfft_noisy_2048, 4096);

DEFINE_TEST_VARIANT3(transform_cq31,
	arm_cfft_q31, noisy_4096,
	in_cfft_noisy_4096, ref_cfft_noisy_4096, 8192);

DEFINE_TEST_VARIANT3(transform_cq31,
	arm_cfft_q31, step_16,
	in_cfft_step_16, ref_cfft_step_16, 32);

DEFINE_TEST_VARIANT3(transform_cq31,
	arm_cfft_q31, step_32,
	in_cfft_step_32, ref_cfft_step_32, 64);

DEFINE_TEST_VARIANT3(transform_cq31,
	arm_cfft_q31, step_64,
	in_cfft_step_64, ref_cfft_step_64, 128);

DEFINE_TEST_VARIANT3(transform_cq31,
	arm_cfft_q31, step_128,
	in_cfft_step_128, ref_cfft_step_128, 256);

DEFINE_TEST_VARIANT3(transform_cq31,
	arm_cfft_q31, step_256,
	in_cfft_step_256, ref_cfft_step_256, 512);

DEFINE_TEST_VARIANT3(transform_cq31,
	arm_cfft_q31, step_512,
	in_cfft_step_512, ref_cfft_step_512, 1024);

DEFINE_TEST_VARIANT3(transform_cq31,
	arm_cfft_q31, step_1024,
	in_cfft_step_1024, ref_cfft_step_1024, 2048);

DEFINE_TEST_VARIANT3(transform_cq31,
	arm_cfft_q31, step_2048,
	in_cfft_step_2048, ref_cfft_step_2048, 4096);

DEFINE_TEST_VARIANT3(transform_cq31,
	arm_cfft_q31, step_4096,
	in_cfft_step_4096, ref_cfft_step_4096, 8192);

static void test_arm_cifft_q31(
	int scale_factor, const q31_t *input, const q31_t *ref, size_t length)
{
	arm_cfft_instance_q31 inst;
	size_t index;
	q31_t *output, *scaled_ref;
	arm_status status;

	/* Initialise instance */
	status = arm_cfft_init_q31(&inst, length / 2);

	zassert_equal(status, ARM_MATH_SUCCESS,
		      ASSERT_MSG_INCORRECT_COMP_RESULT);

	/* Allocate buffers */
	output = malloc(length * sizeof(q31_t));
	zassert_not_null(output, ASSERT_MSG_BUFFER_ALLOC_FAILED);

	scaled_ref = malloc(length * sizeof(q31_t));
	zassert_not_null(scaled_ref, ASSERT_MSG_BUFFER_ALLOC_FAILED);

	/* Load data in place */
	memcpy(output, input, length * sizeof(q31_t));

	/* Run test function */
	arm_cfft_q31(&inst, output, true, true);

	/* Scale reference data */
	for (index = 0; index < length; index++) {
		scaled_ref[index] = ref[index] >> scale_factor;
	}

	/* Validate output */
	zassert_true(
		test_snr_error_q31(length, output, scaled_ref,
			SNR_ERROR_THRESH),
		ASSERT_MSG_SNR_LIMIT_EXCEED);

	/* Free output buffer */
	free(output);
	free(scaled_ref);
}

DEFINE_TEST_VARIANT4(transform_cq31,
	arm_cifft_q31, noisy_16, 4,
	in_cifft_noisy_16, in_cfft_noisy_16, 32);

DEFINE_TEST_VARIANT4(transform_cq31,
	arm_cifft_q31, noisy_32, 5,
	in_cifft_noisy_32, in_cfft_noisy_32, 64);

DEFINE_TEST_VARIANT4(transform_cq31,
	arm_cifft_q31, noisy_64, 6,
	in_cifft_noisy_64, in_cfft_noisy_64, 128);

DEFINE_TEST_VARIANT4(transform_cq31,
	arm_cifft_q31, noisy_128, 7,
	in_cifft_noisy_128, in_cfft_noisy_128, 256);

DEFINE_TEST_VARIANT4(transform_cq31,
	arm_cifft_q31, noisy_256, 8,
	in_cifft_noisy_256, in_cfft_noisy_256, 512);

DEFINE_TEST_VARIANT4(transform_cq31,
	arm_cifft_q31, noisy_512, 9,
	in_cifft_noisy_512, in_cfft_noisy_512, 1024);

DEFINE_TEST_VARIANT4(transform_cq31,
	arm_cifft_q31, noisy_1024, 10,
	in_cifft_noisy_1024, in_cfft_noisy_1024, 2048);

DEFINE_TEST_VARIANT4(transform_cq31,
	arm_cifft_q31, noisy_2048, 11,
	in_cifft_noisy_2048, in_cfft_noisy_2048, 4096);

DEFINE_TEST_VARIANT4(transform_cq31,
	arm_cifft_q31, noisy_4096, 12,
	in_cifft_noisy_4096, in_cfft_noisy_4096, 8192);

DEFINE_TEST_VARIANT4(transform_cq31,
	arm_cifft_q31, step_16, 4,
	in_cifft_step_16, in_cfft_step_16, 32);

DEFINE_TEST_VARIANT4(transform_cq31,
	arm_cifft_q31, step_32, 5,
	in_cifft_step_32, in_cfft_step_32, 64);

DEFINE_TEST_VARIANT4(transform_cq31,
	arm_cifft_q31, step_64, 6,
	in_cifft_step_64, in_cfft_step_64, 128);

DEFINE_TEST_VARIANT4(transform_cq31,
	arm_cifft_q31, step_128, 7,
	in_cifft_step_128, in_cfft_step_128, 256);

DEFINE_TEST_VARIANT4(transform_cq31,
	arm_cifft_q31, step_256, 8,
	in_cifft_step_256, in_cfft_step_256, 512);

DEFINE_TEST_VARIANT4(transform_cq31,
	arm_cifft_q31, step_512, 9,
	in_cifft_step_512, in_cfft_step_512, 1024);

DEFINE_TEST_VARIANT4(transform_cq31,
	arm_cifft_q31, step_1024, 10,
	in_cifft_step_1024, in_cfft_step_1024, 2048);

DEFINE_TEST_VARIANT4(transform_cq31,
	arm_cifft_q31, step_2048, 11,
	in_cifft_step_2048, in_cfft_step_2048, 4096);

DEFINE_TEST_VARIANT4(transform_cq31,
	arm_cifft_q31, step_4096, 12,
	in_cifft_step_4096, in_cfft_step_4096, 8192);

ZTEST_SUITE(transform_cq31, NULL, NULL, NULL, NULL, NULL);
```

## src/q15.c
```c
/*
 * Copyright (c) 2019 Stephanos Ioannidis <root@stephanos.io>
 * Copyright (C) 2010-2019 ARM Limited or its affiliates. All rights reserved.
 *
 * SPDX-License-Identifier: Apache-2.0
 */

#include <ztest.h>
#include <zephyr.h>
#include <stdlib.h>
#include <arm_math.h>
#include <arm_const_structs.h>
#include "../../common/test_common.h"

#include "q15.pat"

#define SNR_ERROR_THRESH    ((float32_t)5)

static void test_arm_cfft_q15(
    const arm_cfft_instance_q15 *inst,
    const q15_t *input, const q15_t *ref, size_t length)
{
    q15_t *output;

    /* Allocate output buffer */
    output = malloc(length * sizeof(q15_t));
    zassert_not_null(output, ASSERT_MSG_BUFFER_ALLOC_FAILED);

    /* Load data in place */
    memcpy(output, input, length * sizeof(q15_t));

    /* Run test function */
    arm_cfft_q15(inst, output, false, true);

    /* Validate output */
    zassert_true(
        test_snr_error_q15(length, output, ref, SNR_ERROR_THRESH),
        ASSERT_MSG_SNR_LIMIT_EXCEED);

    /* Free output buffer */
    free(output);
}

DEFINE_TEST_VARIANT4(arm_cfft_q15, noisy_16, &arm_cfft_sR_q15_len16,
    in_cfft_noisy_16, ref_cfft_noisy_16, 32);

DEFINE_TEST_VARIANT4(arm_cfft_q15, noisy_32, &arm_cfft_sR_q15_len32,
    in_cfft_noisy_32, ref_cfft_noisy_32, 64);

DEFINE_TEST_VARIANT4(arm_cfft_q15, noisy_64, &arm_cfft_sR_q15_len64,
    in_cfft_noisy_64, ref_cfft_noisy_64, 128);

DEFINE_TEST_VARIANT4(arm_cfft_q15, noisy_128, &arm_cfft_sR_q15_len128,
    in_cfft_noisy_128, ref_cfft_noisy_128, 256);

DEFINE_TEST_VARIANT4(arm_cfft_q15, noisy_256, &arm_cfft_sR_q15_len256,
    in_cfft_noisy_256, ref_cfft_noisy_256, 512);

DEFINE_TEST_VARIANT4(arm_cfft_q15, noisy_512, &arm_cfft_sR_q15_len512,
    in_cfft_noisy_512, ref_cfft_noisy_512, 1024);

DEFINE_TEST_VARIANT4(arm_cfft_q15, noisy_1024, &arm_cfft_sR_q15_len1024,
    in_cfft_noisy_1024, ref_cfft_noisy_1024, 2048);

DEFINE_TEST_VARIANT4(arm_cfft_q15, noisy_2048, &arm_cfft_sR_q15_len2048,
    in_cfft_noisy_2048, ref_cfft_noisy_2048, 4096);

DEFINE_TEST_VARIANT4(arm_cfft_q15, noisy_4096, &arm_cfft_sR_q15_len4096,
    in_cfft_noisy_4096, ref_cfft_noisy_4096, 8192);

DEFINE_TEST_VARIANT4(arm_cfft_q15, step_16, &arm_cfft_sR_q15_len16,
    in_cfft_step_16, ref_cfft_step_16, 32);

DEFINE_TEST_VARIANT4(arm_cfft_q15, step_32, &arm_cfft_sR_q15_len32,
    in_cfft_step_32, ref_cfft_step_32, 64);

DEFINE_TEST_VARIANT4(arm_cfft_q15, step_64, &arm_cfft_sR_q15_len64,
    in_cfft_step_64, ref_cfft_step_64, 128);

DEFINE_TEST_VARIANT4(arm_cfft_q15, step_128, &arm_cfft_sR_q15_len128,
    in_cfft_step_128, ref_cfft_step_128, 256);

DEFINE_TEST_VARIANT4(arm_cfft_q15, step_256, &arm_cfft_sR_q15_len256,
    in_cfft_step_256, ref_cfft_step_256, 512);

DEFINE_TEST_VARIANT4(arm_cfft_q15, step_512, &arm_cfft_sR_q15_len512,
    in_cfft_step_512, ref_cfft_step_512, 1024);

DEFINE_TEST_VARIANT4(arm_cfft_q15, step_1024, &arm_cfft_sR_q15_len1024,
    in_cfft_step_1024, ref_cfft_step_1024, 2048);

DEFINE_TEST_VARIANT4(arm_cfft_q15, step_2048, &arm_cfft_sR_q15_len2048,
    in_cfft_step_2048, ref_cfft_step_2048, 4096);

DEFINE_TEST_VARIANT4(arm_cfft_q15, step_4096, &arm_cfft_sR_q15_len4096,
    in_cfft_step_4096, ref_cfft_step_4096, 8192);

static void test_arm_cifft_q15(
    const arm_cfft_instance_q15 *inst, int scale_factor,
    const q15_t *input, const q15_t *ref, size_t length)
{
    size_t index;
    q15_t *output, *scaled_ref;

    /* Allocate buffers */
    output = malloc(length * sizeof(q15_t));
    zassert_not_null(output, ASSERT_MSG_BUFFER_ALLOC_FAILED);

    scaled_ref = malloc(length * sizeof(q15_t));
    zassert_not_null(scaled_ref, ASSERT_MSG_BUFFER_ALLOC_FAILED);

    /* Load data in place */
    memcpy(output, input, length * sizeof(q15_t));

    /* Run test function */
    arm_cfft_q15(inst, output, true, true);

    /* Scale reference data */
    for (index = 0; index < length; index++)
    {
        scaled_ref[index] = ref[index] >> scale_factor;
    }

    /* Validate output */
    zassert_true(
        test_snr_error_q15(length, output, scaled_ref, SNR_ERROR_THRESH),
        ASSERT_MSG_SNR_LIMIT_EXCEED);

    /* Free output buffer */
    free(output);
    free(scaled_ref);
}

DEFINE_TEST_VARIANT5(arm_cifft_q15, noisy_16, &arm_cfft_sR_q15_len16, 4,
    in_cifft_noisy_16, in_cfft_noisy_16, 32);

DEFINE_TEST_VARIANT5(arm_cifft_q15, noisy_32, &arm_cfft_sR_q15_len32, 5,
    in_cifft_noisy_32, in_cfft_noisy_32, 64);

DEFINE_TEST_VARIANT5(arm_cifft_q15, noisy_64, &arm_cfft_sR_q15_len64, 6,
    in_cifft_noisy_64, in_cfft_noisy_64, 128);

DEFINE_TEST_VARIANT5(arm_cifft_q15, noisy_128, &arm_cfft_sR_q15_len128, 7,
    in_cifft_noisy_128, in_cfft_noisy_128, 256);

DEFINE_TEST_VARIANT5(arm_cifft_q15, noisy_256, &arm_cfft_sR_q15_len256, 8,
    in_cifft_noisy_256, in_cfft_noisy_256, 512);

DEFINE_TEST_VARIANT5(arm_cifft_q15, noisy_512, &arm_cfft_sR_q15_len512, 9,
    in_cifft_noisy_512, in_cfft_noisy_512, 1024);

DEFINE_TEST_VARIANT5(arm_cifft_q15, noisy_1024, &arm_cfft_sR_q15_len1024, 10,
    in_cifft_noisy_1024, in_cfft_noisy_1024, 2048);

DEFINE_TEST_VARIANT5(arm_cifft_q15, noisy_2048, &arm_cfft_sR_q15_len2048, 11,
    in_cifft_noisy_2048, in_cfft_noisy_2048, 4096);

DEFINE_TEST_VARIANT5(arm_cifft_q15, noisy_4096, &arm_cfft_sR_q15_len4096, 12,
    in_cifft_noisy_4096, in_cfft_noisy_4096, 8192);

DEFINE_TEST_VARIANT5(arm_cifft_q15, step_16, &arm_cfft_sR_q15_len16, 4,
    in_cifft_step_16, in_cfft_step_16, 32);

DEFINE_TEST_VARIANT5(arm_cifft_q15, step_32, &arm_cfft_sR_q15_len32, 5,
    in_cifft_step_32, in_cfft_step_32, 64);

DEFINE_TEST_VARIANT5(arm_cifft_q15, step_64, &arm_cfft_sR_q15_len64, 6,
    in_cifft_step_64, in_cfft_step_64, 128);

DEFINE_TEST_VARIANT5(arm_cifft_q15, step_128, &arm_cfft_sR_q15_len128, 7,
    in_cifft_step_128, in_cfft_step_128, 256);

DEFINE_TEST_VARIANT5(arm_cifft_q15, step_256, &arm_cfft_sR_q15_len256, 8,
    in_cifft_step_256, in_cfft_step_256, 512);

DEFINE_TEST_VARIANT5(arm_cifft_q15, step_512, &arm_cfft_sR_q15_len512, 9,
    in_cifft_step_512, in_cfft_step_512, 1024);

DEFINE_TEST_VARIANT5(arm_cifft_q15, step_1024, &arm_cfft_sR_q15_len1024, 10,
    in_cifft_step_1024, in_cfft_step_1024, 2048);

DEFINE_TEST_VARIANT5(arm_cifft_q15, step_2048, &arm_cfft_sR_q15_len2048, 11,
    in_cifft_step_2048, in_cfft_step_2048, 4096);

DEFINE_TEST_VARIANT5(arm_cifft_q15, step_4096, &arm_cfft_sR_q15_len4096, 12,
    in_cifft_step_4096, in_cfft_step_4096, 8192);

void test_transform_q15(void)
{
    ztest_test_suite(transform_q15,
        ztest_unit_test(test_arm_cfft_q15_noisy_16),
        ztest_unit_test(test_arm_cifft_q15_noisy_16),
        ztest_unit_test(test_arm_cfft_q15_noisy_32),
        ztest_unit_test(test_arm_cifft_q15_noisy_32),
        ztest_unit_test(test_arm_cfft_q15_noisy_64),
        ztest_unit_test(test_arm_cifft_q15_noisy_64),
        ztest_unit_test(test_arm_cfft_q15_noisy_128),
        ztest_unit_test(test_arm_cifft_q15_noisy_128),
        ztest_unit_test(test_arm_cfft_q15_noisy_256),
        ztest_unit_test(test_arm_cifft_q15_noisy_256),
        ztest_unit_test(test_arm_cfft_q15_noisy_512),
        ztest_unit_test(test_arm_cifft_q15_noisy_512),
        ztest_unit_test(test_arm_cfft_q15_noisy_1024),
        ztest_unit_test(test_arm_cifft_q15_noisy_1024),
        ztest_unit_test(test_arm_cfft_q15_noisy_2048),
        ztest_unit_test(test_arm_cifft_q15_noisy_2048),
        ztest_unit_test(test_arm_cfft_q15_noisy_4096),
        ztest_unit_test(test_arm_cifft_q15_noisy_4096),
        ztest_unit_test(test_arm_cfft_q15_step_16),
        ztest_unit_test(test_arm_cifft_q15_step_16),
        ztest_unit_test(test_arm_cfft_q15_step_32),
        ztest_unit_test(test_arm_cifft_q15_step_32),
        ztest_unit_test(test_arm_cfft_q15_step_64),
        ztest_unit_test(test_arm_cifft_q15_step_64),
        ztest_unit_test(test_arm_cfft_q15_step_128),
        ztest_unit_test(test_arm_cifft_q15_step_128),
        ztest_unit_test(test_arm_cfft_q15_step_256),
        ztest_unit_test(test_arm_cifft_q15_step_256),
        ztest_unit_test(test_arm_cfft_q15_step_512),
        ztest_unit_test(test_arm_cifft_q15_step_512),
        ztest_unit_test(test_arm_cfft_q15_step_1024),
        ztest_unit_test(test_arm_cifft_q15_step_1024),
        ztest_unit_test(test_arm_cfft_q15_step_2048),
        ztest_unit_test(test_arm_cifft_q15_step_2048),
        ztest_unit_test(test_arm_cfft_q15_step_4096),
        ztest_unit_test(test_arm_cifft_q15_step_4096)
        );

    ztest_run_test_suite(transform_q15);
}
```

## src/q31.c
```c
/*
 * Copyright (c) 2019 Stephanos Ioannidis <root@stephanos.io>
 * Copyright (C) 2010-2019 ARM Limited or its affiliates. All rights reserved.
 *
 * SPDX-License-Identifier: Apache-2.0
 */

#include <ztest.h>
#include <zephyr.h>
#include <stdlib.h>
#include <arm_math.h>
#include <arm_const_structs.h>
#include "../../common/test_common.h"

#include "q31.pat"

#define SNR_ERROR_THRESH    ((float32_t)90)

static void test_arm_cfft_q31(
    const arm_cfft_instance_q31 *inst,
    const q31_t *input, const q31_t *ref, size_t length)
{
    q31_t *output;

    /* Allocate output buffer */
    output = malloc(length * sizeof(q31_t));
    zassert_not_null(output, ASSERT_MSG_BUFFER_ALLOC_FAILED);

    /* Load data in place */
    memcpy(output, input, length * sizeof(q31_t));

    /* Run test function */
    arm_cfft_q31(inst, output, false, true);

    /* Validate output */
    zassert_true(
        test_snr_error_q31(length, output, ref, SNR_ERROR_THRESH),
        ASSERT_MSG_SNR_LIMIT_EXCEED);

    /* Free output buffer */
    free(output);
}

DEFINE_TEST_VARIANT4(arm_cfft_q31, noisy_16, &arm_cfft_sR_q31_len16,
    in_cfft_noisy_16, ref_cfft_noisy_16, 32);

DEFINE_TEST_VARIANT4(arm_cfft_q31, noisy_32, &arm_cfft_sR_q31_len32,
    in_cfft_noisy_32, ref_cfft_noisy_32, 64);

DEFINE_TEST_VARIANT4(arm_cfft_q31, noisy_64, &arm_cfft_sR_q31_len64,
    in_cfft_noisy_64, ref_cfft_noisy_64, 128);

DEFINE_TEST_VARIANT4(arm_cfft_q31, noisy_128, &arm_cfft_sR_q31_len128,
    in_cfft_noisy_128, ref_cfft_noisy_128, 256);

DEFINE_TEST_VARIANT4(arm_cfft_q31, noisy_256, &arm_cfft_sR_q31_len256,
    in_cfft_noisy_256, ref_cfft_noisy_256, 512);

DEFINE_TEST_VARIANT4(arm_cfft_q31, noisy_512, &arm_cfft_sR_q31_len512,
    in_cfft_noisy_512, ref_cfft_noisy_512, 1024);

DEFINE_TEST_VARIANT4(arm_cfft_q31, noisy_1024, &arm_cfft_sR_q31_len1024,
    in_cfft_noisy_1024, ref_cfft_noisy_1024, 2048);

DEFINE_TEST_VARIANT4(arm_cfft_q31, noisy_2048, &arm_cfft_sR_q31_len2048,
    in_cfft_noisy_2048, ref_cfft_noisy_2048, 4096);

DEFINE_TEST_VARIANT4(arm_cfft_q31, noisy_4096, &arm_cfft_sR_q31_len4096,
    in_cfft_noisy_4096, ref_cfft_noisy_4096, 8192);

DEFINE_TEST_VARIANT4(arm_cfft_q31, step_16, &arm_cfft_sR_q31_len16,
    in_cfft_step_16, ref_cfft_step_16, 32);

DEFINE_TEST_VARIANT4(arm_cfft_q31, step_32, &arm_cfft_sR_q31_len32,
    in_cfft_step_32, ref_cfft_step_32, 64);

DEFINE_TEST_VARIANT4(arm_cfft_q31, step_64, &arm_cfft_sR_q31_len64,
    in_cfft_step_64, ref_cfft_step_64, 128);

DEFINE_TEST_VARIANT4(arm_cfft_q31, step_128, &arm_cfft_sR_q31_len128,
    in_cfft_step_128, ref_cfft_step_128, 256);

DEFINE_TEST_VARIANT4(arm_cfft_q31, step_256, &arm_cfft_sR_q31_len256,
    in_cfft_step_256, ref_cfft_step_256, 512);

DEFINE_TEST_VARIANT4(arm_cfft_q31, step_512, &arm_cfft_sR_q31_len512,
    in_cfft_step_512, ref_cfft_step_512, 1024);

DEFINE_TEST_VARIANT4(arm_cfft_q31, step_1024, &arm_cfft_sR_q31_len1024,
    in_cfft_step_1024, ref_cfft_step_1024, 2048);

DEFINE_TEST_VARIANT4(arm_cfft_q31, step_2048, &arm_cfft_sR_q31_len2048,
    in_cfft_step_2048, ref_cfft_step_2048, 4096);

DEFINE_TEST_VARIANT4(arm_cfft_q31, step_4096, &arm_cfft_sR_q31_len4096,
    in_cfft_step_4096, ref_cfft_step_4096, 8192);

static void test_arm_cifft_q31(
    const arm_cfft_instance_q31 *inst, int scale_factor,
    const q31_t *input, const q31_t *ref, size_t length)
{
    size_t index;
    q31_t *output, *scaled_ref;

    /* Allocate buffers */
    output = malloc(length * sizeof(q31_t));
    zassert_not_null(output, ASSERT_MSG_BUFFER_ALLOC_FAILED);

    scaled_ref = malloc(length * sizeof(q31_t));
    zassert_not_null(scaled_ref, ASSERT_MSG_BUFFER_ALLOC_FAILED);

    /* Load data in place */
    memcpy(output, input, length * sizeof(q31_t));

    /* Run test function */
    arm_cfft_q31(inst, output, true, true);

    /* Scale reference data */
    for (index = 0; index < length; index++)
    {
        scaled_ref[index] = ref[index] >> scale_factor;
    }

    /* Validate output */
    zassert_true(
        test_snr_error_q31(length, output, scaled_ref, SNR_ERROR_THRESH),
        ASSERT_MSG_SNR_LIMIT_EXCEED);

    /* Free output buffer */
    free(output);
    free(scaled_ref);
}

DEFINE_TEST_VARIANT5(arm_cifft_q31, noisy_16, &arm_cfft_sR_q31_len16, 4,
    in_cifft_noisy_16, in_cfft_noisy_16, 32);

DEFINE_TEST_VARIANT5(arm_cifft_q31, noisy_32, &arm_cfft_sR_q31_len32, 5,
    in_cifft_noisy_32, in_cfft_noisy_32, 64);

DEFINE_TEST_VARIANT5(arm_cifft_q31, noisy_64, &arm_cfft_sR_q31_len64, 6,
    in_cifft_noisy_64, in_cfft_noisy_64, 128);

DEFINE_TEST_VARIANT5(arm_cifft_q31, noisy_128, &arm_cfft_sR_q31_len128, 7,
    in_cifft_noisy_128, in_cfft_noisy_128, 256);

DEFINE_TEST_VARIANT5(arm_cifft_q31, noisy_256, &arm_cfft_sR_q31_len256, 8,
    in_cifft_noisy_256, in_cfft_noisy_256, 512);

DEFINE_TEST_VARIANT5(arm_cifft_q31, noisy_512, &arm_cfft_sR_q31_len512, 9,
    in_cifft_noisy_512, in_cfft_noisy_512, 1024);

DEFINE_TEST_VARIANT5(arm_cifft_q31, noisy_1024, &arm_cfft_sR_q31_len1024, 10,
    in_cifft_noisy_1024, in_cfft_noisy_1024, 2048);

DEFINE_TEST_VARIANT5(arm_cifft_q31, noisy_2048, &arm_cfft_sR_q31_len2048, 11,
    in_cifft_noisy_2048, in_cfft_noisy_2048, 4096);

DEFINE_TEST_VARIANT5(arm_cifft_q31, noisy_4096, &arm_cfft_sR_q31_len4096, 12,
    in_cifft_noisy_4096, in_cfft_noisy_4096, 8192);

DEFINE_TEST_VARIANT5(arm_cifft_q31, step_16, &arm_cfft_sR_q31_len16, 4,
    in_cifft_step_16, in_cfft_step_16, 32);

DEFINE_TEST_VARIANT5(arm_cifft_q31, step_32, &arm_cfft_sR_q31_len32, 5,
    in_cifft_step_32, in_cfft_step_32, 64);

DEFINE_TEST_VARIANT5(arm_cifft_q31, step_64, &arm_cfft_sR_q31_len64, 6,
    in_cifft_step_64, in_cfft_step_64, 128);

DEFINE_TEST_VARIANT5(arm_cifft_q31, step_128, &arm_cfft_sR_q31_len128, 7,
    in_cifft_step_128, in_cfft_step_128, 256);

DEFINE_TEST_VARIANT5(arm_cifft_q31, step_256, &arm_cfft_sR_q31_len256, 8,
    in_cifft_step_256, in_cfft_step_256, 512);

DEFINE_TEST_VARIANT5(arm_cifft_q31, step_512, &arm_cfft_sR_q31_len512, 9,
    in_cifft_step_512, in_cfft_step_512, 1024);

DEFINE_TEST_VARIANT5(arm_cifft_q31, step_1024, &arm_cfft_sR_q31_len1024, 10,
    in_cifft_step_1024, in_cfft_step_1024, 2048);

DEFINE_TEST_VARIANT5(arm_cifft_q31, step_2048, &arm_cfft_sR_q31_len2048, 11,
    in_cifft_step_2048, in_cfft_step_2048, 4096);

DEFINE_TEST_VARIANT5(arm_cifft_q31, step_4096, &arm_cfft_sR_q31_len4096, 12,
    in_cifft_step_4096, in_cfft_step_4096, 8192);

void test_transform_q31(void)
{
    ztest_test_suite(transform_q31,
        ztest_unit_test(test_arm_cfft_q31_noisy_16),
        ztest_unit_test(test_arm_cifft_q31_noisy_16),
        ztest_unit_test(test_arm_cfft_q31_noisy_32),
        ztest_unit_test(test_arm_cifft_q31_noisy_32),
        ztest_unit_test(test_arm_cfft_q31_noisy_64),
        ztest_unit_test(test_arm_cifft_q31_noisy_64),
        ztest_unit_test(test_arm_cfft_q31_noisy_128),
        ztest_unit_test(test_arm_cifft_q31_noisy_128),
        ztest_unit_test(test_arm_cfft_q31_noisy_256),
        ztest_unit_test(test_arm_cifft_q31_noisy_256),
        ztest_unit_test(test_arm_cfft_q31_noisy_512),
        ztest_unit_test(test_arm_cifft_q31_noisy_512),
        ztest_unit_test(test_arm_cfft_q31_noisy_1024),
        ztest_unit_test(test_arm_cifft_q31_noisy_1024),
        ztest_unit_test(test_arm_cfft_q31_noisy_2048),
        ztest_unit_test(test_arm_cifft_q31_noisy_2048),
        ztest_unit_test(test_arm_cfft_q31_noisy_4096),
        ztest_unit_test(test_arm_cifft_q31_noisy_4096),
        ztest_unit_test(test_arm_cfft_q31_step_16),
        ztest_unit_test(test_arm_cifft_q31_step_16),
        ztest_unit_test(test_arm_cfft_q31_step_32),
        ztest_unit_test(test_arm_cifft_q31_step_32),
        ztest_unit_test(test_arm_cfft_q31_step_64),
        ztest_unit_test(test_arm_cifft_q31_step_64),
        ztest_unit_test(test_arm_cfft_q31_step_128),
        ztest_unit_test(test_arm_cifft_q31_step_128),
        ztest_unit_test(test_arm_cfft_q31_step_256),
        ztest_unit_test(test_arm_cifft_q31_step_256),
        ztest_unit_test(test_arm_cfft_q31_step_512),
        ztest_unit_test(test_arm_cifft_q31_step_512),
        ztest_unit_test(test_arm_cfft_q31_step_1024),
        ztest_unit_test(test_arm_cifft_q31_step_1024),
        ztest_unit_test(test_arm_cfft_q31_step_2048),
        ztest_unit_test(test_arm_cifft_q31_step_2048),
        ztest_unit_test(test_arm_cfft_q31_step_4096),
        ztest_unit_test(test_arm_cifft_q31_step_4096)
        );

    ztest_run_test_suite(transform_q31);
}
```
