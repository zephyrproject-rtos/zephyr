## CMakeLists.txt
```
# Copyright (c) 2026 Måns Ansgariusson <mansgariusson@gmail.com>
# SPDX-License-Identifier: Apache-2.0

cmake_minimum_required(VERSION 3.20.0)
find_package(Zephyr REQUIRED HINTS $ENV{ZEPHYR_BASE})
project(memref)

target_sources(app PRIVATE
  src/test_cases.c
  src/mempool.c
  src/memslab.c
  src/sys_heap.c
)
```

## prj.conf
```kconfig
CONFIG_ZTEST=y
CONFIG_MEMREF=y
CONFIG_MEMREF_DESTROY_CB=y

CONFIG_HEAP_MEM_POOL_SIZE=1024
```

## src/mempool.c
```c
/*
 * Copyright (c) 2026, Måns Ansgariusson <mansgariusson@gmail.com>
 *
 * SPDX-License-Identifier: Apache-2.0
 */
#include <zephyr/kernel.h>

#include <zephyr/logging/log.h>
LOG_MODULE_REGISTER(memref_mempool, LOG_LEVEL_DBG);

#include "memref_testcases.h"

MEMREF_K_HEAP_DEFINE(mempool_backend, 4096);

static void *mempool_alloc(void)
{
	return memref_alloc(&mempool_backend, 64);
}

#ifdef CONFIG_MEMREF_DESTROY_CB
static void *mempool_alloc_cb(memref_destroy_cb_t destroy)
{
	return memref_alloc_with_destroy(&mempool_backend, 64, destroy);
}
#endif

MEMREF_VARLEN_TESTCASES(memref_mempool, &mempool_backend, mempool_alloc, mempool_alloc_cb);
```

## src/memref_testcases.h
```c
/*
 * Copyright (c) 2026 Måns Ansgariusson <mansgariusson@gmail.com>
 *
 * SPDX-License-Identifier: Apache-2.0
 */

#ifndef MEMREF_TESTCASES_H_
#define MEMREF_TESTCASES_H_

#include <zephyr/sys/memref.h>
#include <zephyr/ztest.h>

typedef void *(*memref_test_alloc_t)(void);

void memref_test_basic(memref_test_alloc_t alloc);
void memref_test_stress_allocs(memref_test_alloc_t alloc);
void memref_test_payload_rw(memref_test_alloc_t alloc);
void memref_test_alignment(memref_test_alloc_t alloc);
void memref_test_reuse_after_free(memref_test_alloc_t alloc);
void memref_test_independent_allocs(memref_test_alloc_t alloc);
void memref_test_unref_null(void);

void memref_test_alloc_overflow(const struct memref_backend *be);
void memref_test_zero_size_alloc(const struct memref_backend *be);
void memref_test_varied_sizes(const struct memref_backend *be);

void memref_test_exhaustion(memref_test_alloc_t alloc, size_t capacity);
void memref_test_full_reuse(memref_test_alloc_t alloc, size_t capacity);

#ifdef CONFIG_MEMREF_DESTROY_CB
typedef void *(*memref_test_alloc_cb_t)(memref_destroy_cb_t destroy);

void memref_test_destroy_called(memref_test_alloc_cb_t alloc_cb);
void memref_test_multi_owners(memref_test_alloc_cb_t alloc_cb);
void memref_test_destroy_pointer_identity(memref_test_alloc_cb_t alloc_cb);
void memref_test_ref_depth(memref_test_alloc_cb_t alloc_cb);
#endif

#ifdef CONFIG_MEMREF_DESTROY_CB
#define MEMREF_DESTROY_CB_TESTCASES(suite, alloc_cb)				\
	ZTEST(suite, test_destroy_called)					\
	{									\
		memref_test_destroy_called(alloc_cb);				\
	}									\
	ZTEST(suite, test_multi_owners)						\
	{									\
		memref_test_multi_owners(alloc_cb);				\
	}									\
	ZTEST(suite, test_destroy_pointer_identity)				\
	{									\
		memref_test_destroy_pointer_identity(alloc_cb);			\
	}									\
	ZTEST(suite, test_ref_depth)						\
	{									\
		memref_test_ref_depth(alloc_cb);				\
	}
#else
#define MEMREF_DESTROY_CB_TESTCASES(suite, alloc_cb)
#endif

#define MEMREF_TESTCASES(suite, alloc, alloc_cb)				\
	ZTEST_SUITE(suite, NULL, NULL, NULL, NULL, NULL);			\
	MEMREF_DESTROY_CB_TESTCASES(suite, alloc_cb)				\
	ZTEST(suite, test_basic)						\
	{									\
		memref_test_basic(alloc);					\
	}									\
	ZTEST(suite, test_stress_allocs)					\
	{									\
		memref_test_stress_allocs(alloc);				\
	}									\
	ZTEST(suite, test_payload_rw)						\
	{									\
		memref_test_payload_rw(alloc);					\
	}									\
	ZTEST(suite, test_alignment)						\
	{									\
		memref_test_alignment(alloc);					\
	}									\
	ZTEST(suite, test_reuse_after_free)					\
	{									\
		memref_test_reuse_after_free(alloc);				\
	}									\
	ZTEST(suite, test_independent_allocs)					\
	{									\
		memref_test_independent_allocs(alloc);				\
	}									\
	ZTEST(suite, test_unref_null)						\
	{									\
		memref_test_unref_null();					\
	}

#define MEMREF_VARLEN_TESTCASES(suite, be, alloc, alloc_cb)			\
	MEMREF_TESTCASES(suite, alloc, alloc_cb)				\
	ZTEST(suite, test_alloc_overflow)					\
	{									\
		memref_test_alloc_overflow(be);					\
	}									\
	ZTEST(suite, test_zero_size_alloc)					\
	{									\
		memref_test_zero_size_alloc(be);				\
	}									\
	ZTEST(suite, test_varied_sizes)						\
	{									\
		memref_test_varied_sizes(be);					\
	}

#define MEMREF_BLOCK_TESTCASES(suite, alloc, alloc_cb, capacity)		\
	MEMREF_TESTCASES(suite, alloc, alloc_cb)				\
	ZTEST(suite, test_exhaustion)						\
	{									\
		memref_test_exhaustion(alloc, capacity);			\
	}									\
	ZTEST(suite, test_full_reuse)						\
	{									\
		memref_test_full_reuse(alloc, capacity);			\
	}

#endif /* MEMREF_TESTCASES_H_ */
```

## src/memslab.c
```c
/*
 * Copyright (c) 2026, Måns Ansgariusson <mansgariusson@gmail.com>
 *
 * SPDX-License-Identifier: Apache-2.0
 */
#include <zephyr/kernel.h>

#include <zephyr/logging/log.h>
LOG_MODULE_REGISTER(memref_memslab, LOG_LEVEL_DBG);

#include "memref_testcases.h"

MEMREF_K_MEM_SLAB_DEFINE(memslab_backend, 128, 10, sizeof(void *));

static void *memslab_alloc(void)
{
	return memref_block_alloc(&memslab_backend);
}

#ifdef CONFIG_MEMREF_DESTROY_CB
static void *memslab_alloc_cb(memref_destroy_cb_t destroy)
{
	return memref_block_alloc_with_destroy(&memslab_backend, destroy);
}
#endif

MEMREF_BLOCK_TESTCASES(memref_memslab, memslab_alloc, memslab_alloc_cb, 10);
```

## src/sys_heap.c
```c
/*
 * Copyright (c) 2026, Måns Ansgariusson <mansgariusson@gmail.com>
 *
 * SPDX-License-Identifier: Apache-2.0
 */
#include <zephyr/kernel.h>
#include <zephyr/init.h>
#include <zephyr/sys/sys_heap.h>

#include <zephyr/logging/log.h>
LOG_MODULE_REGISTER(memref_sys_heap, LOG_LEVEL_DBG);

#include "memref_testcases.h"

#define HEAP_SIZE 4096
static uint8_t heap_mem[HEAP_SIZE];
static struct sys_heap heap;

static int sys_heap_backend_setup(void)
{
	sys_heap_init(&heap, heap_mem, HEAP_SIZE);

	return 0;
}
SYS_INIT(sys_heap_backend_setup, APPLICATION, 0);

static void *sys_heap_alloc_wrapper(void *ctx, size_t size)
{
	return sys_heap_alloc((struct sys_heap *)ctx, size);
}

static void sys_heap_free_wrapper(void *ctx, void *mem)
{
	sys_heap_free((struct sys_heap *)ctx, mem);
}

MEMREF_BACKEND_DEFINE(sys_heap_backend, sys_heap_alloc_wrapper, sys_heap_free_wrapper, &heap);

static void *sys_heap_backend_alloc(void)
{
	return memref_alloc(&sys_heap_backend, 64);
}

#ifdef CONFIG_MEMREF_DESTROY_CB
static void *sys_heap_backend_alloc_cb(memref_destroy_cb_t destroy)
{
	return memref_alloc_with_destroy(&sys_heap_backend, 64, destroy);
}
#endif

MEMREF_VARLEN_TESTCASES(memref_sys_heap, &sys_heap_backend, sys_heap_backend_alloc,
			sys_heap_backend_alloc_cb);
```

## src/test_cases.c
```c
/*
 * Copyright (c) 2026 Måns Ansgariusson <mansgariusson@gmail.com>
 *
 * SPDX-License-Identifier: Apache-2.0
 */

#include <zephyr/kernel.h>

#include "memref_testcases.h"

#define MEMREF_TEST_MAX_BLOCKS 16

void memref_test_basic(memref_test_alloc_t alloc)
{
	void *mem;

	mem = alloc();
	zassert_not_null(mem, "alloc failed");
	memref_unref(mem);
}

void memref_test_payload_rw(memref_test_alloc_t alloc)
{
	uint8_t *mem;
	const size_t len = 16;

	mem = alloc();
	zassert_not_null(mem, "alloc failed");

	for (size_t i = 0; i < len; i++) {
		mem[i] = (uint8_t)(i + 1);
	}
	for (size_t i = 0; i < len; i++) {
		zassert_equal(mem[i], (uint8_t)(i + 1), "payload corrupted at %zu", i);
	}

	memref_unref(mem);
}

void memref_test_alignment(memref_test_alloc_t alloc)
{
	void *mem;

	mem = alloc();
	zassert_not_null(mem, "alloc failed");
	zassert_equal((uintptr_t)mem % sizeof(void *), 0, "payload not aligned");
	memref_unref(mem);
}

void memref_test_reuse_after_free(memref_test_alloc_t alloc)
{
	void *first;
	void *second;

	first = alloc();
	zassert_not_null(first, "first alloc failed");
	memref_unref(first);

	second = alloc();
	zassert_not_null(second, "alloc after free failed");
	memref_unref(second);
}

void memref_test_independent_allocs(memref_test_alloc_t alloc)
{
	const size_t count = 3;
	uint32_t *mem[3];

	for (size_t i = 0; i < count; i++) {
		mem[i] = alloc();
		zassert_not_null(mem[i], "alloc %zu failed", i);
		*mem[i] = (uint32_t)(0xA5A50000u + i);
	}

	for (size_t i = 0; i < count; i++) {
		zassert_equal(*mem[i], (uint32_t)(0xA5A50000u + i),
			      "alloc %zu aliased or corrupted", i);
		memref_unref(mem[i]);
	}
}

void memref_test_unref_null(void)
{
	memref_unref(NULL);
}

void memref_test_stress_allocs(memref_test_alloc_t alloc)
{
	void *mem;
	const size_t iterations = 100;

	for (size_t i = 0; i < iterations; i++) {
		mem = alloc();
		zassert_not_null(mem, "alloc failed");
		memref_unref(mem);
	}
}

void memref_test_exhaustion(memref_test_alloc_t alloc, size_t capacity)
{
	void *mem[MEMREF_TEST_MAX_BLOCKS];

	zassert_true(capacity <= MEMREF_TEST_MAX_BLOCKS, "capacity too large for test");

	for (size_t i = 0; i < capacity; i++) {
		mem[i] = alloc();
		zassert_not_null(mem[i], "alloc %zu failed before exhaustion", i);
	}

	zassert_is_null(alloc(), "alloc succeeded past capacity");

	memref_unref(mem[0]);
	mem[0] = alloc();
	zassert_not_null(mem[0], "alloc failed after freeing a block");

	for (size_t i = 0; i < capacity; i++) {
		memref_unref(mem[i]);
	}
}

void memref_test_full_reuse(memref_test_alloc_t alloc, size_t capacity)
{
	void *mem[MEMREF_TEST_MAX_BLOCKS];

	zassert_true(capacity <= MEMREF_TEST_MAX_BLOCKS, "capacity too large for test");

	for (size_t round = 0; round < 2; round++) {
		for (size_t i = 0; i < capacity; i++) {
			mem[i] = alloc();
			zassert_not_null(mem[i], "round %zu alloc %zu failed", round, i);
		}
		for (size_t i = 0; i < capacity; i++) {
			memref_unref(mem[i]);
		}
	}
}

void memref_test_alloc_overflow(const struct memref_backend *be)
{
	zassert_is_null(memref_alloc(be, SIZE_MAX), "alloc overflow not rejected");
}

void memref_test_zero_size_alloc(const struct memref_backend *be)
{
	void *mem = memref_alloc(be, 0);

	zassert_true(mem == NULL, "zero size alloc should result in no-alloc");
}

void memref_test_varied_sizes(const struct memref_backend *be)
{
	const size_t sizes[] = {1, 7, 31, 64, 200};

	for (size_t i = 0; i < ARRAY_SIZE(sizes); i++) {
		uint8_t *mem = memref_alloc(be, sizes[i]);

		zassert_not_null(mem, "alloc of %zu failed", sizes[i]);
		for (size_t j = 0; j < sizes[i]; j++) {
			mem[j] = (uint8_t)j;
		}
		for (size_t j = 0; j < sizes[i]; j++) {
			zassert_equal(mem[j], (uint8_t)j, "corrupted at %zu", j);
		}
		memref_unref(mem);
	}
}

#ifdef CONFIG_MEMREF_DESTROY_CB
struct container {
	struct k_sem *sem;
};

static void container_destroy(void *ptr)
{
	struct container *mem = ptr;

	k_sem_give(mem->sem);
}

static void *destroyed_ptr;

static void record_destroy(void *ptr)
{
	destroyed_ptr = ptr;
}

static int destroy_count;

static void count_destroy(void *ptr)
{
	ARG_UNUSED(ptr);

	destroy_count++;
}

void memref_test_destroy_called(memref_test_alloc_cb_t alloc_cb)
{
	struct container *mem;
	struct k_sem sem;

	k_sem_init(&sem, 0, 1);

	mem = alloc_cb(container_destroy);
	zassert_not_null(mem, "alloc_cb failed");
	mem->sem = &sem;
	memref_unref(mem);
	zassert_ok(k_sem_take(&sem, K_MSEC(100)), "destroy not called");
}

void memref_test_multi_owners(memref_test_alloc_cb_t alloc_cb)
{
	struct container *mem;
	struct k_sem sem;

	k_sem_init(&sem, 0, 1);

	mem = alloc_cb(container_destroy);
	zassert_not_null(mem, "alloc_cb failed");
	mem->sem = &sem;
	memref_ref(mem);
	memref_unref(mem);
	zassert_not_equal(k_sem_take(&sem, K_MSEC(100)), 0,
			  "destroy called when refcount > 0");
	memref_unref(mem);
	zassert_ok(k_sem_take(&sem, K_MSEC(100)), "destroy not called");
}

void memref_test_destroy_pointer_identity(memref_test_alloc_cb_t alloc_cb)
{
	void *mem;

	destroyed_ptr = NULL;
	mem = alloc_cb(record_destroy);
	zassert_not_null(mem, "alloc_cb failed");
	memref_unref(mem);
	zassert_equal(destroyed_ptr, mem, "destroy received a different pointer");
}

void memref_test_ref_depth(memref_test_alloc_cb_t alloc_cb)
{
	const int depth = 5;
	void *mem;

	destroy_count = 0;
	mem = alloc_cb(count_destroy);
	zassert_not_null(mem, "alloc_cb failed");

	for (int i = 0; i < depth; i++) {
		memref_ref(mem);
	}
	for (int i = 0; i < depth; i++) {
		memref_unref(mem);
		zassert_equal(destroy_count, 0, "destroy called while refs remain");
	}

	memref_unref(mem);
	zassert_equal(destroy_count, 1, "destroy not called exactly once");
}
#endif
```
