## CMakeLists.txt
```
# Copyright (c) 2022 Meta
#
# SPDX-License-Identifier: Apache-2.0

cmake_minimum_required(VERSION 3.28.0)
find_package(Zephyr REQUIRED HINTS $ENV{ZEPHYR_BASE})
project(hash_map)

FILE(GLOB app_sources src/*.c)
target_sources(app PRIVATE ${app_sources})
```

## Kconfig
```
# Copyright (c) 2022 Meta
#
# SPDX-License-Identifier: Apache-2.0

config TEST_LIB_HASH_MAP_MAX_ENTRIES
	int "Maximum number of Hashmap entries"
	default 40
	help
	  When benchmarking the performance of the Hashmap, it helps to be able
	  to vary the number of entries to insert or remove from the hash table
	  in a convenient way. This option translates to MANY in the test sources.

	  CONFIG_TEST_LIB_HASH_MAP_MAX_ENTRIES

	  Of course, using realloc(), we are limited by the amount of available
	  heap memory. For test scenarios using the Minimal C library, the heap
	  size is controlled via

	  CONFIG_COMMON_LIBC_MALLOC_ARENA_SIZE

	  For native_sim, the number of entries can be configured
	  independently of the arena size since the native libc is used.

source "Kconfig.zephyr"
```

## prj.conf
```kconfig
# Copyright (c) 2022 Meta
#
# SPDX-License-Identifier: Apache-2.0

CONFIG_ZTEST=y

CONFIG_SYS_HASH_FUNC32=y
CONFIG_SYS_HASH_MAP=y

CONFIG_BASE64=y

CONFIG_TEST_LIB_HASH_MAP_MAX_ENTRIES=40
```

## src/_main.c
```c
/*
 * Copyright (c) 2022 Meta
 *
 * SPDX-License-Identifier: Apache-2.0
 */

#include <stdlib.h>

#include <zephyr/ztest.h>
#include <zephyr/sys/hash_map.h>

#include "_main.h"

SYS_HASHMAP_DEFINE(map);
SYS_HASHMAP_DEFAULT_DEFINE_ADVANCED(custom_load_factor_map, sys_hash32, realloc,
				    SYS_HASHMAP_CONFIG(SIZE_MAX, CUSTOM_LOAD_FACTOR));

static void *setup(void)
{
	printk("CONFIG_TEST_LIB_HASH_MAP_MAX_ENTRIES: %u\n", CONFIG_TEST_LIB_HASH_MAP_MAX_ENTRIES);

	return NULL;
}

static void after(void *arg)
{
	ARG_UNUSED(arg);

	(void)sys_hashmap_clear(&map, NULL, NULL);
	(void)sys_hashmap_clear(&custom_load_factor_map, NULL, NULL);
}

ZTEST_SUITE(hash_map, NULL, setup, NULL, after, NULL);
```

## src/_main.h
```c
/*
 * Copyright (c) 2022 Meta
 *
 * SPDX-License-Identifier: Apache-2.0
 */

#ifndef ZEPHYR_TESTS_LIB_HASH_MAP_SRC_MAIN_H_
#define ZEPHYR_TESTS_LIB_HASH_MAP_SRC_MAIN_H_

#include <zephyr/sys/hash_map.h>

#define MANY		   CONFIG_TEST_LIB_HASH_MAP_MAX_ENTRIES
#define CUSTOM_LOAD_FACTOR 42

extern struct sys_hashmap map;
extern struct sys_hashmap custom_load_factor_map;

#endif
```

## src/capacity.c
```c
/*
 * SPDX-FileCopyrightText: Copyright The Zephyr Project Contributors
 * SPDX-License-Identifier: Apache-2.0
 */

#include <errno.h>

#include <zephyr/sys/hash_map.h>
#include <zephyr/ztest.h>

static void check_capacity(struct sys_hashmap *map)
{
	const size_t limit = map->config->max_size;
	uint64_t old_value = 0;
	uint64_t value = 0;
	int fill_ret = 1;
	int replace_ret = 0;
	int ret;
	size_t size;
	bool found = false;
	bool extra_present;

	for (size_t i = 0; i < limit; ++i) {
		ret = sys_hashmap_insert(map, i, i + 10, NULL);
		if (ret != 1) {
			fill_ret = ret;
		}
	}
	if (limit > 0) {
		replace_ret = sys_hashmap_insert(map, 0, 99, &old_value);
	}
	ret = sys_hashmap_insert(map, 42, 42, NULL);
	size = sys_hashmap_size(map);
	extra_present = sys_hashmap_contains_key(map, 42);
	if (limit > 0) {
		found = sys_hashmap_get(map, 0, &value);
	}
	sys_hashmap_clear(map, NULL, NULL);

	zassert_equal(fill_ret, 1);
	zassert_equal(ret, -ENOSPC);
	zassert_equal(size, limit);
	zassert_false(extra_present);
	if (limit > 0) {
		zassert_equal(replace_ret, 0);
		zassert_equal(old_value, 10);
		zassert_true(found);
		zassert_equal(value, 99);
	}
}

ZTEST(hash_map, test_capacity_zero)
{
	SYS_HASHMAP_DEFAULT_DEFINE_STATIC_ADVANCED(
		bounded, sys_hash32, SYS_HASHMAP_DEFAULT_ALLOCATOR,
		SYS_HASHMAP_CONFIG(0, SYS_HASHMAP_DEFAULT_LOAD_FACTOR));

	check_capacity(&bounded);
}

ZTEST(hash_map, test_capacity_one)
{
	SYS_HASHMAP_DEFAULT_DEFINE_STATIC_ADVANCED(
		bounded, sys_hash32, SYS_HASHMAP_DEFAULT_ALLOCATOR,
		SYS_HASHMAP_CONFIG(1, SYS_HASHMAP_DEFAULT_LOAD_FACTOR));

	check_capacity(&bounded);
}

ZTEST(hash_map, test_capacity_two)
{
	SYS_HASHMAP_DEFAULT_DEFINE_STATIC_ADVANCED(
		bounded, sys_hash32, SYS_HASHMAP_DEFAULT_ALLOCATOR,
		SYS_HASHMAP_CONFIG(2, SYS_HASHMAP_DEFAULT_LOAD_FACTOR));

	check_capacity(&bounded);
}
```

## src/clear.c
```c
/*
 * Copyright (c) 2022 Meta
 *
 * SPDX-License-Identifier: Apache-2.0
 */

#include <zephyr/ztest.h>
#include <zephyr/sys/hash_map.h>

#include "_main.h"

ZTEST(hash_map, test_clear_no_callback)
{
	const size_t N = 10;
	BUILD_ASSERT(N <= MANY, "N has to be <= than MANY to"
							 " be able to use preallocated string keys");

	zassert_true(sys_hashmap_is_empty(&map));

	for (size_t i = 0; i < N; ++i) {
		zassert_equal(1, INSERT_FUNC(&map, i, i, NULL, NULL));
	}

	zassert_equal(N, sys_hashmap_size(&map));

	sys_hashmap_clear(&map, NULL, NULL);
	zassert_true(sys_hashmap_is_empty(&map));
}

#ifdef CONFIG_TEST_USE_CUSTOM_EQ_FUNC
static void clear_callback(char *key, uint64_t value, void *cookie)
{
	bool *cleared = (bool *)cookie;
	uint64_t uint_key = get_key_index(key);

	zassert_true(uint_key < 10);
	cleared[uint_key] = true;
}
#else
static void clear_callback(uint64_t key, uint64_t value, void *cookie)
{
	bool *cleared = (bool *)cookie;

	zassert_true(key < 10);
	cleared[key] = true;
}
#endif

ZTEST(hash_map, test_clear_callback)
{
	bool cleared[10] = {0};
	BUILD_ASSERT(ARRAY_SIZE(cleared) <= MANY, "the size has to be <= than MANY"
							 " to be able to use preallocated string keys");

	zassert_true(sys_hashmap_is_empty(&map));

	for (size_t i = 0; i < ARRAY_SIZE(cleared); ++i) {
		zassert_equal(1, INSERT_FUNC(&map, i, i, NULL, NULL));
	}

	zassert_equal(ARRAY_SIZE(cleared), sys_hashmap_size(&map));

	CLEAR_FUNC_NAME(&map, clear_callback, cleared);
	zassert_true(sys_hashmap_is_empty(&map));

	for (size_t i = 0; i < ARRAY_SIZE(cleared); ++i) {
		zassert_true(cleared[i], "entry " KEY_FORMAT " was not cleared", GET_KEY(i + 1));
	}
}
```

## src/empty.c
```c
/*
 * Copyright (c) 2022 Meta
 *
 * SPDX-License-Identifier: Apache-2.0
 */

#include <stdlib.h>

#include <zephyr/ztest.h>
#include <zephyr/sys/hash_map.h>

#include "_main.h"

ZTEST(hash_map, test_empty)
{
	/* test size 0 */
	zassert_true(sys_hashmap_is_empty(&map));

	/* test size 1 */
	zassume_equal(1, sys_hashmap_insert(&map, 1, 1, NULL));
	zassert_false(sys_hashmap_is_empty(&map));
}
```

## src/foreach.c
```c
/*
 * Copyright (c) 2022 Meta
 *
 * SPDX-License-Identifier: Apache-2.0
 */

#include <zephyr/ztest.h>
#include <zephyr/sys/hash_map.h>

#include "_main.h"

static void foreach_callback(uint64_t key, uint64_t value, void *cookie)
{
	bool *called = (bool *)cookie;

	zassert_true(key < 10);
	called[key] = true;
}

ZTEST(hash_map, test_foreach)
{
	bool called[10] = {0};

	zassert_true(sys_hashmap_is_empty(&map));

	for (size_t i = 0; i < ARRAY_SIZE(called); ++i) {
		zassert_equal(1, sys_hashmap_insert(&map, i, i, NULL));
	}

	zassert_equal(ARRAY_SIZE(called), sys_hashmap_size(&map));

	sys_hashmap_foreach(&map, foreach_callback, called);
	for (size_t i = 0; i < ARRAY_SIZE(called); ++i) {
		zassert_true(called[i], "entry %zu was not called", i + 1);
	}
}
```

## src/get.c
```c
/*
 * Copyright (c) 2022 Meta
 *
 * SPDX-License-Identifier: Apache-2.0
 */

#include <zephyr/ztest.h>
#include <zephyr/sys/hash_map.h>

#include "_main.h"

ZTEST(hash_map, test_get_true)
{
	int ret;
	uint64_t value = 0x42;

	zassert_true(sys_hashmap_is_empty(&map));
	zassert_equal(1, sys_hashmap_insert(&map, 0, 0, NULL));
	zassert_true(sys_hashmap_get(&map, 0, NULL));
	zassert_true(sys_hashmap_get(&map, 0, &value));
	zassert_equal(0, value);

	for (size_t i = 1; i < MANY; ++i) {
		ret = sys_hashmap_insert(&map, i, i, NULL);
		zassert_equal(1, ret, "failed to insert (%zu, %zu): %d", i, i, ret);
	}

	for (size_t i = 0; i < MANY; ++i) {
		zassert_true(sys_hashmap_get(&map, i, NULL));
	}
}

ZTEST(hash_map, test_get_false)
{
	int ret;
	uint64_t value = 0x42;

	zassert_true(sys_hashmap_is_empty(&map));

	zassert_false(sys_hashmap_get(&map, 73, &value));
	zassert_equal(value, 0x42);

	for (size_t i = 0; i < MANY; ++i) {
		ret = sys_hashmap_insert(&map, i, i, NULL);
		zassert_equal(1, ret, "failed to insert (%zu, %zu): %d", i, i, ret);
	}

	zassert_false(sys_hashmap_get(&map, 0x4242424242424242ULL, NULL));
}
```

## src/insert.c
```c
/*
 * Copyright (c) 2022 Meta
 *
 * SPDX-License-Identifier: Apache-2.0
 */

#include <errno.h>
#include <stdlib.h>

#include <zephyr/ztest.h>
#include <zephyr/sys/hash_map.h>

#include "_main.h"

ZTEST(hash_map, test_insert_no_replacement)
{
	zassert_true(sys_hashmap_is_empty(&map));

	zassert_equal(1, sys_hashmap_insert(&map, 1, 1, NULL));
	zassert_equal(1, sys_hashmap_size(&map));
	zassert_true(sys_hashmap_contains_key(&map, 1));

	zassert_equal(1, sys_hashmap_insert(&map, 2, 2, NULL));
	zassert_equal(2, sys_hashmap_size(&map));
	zassert_true(sys_hashmap_contains_key(&map, 2));
}

ZTEST(hash_map, test_insert_replacement)
{
	uint64_t old_value;

	zassert_true(sys_hashmap_is_empty(&map));

	zassert_equal(1, sys_hashmap_insert(&map, 1, 1, NULL));
	zassert_equal(1, sys_hashmap_size(&map));
	zassert_true(sys_hashmap_contains_key(&map, 1));

	old_value = 0x42;
	zassert_equal(0, sys_hashmap_insert(&map, 1, 2, &old_value));
	zassert_equal(1, old_value);
	zassert_equal(1, sys_hashmap_size(&map));
	zassert_true(sys_hashmap_contains_key(&map, 1));
}

ZTEST(hash_map, test_insert_many)
{
	int ret;

	zassert_true(sys_hashmap_is_empty(&map));

	for (size_t i = 0; i < MANY; ++i) {
		ret = sys_hashmap_insert(&map, i, i, NULL);
		zassert_equal(1, ret, "failed to insert (%zu, %zu): %d", i, i, ret);
		zassert_equal(i + 1, sys_hashmap_size(&map));
	}

	for (size_t i = 0; i < MANY; ++i) {
		zassert_true(sys_hashmap_contains_key(&map, i));
	}
}

static void *fail_entry_alloc(void *ptr, size_t size)
{
	/* Allow bucket allocation and resizing, but reject new entries. */
	if (ptr == NULL && size != 0 && map.data->buckets != NULL) {
		return NULL;
	}

	return sys_hashmap_default_allocator(ptr, size);
}

ZTEST(hash_map, test_insert_entry_alloc_failure)
{
	sys_hashmap_allocator_t alloc_func = map.alloc_func;
	uint64_t value;
	int ret;

	if (!IS_ENABLED(CONFIG_SYS_HASH_MAP_CHOICE_SC)) {
		ztest_test_skip();
	}

	map.alloc_func = fail_entry_alloc;
	ret = sys_hashmap_insert(&map, 1, 42, NULL);
	map.alloc_func = alloc_func;

	zassert_equal(ret, -ENOMEM);
	zassert_true(sys_hashmap_is_empty(&map));
	zassert_is_null(map.data->buckets);
	zassert_equal(map.data->n_buckets, 0);
	zassert_false(sys_hashmap_get(&map, 1, NULL));
	zassert_false(sys_hashmap_remove(&map, 1, NULL));
	zassert_equal(sys_hashmap_insert(&map, 1, 42, NULL), 1);

	map.alloc_func = fail_entry_alloc;
	ret = sys_hashmap_insert(&map, 2, 84, NULL);
	map.alloc_func = alloc_func;

	zassert_equal(ret, -ENOMEM);
	zassert_equal(sys_hashmap_size(&map), 1);
	zassert_true(sys_hashmap_get(&map, 1, &value));
	zassert_equal(value, 42);
	zassert_false(sys_hashmap_contains_key(&map, 2));
}
```

## src/load_factor.c
```c
/*
 * Copyright (c) 2022 Meta
 *
 * SPDX-License-Identifier: Apache-2.0
 */

#include <zephyr/ztest.h>
#include <zephyr/sys/hash_map.h>

#include "_main.h"

ZTEST(hash_map, test_load_factor_default)
{
	int ret;
	uint32_t load_factor;

	zassert_true(sys_hashmap_is_empty(&map));
	zassert_equal(0, sys_hashmap_load_factor(&map));

	for (size_t i = 0; i < MANY; ++i) {
		ret = INSERT_FUNC(&map, i, i, NULL, NULL);
		zassert_equal(1, ret, "failed to insert (%zu, %zu): %d", i, i, ret);
		load_factor = sys_hashmap_load_factor(&map);
		zassert_true(load_factor > 0 && load_factor <= SYS_HASHMAP_DEFAULT_LOAD_FACTOR);
	}

	for (size_t i = MANY; i > 0; --i) {
		zassert_equal(true, REMOVE_FUNC(&map, i - 1, NULL, NULL));
		load_factor = sys_hashmap_load_factor(&map);
		zassert_true(load_factor <= SYS_HASHMAP_DEFAULT_LOAD_FACTOR);
	}
}

ZTEST(hash_map, test_load_factor_custom)
{
	int ret;
	uint32_t load_factor;
	struct sys_hashmap *const hmap = &custom_load_factor_map;

	zassert_equal(hmap->config->load_factor, CUSTOM_LOAD_FACTOR);

	zassert_true(sys_hashmap_is_empty(hmap));
	zassert_equal(0, sys_hashmap_load_factor(hmap));

	for (size_t i = 0; i < MANY; ++i) {
		ret = INSERT_FUNC(hmap, i, i, NULL, NULL);
		zassert_equal(1, ret, "failed to insert (%zu, %zu): %d", i, i, ret);
		load_factor = sys_hashmap_load_factor(hmap);
		zassert_true(load_factor > 0 && load_factor <= CUSTOM_LOAD_FACTOR);
	}

	for (size_t i = MANY; i > 0; --i) {
		zassert_equal(true, REMOVE_FUNC(hmap, i - 1, NULL, NULL));
		load_factor = sys_hashmap_load_factor(hmap);
		zassert_true(load_factor <= CUSTOM_LOAD_FACTOR);
	}
}
```

## src/remove.c
```c
/*
 * Copyright (c) 2022 Meta
 *
 * SPDX-License-Identifier: Apache-2.0
 */

#include <zephyr/ztest.h>
#include <zephyr/sys/hash_map.h>

#include "_main.h"

ZTEST(hash_map, test_remove_true)
{
	int ret;

	for (size_t i = 0; i < MANY; ++i) {
		ret = sys_hashmap_insert(&map, i, i, NULL);
		zassert_equal(1, ret, "failed to insert (%zu, %zu): %d", i, i, ret);
		zassert_equal(i + 1, sys_hashmap_size(&map));
	}

	for (size_t i = MANY; i > 0; --i) {
		zassert_equal(true, sys_hashmap_remove(&map, i - 1, NULL));
		zassert_equal(i - 1, sys_hashmap_size(&map));
	}

	/* after removing the last node, buckets should also be freed */
	zassert_equal(map.data->buckets, NULL);
	zassert_equal(map.data->n_buckets, 0);
}

ZTEST(hash_map, test_remove_false)
{
	zassert_true(sys_hashmap_is_empty(&map));
	zassert_false(sys_hashmap_remove(&map, 42, NULL));

	zassert_equal(1, sys_hashmap_insert(&map, 1, 1, NULL));
	zassert_false(sys_hashmap_remove(&map, 42, NULL));
}

ZTEST(hash_map, test_remove_entry)
{
	uint64_t entry = 0xF00DF00DF00DF00DU;
	uint64_t old_value;

	/* Fill hashmap so that the rehashing condition is not always met when running the test */
	for (size_t i = 0; i < 20; ++i) {
		zassert_false(sys_hashmap_insert(&map, i, i, NULL) < 0);
	}

	/* Remove key 16, expecting its entry to be erased */
	old_value = 0;
	zassert_true(sys_hashmap_remove(&map, 16, &old_value));
	zassert_equal(16, old_value);

	/* Insert an entry at key 16, expecting no old entry to be returned */
	old_value = 0;
	zassert_equal(1, sys_hashmap_insert(&map, 16, entry, &old_value));
	zassert_equal(0, old_value);
}
```

## src/size.c
```c
/*
 * Copyright (c) 2022 Meta
 *
 * SPDX-License-Identifier: Apache-2.0
 */

#include <zephyr/ztest.h>
#include <zephyr/sys/hash_map.h>

#include "_main.h"

ZTEST(hash_map, test_size)
{
	zassert_equal(0, sys_hashmap_size(&map));

	zassume_equal(1, sys_hashmap_insert(&map, 1, 1, NULL));
	zassert_equal(1, sys_hashmap_size(&map));

	zassume_equal(1, sys_hashmap_insert(&map, 2, 2, NULL));
	zassert_equal(2, sys_hashmap_size(&map));
}
```

## src/string_cmp.c
```c
/*
 * Copyright (c) 2025 SecoMind
 *
 * SPDX-License-Identifier: Apache-2.0
 */

#include "_main.h"

#include <zephyr/sys/base64.h>
#include <zephyr/sys/hash_map.h>

#include <string.h>

uint32_t hash_string(const void *uint64_ptr_key, size_t len)
{
	__ASSERT(len == sizeof(uint64_t),
		 "Received an invalid length for the hasmap key, expected only uint64_t");

	uint64_t key_pointer = {0};

	memcpy(&key_pointer, uint64_ptr_key, sizeof(uint64_t));

	const char *key_string = UINT_TO_POINTER(key_pointer);
	size_t key_string_len = strlen(key_string);

	return sys_hash32(key_string, key_string_len);
}

bool eq_string(uint64_t key_left, uint64_t key_right)
{
	if (key_left == key_right) {
		return true;
	} else if (key_left == 0 || key_right == 0) {
		return false;
	}

	const char *key_left_string = UINT_TO_POINTER(key_left);
	const char *key_right_string = UINT_TO_POINTER(key_right);

	return strcmp(key_left_string, key_right_string) == 0;
}
```
