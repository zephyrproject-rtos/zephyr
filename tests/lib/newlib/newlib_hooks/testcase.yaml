## tests/lib/newlib/newlib_hooks/testcase.yaml
```yaml
tests:
  libraries.libc.newlib.posix.hooks:
    tags: clib newlib ignore_faults
    filter: TOOLCHAIN_HAS_NEWLIB == 1
    extra_configs:
      - CONFIG_POSIX_API=y
  libraries.libc.newlib.no.posix.config:
    tags: clib newlib ignore_faults
    filter: TOOLCHAIN_HAS_NEWLIB == 1
```

## tests/lib/newlib/thread_safety/Kconfig
```kconfig
# Copyright (c) 2021 Stephanos Ioannidis <root@stephanos.io>
# SPDX-License-Identifier: Apache-2.0

config NEWLIB_THREAD_SAFETY_TEST_LOCKS
	bool "Test: Locks"
	default y

config NEWLIB_THREAD_SAFETY_TEST_STRESS
	bool "Test: Stress"

source "Kconfig"
```

## tests/lib/newlib/thread_safety/boards/acrn_ehl_crb.conf
```kconfig
# The kobject hash table is significantly larger when
# compiled with Zephyr SDK 0.16.1. So we need to enlarge
# the kobject rodata data area to accommodate that.
# Note this is just a workaround until we figure out
# what is going on with the SDK.
CONFIG_KOBJECT_RODATA_AREA_EXTRA_BYTES=256
```

## tests/lib/newlib/thread_safety/testcase.yaml
```yaml
common:
  filter: TOOLCHAIN_HAS_NEWLIB == 1
  arch_exclude: posix
  tags:
    - clib
    - newlib
  integration_platforms:
    - mps2/an521/cpu0
    - qemu_x86
tests:
  libraries.libc.newlib.thread_safety:
    min_ram: 64
  libraries.libc.newlib.thread_safety.stress:
    extra_configs:
      - CONFIG_NEWLIB_THREAD_SAFETY_TEST_STRESS=y
    slow: true
    min_ram: 192
  libraries.libc.newlib.thread_safety.userspace:
    extra_args: CONF_FILE=prj_userspace.conf
    filter: CONFIG_ARCH_HAS_USERSPACE
    tags:
      - userspace
    min_ram: 64
  libraries.libc.newlib.thread_safety.userspace.stress:
    extra_args: CONF_FILE=prj_userspace.conf
    extra_configs:
      - CONFIG_NEWLIB_THREAD_SAFETY_TEST_STRESS=y
      - CONFIG_NEWLIB_LIBC_ALIGNED_HEAP_SIZE=8192
    filter: CONFIG_ARCH_HAS_USERSPACE
    slow: true
    tags:
      - userspace
    min_ram: 192
    timeout: 120
    platform_exclude: acrn_ehl_crb  # See #61129
  libraries.libc.newlib_nano.thread_safety:
    extra_configs:
      - CONFIG_NEWLIB_LIBC_NANO=y
    filter: CONFIG_HAS_NEWLIB_LIBC_NANO
    min_ram: 64
  libraries.libc.newlib_nano.thread_safety.stress:
    extra_configs:
      - CONFIG_NEWLIB_THREAD_SAFETY_TEST_STRESS=y
      - CONFIG_NEWLIB_LIBC_NANO=y
    filter: CONFIG_HAS_NEWLIB_LIBC_NANO
    slow: true
    min_ram: 192
  libraries.libc.newlib_nano.thread_safety.userspace:
    extra_args: CONF_FILE=prj_userspace.conf
    extra_configs:
      - CONFIG_NEWLIB_LIBC_NANO=y
    filter: CONFIG_ARCH_HAS_USERSPACE and CONFIG_HAS_NEWLIB_LIBC_NANO
    tags:
      - userspace
    min_ram: 64
  libraries.libc.newlib_nano.thread_safety.userspace.stress:
    extra_args: CONF_FILE=prj_userspace.conf
    extra_configs:
      - CONFIG_NEWLIB_THREAD_SAFETY_TEST_STRESS=y
      - CONFIG_NEWLIB_LIBC_NANO=y
      - CONFIG_NEWLIB_LIBC_ALIGNED_HEAP_SIZE=2048
    filter: CONFIG_ARCH_HAS_USERSPACE and CONFIG_HAS_NEWLIB_LIBC_NANO
    slow: true
    tags:
      - userspace
    min_ram: 192
    timeout: 120
    platform_exclude: acrn_ehl_crb  # See #61129
```

## tests/lib/notify/testcase.yaml
```yaml
tests:
  libraries.data_structures:
    tags: notify
    integration_platforms:
      - native_posix
```

## tests/lib/onoff/testcase.yaml
```yaml
tests:
  libraries.onoff:
    tags:
      - onoff
      - timer
    integration_platforms:
      - native_sim
```

## tests/lib/p4workq/testcase.yaml
```yaml
tests:
  libraries.p4wq:
    tags:
      - kernel
    integration_platforms:
      - qemu_x86/atom
      - native_sim/native
```

## tests/lib/pid/testcase.yaml
```yaml
# Copyright (c) 2026 Contributors to the Zephyr Project
# SPDX-License-Identifier: Apache-2.0

tests:
  libraries.pid:
    tags:
      - pid
      - utilities
    platform_allow:
      - native_sim
```

## tests/lib/pixel/convert/testcase.yaml
```yaml
tests:
  libraries.pixel.convert:
    tags:
      - pixel
    integration_platforms:
      - qemu_cortex_m3
      - native_sim
    extra_configs:
      - CONFIG_PIXEL_PRINT_NONE=y
```

## tests/lib/pixel/testcase.yaml
```yaml
tests:
  libraries.pixel:
    tags:
      - pixel
    integration_platforms:
      - qemu_cortex_m3
      - native_sim
```

## tests/lib/predef_heap/testcase.yaml
```yaml
tests:
  lib.mem_blocks:
    tags: heap predef_heap
    timeout: 480
    integration_platforms:
      - native_posix
      - native_posix_64
```

## tests/lib/rbtree/testcase.yaml
```yaml
tests:
  libraries.data_structures.rbtree:
    tags: rbtree
    filter: not CONFIG_MISRA_SANE
    platform_exclude: qemu_riscv64
```

## tests/lib/ring_buffer/testcase.yaml
```yaml
common:
  tags:
    - ring_buffer
    - circular_buffer
  timeout: 150

tests:
  libraries.ring_buffer:
    integration_platforms:
      - native_sim
      - native_sim/native/64
```

## tests/lib/ringbuffer/Kconfig
```kconfig
# Copyright (c) 2020 Nordic Semiconductor ASA
# SPDX-License-Identifier: Apache-2.0

config RING_BUFFER_TEST
	bool
	default y

source "Kconfig.zephyr"
```

## tests/lib/ringbuffer/testcase.yaml
```yaml
common:
  tags:
    - ring_buffer
    - circular_buffer
  timeout: 150

tests:
  libraries.ring_buffer:
    platform_allow:
      - qemu_x86
    integration_platforms:
      - qemu_x86

  libraries.ring_buffer.large:
    platform_allow:
      - qemu_x86
    integration_platforms:
      - qemu_x86
    extra_configs:
      - CONFIG_RING_BUFFER_LARGE=y

  libraries.ring_buffer.concurrent:
    platform_allow: qemu_x86
    integration_platforms:
      - qemu_x86
    extra_configs:
      - CONFIG_SYS_CLOCK_TICKS_PER_SEC=100000

  libraries.ring_buffer.benchmark:
    platform_allow: qemu_x86
    integration_platforms:
      - qemu_x86
    extra_configs:
      - CONFIG_ZTEST_BENCHMARK=y

  libraries.ring_buffer.benchmark.large:
    platform_allow: qemu_x86
    integration_platforms:
      - qemu_x86
    extra_configs:
      - CONFIG_ZTEST_BENCHMARK=y
      - CONFIG_RING_BUFFER_LARGE=y
```

## tests/lib/rust/time/testcase.yaml
```yaml
common:
  filter: CONFIG_RUST_SUPPORTED
tests:
  test.rust.time:
    harness: console
    harness_config:
      type: one_line
      regex:
        - "All tests passed"
```

## tests/lib/shared_multi_heap/boards/qemu_cortex_a53.conf
```kconfig
CONFIG_HAVE_CUSTOM_LINKER_SCRIPT=y
CONFIG_CUSTOM_LINKER_SCRIPT="linker_arm64_shared_pool.ld"
```

## tests/lib/shared_multi_heap/testcase.yaml
```yaml
# Copyright 2021 Carlo Caione <ccaione@baylibre.com>
# SPDX-License-Identifier: Apache-2.0

tests:
  libraries.shared_multi_heap:
    platform_allow:
      - qemu_cortex_a53
      - mps2/an521/cpu0
    integration_platforms:
      - qemu_cortex_a53
    tags:
      - kernel
      - multi_heap
    harness: ztest
```

## tests/lib/smf/testcase.yaml
```yaml
common:
  integration_platforms:
    - native_sim
  tags:
    - smf
tests:
  libraries.smf.flat: {}
  libraries.smf.hierarchical:
    extra_configs:
      - CONFIG_SMF_ANCESTOR_SUPPORT=y
  libraries.smf.initial_transition:
    extra_configs:
      - CONFIG_SMF_ANCESTOR_SUPPORT=y
      - CONFIG_SMF_INITIAL_TRANSITION=y
```

## tests/lib/sprintf/testcase.yaml
```yaml
common:
  tags:
    - libc
tests:
  libraries.libc.sprintf:
    extra_args: CONF_FILE=prj.conf
    filter: not CONFIG_SOC_MCIMX7D_M4 and CONFIG_STDOUT_CONSOLE
    integration_platforms:
      - qemu_x86
    arch_exclude: posix
    ignore_faults: true
  libraries.libc.sprintf_new:
    extra_args: CONF_FILE=prj_new.conf
    arch_exclude: posix
    integration_platforms:
      - qemu_x86
  libraries.libc.picolibc.sprintf:
    extra_args: CONF_FILE=prj_picolibc.conf
    tags:
      - picolibc
    ignore_faults: true
    filter: CONFIG_PICOLIBC_SUPPORTED
    integration_platforms:
      - qemu_x86
  libraries.libc.picolibc.sprintf_new:
    extra_args: CONF_FILE=prj_picolibc_new.conf
    tags:
      - picolibc
    filter: CONFIG_PICOLIBC_SUPPORTED
    integration_platforms:
      - qemu_x86
  libraries.libc.picolibc.sprintf_inexact:
    extra_args: CONF_FILE=prj_picolibc_new.conf
    extra_configs:
      - CONFIG_PICOLIBC_USE_MODULE=y
      - CONFIG_PICOLIBC_IO_FLOAT_EXACT=n
    tags:
      - picolibc
    filter: CONFIG_PICOLIBC_SUPPORTED
    integration_platforms:
      - qemu_x86
```
