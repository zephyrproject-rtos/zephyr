## CMakeLists.txt
```
# SPDX-FileCopyrightText: Copyright The Zephyr Project Contributors
# SPDX-License-Identifier: Apache-2.0

cmake_minimum_required(VERSION 3.20.0)
find_package(Zephyr REQUIRED HINTS $ENV{ZEPHYR_BASE})
project(lib_printk)

target_sources(app PRIVATE src/main.c)
target_sources(app PRIVATE src/format.c)
```

## prj.conf
```kconfig
# SPDX-FileCopyrightText: Copyright The Zephyr Project Contributors
# SPDX-License-Identifier: Apache-2.0

CONFIG_ZTEST=y
CONFIG_PRINTK=y
CONFIG_TEST_CAPTURE=y
CONFIG_TEST_CAPTURE_BUFFER_SIZE=1024
CONFIG_TEST_USERSPACE=y
# This suite validates the raw printk output path through the console
# hook; keep printk from being redirected into the log subsystem.
CONFIG_LOG_PRINTK=n
```

## src/main.c
```c
/*
 * SPDX-FileCopyrightText: Copyright The Zephyr Project Contributors
 * SPDX-License-Identifier: Apache-2.0
 */

#include <zephyr/ztest.h>
#include <zephyr/kernel.h>
#include <zephyr/sys/printk.h>
#include <zephyr/tc_capture.h>

#define STACK_SIZE (1024 + CONFIG_TEST_EXTRA_STACK_SIZE)

static K_THREAD_STACK_DEFINE(worker_stack, STACK_SIZE);
static struct k_thread worker;

/*
 * The tc_capture API can only be used from kernel context, so the user
 * mode cases keep the test body in kernel mode and run just the print
 * call in a worker thread that drops to user mode when CONFIG_USERSPACE
 * is enabled (and runs as a plain kernel thread otherwise).
 */
static void run_in_user_thread(k_thread_entry_t entry)
{
	k_thread_create(&worker, worker_stack, K_THREAD_STACK_SIZEOF(worker_stack), entry, NULL,
			NULL, NULL, k_thread_priority_get(k_current_get()),
			K_USER | K_INHERIT_PERMS, K_NO_WAIT);
	k_thread_join(&worker, K_FOREVER);
}

/* Assert that exactly the expected bytes were captured since the last clear */
static void expect_captured(const char *expected)
{
	static char captured[CONFIG_TEST_CAPTURE_BUFFER_SIZE + 1];

	(void)tc_capture_get(captured, sizeof(captured));
	zassert_str_equal(captured, expected);
}

static void call_vprintk(const char *fmt, ...)
{
	va_list ap;

	va_start(ap, fmt);
	vprintk(fmt, ap);
	va_end(ap);
}

static void call_vprintk_unlocked(const char *fmt, ...)
{
	va_list ap;

	va_start(ap, fmt);
	vprintk_unlocked(fmt, ap);
	va_end(ap);
}

static void printk_worker(void *p1, void *p2, void *p3)
{
	ARG_UNUSED(p1);
	ARG_UNUSED(p2);
	ARG_UNUSED(p3);

	printk("user %s %d %x\n", "context", -42, 0xdead);
}

static void printk_long_worker(void *p1, void *p2, void *p3)
{
	const char *part = p1;

	ARG_UNUSED(p2);
	ARG_UNUSED(p3);

	printk("%s%s%s\n", part, part, part);
}

static void printk_unlocked_worker(void *p1, void *p2, void *p3)
{
	ARG_UNUSED(p1);
	ARG_UNUSED(p2);
	ARG_UNUSED(p3);

	printk_unlocked("user %s %d %x\n", "unlocked", -42, 0xdead);
}

static void vprintk_unlocked_worker(void *p1, void *p2, void *p3)
{
	ARG_UNUSED(p1);
	ARG_UNUSED(p2);
	ARG_UNUSED(p3);

	call_vprintk_unlocked("user %s %d %x\n", "vprintk", -42, 0xdead);
}

static void k_str_out_worker(void *p1, void *p2, void *p3)
{
	char raw[] = "raw 100% bytes\n";

	ARG_UNUSED(p1);
	ARG_UNUSED(p2);
	ARG_UNUSED(p3);

	k_str_out(raw, sizeof(raw) - 1U);
}

static void printk_before(void *data)
{
	ARG_UNUSED(data);

	tc_capture_start();
}

static void printk_after(void *data)
{
	ARG_UNUSED(data);

	tc_capture_stop();
}

/**
 * @brief Printk output path tests
 * @defgroup lib_printk_tests Printk
 * @ingroup all_tests
 * @{
 */

/**
 * @brief Verify that printk() output reaches the console from kernel
 * context.
 *
 * @details
 * Console output is recorded with the tc_capture helper. The test
 * calls printk() from a kernel mode thread and verifies the formatted
 * string arrives at the console unmodified.
 *
 * Test steps:
 * - Clear the capture buffer.
 * - Call printk() with a format string and arguments.
 * - Compare the captured output to the expected string.
 *
 * Expected result:
 * - Exactly the formatted string is captured.
 *
 * @see printk()
 */
ZTEST(lib_printk, test_printk_kernel_context_output)
{
	tc_capture_clear();
	printk("kernel %s %d %x\n", "context", -42, 0xdead);
	expect_captured("kernel context -42 dead\n");
}

/**
 * @brief Verify that printk() output reaches the console from user
 * context.
 *
 * @details
 * From a user mode thread, printk() cannot touch the console hook
 * directly: it must buffer the formatted output and hand it to the
 * kernel through the k_str_out() syscall. The test runs printk() in a
 * user mode worker thread and verifies the output still arrives at
 * the console unmodified.
 *
 * Test steps:
 * - Clear the capture buffer.
 * - Run printk() in a user mode worker thread and join it.
 * - Compare the captured output to the expected string.
 *
 * Expected result:
 * - Exactly the formatted string is captured, with no fault.
 *
 * @see printk()
 * @see k_str_out()
 */
ZTEST(lib_printk, test_printk_user_context_output)
{
	tc_capture_clear();
	run_in_user_thread(printk_worker);
	expect_captured("user context -42 dead\n");
}

/**
 * @brief Verify that user context printk() output longer than the
 * intermediate buffer is not lost or reordered.
 *
 * @details
 * The user mode printk() path accumulates characters in a fixed-size
 * buffer (CONFIG_PRINTK_BUFFER_SIZE) flushed through k_str_out()
 * whenever it fills. Output longer than the buffer therefore takes
 * multiple flushes. The test emits a string much longer than the
 * buffer from a user mode worker thread and verifies the console
 * receives all of it, in order.
 *
 * Test steps:
 * - Clear the capture buffer.
 * - Run printk() in a user mode worker thread with output longer
 *   than CONFIG_PRINTK_BUFFER_SIZE.
 * - Compare the captured output to the expected string.
 *
 * Expected result:
 * - The whole string is captured in order across flushes.
 *
 * @see printk()
 * @see k_str_out()
 */
ZTEST(lib_printk, test_printk_user_context_long_output)
{
	static const char part[] = "0123456789abcdefghijklmnopqrstuvwxyz";
	char expected[3 * (sizeof(part) - 1U) + 2U];

	(void)snprintk(expected, sizeof(expected), "%s%s%s\n", part, part, part);

	tc_capture_clear();
	k_thread_create(&worker, worker_stack, K_THREAD_STACK_SIZEOF(worker_stack),
			printk_long_worker, (void *)part, NULL, NULL,
			k_thread_priority_get(k_current_get()), K_USER | K_INHERIT_PERMS,
			K_NO_WAIT);
	k_thread_join(&worker, K_FOREVER);
	expect_captured(expected);
}

/**
 * @brief Verify that printk_unlocked() output reaches the console
 * from kernel context.
 *
 * @details
 * printk_unlocked() bypasses the printk spinlock so it stays usable
 * from fatal error and assertion paths. The test calls it from a
 * kernel mode thread and verifies the formatted string arrives at the
 * console unmodified.
 *
 * Test steps:
 * - Clear the capture buffer.
 * - Call printk_unlocked() with a format string and arguments.
 * - Compare the captured output to the expected string.
 *
 * Expected result:
 * - Exactly the formatted string is captured.
 *
 * @see printk_unlocked()
 */
ZTEST(lib_printk, test_printk_unlocked_kernel_context_output)
{
	tc_capture_clear();
	printk_unlocked("kernel %s %d %x\n", "unlocked", -42, 0xdead);
	expect_captured("kernel unlocked -42 dead\n");
}

/**
 * @brief Verify that printk_unlocked() works from user context.
 *
 * @details
 * Assertion reporting uses the unlocked printk variant, and an
 * assertion can fire in a user mode thread, so printk_unlocked() must
 * not touch kernel memory when called from user context: it has to
 * take the same buffered k_str_out() syscall path as printk(). A
 * regression here faults on the first emitted character (memory
 * protection violation reading the console hook) instead of printing.
 *
 * Test steps:
 * - Clear the capture buffer.
 * - Run printk_unlocked() in a user mode worker thread and join it.
 * - Compare the captured output to the expected string.
 *
 * Expected result:
 * - Exactly the formatted string is captured, with no fault.
 *
 * @see printk_unlocked()
 * @see k_str_out()
 */
ZTEST(lib_printk, test_printk_unlocked_user_context_output)
{
	tc_capture_clear();
	run_in_user_thread(printk_unlocked_worker);
	expect_captured("user unlocked -42 dead\n");
}

/**
 * @brief Verify that vprintk() produces the same output as printk().
 *
 * @details
 * vprintk() is the va_list form backing printk(). The test routes the
 * same format and arguments through a variadic wrapper calling
 * vprintk() and verifies the console receives the same formatted
 * string printk() would produce.
 *
 * Test steps:
 * - Clear the capture buffer.
 * - Call vprintk() through a variadic wrapper.
 * - Compare the captured output to the expected string.
 *
 * Expected result:
 * - Exactly the formatted string is captured.
 *
 * @see vprintk()
 */
ZTEST(lib_printk, test_printk_vprintk_output)
{
	tc_capture_clear();
	call_vprintk("kernel %s %d %x\n", "vprintk", -42, 0xdead);
	expect_captured("kernel vprintk -42 dead\n");
}

/**
 * @brief Verify that vprintk_unlocked() works from user context.
 *
 * @details
 * vprintk_unlocked() is the va_list form used directly by
 * assert_print(). The test calls it through a variadic wrapper in a
 * user mode worker thread and verifies the output arrives at the
 * console instead of faulting on kernel memory.
 *
 * Test steps:
 * - Clear the capture buffer.
 * - Run vprintk_unlocked() in a user mode worker thread and join it.
 * - Compare the captured output to the expected string.
 *
 * Expected result:
 * - Exactly the formatted string is captured, with no fault.
 *
 * @see vprintk_unlocked()
 */
ZTEST(lib_printk, test_printk_vprintk_unlocked_user_context_output)
{
	tc_capture_clear();
	run_in_user_thread(vprintk_unlocked_worker);
	expect_captured("user vprintk -42 dead\n");
}

/**
 * @brief Verify that k_str_out() passes bytes through to the console
 * unmodified.
 *
 * @details
 * k_str_out() is the syscall the user mode printk() path flushes
 * through. The test calls it directly from a user mode worker thread
 * with a fixed string, including a '%' character, and verifies the
 * exact bytes reach the console with no formatting applied.
 *
 * Test steps:
 * - Clear the capture buffer.
 * - Run k_str_out() in a user mode worker thread with a fixed byte
 *   string and join it.
 * - Compare the captured output to the input bytes.
 *
 * Expected result:
 * - The exact bytes are captured, '%' included.
 *
 * @see k_str_out()
 */
ZTEST(lib_printk, test_printk_k_str_out_passthrough)
{
	tc_capture_clear();
	run_in_user_thread(k_str_out_worker);
	expect_captured("raw 100% bytes\n");
}

/**
 * @}
 */

ZTEST_SUITE(lib_printk, NULL, NULL, printk_before, printk_after, NULL);
```

## src/format.c
```c
/*
 * SPDX-FileCopyrightText: Copyright The Zephyr Project Contributors
 * SPDX-License-Identifier: Apache-2.0
 */

#include <inttypes.h>

#include <zephyr/ztest.h>
#include <zephyr/sys/printk.h>
#include <zephyr/tc_capture.h>

#define BUF_SZ 1024

#if defined(CONFIG_PICOLIBC)

#define ZEPHYR_PICOLIBC_VERSION (__PICOLIBC__ * 10000 + \
				 __PICOLIBC_MINOR__ * 100 + \
				 __PICOLIBC_PATCHLEVEL__)

#ifdef CONFIG_PICOLIBC_IO_MINIMAL
/*
 * If picolibc is >= 1.8.4, then minimal printf is available. Otherwise,
 * we're going to get the floating point version when the minimal one is
 * selected.
 */
#if ZEPHYR_PICOLIBC_VERSION >= 10804
#define HAS_PICOLIBC_IO_MINIMAL
#else
#define HAS_PICOLIBC_IO_FLOAT
#endif
#endif

#ifdef CONFIG_PICOLIBC_IO_LONG_LONG
/*
 * If picolibc is >= 1.8.5, then long long printf is available. Otherwise,
 * we're going to get the floating point version when the long long one is
 * selected.
 */
#if ZEPHYR_PICOLIBC_VERSION >= 10805
#define HAS_PICOLIBC_IO_LONG_LONG
#else
#define HAS_PICOLIBC_IO_FLOAT
#endif
#endif

#ifdef CONFIG_PICOLIBC_IO_FLOAT
#define HAS_PICOLIBC_IO_FLOAT
#endif

/*
 * Picolibc long long support is present if Zephyr configuration has
 * enabled long long or floating point support.
 */

static char expected_32[] = "22 113 10000 32768 40000 22\n"
	"p 112 -10000 -32768 -40000 -22\n"
#if defined(HAS_PICOLIBC_IO_MINIMAL)
	"0x1 0x1 0x1 0x1 0x1\n"
	"0x1 0x1 0x1 0x1\n"
	"42 42 42 42\n"
	"-42 -42 -42 -42\n"
	"42 42 42 42\n"
	"42 42 42 42\n"
	"25542abcdef  42\n"
#if defined(_WANT_MINIMAL_IO_LONG_LONG) || defined(__IO_MINIMAL_LONG_LONG)
	"68719476735 -1 18446744073709551615 ffffffffffffffff\n"
#else
	"-1 -1 4294967295 ffffffff\n"
#endif
#else
	"0x1 0x01 0x0001 0x00000001 0x0000000000000001\n"
	"0x1 0x 1 0x   1 0x       1\n"
	"42 42 0042 00000042\n"
	"-42 -42 -042 -0000042\n"
	"42 42   42       42\n"
	"42 42 0042 00000042\n"
	"255     42    abcdef        42\n"
#if defined(HAS_PICOLIBC_IO_LONG_LONG) || defined(HAS_PICOLIBC_IO_FLOAT)
	"68719476735 -1 18446744073709551615 ffffffffffffffff\n"
#else
	"-1 -1 4294967295 ffffffff\n"
#endif
#endif
	"0xcafebabe 0xbeef 0x2a\n"
;

static char expected_64[] = "22 113 10000 32768 40000 22\n"
	"p 112 -10000 -32768 -40000 -22\n"
#if defined(HAS_PICOLIBC_IO_MINIMAL)
	"0x1 0x1 0x1 0x1 0x1\n"
	"0x1 0x1 0x1 0x1\n"
	"42 42 42 42\n"
	"-42 -42 -42 -42\n"
	"42 42 42 42\n"
	"42 42 42 42\n"
	"25542abcdef  42\n"
#else
	"0x1 0x01 0x0001 0x00000001 0x0000000000000001\n"
	"0x1 0x 1 0x   1 0x       1\n"
	"42 42 0042 00000042\n"
	"-42 -42 -042 -0000042\n"
	"42 42   42       42\n"
	"42 42 0042 00000042\n"
	"255     42    abcdef        42\n"
#endif
	"68719476735 -1 18446744073709551615 ffffffffffffffff\n"
	"0xcafebabe 0xbeef 0x2a\n"
;
static char *expected = (sizeof(long) == sizeof(long long)) ? expected_64 : expected_32;
#else
#if defined(CONFIG_CBPRINTF_FULL_INTEGRAL)
static char *expected = "22 113 10000 32768 40000 22\n"
			"p 112 -10000 -32768 -40000 -22\n"
			"0x1 0x01 0x0001 0x00000001 0x0000000000000001\n"
			"0x1 0x 1 0x   1 0x       1\n"
			"42 42 0042 00000042\n"
			"-42 -42 -042 -0000042\n"
			"42 42   42       42\n"
			"42 42 0042 00000042\n"
			"255     42    abcdef        42\n"
			"68719476735 -1 18446744073709551615 ffffffffffffffff\n"
			"0xcafebabe 0xbeef 0x2a\n"
;
#elif defined(CONFIG_CBPRINTF_COMPLETE)
static char *expected = "22 113 10000 32768 40000 %llu\n"
			"p 112 -10000 -32768 -40000 %lld\n"
			"0x1 0x01 0x0001 0x00000001 0x0000000000000001\n"
			"0x1 0x 1 0x   1 0x       1\n"
			"42 42 0042 00000042\n"
			"-42 -42 -042 -0000042\n"
			"42 42   42       42\n"
			"42 42 0042 00000042\n"
			"255     42    abcdef        42\n"
			"%lld %lld %llu %llx\n"
			"0xcafebabe 0xbeef 0x2a\n"
;
#elif defined(CONFIG_CBPRINTF_NANO)
static char *expected = "22 113 10000 32768 40000 22\n"
			"p 112 -10000 -32768 -40000 -22\n"
			"0x1 0x01 0x0001 0x00000001 0x0000000000000001\n"
			"0x1 0x 1 0x   1 0x       1\n"
			"42 42 0042 00000042\n"
			"-42 -42 -042 -0000042\n"
			"42 42   42       42\n"
			"42 42 0042 00000042\n"
			"255     42    abcdef        42\n"
			"ERR -1 ERR ERR\n"
			"0xcafebabe 0xbeef 0x2a\n"
;
#endif
#endif

static size_t stv = 22;
static unsigned char uc = 'q';
static unsigned short int usi = 10000U;
static unsigned int ui = 32768U;
static unsigned long ul = 40000;

/* FIXME
 * we know printk doesn't have full support for 64-bit values.
 * at least show it can print uint64_t values less than 32-bits wide
 */
static unsigned long long ull = 22;

static char c = 'p';
static signed short int ssi = -10000;
static signed int si = -32768;
static signed long sl = -40000;
static signed long long sll = -22;

static uint32_t hex = 0xCAFEBABE;

static void *ptr = (void *)0xBEEF;

/**
 * @addtogroup lib_printk_tests
 * @{
 */

/**
 * @brief Verify printk() formats a wide range of conversions correctly.
 *
 * @details
 * Validates that the console output path produces byte-for-byte the
 * expected text for integer width/sign/padding specifiers, hexadecimal,
 * pointers and 64-bit values. The expected output accounts for the
 * configured formatting engine (cbprintf complete/nano/full-integral or
 * the picolibc printf variants).
 *
 * Test steps:
 * - Clear the capture buffer.
 * - Emit a fixed series of printk() format strings covering
 *   size/char/short/int/long/long-long, hex, width, zero/space padding,
 *   left-justify and pointer conversions.
 * - Compare the captured output to the expected string.
 *
 * Expected result:
 * - The captured printk output equals the expected string.
 *
 * @see printk()
 */
ZTEST(lib_printk, test_printk_format_specifiers)
{
	static char captured[BUF_SZ];

	tc_capture_clear();

	printk("%zu %hhu %hu %u %lu %llu\n", stv, uc, usi, ui, ul, ull);
	printk("%c %hhd %hd %d %ld %lld\n", c, c, ssi, si, sl, sll);
	printk("0x%x 0x%02x 0x%04x 0x%08x 0x%016x\n", 1, 1, 1, 1, 1);
	printk("0x%x 0x%2x 0x%4x 0x%8x\n", 1, 1, 1, 1);
	printk("%d %02d %04d %08d\n", 42, 42, 42, 42);
	printk("%d %02d %04d %08d\n", -42, -42, -42, -42);
	printk("%u %2u %4u %8u\n", 42, 42, 42, 42);
	printk("%u %02u %04u %08u\n", 42, 42, 42, 42);
	printk("%-8u%-6d%-4x  %8d\n", 0xFF, 42, 0xABCDEF, 42);
	printk("%lld %lld %llu %llx\n", 0xFFFFFFFFFULL, -1LL, -1ULL, -1ULL);
	printk("0x%x %p %-2p\n", hex, ptr, (char *)42);

	(void)tc_capture_get(captured, sizeof(captured));
	zassert_str_equal(captured, expected, "printk failed");
}

/**
 * @brief Verify snprintk() formats a wide range of conversions correctly.
 *
 * @details
 * Renders the same conversion series as the printk() formatting test
 * into a buffer with snprintk() and verifies the result matches the
 * expected string, proving the buffered formatting entry point behaves
 * identically to the console output path.
 *
 * Test steps:
 * - Render a fixed series of format strings into a buffer with
 *   snprintk(), accumulating the returned lengths.
 * - Compare the buffer contents to the expected string.
 *
 * Expected result:
 * - The snprintk() output equals the expected string.
 *
 * @see snprintk()
 */
ZTEST(lib_printk, test_printk_snprintk_format_specifiers)
{
	static char buf[BUF_SZ];
	int count = 0;

	count += snprintk(buf + count, sizeof(buf) - count,
			  "%zu %hhu %hu %u %lu %llu\n",
			  stv, uc, usi, ui, ul, ull);
	count += snprintk(buf + count, sizeof(buf) - count,
			  "%c %hhd %hd %d %ld %lld\n", c, c, ssi, si, sl, sll);
	count += snprintk(buf + count, sizeof(buf) - count,
			  "0x%x 0x%02x 0x%04x 0x%08x 0x%016x\n", 1, 1, 1, 1, 1);
	count += snprintk(buf + count, sizeof(buf) - count,
			  "0x%x 0x%2x 0x%4x 0x%8x\n", 1, 1, 1, 1);
	count += snprintk(buf + count, sizeof(buf) - count,
			  "%d %02d %04d %08d\n", 42, 42, 42, 42);
	count += snprintk(buf + count, sizeof(buf) - count,
			  "%d %02d %04d %08d\n", -42, -42, -42, -42);
	count += snprintk(buf + count, sizeof(buf) - count,
			  "%u %2u %4u %8u\n", 42, 42, 42, 42);
	count += snprintk(buf + count, sizeof(buf) - count,
			  "%u %02u %04u %08u\n", 42, 42, 42, 42);
	count += snprintk(buf + count, sizeof(buf) - count,
			  "%-8u%-6d%-4x  %8d\n",
			  0xFF, 42, 0xABCDEF, 42);
	count += snprintk(buf + count, sizeof(buf) - count,
			  "%lld %lld %llu %llx\n",
			  0xFFFFFFFFFULL, -1LL, -1ULL, -1ULL);
	count += snprintk(buf + count, sizeof(buf) - count,
			  "0x%x %p %-2p\n", hex, ptr, (char *)42);
	buf[count] = '\0';
	zassert_str_equal(buf, expected, "snprintk failed");
}

/**
 * @brief Verify printk() supports the inttypes.h PRI* conversion macros.
 *
 * @details
 * Emits every fixed-width signed, unsigned, octal and hexadecimal
 * conversion through its PRIdN/PRIiN/PRIoN/PRIuN/PRIxN/PRIXN macro
 * with a value encoding the width (e.g. 64 prints as "o100" in octal
 * and "x40" in hex), and verifies the exact expected bytes reach the
 * console. The values all fit in 32 bits so the expected output does
 * not depend on the configured formatting engine or libc, except that
 * the octal conversions are skipped when the engine (cbprintf nano
 * without picolibc) does not implement %o.
 *
 * Test steps:
 * - Clear the capture buffer.
 * - Print each fixed-width integer conversion via its PRI* macro.
 * - Compare the captured output to the expected string.
 *
 * Expected result:
 * - The captured output equals the expected string.
 *
 * @see printk()
 */
ZTEST(lib_printk, test_printk_inttypes_specifiers)
{
	static char captured[BUF_SZ];

	tc_capture_clear();

	printk("d%" PRId8 "\n", INT8_C(8));
	printk("d%" PRId16 "\n", INT16_C(16));
	printk("d%" PRId32 "\n", INT32_C(32));
	printk("d%" PRId64 "\n", INT64_C(64));

	printk("i%" PRIi8 "\n", INT8_C(8));
	printk("i%" PRIi16 "\n", INT16_C(16));
	printk("i%" PRIi32 "\n", INT32_C(32));
	printk("i%" PRIi64 "\n", INT64_C(64));

#if defined(CONFIG_PICOLIBC) || !defined(CONFIG_CBPRINTF_NANO)
	/*
	 * The octal conversion comes from the formatting engine: cbprintf
	 * nano does not implement %o, while a picolibc-backed printk
	 * supports it regardless of the cbprintf configuration.
	 */
	printk("o%" PRIo8 "\n", INT8_C(8));
	printk("o%" PRIo16 "\n", INT16_C(16));
	printk("o%" PRIo32 "\n", INT32_C(32));
	printk("o%" PRIo64 "\n", INT64_C(64));
#endif

	printk("u%" PRIu8 "\n", UINT8_C(8));
	printk("u%" PRIu16 "\n", UINT16_C(16));
	printk("u%" PRIu32 "\n", UINT32_C(32));
	printk("u%" PRIu64 "\n", UINT64_C(64));

	printk("x%" PRIx8 "\n", UINT8_C(8));
	printk("x%" PRIx16 "\n", UINT16_C(16));
	printk("x%" PRIx32 "\n", UINT32_C(32));
	printk("x%" PRIx64 "\n", UINT64_C(64));

	printk("X%" PRIX8 "\n", UINT8_C(8));
	printk("X%" PRIX16 "\n", UINT16_C(16));
	printk("X%" PRIX32 "\n", UINT32_C(32));
	printk("X%" PRIX64 "\n", UINT64_C(64));

	(void)tc_capture_get(captured, sizeof(captured));
	zassert_str_equal(captured,
			  "d8\nd16\nd32\nd64\n"
			  "i8\ni16\ni32\ni64\n"
#if defined(CONFIG_PICOLIBC) || !defined(CONFIG_CBPRINTF_NANO)
			  "o10\no20\no40\no100\n"
#endif
			  "u8\nu16\nu32\nu64\n"
			  "x8\nx10\nx20\nx40\n"
			  "X8\nX10\nX20\nX40\n");
}

/**
 * @}
 */
```
