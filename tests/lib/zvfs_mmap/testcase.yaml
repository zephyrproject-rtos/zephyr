## tests/misc/dtdoctor/dts/bindings/vnd,dtdoctor-device.yaml
```yaml
# SPDX-FileCopyrightText: Copyright The Zephyr Project Contributors
# SPDX-License-Identifier: Apache-2.0

description: Fake device without a driver, used by the DT Doctor integration test

compatible: "vnd,dtdoctor-device"
```

## tests/misc/dtdoctor/unit/fixture/kconfig_select/Kconfig
```kconfig
# SPDX-FileCopyrightText: Copyright The Zephyr Project Contributors
# SPDX-License-Identifier: Apache-2.0

# Symbols related to the DT_HAS symbol only through select/imply conditions.

config DTD_SELECT_HELPER
	bool "Helper selected when the foo device is present"

config DTD_PLATFORM_SELECT
	bool "Platform selecting the helper for the foo device"
	select DTD_SELECT_HELPER if DT_HAS_VND_FOO_DEVICE_ENABLED

config DTD_IMPLY_HELPER
	bool "Helper implied when the foo device is present"

config DTD_PLATFORM_IMPLY
	bool "Platform implying the helper for the foo device"
	imply DTD_IMPLY_HELPER if DT_HAS_VND_FOO_DEVICE_ENABLED

config DT_HAS_VND_FOO_DEVICE_ENABLED
	def_bool y
```

## tests/misc/iterable_sections/Kconfig
```kconfig
# Copyright The Zephyr Project Contributors
# SPDX-License-Identifier: Apache-2.0

config TEST_LARGE_ROM_SECTION
	bool "Link a multi-page iterable ROM section"
	help
	  Add two 4 KiB entries to the test_rom_large iterable section, so
	  that the section ends at least one MMU page past the sections
	  linked before it.

source "Kconfig.zephyr"
```

## tests/modules/hal_realtek/ameba_timer/Kconfig
```kconfig
# SPDX-FileCopyrightText: Copyright The Zephyr Project Contributors
# SPDX-License-Identifier: Apache-2.0
source "Kconfig.zephyr"
source "modules/hal_realtek/ameba/Kconfig.timer"
```

## tests/net/lib/coap_oscore/Kconfig
```kconfig
# Copyright (c) 2026 Nordic Semiconductor ASA
#
# SPDX-License-Identifier: Apache-2.0

config TEST_OSCORE_SALT_ONLY
	bool "Build only the master-salt-zero OSCORE test"
	help
	  Select the minimal salt-only test source (src/salt.c) instead of the
	  full OSCORE test suite (src/main.c).

source "Kconfig.zephyr"
```

## tests/net/lib/mqtt_fuzz/Kconfig
```kconfig
# Copyright (c) 2017 Intel Corporation
# Copyright (c) Qualcomm Technologies, Inc. and/or its subsidiaries.
# SPDX-License-Identifier: Apache-2.0

config ARCH_POSIX_FUZZ_IRQ
	int "OS interrupt via which to deliver fuzz cases"
	default 31
	help
	  In this test, new fuzz cases are delivered to Zephyr
	  via interrupts.  The IRQ number is arbitrary: any line the
	  board is not otherwise using works, since it is only the
	  delivery mechanism for handing the fuzz buffer into the
	  simulated OS.  The IRQ should be otherwise unused, but can
	  be any value desired by the app.

config ARCH_POSIX_FUZZ_TICKS
	int "Ticks to allow for fuzz case processing"
	default 10
	help
	  Fuzz interrupts are delivered, from the perspective of the
	  OS, at a steady cadence in simulated time.  The ISR only
	  signals a semaphore; the default of 10 ticks is the simulated
	  time nsi_exec_for() grants per iteration for that handoff to
	  reach main()'s thread AND for the full packet-draining loop
	  there to complete before the next fuzz case is delivered.
	  Too few ticks silently truncates processing rather than
	  failing loudly: the fuzzer keeps reporting steady (or even
	  rising) exec/s while quietly exercising less code per
	  iteration.  If a harness change makes per-iteration work
	  longer, watch for falling coverage alongside rising exec/s as
	  the symptom that this value needs raising.

source "Kconfig.zephyr"
```

## tests/net/ptp/port_events/Kconfig
```kconfig
# Copyright (c) 2026 Philipp Steiner
# SPDX-License-Identifier: Apache-2.0

rsource "../Kconfig.unit"

# See ../Kconfig.unit for why selected PTP Kconfig entries are redeclared here.

config PTP_NUM_PORTS
	default 1

config PTP_FOREIGN_TIME_TRANSMITTER_FEATURE
	default y

config PTP_FOREIGN_TIME_TRANSMITTER_RECORD_SIZE
	default 5

config PTP_MSG_POLL_SIZE
	default 4

config PTP_MIN_DELAY_REQ_LOG_INTERVAL
	default 0

config PTP_ANNOUNCE_LOG_INTERVAL
	default 0

config PTP_ANNOUNCE_RECV_TIMEOUT
	default 3

config PTP_SYNC_LOG_INTERVAL
	default 0

config PTP_MIN_PDELAY_REQ_LOG_INTERVAL
	default 0

config PTP_HYBRID_FALLBACK_ATTEMPTS
	default 3

choice PTP_DELAY_MECHANISM_TYPE
	bool "PTP port events test delay mechanism"
	default PTP_DELAY_MECHANISM_E2E
endchoice

choice PTP_NETWORK_MODE
	bool "PTP port events test network mode"
	default PTP_NETWORK_MODE_MULTICAST
endchoice

choice PTP_NETWORKING_PROTOCOL
	bool "PTP port events test protocol"
	default PTP_IEEE_802_3_PROTOCOL
endchoice

source "Kconfig.zephyr"
```

## tests/net/route/ipv6/Kconfig
```kconfig
# Copyright The Zephyr Project Contributors
# SPDX-License-Identifier: Apache-2.0

mainmenu "IPv6 route test application"

config NET_ROUTE_TEST_VPN
	bool
	default y
	select NET_VPN
	help
	  Enable the VPN handling of the network stack, which only a VPN
	  implementation selects otherwise, for the VPN interface of the test.

source "Kconfig.zephyr"
```

## tests/net/route/testcase.yaml
```yaml
common:
  depends_on: netif
tests:
  net.route:
    min_ram: 16
    tags:
      - net
      - route
  net.route.unknown_ll:
    min_ram: 16
    tags:
      - net
      - route
    extra_configs:
      - CONFIG_NET_L2_ETHERNET=y
      - CONFIG_ETH_DRIVER=n
      - CONFIG_ASSERT=y
      - CONFIG_NET_IF_MAX_IPV6_COUNT=3
```

## tests/net/rtp/loopback/Kconfig
```kconfig
# SPDX-FileCopyrightText: 2026 Basalte bv
# SPDX-License-Identifier: Apache-2.0

config RTP_LOOPBACK_TEST_SRTP_GCM
	bool "Use AES-GCM for the SRTP loopback permutations"
	help
	  Protect the loopback session with AES-128-GCM instead of
	  AES-128-CM with HMAC-SHA1-80.

config RTP_LOOPBACK_TEST_SRTP_GCM_256
	bool "Use AES-256-GCM for the SRTP loopback permutations"
	help
	  Protect the loopback session with AES-256-GCM instead of
	  AES-128-CM with HMAC-SHA1-80. Takes precedence over
	  RTP_LOOPBACK_TEST_SRTP_GCM.

source "Kconfig.zephyr"
```

## tests/net/socket/tls_configurations/Kconfig
```kconfig
# Copyright (c) 2024 Nordic Semiconductor ASA
# SPDX-License-Identifier: Apache-2.0

config SERVER_PORT
	int "Server port to connect to"
	default 4242

choice TLS_CONFIGURATIONS_PSK_FORMAT
	prompt "Format of the PSK stored in TLS credentials"
	default TLS_CONFIGURATIONS_PSK_FORMAT_PLAINTEXT

config TLS_CONFIGURATIONS_PSK_FORMAT_PLAINTEXT
	bool "Plaintext"

config TLS_CONFIGURATIONS_PSK_FORMAT_OPAQUE
	bool "Opaque"

endchoice

config SERVER_ADDR
	string "Server address"
	default "127.0.0.1" # For native_sim target

config TEST_TIMEOUT
	int "Timeout (in seconds) for the test to complete"
	default 10
	help
	  Time that the pytest harness waits for the whole run.

source "Kconfig.zephyr"
```
