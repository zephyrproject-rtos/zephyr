## CMakeLists.txt
```
# SPDX-License-Identifier: Apache-2.0

cmake_minimum_required(VERSION 3.20.0)
find_package(Zephyr REQUIRED HINTS $ENV{ZEPHYR_BASE})
project(sys_regmap)

target_sources(app PRIVATE src/test.c)
```

## prj.conf
```kconfig
# Copyright (c) 2026 Nordic Semiconductor ASA
# SPDX-License-Identifier: Apache-2.0

CONFIG_ZTEST=y
```

## src/test.c
```c
/*
 * Copyright (c) 2026 Nordic Semiconductor ASA
 *
 * SPDX-License-Identifier: Apache-2.0
 */

#include <zephyr/ztest.h>
#include <zephyr/sys/regmap.h>

#include <stdint.h>

#define TEST_REG_8BIT_ADDR           0x10
#define TEST_REG_8BIT_FIELD_A_OFFSET 0
#define TEST_REG_8BIT_FIELD_A_SIZE   2
#define TEST_REG_8BIT_FIELD_B_OFFSET 6
#define TEST_REG_8BIT_FIELD_B_SIZE   2
#define TEST_REG_8BIT_FIELD_B_ENUM_C 1
#define TEST_REG_8BIT_FIELD_B_ENUM_D 2

#define TEST_REG_32BIT_ADDR           0x20
#define TEST_REG_32BIT_FIELD_A_OFFSET 0
#define TEST_REG_32BIT_FIELD_A_SIZE   4
#define TEST_REG_32BIT_FIELD_B_OFFSET 28
#define TEST_REG_32BIT_FIELD_B_SIZE   4
#define TEST_REG_32BIT_FIELD_B_ENUM_C 3
#define TEST_REG_32BIT_FIELD_B_ENUM_D 4

#define TEST_REG_64BIT_ADDR           0x30
#define TEST_REG_64BIT_FIELD_A_OFFSET 0
#define TEST_REG_64BIT_FIELD_A_SIZE   8
#define TEST_REG_64BIT_FIELD_B_OFFSET 56
#define TEST_REG_64BIT_FIELD_B_SIZE   8
#define TEST_REG_64BIT_FIELD_B_ENUM_C 5
#define TEST_REG_64BIT_FIELD_B_ENUM_D 6

ZTEST(sys_regmap, test_8bit)
{
	uint8_t mask;
	uint8_t reg;

	zassert_equal(SYS_REGMAP_GET_ADDR(TEST_REG_8BIT), TEST_REG_8BIT_ADDR);
	zassert_equal(SYS_REGMAP_GET_OFFSET(TEST_REG_8BIT, A), TEST_REG_8BIT_FIELD_A_OFFSET);
	zassert_equal(SYS_REGMAP_GET_SIZE(TEST_REG_8BIT, A), TEST_REG_8BIT_FIELD_A_SIZE);
	zassert_equal(SYS_REGMAP_GET_OFFSET(TEST_REG_8BIT, B), TEST_REG_8BIT_FIELD_B_OFFSET);
	zassert_equal(SYS_REGMAP_GET_SIZE(TEST_REG_8BIT, B), TEST_REG_8BIT_FIELD_B_SIZE);

	mask = GENMASK(TEST_REG_8BIT_FIELD_A_OFFSET + TEST_REG_8BIT_FIELD_A_SIZE - 1,
		       TEST_REG_8BIT_FIELD_A_OFFSET);
	zassert_equal(SYS_REGMAP_GEN_MASK(TEST_REG_8BIT, A), mask);

	mask = GENMASK(TEST_REG_8BIT_FIELD_B_OFFSET + TEST_REG_8BIT_FIELD_B_SIZE - 1,
		       TEST_REG_8BIT_FIELD_B_OFFSET);
	zassert_equal(SYS_REGMAP_GEN_MASK(TEST_REG_8BIT, B), mask);

	reg = (uint8_t)(SYS_REGMAP_GEN_FIELD(TEST_REG_8BIT, A, 1));
	zassert_equal(reg, 0x01);
	zassert_equal(SYS_REGMAP_GET_FIELD(TEST_REG_8BIT, A, reg), 1);
	zassert_equal(SYS_REGMAP_GET_FIELD(TEST_REG_8BIT, B, reg), 0);

	reg |= (uint8_t)(SYS_REGMAP_GEN_FIELD(TEST_REG_8BIT, B, 2));
	zassert_equal(reg, 0x81);
	zassert_equal(SYS_REGMAP_GET_FIELD(TEST_REG_8BIT, A, reg), 1);
	zassert_equal(SYS_REGMAP_GET_FIELD(TEST_REG_8BIT, B, reg), 2);

	reg = SYS_REGMAP_GEN_FIELD_ENUM(TEST_REG_8BIT, B, C);
	zassert_equal(SYS_REGMAP_GET_FIELD(TEST_REG_8BIT, B, reg),
		      TEST_REG_8BIT_FIELD_B_ENUM_C);
	reg = SYS_REGMAP_GEN_FIELD_ENUM(TEST_REG_8BIT, B, D);
	zassert_equal(SYS_REGMAP_GET_FIELD(TEST_REG_8BIT, B, reg),
		      TEST_REG_8BIT_FIELD_B_ENUM_D);
}

ZTEST(sys_regmap, test_32bit)
{
	uint32_t mask;
	uint32_t reg;

	zassert_equal(SYS_REGMAP_GET_ADDR(TEST_REG_32BIT), TEST_REG_32BIT_ADDR);
	zassert_equal(SYS_REGMAP_GET_OFFSET(TEST_REG_32BIT, A), TEST_REG_32BIT_FIELD_A_OFFSET);
	zassert_equal(SYS_REGMAP_GET_SIZE(TEST_REG_32BIT, A), TEST_REG_32BIT_FIELD_A_SIZE);
	zassert_equal(SYS_REGMAP_GET_OFFSET(TEST_REG_32BIT, B), TEST_REG_32BIT_FIELD_B_OFFSET);
	zassert_equal(SYS_REGMAP_GET_SIZE(TEST_REG_32BIT, B), TEST_REG_32BIT_FIELD_B_SIZE);

	mask = GENMASK(TEST_REG_32BIT_FIELD_A_OFFSET + TEST_REG_32BIT_FIELD_A_SIZE - 1,
		       TEST_REG_32BIT_FIELD_A_OFFSET);
	zassert_equal(SYS_REGMAP_GEN_MASK(TEST_REG_32BIT, A), mask);

	mask = GENMASK(TEST_REG_32BIT_FIELD_B_OFFSET + TEST_REG_32BIT_FIELD_B_SIZE - 1,
		       TEST_REG_32BIT_FIELD_B_OFFSET);
	zassert_equal(SYS_REGMAP_GEN_MASK(TEST_REG_32BIT, B), mask);

	reg = SYS_REGMAP_GEN_FIELD(TEST_REG_32BIT, A, 1);
	zassert_equal(reg, 0x00000001);
	zassert_equal(SYS_REGMAP_GET_FIELD(TEST_REG_32BIT, A, reg), 1);
	zassert_equal(SYS_REGMAP_GET_FIELD(TEST_REG_32BIT, B, reg), 0);

	reg |= SYS_REGMAP_GEN_FIELD(TEST_REG_32BIT, B, 2);
	zassert_equal(reg, 0x20000001);
	zassert_equal(SYS_REGMAP_GET_FIELD(TEST_REG_32BIT, A, reg), 1);
	zassert_equal(SYS_REGMAP_GET_FIELD(TEST_REG_32BIT, B, reg), 2);

	reg = SYS_REGMAP_GEN_FIELD_ENUM(TEST_REG_32BIT, B, C);
	zassert_equal(SYS_REGMAP_GET_FIELD(TEST_REG_32BIT, B, reg),
		      TEST_REG_32BIT_FIELD_B_ENUM_C);
	reg = SYS_REGMAP_GEN_FIELD_ENUM(TEST_REG_32BIT, B, D);
	zassert_equal(SYS_REGMAP_GET_FIELD(TEST_REG_32BIT, B, reg),
		      TEST_REG_32BIT_FIELD_B_ENUM_D);
}

ZTEST(sys_regmap, test_64bit)
{
	uint64_t mask;
	uint64_t reg;

	zassert_equal(SYS_REGMAP_GET_ADDR(TEST_REG_64BIT), TEST_REG_64BIT_ADDR);
	zassert_equal(SYS_REGMAP_GET_OFFSET(TEST_REG_64BIT, A), TEST_REG_64BIT_FIELD_A_OFFSET);
	zassert_equal(SYS_REGMAP_GET_SIZE(TEST_REG_64BIT, A), TEST_REG_64BIT_FIELD_A_SIZE);
	zassert_equal(SYS_REGMAP_GET_OFFSET(TEST_REG_64BIT, B), TEST_REG_64BIT_FIELD_B_OFFSET);
	zassert_equal(SYS_REGMAP_GET_SIZE(TEST_REG_64BIT, B), TEST_REG_64BIT_FIELD_B_SIZE);

	mask = GENMASK64(TEST_REG_64BIT_FIELD_A_OFFSET + TEST_REG_64BIT_FIELD_A_SIZE - 1,
			 TEST_REG_64BIT_FIELD_A_OFFSET);
	zassert_equal(SYS_REGMAP_GEN_MASK64(TEST_REG_64BIT, A), mask);

	mask = GENMASK64(TEST_REG_64BIT_FIELD_B_OFFSET + TEST_REG_64BIT_FIELD_B_SIZE - 1,
			 TEST_REG_64BIT_FIELD_B_OFFSET);
	zassert_equal(SYS_REGMAP_GEN_MASK64(TEST_REG_64BIT, B), mask);

	reg = SYS_REGMAP_GEN_FIELD64(TEST_REG_64BIT, A, 1);
	zassert_equal(reg, 0x1);
	zassert_equal(SYS_REGMAP_GET_FIELD64(TEST_REG_64BIT, A, reg), 1);
	zassert_equal(SYS_REGMAP_GET_FIELD64(TEST_REG_64BIT, B, reg), 0);

	reg |= SYS_REGMAP_GEN_FIELD64(TEST_REG_64BIT, B, 2);
	zassert_equal(reg, 0x200000000000001);
	zassert_equal(SYS_REGMAP_GET_FIELD64(TEST_REG_64BIT, A, reg), 1);
	zassert_equal(SYS_REGMAP_GET_FIELD64(TEST_REG_64BIT, B, reg), 2);

	reg = SYS_REGMAP_GEN_FIELD_ENUM64(TEST_REG_64BIT, B, C);
	zassert_equal(SYS_REGMAP_GET_FIELD64(TEST_REG_64BIT, B, reg),
		      TEST_REG_64BIT_FIELD_B_ENUM_C);
	reg = SYS_REGMAP_GEN_FIELD_ENUM64(TEST_REG_64BIT, B, D);
	zassert_equal(SYS_REGMAP_GET_FIELD64(TEST_REG_64BIT, B, reg),
		      TEST_REG_64BIT_FIELD_B_ENUM_D);
}

ZTEST_SUITE(sys_regmap, NULL, NULL, NULL, NULL, NULL);
```
