## CMakeLists.txt
```
# SPDX-License-Identifier: Apache-2.0

cmake_minimum_required(VERSION 3.28.0)
find_package(Zephyr REQUIRED HINTS $ENV{ZEPHYR_BASE})
project(ringbuffer)

target_sources(app PRIVATE
    src/main.c
    src/concurrent.c
    src/index_math.c
  )
```

## Kconfig
```
# Copyright (c) 2020 Nordic Semiconductor ASA
# SPDX-License-Identifier: Apache-2.0

config RING_BUFFER_TEST
	bool
	default y

source "Kconfig.zephyr"
```

## prj.conf
```kconfig
CONFIG_ZTEST=y
CONFIG_ZTRESS=y
CONFIG_TEST_EXTRA_STACK_SIZE=1024
CONFIG_IRQ_OFFLOAD=y
CONFIG_TEST_RANDOM_GENERATOR=y
CONFIG_ENTROPY_GENERATOR=y
CONFIG_XOSHIRO_RANDOM_GENERATOR=y
CONFIG_MP_MAX_NUM_CPUS=1
```

## src/main.c
```c
/*
 * Copyright (c) 2026 Zephyr Project Contributors
 *
 * SPDX-License-Identifier: Apache-2.0
 */

#include <zephyr/ztest.h>
#include <zephyr/sys/ring_buffer.h>

#define BUF_SIZE 16
#define DATA_SIZE 12
#define HALF_DATA_SIZE (DATA_SIZE / 2)

/**
 * @brief Verify byte copy storage and retrieval, including wrap-around and reset.
 *
 * @ingroup lib_ringbuffer_tests
 * @verifies ZEP-SRS-40-1
 * @verifies ZEP-SRS-40-2
 * @verifies ZEP-SRS-40-3
 * @verifies ZEP-SRS-40-9
 */
ZTEST(ringbuffer_api, test_ringbuffer_copy_api)
{
	uint8_t ring_storage[BUF_SIZE];
	uint8_t input_data[DATA_SIZE];
	uint8_t output_data[BUF_SIZE] = {0};
	struct ring_buf rb;

	for (uint8_t i = 0; i < DATA_SIZE; i++) {
		input_data[i] = i;
	}

	ring_buf_init(&rb, sizeof(ring_storage), ring_storage);

	zassert_equal(ring_buf_get(&rb, output_data, sizeof(output_data)), 0,
		      "Reading from an empty buffer should return 0 bytes");

	zassert_equal(ring_buf_put(&rb, input_data, DATA_SIZE), DATA_SIZE,
		      "Failed to write full input payload");

	zassert_equal(ring_buf_get(&rb, output_data, HALF_DATA_SIZE), HALF_DATA_SIZE,
		      "Failed to read first chunk");
	zassert_mem_equal(output_data, input_data, HALF_DATA_SIZE,
			  "First data chunk corrupted");

	zassert_equal(ring_buf_get(&rb, output_data, HALF_DATA_SIZE), HALF_DATA_SIZE,
		      "Failed to read remaining chunk");
	zassert_mem_equal(output_data, &input_data[HALF_DATA_SIZE], HALF_DATA_SIZE,
			  "Remaining data chunk corrupted");

	zassert_equal(ring_buf_get(&rb, output_data, 1), 0,
		      "Buffer should be empty after reading all contents");

	zassert_equal(ring_buf_put(&rb, input_data, 8), 8, "Failed to write data");
	zassert_equal(ring_buf_get(&rb, output_data, 8), 8, "Failed to flush data");

	zassert_equal(ring_buf_put(&rb, input_data, DATA_SIZE), DATA_SIZE,
		      "Failed to write data during wrap-around state");
	zassert_equal(ring_buf_get(&rb, output_data, DATA_SIZE), DATA_SIZE,
		      "Failed to read data during wrap-around state");
	zassert_mem_equal(output_data, input_data, DATA_SIZE,
			  "Data corrupted during wrap-around copy handling");

	ring_buf_reset(&rb);
	zassert_equal(ring_buf_get(&rb, output_data, 1), 0,
		      "Buffer should return 0 bytes immediately after reset");

	zassert_equal(ring_buf_put(&rb, output_data, BUF_SIZE), BUF_SIZE,
		      "Buffer capacity was not fully recovered after reset");
}

/**
 * @brief Verify the zero-copy claim and finish operations in both directions.
 *
 * @ingroup lib_ringbuffer_tests
 * @verifies ZEP-SRS-40-5
 * @verifies ZEP-SRS-40-6
 * @verifies ZEP-SRS-40-8
 * @verifies ZEP-SRS-40-11
 * @verifies ZEP-SRS-40-12
 */
ZTEST(ringbuffer_api, test_ringbuffer_zero_copy)
{
	uint8_t *ref, *ref2;
	size_t read_sz;
	size_t write_sz;
	uint8_t buf[16];
	uint8_t input[12];
	struct ring_buf rb;

	for (uint8_t i = 0; i < sizeof(input); i++) {
		input[i] = i;
	}

	ring_buf_init(&rb, sizeof(buf), buf);

	ring_buf_put(&rb, input, sizeof(input));

	ref = NULL;
	read_sz = ring_buf_get_ptr(&rb, &ref, 0);
	zassert_equal(read_sz, sizeof(input), "Unexpected read size");
	zassert_true(memcmp(ref, input, read_sz) == 0, "Data corrupted after get_ptr");
	zassert_equal(ring_buf_size_get(&rb), read_sz, "Size calculation incorrect after get_ptr");
	zassert_equal(ring_buf_capacity_get(&rb), sizeof(buf), "Capacity changed after get_ptr");
	zassert_equal(ring_buf_space_get(&rb), sizeof(buf) - read_sz,
			"Space calculation incorrect after get_ptr");

	zassert_equal(ring_buf_get_ptr(&rb, &ref2, 0), read_sz,
			"Subsequent get_ptr calls returned different sizes");
	zassert_equal(ref, ref2, "Subsequent get_ptr calls returned different pointers");

	ring_buf_consume(&rb, read_sz);
	zassert_equal(ring_buf_size_get(&rb), 0, "Size not zero after consuming all data");
	zassert_equal(ring_buf_capacity_get(&rb), sizeof(buf), "Capacity changed after consume");
	zassert_equal(ring_buf_space_get(&rb), sizeof(buf),
			"Space not fully restored after consuming all data");
	zassert_equal(ring_buf_get_ptr(&rb, &ref, 0), 0,
			"Data still available after consuming all data");

	write_sz = ring_buf_put_ptr(&rb, &ref, 0);
	zassert_equal(write_sz, sizeof(buf) - sizeof(input),
			"Unexpected write size");
	zassert_equal(ring_buf_size_get(&rb), 0, "Change in data without commit");
	zassert_equal(ring_buf_capacity_get(&rb), sizeof(buf), "Capacity changed after put_ptr");
	zassert_equal(ring_buf_space_get(&rb), sizeof(buf), "Space changed after put_ptr");

	zassert_equal(ring_buf_put_ptr(&rb, &ref2, 0), write_sz,
			"Subsequent put_ptr calls returned different sizes");
	zassert_equal(ref, ref2, "Subsequent put_ptr calls returned different pointers");

	memcpy(ref, &input[0], write_sz);
	ring_buf_commit(&rb, write_sz);
	zassert_equal(ring_buf_size_get(&rb), write_sz,
			"Size not updated after commit");

	zassert_equal(ring_buf_get_ptr(&rb, &ref, 0), write_sz, "Data size incorrect after commit");
	zassert_true(memcmp(ref, &input[0], write_sz) == 0, "Data corrupted after commit");
	ring_buf_consume(&rb, write_sz);

	write_sz = ring_buf_put_ptr(&rb, &ref, 0);
	zassert_equal(ref, buf, "Data pointer incorrect after buffer empty");
	zassert_equal(write_sz, sizeof(buf),
			"Unexpected write size after buffer empty");
	memcpy(ref, input, sizeof(buf) / 2);
	ring_buf_commit(&rb, sizeof(buf) / 2);

	zassert_equal(ring_buf_size_get(&rb), sizeof(buf) / 2,
			"Size not updated after partial commit");
	zassert_equal(ring_buf_space_get(&rb), sizeof(buf) / 2,
			"Space not updated after partial commit");
	zassert_equal(ring_buf_get_ptr(&rb, &ref, 0), sizeof(buf) / 2,
			"Data size incorrect after partial commit");
	zassert_equal(ref, buf, "Data pointer incorrect after partial commit");
}


ZTEST(ringbuffer_api, test_ringbuffer_put_ptr)
{
	uint8_t *ref, *ref2;
	size_t write_sz, write_sz2;
	uint8_t buf[16];
	uint8_t tmp[16];
	uint8_t input[13];
	struct ring_buf rb;

	for (uint8_t i = 0; i < sizeof(input); i++) {
		input[i] = i;
	}

	ring_buf_init(&rb, sizeof(buf), buf);

	write_sz = ring_buf_put_ptr(&rb, &ref, 0);
	zassert_equal(write_sz, sizeof(buf), "Unexpected write size");
	write_sz2 = ring_buf_put_ptr(&rb, &ref2, 0);
	zassert_equal(write_sz2, write_sz, "Subsequent put_ptr calls returned different sizes");
	zassert_equal(ref, ref2, "Subsequent put_ptr calls returned different pointers");

	memcpy(ref, input, sizeof(input));
	ring_buf_commit(&rb, sizeof(input));

	/* clearing start of buffer to test wrap-around */
	zassert_equal(sizeof(input) - 3, ring_buf_get(&rb, tmp, sizeof(input) - 3),
			"Unexpected read size");
	zassert_true(memcmp(tmp, input, sizeof(input) - 3) == 0, "Data corrupted after get");

	write_sz = ring_buf_put_ptr(&rb, &ref, 0);
	zassert_equal(write_sz, sizeof(buf) - sizeof(input),
			"Unexpected write size, should be able to write up to buffer end");
	zassert_equal(ref, &buf[sizeof(buf) - write_sz],
			"Data pointer incorrect after wrap-around put_ptr");

	write_sz2 = ring_buf_put_ptr(&rb, &ref2, 0);
	zassert_equal(write_sz2, write_sz, "Subsequent put_ptr calls returned different sizes");
	zassert_equal(ref, ref2, "Subsequent put_ptr calls returned different pointers");

	memcpy(ref, &input[0], write_sz);
	ring_buf_commit(&rb, write_sz);

	write_sz = ring_buf_put_ptr(&rb, &ref, 0);
	zassert_equal(write_sz, sizeof(input) - 3,
			"Unexpected write size, should be able to write until data start");
	zassert_equal(ref, buf, "Data pointer incorrect after full buffer wrap-around put_ptr");
	write_sz2 = ring_buf_put_ptr(&rb, &ref2, 0);
	zassert_equal(write_sz2, write_sz, "Subsequent put_ptr calls returned different sizes");
	zassert_equal(ref, ref2, "Subsequent put_ptr calls returned different pointers");
	memcpy(ref, &input[0], write_sz);
	ring_buf_commit(&rb, write_sz);
	zassert_equal(ring_buf_size_get(&rb), sizeof(buf), "buffer should be full now");
	zassert_equal(ring_buf_space_get(&rb), 0, "no space should be left in buffer");
}


ZTEST(ringbuffer_api, test_ringbuffer_get_ptr)
{
	uint8_t *ref, *ref2;
	size_t read_sz;
	uint8_t buf[16];
	uint8_t input[13];
	struct ring_buf rb;

	for (uint8_t i = 0; i < sizeof(input); i++) {
		input[i] = i;
	}

	ring_buf_init(&rb, sizeof(buf), buf);

	zassert_equal(0, ring_buf_get_ptr(&rb, &ref, 0), "get_ptr on empty buffer should return 0");
	zassert_equal(sizeof(input), ring_buf_put(&rb, input, sizeof(input)),
			"Unexpected write size");

	read_sz = ring_buf_get_ptr(&rb, &ref, 0);
	zassert_equal(read_sz, sizeof(input), "Unexpected read size");
	zassert_true(memcmp(ref, input, read_sz) == 0, "Data corrupted after get_ptr");
	zassert_equal(ring_buf_size_get(&rb), read_sz, "Size calculation incorrect after get_ptr");
	zassert_equal(ring_buf_get_ptr(&rb, &ref2, 0), read_sz,
			"Subsequent get_ptr calls returned different sizes");
	zassert_equal(ref, ref2, "Subsequent get_ptr calls returned different pointers");
	ring_buf_consume(&rb, read_sz);
	zassert_equal(0, ring_buf_get_ptr(&rb, &ref, 0),
			"get_ptr on empty buffer should return 0 after consume");

	zassert_equal(sizeof(input), ring_buf_put(&rb, input, sizeof(input)),
			"Unexpected write size");

	read_sz = ring_buf_get_ptr(&rb, &ref, 0);
	zassert_equal(sizeof(buf) - sizeof(input), read_sz,
			"get_ptr should return data up to buffer end on wrap-around");
	zassert_equal(ring_buf_get_ptr(&rb, &ref2, 0), read_sz,
			"Subsequent get_ptr calls returned different sizes");
	zassert_equal(ref, ref2, "Subsequent get_ptr calls returned different pointers");
	zassert_true(memcmp(ref, input, read_sz) == 0,
			"Data corrupted after get_ptr on wrap-around");
	ring_buf_consume(&rb, read_sz);

	read_sz = ring_buf_get_ptr(&rb, &ref, 0);
	zassert_equal(ref, buf, "Data pointer incorrect after wrap-around get_ptr");
	zassert_equal(read_sz, sizeof(input) - (sizeof(buf) - sizeof(input)),
			"get_ptr should return remaining data after wrap-around");
	zassert_true(memcmp(ref, &input[sizeof(buf) - sizeof(input)], read_sz) == 0,
			"Data corrupted after get_ptr on wrap-around");
	ring_buf_consume(&rb, read_sz);
	zassert_equal(0, ring_buf_get_ptr(&rb, &ref, 0),
			"get_ptr on empty buffer should return 0 after consuming all data");

	ring_buf_reset(&rb);
	zassert_equal(0, ring_buf_get_ptr(&rb, &ref, 0),
			"get_ptr on empty buffer should return 0 after reset");
	ring_buf_put(&rb, input, sizeof(input));
	zassert_equal(sizeof(input), ring_buf_get(&rb, input, sizeof(input)),
		"Unexpected read size");
}

ZTEST(ringbuffer_api, test_ringbuffer_put_ptr_offset)
{
	uint8_t *ref;
	uint32_t avail;
	uint8_t buf[16];
	struct ring_buf rb;

	ring_buf_init(&rb, sizeof(buf), buf);

	avail = ring_buf_put_ptr(&rb, &ref, 0);
	zassert_equal(avail, sizeof(buf), "offset 0 should expose full buffer");
	zassert_equal(ref, buf, "offset 0 should point at buffer start");

	avail = ring_buf_put_ptr(&rb, &ref, 4);
	zassert_equal(ref, &buf[4], "offset should advance the pointer");
	zassert_equal(avail, sizeof(buf) - 4, "offset should shrink available space");
	zassert_equal(ring_buf_size_get(&rb), 0, "offset must not mutate the buffer");
	zassert_equal(ring_buf_space_get(&rb), sizeof(buf), "offset must not consume space");

	avail = ring_buf_put_ptr(&rb, &ref, sizeof(buf));
	zassert_equal(ref, buf, "offset at capacity should wrap to start");
	zassert_equal(avail, 0, "no free space remains past a full reservation");
}

ZTEST(ringbuffer_api, test_ringbuffer_get_ptr_offset)
{
	uint8_t *ref;
	uint32_t avail;
	uint8_t buf[16];
	uint8_t input[16];
	struct ring_buf rb;

	for (uint8_t i = 0; i < sizeof(input); i++) {
		input[i] = i;
	}

	ring_buf_init(&rb, sizeof(buf), buf);
	ring_buf_put(&rb, input, sizeof(input));
	zassert_equal(8, ring_buf_get(&rb, input, 8), "Unexpected read size");
	zassert_equal(8, ring_buf_put(&rb, input, 8), "Unexpected write size");

	avail = ring_buf_get_ptr(&rb, &ref, 0);
	zassert_equal(avail, sizeof(buf) - 8, "offset 0 should reach buffer end");
	zassert_equal(ref, &buf[8], "offset 0 should point at read index");

	avail = ring_buf_get_ptr(&rb, &ref, 4);
	zassert_equal(ref, &buf[12], "offset should advance the read pointer");
	zassert_equal(avail, sizeof(buf) - 12, "offset should shrink available data");

	avail = ring_buf_get_ptr(&rb, &ref, sizeof(buf) - 8);
	zassert_equal(ref, buf, "offset across wrap should point at start");
	zassert_equal(avail, 8, "remaining data after wrap");

	zassert_equal(ring_buf_size_get(&rb), sizeof(buf), "offset must not consume data");
}

static void check_peek(struct ring_buf *rb, const uint8_t *expected, uint32_t len)
{
	uint8_t output[BUF_SIZE + 1];

	zassert_true(len < sizeof(output), "Test setup error: output buffer too small");

	memset(output, 0xff, sizeof(output));
	zassert_equal(ring_buf_peek(rb, output, HALF_DATA_SIZE), HALF_DATA_SIZE,
		      "Partial peek should return the requested size");
	zassert_mem_equal(output, expected, HALF_DATA_SIZE, "Partial peek returned corrupted data");

	memset(output, 0xff, sizeof(output));
	zassert_equal(ring_buf_peek(rb, output, sizeof(output)), len,
		      "Peek larger than available should return only available bytes");
	zassert_mem_equal(output, expected, len, "Peek returned corrupted data");
	zassert_equal(output[len], 0xff, "Peek wrote past the available bytes");

	memset(output, 0xff, sizeof(output));
	zassert_equal(ring_buf_peek(rb, output, len), len,
		      "Repeated peek returned a different size");
	zassert_mem_equal(output, expected, len, "Repeated peek returned different data");

	zassert_equal(ring_buf_size_get(rb), len, "Peek must not consume data");

	zassert_equal(ring_buf_get(rb, output, len), len,
		      "Peeked data should still be retrievable");
	zassert_mem_equal(output, expected, len, "Get after peek returned corrupted data");
	zassert_equal(ring_buf_size_get(rb), 0, "Buffer should be empty after get");
}

/**
 * @brief Verify peeking returns data without removing it.
 *
 * @ingroup lib_ringbuffer_tests
 * @verifies ZEP-SRS-40-4
 */
ZTEST(ringbuffer_api, test_ringbuffer_peek)
{
	uint8_t ring_storage[BUF_SIZE];
	uint8_t input_data[DATA_SIZE];
	struct ring_buf rb;

	for (uint8_t i = 0; i < DATA_SIZE; i++) {
		input_data[i] = i;
	}

	ring_buf_init(&rb, sizeof(ring_storage), ring_storage);
	zassert_equal(ring_buf_put(&rb, input_data, DATA_SIZE), DATA_SIZE,
		      "Failed to write input payload");

	check_peek(&rb, input_data, DATA_SIZE);
}

ZTEST(ringbuffer_api, test_ringbuffer_peek_wrap)
{
	uint8_t ring_storage[BUF_SIZE];
	uint8_t input_data[DATA_SIZE];
	uint8_t scratch[DATA_SIZE];
	struct ring_buf rb;

	BUILD_ASSERT(DATA_SIZE < BUF_SIZE && 2 * DATA_SIZE > BUF_SIZE,
		     "Setup relies on the payload straddling the physical buffer end");

	for (uint8_t i = 0; i < DATA_SIZE; i++) {
		input_data[i] = i;
	}

	ring_buf_init(&rb, sizeof(ring_storage), ring_storage);

	/* prime ring_buffer to produce wrap case for peek */
	zassert_equal(ring_buf_put(&rb, input_data, DATA_SIZE), DATA_SIZE,
		      "Failed to prime buffer");
	zassert_equal(ring_buf_get(&rb, scratch, DATA_SIZE), DATA_SIZE, "Failed to drain buffer");
	zassert_equal(ring_buf_put(&rb, input_data, DATA_SIZE), DATA_SIZE,
		      "Failed to write input payload");

	check_peek(&rb, input_data, DATA_SIZE);
}

ZTEST_SUITE(ringbuffer_api, NULL, NULL, NULL, NULL, NULL);
```

## src/benchmark.c
```c
#include <string.h>
#include <zephyr/ztest.h>
#include <zephyr/sys/ring_buffer.h>

#define BENCH_BUF_SIZE 128
#define BENCH_OP_SIZE  16

static uint8_t bench_storage[BENCH_BUF_SIZE];
static struct ring_buf bench_rb;
static uint8_t bench_payload[BENCH_OP_SIZE];
static uint8_t *bench_ptr;

static void suite_setup(void)
{
	ring_buf_init(&bench_rb, BENCH_BUF_SIZE, bench_storage);
}

ZTEST_BENCHMARK_SUITE(ring_buffer, suite_setup, NULL);

static void setup_empty(void)
{
	ring_buf_reset(&bench_rb);
}

static void setup_full(void)
{
	ring_buf_reset(&bench_rb);
	ring_buf_put(&bench_rb, bench_payload, BENCH_OP_SIZE);
}

static void setup_pending_put_ptr(void)
{
	setup_empty();
	ring_buf_put_ptr(&bench_rb, &bench_ptr);
}

static void setup_pending_get_ptr(void)
{
	setup_full();
	ring_buf_get_ptr(&bench_rb, &bench_ptr);
}

static void advance_heads(uint32_t bytes)
{
	while (bytes) {
		uint32_t step = MIN(bytes, BENCH_OP_SIZE);

		ring_buf_put(&bench_rb, bench_payload, step);
		ring_buf_get(&bench_rb, bench_payload, step);
		bytes -= step;
	}
}

static void setup_pre_wrap_empty(void)
{
	setup_empty();
	advance_heads(BENCH_BUF_SIZE - BENCH_OP_SIZE / 2);
}

static void setup_pre_wrap_full(void)
{
	setup_pre_wrap_empty();
	ring_buf_put(&bench_rb, bench_payload, BENCH_OP_SIZE);
}

ZTEST_BENCHMARK_SETUP_TEARDOWN(ring_buffer, put, 100, setup_empty, NULL)
{
	ring_buf_put(&bench_rb, bench_payload, BENCH_OP_SIZE);
}

ZTEST_BENCHMARK_SETUP_TEARDOWN(ring_buffer, get, 100, setup_full, NULL)
{
	ring_buf_get(&bench_rb, bench_payload, BENCH_OP_SIZE);
}

ZTEST_BENCHMARK_SETUP_TEARDOWN(ring_buffer, put_ptr, 100, setup_empty, NULL)
{
	ring_buf_put_ptr(&bench_rb, &bench_ptr);
}

ZTEST_BENCHMARK_SETUP_TEARDOWN(ring_buffer, commit, 100, setup_pending_put_ptr, NULL)
{
	ring_buf_commit(&bench_rb, BENCH_OP_SIZE);
}

ZTEST_BENCHMARK_SETUP_TEARDOWN(ring_buffer, get_ptr, 100, setup_full, NULL)
{
	ring_buf_get_ptr(&bench_rb, &bench_ptr);
}

ZTEST_BENCHMARK_SETUP_TEARDOWN(ring_buffer, consume, 100, setup_pending_get_ptr, NULL)
{
	ring_buf_consume(&bench_rb, BENCH_OP_SIZE);
}

ZTEST_BENCHMARK_SETUP_TEARDOWN(ring_buffer, put_ptr_commit_wrap, 100, setup_pre_wrap_empty, NULL)
{
	uint8_t *p;
	uint32_t off = 0;

	while (off < BENCH_OP_SIZE) {
		uint32_t n = MIN(ring_buf_put_ptr(&bench_rb, &p), BENCH_OP_SIZE - off);

		memcpy(p, bench_payload + off, n);
		ring_buf_commit(&bench_rb, n);
		off += n;
	}
}

ZTEST_BENCHMARK_SETUP_TEARDOWN(ring_buffer, get_ptr_consume_wrap, 100, setup_pre_wrap_full, NULL)
{
	uint8_t out[BENCH_OP_SIZE];
	uint8_t *p;
	uint32_t off = 0;

	while (off < BENCH_OP_SIZE) {
		uint32_t n = MIN(ring_buf_get_ptr(&bench_rb, &p), BENCH_OP_SIZE - off);

		memcpy(out + off, p, n);
		ring_buf_consume(&bench_rb, n);
		off += n;
	}
}
```

## src/benchmarks.c
```c
/*
 * Copyright (c) 2016 Intel Corporation
 *
 * SPDX-License-Identifier: Apache-2.0
 */

#include <zephyr/ztest.h>
#include <zephyr/sys/ring_buffer.h>

/* Ring buffer performance benchmarks. Each benchmark performs one full
 * put followed by one full get per sample, so the ring buffer is balanced
 * across iterations and never overflows or underflows.
 */
#define PERF_BUF_SIZE 16
#define PERF_SAMPLES  1000

static uint8_t perf_buf[PERF_BUF_SIZE];
static uint8_t perf_indata[PERF_BUF_SIZE];
static uint8_t perf_outdata[PERF_BUF_SIZE];
static struct ring_buf perf_rbuf;

static void perf_setup(void)
{
	ring_buf_init(&perf_rbuf, sizeof(perf_buf), perf_buf);
}

ZTEST_BENCHMARK_SUITE(ringbuffer_perf, NULL, NULL);

ZTEST_BENCHMARK(ringbuffer_perf, put_get_1byte, PERF_SAMPLES, perf_setup, NULL)
{
	ring_buf_put(&perf_rbuf, perf_indata, 1);
	ring_buf_get(&perf_rbuf, perf_outdata, 1);
}

ZTEST_BENCHMARK(ringbuffer_perf, put_get_4byte, PERF_SAMPLES, perf_setup, NULL)
{
	ring_buf_put(&perf_rbuf, perf_indata, 4);
	ring_buf_get(&perf_rbuf, perf_outdata, 4);
}

ZTEST_BENCHMARK(ringbuffer_perf, put_ptr_commit_1byte, PERF_SAMPLES, perf_setup, NULL)
{
	uint8_t *ptr;

	ring_buf_put_ptr(&perf_rbuf, &ptr);
	ring_buf_commit(&perf_rbuf, 1);
	ring_buf_get(&perf_rbuf, perf_outdata, 1);
}

ZTEST_BENCHMARK(ringbuffer_perf, put_ptr_commit_5byte, PERF_SAMPLES, perf_setup, NULL)
{
	uint8_t *ptr;

	ring_buf_put_ptr(&perf_rbuf, &ptr);
	ring_buf_commit(&perf_rbuf, 5);
	ring_buf_get(&perf_rbuf, perf_outdata, 5);
}

ZTEST_BENCHMARK(ringbuffer_perf, get_ptr_consume_5byte, PERF_SAMPLES, perf_setup, NULL)
{
	uint8_t *ptr;

	ring_buf_put(&perf_rbuf, perf_indata, 5);
	ring_buf_get_ptr(&perf_rbuf, &ptr);
	ring_buf_consume(&perf_rbuf, 5);
}
```

## src/concurrent.c
```c
/*
 * Copyright (c) 2021 Intel Corporation
 *
 * SPDX-License-Identifier: Apache-2.0
 */
#include <zephyr/ztest.h>
#include <zephyr/ztress.h>
#include <zephyr/sys/ring_buffer.h>
#include <zephyr/sys/mutex.h>
#include <zephyr/random/random.h>
#include <stdint.h>

/**
 * @defgroup lib_ringbuffer_tests Ringbuffer
 * @ingroup all_tests
 * @{
 * @}
 */

#define PTR_RINGBUFFER			32

static ZTEST_BMEM struct ring_buf ptr_ringbuf;
static ZTEST_BMEM uint8_t ptr_buffer[PTR_RINGBUFFER];

static bool produce_ptr(void *user_data, uint32_t iter_cnt, bool last, int prio)
{
	static int cnt;
	static uint32_t wr = 8;
	uint32_t len;
	uint8_t *data;

	if (iter_cnt == 0) {
		cnt = 0;
		wr = 8;
	}

	len = ring_buf_put_ptr(&ptr_ringbuf, &data, 0);
	if (len == 0) {
		return true;
	}

	len = MIN(len, wr);
	for (uint32_t i = 0; i < len; i++) {
		data[i] = cnt++;
	}
	ring_buf_commit(&ptr_ringbuf, len);

	wr++;
	if (wr == 15) {
		wr = 8;
	}

	return true;
}

static bool consume_ptr(void *user_data, uint32_t iter_cnt, bool last, int prio)
{
	static int cnt;
	static uint32_t rd = 8;
	uint32_t len;
	uint8_t *data;

	if (iter_cnt == 0) {
		cnt = 0;
		rd = 8;
	}

	len = ring_buf_get_ptr(&ptr_ringbuf, &data, 0);
	if (len == 0) {
		return true;
	}

	len = MIN(len, rd);
	for (uint32_t i = 0; i < len; i++) {
		zassert_equal(data[i], (uint8_t)cnt,
			      "Got %02x, exp: %02x", data[i], (uint8_t)cnt);
		cnt++;
	}
	ring_buf_consume(&ptr_ringbuf, len);

	rd++;
	if (rd == 15) {
		rd = 8;
	}

	return true;
}

static void test_ptr_ztress(ztress_handler high_handler, ztress_handler low_handler)
{
	ring_buf_idx_t offset;
	k_timeout_t timeout;

	ring_buf_init(&ptr_ringbuf, sizeof(ptr_buffer), ptr_buffer);

#ifdef CONFIG_RING_BUFFER
	offset = (ring_buf_idx_t)-1 - ring_buf_capacity_get(&ptr_ringbuf) / 2;
	ring_buf_internal_reset(&ptr_ringbuf, offset);
#else
	offset = 2 * ring_buf_capacity_get(&ptr_ringbuf) -
		 ring_buf_capacity_get(&ptr_ringbuf) / 2;
	ptr_ringbuf.read_idx = offset;
	ptr_ringbuf.write_idx = offset;
#endif

	timeout = (CONFIG_SYS_CLOCK_TICKS_PER_SEC < 10000) ? K_MSEC(1000) : K_MSEC(10000);
	ztress_set_timeout(timeout);
	ZTRESS_EXECUTE(ZTRESS_THREAD(high_handler, NULL, 0, 0, Z_TIMEOUT_TICKS(20)),
		       ZTRESS_THREAD(low_handler, NULL, 0, 2000, Z_TIMEOUT_TICKS(20)));
}

/**
 * @brief Verify one producer and one consumer can run concurrently without extra locking.
 *
 * @ingroup lib_ringbuffer_tests
 * @verifies ZEP-SRS-40-10
 */
ZTEST(ringbuffer_api, test_ringbuffer_ptr_stress)
{
	PRINT("Producing interrupts consuming\n");
	test_ptr_ztress(produce_ptr, consume_ptr);

	PRINT("Consuming interrupts producing\n");
	test_ptr_ztress(consume_ptr, produce_ptr);
}

#ifdef CONFIG_RING_BUFFER

#define STACKSIZE (512 + CONFIG_TEST_EXTRA_STACK_SIZE)

#define RINGBUFFER			256
#define LENGTH				64
#define VALUE				0xb
#define TYPE				0xc

static ZTEST_BMEM SYS_MUTEX_DEFINE(mutex);
RING_BUF_ITEM_DECLARE(ringbuf, RINGBUFFER);
static uint32_t data_output[LENGTH];
static uint32_t databuffer1[LENGTH];
static uint32_t databuffer2[LENGTH];

static void data_write(uint32_t *input)
{
	sys_mutex_lock(&mutex, K_FOREVER);
	int ret = ring_buf_item_put(&ringbuf, TYPE, VALUE,
				   input, LENGTH);
	zassert_equal(ret, 0);
	sys_mutex_unlock(&mutex);
}

static void data_read(uint32_t *output)
{
	uint16_t type;
	uint8_t value, size32 = LENGTH;
	int ret;

	sys_mutex_lock(&mutex, K_FOREVER);
	ret = ring_buf_item_get(&ringbuf, &type, &value, output, &size32);
	sys_mutex_unlock(&mutex);

	zassert_equal(ret, 0);
	zassert_equal(type, TYPE);
	zassert_equal(value, VALUE);
	zassert_equal(size32, LENGTH);
	if (output[0] == 1) {
		zassert_equal(memcmp(output, databuffer1, size32 * sizeof(uint32_t)), 0);
	} else {
		zassert_equal(memcmp(output, databuffer2, size32 * sizeof(uint32_t)), 0);
	}
}

static bool user_handler(void *user_data, uint32_t iter_cnt, bool last, int prio)
{
	uintptr_t id = (uintptr_t)user_data;
	uint32_t *buffer = id ? databuffer2 : databuffer1;

	if (iter_cnt == 0) {
		for (int i = 0; i < LENGTH; i++) {
			buffer[i] = 1;
		}
	}

	/* Try to write data into the ringbuffer */
	data_write(buffer);
	/* Try to get data from the ringbuffer and check */
	data_read(data_output);

	return true;
}

/**
 * @brief Test that prevent concurrent writing
 * operations by using a mutex
 *
 * @details Define a ring buffer and a mutex,
 * and then spawn two threads to read and
 * write the same buffer at the same time to
 * check the integrity of data reading and writing.
 *
 * @ingroup lib_ringbuffer_tests
 */
ZTEST(ringbuffer_api, test_ringbuffer_concurrent)
{
	ztress_set_timeout(K_MSEC(1000));
	ZTRESS_EXECUTE(ZTRESS_THREAD(user_handler, (void *)0, 0, 0, Z_TIMEOUT_TICKS(20)),
		       ZTRESS_THREAD(user_handler, (void *)1, 0, 10, Z_TIMEOUT_TICKS(20)));
}

static bool produce_cpy(void *user_data, uint32_t iter_cnt, bool last, int prio)
{
	static int cnt;
	uint8_t buf[3];
	uint32_t len;

	if (iter_cnt == 0) {
		cnt = 0;
	}

	for (int i = 0; i < sizeof(buf); i++) {
		buf[i] = (uint8_t)cnt++;
	}

	len = ring_buf_put(&ringbuf, buf, sizeof(buf));
	cnt -= (sizeof(buf) - len);

	return true;
}

static bool consume_cpy(void *user_data, uint32_t iter_cnt, bool last, int prio)
{
	static int cnt;
	uint8_t buf[3];
	uint32_t len;

	if (iter_cnt == 0) {
		cnt = 0;
	}

	len = ring_buf_get(&ringbuf, buf, sizeof(buf));
	for (int i = 0; i < len; i++) {
		zassert_equal(buf[i], (uint8_t)cnt);
		cnt++;
	}

	return true;
}

static bool produce_item(void *user_data, uint32_t cnt, bool last, int prio)
{
	int err;
	static uint32_t pcnt;
	uint32_t buf[2];

	if (cnt == 0) {
		pcnt = 0;
	}

	err = ring_buf_item_put(&ringbuf, (uint16_t)pcnt, VALUE, buf, 2);
	if (err == 0) {
		pcnt++;
	}

	return true;
}

static bool consume_item(void *user_data, uint32_t cnt, bool last, int prio)
{
	int err;
	static uint32_t pcnt;
	uint32_t data[2];
	uint16_t type;
	uint8_t value;
	uint8_t size32 = ARRAY_SIZE(data);

	if (cnt == 0) {
		pcnt = 0;
	}

	err = ring_buf_item_get(&ringbuf, &type, &value, data, &size32);
	if (err == 0) {
		zassert_equal(value, VALUE);
		zassert_equal(type, (uint16_t)pcnt);
		pcnt++;
	} else if (err == -EMSGSIZE) {
		zassert_true(false);
	}

	return true;
}

static bool produce(void *user_data, uint32_t iter_cnt, bool last, int prio)
{
	static int cnt;
	static int wr = 8;
	uint32_t len;
	uint8_t *data;

	if (iter_cnt == 0) {
		cnt = 0;
	}

	len = ring_buf_put_claim(&ringbuf, &data, wr);
	if (len == 0) {
		len = ring_buf_put_claim(&ringbuf, &data, wr);
	}

	if (len == 0) {
		return true;
	}

	for (uint32_t i = 0; i < len; i++) {
		data[i] = cnt++;
	}

	wr++;
	if (wr == 15) {
		wr = 8;
	}

	int err = ring_buf_put_finish(&ringbuf, len);

	zassert_equal(err, 0, "cnt: %d", cnt);

	return true;
}

static bool consume(void *user_data, uint32_t iter_cnt, bool last, int prio)
{
	static int rd = 8;
	static int cnt;
	uint32_t len;
	uint8_t *data;

	if (iter_cnt == 0) {
		cnt = 0;
	}

	len = ring_buf_get_claim(&ringbuf, &data, rd);
	if (len == 0) {
		len = ring_buf_get_claim(&ringbuf, &data, rd);
	}

	if (len == 0) {
		return true;
	}

	for (uint32_t i = 0; i < len; i++) {
		zassert_equal(data[i], (uint8_t)cnt,
			      "Got %02x, exp: %02x", data[i], (uint8_t)cnt);
		cnt++;
	}

	rd++;
	if (rd == 15) {
		rd = 8;
	}

	int err = ring_buf_get_finish(&ringbuf, len);

	zassert_equal(err, 0);

	return true;
}

static void test_ztress(ztress_handler high_handler,
			ztress_handler low_handler,
			bool item_mode)
{
	union {
		uint8_t buf8[32];
		uint32_t buf32[32];
	} buf;
	k_timeout_t timeout;
	uint32_t offset;

	if (item_mode) {
		ring_buf_item_init(&ringbuf, ARRAY_SIZE(buf.buf32), buf.buf32);
	} else {
		ring_buf_init(&ringbuf, ARRAY_SIZE(buf.buf8), buf.buf8);
	}

	/* force internal index roll-over */
	offset = (ring_buf_idx_t)-1 - ring_buf_capacity_get(&ringbuf)/2;
	ring_buf_internal_reset(&ringbuf, offset);

	/* Timeout after 5 seconds. */
	timeout =  (CONFIG_SYS_CLOCK_TICKS_PER_SEC < 10000) ? K_MSEC(1000) : K_MSEC(10000);

	ztress_set_timeout(timeout);
	ZTRESS_EXECUTE(ZTRESS_THREAD(high_handler, NULL, 0, 0, Z_TIMEOUT_TICKS(20)),
		       ZTRESS_THREAD(low_handler, NULL, 0, 2000, Z_TIMEOUT_TICKS(20)));
}

void test_ringbuffer_stress(ztress_handler produce_handler,
			    ztress_handler consume_handler,
			    bool item_mode)
{
	PRINT("Producing interrupts consuming\n");
	test_ztress(produce_handler, consume_handler, item_mode);

	PRINT("Consuming interrupts producing\n");
	test_ztress(consume_handler, produce_handler, item_mode);
}

/* Zero-copy API. Test is validating single producer, single consumer from
 * different priorities.
 */
ZTEST(ringbuffer_api, test_ringbuffer_zerocpy_stress)
{
	test_ringbuffer_stress(produce, consume, false);
}

/* Copy API. Test is validating single producer, single consumer from
 * different priorities.
 */
ZTEST(ringbuffer_api, test_ringbuffer_cpy_stress)
{
	test_ringbuffer_stress(produce_cpy, consume_cpy, false);
}

/* Item API. Test is validating single producer, single consumer from
 * different priorities.
 */
ZTEST(ringbuffer_api, test_ringbuffer_item_stress)
{
	test_ringbuffer_stress(produce_item, consume_item, true);
}

#endif /* CONFIG_RING_BUFFER */
```

## src/index_math.c
```c
/*
 * Copyright (c) 2026 Zephyr Project Contributors
 *
 * SPDX-License-Identifier: Apache-2.0
 */

#include <zephyr/ztest.h>
#include <zephyr/sys/ring_buffer.h>

static uint8_t edge_dummy[1];
static inline void edge_fake_max_init(struct ring_buf *rb)
{
	/* As no data is pushed to the buffer, this is still illegal but allows us
	 * to test index math at the maximum size without needing to allocate a
	 * large buffer
	 */
	ring_buf_init(rb, RING_BUFFER_MAX_SIZE, edge_dummy);
}

ZTEST(ringbuffer_index_math, test_max_size_constants)
{
	struct ring_buf rb;

	zassert_equal(sizeof(rb.size), sizeof(ring_buf_idx_t));
	zassert_equal(sizeof(rb.read_idx), sizeof(ring_buf_idx_t));
	zassert_equal(sizeof(rb.write_idx), sizeof(ring_buf_idx_t));
#ifdef CONFIG_RING_BUFFER_LARGE
	zassert_equal(RING_BUFFER_MAX_SIZE, UINT32_MAX / 4);
#else
	zassert_equal(RING_BUFFER_MAX_SIZE, UINT16_MAX / 2);
#endif
}

ZTEST(ringbuffer_index_math, test_init_at_max_size)
{
	struct ring_buf rb;

	edge_fake_max_init(&rb);
	zassert_equal(ring_buf_capacity_get(&rb), RING_BUFFER_MAX_SIZE);
	zassert_equal(ring_buf_space_get(&rb), RING_BUFFER_MAX_SIZE);
	zassert_equal(ring_buf_size_get(&rb), 0);
	zassert_true(ring_buf_is_empty(&rb));
	zassert_false(ring_buf_is_full(&rb));
}

/**
 * @brief Verify a maximum-size ring buffer fills completely and reports empty and full states.
 *
 * @ingroup lib_ringbuffer_tests
 * @verifies ZEP-SRS-40-8
 */
ZTEST(ringbuffer_index_math, test_fill_completely_max_size)
{
	struct ring_buf rb;
	uint32_t written = 0;
	uint32_t read = 0;
	uint32_t avail;
	uint8_t *p;

	edge_fake_max_init(&rb);

	while ((avail = ring_buf_put_ptr(&rb, &p, 0))) {
		ring_buf_commit(&rb, avail);
		written += avail;
	}
	zassert_equal(written, RING_BUFFER_MAX_SIZE);
	zassert_true(ring_buf_is_full(&rb));
	zassert_equal(ring_buf_size_get(&rb), RING_BUFFER_MAX_SIZE);
	zassert_equal(ring_buf_space_get(&rb), 0);
	zassert_equal(ring_buf_put_ptr(&rb, &p, 0), 0);

	while ((avail = ring_buf_get_ptr(&rb, &p, 0))) {
		ring_buf_consume(&rb, avail);
		read += avail;
	}
	zassert_equal(read, RING_BUFFER_MAX_SIZE);
	zassert_true(ring_buf_is_empty(&rb));
}

ZTEST(ringbuffer_index_math, test_index_at_storage_top)
{
	struct ring_buf rb;

	edge_fake_max_init(&rb);

	rb.read_idx = (ring_buf_idx_t)(rb.size - 2);
	rb.write_idx = (ring_buf_idx_t)(rb.size - 2);
	zassert_true(ring_buf_is_empty(&rb));
	zassert_equal(ring_buf_size_get(&rb), 0);

	ring_buf_commit(&rb, 1);
	zassert_equal(rb.write_idx, rb.size - 1);
	zassert_false(ring_buf_is_full(&rb));
	zassert_equal(ring_buf_size_get(&rb), 1);

	ring_buf_commit(&rb, 1);
	zassert_equal(rb.write_idx, rb.size);
	zassert_equal(ring_buf_size_get(&rb), 2);

	ring_buf_consume(&rb, 2);
	zassert_true(ring_buf_is_empty(&rb));
	zassert_equal(rb.read_idx, rb.write_idx);
}


ZTEST(ringbuffer_index_math, test_size_get_wrap_branch_at_max)
{
	struct ring_buf rb;

	edge_fake_max_init(&rb);

	rb.read_idx = RING_BUFFER_MAX_SIZE - 2;
	rb.write_idx = RING_BUFFER_MAX_SIZE + 3;

	zassert_equal(ring_buf_capacity_get(&rb), RING_BUFFER_MAX_SIZE);
	zassert_equal(ring_buf_size_get(&rb), 5, "expected %u, got %u", 5, ring_buf_size_get(&rb));
	zassert_equal(ring_buf_space_get(&rb), ring_buf_capacity_get(&rb) - 5);
	zassert_false(ring_buf_is_empty(&rb));
	zassert_false(ring_buf_is_full(&rb));
}

ZTEST(ringbuffer_index_math, test_put_size_uint32_max)
{
	uint8_t buf[16];
	uint8_t src[16];
	struct ring_buf rb;
	uint32_t n;

	for (size_t i = 0; i < sizeof(src); i++) {
		src[i] = (uint8_t)i;
	}
	ring_buf_init(&rb, sizeof(buf), buf);

	n = ring_buf_put(&rb, src, UINT32_MAX);
	zassert_equal(n, ring_buf_capacity_get(&rb));
	zassert_true(ring_buf_is_full(&rb));
	zassert_equal(ring_buf_size_get(&rb), ring_buf_capacity_get(&rb));
}

ZTEST(ringbuffer_index_math, test_get_size_uint32_max)
{
	uint8_t buf[16];
	uint8_t src[15];
	uint8_t dst[15] = {0};
	struct ring_buf rb;
	uint32_t n;

	for (size_t i = 0; i < sizeof(src); i++) {
		src[i] = i;
	}
	ring_buf_init(&rb, sizeof(buf), buf);
	zassert_equal(ring_buf_put(&rb, src, sizeof(src)), sizeof(src));

	n = ring_buf_get(&rb, dst, UINT32_MAX);
	zassert_equal(n, sizeof(dst));
	for (size_t i = 0; i < sizeof(dst); i++) {
		zassert_equal(dst[i], i);
	}
	zassert_true(ring_buf_is_empty(&rb));
}

ZTEST(ringbuffer_index_math, test_peek_size_uint32_max)
{
	uint8_t buf[16];
	uint8_t src[15];
	uint8_t dst[15] = {0};
	struct ring_buf rb;
	uint32_t n;

	for (size_t i = 0; i < sizeof(src); i++) {
		src[i] = i;
	}
	ring_buf_init(&rb, sizeof(buf), buf);
	zassert_equal(ring_buf_put(&rb, src, sizeof(src)), sizeof(src));

	n = ring_buf_peek(&rb, dst, UINT32_MAX);
	zassert_equal(n, sizeof(src));
	for (size_t i = 0; i < sizeof(dst); i++) {
		zassert_equal(dst[i], i);
	}
	zassert_equal(ring_buf_size_get(&rb), sizeof(src));
	zassert_false(ring_buf_is_empty(&rb));
}

ZTEST(ringbuffer_index_math, test_commit_consume_full_storage_walk)
{
	struct ring_buf rb;
	const uint32_t window = 256;

	edge_fake_max_init(&rb);

	/* Force the index math to wrap around the underlying index type and
	 * verify size/capacity tracking
	 */
	rb.read_idx = (ring_buf_idx_t)(RING_BUFFER_MAX_SIZE - (window / 2));
	rb.write_idx = rb.read_idx;

	zassert_true(ring_buf_is_empty(&rb));
	zassert_true(!ring_buf_is_full(&rb));
	for (uint32_t i = 0; i < window; i++) {
		ring_buf_commit(&rb, 1);
		zassert_true(ring_buf_size_get(&rb) == 1, "size should be 1 after commit");
		ring_buf_consume(&rb, 1);
		zassert_true(ring_buf_size_get(&rb) == 0, "size should be 0 after consume");
		zassert_equal(rb.read_idx, rb.write_idx);
	}
	zassert_true(ring_buf_is_empty(&rb));
}

ZTEST_SUITE(ringbuffer_index_math, NULL, NULL, NULL, NULL, NULL);
```
