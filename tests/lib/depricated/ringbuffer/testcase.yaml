## tests/lib/depricated/ringbuffer/testcase.yaml
```yaml
common:
  tags:
    - ring_buffer
    - circular_buffer
  ignore_faults: true
  timeout: 150

tests:
  libraries.ring_buf:
    integration_platforms:
      - native_sim
      - native_sim/native/64

  libraries.ring_buf.concurrent:
    platform_allow: qemu_x86
    extra_configs:
      - CONFIG_SYS_CLOCK_TICKS_PER_SEC=100000
    integration_platforms:
      - qemu_x86
```

## tests/lib/devicetree/api/dts/bindings/test-unique-device-type.yaml
```yaml
# Copyright (c) 2024 Vestas Wind Systems A/S
# SPDX-License-Identifier: Apache-2.0

description: Test node with unique zephyr,device-type

compatible: "test-unique-device-type"

include: base.yaml

properties:
  zephyr,device-type:
    default: test-unique-device-type-string
    const: test-unique-device-type-string
```

## tests/lib/devicetree/api/testcase.yaml
```yaml
tests:
  libraries.devicetree.api:
    tags: devicetree
    # We only need this to run on one platform so use native_sim as it
    # will mostly likely be the fastest.
    platform_allow:
      - native_posix
      - native_sim
      - qemu_x86
      - qemu_x86_64
      - qemu_cortex_m3
      - qemu_riscv32
    integration_platforms:
      - native_sim
```

## tests/lib/devicetree/api_ext/testcase.yaml
```yaml
tests:
  libraries.devicetree.api_ext:
    tags: devicetree
    # We only need this to run on one platform so use native_sim as it
    # will mostly likely be the fastest.
    integration_platforms:
      - native_sim
    platform_exclude: kit_psc3m5_evk
```

## tests/lib/devicetree/boot_order/testcase.yaml
```yaml
tests:

  libraries.devicetree.boot_order:
    platform_allow: native_posix
    tags: devicetree
```

## tests/lib/devicetree/devices/testcase.yaml
```yaml
tests:
  libraries.devicetree.devices:
    tags: devicetree
    # We only need this to run on one platform so use native_sim as it
    # will mostly likely be the fastest.
    integration_platforms:
      - native_sim
    # The test instantiate few vnd,i2c devices so it fails with boards with
    # devices that select I2C.
    platform_allow:
      - native_sim
```

## tests/lib/devicetree/memory_region/testcase.yaml
```yaml
tests:

  libraries.devicetree.memory_region:
    platform_allow: qemu_cortex_m3/ti_lm3s6965
    tags: devicetree

  libraries.devicetree.memory_region.linker_generator:
    platform_allow: qemu_cortex_m3/ti_lm3s6965
    tags: devicetree
    extra_configs:
      - CONFIG_CMAKE_LINKER_GENERATOR=y
```

## tests/lib/devicetree/memory_region_flags/testcase.yaml
```yaml
tests:

  libraries.devicetree.memory_region_flags:
    harness: pytest
    platform_allow: qemu_cortex_m3
    tags:
      - devicetree
      - pytest

  libraries.devicetree.memory_region_flags.linker_generator:
    harness: pytest
    platform_allow: qemu_cortex_m3
    tags:
      - devicetree
      - pytest
    extra_configs:
      - CONFIG_CMAKE_LINKER_GENERATOR=y
```

## tests/lib/fast_console_output/testcase.yaml
```yaml
tests:
  lib.os.fast_console_output:
    tags: fast_console_output
    filter: CONFIG_BOARD_INTEL_ADSP_CAVS15 or CONFIG_BOARD_INTEL_ADSP_CAVS18 or CONFIG_BOARD_INTEL_ADSP_CAVS25
    timeout: 180
    integration_platforms:
      - intel_adsp_cavs15
      - intel_adsp_cavs18
      - intel_adsp_cavs25
```

## tests/lib/fdtable/Kconfig
```kconfig
# Copyright (c) 2025 Embeint Pty Ltd
# SPDX-License-Identifier: Apache-2.0

config ZVFS_OPEN_ADD_SIZE_TEST
	int
	default 1

source "Kconfig.zephyr"
```

## tests/lib/fdtable/testcase.yaml
```yaml
tests:
  libraries.os.fdtable:
    tags: fdtable
    integration_platforms:
      - qemu_x86
```

## tests/lib/gui/lvgl/boards/stm32h747i_disco_stm32h747xx_m7.conf
```kconfig
CONFIG_FS_LITTLEFS_FC_HEAP_SIZE=2048
CONFIG_MAIN_STACK_SIZE=2048

CONFIG_DUMMY_DISPLAY=n

CONFIG_NOCACHE_MEMORY=y
```

## tests/lib/gui/lvgl/testcase.yaml
```yaml
common:
  tags:
    - display
    - gui
tests:
  libraries.gui.lvgl:
    platform_allow:
      - native_sim/native/64
      - native_sim
    integration_platforms:
      - native_sim
  libraries.gui.lvgl.dynamic.heap.libc:
    filter: CONFIG_FULL_LIBC_SUPPORTED
    extra_configs:
      - CONFIG_REQUIRES_FULL_LIBC=y
      - CONFIG_LV_Z_BUFFER_ALLOC_DYNAMIC=y
      - CONFIG_LV_Z_MEM_POOL_HEAP_LIB_C=y
    platform_allow:
      - native_sim/native/64
      - native_sim
    integration_platforms:
      - native_sim
  libraries.gui.lvgl.dynamic.pool.sys_heap:
    extra_configs:
      - CONFIG_LV_Z_BUFFER_ALLOC_DYNAMIC=y
      - CONFIG_LV_Z_MEM_POOL_SYS_HEAP=y
      - CONFIG_LV_Z_MEM_POOL_SIZE=98304
    platform_allow:
      - native_sim/native/64
      - native_sim
    integration_platforms:
      - native_sim
  libraries.gui.lvgl.16bit:
    extra_configs:
      - CONFIG_LV_COLOR_DEPTH_16=y
    platform_allow:
      - native_sim/native/64
      - native_sim
    integration_platforms:
      - native_sim
  libraries.gui.lvgl.8bit:
    extra_configs:
      - CONFIG_LV_COLOR_DEPTH_8=y
    platform_allow:
      - native_sim/native/64
      - native_sim
    integration_platforms:
      - native_sim
  libraries.gui.lvgl.mono:
    extra_configs:
      - CONFIG_LV_COLOR_DEPTH_1=y
    platform_allow:
      - native_sim/native/64
      - native_sim
    integration_platforms:
      - native_sim
  libraries.gui.lvgl.16bit.swap:
    extra_configs:
      - CONFIG_LV_COLOR_DEPTH_16=y
      - CONFIG_LV_COLOR_16_SWAP=y
    platform_allow:
      - native_sim/native/64
      - native_sim
    integration_platforms:
      - native_sim
  libraries.gui.lvgl.stm32h747i_disco_m7:
    platform_allow: stm32h747i_disco/stm32h747xx/m7
    extra_args:
      - SHIELD=st_b_lcd40_dsi1_mb1166
    tags:
      - shield
  libraries.gui.lvgl.stm32h747i_disco_m7_blk:
    platform_allow: stm32h747i_disco/stm32h747xx/m7
    extra_configs:
      - CONFIG_SDMMC_STM32_HWFC=y
      - CONFIG_NOCACHE_MEMORY=y
      - CONFIG_DUMMY_DISPLAY=n
    extra_args:
      - SHIELD=st_b_lcd40_dsi1_mb1166
      - EXTRA_CONF_FILE=prj_blk.conf
    tags:
      - shield
```

## tests/lib/gui/lvgl_input/testcase.yaml
```yaml
common:
  tags:
    - display
    - gui
tests:
  libraries.gui.lvgl_input:
    platform_allow:
      - native_posix/native/64
      - native_sim/native/64
      - native_sim
    integration_platforms:
      - native_sim
```

## tests/lib/hash_function/Kconfig
```kconfig
# Copyright (c) 2022 Meta
#
# SPDX-License-Identifier: Apache-2.0

config TEST_HASH_FUNC_NUM_BUCKETS
	int "Number of buckets for Hash Function test"
	range 40 2147483648
	default 40

config TEST_HASH_FUNC_NUM_ENTRIES
	int "Number of entries for Hash Function test"
	range 400 2147483648
	default 400

config TEST_HASH_FUNC_DEBUG
	bool "Print debugging information"

source "Kconfig.zephyr"
```

## tests/lib/hash_function/testcase.yaml
```yaml
# Copyright (c) 2022 Meta
#
# SPDX-License-Identifier: Apache-2.0

common:
  integration_platforms:
    - native_sim
tests:
  libraries.hash_function.identity:
    # RNG seems to be broken on qemu_cortex_a53
    platform_exclude: qemu_cortex_a53
    extra_configs:
      - CONFIG_SYS_HASH_FUNC32_CHOICE_IDENTITY=y
  libraries.hash_function.djb2:
    extra_configs:
      - CONFIG_SYS_HASH_FUNC32_DJB2=y
      - CONFIG_SYS_HASH_FUNC32_CHOICE_DJB2=y
```

## tests/lib/hash_map/Kconfig
```kconfig
# Copyright (c) 2022 Meta
#
# SPDX-License-Identifier: Apache-2.0

config TEST_LIB_HASH_MAP_MAX_ENTRIES
	int "Maximum number of Hashmap entries"
	default 40
	help
	  When benchmarking the performance of the Hashmap, it helps to be able
	  to vary the number of entries to insert or remove from the hash table
	  in a convenient way. This option translates to MANY in the test sources.

	  CONFIG_TEST_LIB_HASH_MAP_MAX_ENTRIES

	  Of course, using realloc(), we are limited by the amount of available
	  heap memory. For test scenarios using the Minimal C library, the heap
	  size is controlled via

	  CONFIG_COMMON_LIBC_MALLOC_ARENA_SIZE

	  For native_posix_64, the number of entries can be configured
	  independently of the arena size since the native libc is used.

source "Kconfig.zephyr"
```

## tests/lib/hash_map/testcase.yaml
```yaml
# Copyright (c) 2022 Meta
#
# SPDX-License-Identifier: Apache-2.0

common:
  min_ram: 24
  integration_platforms:
    - native_posix

tests:
  libraries.hash_map.separate_chaining.djb2:
    extra_configs:
      - CONFIG_COMMON_LIBC_MALLOC_ARENA_SIZE=8192
      - CONFIG_SYS_HASH_MAP_CHOICE_SC=y
      - CONFIG_SYS_HASH_FUNC32_CHOICE_DJB2=y
  libraries.hash_map.open_addressing.djb2:
    extra_configs:
      - CONFIG_COMMON_LIBC_MALLOC_ARENA_SIZE=8192
      - CONFIG_SYS_HASH_MAP_CHOICE_OA_LP=y
      - CONFIG_SYS_HASH_FUNC32_CHOICE_DJB2=y
  libraries.hash_map.cxx.djb2:
    # need newlib for the c++ runtime
    filter: TOOLCHAIN_HAS_NEWLIB == 1
    extra_configs:
      - CONFIG_NEWLIB_LIBC=y
      - CONFIG_NEWLIB_LIBC_MIN_REQUIRED_HEAP_SIZE=8192
      - CONFIG_SYS_HASH_MAP_CHOICE_CXX=y
```

## tests/lib/heap/testcase.yaml
```yaml
# Excludes m2gl025_miv, which is based on the renode simulator.  This
# is very slow for CPU-bound tests like this, taking upwards of 10
# minutes (vs. ~20 seconds for qemu) to complete in CI.  There's
# little value there, this is a unit test of library code and we have
# coverage of the RISC-V architectures via qemu platforms already.
# Excludes qemu_xtensa/dc233c due to pathological runtimes which cannot be
# reproduced on real hardware.
common:
  tags: heap
  platform_exclude:
    - m2gl025_miv
    - qemu_xtensa/dc233c
    - esp32s2_saola
    - esp32s2_lolin_mini
  timeout: 480
  integration_platforms:
    - native_sim
    - qemu_x86
tests:
  libraries.heap: {}
  libraries.heap.canaries:
    extra_configs:
      - CONFIG_SYS_HEAP_CANARIES=y
```

## tests/lib/heap_align/testcase.yaml
```yaml
common:
  tags:
    - heap
    - heap_align
  integration_platforms:
    - native_sim
    - mps2/an521/cpu0
tests:
  libraries.heap_align: {}
  libraries.heap_align.hardening_full:
    extra_configs:
      - CONFIG_SYS_HEAP_HARDENING_FULL=y
```

## tests/lib/heap_asan_demo/Kconfig
```kconfig
# Copyright (c) 2025
#
# SPDX-License-Identifier: Apache-2.0

config HEAP_ASAN_DEMO_CRASH_USE_AFTER_FREE
	bool "Enable use-after-free crash test"
	help
	  Demonstrates ASAN detection of use-after-free errors in the heap
	  allocator test suite.

	  This crash test is part of the comprehensive heap_asan_demo test that
	  validates ASAN memory poisoning integration. When enabled, it includes
	  a test case that deliberately accesses freed memory to verify ASAN
	  correctly detects and reports the error.

	  Test scenario:
	  1. Allocate memory block
	  2. Free the memory block (heap poisons it)
	  3. Attempt to read from the freed block
	  4. ASAN detects the access and terminates with error

	  Expected result: AddressSanitizer: use-after-poison on address 0x...

	  WARNING: This test will intentionally crash the program!
	  Only enable ONE crash test configuration at a time.

config HEAP_ASAN_DEMO_CRASH_UNALLOCATED
	bool "Enable unallocated memory access crash test"
	help
	  Demonstrates ASAN detection of accessing never-allocated memory in the
	  heap allocator test suite.

	  This crash test is part of the comprehensive heap_asan_demo test that
	  validates ASAN memory poisoning integration. When enabled, it includes
	  a test case that deliberately accesses heap memory that was never
	  allocated to verify ASAN correctly detects and reports the error.

	  Test scenario:
	  1. Identify address within heap bounds but never allocated
	  2. Verify the memory is poisoned using ASAN API
	  3. Attempt to read from the unallocated region
	  4. ASAN detects the access and terminates with error

	  Expected result: AddressSanitizer: use-after-poison on address 0x...

	  WARNING: This test will intentionally crash the program!
	  Only enable ONE crash test configuration at a time.

config HEAP_ASAN_DEMO_CRASH_BUFFER_OVERFLOW
	bool "Enable buffer overflow crash test"
	help
	  Demonstrates ASAN detection of buffer overflow errors in the heap
	  allocator test suite.

	  This crash test is part of the comprehensive heap_asan_demo test that
	  validates ASAN memory poisoning integration. When enabled, it includes
	  a test case that deliberately writes beyond allocated buffer boundaries
	  to verify ASAN correctly detects and reports the error when the overflow
	  reaches a poisoned adjacent region.

	  Test scenario:
	  1. Allocate two adjacent memory blocks
	  2. Free the second block (heap poisons it)
	  3. Write beyond first block's boundary into freed region
	  4. ASAN detects the overflow and terminates with error

	  Expected result: AddressSanitizer: use-after-poison on address 0x...
	  (if the overflow reaches the poisoned adjacent region)

	  WARNING: This test will intentionally crash the program!
	  Only enable ONE crash test configuration at a time.

config HEAP_ASAN_DEMO_CRASH_USE_AFTER_REALLOC
	bool "Enable use-after-realloc crash test"
	help
	  Demonstrates ASAN detection of use-after-realloc errors in the heap
	  allocator test suite.

	  This crash test is part of the comprehensive heap_asan_demo test that
	  validates ASAN memory poisoning integration. When enabled, it includes
	  a test case that demonstrates detection of accessing the old memory
	  location after realloc() has moved the allocation to a new address.

	  Test scenario:
	  1. Allocate memory at address A
	  2. Call realloc() to expand, forcing relocation to address B
	  3. The old address A is freed and poisoned
	  4. Attempt to access the old address A
	  5. ASAN detects the access and terminates with error

	  This demonstrates a common programming error where code maintains
	  multiple pointers to the same memory, and only one pointer is updated
	  after realloc(), leaving stale references to the freed memory.

	  Expected result: AddressSanitizer: use-after-poison on address 0x...

	  WARNING: This test will intentionally crash the program!
	  Only enable ONE crash test configuration at a time.

source "Kconfig.zephyr"
```

## tests/lib/heap_asan_demo/testcase.yaml
```yaml
tests:
  libraries.heap.asan_demo:
    tags: heap asan
    platform_allow: native_sim
    integration_platforms:
      - native_sim
```

## tests/lib/heap_canary/testcase.yaml
```yaml
tests:
  libraries.heap.canary:
    tags: heap canary
    filter: CONFIG_SYS_HEAP_CANARIES
    platform_exclude:
      - m2gl025_miv
      - qemu_xtensa/dc233c
      - esp32s2_saola
      - esp32s2_lolin_mini
    integration_platforms:
      - native_sim
      - qemu_x86
    harness: console
    harness_config:
      type: multi_line
      regex:
        - "ASSERTION FAIL"
```

## tests/lib/heap_min/testcase.yaml
```yaml
common:
  tags: heap
  integration_platforms:
    - native_sim
    - qemu_x86
tests:
  libraries.heap_min: {}
  libraries.heap_min.runtime_stats:
    extra_configs:
      - CONFIG_SYS_HEAP_RUNTIME_STATS=y
```
