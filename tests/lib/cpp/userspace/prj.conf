## CMakeLists.txt
```
# Copyright (c) Qualcomm Technologies, Inc. and/or its subsidiaries.
# SPDX-License-Identifier: Apache-2.0

cmake_minimum_required(VERSION 3.28.0)
find_package(Zephyr REQUIRED HINTS $ENV{ZEPHYR_BASE})
project(cpp_userspace)

target_sources(app PRIVATE src/main.cpp)
```

## prj.conf
```kconfig
# Copyright (c) Qualcomm Technologies, Inc. and/or its subsidiaries.
# SPDX-License-Identifier: Apache-2.0

CONFIG_CPP=y
CONFIG_STD_CPP17=y
CONFIG_ZTEST=y
CONFIG_TEST_USERSPACE=y
```

## src/main.cpp
```c
/*
 * Copyright (c) Qualcomm Technologies, Inc. and/or its subsidiaries.
 *
 * SPDX-License-Identifier: Apache-2.0
 */

#include <zephyr/kernel.h>
#include <zephyr/ztest.h>

ZTEST(cpp_userspace, test_supervisor_context)
{
	zassert_false(k_is_user_context());
}

ZTEST_USER(cpp_userspace, test_user_context)
{
	zassert_true(k_is_user_context());
}

ZTEST_SUITE(cpp_userspace, NULL, NULL, NULL, NULL, NULL);
```
