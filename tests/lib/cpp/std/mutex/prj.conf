## CMakeLists.txt
```
# SPDX-License-Identifier: Apache-2.0

cmake_minimum_required(VERSION 3.13.1)
find_package(Zephyr REQUIRED HINTS $ENV{ZEPHYR_BASE})
project(mutex)

FILE(GLOB_RECURSE app_sources src/*.cpp)
target_sources(app PRIVATE ${app_sources})
```

## prj.conf
```kconfig
CONFIG_ZTEST=y

CONFIG_CPP=y
CONFIG_REQUIRES_FULL_LIBCPP=y
CONFIG_CPP_EXCEPTIONS=y
CONFIG_STD_CPP20=y

CONFIG_POSIX_API=y
CONFIG_THREAD_STACK_INFO=y
CONFIG_DYNAMIC_THREAD=y
CONFIG_DYNAMIC_THREAD_STACK_SIZE=4096
CONFIG_DYNAMIC_THREAD_POOL_SIZE=6

CONFIG_ZTEST_STACK_SIZE=4096
```

## src/_main.cpp
```c
/*
 * Copyright (c) 2020, Friedt Professional Engineering Services, Inc
 *
 * SPDX-License-Identifier: Apache-2.0
 */

#include "_main.hpp"

#include <zephyr/ztest.h>

bool lock_succeeded;
time_point t0, t1, t2, t3;

time_point now()
{
	return std::chrono::steady_clock::now();
}

void time_init()
{
	t0 = now();
	t1 = t0 + 2 * dt;
	t2 = t0 + 3 * dt;
	t3 = t0 + 4 * dt;
}

static void before(void *arg)
{
	ARG_UNUSED(arg);

	lock_succeeded = false;
	time_init();
}

ZTEST_SUITE(std_mutex, nullptr, nullptr, before, nullptr, nullptr);
```

## src/_main.hpp
```c
/*
 * Copyright (c) 2020, Friedt Professional Engineering Services, Inc
 *
 * SPDX-License-Identifier: Apache-2.0
 */

#include <chrono>
#include <mutex>
#include <thread>

using namespace std::chrono_literals;

using time_point = std::chrono::time_point<std::chrono::steady_clock>;

time_point now();
void time_init();

extern bool lock_succeeded;
extern time_point t0, t1, t2, t3;
constexpr auto dt = 100ms;
```

## src/plain.cpp
```c
/*
 * Copyright (c) 2020, Friedt Professional Engineering Services, Inc
 *
 * SPDX-License-Identifier: Apache-2.0
 */

#include "_main.hpp"

#include <zephyr/ztest.h>

static std::mutex mu;

ZTEST(std_mutex, test_plain)
{
	mu.lock();

	std::thread th([] {
		zassert_false(mu.try_lock());
		mu.lock();
		lock_succeeded = true;
		mu.unlock();
	});
	std::this_thread::sleep_until(t1);
	zassert_false(lock_succeeded);
	mu.unlock();

	th.join();

	zassert_true(lock_succeeded);
}
```

## src/recursive.cpp
```c
/*
 * Copyright (c) 2020, Friedt Professional Engineering Services, Inc
 *
 * SPDX-License-Identifier: Apache-2.0
 */

#include "_main.hpp"

#include <zephyr/ztest.h>

static std::recursive_mutex mu;

ZTEST(std_mutex, test_recursive)
{
	mu.lock();
	zassert_true(mu.try_lock());

	std::thread th([] {
		zassert_false(mu.try_lock());
		std::this_thread::sleep_until(t2);
		mu.lock();
		mu.lock();
		lock_succeeded = true;
		mu.unlock();
		mu.unlock();
	});
	std::this_thread::sleep_until(t1);
	zassert_false(lock_succeeded);
	mu.unlock();
	mu.unlock();

	th.join();

	zassert_true(lock_succeeded);
}
```

## src/recursive_timed.cpp
```c
/*
 * Copyright (c) 2020, Friedt Professional Engineering Services, Inc
 *
 * SPDX-License-Identifier: Apache-2.0
 */

#include <iostream>

#include "_main.hpp"

#include <zephyr/ztest.h>

static std::recursive_timed_mutex mu;

ZTEST(std_mutex, test_resursive_timed)
{
	mu.lock();
	zassert_true(mu.try_lock());

	std::thread th([] {
		zassert_false(mu.try_lock());
		zassert_false(mu.try_lock_for(2 * dt));
		mu.lock();
		mu.lock();
		lock_succeeded = true;
		mu.unlock();
		mu.unlock();
	});
	std::this_thread::sleep_until(t1);
	zassert_false(lock_succeeded);
	mu.unlock();
	mu.unlock();

	zassert_true(mu.try_lock_until(t3));
	mu.unlock();

	th.join();

	zassert_true(lock_succeeded);
}
```

## src/timed.cpp
```c
/*
 * Copyright (c) 2020, Friedt Professional Engineering Services, Inc
 *
 * SPDX-License-Identifier: Apache-2.0
 */

#include "_main.hpp"

#include <zephyr/ztest.h>

static std::timed_mutex mu;

ZTEST(std_mutex, test_timed)
{
	mu.lock();

	std::thread th([] {
		zassert_false(mu.try_lock());
		zassert_false(mu.try_lock_for(2 * dt));
		mu.lock();
		lock_succeeded = true;
		mu.unlock();
	});
	std::this_thread::sleep_until(t1);
	zassert_false(lock_succeeded);
	mu.unlock();

	zassert_true(mu.try_lock_until(t3));
	mu.unlock();

	th.join();

	zassert_true(lock_succeeded);
}
```
