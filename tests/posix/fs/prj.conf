## CMakeLists.txt
```
# SPDX-License-Identifier: Apache-2.0

cmake_minimum_required(VERSION 3.20.0)
find_package(Zephyr REQUIRED HINTS $ENV{ZEPHYR_BASE})
project(fs)

FILE(GLOB app_sources src/*.c)
target_sources(app PRIVATE ${app_sources})

target_compile_options(app PRIVATE -U_POSIX_C_SOURCE -D_POSIX_C_SOURCE=200809L)
target_compile_options(app PRIVATE -U_XOPEN_SOURCE -D_XOPEN_SOURCE=700)
```

## prj.conf
```kconfig
CONFIG_FILE_SYSTEM=y
CONFIG_LOG=y
CONFIG_FAT_FILESYSTEM_ELM=y
CONFIG_POSIX_AEP_CHOICE_PSE52=y
CONFIG_POSIX_FILE_SYSTEM=y
CONFIG_POSIX_FILE_SYSTEM_R=y
# CONFIG_XSI=y is needed for constants S_IFDIR and S_IFREG
# For more information, please see
# https://pubs.opengroup.org/onlinepubs/9699919799/basedefs/sys_stat.h.html
CONFIG_XSI=y
CONFIG_ZTEST=y
CONFIG_MAIN_STACK_SIZE=4096
CONFIG_ZTEST_STACK_SIZE=2048
CONFIG_EVENTFD=n
CONFIG_ZVFS_OPEN_ADD_SIZE_POSIX=5
```

## src/main.c
```c
/*
 * Copyright (c) 2018 Codecoup
 *
 * SPDX-License-Identifier: Apache-2.0
 */

#include <ff.h>
#include "test_fs.h"

ZTEST_SUITE(posix_fs_test, NULL, test_mount, NULL, NULL, test_unmount);
```

## src/test_fat_mount.c
```c
/*
 * Copyright (c) 2018 Intel Corporation.
 *
 * SPDX-License-Identifier: Apache-2.0
 */

#include <zephyr/fs/fs.h>
#include <ff.h>
#include "test_fs.h"

/* FatFs work area */
static FATFS fat_fs;

/* mounting info */
static struct fs_mount_t fatfs_mnt = {
	.type = FS_FATFS,
	.mnt_point = FATFS_MNTP,
	.fs_data = &fat_fs,
};

void *test_mount(void)
{
	int res;

	res = fs_mount(&fatfs_mnt);
	if (res < 0) {
		TC_ERROR("Error mounting fs [%d]\n", res);
		/* FIXME: restructure tests as per #46897 */
		__ASSERT_NO_MSG(res == 0);
	}

	return NULL;
}

void test_unmount(void *unused)
{
	int res;

	ARG_UNUSED(unused);
	res = fs_unmount(&fatfs_mnt);
	if (res < 0) {
		TC_ERROR("Error unmounting fs [%d]\n", res);
		/* FIXME: restructure tests as per #46897 */
		__ASSERT_NO_MSG(res == 0);
	}
}

/**
 * @brief Test for File System mount operation
 *
 * @details Test initializes the fs_mount_t data structure with FatFs
 * related info and calls the fs_mount API for mount the file system.
 */
ZTEST(posix_fs_test, test_fs_mount)
{
	/* FIXME: restructure tests as per #46897 */
	zassert_equal(fatfs_mnt.flags, FS_MOUNT_FLAG_USE_DISK_ACCESS);
}
```

## src/test_fs.h
```c
/*
 * Copyright (c) 2018 Intel Corporation.
 *
 * SPDX-License-Identifier: Apache-2.0
 */

#include <zephyr/ztest.h>

#define FATFS_MNTP	"/RAM:"
#define TEST_FILE	FATFS_MNTP"/testfile.txt"
#define TEST_DIR	FATFS_MNTP"/testdir"
#define TEST_DIR_FILE	FATFS_MNTP"/testdir/testfile.txt"

extern const char test_str[];

void *test_mount(void);
void test_unmount(void *unused);
```

## src/test_fs_dir.c
```c
/*
 * Copyright (c) 2018 Intel Corporation.
 *
 * SPDX-License-Identifier: Apache-2.0
 */

#include <stdio.h>
#include <fcntl.h>
#include <unistd.h>
#include <dirent.h>
#include "test_fs.h"

extern int test_file_write(void);
extern int test_file_close(void);
extern int file;

static int test_mkdir(void)
{
	int res;

	TC_PRINT("\nmkdir tests:\n");

	/* Verify fs_mkdir() */
	res = mkdir(TEST_DIR, S_IRWXG);
	if (res) {
		TC_PRINT("Error creating dir[%d]\n", res);
		return res;
	}

	res = open(TEST_DIR_FILE, O_CREAT | O_RDWR, 0770);

	if (res < 0) {
		TC_PRINT("Failed opening file [%d]\n", res);
		return res;
	}
	file = res;

	res = test_file_write();
	if (res) {
		return res;
	}

	res = close(file);
	if (res) {
		TC_PRINT("Error closing file [%d]\n", res);
		return res;
	}

	TC_PRINT("Created dir %s!\n", TEST_DIR);

	return res;
}

static struct dirent *readdir_wrap(DIR *dirp, bool thread_safe)
{
	if (thread_safe) {
		/* cannot declare on stack otherwise this test fails for qemu_x86/atom */
		static struct dirent entry;
		struct dirent *result = NULL;

		zassert_ok(readdir_r(dirp, &entry, &result));

		return result;
	} else {
		return readdir(dirp);
	}
}

static int test_lsdir(const char *path, bool thread_safe)
{
	DIR *dirp;
	int res = 0;
	struct dirent *entry;

	TC_PRINT("\nreaddir test:\n");

	/* Verify fs_opendir() */
	dirp = opendir(path);
	if (dirp == NULL) {
		TC_PRINT("Error opening dir %s\n", path);
		return -EIO;
	}

	TC_PRINT("\nListing dir %s:\n", path);
	/* Verify fs_readdir() */
	errno = 0;
	while ((entry = readdir_wrap(dirp, thread_safe)) != NULL) {
		if (entry->d_name[0] == 0) {
			res = -EIO;
			break;
		}

		TC_PRINT("[FILE] %s\n", entry->d_name);
	}

	if (errno) {
		res = -EIO;
	}

	/* Verify fs_closedir() */
	closedir(dirp);

	return res;
}

static void after_fn(void *unused)
{
	ARG_UNUSED(unused);

	unlink(TEST_DIR_FILE);
	unlink(TEST_DIR);
}

/* FIXME: restructure tests as per #46897 */
ZTEST_SUITE(posix_fs_dir_test, NULL, test_mount, NULL, after_fn,
	    test_unmount);

/**
 * @brief Test for POSIX mkdir API
 *
 * @details Test creates a new directory through POSIX
 * mkdir API and open a new file under the directory and
 * writes some data into the file.
 */
ZTEST(posix_fs_dir_test, test_fs_mkdir)
{
	/* FIXME: restructure tests as per #46897 */
	zassert_true(test_mkdir() == TC_PASS);
}

/**
 * @brief Test for POSIX opendir, readdir and closedir API
 *
 * @details Test opens an existing directory through POSIX
 * opendir API, reads the contents of the directory through
 * readdir API and closes it through closedir API.
 */
ZTEST(posix_fs_dir_test, test_fs_readdir)
{
	/* FIXME: restructure tests as per #46897 */
	zassert_true(test_mkdir() == TC_PASS);
	zassert_true(test_lsdir(TEST_DIR, false) == TC_PASS);
}

/**
 * Same test as `test_fs_readdir`, but use thread-safe `readdir_r()` function
 */
ZTEST(posix_fs_dir_test, test_fs_readdir_threadsafe)
{
	/* FIXME: restructure tests as per #46897 */
	zassert_true(test_mkdir() == TC_PASS);
	zassert_true(test_lsdir(TEST_DIR, true) == TC_PASS);
}

/**
 * @brief Test for POSIX rmdir API
 *
 * @details Test creates a new directory through POSIX
 * mkdir API and remove directory using rmdir.
 */
ZTEST(posix_fs_dir_test, test_fs_rmdir)
{
#define IRWXG	0070
	/* Create and remove empty directory */
	zassert_ok(mkdir(TEST_DIR, IRWXG), "Error creating dir: %d", errno);
	zassert_ok(rmdir(TEST_DIR), "Error removing dir: %d\n", errno);

	/* Create directory and open a file in the directory
	 * now removing the directory will fail, test will
	 * fail in removal of non empty directory
	 */
	zassert_ok(mkdir(TEST_DIR, IRWXG), "Error creating dir: %d", errno);
	zassert_not_equal(open(TEST_DIR_FILE, O_CREAT | O_RDWR), -1,
			  "Error creating file: %d", errno);
	zassert_not_ok(rmdir(TEST_DIR), "Error Non empty dir removed");
	zassert_not_ok(rmdir(""), "Error Invalid path removed");
	zassert_not_ok(rmdir(NULL), "Error Invalid path removed");
	zassert_not_ok(rmdir("TEST_DIR."), "Error Invalid path removed");
	zassert_not_ok(rmdir(TEST_FILE), "Error file removed");
}
```

## src/test_fs_file.c
```c
/*
 * Copyright (c) 2018 Intel Corporation.
 *
 * SPDX-License-Identifier: Apache-2.0
 */

#include <string.h>
#include <fcntl.h>
#include <stdio.h>
#include <zephyr/posix/unistd.h>
#include "test_fs.h"

const char test_str[] = "hello world!";
int file = -1;

static int test_file_open(void)
{
	int res;

	res = open(TEST_FILE, O_CREAT | O_RDWR, 0660);
	if (res < 0) {
		TC_ERROR("Failed opening file: %d, errno=%d\n", res, errno);
		/* FIXME: restructure tests as per #46897 */
		__ASSERT_NO_MSG(res >= 0);
	}

	file = res;

	return TC_PASS;
}

int test_file_write(void)
{
	ssize_t brw;
	off_t res;

	res = lseek(file, 0, SEEK_SET);
	if (res != 0) {
		TC_PRINT("lseek failed [%d]\n", (int)res);
		close(file);
		file = -1;
		return TC_FAIL;
	}

	brw = write(file, (char *)test_str, strlen(test_str));
	if (brw < 0) {
		TC_PRINT("Failed writing to file [%d]\n", (int)brw);
		close(file);
		file = -1;
		return TC_FAIL;
	}

	if (brw < strlen(test_str)) {
		TC_PRINT("Unable to complete write. Volume full.\n");
		TC_PRINT("Number of bytes written: [%d]\n", (int)brw);
		close(file);
		file = -1;
		return TC_FAIL;
	}

	return res;
}

static int test_file_read(void)
{
	ssize_t brw;
	off_t res;
	char read_buff[80];
	size_t sz = strlen(test_str);

	res = lseek(file, 0, SEEK_SET);
	if (res != 0) {
		TC_PRINT("lseek failed [%d]\n", (int)res);
		close(file);
		file = -1;
		return TC_FAIL;
	}

	brw = read(file, read_buff, sz);
	if (brw < 0) {
		TC_PRINT("Failed reading file [%d]\n", (int)brw);
		close(file);
		file = -1;
		return TC_FAIL;
	}

	read_buff[brw] = 0;

	if (strcmp(test_str, read_buff)) {
		TC_PRINT("Error - Data read does not match data written\n");
		TC_PRINT("Data read:\"%s\"\n\n", read_buff);
		return TC_FAIL;
	}

	/* Now test after non-zero lseek. */

	res = lseek(file, 2, SEEK_SET);
	if (res != 2) {
		TC_PRINT("lseek failed [%d]\n", (int)res);
		close(file);
		file = -1;
		return TC_FAIL;
	}

	brw = read(file, read_buff, sizeof(read_buff));
	if (brw < 0) {
		TC_PRINT("Failed reading file [%d]\n", (int)brw);
		close(file);
		file = -1;
		return TC_FAIL;
	}

	/* Check for array overrun */
	brw = (brw < 80) ? brw : brw - 1;

	read_buff[brw] = 0;

	if (strcmp(test_str + 2, read_buff)) {
		TC_PRINT("Error - Data read does not match data written\n");
		TC_PRINT("Data read:\"%s\"\n\n", read_buff);
		return TC_FAIL;
	}

	return TC_PASS;
}

static int test_file_close(void)
{
	int res = 0;

	if (file >= 0) {
		res = close(file);
		if (res < 0) {
			TC_ERROR("Failed closing file: %d, errno=%d\n", res, errno);
			/* FIXME: restructure tests as per #46897 */
			__ASSERT_NO_MSG(res == 0);
		}

		file = -1;
	}

	return res;
}


static int test_file_truncate(void)
{
	int res = 0;
	size_t truncate_size = sizeof(test_str) - 4;

	if (file < 0) {
		return res;
	}

	res = ftruncate(file, truncate_size);
	if (res) {
		TC_PRINT("Error truncating file [%d]\n", res);
		res = TC_FAIL;
	}

	close(file);
	file = -1;
	return res;
}

static int test_file_delete(void)
{
	int res;

	res = unlink(TEST_FILE);
	if (res) {
		TC_PRINT("Error deleting file [%d]\n", res);
		return res;
	}

	return res;
}

static void after_fn(void *unused)
{
	ARG_UNUSED(unused);

	test_file_close();
	unlink(TEST_FILE);
}

ZTEST_SUITE(posix_fs_file_test, NULL, test_mount, NULL, after_fn,
	    test_unmount);

/**
 * @brief Test for POSIX open API
 *
 * @details Test opens new file through POSIX open API.
 */
ZTEST(posix_fs_file_test, test_fs_open)
{
	/* FIXME: restructure tests as per #46897 */
	zassert_true(test_file_open() == TC_PASS);
}

/**
 * @brief Test for POSIX write API
 *
 * @details Test writes some data through POSIX write API.
 */
ZTEST(posix_fs_file_test, test_fs_write)
{
	/* FIXME: restructure tests as per #46897 */
	zassert_true(test_file_open() == TC_PASS);
	zassert_true(test_file_write() == TC_PASS);
}

/**
 * @brief Test for POSIX write API
 *
 * @details Test reads data back through POSIX read API.
 */
ZTEST(posix_fs_file_test, test_fs_read)
{
	/* FIXME: restructure tests as per #46897 */
	zassert_true(test_file_open() == TC_PASS);
	zassert_true(test_file_write() == TC_PASS);
	zassert_true(test_file_read() == TC_PASS);
}

/**
 * @brief Test for POSIX ftruncate API
 *
 * @details Test truncate the file through POSIX ftruncate API.
 */
ZTEST(posix_fs_file_test, test_fs_truncate)
{
	/* FIXME: restructure tests as per #46897 */
	zassert_true(test_file_open() == TC_PASS);
	zassert_true(test_file_write() == TC_PASS);
	zassert_true(test_file_truncate() == TC_PASS);
}

/**
 * @brief Test for POSIX close API
 *
 * @details Test closes the open file through POSIX close API.
 */
ZTEST(posix_fs_file_test, test_fs_close)
{
	/* FIXME: restructure tests as per #46897 */
	zassert_true(test_file_open() == TC_PASS);
	zassert_true(test_file_close() == TC_PASS);
}

/**
 * @brief Test for POSIX unlink API
 *
 * @details Test deletes a file through POSIX unlink API.
 */
ZTEST(posix_fs_file_test, test_fs_unlink)
{
	zassert_true(test_file_open() == TC_PASS);
	zassert_true(test_file_delete() == TC_PASS);
}

#ifdef CONFIG_TC_PROVIDES_POSIX_DEVICE_IO_STREAMS
/**
 * @brief Test for POSIX fdopen and fileno APIs
 *
 * @details Test wraps an open file descriptor in a libc-owned FILE stream.
 */
ZTEST(posix_fs_file_test, test_fs_fdopen)
{
	FILE *stream;
	char read_buff[sizeof(test_str)];
	int fd;
	size_t len = strlen(test_str);
	size_t brw;

	zassert_true(test_file_open() == TC_PASS);
	fd = file;

	stream = fdopen(file, "w+");
	zassert_not_null(stream);
	file = -1;

	zassert_equal(fileno(stream), fd);
	zassert_equal(fwrite(test_str, 1, len, stream), len);
	zassert_equal(fflush(stream), 0);
	zassert_equal(fseek(stream, 0, SEEK_SET), 0);

	brw = fread(read_buff, 1, len, stream);
	zassert_equal(brw, len);
	zassert_mem_equal(read_buff, test_str, len);

	zassert_equal(fclose(stream), 0);
}
#endif

ZTEST(posix_fs_file_test, test_fs_fd_leak)
{
	const int reps =
	    MAX(CONFIG_POSIX_OPEN_MAX, ZVFS_OPEN_SIZE) + 5;

	for (int i = 0; i < reps; i++) {
		if (i > 0) {
			zassert_true(test_file_open() == TC_PASS);
		}

		if (i < reps - 1) {
			zassert_true(test_file_close() == TC_PASS);
		}
	}
}

ZTEST(posix_fs_file_test, test_file_open_truncate)
{
	struct stat buf = {0};

	zassert_ok(test_file_open());
	zassert_ok(test_file_write());
	zassert_ok(test_file_close());
	file = open(TEST_FILE, O_RDWR | O_TRUNC);
	zassert_not_equal(file, -1,
			  "File open failed for truncate mode");

	zassert_ok(test_file_close());
	zassert_ok(stat(TEST_FILE, &buf));
	zassert_equal(buf.st_size, 0, "Error: file is not truncated");
	zassert_ok(test_file_delete());
}
```

## src/test_fs_fstat.c
```c
/*
 * Copyright (c) 2024 Linumiz
 *
 * SPDX-License-Identifier: Apache-2.0
 */

#include <errno.h>
#include <zephyr/posix/fcntl.h>
#include <zephyr/posix/unistd.h>
#include <zephyr/posix/sys/stat.h>
#include "test_fs.h"

#define FILL_SIZE      128
#define TEST_FILE_SIZE 80
#define APPEND_DATA    "hello_world"

static void create_file(const char *filename, uint32_t size)
{
	int fh;

	fh = open(filename, O_CREAT | O_WRONLY);
	zassert(fh >= 0, "Failed creating test file");

	uint8_t filling[FILL_SIZE];

	while (size > FILL_SIZE) {
		zassert_equal(FILL_SIZE, write(fh, filling, FILL_SIZE));
		size -= FILL_SIZE;
	}

	zassert_equal(size, write(fh, filling, size));

	zassert_ok(close(fh));
}

static void before_fn(void *unused)
{
	ARG_UNUSED(unused);

	create_file(TEST_FILE, TEST_FILE_SIZE);
}

static void after_fn(void *unused)
{
	ARG_UNUSED(unused);

	zassert_ok(unlink(TEST_FILE));
}
ZTEST_SUITE(posix_fs_fstat_test, NULL, test_mount, before_fn, after_fn, test_unmount);

/**
 * @brief Test fstat command on file
 *
 */
ZTEST(posix_fs_fstat_test, test_fs_fstat_file)
{
	int fd = -1;
	struct stat buf = {0};

	fd = open(TEST_FILE, O_APPEND | O_WRONLY);
	zassert(fd >= 0, "Failed creating test file");

	zassert_equal(0, fstat(fd, &buf));
	zassert_equal(TEST_FILE_SIZE, buf.st_size);
	zassert_equal(S_IFREG, buf.st_mode);
	zassert_not_equal(-1, write(fd, APPEND_DATA, strlen(APPEND_DATA)));

	/* In Zephyr fs_stat, File info are updated only after close */
	zassert_ok(close(fd));
	fd = open(TEST_FILE, O_RDWR);
	zassert(fd >= 0, "Failed creating test file");

	zassert_equal(0, fstat(fd, &buf));
	zassert_equal(TEST_FILE_SIZE + strlen(APPEND_DATA), buf.st_size);
	zassert_equal(S_IFREG, buf.st_mode);

	zassert_equal(-1, fstat(-1, &buf));
	zassert_equal(EBADF, errno);

	zassert_ok(close(fd));
}
```

## src/test_fs_open_flags.c
```c
/*
 * Copyright (c) 2020 Nordic Semiconductor ASA
 *
 * SPDX-License-Identifier: Apache-2.0
 */

#include <string.h>
#include <fcntl.h>
#include <unistd.h>
#include "test_fs.h"

#define THE_FILE FATFS_MNTP"/the_file.txt"

static int test_file_open_flags(void)
{
	int fd = 0;
	int data = 0;
	int ret;

	/* 1 Check opening non-existent without O_CREAT */
	TC_PRINT("Open of non-existent file, flags = 0\n");
	fd = open(THE_FILE, 0);
	if (fd >= 0 || errno != ENOENT) {
		TC_PRINT("Expected fail; fd = %d, errno = %d\n", fd, errno);
		if (fd >= 0) {
			close(fd);
		}
		return TC_FAIL;
	}

	TC_PRINT("Open on non-existent file, flags = O_RDONLY\n");
	fd = open(THE_FILE, O_RDONLY);
	if (fd >= 0 || errno != ENOENT) {
		TC_PRINT("Expected fail; fd = %d, errno = %d\n", fd, errno);
		if (fd >= 0) {
			close(fd);
		}
		return TC_FAIL;
	}
	TC_PRINT("Open on non-existent file, flags = O_WRONLY\n");
	fd = open(THE_FILE, O_WRONLY);
	if (fd >= 0 || errno != ENOENT) {
		TC_PRINT("Expected fail; fd = %d, errno = %d\n", fd, errno);
		if (fd >= 0) {
			close(fd);
		}
		return TC_FAIL;
	}

	TC_PRINT("Open on non-existent file, flags = O_RDWR\n");
	fd = open(THE_FILE, O_RDWR);
	if (fd >= 0 || errno != ENOENT) {
		TC_PRINT("Expected fail; fd = %d, errno = %d\n", fd, errno);
		if (fd >= 0) {
			close(fd);
		}
		return TC_FAIL;
	}
	/* end 1 */

	/* 2 Create file for read only, attempt to read, attempt to write */
	TC_PRINT("Open on non-existent file, flags = O_CREAT | O_WRONLY\n");
	fd = open(THE_FILE, O_CREAT | O_WRONLY, 0440);
	if (fd < 0) {
		TC_PRINT("Expected success; fd = %d, errno = %d\n", fd, errno);
		return TC_FAIL;
	}

	TC_PRINT("Attempt read file opened with flags = O_CREAT | O_WRONLY\n");
	ret = read(fd, &data, sizeof(data));
	if (ret > 0 || errno != EACCES) {
		TC_PRINT("Expected fail, ret = %d, errno = %d\n", ret, errno);
		close(fd);
		return TC_FAIL;
	}

	TC_PRINT("Attempt write file opened with flags = O_CREAT | O_WRONLY\n");
	ret = write(fd, &data, sizeof(data));
	if (ret <= 0 || errno != EACCES) {
		TC_PRINT("Expected success, ret = %d, errno = %d\n", ret,
			 errno);
		close(fd);
		return TC_FAIL;
	}

	close(fd);
	/* end 2 */


	/* 3 Attempt read/write operation on file opened with flags = 0 */
	TC_PRINT("Attempt open existing with flags = 0\n");
	fd = open(THE_FILE, 0);
	if (fd < 0) {
		TC_PRINT("Expected success, fd = %d, errno = %d\n", fd, errno);
		return TC_FAIL;
	}

	TC_PRINT("Attempt read file opened with flags = 0\n");
	ret = read(fd, &data, sizeof(data));
	if (ret < 0) {
		TC_PRINT("Expected success, ret = %d, errno = %d\n", ret,
			 errno);
		close(fd);
		return TC_FAIL;
	}

	TC_PRINT("Attempt write file opened with flags = 0\n");
	ret = write(fd, &data, sizeof(data));
	if (ret >= 0 || errno != EACCES) {
		TC_PRINT("Expected fail, ret = %d, errno = %d\n", ret, errno);
		close(fd);
		return TC_FAIL;
	}

	close(fd);
	/* end 3 */

	/* 4 Attempt read/write on file opened with flags O_RDONLY */
	/* File does have content after previous tests. */
	TC_PRINT("Attempt open existing with flags = O_RDONLY\n");
	fd = open(THE_FILE, O_RDONLY);
	if (fd < 0) {
		TC_PRINT("Expected success, fd = %d, errno = %d\n", fd, errno);
		return TC_FAIL;
	}

	TC_PRINT("Attempt read file opened with flags = O_RDONLY\n");
	ret = read(fd, &data, sizeof(data));
	if (ret < 0) {
		TC_PRINT("Expected success, ret = %d, errno = %d\n", ret,
			 errno);
		close(fd);
		return TC_FAIL;
	}

	TC_PRINT("Attempt write file opened with flags = O_RDONLY\n");
	ret = write(fd, &data, sizeof(data));
	if (ret >= 0 || errno != EACCES) {
		TC_PRINT("Expected fail, ret = %d, errno = %d\n", ret, errno);
		close(fd);
		return TC_FAIL;
	}

	close(fd);
	/* end 4 */

	/* 5 Attempt read/write on file opened with flags O_WRONLY */
	/* File does have content after previous tests. */
	TC_PRINT("Attempt open existing with flags = O_WRONLY\n");
	fd = open(THE_FILE, O_WRONLY);
	if (fd < 0) {
		TC_PRINT("Expected success, fd = %d, errno = %d\n", fd, errno);
		return TC_FAIL;
	}

	TC_PRINT("Attempt read file opened with flags = O_WRONLY\n");
	ret = read(fd, &data, sizeof(data));
	if (ret >= 0 || errno != EACCES) {
		TC_PRINT("Expected fail, ret = %d, errno = %d\n", ret, errno);
		close(fd);
		return TC_FAIL;
	}

	TC_PRINT("Attempt write file opened with flags = O_WRONLY\n");
	ret = write(fd, &data, sizeof(data));
	if (ret < 0) {
		TC_PRINT("Expected success, ret = %d, errno = %d\n", ret,
			 errno);
		close(fd);
		return TC_FAIL;
	}

	close(fd);
	/* end 5 */

	/* 6 Attempt read/write on file opened with flags O_APPEND | O_WRONLY */
	TC_PRINT("Attempt open existing with flags = O_APPEND | O_WRONLY\n");
	fd = open(THE_FILE, O_APPEND | O_WRONLY);
	if (fd < 0) {
		TC_PRINT("Expected success, fd = %d, errno = %d\n", fd, errno);
		return TC_FAIL;
	}

	TC_PRINT("Attempt read file opened with flags = O_APPEND | O_WRONLY\n");
	ret = read(fd, &data, sizeof(data));
	if (ret >= 0 || errno != EACCES) {
		TC_PRINT("Expected fail, ret = %d, errno = %d\n", ret, errno);
		close(fd);
		return TC_FAIL;
	}

	TC_PRINT("Attempt write to opened with flags = O_APPEND | O_WRONLY\n");
	ret = write(fd, &data, sizeof(data));
	if (ret < 0) {
		TC_PRINT("Expected success, ret = %d, errno = %d\n", ret,
			 errno);
		close(fd);
		return TC_FAIL;
	}

	close(fd);
	/* end 6 */

	/* 7 Attempt read/write on file opened with flags O_APPEND | O_RDWR */
	TC_PRINT("Attempt open existing with flags = O_APPEND | O_RDWR\n");
	fd = open(THE_FILE, O_APPEND | O_RDWR);
	if (fd < 0) {
		TC_PRINT("Expected success, fd = %d, errno = %d\n", fd, errno);
		return TC_FAIL;
	}


	TC_PRINT("Attempt read file opened with flags = O_APPEND | O_RDWR\n");
	lseek(fd, 0, SEEK_SET);
	ret = read(fd, &data, sizeof(data));
	if (ret < 0) {
		TC_PRINT("Expected success, ret = %d, errno = %d\n", ret,
			 errno);
		close(fd);
		return TC_FAIL;
	}

	TC_PRINT("Attempt write file opened with flags = O_APPEND | O_RDWR\n");
	ret = write(fd, &data, sizeof(data));
	if (ret < 0) {
		TC_PRINT("Expected success, ret = %d, errno = %d\n", ret,
			 errno);
		close(fd);
		return TC_FAIL;
	}

	close(fd);
	/* end 7 */

	/* 8 Check if appended file is always written at the end */
	TC_PRINT("Attempt write to file opened with O_APPEND | O_RDWR\n");
	/* Clean start */
	unlink(THE_FILE);
	fd = open(THE_FILE, O_CREAT | O_WRONLY, 0440);
	if (fd < 0) {
		TC_PRINT("Expected success, fd = %d, errno = %d\n", fd, errno);
		return TC_FAIL;
	}

	ret = write(fd, &data, sizeof(data));
	if (ret < 0) {
		TC_PRINT("Expected success, ret = %d, errno = %d\n", ret,
			 errno);
		close(fd);
		return TC_FAIL;
	}

	close(fd);

	fd = open(THE_FILE, O_APPEND | O_RDWR);
	if (fd < 0) {
		TC_PRINT("Expected success, fd = %d, errno = %d\n", fd, errno);
		return TC_FAIL;
	}

	lseek(fd, 0, SEEK_SET);
	ret = write(fd, &data, sizeof(data));
	if (ret < 0) {
		TC_PRINT("Expected success, ret = %d, errno = %d\n", ret,
			 errno);
		close(fd);
		return TC_FAIL;
	}

	ret = lseek(fd, 0, SEEK_END);

	if (ret != (sizeof(data) * 2)) {
		TC_PRINT("Expected file size %zu, ret = %d, errno = %d\n",
			 sizeof(data) * 2, ret, errno);
		close(fd);
		return TC_FAIL;
	}

	close(fd);
	/* end 8 */

	return TC_PASS;
}

/**
 * @brief Test for POSIX open flags
 *
 * @details Test attempts to open file with different combinations of open
 * flags and checks if operations on files are permitted according to flags.
 */
ZTEST(posix_fs_test, test_fs_open_flags)
{
	zassert_true(test_file_open_flags() == TC_PASS);
}
```

## src/test_fs_stat.c
```c
/*
 * Copyright (c) 2023 Nikhef
 *
 * SPDX-License-Identifier: Apache-2.0
 */

#undef _POSIX_C_SOURCE
#define _POSIX_C_SOURCE 200809L

#include <string.h>
#include <fcntl.h>
#include <sys/stat.h>
#include <unistd.h>
#include <dirent.h>
#include "test_fs.h"

#define FILL_SIZE 128

#define TEST_FILE_SIZE     80
#define TEST_DIR_FILE_SIZE 1000

#define TEST_EMPTY_FILE FATFS_MNTP "/empty.dat"

static void create_file(const char *filename, uint32_t size)
{
	int fh;

	fh = open(filename, O_CREAT | O_WRONLY, 0440);
	zassert(fh >= 0, "Failed creating test file");

	uint8_t filling[FILL_SIZE];

	while (size > FILL_SIZE) {
		zassert_equal(FILL_SIZE, write(fh, filling, FILL_SIZE));
		size -= FILL_SIZE;
	}

	zassert_equal(size, write(fh, filling, size));

	zassert_ok(close(fh));
}

static void before_fn(void *unused)
{
	ARG_UNUSED(unused);

	zassert_ok(mkdir(TEST_DIR, 0070));

	create_file(TEST_FILE, TEST_FILE_SIZE);
	create_file(TEST_DIR_FILE, TEST_DIR_FILE_SIZE);
	create_file(TEST_EMPTY_FILE, 0);
}

static void after_fn(void *unused)
{
	ARG_UNUSED(unused);

	zassert_ok(unlink(TEST_FILE));
	zassert_ok(unlink(TEST_DIR_FILE));
	zassert_ok(unlink(TEST_DIR));
}

ZTEST_SUITE(posix_fs_stat_test, NULL, test_mount, before_fn, after_fn, test_unmount);

/**
 * @brief Test stat command on file
 *
 * @details Tests file in root, file in directroy, non-existing file and empty file.
 */
ZTEST(posix_fs_stat_test, test_fs_stat_file)
{
	struct stat buf;

	zassert_equal(0, stat(TEST_FILE, &buf));
	zassert_equal(TEST_FILE_SIZE, buf.st_size);
	zassert_equal(S_IFREG, buf.st_mode);

	zassert_equal(0, stat(TEST_DIR_FILE, &buf));
	zassert_equal(TEST_DIR_FILE_SIZE, buf.st_size);
	zassert_equal(S_IFREG, buf.st_mode);

	zassert_not_equal(0, stat(TEST_ROOT "foo.txt", &buf));
	zassert_not_equal(0, stat("", &buf));

	zassert_equal(0, stat(TEST_EMPTY_FILE, &buf));

	zassert_equal(0, buf.st_size);
	zassert_equal(S_IFREG, buf.st_mode);
}

/**
 * @brief Test stat command on dir
 *
 * @details Tests if we can retrieve stastics for a directory. This should only provide S_IFDIR
 *          return value.
 */
ZTEST(posix_fs_stat_test, test_fs_stat_dir)
{
	struct stat buf;

	zassert_equal(0, stat(TEST_DIR, &buf));

	zassert_equal(0, buf.st_size);
	zassert_equal(S_IFDIR, buf.st_mode);

	zassert_equal(0, stat(TEST_ROOT, &buf));
}

/**
 * @brief Test fstat command on file
 *
 * @details Tests file in root, file in directroy, and empty file
 */
ZTEST(posix_fs_stat_test, test_fs_fstat_file)
{
	struct stat buf;

	int test_file_fd = open(TEST_FILE, O_RDONLY);
	int dir_file_fd = open(TEST_DIR_FILE, O_RDONLY);
	int empty_file_fd = open(TEST_EMPTY_FILE, O_RDONLY);

	zassert_not_equal(-1, test_file_fd);
	zassert_equal(0, fstat(test_file_fd, &buf));
	zassert_equal(TEST_FILE_SIZE, buf.st_size);
	zassert_equal(S_IFREG, buf.st_mode);
	close(test_file_fd);

	zassert_not_equal(-1, dir_file_fd);
	zassert_equal(0, fstat(dir_file_fd, &buf));
	zassert_equal(TEST_DIR_FILE_SIZE, buf.st_size);
	zassert_equal(S_IFREG, buf.st_mode);
	close(dir_file_fd);

	zassert_not_equal(-1, empty_file_fd);
	zassert_equal(0, fstat(empty_file_fd, &buf));
	zassert_equal(0, buf.st_size);
	zassert_equal(S_IFREG, buf.st_mode);
	close(empty_file_fd);
}

/**
 * @brief Test fstat command on dir
 *
 * @details Tests if we can retrieve stastics for a directory.
 */
ZTEST(posix_fs_stat_test, test_fs_fstat_dir)
{
	struct stat buf;

	int fd = open(TEST_DIR, O_RDONLY);

	/*
	 * if this failed it means open doesn't support directories
	 * so skip the rest of the test
	 */
	if (fd == -1) {
		ztest_test_skip();
	}

	zassert_equal(0, fstat(fd, &buf));
	zassert_equal(0, buf.st_size);
	zassert_equal(S_IFDIR, buf.st_mode);
	close(fd);
}
```
