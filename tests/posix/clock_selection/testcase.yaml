## tests/posix/pthread_pressure/testcase.yaml
```yaml
common:
  tags: posix
  min_ram: 64
  arch_exclude:
    - posix
  integration_platforms:
    - qemu_cortex_a53/qemu_cortex_a53/smp
    - qemu_riscv64/qemu_virt_riscv64/smp
    - qemu_riscv32/qemu_virt_riscv32/smp
    - qemu_x86_64
tests:
  portability.posix.pthread_pressure:
    extra_configs:
      # Enabled for GitHub CI to reduce host scheduling noise while running
      # several concurrent Qemu processes each under stressful SMP load.
      - CONFIG_PTHREAD_CREATE_BARRIER=y
```
