## tests/posix/clock_selection/testcase.yaml
```yaml
common:
  filter: not CONFIG_NATIVE_LIBC
  tags:
    - posix
    - clock_selection
  # 1 tier0 platform per supported architecture
  platform_key:
    - arch
    - simulation
  integration_platforms:
    - qemu_riscv64
  min_flash: 64
  min_ram: 32
  # FVP SMP has unresolved issues
  platform_exclude:
    - fvp_base_revc_2xaem/v8a/smp
    - fvp_base_revc_2xaem/v8a/smp/ns
    - fvp_base_revc_2xaem/v9a/smp
    - fvp_base_revc_2xaem/v9a/smp/ns
tests:
  portability.posix.clock_selection: {}
  portability.posix.clock_selection.minimal:
    extra_configs:
      - CONFIG_MINIMAL_LIBC=y
  portability.posix.clock_selection.newlib:
    filter: TOOLCHAIN_HAS_NEWLIB == 1
    extra_configs:
      - CONFIG_NEWLIB_LIBC=y
      - CONFIG_NEWLIB_LIBC_MIN_REQUIRED_HEAP_SIZE=8192
  portability.posix.clock_selection.picolibc:
    tags: picolibc
    filter: CONFIG_PICOLIBC_SUPPORTED
    extra_configs:
      - CONFIG_PICOLIBC=y
```

## tests/posix/common/testcase.yaml
```yaml
common:
  tags: posix
  min_ram: 64
  timeout: 240
  # 1 tier0 platform per supported architecture
  platform_key:
    - arch
    - simulation
  platform_exclude:
    - native_posix
    - native_posix/native/64
    # consistently overflows flash
    - qemu_nios2
  filter: not CONFIG_NATIVE_LIBC
tests:
  portability.posix.common: {}
  portability.posix.common.minimal:
    extra_configs:
      - CONFIG_MINIMAL_LIBC=y
  portability.posix.common.newlib:
    platform_exclude:
      - intel_ehl_crb
      - lpcxpresso55s06
    filter: TOOLCHAIN_HAS_NEWLIB == 1
    extra_configs:
      - CONFIG_NEWLIB_LIBC=y
  portability.posix.common.armclang_std_libc:
    toolchain_allow: armclang
    extra_configs:
      - CONFIG_ARMCLANG_STD_LIBC=y
  portability.posix.common.arcmwdtlib:
    toolchain_allow: arcmwdt
    extra_configs:
      - CONFIG_ARCMWDT_LIBC=y
  portability.posix.common.tls:
    platform_exclude:
      - intel_ehl_crb
    filter: CONFIG_ARCH_HAS_THREAD_LOCAL_STORAGE and CONFIG_TOOLCHAIN_SUPPORTS_THREAD_LOCAL_STORAGE
    extra_configs:
      - CONFIG_NEWLIB_LIBC=n
      - CONFIG_THREAD_LOCAL_STORAGE=y
  portability.posix.common.tls.newlib:
    platform_exclude:
      - intel_ehl_crb
      - lpcxpresso55s06
    filter: TOOLCHAIN_HAS_NEWLIB == 1 and CONFIG_ARCH_HAS_THREAD_LOCAL_STORAGE and
      CONFIG_TOOLCHAIN_SUPPORTS_THREAD_LOCAL_STORAGE
    extra_configs:
      - CONFIG_NEWLIB_LIBC=y
      - CONFIG_THREAD_LOCAL_STORAGE=y
  portability.posix.common.picolibc:
    tags: picolibc
    filter: CONFIG_PICOLIBC_SUPPORTED
    extra_configs:
      - CONFIG_PICOLIBC=y
  portability.posix.common.no_spin_validate:
    extra_configs:
      - CONFIG_SPIN_VALIDATE=n
  portability.posix.common.signal.strsignal_no_desc:
    extra_configs:
      - CONFIG_POSIX_SIGNAL_STRING_DESC=n
  portability.posix.common.signal.big_nsig:
    extra_configs:
      - CONFIG_POSIX_RTSIG_MAX=1024
  portability.posix.common.dynamic_stack:
    extra_configs:
      - CONFIG_DYNAMIC_THREAD=y
      - CONFIG_THREAD_STACK_INFO=y
      - CONFIG_HEAP_MEM_POOL_SIZE=16384
  portability.posix.common.static_stack:
    extra_configs:
      - CONFIG_DYNAMIC_THREAD=n
      - CONFIG_THREAD_STACK_INFO=n
  portability.posix.common.userspace:
    filter: CONFIG_ARCH_HAS_USERSPACE
    tags:
      - userspace
    extra_configs:
      - CONFIG_USERSPACE=y
```

## tests/posix/device_io/testcase.yaml
```yaml
common:
  tags:
    - posix
    - device_io
  platform_key:
    - arch
    - simulation
  min_ram: 32
tests:
  portability.posix.device_io: {}
  portability.posix.device_io.tty_stdio:
    filter: CONFIG_UART_CONSOLE
    extra_configs:
      - CONFIG_CONSOLE_SUBSYS=y
  portability.posix.device_io.armclang_std_libc:
    toolchain_allow: armclang
    extra_configs:
      - CONFIG_ARMCLANG_STD_LIBC=y
  portability.posix.device_io.arcmwdtlib:
    toolchain_allow: arcmwdt
    extra_configs:
      - CONFIG_ARCMWDT_LIBC=y
  portability.posix.device_io.minimal:
    extra_configs:
      - CONFIG_MINIMAL_LIBC=y
  portability.posix.device_io.newlib:
    filter: TOOLCHAIN_HAS_NEWLIB == 1
    extra_configs:
      - CONFIG_NEWLIB_LIBC=y
  portability.posix.device_io.picolibc:
    tags: picolibc
    filter: CONFIG_PICOLIBC_SUPPORTED
    extra_configs:
      - CONFIG_PICOLIBC=y
```

## tests/posix/env/testcase.yaml
```yaml
common:
  filter: not CONFIG_NATIVE_LIBC
  arch_exclude:
    - posix
  integration_platforms:
    - qemu_riscv64
  tags: posix
tests:
  portability.posix.env: {}
  portability.posix.env.armclang_std_libc:
    toolchain_allow: armclang
    extra_configs:
      - CONFIG_ARMCLANG_STD_LIBC=y
  portability.posix.env.arcmwdtlib:
    toolchain_allow: arcmwdt
    extra_configs:
      - CONFIG_ARCMWDT_LIBC=y
  portability.posix.env.minimal:
    extra_configs:
      - CONFIG_MINIMAL_LIBC=y
      - CONFIG_COMMON_LIBC_MALLOC_ARENA_SIZE=256
  portability.posix.env.newlib:
    platform_exclude:
      - hifive1
    filter: TOOLCHAIN_HAS_NEWLIB == 1
    extra_configs:
      - CONFIG_NEWLIB_LIBC=y
  portability.posix.env.picolibc:
    tags: picolibc
    filter: CONFIG_PICOLIBC_SUPPORTED
    extra_configs:
      - CONFIG_PICOLIBC=y
```

## tests/posix/eventfd/Kconfig
```kconfig
# Copyright (c) 2023, Meta
#
# SPDX-License-Identifier: Apache-2.0

source "Kconfig.zephyr"

config TEST_DURATION_S
	int "Number of seconds to run the test"
	range 1 21600
	default 5
	help
	   Duration for the test, in seconds. The range has a reblatively high
	   upper bound because we should expect that eventfd_read() and
	   eventfd_write() are stable enough to run for an arbitrarily long
	   period of time without encountering any race conditions.

config TEST_TIMEOUT_S
	int "Number of seconds to run the test"
	range 1 21600
	default 10

config TEST_STACK_SIZE
	int "Size of each thread stack in this test"
	default 2048
	help
	  The minimal stack size required to run a no-op thread.

config TEST_EXTRA_ASSERTIONS
	bool "Add extra assertions into the hot path"
	help
	  In order to get a true benchmark, there should be as few branches
	  as possible on the hot path. Say 'y' here to add extra assertions
	  on the hot path as well to verify functionality.

config TEST_EXTRA_QUIET
	bool "Do not print out regular reports"
	help
	  In order to get a true benchmark, there should be as few branches
	  as possible on the hot path. Say 'y' here to skip reporting.

module = EVENTFD_TEST
module-str = eventfd
source "subsys/logging/Kconfig.template.log_config"
```

## tests/posix/eventfd/testcase.yaml
```yaml
common:
  filter: not CONFIG_NATIVE_LIBC
  tags:
    - posix
    - eventfd
  # 1 tier0 platform per supported architecture
  platform_key:
    - arch
    - simulation
  integration_platforms:
    - qemu_riscv64
tests:
  portability.posix.eventfd: {}
  portability.posix.eventfd.minimal:
    extra_configs:
      - CONFIG_MINIMAL_LIBC=y
  portability.posix.eventfd.newlib:
    platform_exclude:
      - intel_ehl_crb
      - lpcxpresso55s06
    filter: TOOLCHAIN_HAS_NEWLIB == 1
    extra_configs:
      - CONFIG_NEWLIB_LIBC=y
  portability.posix.eventfd.armclang_std_libc:
    toolchain_allow: armclang
    extra_configs:
      - CONFIG_ARMCLANG_STD_LIBC=y
  portability.posix.eventfd.arcmwdtlib:
    toolchain_allow: arcmwdt
    extra_configs:
      - CONFIG_ARCMWDT_LIBC=y
  portability.posix.eventfd.picolibc:
    tags: picolibc
    filter: CONFIG_PICOLIBC_SUPPORTED
    extra_configs:
      - CONFIG_PICOLIBC=y
```

## tests/posix/eventfd_basic/testcase.yaml
```yaml
common:
  arch_exclude: posix
  tags: posix eventfd
  min_ram: 32
tests:
  portability.posix.eventfd_basic:
    extra_configs:
      - CONFIG_POSIX_API=n
  portability.posix.eventfd_basic.posix_api:
    extra_configs:
      - CONFIG_POSIX_API=y
  portability.posix.eventfd_basic.newlib:
    filter: TOOLCHAIN_HAS_NEWLIB == 1
    extra_configs:
      - CONFIG_NEWLIB_LIBC=y
      - CONFIG_POSIX_API=n
  portability.posix.eventfd_basic.newlib.posix_api:
    filter: TOOLCHAIN_HAS_NEWLIB == 1
    extra_configs:
      - CONFIG_NEWLIB_LIBC=y
      - CONFIG_POSIX_API=y
  portability.posix.eventfd_basic.picolibc:
    tags: picolibc
    filter: CONFIG_PICOLIBC_SUPPORTED
    extra_configs:
      - CONFIG_PICOLIBC=y
  portability.posix.eventfd_basic.picolibc.posix_api:
    tags: picolibc
    filter: CONFIG_PICOLIBC_SUPPORTED
    extra_configs:
      - CONFIG_PICOLIBC=y
```

## tests/posix/file_locking/Kconfig
```kconfig
# Copyright (c) 2024 Tenstorrent AI ULC
# SPDX-License-Identifier: Apache-2.0

source "Kconfig.zephyr"

menu "File Locking Tests"

config TEST_NEGLIGIBLE_DELAY_MS
	int "Negligible delay in milliseconds"
	default 10
	help
	  Delays less than or equal to this value are considered neglible for the purposes of this
	  testsuite.

config TEST_LOCK_PERIOD_MS
	int "Time to hold a lock in milliseconds"
	default 100
	help
	  The amount of time to hold a lock before releasing it, for the purposes of this testuite.

endmenu
```

## tests/posix/fs/testcase.yaml
```yaml
common:
  filter: not CONFIG_NATIVE_LIBC
  tags:
    - posix
    - filesystem
    - fatfs
  min_ram: 128
  modules:
    - fatfs
  # 1 tier0 platform per supported architecture
  platform_key:
    - arch
    - simulation
  integration_platforms:
    - qemu_x86
    - qemu_riscv64
  # FVP SMP has unresolved issues
  platform_exclude:
    - fvp_base_revc_2xaem/v8a/smp
    - fvp_base_revc_2xaem/v8a/smp/ns
    - fvp_base_revc_2xaem/v9a/smp
    - fvp_base_revc_2xaem/v9a/smp/ns
tests:
  portability.posix.fs: {}
  portability.posix.fs.minimal:
    extra_configs:
      - CONFIG_MINIMAL_LIBC=y
  portability.posix.fs.newlib:
    filter: TOOLCHAIN_HAS_NEWLIB == 1
    extra_configs:
      - CONFIG_NEWLIB_LIBC=y
  portability.posix.fs.tls:
    filter: CONFIG_ARCH_HAS_THREAD_LOCAL_STORAGE and CONFIG_TOOLCHAIN_SUPPORTS_THREAD_LOCAL_STORAGE
    extra_configs:
      - CONFIG_NEWLIB_LIBC=n
      - CONFIG_THREAD_LOCAL_STORAGE=y
  portability.posix.fs.tls.newlib:
    filter: TOOLCHAIN_HAS_NEWLIB == 1 and CONFIG_ARCH_HAS_THREAD_LOCAL_STORAGE and
      CONFIG_TOOLCHAIN_SUPPORTS_THREAD_LOCAL_STORAGE
    extra_configs:
      - CONFIG_NEWLIB_LIBC=y
      - CONFIG_THREAD_LOCAL_STORAGE=y
  portability.posix.fs.picolibc:
    tags: picolibc
    filter: CONFIG_PICOLIBC_SUPPORTED
    extra_configs:
      - CONFIG_PICOLIBC=y
  portability.posix.fs.tls.picolibc:
    tags: picolibc
    filter: CONFIG_PICOLIBC_SUPPORTED
    extra_configs:
      - CONFIG_PICOLIBC=y
```

## tests/posix/getentropy/testcase.yaml
```yaml
common:
  filter: dt_chosen_enabled("zephyr,entropy") and CONFIG_ENTROPY_HAS_DRIVER and
    not CONFIG_NATIVE_LIBC
  integration_platforms:
    - native_sim
  tags:
    - posix
    - getentropy
tests:
  portability.posix.getentropy: {}
  portability.posix.getentropy.newlib:
    filter: CONFIG_NEWLIB_LIBC_SUPPORTED
    extra_configs:
      - CONFIG_NEWLIB_LIBC=y
      - CONFIG_NEWLIB_LIBC_MIN_REQUIRED_HEAP_SIZE=4096
  portability.posix.getentropy.picolibc:
    tags: picolibc
    filter: CONFIG_PICOLIBC_SUPPORTED
    extra_configs:
      - CONFIG_PICOLIBC=y
```

## tests/posix/getopt/testcase.yaml
```yaml
common:
  filter: not CONFIG_NATIVE_LIBC
  tags:
    - posix
    - getopt
  # 1 tier0 platform per supported architecture
  platform_key:
    - arch
    - simulation
tests:
  portability.posix.getopt:
    min_flash: 64
    min_ram: 32
  portability.posix.getopt.minimal:
    extra_configs:
      - CONFIG_MINIMAL_LIBC=y
  portability.posix.getopt.newlib:
    filter: TOOLCHAIN_HAS_NEWLIB == 1
    extra_configs:
      - CONFIG_NEWLIB_LIBC=y
  portability.posix.getopt.picolibc:
    tags: picolibc
    filter: CONFIG_PICOLIBC_SUPPORTED
    extra_configs:
      - CONFIG_PICOLIBC=y
  portability.posix.getopt.logger:
    extra_configs:
      - CONFIG_LOG=y
    build_only: true
```

## tests/posix/headers/testcase.yaml
```yaml
common:
  filter: not CONFIG_NATIVE_LIBC
  tags:
    - posix
  min_ram: 32
  # 1 tier0 platform per supported architecture
  platform_key:
    - arch
    - simulation
tests:
  portability.posix.headers.with_posix_api:
    extra_configs:
      - CONFIG_POSIX_API=y
  portability.posix.headers.without_posix_api:
    extra_configs:
      - CONFIG_POSIX_API=n
  portability.posix.headers.minimal.with_posix_api:
    extra_configs:
      - CONFIG_POSIX_API=y
  portability.posix.headers.minimal.without_posix_api:
    extra_configs:
      - CONFIG_POSIX_API=n
  portability.posix.headers.picolibc.with_posix_api:
    tags: picolibc
    filter: CONFIG_PICOLIBC_SUPPORTED
    extra_configs:
      - CONFIG_POSIX_API=y
      - CONFIG_PICOLIBC=y
  portability.posix.headers.picolibc.without_posix_api:
    tags: picolibc
    filter: CONFIG_PICOLIBC_SUPPORTED
    extra_configs:
      - CONFIG_POSIX_API=n
      - CONFIG_PICOLIBC=y
  portability.posix.headers.newlib.with_posix_api:
    tags: newlib
    filter: TOOLCHAIN_HAS_NEWLIB == 1
    extra_configs:
      - CONFIG_POSIX_API=y
      - CONFIG_NEWLIB_LIBC=y
  portability.posix.headers.newlib.without_posix_api:
    filter: TOOLCHAIN_HAS_NEWLIB == 1
    extra_configs:
      - CONFIG_POSIX_API=n
      - CONFIG_NEWLIB_LIBC=y
  portability.posix.headers.arcmwdtlib.with_posix_api:
    toolchain_allow: arcmwdt
    extra_configs:
      - CONFIG_POSIX_API=y
      - CONFIG_ARCMWDT_LIBC=y
  portability.posix.headers.arcmwdtlib.without_posix_api:
    toolchain_allow: arcmwdt
    extra_configs:
      - CONFIG_POSIX_API=n
      - CONFIG_ARCMWDT_LIBC=y
```

## tests/posix/mutex/testcase.yaml
```yaml
tests:
  portability.posix.mutex:
    arch_exclude: nios2 riscv32
    tags: core posix
```

## tests/posix/net/testcase.yaml
```yaml
common:
  depends_on: netif
  min_ram: 16
  tags:
    - iface
    - net
    - posix
  # 1 tier0 platform per supported architecture (dependent on netif support)
  integration_platforms:
    - mps2/an385
    - qemu_x86
  # native_posix and native_sim link to if_*() from the host libc which causes the test to crash
  # immediately.
  filter: not CONFIG_NATIVE_LIBC
tests:
  portability.posix.net:
    extra_configs:
      - CONFIG_COMMON_LIBC_MALLOC_ARENA_SIZE=256
  portability.posix.net.armclang_std_libc:
    toolchain_allow: armclang
    extra_configs:
      - CONFIG_ARMCLANG_STD_LIBC=y
  portability.posix.net.arcmwdtlib:
    toolchain_allow: arcmwdt
    extra_configs:
      - CONFIG_ARCMWDT_LIBC=y
  portability.posix.net.minimal:
    extra_configs:
      - CONFIG_MINIMAL_LIBC=y
      - CONFIG_COMMON_LIBC_MALLOC_ARENA_SIZE=256
  portability.posix.net.newlib:
    filter: TOOLCHAIN_HAS_NEWLIB == 1
    extra_configs:
      - CONFIG_NEWLIB_LIBC=y
  portability.posix.net.picolibc:
    tags: picolibc
    filter: CONFIG_PICOLIBC_SUPPORTED
    extra_configs:
      - CONFIG_PICOLIBC=y
```

## tests/posix/newlib/testcase.yaml
```yaml
tests:
  portability.posix:
    tags: posix
    arch_exclude: posix
    filter: TOOLCHAIN_HAS_NEWLIB == 1
    min_ram: 64
```

## tests/posix/pthread_pressure/Kconfig
```kconfig
# Copyright (c) 2023, Meta
#
# SPDX-License-Identifier: Apache-2.0

source "Kconfig.zephyr"

config TEST_NUM_CPUS
	int "Number of CPUs to use in parallel"
	range 1 MP_MAX_NUM_CPUS
	default MP_MAX_NUM_CPUS
	help
	  The number of parallel threads to run during the test.

config TEST_DURATION_S
	int "Number of seconds to run the test"
	default 5
	help
	   Duration for the test, in seconds.

config TEST_DELAY_US
	int "Microseconds to delay between pthread join and create"
	default 0
	help
	  If there is a race condition, a value of zero here should
	  cause a crash.

config TEST_STACK_SIZE
	int "Size of each thread stack in this test"
	default 1024 if 64BIT
	default 1024 if SPARC
	default 512
	help
	  The minimal stack size required to run a minimal thread.

config TEST_KTHREADS
	bool "Test k_threads"
	default y
	help
	  Run tests for k_threads

config TEST_PTHREADS
	bool "Test pthreads"
	default y
	help
	  Run tests for pthreads

config TEST_EXTRA_ASSERTIONS
	bool "Add extra assertions into the hot path"
	default y
	help
	  This can be disabled for benchmarking.
```
