## CMakeLists.txt
```
# SPDX-License-Identifier: Apache-2.0

cmake_minimum_required(VERSION 3.20.0)
find_package(Zephyr REQUIRED HINTS $ENV{ZEPHYR_BASE})
project(posix_thread_safe_functions)

FILE(GLOB app_sources src/*.c)

target_sources(app PRIVATE ${app_sources})
```

## prj.conf
```kconfig
CONFIG_POSIX_API=y
CONFIG_ZTEST=y

CONFIG_POSIX_AEP_CHOICE_BASE=y
CONFIG_POSIX_THREAD_SAFE_FUNCTIONS=y
```

## src/main.c
```c
/*
 * Copyright (c) 2024 Marvin Ouma <pancakesdeath@protonmail.com>
 *
 * SPDX-License-Identifier: Apache-2.0
 */

#include <zephyr/ztest.h>

ZTEST_SUITE(posix_thread_safe_functions, NULL, NULL, NULL, NULL, NULL);
```

## src/grp.c
```c
/*
 * Copyright (c) 2024 Meta Platforms
 *
 * SPDX-License-Identifier: Apache-2.0
 */

#include <errno.h>
#include <grp.h>

#include <zephyr/ztest.h>

ZTEST(posix_thread_safe_functions, test_grp_stubs)
{
	zassert_equal(getgrnam_r(NULL, NULL, NULL, 42, NULL), ENOSYS);
	zassert_equal(getgrgid_r(42, NULL, NULL, 42, NULL), ENOSYS);
}
```

## src/pwd.c
```c
/*
 * Copyright (c) 2024 Meta Platforms
 *
 * SPDX-License-Identifier: Apache-2.0
 */

#include <errno.h>
#include <pwd.h>

#include <zephyr/ztest.h>

ZTEST(posix_thread_safe_functions, test_pwd_stubs)
{
	zassert_equal(getpwnam_r(NULL, NULL, NULL, 42, NULL), ENOSYS);
	zassert_equal(getpwuid_r(42, NULL, NULL, 42, NULL), ENOSYS);
}
```
