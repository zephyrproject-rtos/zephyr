## Kconfig
```
# Copyright (c) 2025 Atym, Inc
#
# SPDX-License-Identifier: Apache-2.0

source "Kconfig.zephyr"

config TEST_DURATION_S
	int "Number of seconds to run the test"
	range 1 21600
	default 5
	help
	   Duration for the test, in seconds. The range has a reblatively high
	   upper bound because we should expect that timerfd_read() and
	   the timer are stable enough to run for an arbitrarily long
	   period of time without encountering any race conditions.

config TEST_TIMEOUT_S
	int "Number of seconds to run the test"
	range 1 21600
	default 10

config TEST_STACK_SIZE
	int "Size of each thread stack in this test"
	default 2048
	help
	  The minimal stack size required to run a no-op thread.

config TEST_EXTRA_ASSERTIONS
	bool "Add extra assertions into the hot path"
	help
	  In order to get a true benchmark, there should be as few branches
	  as possible on the hot path. Say 'y' here to add extra assertions
	  on the hot path as well to verify functionality.

config TEST_EXTRA_QUIET
	bool "Do not print out regular reports"
	help
	  In order to get a true benchmark, there should be as few branches
	  as possible on the hot path. Say 'y' here to skip reporting.

module = TIMERFD_TEST
module-str = timerfd
source "subsys/logging/Kconfig.template.log_config"
```

## prj.conf
```kconfig
CONFIG_ZTEST=y

CONFIG_POSIX_API=y
CONFIG_XOPEN_STREAMS=y
CONFIG_TIMERFD=y

CONFIG_ZVFS_OPEN_MAX=4

CONFIG_TEST_STACK_SIZE=5200
```

## src/_main.c
```c
/*
 * Copyright (c) 2020 Tobias Svehagen
 *
 * SPDX-License-Identifier: Apache-2.0
 */

#include "_main.h"

void reopen(int *fd, int clockid, int flags)
{
	zassert_not_null(fd);
	zassert_ok(close(*fd));
	*fd = timerfd_create(clockid, flags);
	zassert_true(*fd >= 0, "timerfd(%d, %d) failed: %d", clockid, flags, errno);
}

int is_blocked(int fd, short *event)
{
	struct pollfd pfd;
	int ret;

	pfd.fd = fd;
	pfd.events = *event;

	ret = poll(&pfd, 1, 0);
	zassert_true(ret >= 0, "poll failed %d", ret);

	*event = pfd.revents;

	return ret == 0;
}

void timerfd_poll_unset_common(int fd)
{
   	uint64_t val = 0;

	short event;
	int ret;

	event = POLLIN;
	ret = is_blocked(fd, &event);
	zassert_equal(ret, 1, "timerfd not blocked with initval == 0");

	zassert_ok(ioctl(fd, TFD_IOC_SET_TICKS, (uint64_t)TESTVAL));

	event = POLLIN;
	ret = is_blocked(fd, &event);
	zassert_equal(ret, 0, "timerfd blocked after write");
	zassert_equal(event, POLLIN, "POLLIN not set");

	zassert_equal(read(fd, &val, sizeof(val)), sizeof(val), "read failed");
	zassert_equal(val, TESTVAL, "val == %lld, expected %d", val, TESTVAL);

	/* timerfd shall block on subsequent reads before next interval expires */

	event = POLLIN;
	ret = is_blocked(fd, &event);
	zassert_equal(ret, 1, "timerfd not blocked after read");
}

void timerfd_poll_set_common(int fd)
{
	timerfd_t val = 0;
	short event;
	int ret;

	event = POLLIN;
	ret = is_blocked(fd, &event);
	zassert_equal(ret, 0, "timerfd is blocked with initval != 0");

	ret = read(fd, &val, sizeof(val));
	zassert_equal(ret, sizeof(val), "read ret %d", ret);
	zassert_equal(val, TESTVAL, "val == %d", (int)val);

	event = POLLIN;
	ret = is_blocked(fd, &event);
	zassert_equal(ret, 1, "timerfd is not blocked after read");
}

static struct timerfd_fixture tfd_fixture;

static void *setup(void)
{
	tfd_fixture.fd = -1;
	return &tfd_fixture;
}

static void before(void *arg)
{
	struct timerfd_fixture *fixture = arg;

	fixture->fd = timerfd_create(0, 0);
	zassert_true(fixture->fd >= 0, "timerfd(0, 0) failed: %d", errno);
}

static void after(void *arg)
{
	struct timerfd_fixture *fixture = arg;

	if (fixture->fd != -1) {
		close(fixture->fd);
		fixture->fd = -1;
	}
}

ZTEST_SUITE(timerfd, NULL, setup, before, after, NULL);
```

## src/_main.h
```c
/*
 * Copyright (c) 2020 Tobias Svehagen
 *
 * SPDX-License-Identifier: Apache-2.0
 */

#ifndef TESTS_POSIX_TIMERFD_SRC__MAIN_H_
#define TESTS_POSIX_TIMERFD_SRC__MAIN_H_

#include <errno.h>
#include <stdio.h>

#include <zephyr/net/socket.h>
#include <zephyr/posix/fcntl.h>
#include <zephyr/posix/sys/ioctl.h>
#include <zephyr/posix/poll.h>
#include <zephyr/posix/sys/timerfd.h>
#include <zephyr/posix/unistd.h>
#include <zephyr/ztest.h>

#define TESTVAL 10

#ifdef __cplusplus
extern "C" {
#endif

struct timerfd_fixture {
	int fd;
};

void reopen(int *fd, int clockid, int flags);
int is_blocked(int fd, short *event);
void timerfd_poll_set_common(int fd);
void timerfd_poll_unset_common(int fd);

#ifdef __cplusplus
}
#endif

#endif
```

## src/blocking.c
```c
/*
 * Copyright (c) 2020 Tobias Svehagen
 * Copyright (c) 2025 Atym, Inc.
 *
 * SPDX-License-Identifier: Apache-2.0
 */
#include "_main.h"

ZTEST_F(timerfd, test_expire_then_read)
{
	struct itimerspec ts = {
		.it_interval = {0, 100 * NSEC_PER_MSEC},
		.it_value = {0, 100 * NSEC_PER_MSEC},
	};
	timerfd_t val;
	int ret;

	zassert_ok(timerfd_settime(fixture->fd, 0, &ts, NULL));
	k_sleep(K_MSEC(550));

	ret = read(fixture->fd, &val, sizeof(val));
	zassert_true(ret == 8, "read ret %d", ret);
	zassert_true(val == 5, "val == %lld", val);
}

ZTEST_F(timerfd, test_not_started_shall_not_unblock)
{
	short event;
	int ret;

	event = POLLIN;
	ret = is_blocked(fixture->fd, &event);
	zassert_equal(ret, 1, "timerfd unblocked by expiry");
}

ZTEST_F(timerfd, test_poll_timeout)
{
	struct pollfd pfd;
	int ret;

	pfd.fd = fixture->fd;
	pfd.events = POLLIN;

	ret = poll(&pfd, 1, 500);
	zassert_true(ret == 0, "poll ret %d", ret);
}

ZTEST_F(timerfd, test_set_poll_event_block)
{
	reopen(&fixture->fd, CLOCK_MONOTONIC, 0);
	zassert_ok(ioctl(fixture->fd, TFD_IOC_SET_TICKS, (uint64_t)TESTVAL));
	timerfd_poll_set_common(fixture->fd);
}

ZTEST_F(timerfd, test_unset_poll_event_block)
{
	timerfd_poll_unset_common(fixture->fd);
}

K_THREAD_STACK_DEFINE(thread_stack, CONFIG_TEST_STACK_SIZE);
static struct k_thread thread;

static void thread_timerfd_read_1(void *arg1, void *arg2, void *arg3)
{
	uint64_t value;
	struct timerfd_fixture *fixture = arg1;

	zassert_equal(read(fixture->fd, &value, sizeof(value)), sizeof(value));
	zassert_equal(value, 1);
}

ZTEST_F(timerfd, test_read_then_expire_block)
{
	struct itimerspec ts = {
		.it_interval = {0, 100 * NSEC_PER_MSEC},
		.it_value = {0, 100 * NSEC_PER_MSEC},
	};

	k_thread_create(&thread, thread_stack, K_THREAD_STACK_SIZEOF(thread_stack),
			thread_timerfd_read_1, fixture, NULL, NULL, 0, 0, K_NO_WAIT);

	zassert_ok(timerfd_settime(fixture->fd, 0, &ts, NULL));

	k_thread_join(&thread, K_FOREVER);
}

static void thread_timerfd_close(void *arg1, void *arg2, void *arg3)
{
	struct timerfd_fixture *fixture = arg1;

	zassert_ok(close(fixture->fd));
}

ZTEST_F(timerfd, test_read_then_close_block)
{
   	timerfd_t value;

	struct itimerspec ts = {
		.it_interval = {1, 0},
		.it_value = {1, 0},
	};

	k_thread_create(&thread, thread_stack, K_THREAD_STACK_SIZEOF(thread_stack),
			thread_timerfd_close, fixture, NULL, NULL, 0, 0, K_MSEC(100));

	zassert_ok(timerfd_settime(fixture->fd, 0, &ts, NULL));

	zassert_equal(read(fixture->fd, &value, sizeof(value)), -1);

	k_thread_join(&thread, K_FOREVER);
}

ZTEST_F(timerfd, test_expire_while_pollin)
{
   	struct itimerspec ts = {
		.it_value = {0, 100 * NSEC_PER_MSEC},
	};

	struct zsock_pollfd fds[] = {
		{
			.fd = fixture->fd,
			.events = ZSOCK_POLLIN,
		},
	};
	timerfd_t value;
	int ret;

	zassert_ok(timerfd_settime(fixture->fd, 0, &ts, NULL));

	/* Expect 1 event */
	ret = zsock_poll(fds, ARRAY_SIZE(fds), 200);
	zassert_equal(ret, 1);

	zassert_equal(fds[0].revents, ZSOCK_POLLIN);

	/* Check value */
	zassert_equal(read(fixture->fd, &value, sizeof(value)), sizeof(value));
	zassert_equal(value, 1);
}
```

## src/ioctl.c
```c
/*
 * Copyright (c) 2024 Celina Sophie Kalus
 *
 * SPDX-License-Identifier: Apache-2.0
 */

#include "_main.h"
#include "sys/stat.h"

#define TFD_IN_USE_INTERNAL 0x1

ZTEST_F(timerfd, test_fstat)
{
    struct stat statbuf;
	zassert_ok(fstat(fixture->fd, &statbuf));
}

ZTEST_F(timerfd, test_set_flags)
{
	timerfd_t val;
	int ret;
	int flags;
	short event;

	/* Get current flags; Expect blocking, non-semaphore. */
	flags = ioctl(fixture->fd, F_GETFL, 0);
	zassert_equal(flags, 0, "flags == %d", flags);

	event = POLLIN;
	ret = is_blocked(fixture->fd, &event);
	zassert_equal(ret, 1, "timerfd read not blocked");

	/* Try writing and reading. Should not fail. */
	zassert_ok(ioctl(fixture->fd, TFD_IOC_SET_TICKS, (uint64_t)3));

	ret = read(fixture->fd, &val, sizeof(val));
	zassert_equal(ret, sizeof(val), "read failed");
	zassert_equal(val, 3, "val == %lld", val);


	/* Set nonblocking without reopening. */
	ret = ioctl(fixture->fd, F_SETFL, O_NONBLOCK);
	zassert_ok(ret);

	flags = ioctl(fixture->fd, F_GETFL, 0);
	zassert_equal(flags, O_NONBLOCK, "flags == %d", flags);

	event = POLLIN;
	ret = is_blocked(fixture->fd, &event);
	zassert_equal(ret, 1, "timerfd read not blocked");


	/* Try writing and reading again. */
	zassert_ok(ioctl(fixture->fd, TFD_IOC_SET_TICKS, (uint64_t)19));

	ret = read(fixture->fd, &val, sizeof(val));
	zassert_equal(ret, sizeof(val), "read failed");
	zassert_equal(val, 19, "val == %lld", val);


	/* Set back to blocking. */
	ret = ioctl(fixture->fd, F_SETFL, 0);
	zassert_ok(ret);

	flags = ioctl(fixture->fd, F_GETFL, 0);
	zassert_equal(flags, 0, "flags == %d", flags);

	event = POLLIN;
	ret = is_blocked(fixture->fd, &event);
	zassert_equal(ret, 1, "timerfd read not blocked");


	/* Try writing and reading again. */
	zassert_ok(ioctl(fixture->fd, TFD_IOC_SET_TICKS, (uint64_t)10));

	ret = read(fixture->fd, &val, sizeof(val));
	zassert_equal(ret, sizeof(val), "read failed");
	zassert_equal(val, 10, "val == %lld", val);


	/* Test setting internal in-use-flag. Should fail. */
	ret = ioctl(fixture->fd, F_SETFL, TFD_IN_USE_INTERNAL);
	zassert_not_ok(ret);


	/* File descriptor should still be valid and working. */
	zassert_ok(ioctl(fixture->fd, TFD_IOC_SET_TICKS, (uint64_t)97));

	ret = read(fixture->fd, &val, sizeof(val));
	zassert_equal(ret, sizeof(val), "read failed");
	zassert_equal(val, 97, "val == %lld", val);
}
```

## src/nonblocking.c
```c
/*
 * Copyright (c) 2020 Tobias Svehagen
 *
 * SPDX-License-Identifier: Apache-2.0
 */

#include "_main.h"

ZTEST_F(timerfd, test_read_nonblock)
{
	uint64_t val = 0;
	int ret;

	struct itimerspec ts = {
		.it_interval = {0, 100 * NSEC_PER_MSEC},
		.it_value = {0, 100 * NSEC_PER_MSEC},
	};

	reopen(&fixture->fd, 0, TFD_NONBLOCK);

	ret = read(fixture->fd, &val, sizeof(val));
	zassert_true(ret == -1, "read unset ret %d", ret);
	zassert_true(errno == EAGAIN, "errno %d", errno);

	// ret = eventfd_write(fixture->fd, TESTVAL);
	// zassert_true(ret == 0, "write ret %d", ret);
	zassert_ok(timerfd_settime(fixture->fd, 0, &ts, NULL));
	k_sleep(K_MSEC(550));

	ret = read(fixture->fd, &val, sizeof(val));
	zassert_true(ret == sizeof(val), "read set ret %d", ret);
	zassert_true(val == 5, "red set val %lld", val);

	ret = read(fixture->fd, &val, sizeof(val));
	zassert_true(ret == -1, "read subsequent ret %d val %lld", ret, val);
	zassert_true(errno == EAGAIN, "errno %d", errno);
}

ZTEST_F(timerfd, test_set_poll_event_nonblock)
{
	reopen(&fixture->fd, CLOCK_MONOTONIC, TFD_NONBLOCK);
	zassert_ok(ioctl(fixture->fd, TFD_IOC_SET_TICKS, (uint64_t)TESTVAL));
	timerfd_poll_set_common(fixture->fd);
}

ZTEST_F(timerfd, test_unset_poll_event_nonblock)
{
	reopen(&fixture->fd, CLOCK_MONOTONIC, TFD_NONBLOCK);
	timerfd_poll_unset_common(fixture->fd);
}
```

## src/stress.c
```c
/*
 * Copyright (c) 2023, Meta
 *
 * SPDX-License-Identifier: Apache-2.0
 */

#include "_main.h"

/* update interval for printing stats */
#if CONFIG_TEST_DURATION_S >= 60
#define UPDATE_INTERVAL_S 10
#elif CONFIG_TEST_DURATION_S >= 30
#define UPDATE_INTERVAL_S 5
#else
#define UPDATE_INTERVAL_S 1
#endif

enum th_id {
	WRITER,
	READER,
};

typedef int (*timerfd_op_t)(int fd);

static size_t count[2];
static struct k_thread th[2];
static const char *msg[2] = {
	[READER] = "reads",
	[WRITER] = "writes",
};

static int read_op(int fd);
static int write_op(int fd);

static const timerfd_op_t op[2] = {
	[READER] = read_op,
	[WRITER] = write_op,
};
static K_THREAD_STACK_ARRAY_DEFINE(th_stack, 2, CONFIG_TEST_STACK_SIZE);

static int read_op(int fd)
{
	timerfd_t value;

	read(fd, &value, sizeof(value));
	return 0;
}

static int write_op(int fd)
{
    return ioctl(fd, TFD_IOC_SET_TICKS, (uint64_t)1);
}

static void th_fun(void *arg1, void *arg2, void *arg3)
{

	int ret;
	uint64_t now;
	uint64_t end;
	uint64_t report;
	enum th_id id = POINTER_TO_UINT(arg1);
	struct timerfd_fixture *fixture = arg2;
	const uint64_t report_ms = UPDATE_INTERVAL_S * MSEC_PER_SEC;
	const uint64_t end_ms = CONFIG_TEST_DURATION_S * MSEC_PER_SEC;

	for (now = k_uptime_get(), end = now + end_ms, report = now + report_ms; now < end;
	     now = k_uptime_get()) {

		ret = op[id](fixture->fd);
		if (IS_ENABLED(CONFIG_TEST_EXTRA_ASSERTIONS)) {
			zassert_true(ret == 0 || (ret == -1 && errno == EAGAIN),
				     "ret: %d errno: %d", ret, errno);
		}
		count[id] += (ret == 0);

		if (!IS_ENABLED(CONFIG_TEST_EXTRA_QUIET)) {
			if (now >= report) {
				printk("%zu %s\n", count[id], msg[id]);
				report += report_ms;
			}
		}
		Z_SPIN_DELAY(10);
	}

	printk("avg: %zu %s/s\n", (size_t)((count[id] * MSEC_PER_SEC) / end_ms), msg[id]);
}

ZTEST_F(timerfd, test_stress)
{
	enum th_id i;
	enum th_id begin = MIN(READER, WRITER);
	enum th_id end = MAX(READER, WRITER) + 1;

	printk("BOARD: %s\n", CONFIG_BOARD);
	printk("TEST_DURATION_S: %u\n", CONFIG_TEST_DURATION_S);
	printk("UPDATE_INTERVAL_S: %u\n", UPDATE_INTERVAL_S);

	reopen(&fixture->fd, 0, TFD_NONBLOCK);

	for (i = begin; i < end; ++i) {
		k_thread_create(&th[i], th_stack[i], K_THREAD_STACK_SIZEOF(th_stack[0]), th_fun,
				UINT_TO_POINTER(i), fixture, NULL, K_LOWEST_APPLICATION_THREAD_PRIO,
				0, K_NO_WAIT);
	}

	for (i = begin; i < end; ++i) {
		zassert_ok(k_thread_join(&th[i], K_FOREVER));
	}

	zassert_true(count[READER] > 0, "read count is zero");
	zassert_true(count[WRITER] > 0, "write count is zero");
	zassert_true(count[WRITER] >= count[READER], "read count (%zu) > write count (%zu)",
		     count[READER], count[WRITER]);
}
```

## src/timer.c
```c
/*
 * Copyright (c) 2018 Intel Corporation
 *
 * SPDX-License-Identifier: Apache-2.0
 */
#include "_main.h"

#define SECS_TO_SLEEP  2
#define DURATION_SECS  1
#define DURATION_NSECS 0
#define PERIOD_SECS    0
#define PERIOD_NSECS   100000000

LOG_MODULE_REGISTER(timerfd_test);

void test_timerfd(struct timerfd_fixture *fixture, clockid_t clock_id, int flags)
{
	struct itimerspec value, ovalue;
	struct timespec ts, te;
	int64_t nsecs_elapsed, secs_elapsed;

	reopen(&fixture->fd, clock_id, flags);
	value.it_value.tv_sec = DURATION_SECS;
	value.it_value.tv_nsec = DURATION_NSECS;
	value.it_interval.tv_sec = PERIOD_SECS;
	value.it_interval.tv_nsec = PERIOD_NSECS;
	zassert_ok(timerfd_settime(fixture->fd, 0, &value, &ovalue));
	usleep(100 * USEC_PER_MSEC);
	/*TESTPOINT: Check if timer has started successfully*/
	zassert_ok(timerfd_gettime(fixture->fd, &value));

	LOG_DBG("Timer fires every %d secs and  %d nsecs", (int)value.it_interval.tv_sec,
		(int)value.it_interval.tv_nsec);
	LOG_DBG("Time remaining to fire %d secs and  %d nsecs", (int)value.it_value.tv_sec,
		(int)value.it_value.tv_nsec);

	clock_gettime(clock_id, &ts);
	sleep(SECS_TO_SLEEP);
	clock_gettime(clock_id, &te);

	if (te.tv_nsec >= ts.tv_nsec) {
		secs_elapsed = te.tv_sec - ts.tv_sec;
		nsecs_elapsed = te.tv_nsec - ts.tv_nsec;
	} else {
		nsecs_elapsed = NSEC_PER_SEC + te.tv_nsec - ts.tv_nsec;
		secs_elapsed = (te.tv_sec - ts.tv_sec - 1);
	}

	uint64_t elapsed = secs_elapsed * NSEC_PER_SEC + nsecs_elapsed;
	uint64_t first_sig = value.it_value.tv_sec * NSEC_PER_SEC + value.it_value.tv_nsec;
	uint64_t sig_interval = value.it_interval.tv_sec * NSEC_PER_SEC + value.it_interval.tv_nsec;
	uint64_t expected_signal_count = (elapsed - first_sig) / sig_interval + 1;

	/*TESTPOINT: Check if timerfd test passed*/
	uint64_t exp_count;
	zassert_equal(read(fixture->fd, &exp_count, sizeof(exp_count)), sizeof(exp_count));
	zassert_within(exp_count, expected_signal_count, 1, "timerfd test has failed %" PRIu64 " != %" PRIu64,
		       exp_count, expected_signal_count);
}

ZTEST_F(timerfd, test_CLOCK_REALTIME)
{
	test_timerfd(fixture, CLOCK_REALTIME, 0);
}

ZTEST_F(timerfd, test_CLOCK_MONOTONIC)
{
	test_timerfd(fixture, CLOCK_MONOTONIC, 0);
}

ZTEST_F(timerfd, test_timerfd_overrun)
{
	/* Set the timer to expire every 500 milliseconds */
	struct itimerspec ts = {
		.it_interval = {0, 500000000},
		.it_value = {0, 500000000}
	};

	reopen(&fixture->fd, CLOCK_MONOTONIC, 0);

	zassert_ok(timerfd_settime(fixture->fd, 0, &ts, NULL));
	k_sleep(K_MSEC(2000));

	uint64_t exp_count;
	zassert_equal(read(fixture->fd, &exp_count, sizeof(exp_count)), sizeof(exp_count));
	zassert_equal(exp_count, 4, "Number of overruns is incorrect");
}

ZTEST_F(timerfd, test_one_shot)
{
	/* Set the timer to expire only once */

	struct itimerspec ts = {
		.it_interval = {0},
		.it_value = {0, 100 * NSEC_PER_MSEC}
	};

	reopen(&fixture->fd, CLOCK_MONOTONIC, 0);

	zassert_ok(timerfd_settime(fixture->fd, 0, &ts, NULL));
	k_sleep(K_MSEC(300));

	uint64_t exp_count;
	zassert_equal(read(fixture->fd, &exp_count, sizeof(exp_count)), sizeof(exp_count));
	zassert_equal(exp_count, 1, "Number of expiry is incorrect");
}
```
