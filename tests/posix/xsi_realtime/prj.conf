## CMakeLists.txt
```
# SPDX-License-Identifier: Apache-2.0

cmake_minimum_required(VERSION 3.20.0)
find_package(Zephyr REQUIRED HINTS $ENV{ZEPHYR_BASE})
project(posix_xsi_realtime)

FILE(GLOB app_sources src/*.c)

target_sources(app PRIVATE ${app_sources})

target_compile_options(app PRIVATE -U_POSIX_C_SOURCE -D_POSIX_C_SOURCE=200809L)
```

## prj.conf
```kconfig
CONFIG_ZTEST=y

CONFIG_POSIX_AEP_CHOICE_PSE52=y
CONFIG_XSI_REALTIME=y
CONFIG_FILE_SYSTEM=y
CONFIG_POSIX_FILE_SYSTEM=y

CONFIG_FAT_FILESYSTEM_ELM=y
CONFIG_MAIN_STACK_SIZE=4096
CONFIG_ZTEST_STACK_SIZE=2048

CONFIG_DYNAMIC_THREAD=y
CONFIG_THREAD_STACK_INFO=y
CONFIG_DYNAMIC_THREAD_POOL_SIZE=6

CONFIG_ZVFS_OPEN_IGNORE_MIN=y
CONFIG_ZVFS_OPEN_MAX=5
```

## src/main.c
```c
/*
 * Copyright (c) 2025 Marvin Ouma <pancakesdeath@protonmail.com>
 *
 * SPDX-License-Identifier: Apache-2.0
 */

#include <pthread.h>

#include <zephyr/ztest.h>

ZTEST(xsi_realtime, test_sched_getparam)
{
	struct sched_param param;
	int rc = sched_getparam(0, &param);
	int err = errno;

	zassert_true((rc == -1 && err == ENOSYS));
}

ZTEST(xsi_realtime, test_sched_getscheduler)
{
	int rc = sched_getscheduler(0);
	int err = errno;

	zassert_true((rc == -1 && err == ENOSYS));
}
ZTEST(xsi_realtime, test_sched_setparam)
{
	struct sched_param param = {
		.sched_priority = 2,
	};
	int rc = sched_setparam(0, &param);
	int err = errno;

	zassert_true((rc == -1 && err == ENOSYS));
}

ZTEST(xsi_realtime, test_sched_setscheduler)
{
	struct sched_param param = {
		.sched_priority = 2,
	};
	int policy = 0;
	int rc = sched_setscheduler(0, policy, &param);
	int err = errno;

	zassert_true((rc == -1 && err == ENOSYS));
}

ZTEST(xsi_realtime, test_sched_rr_get_interval)
{
	struct timespec interval = {
		.tv_sec = 0,
		.tv_nsec = 0,
	};
	int rc = sched_rr_get_interval(0, &interval);
	int err = errno;

	zassert_true((rc == -1 && err == ENOSYS));
}

ZTEST_SUITE(xsi_realtime, NULL, NULL, NULL, NULL, NULL);
```

## src/mqueue.c
```c
/*
 * Copyright (c) 2018 Intel Corporation
 * Copyright (c) 2024 BayLibre, SAS
 *
 * SPDX-License-Identifier: Apache-2.0
 */

#include <fcntl.h>
#include <mqueue.h>
#include <pthread.h>

#include <zephyr/sys/util.h>
#include <zephyr/ztest.h>

#define N_THR            2
#define MESSAGE_SIZE     16
#define MESG_COUNT_PERMQ 4

static char queue[16] = "server";

static char send_data[MESSAGE_SIZE] = "timed data send";

/*
 * For platforms that select CONFIG_KERNEL_COHERENCE, the receive buffer can
 * not be on the stack as the k_msgq that underlies the mq_timedsend() will
 * copy directly to the receiver's buffer when there is already a waiting
 * receiver.
 */

static char rec_data[MESSAGE_SIZE];

static void *sender_thread(void *p1)
{
	mqd_t mqd;
	struct timespec curtime;

	mqd = mq_open(queue, O_WRONLY);
	zassert_ok(clock_gettime(CLOCK_REALTIME, &curtime));
	curtime.tv_sec += 1;
	zassert_false(mq_timedsend(mqd, send_data, MESSAGE_SIZE, 0, &curtime),
		      "Not able to send message in timer");
	usleep(USEC_PER_MSEC);
	zassert_false(mq_close(mqd), "unable to close message queue descriptor.");
	pthread_exit(p1);
	return NULL;
}

static void *receiver_thread(void *p1)
{
	mqd_t mqd;
	struct timespec curtime;

	mqd = mq_open(queue, O_RDONLY);
	zassert_ok(clock_gettime(CLOCK_REALTIME, &curtime));
	curtime.tv_sec += 1;
	mq_timedreceive(mqd, rec_data, MESSAGE_SIZE, 0, &curtime);
	zassert_false(strcmp(rec_data, send_data), "Error in data reception. exp: %s act: %s",
		      send_data, rec_data);
	usleep(USEC_PER_MSEC);
	zassert_false(mq_close(mqd), "unable to close message queue descriptor.");
	pthread_exit(p1);
	return NULL;
}

ZTEST(xsi_realtime, test_mqueue)
{
	mqd_t mqd;
	struct mq_attr attrs;
	int32_t mode = 0777;
	int flags = O_RDWR | O_CREAT;
	void *retval;
	pthread_t newthread[N_THR];

	attrs.mq_msgsize = MESSAGE_SIZE;
	attrs.mq_maxmsg = MESG_COUNT_PERMQ;

	mqd = mq_open(queue, flags, mode, &attrs);

	for (int i = 0; i < N_THR; i++) {
		/* Creating threads */
		zassert_ok(pthread_create(&newthread[i], NULL,
					  (i % 2 == 0) ? receiver_thread : sender_thread, NULL));
	}

	usleep(USEC_PER_MSEC * 10U);

	for (int i = 0; i < N_THR; i++) {
		pthread_join(newthread[i], &retval);
	}

	zassert_false(mq_close(mqd), "unable to close message queue descriptor.");
	zassert_false(mq_unlink(queue), "Not able to unlink Queue");
}

static bool notification_executed;

void notify_function_basic(union sigval val)
{
	mqd_t mqd;
	bool *executed = (bool *)val.sival_ptr;

	mqd = mq_open(queue, O_RDONLY);

	mq_receive(mqd, rec_data, MESSAGE_SIZE, 0);
	zassert_ok(strcmp(rec_data, send_data), "Error in data reception. exp: %s act: %s",
		   send_data, rec_data);

	zassert_ok(mq_close(mqd), "Unable to close message queue descriptor.");

	*executed = true;
}

ZTEST(xsi_realtime, test_mqueue_notify_basic)
{
	mqd_t mqd;
	struct mq_attr attrs = {
		.mq_msgsize = MESSAGE_SIZE,
		.mq_maxmsg = MESG_COUNT_PERMQ,
	};
	struct sigevent not = {
		.sigev_notify = SIGEV_NONE,
		.sigev_value.sival_ptr = (void *)&notification_executed,
		.sigev_notify_function = notify_function_basic,
	};
	int32_t mode = 0777;
	int flags = O_RDWR | O_CREAT;

	notification_executed = false;
	memset(rec_data, 0, MESSAGE_SIZE);

	mqd = mq_open(queue, flags, mode, &attrs);

	zassert_ok(mq_notify(mqd, &not), "Unable to set notification.");

	zassert_ok(mq_send(mqd, send_data, MESSAGE_SIZE, 0), "Unable to send message");

	zassert_true(notification_executed, "Notification not triggered.");

	zassert_ok(mq_close(mqd), "Unable to close message queue descriptor.");
	zassert_ok(mq_unlink(queue), "Unable to unlink queue");
}

void notify_function_thread(union sigval val)
{
	mqd_t mqd;
	pthread_t sender = (pthread_t)val.sival_int;

	zassert_not_equal(sender, pthread_self(),
			  "Notification function should be executed from different thread.");

	mqd = mq_open(queue, O_RDONLY);

	mq_receive(mqd, rec_data, MESSAGE_SIZE, 0);
	zassert_ok(strcmp(rec_data, send_data), "Error in data reception. exp: %s act: %s",
		   send_data, rec_data);

	zassert_ok(mq_close(mqd), "Unable to close message queue descriptor.");

	notification_executed = true;
}

ZTEST(xsi_realtime, test_mqueue_notify_thread)
{
	mqd_t mqd;
	struct mq_attr attrs = {
		.mq_msgsize = MESSAGE_SIZE,
		.mq_maxmsg = MESG_COUNT_PERMQ,
	};
	struct sigevent not = {
		.sigev_notify = SIGEV_THREAD,
		.sigev_value.sival_int = (int)pthread_self(),
		.sigev_notify_function = notify_function_thread,
	};
	int32_t mode = 0777;
	int flags = O_RDWR | O_CREAT;

	notification_executed = false;
	memset(rec_data, 0, MESSAGE_SIZE);

	mqd = mq_open(queue, flags, mode, &attrs);

	zassert_ok(mq_notify(mqd, &not), "Unable to set notification.");

	zassert_ok(mq_send(mqd, send_data, MESSAGE_SIZE, 0), "Unable to send message");

	usleep(USEC_PER_MSEC * 100U);

	zassert_true(notification_executed, "Notification not triggered.");

	zassert_ok(mq_close(mqd), "Unable to close message queue descriptor.");
	zassert_ok(mq_unlink(queue), "Unable to unlink queue");
}

ZTEST(xsi_realtime, test_mqueue_notify_non_empty_queue)
{
	mqd_t mqd;
	struct mq_attr attrs = {
		.mq_msgsize = MESSAGE_SIZE,
		.mq_maxmsg = MESG_COUNT_PERMQ,
	};
	struct sigevent not = {
		.sigev_notify = SIGEV_NONE,
		.sigev_value.sival_ptr = (void *)&notification_executed,
		.sigev_notify_function = notify_function_basic,
	};
	int32_t mode = 0777;
	int flags = O_RDWR | O_CREAT;

	notification_executed = false;
	memset(rec_data, 0, MESSAGE_SIZE);

	mqd = mq_open(queue, flags, mode, &attrs);

	zassert_ok(mq_send(mqd, send_data, MESSAGE_SIZE, 0), "Unable to send message");

	zassert_ok(mq_notify(mqd, &not), "Unable to set notification.");

	zassert_false(notification_executed, "Notification shouldn't be processed.");

	mq_receive(mqd, rec_data, MESSAGE_SIZE, 0);
	zassert_false(strcmp(rec_data, send_data), "Error in data reception. exp: %s act: %s",
		      send_data, rec_data);

	memset(rec_data, 0, MESSAGE_SIZE);

	zassert_ok(mq_send(mqd, send_data, MESSAGE_SIZE, 0), "Unable to send message");

	zassert_true(notification_executed, "Notification not triggered.");

	zassert_ok(mq_close(mqd), "Unable to close message queue descriptor.");
	zassert_ok(mq_unlink(queue), "Unable to unlink queue");
}

ZTEST(xsi_realtime, test_mqueue_notify_errors)
{
	mqd_t mqd;
	struct mq_attr attrs = {
		.mq_msgsize = MESSAGE_SIZE,
		.mq_maxmsg = MESG_COUNT_PERMQ,
	};
	struct sigevent not = {
		.sigev_notify = SIGEV_SIGNAL,
		.sigev_value.sival_ptr = (void *)&notification_executed,
		.sigev_notify_function = notify_function_basic,
	};
	int32_t mode = 0777;
	int flags = O_RDWR | O_CREAT;

	zassert_not_ok(mq_notify(NULL, NULL), "Should return -1 and set errno to EBADF.");
	zassert_equal(errno, EBADF);

	mqd = mq_open(queue, flags, mode, &attrs);

	zassert_not_ok(mq_notify(mqd, NULL), "Should return -1 and set errno to EINVAL.");
	zassert_equal(errno, EINVAL);

	zassert_not_ok(mq_notify(mqd, &not), "SIGEV_SIGNAL not supported should return -1.");
	zassert_equal(errno, ENOSYS);

	not.sigev_notify = SIGEV_NONE;

	zassert_ok(mq_notify(mqd, &not),
		   "Unexpected error while asigning notification to the queue.");

	zassert_not_ok(mq_notify(mqd, &not),
		       "Can't assign notification when there is another assigned.");
	zassert_equal(errno, EBUSY);

	zassert_ok(mq_notify(mqd, NULL), "Unable to remove notification from the message queue.");

	zassert_ok(mq_close(mqd), "Unable to close message queue descriptor.");
	zassert_ok(mq_unlink(queue), "Unable to unlink queue");
}

ZTEST(xsi_realtime, test_mqueue_open_and_unlink_multiple)
{
	const char *q1 = "q1";
	const char *q2 = "q2";

	mqd_t mqd1, mqd2;
	struct mq_attr attrs = {
		.mq_msgsize = MESSAGE_SIZE,
		.mq_maxmsg = MESG_COUNT_PERMQ,
	};

	int32_t mode = 0600;
	int flags = O_RDWR | O_CREAT;

	mqd1 = mq_open(q1, flags, mode, &attrs);

	zassert_ok(mq_unlink(q1), "Unable to unlink q1");

	mqd2 = mq_open(q2, flags, mode, &attrs);

	zassert_ok(mq_unlink(q2), "Unable to unlink q2");

	zassert_ok(mq_close(mqd1), "Unable to close message queue 1 descriptor.");
	zassert_ok(mq_close(mqd2), "Unable to close message queue 2 descriptor.");
}
```

## src/shm.c
```c
/*
 * Copyright (c) 2024, Tenstorrent AI ULC
 *
 * SPDX-License-Identifier: Apache-2.0
 */

#include <sys/mman.h>

#include <zephyr/kernel.h>
#include <zephyr/net/socket.h>
#include <zephyr/posix/fcntl.h>
#include <zephyr/posix/unistd.h>
#include <zephyr/posix/sys/stat.h>
#include <zephyr/sys/fdtable.h>

#include <zephyr/ztest.h>

#define _page_size COND_CODE_1(CONFIG_MMU, (CONFIG_MMU_PAGE_SIZE), (CONFIG_POSIX_PAGE_SIZE))

#define SHM_SIZE 8

#define VALID_SHM_PATH     "/foo"
#define INVALID_SHM_PATH   "foo"
#define EMPTY_SHM_PATH     ""
#define TOO_SHORT_SHM_PATH "/"

#define INVALID_MODE 0
#define VALID_MODE   0666

#define INVALID_FLAGS 0
#define VALID_FLAGS   (O_RDWR | O_CREAT)
#define CREATE_FLAGS  VALID_FLAGS
#define OPEN_FLAGS    (VALID_FLAGS & ~O_CREAT)

/* account for stdin, stdout, stderr */
#define N (ZVFS_OPEN_SIZE - 3)

/* we need to have at least 2 shared memory objects */
BUILD_ASSERT(N >= 2, "ZVFS_OPEN_SIZE must be > 4");

#define S_TYPEISSHM(st) (((st)->st_mode & ZVFS_MODE_IFMT) == ZVFS_MODE_IFSHM)

ZTEST(xsi_realtime, test_shm_open)
{
	int ret;
	int fd[N];
	struct stat st;

	{
		/* degenerate error cases */
		zassert_not_ok(shm_open(NULL, INVALID_FLAGS, INVALID_MODE));
		zassert_not_ok(shm_open(NULL, INVALID_FLAGS, VALID_MODE));
		zassert_not_ok(shm_open(NULL, VALID_FLAGS, INVALID_MODE));
		zassert_not_ok(shm_open(NULL, VALID_FLAGS, VALID_MODE));
		zassert_not_ok(shm_open(INVALID_SHM_PATH, VALID_FLAGS, VALID_MODE));
		zassert_not_ok(shm_open(EMPTY_SHM_PATH, VALID_FLAGS, VALID_MODE));
		zassert_not_ok(shm_open(TOO_SHORT_SHM_PATH, VALID_FLAGS, VALID_MODE));
		zassert_not_ok(shm_open(VALID_SHM_PATH, INVALID_FLAGS, INVALID_MODE));
		zassert_not_ok(shm_open(VALID_SHM_PATH, INVALID_FLAGS, VALID_MODE));
		zassert_not_ok(shm_open(VALID_SHM_PATH, VALID_FLAGS, INVALID_MODE));
	}

	/* open / close 1 file descriptor referring to VALID_SHM_PATH */
	fd[0] = shm_open(VALID_SHM_PATH, VALID_FLAGS, VALID_MODE);
	zassert_true(fd[0] >= 0, "shm_open(%s, %x, %04o) failed: %d", VALID_SHM_PATH, VALID_FLAGS,
		     VALID_MODE, errno);

	/* should have size 0 and be a shared memory object */
	zassert_ok(fstat(fd[0], &st));
	zassert_equal(st.st_size, 0);
	zassert_true(S_TYPEISSHM(&st));

	/* technically, the order of close / shm_unlink can be reversed too */
	zassert_ok(close(fd[0]));
	ret = shm_unlink(VALID_SHM_PATH);
	zassert_true(ret == 0 || (ret == -1 && errno == ENOENT),
		     "unexpected return / errno from shm_unlink: %d / %d", ret, errno);

	/* open / close N file descriptors referring to VALID_SHM_PATH */
	for (size_t i = 0; i < N; ++i) {
		fd[i] = shm_open(VALID_SHM_PATH, i == 0 ? CREATE_FLAGS : OPEN_FLAGS, VALID_MODE);
		zassert_true(fd[i] >= 0, "shm_open(%s, %x, %04o) failed: %d", VALID_SHM_PATH,
			     VALID_FLAGS, VALID_MODE, errno);
	}
	zassert_ok(shm_unlink(VALID_SHM_PATH));
	for (size_t i = N; i > 0; --i) {
		zassert_ok(close(fd[i - 1]));
	}
}

ZTEST(xsi_realtime, test_shm_unlink)
{
	int fd;

	{
		/* degenerate error cases */
		zassert_not_ok(shm_unlink(NULL));
		zassert_not_ok(shm_unlink(INVALID_SHM_PATH));
		zassert_not_ok(shm_unlink(EMPTY_SHM_PATH));
		zassert_not_ok(shm_unlink(TOO_SHORT_SHM_PATH));
	}

	/* open / close 1 file descriptor referring to VALID_SHM_PATH */
	fd = shm_open(VALID_SHM_PATH, VALID_FLAGS, VALID_MODE);
	zassert_true(fd >= 0, "shm_open(%s, %x, %04o) failed: %d", VALID_SHM_PATH, VALID_FLAGS,
		     VALID_MODE, errno);
	/* technically, the order of close / shm_unlink can be reversed too */
	zassert_ok(close(fd));
	zassert_ok(shm_unlink(VALID_SHM_PATH));
	/* should not be able to re-open the same path without O_CREAT */
	zassert_not_ok(shm_open(VALID_SHM_PATH, OPEN_FLAGS, VALID_MODE));
}

ZTEST(xsi_realtime, test_shm_read_write)
{
	int fd[N];

	for (size_t i = 0; i < N; ++i) {
		char cbuf = 0xff;

		fd[i] = shm_open(VALID_SHM_PATH, i == 0 ? CREATE_FLAGS : OPEN_FLAGS, VALID_MODE);
		zassert_true(fd[i] >= 0, "shm_open(%s, %x, %04o) failed: %d", VALID_SHM_PATH,
			     VALID_FLAGS, VALID_MODE, errno);
		if (i == 0) {
			/* size 0 on create / zero characters written */
			zassert_equal(write(fd[0], "", 1), 0,
				      "write() should fail on newly create shm fd with size 0");
			/* size 0 on create / zero characters read */
			zassert_equal(read(fd[0], &cbuf, 1), 0,
				      "read() should fail on newly create shm fd with size 0");

			BUILD_ASSERT(SHM_SIZE >= 1);
			zassert_ok(ftruncate(fd[0], SHM_SIZE));

			zassert_equal(write(fd[0], "\x42", 1), 1, "write() failed on fd %d: %d\n",
				      fd[0], errno);

			continue;
		}

		zassert_equal(read(fd[i], &cbuf, 1), 1, "read() failed on fd %d: %d\n", fd[i],
			      errno);
		zassert_equal(cbuf, 0x42,
			      "Failed to read byte over fd %d: expected: 0x%02x actual: 0x%02x",
			      fd[i], 0x42, cbuf);
	}

	for (size_t i = N; i > 0; --i) {
		zassert_ok(close(fd[i - 1]));
	}

	zassert_ok(shm_unlink(VALID_SHM_PATH));
}

ZTEST(xsi_realtime, test_shm_mmap)
{
	int fd[N];
	void *addr[N];

	if (!IS_ENABLED(CONFIG_MMU)) {
		ztest_test_skip();
	}

	for (size_t i = 0; i < N; ++i) {
		fd[i] = shm_open(VALID_SHM_PATH, i == 0 ? CREATE_FLAGS : OPEN_FLAGS, VALID_MODE);
		zassert_true(fd[i] >= 0, "shm_open(%s, %x, %04o) failed : %d", VALID_SHM_PATH,
			     VALID_FLAGS, VALID_MODE, errno);

		if (i == 0) {
			/* cannot map shm of size zero */
			zassert_not_ok(mmap(NULL, _page_size, PROT_READ | PROT_WRITE, MAP_SHARED,
					    fd[0], 0));

			zassert_ok(ftruncate(fd[0], _page_size));
		}

		addr[i] = mmap(NULL, _page_size, PROT_READ | PROT_WRITE, MAP_SHARED, fd[i], 0);
		zassert_not_equal(MAP_FAILED, addr[i], "mmap() failed: %d", errno);

		if ((i & 1) == 0) {
			memset(addr[0], i & 0xff, _page_size);
		} else {
			zassert_mem_equal(addr[i], addr[i - 1], _page_size);
		}
	}

	for (size_t i = N; i > 0; --i) {
		zassert_ok(close(fd[i - 1]));
	}

	for (size_t i = N; i > 0; --i) {
		zassert_ok(munmap(addr[i - 1], _page_size));
		/*
		 * Note: for some reason, in Zephyr, unmapping a physical page once, removes all
		 * virtual mappings. When that behaviour changes, remove the break below and adjust
		 * shm.c accordingly.
		 */
		break;
	}

	zassert_ok(shm_unlink(VALID_SHM_PATH));
}
```

## src/sync_io.c
```c
/*
 * Copyright (c) 2018 Intel Corporation.
 *
 * SPDX-License-Identifier: Apache-2.0
 */

#include <string.h>
#include <fcntl.h>
#include <ff.h>
#include <zephyr/fs/fs.h>
#include <unistd.h>
#include <zephyr/ztest.h>

static const char test_str[] = "Hello World!";

#define FATFS_MNTP "/RAM:"
#define TEST_FILE  FATFS_MNTP "/testfile.txt"

static FATFS fat_fs;

static struct fs_mount_t fatfs_mnt = {
	.type = FS_FATFS,
	.mnt_point = FATFS_MNTP,
	.fs_data = &fat_fs,
};

static void test_mount(void)
{
	int res;

	res = fs_mount(&fatfs_mnt);
	zassert_ok(res, "Error mounting fs [%d]\n", res);
}

void test_unmount(void)
{
	int res;

	res = fs_unmount(&fatfs_mnt);
	zassert_ok(res, "Error unmounting fs [%d]", res);
}

static int file_open(void)
{
	int res;

	res = open(TEST_FILE, O_CREAT | O_RDWR, 0660);
	zassert_not_equal(res, -1, "Error opening file [%d], errno [%d]", res, errno);
	return res;
}

static int file_write(int file)
{
	ssize_t brw;
	off_t res;

	res = lseek(file, 0, SEEK_SET);
	zassert_ok((int)res, "lseek failed [%d]\n", (int)res);

	brw = write(file, (char *)test_str, strlen(test_str));
	zassert_ok((int)res, "Failed writing to file [%d]\n", (int)brw);

	zassert_ok(brw < strlen(test_str),
		   "Unable to complete write. Volume full. Number of bytes written: [%d]\n",
		   (int)brw);
	return res;
}

/**
 * @brief Test for POSIX fsync API
 *
 * @details Test sync the file through POSIX fsync API.
 */
ZTEST(xsi_realtime, test_fs_sync)
{
	test_mount();
	int res = 0;
	int file = file_open();

	res = file_write(file);
	res = fsync(file);
	zassert_ok(res, "Failed to sync file: %d, errno = %d\n", res, errno);
	zassert_ok(close(file), "Failed to close file");
	test_unmount();
}

/**
 * @brief Test for POSIX fdatasync API
 *
 * @details Test sync the file through POSIX fdatasync API.
 */
ZTEST(xsi_realtime, test_fs_datasync)
{
	test_mount();
	int res = 0;
	int file = file_open();

	res = file_write(file);
	res = fdatasync(file);
	zassert_ok(res, "Failed to sync file: %d, errno = %d\n", res, errno);
	zassert_ok(close(file), "Failed to close file");
	test_unmount();
}
```
