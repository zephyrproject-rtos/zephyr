/*
 * Copyright (c) 2024 Dawid Osuchowski
 *
 * SPDX-License-Identifier: Apache-2.0
 */

/ {
    chosen {
        zephyr,console = &devmux0;
        zephyr,shell_uart = &devmux0;
    };

    euart0: uart_emul0 {
        compatible = "zephyr,uart-emul";
        current-speed = <0>;
        status = "okay";
    };

    devmux0: dev_mux_0 {
        compatible = "zephyr,devmux";
        devices = <&uart0 &euart0 &euart1>;
        zephyr,mutable;
        status = "okay";
    };
};