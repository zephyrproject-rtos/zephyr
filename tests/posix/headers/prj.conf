## CMakeLists.txt
```
# SPDX-License-Identifier: Apache-2.0

cmake_minimum_required(VERSION 3.20.0)
find_package(Zephyr REQUIRED HINTS $ENV{ZEPHYR_BASE})
project(posix_headers)

FILE(GLOB app_sources src/*.c)
target_sources(app PRIVATE ${app_sources})
target_compile_options(app PRIVATE -U_POSIX_C_SOURCE -D_POSIX_C_SOURCE=200809L)
```

## prj.conf
```kconfig
CONFIG_POSIX_API=y
CONFIG_ZTEST=y

# for POSIX_FILESYSTEM
CONFIG_POSIX_FILE_SYSTEM=y

# for networking things to work
CONFIG_NETWORKING=y
CONFIG_POSIX_NETWORKING=y
CONFIG_NET_TEST=y
CONFIG_TEST_RANDOM_GENERATOR=y

# For e.g. sched_get_priority_max()
CONFIG_POSIX_PRIORITY_SCHEDULING=y

# For putmsg(), etc
CONFIG_XOPEN_STREAMS=y

# for when CONFIG_POSIX_API is not selected
CONFIG_POSIX_THREADS=y
CONFIG_POSIX_TIMERS=y
CONFIG_POSIX_MESSAGE_PASSING=y
CONFIG_EVENTFD=y
CONFIG_POSIX_C_LIB_EXT=y
CONFIG_POSIX_DEVICE_IO=y
```

## boards/mimxrt1015_evk.overlay
```dts
/*
 * Copyright 2023 NXP
 *
 * SPDX-License-Identifier: Apache-2.0
 */

/ {
	chosen {
		zephyr,sram = &ocram;
	};
};
```

## src/_common.h
```c
/*
 * Copyright (c) 2022 Meta
 *
 * SPDX-License-Identifier: Apache-2.0
 */

#pragma once

#include <limits.h>
#include <stddef.h>
#include <stdint.h>

#include <zephyr/ztest.h>
```

## src/_headers.h
```c
/*
 * Copyright (c) 2022 Meta
 *
 * SPDX-License-Identifier: Apache-2.0
 */

#pragma once

#include <getopt.h>

#ifdef CONFIG_POSIX_API

#include <arpa/inet.h>
#include <dirent.h>
#include <mqueue.h>
#include <net/if.h>
#include <netdb.h>
#include <netinet/in.h>
#include <netinet/tcp.h>
#include <poll.h>
#include <pthread.h>
#include <sched.h>
#include <semaphore.h>
#include <signal.h>
#include <sys/eventfd.h>
#include <sys/ioctl.h>
#include <sys/select.h>
#include <sys/socket.h>
#include <sys/time.h>
#include <unistd.h>

#else

#include <zephyr/posix/arpa/inet.h>
#include <zephyr/posix/dirent.h>
#include <zephyr/posix/mqueue.h>
#include <zephyr/posix/net/if.h>
#include <zephyr/posix/netdb.h>
#include <zephyr/posix/netinet/in.h>
#include <zephyr/posix/netinet/tcp.h>
#include <zephyr/posix/poll.h>
#include <zephyr/posix/pthread.h>
#include <zephyr/posix/sched.h>
#include <zephyr/posix/semaphore.h>
#include <zephyr/posix/signal.h>
#include <zephyr/posix/sys/eventfd.h>
#include <zephyr/posix/sys/ioctl.h>
#include <zephyr/posix/sys/select.h>
#include <zephyr/posix/sys/socket.h>
#include <zephyr/posix/sys/time.h>
#include <zephyr/posix/unistd.h>

#endif
```

## src/_main.c
```c
/*
 * Copyright (c) 2022 Meta
 *
 * SPDX-License-Identifier: Apache-2.0
 */

#include "_common.h"

ZTEST_SUITE(posix_headers, NULL, NULL, NULL, NULL, NULL);
```

## src/aio_h.c
```c
/*
 * Copyright (c) 2024 Tenstorrent AI ULC
 *
 * SPDX-License-Identifier: Apache-2.0
 */

#include "_common.h"

#include <aio.h>

ZTEST(posix_headers, test_aio_h)
{
#ifdef CONFIG_POSIX_ASYNCHRONOUS_IO
	zassert_not_equal(offsetof(struct aiocb, aio_fildes), -1);
	zassert_not_equal(offsetof(struct aiocb, aio_offset), -1);
	zassert_not_equal(offsetof(struct aiocb, aio_buf), -1);
	zassert_not_equal(offsetof(struct aiocb, aio_nbytes), -1);
	zassert_not_equal(offsetof(struct aiocb, aio_reqprio), -1);
#ifdef CONFIG_POSIX_REALTIME_SIGNALS
	zassert_not_equal(offsetof(struct aiocb, aio_sigevent), -1);
#endif
	zassert_not_equal(offsetof(struct aiocb, aio_lio_opcode), -1);

	zassert_not_null(aio_cancel);
	zassert_not_null(aio_error);
	zassert_not_null(aio_fsync);
	zassert_not_null(aio_read);
	zassert_not_null(aio_return);
	zassert_not_null(aio_suspend);
	zassert_not_null(aio_write);
	zassert_not_null(lio_listio);
#endif
}
```

## src/arpa_inet_h.c
```c
/*
 * Copyright (c) 2022 Meta
 *
 * SPDX-License-Identifier: Apache-2.0
 */

#include "_common.h"

#include <arpa/inet.h>

/**
 * @brief existence test for `<arpa/inet.h>`
 *
 * @see <a href="https://pubs.opengroup.org/onlinepubs/9699919799/basedefs/arpa_inet.h.html">arpa/inet.h</a>
 */
ZTEST(posix_headers, test_arpa_inet_h)
{
	zassert_not_equal(-1, htonl(0));
	zassert_not_equal(-1, htons(0));
	zassert_not_equal(-1, ntohl(0));
	zassert_not_equal(-1, ntohs(0));

	if (IS_ENABLED(CONFIG_POSIX_NETWORKING)) {
		/* zassert_not_null(inet_addr); */ /* not implemented */
		/* zassert_not_null(inet_ntoa); */ /* not implemented */
		zassert_not_null(inet_ntop);
		zassert_not_null(inet_pton);
	}
}
```

## src/dirent_h.c
```c
/*
 * Copyright (c) 2022 Meta
 *
 * SPDX-License-Identifier: Apache-2.0
 */

#include "_common.h"

#include <dirent.h>

/**
 * @brief existence test for `<dirent.h>`
 *
 * @see <a href="https://pubs.opengroup.org/onlinepubs/9699919799/basedefs/dirent.h.html">dirent.h</a>
 */
ZTEST(posix_headers, test_dirent_h)
{
#ifdef CONFIG_POSIX_AEP_CHOICE_PSE53
	zassert_not_equal((DIR *)-1, (DIR *)NULL);

	zassert_not_equal(-1, offsetof(struct dirent, d_ino));
	zassert_not_equal(-1, offsetof(struct dirent, d_name));

	/* zassert_not_null(alphasort); */ /* not implemented */
	zassert_not_null(closedir);
	/* zassert_not_null(dirfd); */     /* not implemented */
	/* zassert_not_null(fdopendir); */ /* not implemented */
	zassert_not_null(opendir);
	zassert_not_null(readdir);
	zassert_not_null(readdir_r);
	/* zassert_not_null(rewinddir); */ /* not implemented */
	/* zassert_not_null(scandir); */   /* not implemented */
	/* zassert_not_null(seekdir); */   /* not implemented */
	/* zassert_not_null(telldir); */   /* not implemented */
#endif
}
```

## src/mqueue_h.c
```c
/*
 * Copyright (c) 2022 Meta
 *
 * SPDX-License-Identifier: Apache-2.0
 */

#include "_common.h"

#include <mqueue.h>

/**
 * @brief existence test for `<mqueue.h>`
 *
 * @see <a href="https://pubs.opengroup.org/onlinepubs/9699919799/basedefs/mqueue.h.html">mqueue.h</a>
 */
ZTEST(posix_headers, test_mqueue_h)
{
	zassert_not_equal((mqd_t)-1, (mqd_t)NULL);

	zassert_not_equal(-1, offsetof(struct mq_attr, mq_flags));
	zassert_not_equal(-1, offsetof(struct mq_attr, mq_maxmsg));
	zassert_not_equal(-1, offsetof(struct mq_attr, mq_msgsize));
	zassert_not_equal(-1, offsetof(struct mq_attr, mq_curmsgs));

	if (IS_ENABLED(CONFIG_POSIX_AEP_CHOICE_PSE53)) {
		zassert_not_null(mq_close);
		zassert_not_null(mq_getattr);
		zassert_not_null(mq_notify);
		zassert_not_null(mq_open);
		zassert_not_null(mq_receive);
		zassert_not_null(mq_send);
		zassert_not_null(mq_setattr);
		zassert_not_null(mq_timedreceive);
		zassert_not_null(mq_timedsend);
		zassert_not_null(mq_unlink);
	}
}
```

## src/net_if_h.c
```c
/*
 * Copyright (c) 2022 Meta
 *
 * SPDX-License-Identifier: Apache-2.0
 */

#include "_common.h"

#include <net/if.h>

/**
 * @brief existence test for `<net/if.h>`
 *
 * @see <a href="https://pubs.opengroup.org/onlinepubs/9699919799/basedefs/net_if.h.html">net/if.h</a>
 */
ZTEST(posix_headers, test_net_if_h)
{
	zassert_not_equal(-1, offsetof(struct if_nameindex, if_index));
	zassert_not_equal(-1, offsetof(struct if_nameindex, if_name));

	zassert_not_equal(-1, IF_NAMESIZE);

	if (IS_ENABLED(CONFIG_POSIX_NETWORKING)) {
		zassert_not_null(if_freenameindex);
		zassert_not_null(if_indextoname);
		zassert_not_null(if_nameindex);
		zassert_not_null(if_nametoindex);
	}
}
```

## src/netdb_h.c
```c
/*
 * Copyright (c) 2022 Meta
 *
 * SPDX-License-Identifier: Apache-2.0
 */

#include "_common.h"

#include <netdb.h>

/**
 * @brief existence test for `<netdb.h>`
 *
 * @see <a href="https://pubs.opengroup.org/onlinepubs/9699919799/basedefs/netdb.h.html>netdb.h</a>
 */
ZTEST(posix_headers, test_netdb_h)
{
	zassert_not_equal(-1, offsetof(struct hostent, h_name));
	zassert_not_equal(-1, offsetof(struct hostent, h_aliases));
	zassert_not_equal(-1, offsetof(struct hostent, h_addrtype));
	zassert_not_equal(-1, offsetof(struct hostent, h_length));
	zassert_not_equal(-1, offsetof(struct hostent, h_addr_list));

	zassert_not_equal(-1, offsetof(struct netent, n_name));
	zassert_not_equal(-1, offsetof(struct netent, n_aliases));
	zassert_not_equal(-1, offsetof(struct netent, n_addrtype));
	zassert_not_equal(-1, offsetof(struct netent, n_net));

	zassert_not_equal(-1, offsetof(struct protoent, p_name));
	zassert_not_equal(-1, offsetof(struct protoent, p_aliases));
	zassert_not_equal(-1, offsetof(struct protoent, p_proto));

	zassert_not_equal(-1, offsetof(struct servent, s_name));
	zassert_not_equal(-1, offsetof(struct servent, s_aliases));
	zassert_not_equal(-1, offsetof(struct servent, s_port));
	zassert_not_equal(-1, offsetof(struct servent, s_proto));

	/* zassert_equal(IPPORT_RESERVED, UINT16_MAX); */ /* not implemented */

	zassert_not_equal(-1, offsetof(struct addrinfo, ai_flags));
	zassert_not_equal(-1, offsetof(struct addrinfo, ai_family));
	zassert_not_equal(-1, offsetof(struct addrinfo, ai_socktype));
	zassert_not_equal(-1, offsetof(struct addrinfo, ai_protocol));
	zassert_not_equal(-1, offsetof(struct addrinfo, ai_addrlen));
	zassert_not_equal(-1, offsetof(struct addrinfo, ai_addr));
	zassert_not_equal(-1, offsetof(struct addrinfo, ai_canonname));
	zassert_not_equal(-1, offsetof(struct addrinfo, ai_next));

	zassert_not_equal(-1, AI_PASSIVE);
	zassert_not_equal(-1, AI_CANONNAME);
	zassert_not_equal(-1, AI_NUMERICHOST);
	zassert_not_equal(-1, AI_NUMERICSERV);
	zassert_not_equal(-1, AI_V4MAPPED);
	zassert_not_equal(-1, AI_ALL);
	zassert_not_equal(-1, AI_ADDRCONFIG);

	zassert_not_equal(-1, NI_NOFQDN);
	zassert_not_equal(-1, NI_NUMERICHOST);
	zassert_not_equal(-1, NI_NAMEREQD);
	zassert_not_equal(-1, NI_NUMERICSERV);
	/* zassert_not_equal(-1, NI_NUMERICSCOPE); */ /* not implemented */
	zassert_not_equal(-1, NI_DGRAM);

	zassert_not_equal(-1, EAI_AGAIN);
	zassert_equal(-1, EAI_BADFLAGS);
	zassert_not_equal(-1, EAI_FAIL);
	zassert_not_equal(-1, EAI_FAMILY);
	zassert_not_equal(-1, EAI_MEMORY);
	zassert_not_equal(-1, EAI_NONAME);
	zassert_not_equal(-1, EAI_SERVICE);
	zassert_not_equal(-1, EAI_SOCKTYPE);
	zassert_not_equal(-1, EAI_SYSTEM);
	zassert_not_equal(-1, EAI_OVERFLOW);

	if (IS_ENABLED(CONFIG_POSIX_NETWORKING)) {
		zassert_not_null(endhostent);
		zassert_not_null(endnetent);
		zassert_not_null(endprotoent);
		zassert_not_null(endservent);
		zassert_not_null(freeaddrinfo);
		zassert_not_null(gai_strerror);
		zassert_not_null(getaddrinfo);
		zassert_not_null(gethostent);
		zassert_not_null(getnameinfo);
		zassert_not_null(getnetbyaddr);
		zassert_not_null(getnetbyname);
		zassert_not_null(getnetent);
		zassert_not_null(getprotobyname);
		zassert_not_null(getprotobynumber);
		zassert_not_null(getprotoent);
		zassert_not_null(getservbyname);
		zassert_not_null(getservbyport);
		zassert_not_null(getservent);
		zassert_not_null(sethostent);
		zassert_not_null(setnetent);
		zassert_not_null(setprotoent);
		zassert_not_null(setservent);
	}
}
```

## src/netinet_in_h.c
```c
/*
 * Copyright (c) 2022 Meta
 *
 * SPDX-License-Identifier: Apache-2.0
 */

#include "_common.h"

#include <netinet/in.h>

/**
 * @brief existence test for `<netinet/in.h>`
 *
 * @see <a href="https://pubs.opengroup.org/onlinepubs/9699919799/basedefs/netinet_in.h.html">netinet/in.h</a>
 */
ZTEST(posix_headers, test_netinet_in_h)
{
	zexpect_equal(sizeof(in_port_t), sizeof(uint16_t));
	zexpect_equal(sizeof(in_addr_t), sizeof(uint32_t));

	zexpect_not_equal(-1, offsetof(struct in_addr, s_addr));

	zexpect_not_equal(-1, offsetof(struct sockaddr_in, sin_family));
	zexpect_not_equal(-1, offsetof(struct sockaddr_in, sin_port));
	zexpect_not_equal(-1, offsetof(struct sockaddr_in, sin_addr));

	zexpect_not_equal(-1, offsetof(struct in6_addr, s6_addr));
	zexpect_equal(sizeof(((struct in6_addr *)NULL)->s6_addr), 16 * sizeof(uint8_t));

	zexpect_not_equal(-1, offsetof(struct sockaddr_in6, sin6_family));
	zexpect_not_equal(-1, offsetof(struct sockaddr_in6, sin6_port));
	/* not implemented */
	/* zexpect_not_equal(-1, offsetof(struct sockaddr_in6, sin6_flowinfo)); */
	zexpect_not_equal(-1, offsetof(struct sockaddr_in6, sin6_addr));
	zexpect_not_equal(-1, offsetof(struct sockaddr_in6, sin6_scope_id));

	zexpect_not_null(&in6addr_any);
	zexpect_not_null(&in6addr_loopback);
	struct in6_addr any6 = IN6ADDR_ANY_INIT;
	struct in6_addr lo6 = IN6ADDR_LOOPBACK_INIT;

	struct in6_addr mcast6 = { { { 0xff, 0 } } };
	struct in6_addr ll6 = { { { 0xfe, 0x80, 0x01, 0x02,
				0, 0, 0, 0, 0, 0x01 } } };
	struct in6_addr sl6  = { { { 0xfe, 0xc0, 0, 0x01, 0x02 } } };
	struct in6_addr v4mapped = { { { 0, 0, 0, 0, 0, 0, 0, 0,
				0xff, 0xff, 0xff, 0xff, 0xc0, 0, 0x02, 0x01 } } };
	struct in6_addr mcnl6 = { { { 0xff, 0x01, 0, 0, 0, 0, 0, 0,
				0, 0, 0, 0, 0, 0, 0, 0x01 } } };
	struct in6_addr mcll6 = { { { 0xff, 0x02, 0, 0, 0, 0, 0, 0,
				0, 0, 0, 0, 0, 0, 0, 0x01 } } };
	struct in6_addr mcsl6 = { { { 0xff, 0x05, 0, 0, 0, 0, 0, 0,
				0, 0, 0, 0, 0, 0, 0, 0x01 } } };
	struct in6_addr mcol6 = { { { 0xff, 0x08, 0, 0, 0, 0, 0, 0,
				0, 0, 0, 0, 0, 0, 0, 0x01 } } };
	struct in6_addr mcg6 = { { { 0xff, 0x0e, 0, 0, 0, 0, 0, 0,
				0, 0, 0, 0, 0, 0, 0, 0x01 } } };

	zexpect_not_equal(-1, offsetof(struct ipv6_mreq, ipv6mr_multiaddr));
	zexpect_not_equal(-1, offsetof(struct ipv6_mreq, ipv6mr_ifindex));

	zexpect_not_equal(-1, IPPROTO_IP);
	zexpect_not_equal(-1, IPPROTO_IPV6);
	zexpect_not_equal(-1, IPPROTO_ICMP);
	zexpect_not_equal(-1, IPPROTO_RAW);
	zexpect_not_equal(-1, IPPROTO_TCP);
	zexpect_not_equal(-1, IPPROTO_UDP);

	zexpect_not_equal(-1, INADDR_ANY);
	zexpect_equal(0xffffffff, INADDR_BROADCAST);

	zexpect_equal(INET_ADDRSTRLEN, 16);
	zexpect_equal(INET6_ADDRSTRLEN, 46);

	zexpect_equal(IPV6_ADD_MEMBERSHIP, IPV6_JOIN_GROUP);
	zexpect_equal(IPV6_DROP_MEMBERSHIP, IPV6_LEAVE_GROUP);
	zexpect_not_equal(-1, IPV6_MULTICAST_HOPS);
	/* zexpect_not_equal(-1, IPV6_MULTICAST_IF); */ /* not implemented */
	/* zexpect_not_equal(-1, IPV6_MULTICAST_LOOP); */ /* not implemented */
	zexpect_not_equal(-1, IPV6_UNICAST_HOPS);
	zexpect_not_equal(-1, IPV6_V6ONLY);

	zexpect_true(IN6_IS_ADDR_UNSPECIFIED(&any6));
	zexpect_true(IN6_IS_ADDR_LOOPBACK(&lo6));

	zexpect_true(IN6_IS_ADDR_MULTICAST(&mcast6));
	zexpect_true(IN6_IS_ADDR_LINKLOCAL(&ll6));
	zexpect_true(IN6_IS_ADDR_SITELOCAL(&sl6));
	zexpect_true(IN6_IS_ADDR_V4MAPPED(&v4mapped));
	/* IN6_IS_ADDR_V4COMPAT(&lo6); */ /* not implemented */
	zexpect_true(IN6_IS_ADDR_MC_NODELOCAL(&mcnl6));
	zexpect_true(IN6_IS_ADDR_MC_LINKLOCAL(&mcll6));
	zexpect_true(IN6_IS_ADDR_MC_SITELOCAL(&mcsl6));
	zexpect_true(IN6_IS_ADDR_MC_ORGLOCAL(&mcol6));
	zexpect_true(IN6_IS_ADDR_MC_GLOBAL(&mcg6));
}
```

## src/netinet_tcp_h.c
```c
/*
 * Copyright (c) 2022 Meta
 *
 * SPDX-License-Identifier: Apache-2.0
 */

#include "_common.h"

#include <netinet/tcp.h>

/**
 * @brief existence test for `<netinet/tcp.h>`
 *
 * @see <a href="https://pubs.opengroup.org/onlinepubs/9699919799/basedefs/netinet_tcp.h.html">netinet/tcp.h</a>
 */
ZTEST(posix_headers, test_netinet_tcp_h)
{
	zassert_not_equal(-1, TCP_NODELAY);
}
```

## src/poll_h.c
```c
/*
 * Copyright (c) 2022 Meta
 *
 * SPDX-License-Identifier: Apache-2.0
 */

#include "_common.h"

#include <poll.h>

/**
 * @brief existence test for `<poll.h>`
 *
 * @see <a href="https://pubs.opengroup.org/onlinepubs/9699919799/basedefs/poll.h.html">poll.h</a>
 */
ZTEST(posix_headers, test_poll_h)
{
	zassert_not_equal(-1, offsetof(struct pollfd, fd));
	zassert_not_equal(-1, offsetof(struct pollfd, events));
	zassert_not_equal(-1, offsetof(struct pollfd, revents));

	zassert_true(sizeof(nfds_t) <= sizeof(long));

	zassert_not_equal(-1, POLLIN);
	/* zassert_not_equal(-1, POLLRDNORM); */ /* not implemented */
	/* zassert_not_equal(-1, POLLRDBAND); */ /* not implemented */
	zassert_not_equal(-1, POLLPRI);
	zassert_not_equal(-1, POLLOUT);
	/* zassert_not_equal(-1, POLLWRNORM); */ /* not implemented */
	/* zassert_not_equal(-1, POLLWRBAND); */ /* not implemented */
	zassert_not_equal(-1, POLLERR);
	zassert_not_equal(-1, POLLHUP);
	zassert_not_equal(-1, POLLNVAL);

	if (IS_ENABLED(CONFIG_POSIX_DEVICE_IO)) {
		zassert_not_null(poll);
	}
}
```
