## CMakeLists.txt
```
# SPDX-License-Identifier: Apache-2.0

cmake_minimum_required(VERSION 3.20.0)
find_package(Zephyr REQUIRED HINTS $ENV{ZEPHYR_BASE})
project(posix_system_database_r)

FILE(GLOB app_sources src/*.c)
target_sources(app PRIVATE ${app_sources})

target_compile_options(app PRIVATE -U_POSIX_C_SOURCE -D_POSIX_C_SOURCE=200809L)
```

## prj.conf
```kconfig
CONFIG_POSIX_API=y
CONFIG_ZTEST=y

CONFIG_POSIX_AEP_CHOICE_BASE=y
CONFIG_POSIX_SYSTEM_DATABASE_R=y
CONFIG_FAT_FILESYSTEM_ELM=y

CONFIG_MAIN_STACK_SIZE=4096
```

## src/main.c
```c
/*
 * Copyright The Zephyr Project Contributors
 *
 * SPDX-License-Identifier: Apache-2.0
 */

#include <grp.h>
#include <pwd.h>

#include <zephyr/ztest.h>

static char buf[CONFIG_POSIX_GETGR_R_SIZE_MAX];

ZTEST(posix_system_database_r, test_getpwnam_r)
{
	struct passwd pwd;
	struct passwd *result;

	{
		/* degenerate cases */
		zexpect_not_ok(getpwnam_r(NULL, NULL, NULL, 0, NULL));
		zexpect_not_ok(getpwnam_r(NULL, NULL, NULL, 0, &result));
		zexpect_not_ok(getpwnam_r(NULL, NULL, NULL, sizeof(buf), NULL));
		zexpect_not_ok(getpwnam_r(NULL, NULL, NULL, sizeof(buf), &result));
		zexpect_not_ok(getpwnam_r(NULL, NULL, buf, 0, NULL));
		zexpect_not_ok(getpwnam_r(NULL, NULL, buf, 0, &result));
		zexpect_not_ok(getpwnam_r(NULL, NULL, buf, sizeof(buf), NULL));
		zexpect_not_ok(getpwnam_r(NULL, NULL, buf, sizeof(buf), &result));
		zexpect_not_ok(getpwnam_r(NULL, &pwd, NULL, 0, NULL));
		zexpect_not_ok(getpwnam_r(NULL, &pwd, NULL, 0, &result));
		zexpect_not_ok(getpwnam_r(NULL, &pwd, NULL, sizeof(buf), NULL));
		zexpect_not_ok(getpwnam_r(NULL, &pwd, NULL, sizeof(buf), &result));
		zexpect_not_ok(getpwnam_r(NULL, &pwd, buf, 0, NULL));
		zexpect_not_ok(getpwnam_r(NULL, &pwd, buf, 0, &result));
		zexpect_not_ok(getpwnam_r(NULL, &pwd, buf, sizeof(buf), NULL));
		zexpect_not_ok(getpwnam_r(NULL, &pwd, buf, sizeof(buf), &result));
		zexpect_not_ok(getpwnam_r("root", NULL, NULL, 0, NULL));
		zexpect_not_ok(getpwnam_r("root", NULL, NULL, 0, &result));
		zexpect_not_ok(getpwnam_r("root", NULL, NULL, sizeof(buf), NULL));
		zexpect_not_ok(getpwnam_r("root", NULL, NULL, sizeof(buf), &result));
		zexpect_not_ok(getpwnam_r("root", NULL, buf, 0, NULL));
		zexpect_not_ok(getpwnam_r("root", NULL, buf, 0, &result));
		zexpect_not_ok(getpwnam_r("root", NULL, buf, sizeof(buf), NULL));
		zexpect_not_ok(getpwnam_r("root", NULL, buf, sizeof(buf), &result));
		zexpect_not_ok(getpwnam_r("root", &pwd, NULL, 0, NULL));
		zexpect_not_ok(getpwnam_r("root", &pwd, NULL, 0, &result));
		zexpect_not_ok(getpwnam_r("root", &pwd, NULL, sizeof(buf), NULL));
		zexpect_not_ok(getpwnam_r("root", &pwd, NULL, sizeof(buf), &result));
		zexpect_not_ok(getpwnam_r("root", &pwd, buf, 0, NULL));
		zexpect_not_ok(getpwnam_r("root", &pwd, buf, 0, &result));
		zexpect_not_ok(getpwnam_r("root", &pwd, buf, sizeof(buf), NULL));

		/* buffer is not large enough */
		zexpect_equal(getpwnam_r("root", &pwd, buf, 1, &result), ERANGE);

		/* user is not found in /etc/passwd */
		result = (struct passwd *)0x42;
		zexpect_ok(getpwnam_r("nobody", &pwd, buf, sizeof(buf), &result));
		zexpect_equal(result, NULL);
	}

	zexpect_ok(getpwnam_r("root", &pwd, buf, sizeof(buf), &result));
	zexpect_equal(result, &pwd);
	zexpect_str_equal(pwd.pw_name, "root");
	zexpect_equal(pwd.pw_uid, 0);
	zexpect_equal(pwd.pw_gid, 0);
	zexpect_str_equal(pwd.pw_dir, "/root");
	zexpect_str_equal(pwd.pw_shell, "/bin/sh");

	zexpect_ok(getpwnam_r("user", &pwd, buf, sizeof(buf), &result));
	zexpect_equal(result, &pwd);
	zexpect_str_equal(pwd.pw_name, "user");
	zexpect_equal(pwd.pw_uid, 1000);
	zexpect_equal(pwd.pw_gid, 1000);
	zexpect_str_equal(pwd.pw_dir, "/home/user");
	zexpect_str_equal(pwd.pw_shell, "/bin/sh");
}

ZTEST(posix_system_database_r, test_getpwuid_r)
{
	struct passwd pwd;
	struct passwd *result;

	{
		/* degenerate cases */
		zexpect_not_ok(getpwuid_r(-1, NULL, NULL, 0, NULL));
		zexpect_not_ok(getpwuid_r(-1, NULL, NULL, 0, &result));
		zexpect_not_ok(getpwuid_r(-1, NULL, NULL, sizeof(buf), NULL));
		zexpect_not_ok(getpwuid_r(-1, NULL, NULL, sizeof(buf), &result));
		zexpect_not_ok(getpwuid_r(-1, NULL, buf, 0, NULL));
		zexpect_not_ok(getpwuid_r(-1, NULL, buf, 0, &result));
		zexpect_not_ok(getpwuid_r(-1, NULL, buf, sizeof(buf), NULL));
		zexpect_not_ok(getpwuid_r(-1, NULL, buf, sizeof(buf), &result));
		zexpect_not_ok(getpwuid_r(-1, &pwd, NULL, 0, NULL));
		zexpect_not_ok(getpwuid_r(-1, &pwd, NULL, 0, &result));
		zexpect_not_ok(getpwuid_r(-1, &pwd, NULL, sizeof(buf), NULL));
		zexpect_not_ok(getpwuid_r(-1, &pwd, NULL, sizeof(buf), &result));
		zexpect_not_ok(getpwuid_r(-1, &pwd, buf, 0, NULL));
		zexpect_not_ok(getpwuid_r(-1, &pwd, buf, 0, &result));
		zexpect_not_ok(getpwuid_r(-1, &pwd, buf, sizeof(buf), NULL));
		zexpect_not_ok(getpwuid_r(-1, &pwd, buf, sizeof(buf), &result));
		zexpect_not_ok(getpwuid_r(0, NULL, NULL, 0, NULL));
		zexpect_not_ok(getpwuid_r(0, NULL, NULL, 0, &result));
		zexpect_not_ok(getpwuid_r(0, NULL, NULL, sizeof(buf), NULL));
		zexpect_not_ok(getpwuid_r(0, NULL, NULL, sizeof(buf), &result));
		zexpect_not_ok(getpwuid_r(0, NULL, buf, 0, NULL));
		zexpect_not_ok(getpwuid_r(0, NULL, buf, 0, &result));
		zexpect_not_ok(getpwuid_r(0, NULL, buf, sizeof(buf), NULL));
		zexpect_not_ok(getpwuid_r(0, NULL, buf, sizeof(buf), &result));
		zexpect_not_ok(getpwuid_r(0, &pwd, NULL, 0, NULL));
		zexpect_not_ok(getpwuid_r(0, &pwd, NULL, 0, &result));
		zexpect_not_ok(getpwuid_r(0, &pwd, NULL, sizeof(buf), NULL));
		zexpect_not_ok(getpwuid_r(0, &pwd, NULL, sizeof(buf), &result));
		zexpect_not_ok(getpwuid_r(0, &pwd, buf, 0, NULL));
		zexpect_not_ok(getpwuid_r(0, &pwd, buf, 0, &result));
		zexpect_not_ok(getpwuid_r(0, &pwd, buf, sizeof(buf), NULL));

		/* buffer is not large enough */
		zexpect_equal(getpwuid_r(0, &pwd, buf, 1, &result), ERANGE);

		/* user is not found in /etc/passwd */
		result = (struct passwd *)0x42;
		zexpect_ok(getpwuid_r(1001, &pwd, buf, sizeof(buf), &result));
		zexpect_equal(result, NULL);
	}

	zexpect_ok(getpwuid_r(0, &pwd, buf, sizeof(buf), &result));
	zexpect_equal(result, &pwd);
	zexpect_str_equal(pwd.pw_name, "root");
	zexpect_equal(pwd.pw_uid, 0);
	zexpect_equal(pwd.pw_gid, 0);
	zexpect_str_equal(pwd.pw_dir, "/root");
	zexpect_str_equal(pwd.pw_shell, "/bin/sh");

	zexpect_ok(getpwuid_r(1000, &pwd, buf, sizeof(buf), &result));
	zexpect_equal(result, &pwd);
	zexpect_str_equal(pwd.pw_name, "user");
	zexpect_equal(pwd.pw_uid, 1000);
	zexpect_equal(pwd.pw_gid, 1000);
	zexpect_str_equal(pwd.pw_dir, "/home/user");
	zexpect_str_equal(pwd.pw_shell, "/bin/sh");
}

static const char *const members[] = {
	"staff",
	"admin",
};

ZTEST(posix_system_database_r, test_getgrnam_r)
{
	struct group grp;
	struct group *result;

	{
		/* degenerate cases */
		zexpect_not_ok(getgrnam_r(NULL, NULL, NULL, 0, NULL));
		zexpect_not_ok(getgrnam_r(NULL, NULL, NULL, 0, &result));
		zexpect_not_ok(getgrnam_r(NULL, NULL, NULL, sizeof(buf), NULL));
		zexpect_not_ok(getgrnam_r(NULL, NULL, NULL, sizeof(buf), &result));
		zexpect_not_ok(getgrnam_r(NULL, NULL, buf, 0, NULL));
		zexpect_not_ok(getgrnam_r(NULL, NULL, buf, 0, &result));
		zexpect_not_ok(getgrnam_r(NULL, NULL, buf, sizeof(buf), NULL));
		zexpect_not_ok(getgrnam_r(NULL, NULL, buf, sizeof(buf), &result));
		zexpect_not_ok(getgrnam_r(NULL, &grp, NULL, 0, NULL));
		zexpect_not_ok(getgrnam_r(NULL, &grp, NULL, 0, &result));
		zexpect_not_ok(getgrnam_r(NULL, &grp, NULL, sizeof(buf), NULL));
		zexpect_not_ok(getgrnam_r(NULL, &grp, NULL, sizeof(buf), &result));
		zexpect_not_ok(getgrnam_r(NULL, &grp, buf, 0, NULL));
		zexpect_not_ok(getgrnam_r(NULL, &grp, buf, 0, &result));
		zexpect_not_ok(getgrnam_r(NULL, &grp, buf, sizeof(buf), NULL));
		zexpect_not_ok(getgrnam_r(NULL, &grp, buf, sizeof(buf), &result));
		zexpect_not_ok(getgrnam_r("root", NULL, NULL, 0, NULL));
		zexpect_not_ok(getgrnam_r("root", NULL, NULL, 0, &result));
		zexpect_not_ok(getgrnam_r("root", NULL, NULL, sizeof(buf), NULL));
		zexpect_not_ok(getgrnam_r("root", NULL, NULL, sizeof(buf), &result));
		zexpect_not_ok(getgrnam_r("root", NULL, buf, 0, NULL));
		zexpect_not_ok(getgrnam_r("root", NULL, buf, 0, &result));
		zexpect_not_ok(getgrnam_r("root", NULL, buf, sizeof(buf), NULL));
		zexpect_not_ok(getgrnam_r("root", NULL, buf, sizeof(buf), &result));
		zexpect_not_ok(getgrnam_r("root", &grp, NULL, 0, NULL));
		zexpect_not_ok(getgrnam_r("root", &grp, NULL, 0, &result));
		zexpect_not_ok(getgrnam_r("root", &grp, NULL, sizeof(buf), NULL));
		zexpect_not_ok(getgrnam_r("root", &grp, NULL, sizeof(buf), &result));
		zexpect_not_ok(getgrnam_r("root", &grp, buf, 0, NULL));
		zexpect_not_ok(getgrnam_r("root", &grp, buf, 0, &result));
		zexpect_not_ok(getgrnam_r("root", &grp, buf, sizeof(buf), NULL));

		/* buffer is not large enough */
		zexpect_equal(getgrnam_r("root", &grp, buf, 1, &result), ERANGE);

		/* group is not found in /etc/group */
		result = (struct group *)0x42;
		zexpect_ok(getgrnam_r("nobody", &grp, buf, sizeof(buf), &result));
		zexpect_equal(result, NULL);
	}

	zexpect_ok(getgrnam_r("root", &grp, buf, sizeof(buf), &result));
	zexpect_equal(result, &grp);
	zexpect_str_equal(grp.gr_name, "root");
	zexpect_equal(grp.gr_gid, 0);
	zassert_within((uintptr_t)grp.gr_mem, (uintptr_t)buf, sizeof(buf));
	zexpect_equal(grp.gr_mem[0], NULL);

	zexpect_ok(getgrnam_r("user", &grp, buf, sizeof(buf), &result));
	zexpect_equal(result, &grp);
	zexpect_str_equal(grp.gr_name, "user");
	zexpect_equal(grp.gr_gid, 1000);
	zassert_within((uintptr_t)grp.gr_mem, (uintptr_t)buf, sizeof(buf));
	ARRAY_FOR_EACH(members, i) {
		zexpect_str_equal(grp.gr_mem[i], members[i],
				  "members[%zu] (%s) does not match gr.gr_mem[%zu] (%s)", i,
				  members[i], i, grp.gr_mem[i]);
	}
	zexpect_equal(grp.gr_mem[2], NULL);
}

ZTEST(posix_system_database_r, test_getgrgid_r)
{
	struct group grp;
	struct group *result;

	{
		/* degenerate cases */
		zexpect_not_ok(getgrgid_r(-1, NULL, NULL, 0, NULL));
		zexpect_not_ok(getgrgid_r(-1, NULL, NULL, 0, &result));
		zexpect_not_ok(getgrgid_r(-1, NULL, NULL, sizeof(buf), NULL));
		zexpect_not_ok(getgrgid_r(-1, NULL, NULL, sizeof(buf), &result));
		zexpect_not_ok(getgrgid_r(-1, NULL, buf, 0, NULL));
		zexpect_not_ok(getgrgid_r(-1, NULL, buf, 0, &result));
		zexpect_not_ok(getgrgid_r(-1, NULL, buf, sizeof(buf), NULL));
		zexpect_not_ok(getgrgid_r(-1, NULL, buf, sizeof(buf), &result));
		zexpect_not_ok(getgrgid_r(-1, &grp, NULL, 0, NULL));
		zexpect_not_ok(getgrgid_r(-1, &grp, NULL, 0, &result));
		zexpect_not_ok(getgrgid_r(-1, &grp, NULL, sizeof(buf), NULL));
		zexpect_not_ok(getgrgid_r(-1, &grp, NULL, sizeof(buf), &result));
		zexpect_not_ok(getgrgid_r(-1, &grp, buf, 0, NULL));
		zexpect_not_ok(getgrgid_r(-1, &grp, buf, 0, &result));
		zexpect_not_ok(getgrgid_r(-1, &grp, buf, sizeof(buf), NULL));
		zexpect_not_ok(getgrgid_r(-1, &grp, buf, sizeof(buf), &result));
		zexpect_not_ok(getgrgid_r(0, NULL, NULL, 0, NULL));
		zexpect_not_ok(getgrgid_r(0, NULL, NULL, 0, &result));
		zexpect_not_ok(getgrgid_r(0, NULL, NULL, sizeof(buf), NULL));
		zexpect_not_ok(getgrgid_r(0, NULL, NULL, sizeof(buf), &result));
		zexpect_not_ok(getgrgid_r(0, NULL, buf, 0, NULL));
		zexpect_not_ok(getgrgid_r(0, NULL, buf, 0, &result));
		zexpect_not_ok(getgrgid_r(0, NULL, buf, sizeof(buf), NULL));
		zexpect_not_ok(getgrgid_r(0, NULL, buf, sizeof(buf), &result));
		zexpect_not_ok(getgrgid_r(0, &grp, NULL, 0, NULL));
		zexpect_not_ok(getgrgid_r(0, &grp, NULL, 0, &result));
		zexpect_not_ok(getgrgid_r(0, &grp, NULL, sizeof(buf), NULL));
		zexpect_not_ok(getgrgid_r(0, &grp, NULL, sizeof(buf), &result));
		zexpect_not_ok(getgrgid_r(0, &grp, buf, 0, NULL));
		zexpect_not_ok(getgrgid_r(0, &grp, buf, 0, &result));
		zexpect_not_ok(getgrgid_r(0, &grp, buf, sizeof(buf), NULL));

		/* buffer is not large enough */
		zexpect_equal(getgrgid_r(0, &grp, buf, 1, &result), ERANGE);

		/* group is not found in /etc/group */
		result = (struct group *)0x42;
		zexpect_ok(getgrgid_r(1001, &grp, buf, sizeof(buf), &result));
		zexpect_equal(result, NULL);
	}

	zexpect_ok(getgrgid_r(0, &grp, buf, sizeof(buf), &result));
	zexpect_equal(result, &grp);
	zexpect_str_equal(grp.gr_name, "root");
	zexpect_equal(grp.gr_gid, 0);
	zassert_within((uintptr_t)grp.gr_mem, (uintptr_t)buf, sizeof(buf));
	zexpect_equal(grp.gr_mem[0], NULL);

	zexpect_ok(getgrgid_r(1000, &grp, buf, sizeof(buf), &result));
	zexpect_equal(result, &grp);
	zexpect_str_equal(grp.gr_name, "user");
	zexpect_equal(grp.gr_gid, 1000);
	zassert_within((uintptr_t)grp.gr_mem, (uintptr_t)buf, sizeof(buf));
	ARRAY_FOR_EACH(members, i) {
		zexpect_str_equal(grp.gr_mem[i], members[i],
				  "members[%zu] (%s) does not match gr.gr_mem[%zu] (%s)", i,
				  members[i], i, grp.gr_mem[i]);
	}
	zexpect_equal(grp.gr_mem[2], NULL);
}

void *setup(void);
void teardown(void *arg);

ZTEST_SUITE(posix_system_database_r, NULL, setup, NULL, NULL, teardown);
```

## src/fs.c
```c
/*
 * Copyright The Zephyr Project Contributors
 *
 * SPDX-License-Identifier: Apache-2.0
 */

#include <string.h>

#include <ff.h>
#include <zephyr/fs/fs.h>
#include <zephyr/sys/util.h>
#include <zephyr/ztest.h>

static FATFS _fs;

static struct fs_mount_t _mnt = {
	.type = FS_FATFS,
	.mnt_point = "/",
	.fs_data = &_fs,
};

struct _entry {
	const char *const name;
	const char *const data;
};

static const struct _entry _data[] = {
	{.name = "/etc/passwd",
	 .data = "user:x:1000:1000:user:/home/user:/bin/sh\nroot:x:0:0:root:/root:/bin/sh\n"},
	{.name = "/etc/group", .data = "user:x:1000:staff,admin\nroot:x:0:\n"},
};

void *setup(void)
{
	int ret;

	memset(&_fs, 0, sizeof(_fs));

	ret = fs_mount(&_mnt);
	zassert_ok(ret, "mount failed: %d", ret);

	ret = fs_mkdir("/etc");
	zassert_ok(ret, "mkdir failed: %d", ret);

	ARRAY_FOR_EACH_PTR(_data, entry) {
		int len;
		struct fs_file_t zfp;

		fs_file_t_init(&zfp);

		ret = fs_open(&zfp, entry->name, FS_O_CREATE | FS_O_RDWR | FS_O_TRUNC);
		zassert_true(ret >= 0, "open failed: %d", ret);

		len = strlen(entry->data);
		ret = fs_write(&zfp, entry->data, len);
		zassert_equal(ret, len, "%s returned %d instead of %d", "write", ret, len);

		ret = fs_close(&zfp);
		zassert_ok(ret, "%s returned %d instead of %d", "close", ret, len);
	};

	return &_mnt;
}

void teardown(void *arg)
{
	struct fs_mount_t *const mnt = arg;

	(void)fs_unmount(mnt);
}
```

## src/minifs.c
```c
/*
 * Copyright (c) 2024 Tenstorrent AI ULC
 *
 * SPDX-License-Identifier: Apache-2.0
 */

#include <fcntl.h>
#include <sys/stat.h>
#include <string.h>

#include <zephyr/sys/fdtable.h>
#include <zephyr/sys/util.h>

struct minifs_entry {
	const char *path;
	const char *contents;
};

static struct minifs_entry minifs[] = {
	{"/etc/passwd",
	 "user:x:1000:1000:user:/home/user:/bin/sh\nroot:x:0:0:root:/root:/bin/sh\n"},
	{"/etc/group", "user:x:1000:staff,admin\nroot:x:0:\n"},
};

static ssize_t minifs_read_offs(void *obj, void *buf, size_t sz, size_t offset)
{
	size_t len;

	ARRAY_FOR_EACH_PTR(minifs, entry) {
		if (obj == entry->path) {
			if (offset >= sizeof(entry->contents)) {
				return 0;
			}

			len = CLAMP(strlen(entry->contents) - offset, 0, sz);
			memcpy(buf, entry->contents + offset, len);

			return len;
		}
	}

	errno = EINVAL;
	return -1;
}

static int minifs_close2(void *obj, int fd)
{
	ARG_UNUSED(obj);
	ARG_UNUSED(fd);

	return 0;
}

static int minifs_ioctl(void *obj, unsigned int request, va_list args)
{
	ARG_UNUSED(obj);
	ARG_UNUSED(request);
	ARG_UNUSED(args);

	return 0;
}

static const struct fd_op_vtable minifs_fops = {
	.read_offs = minifs_read_offs,
	.close2 = minifs_close2,
	.ioctl = minifs_ioctl,
};

/* override other zvfs_open() */
int zvfs_open(const char *name, int flags, ...)
{
	int fd;

	ARRAY_FOR_EACH_PTR(minifs, entry) {
		if (strcmp(name, entry->path) == 0) {
			fd = zvfs_reserve_fd();
			if (fd < 0) {
				errno = ENFILE;
				return -1;
			}
			zvfs_finalize_typed_fd(fd, (void *)entry->path, &minifs_fops,
					       ZVFS_MODE_IFREG);
			return fd;
		}
	}

	errno = ENOENT;
	return -1;
}
```
