## CMakeLists.txt
```
# SPDX-License-Identifier: Apache-2.0

cmake_minimum_required(VERSION 3.20.0)
find_package(Zephyr REQUIRED HINTS $ENV{ZEPHYR_BASE})
project(xsi_single_process)

FILE(GLOB app_sources src/*.c)

target_sources(app PRIVATE ${app_sources})

target_compile_options(app PRIVATE -U_POSIX_C_SOURCE -D_POSIX_C_SOURCE=200809L)
target_compile_options(app PRIVATE -U_XOPEN_SOURCE -D_XOPEN_SOURCE=700)
target_include_directories(app PRIVATE ${ZEPHYR_BASE}/lib/posix/options)
```

## prj.conf
```kconfig
CONFIG_ZTEST=y

CONFIG_POSIX_AEP_CHOICE_BASE=y
CONFIG_XSI=y
CONFIG_XSI_SINGLE_PROCESS=y
```

## src/gethostid.c
```c
/*
 * Copyright (c) 2025 Tenstorrent AI ULC
 *
 * SPDX-License-Identifier: Apache-2.0
 */
#include <unistd.h>

#include <zephyr/ztest.h>

ZTEST(xsi_single_process, test_gethostid)
{
	long id = gethostid();

	if (id == -ENOSYS) {
		printk("CONFIG_HWINFO not implemented for %s\n", CONFIG_BOARD);
		ztest_test_skip();
	}

	uint32_t id32 = gethostid();

	zassert_equal((uint32_t)id, id32, "gethostid() returned inconsistent values %u (exp: %u)",
			(uint32_t)id, id32);
}
```

## src/putenv.c
```c
/*
 * Copyright (c) 2025 Tenstorrent AI ULC
 *
 * SPDX-License-Identifier: Apache-2.0
 */
#include <errno.h>
#include <stdlib.h>

#include <zephyr/ztest.h>

/* declare locally until #97855 is merged, as some C libraries do not declare it in stdlib.h */
int putenv(char *s);

ZTEST(xsi_single_process, test_putenv)
{
	char buf[64];

	{
		/* degenerate cases */
		static const char *const cases[] = {
			NULL, "", "=", "abc", "42", "=abc",
			/*
			 * Note:
			 * There are many poorly-formatted environment variable names and values
			 * that are invalid (from the perspective of a POSIX shell), but still
			 * accepted by setenv() and subsequently putenv().
			 *
			 * See also tests/posix/single_process/src/env.c
			 * See also lib/posix/shell/env.c:101
			 */
		};

		ARRAY_FOR_EACH(cases, i) {
			char *s;

			if (cases[i] == NULL) {
				s = NULL;
			} else {
				strncpy(buf, cases[i], sizeof(buf));
				buf[sizeof(buf) - 1] = '\0';
				s = buf;
			}

			errno = 0;
			zexpect_equal(-1, putenv(s), "putenv(%s) unexpectedly succeeded", s);
			zexpect_not_equal(0, errno, "putenv(%s) did not set errno", s);
		}
	}

	{
		/* valid cases */
		static const char *const cases[] = {
			"FOO=bar",
		};

		ARRAY_FOR_EACH(cases, i) {
			strncpy(buf, cases[i], sizeof(buf));
			buf[sizeof(buf) - 1] = '\0';

			zexpect_ok(putenv(buf), "putenv(%s) failed: %d", buf, errno);
		}
	}
}
```
