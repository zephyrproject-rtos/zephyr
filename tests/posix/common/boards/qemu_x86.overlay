/*
 * Copyright (c) 2024 Dawid Osuchowski
 *
 * SPDX-License-Identifier: Apache-2.0
 */

/ {
    chosen {
        zephyr,console = &euart;
    };

    euart: uart_emul {
        compatible = "zephyr,uart-emul";
        current-speed = <0>;
        status = "okay";
        rx-fifo-size = <256>;
		tx-fifo-size = <256>;
    };
};