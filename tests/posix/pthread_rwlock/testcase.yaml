## tests/posix/rwlocks/testcase.yaml
```yaml
common:
  filter: not CONFIG_NATIVE_LIBC
  tags:
    - posix
    - rwlocks
  # 1 tier0 platform per supported architecture
  platform_key:
    - arch
    - simulation
tests:
  portability.posix.rwlocks:
    min_flash: 64
    min_ram: 32
  portability.posix.rwlocks.minimal:
    extra_configs:
      - CONFIG_MINIMAL_LIBC=y
  portability.posix.rwlocks.newlib:
    filter: TOOLCHAIN_HAS_NEWLIB == 1
    extra_configs:
      - CONFIG_NEWLIB_LIBC=y
      - CONFIG_NEWLIB_LIBC_MIN_REQUIRED_HEAP_SIZE=8192
  portability.posix.rwlocks.picolibc:
    tags: picolibc
    filter: CONFIG_PICOLIBC_SUPPORTED
    extra_configs:
      - CONFIG_PICOLIBC=y
```

## tests/posix/semaphores/Kconfig
```kconfig
# Copyright (c) 2023, Meta
# SPDX-License-Identifier: Apache-2.0

config TEST_SEM_N_LOOPS
	int "Number of loops in semaphore test"
	range 16 1024
	default 32
	help
	  This option is specific to semaphore.test_named_semaphore in semaphore.c

source "Kconfig.zephyr"
```

## tests/posix/semaphores/testcase.yaml
```yaml
common:
  filter: not CONFIG_NATIVE_LIBC
  tags:
    - posix
    - semaphores
  # 1 tier0 platform per supported architecture
  platform_key:
    - arch
    - simulation
  integration_platforms:
    - qemu_x86_64
  min_flash: 64
  min_ram: 32
  # FVP SMP has unresolved issues
  platform_exclude:
    - fvp_base_revc_2xaem/v8a/smp
    - fvp_base_revc_2xaem/v8a/smp/ns
    - fvp_base_revc_2xaem/v9a/smp
    - fvp_base_revc_2xaem/v9a/smp/ns
tests:
  portability.posix.semaphores: {}
  portability.posix.semaphores.minimal:
    extra_configs:
      - CONFIG_MINIMAL_LIBC=y
  portability.posix.semaphores.newlib:
    filter: TOOLCHAIN_HAS_NEWLIB == 1
    extra_configs:
      - CONFIG_NEWLIB_LIBC=y
  portability.posix.semaphores.picolibc:
    tags: picolibc
    filter: CONFIG_PICOLIBC_SUPPORTED
    extra_configs:
      - CONFIG_PICOLIBC=y
```

## tests/posix/shm/testcase.yaml
```yaml
common:
  filter: not CONFIG_NATIVE_LIBC
  tags:
    - posix
    - shm
  # 1 tier0 platform per supported architecture
  platform_key:
    - arch
    - simulation
  platform_exclude:
    # linker_zephyr_pre0.cmd:140: syntax error (??)
    - qemu_xtensa/dc233c
    # CONFIG_MMU=y but no arch_mem_map() or arch_mem_unmap()
    - intel_ish_5_4_1
    - intel_ish_5_6_0
    - intel_ish_5_8_0
tests:
  portability.posix.shm: {}
```

## tests/posix/signal/Kconfig
```kconfig
# Copyright (c) 2023, Meta
#
# SPDX-License-Identifier: Apache-2.0

source "Kconfig.zephyr"
```

## tests/posix/signals/testcase.yaml
```yaml
common:
  filter: not CONFIG_NATIVE_LIBC
  tags:
    - posix
    - signals
  # 1 tier0 platform per supported architecture
  platform_key:
    - arch
    - simulation
  min_flash: 64
  min_ram: 32
  # Exclude qemu_arc/qemu_arc_hs5x for now because of qemu_arc issue
  # qemu-system-arc: /usr/src/debug/nativesdk-qemu-arc/git/target/arc/decoder-v2.c:266:
  #   arc_find_format_v2: Assertion `mcount != 0' failed.
  # Aborted (core dumped)
  platform_exclude:
    - qemu_arc/qemu_arc_hs5x
tests:
  portability.posix.signals:
    integration_platforms:
      - qemu_riscv64
  portability.posix.signals.minimal:
    integration_platforms:
      - qemu_riscv64
    extra_configs:
      - CONFIG_MINIMAL_LIBC=y
  portability.posix.signals.newlib:
    integration_platforms:
      - qemu_riscv64
    filter: TOOLCHAIN_HAS_NEWLIB == 1
    extra_configs:
      - CONFIG_NEWLIB_LIBC=y
  portability.posix.signals.picolibc:
    integration_platforms:
      - qemu_riscv64
    tags: picolibc
    filter: CONFIG_PICOLIBC_SUPPORTED
    extra_configs:
      - CONFIG_PICOLIBC=y
  portability.posix.signals.strginal_no_desc:
    integration_platforms:
      - qemu_riscv64
    extra_configs:
      - CONFIG_POSIX_SIGNAL_STRING_DESC=n
  portability.posix.signals.big_nsig:
    integration_platforms:
      - qemu_riscv64
    extra_configs:
      - CONFIG_POSIX_RTSIG_MAX=1024
  portability.posix.signals.native:
    platform_allow:
      - native_sim
      - native_sim/native/64
    integration_platforms:
      - native_sim
      - native_sim/native/64
    integration_toolchains:
      - host
      - llvm
    extra_configs:
      - CONFIG_PICOLIBC=y
```

## tests/posix/single_process/testcase.yaml
```yaml
common:
  filter: not CONFIG_NATIVE_LIBC
  tags:
    - posix
    - single_process
  # 1 tier0 platform per supported architecture
  platform_key:
    - arch
    - simulation
tests:
  portability.single_process.rwlocks:
    min_flash: 64
    min_ram: 32
  portability.posix.single_process.minimal:
    extra_configs:
      - CONFIG_MINIMAL_LIBC=y
  portability.posix.single_process.newlib:
    filter: TOOLCHAIN_HAS_NEWLIB == 1
    extra_configs:
      - CONFIG_NEWLIB_LIBC=y
  portability.posix.single_process.picolibc:
    tags: picolibc
    filter: CONFIG_PICOLIBC_SUPPORTED
    extra_configs:
      - CONFIG_PICOLIBC=y
```

## tests/posix/spinlocks/testcase.yaml
```yaml
common:
  filter: not CONFIG_NATIVE_LIBC
  tags:
    - posix
    - spinlocks
  # 1 tier0 platform per supported architecture
  platform_key:
    - arch
    - simulation
  min_flash: 64
  min_ram: 32
tests:
  portability.posix.spinlocks: {}
  portability.posix.spinlocks.minimal:
    extra_configs:
      - CONFIG_MINIMAL_LIBC=y
  portability.posix.spinlocks.newlib:
    filter: TOOLCHAIN_HAS_NEWLIB == 1
    extra_configs:
      - CONFIG_NEWLIB_LIBC=y
  portability.posix.spinlocks.picolibc:
    tags: picolibc
    filter: CONFIG_PICOLIBC_SUPPORTED
    extra_configs:
      - CONFIG_PICOLIBC=y
  portability.posix.spinlocks.no_spin_validate:
    extra_configs:
      - CONFIG_SPIN_VALIDATE=n
```

## tests/posix/stdio/testcase.yaml
```yaml
common:
  tags: posix
  platform_allow:
    - qemu_riscv64
  integration_platforms:
    - qemu_riscv64
tests:
  portability.posix.stdio:
    extra_configs:
      - CONFIG_USERSPACE=y
```

## tests/posix/system_database_r/testcase.yaml
```yaml
common:
  filter: not CONFIG_NATIVE_LIBC
  tags:
    - posix
    - posix_system_database_r
  # 1 tier0 platform per supported architecture
  platform_key:
    - arch
    - simulation
  min_flash: 64
  min_ram: 32
tests:
  portability.posix.posix_system_database_r: {}
  portability.posix.posix_system_database_r.minimal:
    extra_configs:
      - CONFIG_MINIMAL_LIBC=y
  portability.posix.posix_system_database_r.newlib:
    filter: TOOLCHAIN_HAS_NEWLIB == 1
    extra_configs:
      - CONFIG_NEWLIB_LIBC=y
  portability.posix.posix_system_database_r.picolibc:
    tags: picolibc
    filter: CONFIG_PICOLIBC_SUPPORTED
    extra_configs:
      - CONFIG_PICOLIBC=y
```

## tests/posix/thread_safe_functions/testcase.yaml
```yaml
common:
  filter: not CONFIG_NATIVE_LIBC
  tags:
    - posix
    - thread_safe_functions
  # 1 tier0 platform per supported architecture
  platform_key:
    - arch
    - simulation
  min_flash: 64
  min_ram: 32
tests:
  portability.posix.thread_safe_functions: {}
  portability.posix.thread_safe_functions.minimal:
    extra_configs:
      - CONFIG_MINIMAL_LIBC=y
  portability.posix.thread_safe_functions.newlib:
    filter: TOOLCHAIN_HAS_NEWLIB == 1
    extra_configs:
      - CONFIG_NEWLIB_LIBC=y
  portability.posix.thread_safe_functions.picolibc:
    tags: picolibc
    filter: CONFIG_PICOLIBC_SUPPORTED
    extra_configs:
      - CONFIG_PICOLIBC=y
```

## tests/posix/threads_base/testcase.yaml
```yaml
common:
  tags:
    - posix
    - threads_base
  min_ram: 64
  timeout: 240
  # 1 tier0 platform per supported architecture
  platform_key:
    - arch
    - simulation
  filter: not CONFIG_NATIVE_LIBC
tests:
  portability.posix.threads_base: {}
  portability.posix.threads_base.minimal:
    extra_configs:
      - CONFIG_MINIMAL_LIBC=y
  portability.posix.threads_base.newlib:
    filter: TOOLCHAIN_HAS_NEWLIB == 1
    extra_configs:
      - CONFIG_NEWLIB_LIBC=y
  portability.posix.threads_base.picolibc:
    tags: picolibc
    filter: CONFIG_PICOLIBC_SUPPORTED
    extra_configs:
      - CONFIG_PICOLIBC=y
```

## tests/posix/timerfd/testcase.yaml
```yaml
common:
  filter: not CONFIG_NATIVE_LIBC
  tags:
    - posix
    - timerfd
  # 1 tier0 platform per supported architecture
  platform_key:
    - arch
    - simulation
  integration_platforms:
    - qemu_riscv64
tests:
  portability.posix.timerfd: {}
  portability.posix.timerfd.minimal:
    extra_configs:
      - CONFIG_MINIMAL_LIBC=y
  portability.posix.timerfd.newlib:
    platform_exclude:
      - intel_ehl_crb
      - lpcxpresso55s06
    filter: TOOLCHAIN_HAS_NEWLIB == 1
    extra_configs:
      - CONFIG_NEWLIB_LIBC=y
  portability.posix.timerfd.armclang_std_libc:
    toolchain_allow: armclang
    extra_configs:
      - CONFIG_ARMCLANG_STD_LIBC=y
  portability.posix.timerfd.arcmwdtlib:
    toolchain_allow: arcmwdt
    extra_configs:
      - CONFIG_ARCMWDT_LIBC=y
  portability.posix.timerfd.picolibc:
    tags: picolibc
    filter: CONFIG_PICOLIBC_SUPPORTED
    extra_configs:
      - CONFIG_PICOLIBC=y
```

## tests/posix/xsi_realtime/testcase.yaml
```yaml
common:
  filter: not CONFIG_NATIVE_LIBC
  tags:
    - posix
    - xsi_realtime
  # 1 tier0 platform per supported architecture
  platform_key:
    - arch
    - simulation
  min_flash: 64
  min_ram: 32
  timeout: 240
  platform_exclude:
    # linker_zephyr_pre0.cmd:140: syntax error (??)
    - qemu_xtensa/dc233c
    - native_sim
    - native_sim/native/64
tests:
  portability.posix.xsi_realtime: {}
  portability.posix.xsi_realtime.minimal:
    extra_configs:
      - CONFIG_MINIMAL_LIBC=y
  portability.posix.xsi_realtime.newlib:
    filter: TOOLCHAIN_HAS_NEWLIB == 1
    extra_configs:
      - CONFIG_NEWLIB_LIBC=y
  portability.posix.xsi_realtime.picolibc:
    tags: picolibc
    filter: CONFIG_PICOLIBC_SUPPORTED
    extra_configs:
      - CONFIG_PICOLIBC=y
```

## tests/posix/xsi_realtime_threads/testcase.yaml
```yaml
common:
  filter: not CONFIG_NATIVE_LIBC
  tags:
    - posix
    - xsi_realtime_threads
  # 1 tier0 platform per supported architecture
  platform_key:
    - arch
    - simulation
  min_flash: 64
  min_ram: 32
  timeout: 520
  platform_exclude:
    # linker_zephyr_pre0.cmd:140: syntax error (??)
    - qemu_xtensa/dc233c
    - native_sim
    - native_sim/native/64
tests:
  portability.posix.xsi_realtime_threads: {}
  portability.posix.xsi_realtime_threads.minimal:
    extra_configs:
      - CONFIG_MINIMAL_LIBC=y
  portability.posix.xsi_realtime_threads.newlib:
    filter: TOOLCHAIN_HAS_NEWLIB == 1
    extra_configs:
      - CONFIG_NEWLIB_LIBC=y
  portability.posix.xsi_realtime_threads.picolibc:
    tags: picolibc
    filter: CONFIG_PICOLIBC_SUPPORTED
    extra_configs:
      - CONFIG_PICOLIBC=y
```

## tests/posix/xsi_single_process/testcase.yaml
```yaml
common:
  filter: not CONFIG_NATIVE_LIBC
  tags:
    - posix
    - xsi
    - single_process
  # 1 tier0 platform per supported architecture
  platform_key:
    - arch
    - simulation
  integration_platforms:
    - qemu_cortex_m0
  min_ram: 16
tests:
  portability.xsi.single_process:
    extra_configs:
      - CONFIG_COMMON_LIBC_MALLOC_ARENA_SIZE=256
  portability.xsi.single_process.armclang_std_libc:
    toolchain_allow: armclang
    extra_configs:
      - CONFIG_ARMCLANG_STD_LIBC=y
  portability.xsi.single_process.arcmwdtlib:
    toolchain_allow: arcmwdt
    extra_configs:
      - CONFIG_ARCMWDT_LIBC=y
  portability.xsi.single_process.minimal:
    extra_configs:
      - CONFIG_MINIMAL_LIBC=y
      - CONFIG_COMMON_LIBC_MALLOC_ARENA_SIZE=256
  portability.xsi.single_process.newlib:
    filter: TOOLCHAIN_HAS_NEWLIB == 1
    extra_configs:
      - CONFIG_NEWLIB_LIBC=y
      - CONFIG_NEWLIB_LIBC_MIN_REQUIRED_HEAP_SIZE=256
  portability.xsi.single_process.picolibc:
    tags: picolibc
    filter: CONFIG_PICOLIBC_SUPPORTED
    extra_configs:
      - CONFIG_PICOLIBC=y
```

## tests/posix/xsi_streams/testcase.yaml
```yaml
common:
  filter: not CONFIG_NATIVE_LIBC
  tags:
    - posix
    - xsi_streams
  # 1 tier0 platform per supported architecture
  platform_key:
    - arch
    - simulation
  integration_platforms:
    - qemu_riscv64
  min_flash: 64
  min_ram: 32
  # FVP SMP has unresolved issues
  platform_exclude:
    - fvp_base_revc_2xaem/v8a/smp
    - fvp_base_revc_2xaem/v8a/smp/ns
    - fvp_base_revc_2xaem/v9a/smp
    - fvp_base_revc_2xaem/v9a/smp/ns
tests:
  portability.posix.xsi_streams: {}
  portability.posix.xsi_streams.minimal:
    extra_configs:
      - CONFIG_MINIMAL_LIBC=y
  portability.posix.xsi_streams.newlib:
    filter: TOOLCHAIN_HAS_NEWLIB == 1
    extra_configs:
      - CONFIG_NEWLIB_LIBC=y
  portability.posix.xsi_streams.picolibc:
    tags: picolibc
    filter: CONFIG_PICOLIBC_SUPPORTED
    extra_configs:
      - CONFIG_PICOLIBC=y
```

## tests/posix/xsi_system_logging/testcase.yaml
```yaml
common:
  filter: not CONFIG_NATIVE_LIBC
  tags:
    - xsi.system.logging
  # 1 tier0 platform per supported architecture
  platform_key:
    - arch
    - simulation
  integration_platforms:
    - qemu_riscv64
  min_flash: 64
  min_ram: 32
  # FVP SMP has unresolved issues
  platform_exclude:
    - fvp_base_revc_2xaem/v8a/smp
    - fvp_base_revc_2xaem/v8a/smp/ns
    - fvp_base_revc_2xaem/v9a/smp
    - fvp_base_revc_2xaem/v9a/smp/ns
tests:
  portability.xsi.system.logging: {}
  portability.xsi.system.logging.minimal:
    extra_configs:
      - CONFIG_MINIMAL_LIBC=y
  portability.xsi.system.logging.newlib:
    filter: TOOLCHAIN_HAS_NEWLIB == 1
    extra_configs:
      - CONFIG_NEWLIB_LIBC=y
  portability.xsi.system.logging.picolibc:
    tags: picolibc
    filter: CONFIG_PICOLIBC_SUPPORTED
    extra_configs:
      - CONFIG_PICOLIBC=y
```

## tests/posix/xsi_threads_ext/testcase.yaml
```yaml
common:
  filter: not CONFIG_NATIVE_LIBC
  tags:
    - posix
    - xsi_threads_ext
  # 1 tier0 platform per supported architecture
  platform_key:
    - arch
    - simulation
  min_flash: 64
  min_ram: 32
tests:
  portability.posix.xsi_threads_ext: {}
  portability.posix.xsi_threads_ext.minimal:
    extra_configs:
      - CONFIG_MINIMAL_LIBC=y
  portability.posix.xsi_threads_ext.newlib:
    filter: TOOLCHAIN_HAS_NEWLIB == 1
    extra_configs:
      - CONFIG_NEWLIB_LIBC=y
  portability.posix.xsi_threads_ext.picolibc:
    tags: picolibc
    filter: CONFIG_PICOLIBC_SUPPORTED
    extra_configs:
      - CONFIG_PICOLIBC=y
  portability.posix.xsi_threads_ext.static_stack:
    extra_configs:
      - CONFIG_DYNAMIC_THREAD_ALLOC=n
```

## tests/power/multicore/arc/testcase.yaml
```yaml
tests:
  test:
    build_only: true
    platform_whitelist: quark_se_c1000_ss_devboard
    tags: pm
```
