## CMakeLists.txt
```
# SPDX-License-Identifier: Apache-2.0

cmake_minimum_required(VERSION 3.20.0)
find_package(Zephyr REQUIRED HINTS $ENV{ZEPHYR_BASE})
project(bsim_test_hogp)

add_subdirectory(${ZEPHYR_BASE}/tests/bsim/babblekit babblekit)
target_link_libraries(app PRIVATE babblekit)

add_subdirectory(${ZEPHYR_BASE}/tests/bluetooth/common/testlib testlib)
target_link_libraries(app PRIVATE testlib)

file(GLOB app_sources src/*.c)
target_sources(app PRIVATE ${app_sources})

zephyr_include_directories(
  ${BSIM_COMPONENTS_PATH}/libUtilv1/src/
  ${BSIM_COMPONENTS_PATH}/libPhyComv1/src/
)
```

## prj.conf
```kconfig
CONFIG_BT=y
CONFIG_BT_DEVICE_NAME="HOGP tester"
CONFIG_BT_PERIPHERAL=y
CONFIG_BT_CENTRAL=y
CONFIG_BT_GATT_CLIENT=y
CONFIG_BT_SMP=y
CONFIG_BT_GATT_DYNAMIC_DB=y

# HID Device side
CONFIG_BT_HIDS=y
CONFIG_BT_HIDS_INPUT_REPORT_COUNT=1
CONFIG_BT_HIDS_OUTPUT_REPORT_COUNT=1
CONFIG_BT_HIDS_FEATURE_REPORT_COUNT=2
CONFIG_BT_HIDS_MAX_REPORT_LEN=256

# HID Host side
CONFIG_BT_HOGP_HOST=y
# Exactly the long Feature Report, which takes a Read Long
CONFIG_BT_HOGP_HOST_MAX_REPORT_LEN=200

CONFIG_BT_MAX_PAIRED=2

CONFIG_BT_L2CAP_TX_MTU=140
CONFIG_BT_BUF_ACL_TX_SIZE=144
CONFIG_BT_BUF_ACL_RX_SIZE=144

CONFIG_BT_SETTINGS=y
CONFIG_FLASH=y
CONFIG_FLASH_MAP=y
CONFIG_NVS=y
CONFIG_SETTINGS=y

CONFIG_ASSERT=y
CONFIG_LOG=y
CONFIG_BT_HOGP_HOST_LOG_LEVEL_DBG=y
```

## src/main.c
```c
/*
 * Copyright (c) 2026 Xiaomi Corporation
 *
 * SPDX-License-Identifier: Apache-2.0
 */

#include "bstests.h"

extern struct bst_test_list *test_hogp_device_install(struct bst_test_list *tests);
extern struct bst_test_list *test_hogp_host_install(struct bst_test_list *tests);

bst_test_install_t test_installers[] = {test_hogp_device_install, test_hogp_host_install, NULL};

int main(void)
{
	bst_main();

	return 0;
}
```

## src/common.h
```c
/*
 * Copyright (c) 2026 Xiaomi Corporation
 *
 * SPDX-License-Identifier: Apache-2.0
 */

#ifndef HOGP_TEST_COMMON_H_
#define HOGP_TEST_COMMON_H_

#include <zephyr/bluetooth/services/hids.h>
#include <zephyr/types.h>
#include <zephyr/usb/class/hid.h>

/* Report IDs the HID Device registers, as many as
 * CONFIG_BT_HIDS_{INPUT,OUTPUT,FEATURE}_REPORT_COUNT configure.
 */
#define TEST_REPORT_ID_INPUT        0x01U
#define TEST_REPORT_ID_OUTPUT       0x02U
#define TEST_REPORT_ID_FEATURE      0x03U
/* A second Feature Report, long enough to need several ATT Read Blob Requests */
#define TEST_REPORT_ID_FEATURE_LONG 0x04U

/* Mouse (Input), keyboard LEDs (Output) and a vendor defined byte (Feature).
 * The Report Map has to describe every Report the HID Service exposes.
 */
/* The indentation mirrors the HID collection nesting. */
/* clang-format off */
/* Longer than one ATT PDU at the MTU this test negotiates, so a Host has to
 * use the Read Long Characteristic Value sub-procedure to read it.
 */
#define TEST_LONG_REPORT_LEN 200U

static const uint8_t test_report_map[] = {
	HID_USAGE_PAGE(HID_USAGE_GEN_DESKTOP),
	HID_USAGE(HID_USAGE_GEN_DESKTOP_MOUSE),
	HID_COLLECTION(HID_COLLECTION_APPLICATION),
		HID_REPORT_ID(TEST_REPORT_ID_INPUT),
		HID_USAGE(HID_USAGE_GEN_DESKTOP_POINTER),
		HID_COLLECTION(HID_COLLECTION_PHYSICAL),
			HID_USAGE_PAGE(HID_USAGE_GEN_BUTTON),
			HID_USAGE_MIN8(1),
			HID_USAGE_MAX8(3),
			HID_LOGICAL_MIN8(0),
			HID_LOGICAL_MAX8(1),
			HID_REPORT_SIZE(1),
			HID_REPORT_COUNT(3),
			HID_INPUT(0x02),
			HID_REPORT_SIZE(5),
			HID_REPORT_COUNT(1),
			HID_INPUT(0x03),
			HID_USAGE_PAGE(HID_USAGE_GEN_DESKTOP),
			HID_USAGE(HID_USAGE_GEN_DESKTOP_X),
			HID_USAGE(HID_USAGE_GEN_DESKTOP_Y),
			HID_LOGICAL_MIN8(-127),
			HID_LOGICAL_MAX8(127),
			HID_REPORT_SIZE(8),
			HID_REPORT_COUNT(2),
			HID_INPUT(0x06),
		HID_END_COLLECTION,
	HID_END_COLLECTION,

	HID_USAGE_PAGE(HID_USAGE_GEN_DESKTOP),
	HID_USAGE(HID_USAGE_GEN_DESKTOP_KEYBOARD),
	HID_COLLECTION(HID_COLLECTION_APPLICATION),
		HID_REPORT_ID(TEST_REPORT_ID_OUTPUT),
		HID_USAGE_PAGE(HID_USAGE_GEN_LEDS),
		HID_USAGE_MIN8(1),
		HID_USAGE_MAX8(5),
		HID_LOGICAL_MIN8(0),
		HID_LOGICAL_MAX8(1),
		HID_REPORT_SIZE(1),
		HID_REPORT_COUNT(5),
		HID_OUTPUT(0x02),
		HID_REPORT_SIZE(3),
		HID_REPORT_COUNT(1),
		HID_OUTPUT(0x03),
		HID_REPORT_ID(TEST_REPORT_ID_FEATURE),
		HID_USAGE_PAGE16(0xFF00),
		HID_USAGE(0x01),
		HID_LOGICAL_MIN8(0),
		HID_LOGICAL_MAX16(0xFF, 0x00),
		HID_REPORT_SIZE(8),
		HID_REPORT_COUNT(1),
		HID_FEATURE(0x02),
		HID_REPORT_ID(TEST_REPORT_ID_FEATURE_LONG),
		HID_USAGE_PAGE16(0xFF00),
		HID_USAGE(0x02),
		HID_LOGICAL_MIN8(0),
		HID_LOGICAL_MAX16(0xFF, 0x00),
		HID_REPORT_SIZE(8),
		HID_REPORT_COUNT(TEST_LONG_REPORT_LEN),
		HID_FEATURE(0x02),
	HID_END_COLLECTION,
};
/* clang-format on */

/* HID Information the server registers and the client verifies */
#define TEST_BCD_HID      0x0111U
#define TEST_COUNTRY_CODE 0x00U
#define TEST_HID_FLAGS    BT_HIDS_INFO_FLAG_NORMALLY_CONNECTABLE

/* Input Report payload: buttons (1) + X (1) + Y (1) */
#define TEST_INPUT_REPORT_LEN 3U
static const uint8_t test_input_data[TEST_INPUT_REPORT_LEN] = {0x01, 0x10, 0x20};

/* Output Report payload: the LED bitmap */
#define TEST_OUTPUT_REPORT_LEN 1U
static const uint8_t test_output_data[TEST_OUTPUT_REPORT_LEN] = {0x05};

/* Feature Report payload: the vendor defined byte */
#define TEST_FEATURE_REPORT_LEN 1U
static const uint8_t test_feature_data[TEST_FEATURE_REPORT_LEN] = {0x5A};

/* Feature Report payload the Host writes */
static const uint8_t test_feature_data_new[TEST_FEATURE_REPORT_LEN] = {0xA5};

/* Every octet of the long Feature Report */
#define TEST_LONG_REPORT_FILL 0x42U

/* Report characteristics of the HID Service, in handle order */
#define TEST_REPORT_COUNT 4U

#endif /* HOGP_TEST_COMMON_H_ */
```

## src/hogp_device_test.c
```c
/*
 * Copyright (c) 2026 Xiaomi Corporation
 *
 * SPDX-License-Identifier: Apache-2.0
 */

/* HID Device for the HOGP Host test: the HID Service, registered the way a
 * HOGP Device application registers it, with a Security Request on every
 * connection.
 */

#include <errno.h>
#include <stddef.h>
#include <string.h>

#include <zephyr/bluetooth/bluetooth.h>
#include <zephyr/bluetooth/conn.h>
#include <zephyr/bluetooth/services/hids.h>
#include <zephyr/bluetooth/uuid.h>
#include <zephyr/kernel.h>
#include <zephyr/settings/settings.h>
#include <zephyr/sys/util.h>

#include "babblekit/flags.h"
#include "babblekit/sync.h"
#include "babblekit/testcase.h"
#include "bstests.h"

#include "common.h"

DEFINE_FLAG_STATIC(flag_connected);
DEFINE_FLAG_STATIC(flag_disconnected);
DEFINE_FLAG_STATIC(flag_set_report);

static struct bt_conn *device_conn;

static enum bt_hids_report_type set_report_type;
static uint8_t set_report_id;
static uint8_t set_report_data[CONFIG_BT_HIDS_MAX_REPORT_LEN];
static uint16_t set_report_len;

static void device_connected(struct bt_conn *conn, uint8_t err)
{
	TEST_ASSERT(err == 0U, "Failed to connect (err 0x%02x)", err);

	device_conn = bt_conn_ref(conn);
	SET_FLAG(flag_connected);

	err = bt_conn_set_security(conn, BT_SECURITY_L2);
	TEST_ASSERT(err == 0, "Failed to request security: %d", err);
}

static void device_disconnected(struct bt_conn *conn, uint8_t reason)
{
	ARG_UNUSED(reason);

	if (conn != device_conn) {
		return;
	}

	bt_conn_unref(device_conn);
	device_conn = NULL;
	SET_FLAG(flag_disconnected);
}

static struct bt_conn_cb device_conn_cb = {
	.connected = device_connected,
	.disconnected = device_disconnected,
};

static void set_report(struct bt_conn *conn, enum bt_hids_report_type report_type,
		       uint8_t report_id, const uint8_t *data, uint16_t len)
{
	ARG_UNUSED(conn);

	TEST_ASSERT(len <= sizeof(set_report_data), "SET_REPORT of %u bytes", len);

	set_report_type = report_type;
	set_report_id = report_id;
	(void)memcpy(set_report_data, data, len);
	set_report_len = len;
	SET_FLAG(flag_set_report);
}

static const struct bt_hids_cb hids_cb = {
	.set_report = set_report,
};

static const struct bt_hids_register_param hids_param = {
	.bcd_hid = TEST_BCD_HID,
	.country_code = TEST_COUNTRY_CODE,
	.flags = TEST_HID_FLAGS,
	.report_map = test_report_map,
	.report_map_len = sizeof(test_report_map),
	.input_report_ids = {TEST_REPORT_ID_INPUT},
	.output_report_ids = {TEST_REPORT_ID_OUTPUT},
	.feature_report_ids = {TEST_REPORT_ID_FEATURE, TEST_REPORT_ID_FEATURE_LONG},
	.cb = &hids_cb,
};

static const struct bt_data ad[] = {
	BT_DATA_BYTES(BT_DATA_FLAGS, (BT_LE_AD_GENERAL | BT_LE_AD_NO_BREDR)),
	BT_DATA_BYTES(BT_DATA_UUID16_ALL, BT_UUID_16_ENCODE(BT_UUID_HIDS_VAL)),
	BT_DATA(BT_DATA_NAME_COMPLETE, CONFIG_BT_DEVICE_NAME, sizeof(CONFIG_BT_DEVICE_NAME) - 1),
};

static void connect_host(void)
{
	int err;

	UNSET_FLAG(flag_connected);
	UNSET_FLAG(flag_disconnected);

	err = bt_le_adv_start(BT_LE_ADV_CONN_FAST_1, ad, ARRAY_SIZE(ad), NULL, 0);
	TEST_ASSERT(err == 0, "Failed to start advertising: %d", err);

	WAIT_FOR_FLAG(flag_connected);
}

static void send_input_report(void)
{
	int err;

	err = bt_hids_send_report(device_conn, TEST_REPORT_ID_INPUT, test_input_data,
				  TEST_INPUT_REPORT_LEN, NULL, NULL);
	TEST_ASSERT(err == 0, "Failed to notify the Input Report: %d", err);
}

static void verify_set_report(enum bt_hids_report_type type, uint8_t id, const uint8_t *data,
			      uint16_t len)
{
	WAIT_FOR_FLAG(flag_set_report);
	UNSET_FLAG(flag_set_report);

	TEST_ASSERT(set_report_type == type && set_report_id == id,
		    "SET_REPORT of type %u ID %u, expected type %u ID %u", set_report_type,
		    set_report_id, type, id);
	TEST_ASSERT(set_report_len == len && memcmp(set_report_data, data, len) == 0,
		    "SET_REPORT with the wrong payload");
}

static void set_long_report(uint16_t len)
{
	uint8_t value[TEST_LONG_REPORT_LEN + 1U];
	int err;

	(void)memset(value, TEST_LONG_REPORT_FILL, len);
	err = bt_hids_report_set(BT_HIDS_REPORT_TYPE_FEATURE, TEST_REPORT_ID_FEATURE_LONG, value,
				 len);
	TEST_ASSERT(err == 0, "Failed to set the long Feature Report: %d", err);
}

static void set_reports(void)
{
	int err;

	err = bt_hids_report_set(BT_HIDS_REPORT_TYPE_FEATURE, TEST_REPORT_ID_FEATURE,
				 test_feature_data, sizeof(test_feature_data));
	TEST_ASSERT(err == 0, "Failed to set the Feature Report: %d", err);

	set_long_report(TEST_LONG_REPORT_LEN);
}

static void test_hogp_device(void)
{
	int err;

	err = bt_enable(NULL);
	TEST_ASSERT(err == 0, "Bluetooth init failed: %d", err);

	err = settings_load();
	TEST_ASSERT(err == 0, "Failed to load the settings: %d", err);

	TEST_ASSERT(bk_sync_init() == 0, "Failed to open the sync channel");

	bt_conn_cb_register(&device_conn_cb);

	err = bt_hids_register(&hids_param);
	TEST_ASSERT(err == 0, "Failed to register the HID Service: %d", err);

	set_reports();
	connect_host();

	/* The Host has discovered the service and subscribed */
	bk_sync_wait();
	send_input_report();

	/* SET_REPORT on the Output Report, then on the Feature Report */
	verify_set_report(BT_HIDS_REPORT_TYPE_OUTPUT, TEST_REPORT_ID_OUTPUT, test_output_data,
			  sizeof(test_output_data));
	verify_set_report(BT_HIDS_REPORT_TYPE_FEATURE, TEST_REPORT_ID_FEATURE,
			  test_feature_data_new, sizeof(test_feature_data_new));

	/* One octet more than the Host reads */
	set_long_report(TEST_LONG_REPORT_LEN + 1U);
	bk_sync_send();

	/* The Host reconnects to the bonded Device and discovers it again */
	WAIT_FOR_FLAG(flag_disconnected);
	connect_host();

	bk_sync_wait();
	send_input_report();

	WAIT_FOR_FLAG(flag_disconnected);

	TEST_PASS("HOGP Device test passed");
}

static const struct bst_test_instance test_hogp_device_defs[] = {
	{
		.test_id = "hogp_device",
		.test_descr = "HID Device built on the HID Service",
		.test_main_f = test_hogp_device,
	},
	BSTEST_END_MARKER,
};

struct bst_test_list *test_hogp_device_install(struct bst_test_list *tests)
{
	return bst_add_tests(tests, test_hogp_device_defs);
}
```

## src/hogp_host_test.c
```c
/*
 * Copyright (c) 2026 Xiaomi Corporation
 *
 * SPDX-License-Identifier: Apache-2.0
 */

/* HOGP Report Host: discovers the HID Device, checks what the discovery found
 * against what the Device registered, receives an Input Report, reads and
 * writes Reports, and checks the errors of the API. It never initiates pairing
 * itself, so the GATT client retries the reads that need encryption once the
 * Security Request of the Device has encrypted the link.
 */

#include <errno.h>
#include <stdbool.h>
#include <stddef.h>
#include <string.h>

#include <zephyr/bluetooth/bluetooth.h>
#include <zephyr/bluetooth/conn.h>
#include <zephyr/bluetooth/gatt.h>
#include <zephyr/bluetooth/hci_types.h>
#include <zephyr/bluetooth/hogp_host.h>
#include <zephyr/bluetooth/services/hids.h>
#include <zephyr/kernel.h>
#include <zephyr/settings/settings.h>
#include <zephyr/sys/util.h>

#include <testlib/att.h>
#include <testlib/conn.h>
#include <testlib/scan.h>

#include "babblekit/flags.h"
#include "babblekit/sync.h"
#include "babblekit/testcase.h"
#include "bstests.h"

#include "common.h"

/* The long Feature Report fills the read buffer exactly */
BUILD_ASSERT(CONFIG_BT_HOGP_HOST_MAX_REPORT_LEN == TEST_LONG_REPORT_LEN);

DEFINE_FLAG_STATIC(flag_discovered);
DEFINE_FLAG_STATIC(flag_input_report);
DEFINE_FLAG_STATIC(flag_report_read);
DEFINE_FLAG_STATIC(flag_report_written);

static struct bt_conn *host_conn;

static int discovered_err;

static uint8_t input_id;
static uint8_t input_data[TEST_INPUT_REPORT_LEN];
static uint16_t input_len;

static enum bt_hids_report_type read_type;
static uint8_t read_id;
static int read_err;
static uint8_t read_data[CONFIG_BT_HOGP_HOST_MAX_REPORT_LEN];
static uint16_t read_len;

static enum bt_hids_report_type written_type;
static uint8_t written_id;
static int written_err;

static void discovered(struct bt_conn *conn, int err)
{
	TEST_ASSERT(conn == host_conn, "Discovered on another connection");

	discovered_err = err;
	SET_FLAG(flag_discovered);
}

static void input_report(struct bt_conn *conn, uint8_t service_index, uint8_t report_id,
			 const uint8_t *data, uint16_t len)
{
	ARG_UNUSED(conn);

	TEST_ASSERT(service_index == 0U, "Input Report of service %u", service_index);
	TEST_ASSERT(len <= sizeof(input_data), "Input Report of %u octets", len);

	input_id = report_id;
	(void)memcpy(input_data, data, len);
	input_len = len;
	SET_FLAG(flag_input_report);
}

static void report_read(struct bt_conn *conn, uint8_t service_index, enum bt_hids_report_type type,
			uint8_t report_id, int err, const uint8_t *data, uint16_t len)
{
	ARG_UNUSED(conn);

	TEST_ASSERT(service_index == 0U, "Report read from service %u", service_index);
	TEST_ASSERT(err != 0 || len <= sizeof(read_data), "Report of %u octets", len);

	read_type = type;
	read_id = report_id;
	read_err = err;
	read_len = len;
	if (len > 0U) {
		(void)memcpy(read_data, data, len);
	}

	SET_FLAG(flag_report_read);
}

static void report_written(struct bt_conn *conn, uint8_t service_index,
			   enum bt_hids_report_type type, uint8_t report_id, int err)
{
	ARG_UNUSED(conn);

	TEST_ASSERT(service_index == 0U, "Report written to service %u", service_index);

	written_type = type;
	written_id = report_id;
	written_err = err;
	SET_FLAG(flag_report_written);
}

static const struct bt_hogp_host_cb hogp_cb = {
	.discovered = discovered,
	.input_report = input_report,
	.report_read = report_read,
	.report_written = report_written,
};

static void connect_device(bool exchange_mtu)
{
	bt_addr_le_t addr;
	int err;

	err = bt_testlib_scan_find_name(&addr, CONFIG_BT_DEVICE_NAME);
	TEST_ASSERT(err == 0, "Failed to find the HID Device: %d", err);

	err = bt_testlib_connect(&addr, &host_conn);
	TEST_ASSERT(err == 0, "Failed to connect: %d", err);

	if (!exchange_mtu) {
		return;
	}

	/* HOGP: exchange the MTU before the discovery */
	err = bt_testlib_att_exchange_mtu(host_conn);
	TEST_ASSERT(err == 0, "Failed to exchange the MTU: %d", err);
}

static void discover(void)
{
	int err;

	UNSET_FLAG(flag_discovered);
	UNSET_FLAG(flag_input_report);

	err = bt_hogp_host_discover(host_conn);
	TEST_ASSERT(err == 0, "Failed to start the discovery: %d", err);

	err = bt_hogp_host_discover(host_conn);
	TEST_ASSERT(err == -EALREADY, "Started the discovery twice: %d", err);

	WAIT_FOR_FLAG(flag_discovered);
	TEST_ASSERT(discovered_err == 0, "The discovery failed: %d", discovered_err);
	TEST_ASSERT(bt_conn_get_security(host_conn) >= BT_SECURITY_L2,
		    "Discovered without an encrypted link");
}

static void wait_for_input_report(void)
{
	WAIT_FOR_FLAG(flag_input_report);
	UNSET_FLAG(flag_input_report);

	TEST_ASSERT(input_id == TEST_REPORT_ID_INPUT, "Input Report ID %u", input_id);
	TEST_ASSERT(input_len == TEST_INPUT_REPORT_LEN &&
			    memcmp(input_data, test_input_data, input_len) == 0,
		    "Input Report with the wrong payload");
}

static void verify_report_info(const struct bt_hogp_host_report_info *info,
			       enum bt_hids_report_type type, uint8_t id, uint8_t properties)
{
	TEST_ASSERT(info->type == type && info->id == id,
		    "Report of type %u ID %u, expected type %u ID %u", info->type, info->id, type,
		    id);
	TEST_ASSERT((info->properties & properties) == properties,
		    "Report ID %u has properties 0x%02x", id, info->properties);
}

static void verify_discovery(void)
{
	struct bt_hogp_host_report_info reports[TEST_REPORT_COUNT + 1U];
	uint8_t map[sizeof(test_report_map)];
	struct bt_hogp_host_hid_info info;
	uint16_t len;
	uint8_t count;
	int err;

	err = bt_hogp_host_service_count_get(host_conn, &count);
	TEST_ASSERT(err == 0 && count == 1U, "Got %u HID Services: %d", count, err);

	err = bt_hogp_host_hid_info_get(host_conn, 0U, &info);
	TEST_ASSERT(err == 0, "Failed to get the HID Information: %d", err);
	TEST_ASSERT(info.bcd_hid == TEST_BCD_HID && info.country_code == TEST_COUNTRY_CODE &&
			    info.flags == TEST_HID_FLAGS,
		    "Wrong HID Information");

	len = sizeof(map);
	err = bt_hogp_host_report_map_get(host_conn, 0U, map, &len);
	TEST_ASSERT(err == 0, "Failed to get the Report Map: %d", err);
	TEST_ASSERT(len == sizeof(test_report_map) && memcmp(map, test_report_map, len) == 0,
		    "Wrong Report Map");

	/* A buffer that is too small is left untouched */
	(void)memset(map, 0xff, sizeof(map));
	len = sizeof(map) - 1U;
	err = bt_hogp_host_report_map_get(host_conn, 0U, map, &len);
	TEST_ASSERT(err == -ENOMEM, "Got the Report Map into a small buffer: %d", err);
	TEST_ASSERT(len == sizeof(test_report_map), "Needs %u octets for the Report Map", len);
	TEST_ASSERT(map[0] == 0xffU, "Wrote to the small Report Map buffer");

	count = ARRAY_SIZE(reports);
	err = bt_hogp_host_reports_get(host_conn, 0U, reports, &count);
	TEST_ASSERT(err == 0 && count == TEST_REPORT_COUNT, "Got %u Reports: %d", count, err);

	/* The HID Service declares them in this order */
	verify_report_info(&reports[0], BT_HIDS_REPORT_TYPE_INPUT, TEST_REPORT_ID_INPUT,
			   BT_GATT_CHRC_READ | BT_GATT_CHRC_NOTIFY);
	verify_report_info(&reports[1], BT_HIDS_REPORT_TYPE_OUTPUT, TEST_REPORT_ID_OUTPUT,
			   BT_GATT_CHRC_READ | BT_GATT_CHRC_WRITE);
	verify_report_info(&reports[2], BT_HIDS_REPORT_TYPE_FEATURE, TEST_REPORT_ID_FEATURE,
			   BT_GATT_CHRC_READ | BT_GATT_CHRC_WRITE);
	verify_report_info(&reports[3], BT_HIDS_REPORT_TYPE_FEATURE, TEST_REPORT_ID_FEATURE_LONG,
			   BT_GATT_CHRC_READ | BT_GATT_CHRC_WRITE);

	(void)memset(reports, 0xff, sizeof(reports));
	count = TEST_REPORT_COUNT - 1U;
	err = bt_hogp_host_reports_get(host_conn, 0U, reports, &count);
	TEST_ASSERT(err == -ENOMEM, "Got the Reports into a small array: %d", err);
	TEST_ASSERT(count == TEST_REPORT_COUNT, "Needs %u entries for the Reports", count);
	TEST_ASSERT(reports[0].id == 0xffU, "Wrote to the small Report array");
}

static void test_getter_validation(void)
{
	struct bt_hogp_host_report_info reports[TEST_REPORT_COUNT];
	struct bt_hogp_host_hid_info info;
	uint8_t map[sizeof(test_report_map)];
	uint16_t len = sizeof(map);
	uint8_t count = ARRAY_SIZE(reports);
	int err;

	err = bt_hogp_host_service_count_get(NULL, &count);
	TEST_ASSERT(err == -EINVAL, "Got the service count of no connection: %d", err);

	err = bt_hogp_host_service_count_get(host_conn, NULL);
	TEST_ASSERT(err == -EINVAL, "Got the service count into NULL: %d", err);

	err = bt_hogp_host_hid_info_get(NULL, 0U, &info);
	TEST_ASSERT(err == -EINVAL, "Got the HID Information of no connection: %d", err);

	err = bt_hogp_host_hid_info_get(host_conn, 0U, NULL);
	TEST_ASSERT(err == -EINVAL, "Got the HID Information into NULL: %d", err);

	err = bt_hogp_host_hid_info_get(host_conn, 1U, &info);
	TEST_ASSERT(err == -EINVAL, "Got the HID Information of service 1: %d", err);

	err = bt_hogp_host_report_map_get(NULL, 0U, map, &len);
	TEST_ASSERT(err == -EINVAL, "Got the Report Map of no connection: %d", err);

	err = bt_hogp_host_report_map_get(host_conn, 0U, map, NULL);
	TEST_ASSERT(err == -EINVAL, "Got the Report Map without a length: %d", err);

	err = bt_hogp_host_report_map_get(host_conn, 0U, NULL, &len);
	TEST_ASSERT(err == -EINVAL, "Got the Report Map into NULL: %d", err);

	err = bt_hogp_host_report_map_get(host_conn, 1U, map, &len);
	TEST_ASSERT(err == -EINVAL, "Got the Report Map of service 1: %d", err);

	err = bt_hogp_host_reports_get(NULL, 0U, reports, &count);
	TEST_ASSERT(err == -EINVAL, "Got the Reports of no connection: %d", err);

	err = bt_hogp_host_reports_get(host_conn, 0U, NULL, &count);
	TEST_ASSERT(err == -EINVAL, "Got the Reports into NULL: %d", err);

	err = bt_hogp_host_reports_get(host_conn, 0U, reports, NULL);
	TEST_ASSERT(err == -EINVAL, "Got the Reports without a count: %d", err);

	err = bt_hogp_host_reports_get(host_conn, 1U, reports, &count);
	TEST_ASSERT(err == -EINVAL, "Got the Reports of service 1: %d", err);
}

/* Before the discovery, and after the connection is gone */
static void verify_no_state(struct bt_conn *conn)
{
	struct bt_hogp_host_hid_info info;
	uint8_t count;
	int err;

	err = bt_hogp_host_service_count_get(conn, &count);
	TEST_ASSERT(err == -ENOENT, "Got the service count without a discovery: %d", err);

	err = bt_hogp_host_hid_info_get(conn, 0U, &info);
	TEST_ASSERT(err == -ENOENT, "Got the HID Information without a discovery: %d", err);

	err = bt_hogp_host_report_read(conn, 0U, BT_HIDS_REPORT_TYPE_FEATURE,
				       TEST_REPORT_ID_FEATURE);
	TEST_ASSERT(err == -ENOENT, "Read a Report without a discovery: %d", err);
}

static void read_report(enum bt_hids_report_type type, uint8_t id)
{
	int err;

	UNSET_FLAG(flag_report_read);

	err = bt_hogp_host_report_read(host_conn, 0U, type, id);
	TEST_ASSERT(err == 0, "Failed to start reading Report ID %u: %d", id, err);

	WAIT_FOR_FLAG(flag_report_read);
	TEST_ASSERT(read_type == type && read_id == id, "Read type %u ID %u", read_type, read_id);
	TEST_ASSERT(read_err == 0, "Failed to read Report ID %u: %d", id, read_err);
}

static void write_report(enum bt_hids_report_type type, uint8_t id, const uint8_t *data,
			 uint16_t len)
{
	int err;

	UNSET_FLAG(flag_report_written);

	err = bt_hogp_host_report_write(host_conn, 0U, type, id, data, len);
	TEST_ASSERT(err == 0, "Failed to start writing Report ID %u: %d", id, err);

	WAIT_FOR_FLAG(flag_report_written);
	TEST_ASSERT(written_type == type && written_id == id, "Wrote type %u ID %u", written_type,
		    written_id);
	TEST_ASSERT(written_err == 0, "Failed to write Report ID %u: %d", id, written_err);
}

static void test_reports(void)
{
	uint8_t long_value[TEST_LONG_REPORT_LEN];

	read_report(BT_HIDS_REPORT_TYPE_FEATURE, TEST_REPORT_ID_FEATURE);
	TEST_ASSERT(read_len == sizeof(test_feature_data) &&
			    memcmp(read_data, test_feature_data, read_len) == 0,
		    "Wrong Feature Report");

	/* Longer than ATT_MTU - 1, so read with several ATT requests */
	read_report(BT_HIDS_REPORT_TYPE_FEATURE, TEST_REPORT_ID_FEATURE_LONG);
	(void)memset(long_value, TEST_LONG_REPORT_FILL, sizeof(long_value));
	TEST_ASSERT(read_len == sizeof(long_value) && memcmp(read_data, long_value, read_len) == 0,
		    "Wrong long Feature Report, %u octets", read_len);

	write_report(BT_HIDS_REPORT_TYPE_OUTPUT, TEST_REPORT_ID_OUTPUT, test_output_data,
		     sizeof(test_output_data));
	write_report(BT_HIDS_REPORT_TYPE_FEATURE, TEST_REPORT_ID_FEATURE, test_feature_data_new,
		     sizeof(test_feature_data_new));

	/* A read after SET_REPORT returns what was written */
	read_report(BT_HIDS_REPORT_TYPE_FEATURE, TEST_REPORT_ID_FEATURE);
	TEST_ASSERT(read_len == sizeof(test_feature_data_new) &&
			    memcmp(read_data, test_feature_data_new, read_len) == 0,
		    "The Feature Report was not written");
}

static void test_report_validation(void)
{
	/* One octet more than an attribute value holds */
	static const uint8_t too_long[513];
	int err;

	err = bt_hogp_host_report_read(NULL, 0U, BT_HIDS_REPORT_TYPE_FEATURE,
				       TEST_REPORT_ID_FEATURE);
	TEST_ASSERT(err == -EINVAL, "Read a Report of no connection: %d", err);

	err = bt_hogp_host_report_read(host_conn, 1U, BT_HIDS_REPORT_TYPE_FEATURE,
				       TEST_REPORT_ID_FEATURE);
	TEST_ASSERT(err == -EINVAL, "Read a Report of service 1: %d", err);

	/* The Report ID exists, but with another Report Type */
	err = bt_hogp_host_report_read(host_conn, 0U, BT_HIDS_REPORT_TYPE_OUTPUT,
				       TEST_REPORT_ID_INPUT);
	TEST_ASSERT(err == -ENOENT, "Read a Report that does not exist: %d", err);

	err = bt_hogp_host_report_write(host_conn, 0U, BT_HIDS_REPORT_TYPE_OUTPUT,
					TEST_REPORT_ID_OUTPUT, NULL, 1U);
	TEST_ASSERT(err == -EINVAL, "Wrote a Report without a payload: %d", err);

	err = bt_hogp_host_report_write(host_conn, 0U, BT_HIDS_REPORT_TYPE_OUTPUT,
					TEST_REPORT_ID_OUTPUT, test_output_data, 0U);
	TEST_ASSERT(err == -EINVAL, "Wrote an empty Report: %d", err);

	err = bt_hogp_host_report_write(NULL, 0U, BT_HIDS_REPORT_TYPE_OUTPUT, TEST_REPORT_ID_OUTPUT,
					test_output_data, sizeof(test_output_data));
	TEST_ASSERT(err == -EINVAL, "Wrote a Report of no connection: %d", err);

	err = bt_hogp_host_report_write(host_conn, 0U, BT_HIDS_REPORT_TYPE_FEATURE,
					TEST_REPORT_ID_FEATURE_LONG, too_long, sizeof(too_long));
	TEST_ASSERT(err == -EINVAL, "Wrote more than an attribute holds: %d", err);

	/* The Input Report of the HID Service is not writable */
	err = bt_hogp_host_report_write(host_conn, 0U, BT_HIDS_REPORT_TYPE_INPUT,
					TEST_REPORT_ID_INPUT, test_input_data,
					sizeof(test_input_data));
	TEST_ASSERT(err == -ENOTSUP, "Wrote the Input Report: %d", err);

	/* One read or write at a time */
	UNSET_FLAG(flag_report_read);
	err = bt_hogp_host_report_read(host_conn, 0U, BT_HIDS_REPORT_TYPE_FEATURE,
				       TEST_REPORT_ID_FEATURE);
	TEST_ASSERT(err == 0, "Failed to start reading the Feature Report: %d", err);

	err = bt_hogp_host_report_read(host_conn, 0U, BT_HIDS_REPORT_TYPE_FEATURE,
				       TEST_REPORT_ID_FEATURE);
	TEST_ASSERT(err == -EBUSY, "Started a second read: %d", err);

	err = bt_hogp_host_report_write(host_conn, 0U, BT_HIDS_REPORT_TYPE_OUTPUT,
					TEST_REPORT_ID_OUTPUT, test_output_data,
					sizeof(test_output_data));
	TEST_ASSERT(err == -EBUSY, "Started a write during a read: %d", err);

	WAIT_FOR_FLAG(flag_report_read);
	TEST_ASSERT(read_err == 0, "Failed to read the Feature Report: %d", read_err);
}

/* The Device makes the long Feature Report one octet longer than
 * CONFIG_BT_HOGP_HOST_MAX_REPORT_LEN, so reading it fails.
 */
static void test_report_too_long(void)
{
	int err;

	UNSET_FLAG(flag_report_read);
	err = bt_hogp_host_report_read(host_conn, 0U, BT_HIDS_REPORT_TYPE_FEATURE,
				       TEST_REPORT_ID_FEATURE_LONG);
	TEST_ASSERT(err == 0, "Failed to start reading the long Feature Report: %d", err);

	WAIT_FOR_FLAG(flag_report_read);
	TEST_ASSERT(read_err == -ENOMEM, "Read a Report longer than the buffer: %d", read_err);
	TEST_ASSERT(read_len == 0U, "Got %u octets of a failed read", read_len);
}

static void test_hogp_host(void)
{
	struct bt_conn *old_conn;
	int err;

	err = bt_enable(NULL);
	TEST_ASSERT(err == 0, "Bluetooth init failed: %d", err);

	err = settings_load();
	TEST_ASSERT(err == 0, "Failed to load the settings: %d", err);

	TEST_ASSERT(bk_sync_init() == 0, "Failed to open the sync channel");

	err = bt_hogp_host_cb_register(NULL);
	TEST_ASSERT(err == -EINVAL, "Registered no callbacks: %d", err);

	err = bt_hogp_host_cb_register(&hogp_cb);
	TEST_ASSERT(err == 0, "Failed to register the callbacks: %d", err);

	err = bt_hogp_host_cb_register(&hogp_cb);
	TEST_ASSERT(err == -EALREADY, "Registered the callbacks twice: %d", err);

	err = bt_hogp_host_discover(NULL);
	TEST_ASSERT(err == -EINVAL, "Discovered no connection: %d", err);

	connect_device(true);
	verify_no_state(host_conn);

	discover();
	verify_discovery();
	test_getter_validation();

	/* The Device notifies the Input Report once we are subscribed */
	bk_sync_send();
	wait_for_input_report();

	test_report_validation();
	test_reports();

	/* The Device has checked both SET_REPORTs and lengthened the long
	 * Feature Report.
	 */
	bk_sync_wait();

	test_report_too_long();

	/* The state of a connection is dropped when it disconnects */
	old_conn = bt_conn_ref(host_conn);
	err = bt_testlib_disconnect(&host_conn, BT_HCI_ERR_REMOTE_USER_TERM_CONN);
	TEST_ASSERT(err == 0, "Failed to disconnect: %d", err);
	verify_no_state(old_conn);

	err = bt_hogp_host_discover(old_conn);
	TEST_ASSERT(err == -ENOTCONN, "Discovered a disconnected Device: %d", err);
	bt_conn_unref(old_conn);

	/* The Device is bonded now; the subscription is set up again. Keeping
	 * the default ATT_MTU makes the Report Map take several ATT reads.
	 */
	connect_device(false);
	discover();
	verify_discovery();

	bk_sync_send();
	wait_for_input_report();

	err = bt_testlib_disconnect(&host_conn, BT_HCI_ERR_REMOTE_USER_TERM_CONN);
	TEST_ASSERT(err == 0, "Failed to disconnect: %d", err);

	TEST_PASS("HOGP Host test passed");
}

static const struct bst_test_instance test_hogp_host_defs[] = {
	{
		.test_id = "hogp_host",
		.test_descr = "HOGP Report Host",
		.test_main_f = test_hogp_host,
	},
	BSTEST_END_MARKER,
};

struct bst_test_list *test_hogp_host_install(struct bst_test_list *tests)
{
	return bst_add_tests(tests, test_hogp_host_defs);
}
```
