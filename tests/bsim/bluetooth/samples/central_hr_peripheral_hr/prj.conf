## CMakeLists.txt
```
# SPDX-License-Identifier: Apache-2.0

cmake_minimum_required(VERSION 3.28.0)

find_package(Zephyr REQUIRED HINTS $ENV{ZEPHYR_BASE})
project(central_hr_peripheral_hr_test)

set(central_hr_path ${ZEPHYR_BASE}/samples/bluetooth/central_hr)

target_sources(app PRIVATE
  ${central_hr_path}/src/main.c
)

target_sources(app PRIVATE
  src/sample_test.c
  src/test_main.c
)

zephyr_library_include_directories(${ZEPHYR_BASE}/samples/bluetooth)

zephyr_include_directories(
  ${BSIM_COMPONENTS_PATH}/libUtilv1/src/
  ${BSIM_COMPONENTS_PATH}/libPhyComv1/src/
  )
```

## Kconfig
```
# Copyright (c) 2023 Nordic Semiconductor ASA
# SPDX-License-Identifier: Apache-2.0

# source sample's Kconfig, if any
#   source "$(ZEPHYR_BASE)/samples/bluetooth/central_hr/Kconfig"
# OR
# source Zephyr Kernel's Kconfig, as below (not both)
menu "Zephyr Kernel"
source "Kconfig.zephyr"
endmenu
```

## Kconfig.sysbuild
```
# Copyright (c) 2023-2024 Nordic Semiconductor ASA
# SPDX-License-Identifier: Apache-2.0

# source the samples' Kconfig.sysbuild, if any
source "$(ZEPHYR_BASE)/samples/bluetooth/central_hr/Kconfig.sysbuild"

config NATIVE_SIMULATOR_PRIMARY_MCU_INDEX
	int
	# Let's pass the test arguments to the application MCU test
	# otherwise by default they would have gone to the net core.
	default 0 if $(BOARD_TARGET_STRING)="NRF5340BSIM_NRF5340_CPUAPP"
```

## prj.conf
```kconfig
# Please build using the sample configuration file:
# ${ZEPHYR_BASE}/samples/bluetooth/central_hr/prj.conf
```

## prj_extended.conf
```kconfig
# From prj.conf
CONFIG_BT=y
CONFIG_LOG=y
CONFIG_BT_CENTRAL=y
CONFIG_BT_SMP=y
CONFIG_BT_GATT_CLIENT=y

# Extra for prj_extended.conf
CONFIG_BT_EXT_ADV=y
```

## boards/nrf5340bsim_nrf5340_cpuapp.conf
```kconfig
CONFIG_BT_BUF_ACL_RX_SIZE=255

CONFIG_BT_SMP_SC_PAIR_ONLY=n
```

## src/sample_test.c
```c
/*
 * Copyright (c) 2023-2024 Nordic Semiconductor ASA
 * Copyright (c) 2017-2019 Oticon A/S
 *
 * SPDX-License-Identifier: Apache-2.0
 */

#include <bs_types.h>
#include <bs_tracing.h>
#include <bs_utils.h>
#include <time_machine.h>
#include <bstests.h>

#define WAIT_TIME 10 /* Seconds */

#define PASS_THRESHOLD 5 /* packets */

extern enum bst_result_t bst_result;

#define FAIL(...)					\
	do {						\
		bst_result = Failed;			\
		bs_trace_error_time_line(__VA_ARGS__);	\
	} while (0)

#define PASS(...)					\
	do {						\
		bst_result = Passed;			\
		bs_trace_info_time(1, __VA_ARGS__);	\
	} while (0)

static void test_sample_init(void)
{
	/* We set an absolute deadline in 30 seconds */
	bst_ticker_set_next_tick_absolute(WAIT_TIME*1e6);
	bst_result = In_progress;
}

static void test_sample_tick(bs_time_t HW_device_time)
{
	/*
	 * If in WAIT_TIME seconds we did not get enough packets through
	 * we consider the test failed
	 */

	extern uint64_t total_rx_count;

	bs_trace_info_time(2, "%"PRIu64" packets received, expected >= %i\n",
			   total_rx_count, PASS_THRESHOLD);

	if (total_rx_count >= PASS_THRESHOLD) {
		PASS("PASSED\n");
		bs_trace_exit("Done, disconnecting from simulation\n");
	} else {
		FAIL("FAILED (Did not pass after %i seconds)\n", WAIT_TIME);
	}
}

static const struct bst_test_instance test_sample[] = {
	{
		.test_id = "central_hr_peripheral_hr",
		.test_descr = "Test based on the peripheral and central HR samples. "
			      "It expects to be connected to a compatible sample, "
			      "waits for " STR(WAIT_TIME) " seconds, and checks how "
			      "many packets have been received correctly",
		.test_pre_init_f = test_sample_init,
		.test_tick_f = test_sample_tick,
	},
	BSTEST_END_MARKER
};

struct bst_test_list *test_sample_install(struct bst_test_list *tests)
{
	tests = bst_add_tests(tests, test_sample);
	return tests;
}
```

## src/test_main.c
```c
/*
 * Copyright (c) 2023-2024 Nordic Semiconductor ASA
 *
 * SPDX-License-Identifier: Apache-2.0
 */

#include <bstests.h>

extern struct bst_test_list *test_sample_install(struct bst_test_list *tests);

bst_test_install_t test_installers[] = {
	test_sample_install,
	NULL
};
```
