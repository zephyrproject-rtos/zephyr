## CMakeLists.txt
```
# SPDX-License-Identifier: Apache-2.0

cmake_minimum_required(VERSION 3.28.0)
find_package(Zephyr REQUIRED HINTS $ENV{ZEPHYR_BASE})
project(bsim_test_hids)

add_subdirectory(${ZEPHYR_BASE}/tests/bsim/babblekit babblekit)
target_link_libraries(app PRIVATE babblekit)

add_subdirectory(${ZEPHYR_BASE}/tests/bluetooth/common/testlib testlib)
target_link_libraries(app PRIVATE testlib)

file(GLOB app_sources src/*.c)
target_sources(app PRIVATE ${app_sources})

zephyr_include_directories(
  ${BSIM_COMPONENTS_PATH}/libUtilv1/src/
  ${BSIM_COMPONENTS_PATH}/libPhyComv1/src/
)
```

## Kconfig
```
# Kconfig options of the HID Service test
#
# Copyright (c) 2026 Xiaomi Corporation
# SPDX-License-Identifier: Apache-2.0

menu "Test configuration"

config TEST_HIDS_SECURITY_REQUEST
	bool "The HID Device requests security when a Host connects"
	default y
	help
	  Use the Peripheral Security Request procedure to inform the HID Host
	  of the security requirements of the HID Device, as recommended by
	  the HID over GATT Profile. The client side of the test never initiates
	  pairing, so building the test with this disabled has to make it fail.

endmenu

source "Kconfig.zephyr"
```

## prj.conf
```kconfig
CONFIG_BT=y
CONFIG_BT_DEVICE_NAME="HIDS tester"
CONFIG_BT_PERIPHERAL=y
CONFIG_BT_CENTRAL=y
CONFIG_BT_GATT_CLIENT=y
CONFIG_BT_SMP=y
CONFIG_BT_GATT_DYNAMIC_DB=y

CONFIG_BT_HIDS=y
CONFIG_BT_HIDS_INPUT_REPORT_COUNT=1
CONFIG_BT_HIDS_OUTPUT_REPORT_COUNT=1
CONFIG_BT_HIDS_FEATURE_REPORT_COUNT=2
# Holds the long Feature Report the Read Long tests use
CONFIG_BT_HIDS_MAX_REPORT_LEN=256

# HOGP Host, connected to two HID Devices at once
CONFIG_BT_HOGP_HOST=y
# Exactly the long Feature Report, which takes a Read Long
CONFIG_BT_HOGP_HOST_MAX_REPORT_LEN=200
CONFIG_BT_MAX_CONN=2

CONFIG_BT_MAX_PAIRED=2

# The Report Map is read in a single ATT read
CONFIG_BT_L2CAP_TX_MTU=140
CONFIG_BT_BUF_ACL_TX_SIZE=144
CONFIG_BT_BUF_ACL_RX_SIZE=144

CONFIG_BT_SETTINGS=y
CONFIG_FLASH=y
CONFIG_FLASH_MAP=y
CONFIG_NVS=y
CONFIG_SETTINGS=y

CONFIG_ASSERT=y
CONFIG_LOG=y
```

## src/main.c
```c
/*
 * Copyright (c) 2026 Xiaomi Corporation
 *
 * SPDX-License-Identifier: Apache-2.0
 */

#include "bstests.h"

extern struct bst_test_list *test_hids_server_install(struct bst_test_list *tests);
extern struct bst_test_list *test_hids_client_install(struct bst_test_list *tests);
extern struct bst_test_list *test_hogp_device_install(struct bst_test_list *tests);
extern struct bst_test_list *test_hogp_host_install(struct bst_test_list *tests);

bst_test_install_t test_installers[] = {
	test_hids_server_install,
	test_hids_client_install,
	test_hogp_device_install,
	test_hogp_host_install,
	NULL,
};

int main(void)
{
	bst_main();

	return 0;
}
```

## src/common.h
```c
/*
 * Copyright (c) 2026 Xiaomi Corporation
 *
 * SPDX-License-Identifier: Apache-2.0
 */

#ifndef HIDS_TEST_COMMON_H_
#define HIDS_TEST_COMMON_H_

#include <zephyr/bluetooth/services/hids.h>
#include <zephyr/types.h>
#include <zephyr/usb/class/hid.h>

/* One Report of each type, as configured by
 * CONFIG_BT_HIDS_{INPUT,OUTPUT,FEATURE}_REPORT_COUNT.
 */
#define TEST_REPORT_ID_INPUT        0x01U
#define TEST_REPORT_ID_OUTPUT       0x02U
#define TEST_REPORT_ID_FEATURE      0x03U
/* A second Feature Report, long enough to need several ATT Read Blob Requests */
#define TEST_REPORT_ID_FEATURE_LONG 0x04U

/* Mouse (Input), keyboard LEDs (Output) and a vendor defined byte (Feature).
 * The Report Map has to describe every Report the HID Service exposes.
 */
/* The indentation mirrors the HID collection nesting. */
/* clang-format off */
/* Longer than one ATT PDU at the MTU this test negotiates, so a Host has to
 * use the Read Long Characteristic Value sub-procedure to read it.
 */
#define TEST_LONG_REPORT_LEN 200U

static const uint8_t test_report_map[] = {
	HID_USAGE_PAGE(HID_USAGE_GEN_DESKTOP),
	HID_USAGE(HID_USAGE_GEN_DESKTOP_MOUSE),
	HID_COLLECTION(HID_COLLECTION_APPLICATION),
		HID_REPORT_ID(TEST_REPORT_ID_INPUT),
		HID_USAGE(HID_USAGE_GEN_DESKTOP_POINTER),
		HID_COLLECTION(HID_COLLECTION_PHYSICAL),
			HID_USAGE_PAGE(HID_USAGE_GEN_BUTTON),
			HID_USAGE_MIN8(1),
			HID_USAGE_MAX8(3),
			HID_LOGICAL_MIN8(0),
			HID_LOGICAL_MAX8(1),
			HID_REPORT_SIZE(1),
			HID_REPORT_COUNT(3),
			HID_INPUT(0x02),
			HID_REPORT_SIZE(5),
			HID_REPORT_COUNT(1),
			HID_INPUT(0x03),
			HID_USAGE_PAGE(HID_USAGE_GEN_DESKTOP),
			HID_USAGE(HID_USAGE_GEN_DESKTOP_X),
			HID_USAGE(HID_USAGE_GEN_DESKTOP_Y),
			HID_LOGICAL_MIN8(-127),
			HID_LOGICAL_MAX8(127),
			HID_REPORT_SIZE(8),
			HID_REPORT_COUNT(2),
			HID_INPUT(0x06),
		HID_END_COLLECTION,
	HID_END_COLLECTION,

	HID_USAGE_PAGE(HID_USAGE_GEN_DESKTOP),
	HID_USAGE(HID_USAGE_GEN_DESKTOP_KEYBOARD),
	HID_COLLECTION(HID_COLLECTION_APPLICATION),
		HID_REPORT_ID(TEST_REPORT_ID_OUTPUT),
		HID_USAGE_PAGE(HID_USAGE_GEN_LEDS),
		HID_USAGE_MIN8(1),
		HID_USAGE_MAX8(5),
		HID_LOGICAL_MIN8(0),
		HID_LOGICAL_MAX8(1),
		HID_REPORT_SIZE(1),
		HID_REPORT_COUNT(5),
		HID_OUTPUT(0x02),
		HID_REPORT_SIZE(3),
		HID_REPORT_COUNT(1),
		HID_OUTPUT(0x03),
		HID_REPORT_ID(TEST_REPORT_ID_FEATURE),
		HID_USAGE_PAGE16(0xFF00),
		HID_USAGE(0x01),
		HID_LOGICAL_MIN8(0),
		HID_LOGICAL_MAX16(0xFF, 0x00),
		HID_REPORT_SIZE(8),
		HID_REPORT_COUNT(1),
		HID_FEATURE(0x02),
		HID_REPORT_ID(TEST_REPORT_ID_FEATURE_LONG),
		HID_USAGE_PAGE16(0xFF00),
		HID_USAGE(0x02),
		HID_LOGICAL_MIN8(0),
		HID_LOGICAL_MAX16(0xFF, 0x00),
		HID_REPORT_SIZE(8),
		HID_REPORT_COUNT(TEST_LONG_REPORT_LEN),
		HID_FEATURE(0x02),
	HID_END_COLLECTION,
};
/* clang-format on */

/* HID Information the server registers and the client verifies */
#define TEST_BCD_HID      0x0111U
#define TEST_COUNTRY_CODE 0x00U
#define TEST_HID_FLAGS    BT_HIDS_INFO_FLAG_NORMALLY_CONNECTABLE

/* Input Report payload: buttons (1) + X (1) + Y (1) */
#define TEST_INPUT_REPORT_LEN 3U
static const uint8_t test_input_data[TEST_INPUT_REPORT_LEN] = {0x01, 0x10, 0x20};

/* Output Report payload: the LED bitmap */
#define TEST_OUTPUT_REPORT_LEN 1U
static const uint8_t test_output_data[TEST_OUTPUT_REPORT_LEN] = {0x05};

/* Feature Report payload: the vendor defined byte */
#define TEST_FEATURE_REPORT_LEN 1U
static const uint8_t test_feature_data[TEST_FEATURE_REPORT_LEN] = {0x5A};

/* Feature Report payload the HOGP Host writes */
static const uint8_t test_feature_data_new[TEST_FEATURE_REPORT_LEN] = {0xA5};

/* Every octet of the long Feature Report */
#define TEST_LONG_REPORT_FILL 0x42U

/* Report characteristics of the HID Service, in handle order */
#define TEST_REPORT_COUNT 4U

/* The second HID Device of the HOGP Host test, which notifies and holds other values */
#define TEST_DEVICE_2_NAME "HOGP device 2"
static const uint8_t test_input_data_2[TEST_INPUT_REPORT_LEN] = {0x02, 0x30, 0x40};
static const uint8_t test_feature_data_2[TEST_FEATURE_REPORT_LEN] = {0x3C};

/* The HID Device of the HOGP Host test that registers malformed HID Services, one per
 * connection, in this order
 */
#define TEST_MALFORMED_NAME         "HOGP malformed"
#define TEST_MALFORMED_EMPTY        0U
#define TEST_MALFORMED_REPORT_LAST  1U
#define TEST_MALFORMED_DUPLICATE    2U
#define TEST_MALFORMED_DUPLICATE_ID 3U
#define TEST_MALFORMED_CCC_REFUSED  4U
#define TEST_MALFORMED_COUNT        5U

#endif /* HIDS_TEST_COMMON_H_ */
```

## src/hogp_device_test.c
```c
/*
 * Copyright (c) 2026 Xiaomi Corporation
 *
 * SPDX-License-Identifier: Apache-2.0
 */

/* HID Devices for the HOGP Host test:
 * - hogp_device: the HID Service, registered the way a HOGP HID Device application registers it,
 *   with a Security Request on every connection.
 * - hogp_device_2: a second HID Device the Report Host is connected to at the same time, which
 *   notifies its Input Report and holds a Feature Report of its own.
 * - hogp_malformed_device: HID Services a Report Host has to reject, registered one after the
 *   other as plain GATT services, without security requirements.
 *
 * The sync channel only links devices 0 and 1, so the other two are driven through their
 * connections.
 */

#include <errno.h>
#include <stdbool.h>
#include <stddef.h>
#include <string.h>

#include <zephyr/bluetooth/att.h>
#include <zephyr/bluetooth/bluetooth.h>
#include <zephyr/bluetooth/conn.h>
#include <zephyr/bluetooth/gatt.h>
#include <zephyr/bluetooth/services/hids.h>
#include <zephyr/bluetooth/uuid.h>
#include <zephyr/kernel.h>
#include <zephyr/settings/settings.h>
#include <zephyr/sys/atomic.h>
#include <zephyr/sys/util.h>

#include "babblekit/flags.h"
#include "babblekit/sync.h"
#include "babblekit/testcase.h"
#include "bstests.h"

#include "common.h"

DEFINE_FLAG_STATIC(flag_connected);
DEFINE_FLAG_STATIC(flag_disconnected);
DEFINE_FLAG_STATIC(flag_set_report);

static struct bt_conn *device_conn;

/* Whether the HID Device sends a Security Request when the Report Host connects */
static bool request_security;

static enum bt_hids_report_type set_report_type;
static uint8_t set_report_id;
static uint8_t set_report_data[CONFIG_BT_HIDS_MAX_REPORT_LEN];
static uint16_t set_report_len;

static void device_connected(struct bt_conn *conn, uint8_t err)
{
	TEST_ASSERT(err == 0U, "Failed to connect (err 0x%02x)", err);

	device_conn = bt_conn_ref(conn);
	SET_FLAG(flag_connected);

	if (request_security) {
		err = bt_conn_set_security(conn, BT_SECURITY_L2);
		TEST_ASSERT(err == 0, "Failed to request security: %d", err);
	}
}

static void device_disconnected(struct bt_conn *conn, uint8_t reason)
{
	ARG_UNUSED(reason);

	if (conn != device_conn) {
		return;
	}

	bt_conn_drop(&device_conn);
	SET_FLAG(flag_disconnected);
}

static struct bt_conn_cb device_conn_cb = {
	.connected = device_connected,
	.disconnected = device_disconnected,
};

static void set_report(struct bt_conn *conn, enum bt_hids_report_type report_type,
		       uint8_t report_id, const uint8_t *data, uint16_t len)
{
	ARG_UNUSED(conn);

	TEST_ASSERT(len <= sizeof(set_report_data), "SET_REPORT of %u bytes", len);

	set_report_type = report_type;
	set_report_id = report_id;
	(void)memcpy(set_report_data, data, len);
	set_report_len = len;
	SET_FLAG(flag_set_report);
}

static const struct bt_hids_cb hids_cb = {
	.set_report = set_report,
};

static const struct bt_hids_register_param hids_param = {
	.bcd_hid = TEST_BCD_HID,
	.country_code = TEST_COUNTRY_CODE,
	.flags = TEST_HID_FLAGS,
	.report_map = test_report_map,
	.report_map_len = sizeof(test_report_map),
	.input_report_ids = {TEST_REPORT_ID_INPUT},
	.output_report_ids = {TEST_REPORT_ID_OUTPUT},
	.feature_report_ids = {TEST_REPORT_ID_FEATURE, TEST_REPORT_ID_FEATURE_LONG},
	.cb = &hids_cb,
};

static const struct bt_data ad[] = {
	BT_DATA_BYTES(BT_DATA_FLAGS, (BT_LE_AD_GENERAL | BT_LE_AD_NO_BREDR)),
	BT_DATA_BYTES(BT_DATA_UUID16_ALL, BT_UUID_16_ENCODE(BT_UUID_HIDS_VAL)),
	BT_DATA(BT_DATA_NAME_COMPLETE, CONFIG_BT_DEVICE_NAME, sizeof(CONFIG_BT_DEVICE_NAME) - 1),
};

static const struct bt_data ad_2[] = {
	BT_DATA_BYTES(BT_DATA_FLAGS, (BT_LE_AD_GENERAL | BT_LE_AD_NO_BREDR)),
	BT_DATA_BYTES(BT_DATA_UUID16_ALL, BT_UUID_16_ENCODE(BT_UUID_HIDS_VAL)),
	BT_DATA(BT_DATA_NAME_COMPLETE, TEST_DEVICE_2_NAME, sizeof(TEST_DEVICE_2_NAME) - 1),
};

static const struct bt_data ad_malformed[] = {
	BT_DATA_BYTES(BT_DATA_FLAGS, (BT_LE_AD_GENERAL | BT_LE_AD_NO_BREDR)),
	BT_DATA_BYTES(BT_DATA_UUID16_ALL, BT_UUID_16_ENCODE(BT_UUID_HIDS_VAL)),
	BT_DATA(BT_DATA_NAME_COMPLETE, TEST_MALFORMED_NAME, sizeof(TEST_MALFORMED_NAME) - 1),
};

static void connect_host_ad(const struct bt_data *data, size_t len)
{
	int err;

	UNSET_FLAG(flag_connected);
	UNSET_FLAG(flag_disconnected);

	err = bt_le_adv_start(BT_LE_ADV_CONN_FAST_1, data, len, NULL, 0);
	TEST_ASSERT(err == 0, "Failed to start advertising: %d", err);

	WAIT_FOR_FLAG(flag_connected);
}

static void connect_host(void)
{
	connect_host_ad(ad, ARRAY_SIZE(ad));
}

static void send_input_report(void)
{
	int err;

	err = bt_hids_send_report(device_conn, TEST_REPORT_ID_INPUT, test_input_data,
				  TEST_INPUT_REPORT_LEN, NULL, NULL);
	TEST_ASSERT(err == 0, "Failed to notify the Input Report: %d", err);
}

static void verify_set_report(enum bt_hids_report_type type, uint8_t id, const uint8_t *data,
			      uint16_t len)
{
	WAIT_FOR_FLAG(flag_set_report);
	UNSET_FLAG(flag_set_report);

	TEST_ASSERT(set_report_type == type && set_report_id == id,
		    "SET_REPORT of type %u ID %u, expected type %u ID %u", set_report_type,
		    set_report_id, type, id);
	TEST_ASSERT(set_report_len == len && memcmp(set_report_data, data, len) == 0,
		    "SET_REPORT with the wrong payload");
}

static void set_long_report(uint16_t len)
{
	uint8_t value[TEST_LONG_REPORT_LEN + 1U];
	int err;

	(void)memset(value, TEST_LONG_REPORT_FILL, len);
	err = bt_hids_report_set(BT_HIDS_REPORT_TYPE_FEATURE, TEST_REPORT_ID_FEATURE_LONG, value,
				 len);
	TEST_ASSERT(err == 0, "Failed to set the long Feature Report: %d", err);
}

static void set_reports(void)
{
	int err;

	err = bt_hids_report_set(BT_HIDS_REPORT_TYPE_FEATURE, TEST_REPORT_ID_FEATURE,
				 test_feature_data, sizeof(test_feature_data));
	TEST_ASSERT(err == 0, "Failed to set the Feature Report: %d", err);

	set_long_report(TEST_LONG_REPORT_LEN);
}

static void hogp_device_init(void)
{
	int err;

	err = bt_enable(NULL);
	TEST_ASSERT(err == 0, "Bluetooth init failed: %d", err);

	err = settings_load();
	TEST_ASSERT(err == 0, "Failed to load the settings: %d", err);

	err = bt_conn_cb_register(&device_conn_cb);
	TEST_ASSERT(err == 0, "Failed to register the connection callbacks: %d", err);
}

static void test_hogp_device(void)
{
	int err;

	request_security = true;
	hogp_device_init();

	TEST_ASSERT(bk_sync_init() == 0, "Failed to open the sync channel");

	err = bt_hids_register(&hids_param);
	TEST_ASSERT(err == 0, "Failed to register the HID Service: %d", err);

	set_reports();
	connect_host();

	/* The Report Host has discovered the service and subscribed */
	bk_sync_wait();
	send_input_report();

	/* SET_REPORT on the Output Report, then on the Feature Report */
	verify_set_report(BT_HIDS_REPORT_TYPE_OUTPUT, TEST_REPORT_ID_OUTPUT, test_output_data,
			  sizeof(test_output_data));
	verify_set_report(BT_HIDS_REPORT_TYPE_FEATURE, TEST_REPORT_ID_FEATURE,
			  test_feature_data_new, sizeof(test_feature_data_new));

	/* One octet more than the Report Host reads */
	set_long_report(TEST_LONG_REPORT_LEN + 1U);
	bk_sync_send();

	/* The Report Host reconnects to the bonded HID Device and discovers it again */
	WAIT_FOR_FLAG(flag_disconnected);
	connect_host();

	bk_sync_wait();
	send_input_report();

	WAIT_FOR_FLAG(flag_disconnected);

	TEST_PASS("HOGP Device test passed");
}

/* The connection fails to be established when its first connection events collide with those of
 * the Report Host and the first HID Device, so this advertises again until the Report Host
 * subscribes to the Input Report, which the notification shows.
 */
static void test_hogp_device_2(void)
{
	int err;

	request_security = true;
	hogp_device_init();

	err = bt_hids_register(&hids_param);
	TEST_ASSERT(err == 0, "Failed to register the HID Service: %d", err);

	err = bt_hids_report_set(BT_HIDS_REPORT_TYPE_FEATURE, TEST_REPORT_ID_FEATURE,
				 test_feature_data_2, sizeof(test_feature_data_2));
	TEST_ASSERT(err == 0, "Failed to set the Feature Report: %d", err);

	connect_host_ad(ad_2, ARRAY_SIZE(ad_2));

	for (;;) {
		struct bt_conn *conn = device_conn;

		if (IS_FLAG_SET(flag_disconnected) || conn == NULL) {
			connect_host_ad(ad_2, ARRAY_SIZE(ad_2));
			continue;
		}

		/* device_disconnected() drops device_conn while this sends */
		conn = bt_conn_ref(conn);

		/* Fails until the Report Host has subscribed over an encrypted link */
		err = bt_hids_send_report(conn, TEST_REPORT_ID_INPUT, test_input_data_2,
					  sizeof(test_input_data_2), NULL, NULL);
		bt_conn_unref(conn);
		if (err == 0) {
			break;
		}

		k_sleep(K_MSEC(10));
	}

	/* The Report Host reads the Feature Report and disconnects */
	WAIT_FOR_FLAG(flag_disconnected);

	TEST_PASS("Second HOGP Device test passed");
}

/* Values of the malformed HID Services */
static const uint8_t malformed_hid_info[] = {0x11, 0x01, 0x00, 0x00};
static const uint8_t malformed_report_ref[] = {TEST_REPORT_ID_INPUT, BT_HIDS_REPORT_TYPE_INPUT};
static const uint8_t malformed_feature_ref[] = {TEST_REPORT_ID_FEATURE,
						BT_HIDS_REPORT_TYPE_FEATURE};

static const struct bt_data malformed_report_map = {
	.data_len = sizeof(test_report_map),
	.data = test_report_map,
};
static const struct bt_data malformed_info = {
	.data_len = sizeof(malformed_hid_info),
	.data = malformed_hid_info,
};
static const struct bt_data malformed_ref = {
	.data_len = sizeof(malformed_report_ref),
	.data = malformed_report_ref,
};
static const struct bt_data malformed_feature = {
	.data_len = sizeof(malformed_feature_ref),
	.data = malformed_feature_ref,
};
static const struct bt_data malformed_input = {
	.data_len = sizeof(test_input_data),
	.data = test_input_data,
};

static ssize_t malformed_read(struct bt_conn *conn, const struct bt_gatt_attr *attr, void *buf,
			      uint16_t len, uint16_t offset)
{
	const struct bt_data *value = attr->user_data;

	return bt_gatt_attr_read(conn, attr, buf, len, offset, value->data, value->data_len);
}

/* The first CCC write is refused, so the first discovery fails at the subscription */
static atomic_t ccc_refused;

static ssize_t malformed_ccc_write(struct bt_conn *conn, const struct bt_gatt_attr *attr,
				   uint16_t value)
{
	ARG_UNUSED(conn);
	ARG_UNUSED(attr);

	if (value != 0U && atomic_cas(&ccc_refused, 0, 1)) {
		return BT_GATT_ERR(BT_ATT_ERR_WRITE_NOT_PERMITTED);
	}

	return sizeof(value);
}

#define MALFORMED_REPORT_MAP                                                                       \
	BT_GATT_CHARACTERISTIC(BT_UUID_HIDS_REPORT_MAP, BT_GATT_CHRC_READ, BT_GATT_PERM_READ,      \
			       malformed_read, NULL, (void *)&malformed_report_map)

#define MALFORMED_HID_INFO                                                                         \
	BT_GATT_CHARACTERISTIC(BT_UUID_HIDS_INFO, BT_GATT_CHRC_READ, BT_GATT_PERM_READ,            \
			       malformed_read, NULL, (void *)&malformed_info)

/* A HID Service without characteristics */
static struct bt_gatt_attr empty_attrs[] = {
	BT_GATT_PRIMARY_SERVICE(BT_UUID_HIDS),
};

/* A Report characteristic without descriptors, which ends the service */
static struct bt_gatt_attr report_last_attrs[] = {
	BT_GATT_PRIMARY_SERVICE(BT_UUID_HIDS),
	MALFORMED_REPORT_MAP,
	MALFORMED_HID_INFO,
	BT_GATT_CHARACTERISTIC(BT_UUID_HIDS_REPORT, BT_GATT_CHRC_READ, BT_GATT_PERM_READ,
			       malformed_read, NULL, (void *)&malformed_input),
};

/* A second Report declaration that names the value handle of the first */
#define DUPLICATE_FIRST_VALUE 6U
static struct bt_gatt_chrc duplicate_chrc =
	BT_GATT_CHRC_INIT(BT_UUID_HIDS_REPORT, 0U, BT_GATT_CHRC_READ);
static struct bt_gatt_attr duplicate_attrs[] = {
	BT_GATT_PRIMARY_SERVICE(BT_UUID_HIDS),
	MALFORMED_REPORT_MAP,
	MALFORMED_HID_INFO,
	BT_GATT_CHARACTERISTIC(BT_UUID_HIDS_REPORT, BT_GATT_CHRC_READ, BT_GATT_PERM_READ,
			       malformed_read, NULL, (void *)&malformed_input),
	BT_GATT_DESCRIPTOR(BT_UUID_HIDS_REPORT_REF, BT_GATT_PERM_READ, malformed_read, NULL,
			   (void *)&malformed_ref),
	BT_GATT_ATTRIBUTE(BT_UUID_GATT_CHRC, BT_GATT_PERM_READ, bt_gatt_attr_read_chrc, NULL,
			  &duplicate_chrc),
	BT_GATT_ATTRIBUTE(BT_UUID_HIDS_REPORT, BT_GATT_PERM_READ, malformed_read, NULL,
			  (void *)&malformed_input),
};

/* Two Feature Reports with the same Report ID */
static struct bt_gatt_attr duplicate_id_attrs[] = {
	BT_GATT_PRIMARY_SERVICE(BT_UUID_HIDS),
	MALFORMED_REPORT_MAP,
	MALFORMED_HID_INFO,
	BT_GATT_CHARACTERISTIC(BT_UUID_HIDS_REPORT, BT_GATT_CHRC_READ, BT_GATT_PERM_READ,
			       malformed_read, NULL, (void *)&malformed_input),
	BT_GATT_DESCRIPTOR(BT_UUID_HIDS_REPORT_REF, BT_GATT_PERM_READ, malformed_read, NULL,
			   (void *)&malformed_feature),
	BT_GATT_CHARACTERISTIC(BT_UUID_HIDS_REPORT, BT_GATT_CHRC_READ, BT_GATT_PERM_READ,
			       malformed_read, NULL, (void *)&malformed_input),
	BT_GATT_DESCRIPTOR(BT_UUID_HIDS_REPORT_REF, BT_GATT_PERM_READ, malformed_read, NULL,
			   (void *)&malformed_feature),
};

/* Value of the Report characteristic in ccc_refused_attrs */
#define CCC_REFUSED_REPORT_VALUE 9U
static struct bt_gatt_attr ccc_refused_attrs[];

/* A characteristic the Report Host ignores, in front of the Input Report. It becomes a Feature
 * Report for one discovery, which moves the Input Report to the next index without changing its
 * handles.
 */
static const struct bt_uuid *const moved_uuid[] = {
	BT_UUID_HIDS_BOOT_MOUSE_IN_REPORT,
	BT_UUID_HIDS_REPORT,
};
static struct bt_gatt_chrc moved_chrc =
	BT_GATT_CHRC_INIT(BT_UUID_HIDS_BOOT_MOUSE_IN_REPORT, 0U, BT_GATT_CHRC_READ);
static atomic_t ccc_refused_map_reads;

/* Notifies while the Report Host reads the Report Map, so that the notification reaches it during
 * the discovery, over the subscription a failed discovery left. The GATT client of the Report Host
 * drops it while the link is not encrypted. The fourth discovery finds the Feature Report.
 */
static ssize_t ccc_refused_map_read(struct bt_conn *conn, const struct bt_gatt_attr *attr,
				    void *buf, uint16_t len, uint16_t offset)
{
	if (offset == 0U) {
		(void)bt_gatt_notify(conn, &ccc_refused_attrs[CCC_REFUSED_REPORT_VALUE],
				     test_input_data, sizeof(test_input_data));

		moved_chrc.uuid = moved_uuid[atomic_inc(&ccc_refused_map_reads) == 2 ? 1 : 0];
	}

	return malformed_read(conn, attr, buf, len, offset);
}

/* A valid HID Service, apart from the security it does not require, with a CCC that refuses the
 * first write
 */
static struct bt_gatt_attr ccc_refused_attrs[] = {
	BT_GATT_PRIMARY_SERVICE(BT_UUID_HIDS),
	BT_GATT_CHARACTERISTIC(BT_UUID_HIDS_REPORT_MAP, BT_GATT_CHRC_READ, BT_GATT_PERM_READ,
			       ccc_refused_map_read, NULL, (void *)&malformed_report_map),
	MALFORMED_HID_INFO,
	BT_GATT_ATTRIBUTE(BT_UUID_GATT_CHRC, BT_GATT_PERM_READ, bt_gatt_attr_read_chrc, NULL,
			  &moved_chrc),
	BT_GATT_ATTRIBUTE(BT_UUID_HIDS_REPORT, BT_GATT_PERM_READ, malformed_read, NULL,
			  (void *)&malformed_input),
	BT_GATT_DESCRIPTOR(BT_UUID_HIDS_REPORT_REF, BT_GATT_PERM_READ, malformed_read, NULL,
			   (void *)&malformed_feature),
	BT_GATT_CHARACTERISTIC(BT_UUID_HIDS_REPORT, BT_GATT_CHRC_READ | BT_GATT_CHRC_NOTIFY,
			       BT_GATT_PERM_READ, malformed_read, NULL, (void *)&malformed_input),
	BT_GATT_DESCRIPTOR(BT_UUID_HIDS_REPORT_REF, BT_GATT_PERM_READ, malformed_read, NULL,
			   (void *)&malformed_ref),
	BT_GATT_CCC_WITH_WRITE_CB(NULL, malformed_ccc_write,
				  BT_GATT_PERM_READ | BT_GATT_PERM_WRITE),
};

/* In the order of TEST_MALFORMED_* in common.h */
static struct bt_gatt_service malformed_services[] = {
	BT_GATT_SERVICE(empty_attrs),
	BT_GATT_SERVICE(report_last_attrs),
	BT_GATT_SERVICE(duplicate_attrs),
	BT_GATT_SERVICE(duplicate_id_attrs),
	BT_GATT_SERVICE(ccc_refused_attrs),
};

BUILD_ASSERT(ARRAY_SIZE(malformed_services) == TEST_MALFORMED_COUNT);

/* Never asks for security, so the Report Host never pairs with it */
static void test_hogp_malformed_device(void)
{
	int err;

	request_security = false;
	hogp_device_init();

	ARRAY_FOR_EACH_PTR(malformed_services, svc) {
		err = bt_gatt_service_register(svc);
		TEST_ASSERT(err == 0, "Failed to register a malformed HID Service: %d", err);

		/* The handles are only known once the service is registered */
		if (svc->attrs == duplicate_attrs) {
			duplicate_chrc.value_handle = duplicate_attrs[DUPLICATE_FIRST_VALUE].handle;
		}

		/* The Report Host disconnects once the discovery failed */
		connect_host_ad(ad_malformed, ARRAY_SIZE(ad_malformed));
		WAIT_FOR_FLAG(flag_disconnected);

		err = bt_gatt_service_unregister(svc);
		TEST_ASSERT(err == 0, "Failed to unregister a malformed HID Service: %d", err);
	}

	TEST_PASS("Malformed HOGP Device test passed");
}

static const struct bst_test_instance test_hogp_device_defs[] = {
	{
		.test_id = "hogp_device",
		.test_descr = "HID Device built on the HID Service",
		.test_main_f = test_hogp_device,
	},
	{
		.test_id = "hogp_device_2",
		.test_descr = "Second HID Device of the HOGP Host test",
		.test_main_f = test_hogp_device_2,
	},
	{
		.test_id = "hogp_malformed_device",
		.test_descr = "HID Device with malformed HID Services",
		.test_main_f = test_hogp_malformed_device,
	},
	BSTEST_END_MARKER,
};

struct bst_test_list *test_hogp_device_install(struct bst_test_list *tests)
{
	return bst_add_tests(tests, test_hogp_device_defs);
}
```
