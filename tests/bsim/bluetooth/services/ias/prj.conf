## CMakeLists.txt
```
# SPDX-License-Identifier: Apache-2.0

cmake_minimum_required(VERSION 3.20.0)

find_package(Zephyr REQUIRED HINTS $ENV{ZEPHYR_BASE})
project(bsim_test_ias)

add_subdirectory(${ZEPHYR_BASE}/tests/bsim/babblekit babblekit)
target_link_libraries(app PRIVATE babblekit)

add_subdirectory(${ZEPHYR_BASE}/tests/bluetooth/common/testlib testlib)
target_link_libraries(app PRIVATE testlib)

file(GLOB app_sources src/*.c)
target_sources(app PRIVATE ${app_sources})

zephyr_include_directories(
  ${BSIM_COMPONENTS_PATH}/libUtilv1/src/
  ${BSIM_COMPONENTS_PATH}/libPhyComv1/src/
)
```

## prj.conf
```kconfig
CONFIG_BT=y
CONFIG_BT_CENTRAL=y
CONFIG_BT_PERIPHERAL=y
CONFIG_BT_DEVICE_NAME="bsim_test_ias"
CONFIG_BT_GATT_CLIENT=y
# The two-client test connects two clients to the server
CONFIG_BT_MAX_CONN=2

# Immediate Alert
CONFIG_BT_IAS=y
CONFIG_BT_IAS_CLIENT=y

# DEBUGGING
CONFIG_LOG=y
CONFIG_LOG_MODE_IMMEDIATE=y
```

## src/main.c
```c
/*
 * Copyright (c) 2026 Bohdan Vereshchak
 *
 * SPDX-License-Identifier: Apache-2.0
 */

#include "bstests.h"

extern struct bst_test_list *test_ias_install(struct bst_test_list *tests);
extern struct bst_test_list *test_ias_client_install(struct bst_test_list *tests);

bst_test_install_t test_installers[] = {test_ias_install, test_ias_client_install, NULL};

int main(void)
{
	bst_main();

	return 0;
}
```

## src/ias_client_test.c
```c
/*
 * Copyright (c) 2022 Codecoup
 * Copyright (c) 2026 Silicon Laboratories Inc.
 *
 * SPDX-License-Identifier: Apache-2.0
 */

#include <stddef.h>
#include <stdint.h>

#include <zephyr/autoconf.h>
#include <zephyr/bluetooth/att.h>
#include <zephyr/bluetooth/bluetooth.h>
#include <zephyr/bluetooth/conn.h>
#include <zephyr/bluetooth/gatt.h>
#include <zephyr/bluetooth/services/ias.h>
#include <zephyr/bluetooth/uuid.h>
#include <zephyr/kernel.h>
#include <zephyr/logging/log.h>
#include <zephyr/toolchain.h>

#include "testlib/conn.h"
#include "testlib/scan.h"

#include "babblekit/flags.h"
#include "babblekit/sync.h"
#include "babblekit/testcase.h"
#include "bstests.h"

LOG_MODULE_REGISTER(ias_client_test);

DEFINE_FLAG_STATIC(g_service_discovered);
DEFINE_FLAG_STATIC(g_alert_lvl_discovered);
static uint16_t alert_lvl_handle;

static void discover_cb(struct bt_conn *conn, int err)
{
	ARG_UNUSED(conn);

	if (err != 0) {
		TEST_FAIL("Failed to discover IAS (err %d)\n", err);
		return;
	}

	LOG_INF("IAS discovered");
	SET_FLAG(g_service_discovered);
}

static const struct bt_ias_client_cb ias_client_cb = {
	.discover = discover_cb,
};

static void test_alert_high(struct bt_conn *conn)
{
	int err;

	err = bt_ias_client_alert_write(conn, BT_IAS_ALERT_LVL_HIGH_ALERT);
	if (err == 0) {
		LOG_INF("High alert sent");
	} else {
		TEST_FAIL("Failed to send high alert\n");
	}
}

static void test_alert_mild(struct bt_conn *conn)
{
	int err;

	err = bt_ias_client_alert_write(conn, BT_IAS_ALERT_LVL_MILD_ALERT);
	if (err == 0) {
		LOG_INF("Mild alert sent");
	} else {
		TEST_FAIL("Failed to send mild alert\n");
	}
}

static void test_alert_stop(struct bt_conn *conn)
{
	int err;

	err = bt_ias_client_alert_write(conn, BT_IAS_ALERT_LVL_NO_ALERT);
	if (err == 0) {
		LOG_INF("Stop alert sent");
	} else {
		TEST_FAIL("Failed to send no alert\n");
	}
}

static void discover_ias(struct bt_conn *conn)
{
	int err;

	UNSET_FLAG(g_service_discovered);

	err = bt_ias_discover(conn);
	if (err < 0) {
		TEST_FAIL("Failed to discover IAS (err %d)\n", err);
		return;
	}

	WAIT_FOR_FLAG(g_service_discovered);
}

static uint8_t alert_lvl_discover_cb(struct bt_conn *conn, const struct bt_gatt_attr *attr,
				     struct bt_gatt_discover_params *params)
{
	const struct bt_gatt_chrc *chrc;

	ARG_UNUSED(conn);
	ARG_UNUSED(params);

	if (attr == NULL) {
		TEST_FAIL("Alert Level characteristic not found\n");
		return BT_GATT_ITER_STOP;
	}

	chrc = attr->user_data;
	alert_lvl_handle = chrc->value_handle;
	SET_FLAG(g_alert_lvl_discovered);

	return BT_GATT_ITER_STOP;
}

static void discover_alert_lvl(struct bt_conn *conn)
{
	static struct bt_gatt_discover_params params;
	int err;

	UNSET_FLAG(g_alert_lvl_discovered);

	params.uuid = BT_UUID_ALERT_LEVEL;
	params.func = alert_lvl_discover_cb;
	params.start_handle = BT_ATT_FIRST_ATTRIBUTE_HANDLE;
	params.end_handle = BT_ATT_LAST_ATTRIBUTE_HANDLE;
	params.type = BT_GATT_DISCOVER_CHARACTERISTIC;

	err = bt_gatt_discover(conn, &params);
	TEST_ASSERT(err == 0, "Failed to discover the Alert Level characteristic (err %d)", err);

	WAIT_FOR_FLAG(g_alert_lvl_discovered);
}

static struct bt_conn *connect_to_server(void)
{
	struct bt_conn *conn = NULL;
	bt_addr_le_t addr;
	int err;

	err = bt_enable(NULL);
	TEST_ASSERT(err == 0, "Bluetooth init failed (err %d)", err);

	LOG_INF("Bluetooth initialized");

	err = bt_testlib_scan_find_name(&addr, CONFIG_BT_DEVICE_NAME);
	TEST_ASSERT(err == 0, "Failed to find IAS server: %d", err);

	err = bt_testlib_connect(&addr, &conn);
	TEST_ASSERT(err == 0, "Failed to connect: %d", err);

	return conn;
}

static void test_main(void)
{
	struct bt_conn *client_conn;
	int err;

	err = bk_sync_init();
	TEST_ASSERT(err == 0, "Failed to init sync: %d", err);

	client_conn = connect_to_server();

	err = bt_ias_client_cb_register(&ias_client_cb);
	TEST_ASSERT(err == 0, "Failed to register callbacks (err %d)", err);

	discover_ias(client_conn);
	discover_ias(client_conn); /* test that we can discover twice */

	/* Sync with the server after each write so it can check every alert level */
	test_alert_high(client_conn);
	bk_sync_send();
	bk_sync_wait();

	test_alert_mild(client_conn);
	bk_sync_send();
	bk_sync_wait();

	test_alert_stop(client_conn);
	bk_sync_send();
	bk_sync_wait();

	TEST_PASS("IAS client PASS\n");
}

/* In tests_scripts/ias_two_clients.sh the two clients are devices 0 and 1, the pair that
 * babblekit sync connects, and the server is device 2.
 */
static void test_valid_lvl_client(void)
{
	struct bt_conn *conn;
	int err;

	err = bk_sync_init();
	TEST_ASSERT(err == 0, "Failed to init sync: %d", err);

	conn = connect_to_server();

	err = bt_ias_client_cb_register(&ias_client_cb);
	TEST_ASSERT(err == 0, "Failed to register callbacks (err %d)", err);

	discover_ias(conn);

	test_alert_high(conn);

	/* A Write Command gets no response. The server has handled it once it answers the
	 * requests of another discovery.
	 */
	discover_ias(conn);

	/* Let the other client connect and write its invalid level */
	bk_sync_send();
	bk_sync_wait();

	test_alert_mild(conn);

	TEST_PASS("IAS valid level client PASS\n");
}

static void test_invalid_lvl_client(void)
{
	/* The first value after the Alert Level range */
	const uint8_t invalid_lvl = (uint8_t)BT_IAS_ALERT_LVL_HIGH_ALERT + 1U;
	struct bt_conn *conn;
	int err;

	err = bk_sync_init();
	TEST_ASSERT(err == 0, "Failed to init sync: %d", err);

	/* The server has the High Alert of the other client by now */
	bk_sync_wait();

	conn = connect_to_server();

	discover_alert_lvl(conn);

	err = bt_gatt_write_without_response(conn, alert_lvl_handle, &invalid_lvl,
					     sizeof(invalid_lvl), false);
	TEST_ASSERT(err == 0, "Failed to send the invalid alert level (err %d)", err);

	/* As for the High Alert of the other client: wait until the server has handled it */
	discover_alert_lvl(conn);

	bk_sync_send();

	TEST_PASS("IAS invalid level client PASS\n");
}

static const struct bst_test_instance test_ias[] = {
	{
		.test_id = "ias_client",
		.test_main_f = test_main,
	},
	{
		.test_id = "ias_client_valid_lvl",
		.test_main_f = test_valid_lvl_client,
	},
	{
		.test_id = "ias_client_invalid_lvl",
		.test_main_f = test_invalid_lvl_client,
	},
	BSTEST_END_MARKER,
};

struct bst_test_list *test_ias_client_install(struct bst_test_list *tests)
{
	return bst_add_tests(tests, test_ias);
}
```

## src/ias_test.c
```c
/*
 * Copyright (c) 2022 Codecoup
 * Copyright (c) 2026 Silicon Laboratories Inc.
 *
 * SPDX-License-Identifier: Apache-2.0
 */

#include <errno.h>
#include <stddef.h>

#include <zephyr/bluetooth/bluetooth.h>
#include <zephyr/bluetooth/conn.h>
#include <zephyr/bluetooth/gatt.h>
#include <zephyr/bluetooth/services/ias.h>
#include <zephyr/bluetooth/uuid.h>
#include <zephyr/kernel.h>
#include <zephyr/logging/log.h>

#include "babblekit/flags.h"
#include "babblekit/sync.h"
#include "babblekit/testcase.h"

#include "bstests.h"

LOG_MODULE_REGISTER(ias_test);

DEFINE_FLAG_STATIC(g_high_alert_received);
DEFINE_FLAG_STATIC(g_mild_alert_received);
DEFINE_FLAG_STATIC(g_stop_alert_received);
DEFINE_FLAG_STATIC(g_connected);

static const struct bt_data ad[] = {
	BT_DATA_BYTES(BT_DATA_FLAGS, (BT_LE_AD_GENERAL | BT_LE_AD_NO_BREDR)),
	BT_DATA_BYTES(BT_DATA_UUID16_ALL, BT_UUID_16_ENCODE(BT_UUID_IAS_VAL)),
	BT_DATA(BT_DATA_NAME_COMPLETE, CONFIG_BT_DEVICE_NAME, sizeof(CONFIG_BT_DEVICE_NAME) - 1),
};

static void high_alert_cb(void)
{
	SET_FLAG(g_high_alert_received);
}

static void mild_alert_cb(void)
{
	SET_FLAG(g_mild_alert_received);
}

static void no_alert_cb(void)
{
	SET_FLAG(g_stop_alert_received);
}

BT_IAS_CB_DEFINE(ias_callbacks) = {
	.high_alert = high_alert_cb,
	.mild_alert = mild_alert_cb,
	.no_alert = no_alert_cb,
};

static void connected(struct bt_conn *conn, uint8_t err)
{
	ARG_UNUSED(conn);

	if (err == 0U) {
		SET_FLAG(g_connected);
	}
}

BT_CONN_CB_DEFINE(conn_callbacks) = {
	.connected = connected,
};

static void start_adv(void)
{
	int err;

	err = bt_le_adv_start(BT_LE_ADV_CONN_FAST_1, ad, ARRAY_SIZE(ad), NULL, 0);
	/* The host may already have resumed advertising after a connection */
	TEST_ASSERT(err == 0 || err == -EALREADY, "Failed to start advertising: %d", err);
}

static void test_main(void)
{
	int err;

	err = bt_enable(NULL);
	if (err != 0) {
		TEST_FAIL("Bluetooth init failed (err %d)\n", err);
		return;
	}
	err = bk_sync_init();
	TEST_ASSERT(err == 0, "Failed to init sync: %d", err);

	start_adv();

	WAIT_FOR_FLAG(g_high_alert_received);
	LOG_INF("High alert received");

	err = bt_ias_local_alert_stop();
	TEST_ASSERT(err == 0, "Failed to locally stop alert: %d", err);

	/* Local stop does not trigger callbacks; verify the alert is now off instead */
	err = bt_ias_local_alert_stop();
	TEST_ASSERT(err == -EALREADY, "Alert still active after local stop: %d", err);

	bk_sync_send();
	bk_sync_wait();

	WAIT_FOR_FLAG(g_mild_alert_received);
	LOG_INF("Mild alert received");
	bk_sync_send();
	bk_sync_wait();

	WAIT_FOR_FLAG(g_stop_alert_received);
	LOG_INF("Stop alert received");
	bk_sync_send();
	bk_sync_wait();

	TEST_PASS("IAS test passed\n");
}

static void test_two_clients(void)
{
	int err;

	err = bt_enable(NULL);
	TEST_ASSERT(err == 0, "Bluetooth init failed (err %d)", err);

	start_adv();
	WAIT_FOR_FLAG(g_connected);
	UNSET_FLAG(g_connected);

	/* The first connection stopped the advertising */
	start_adv();
	WAIT_FOR_FLAG(g_connected);

	WAIT_FOR_FLAG(g_high_alert_received);
	LOG_INF("High alert received");

	/* The first client lowers its level to Mild Alert after the second client wrote an
	 * invalid level, which must not count as a request of any level.
	 */
	while (!IS_FLAG_SET(g_mild_alert_received) && !IS_FLAG_SET(g_stop_alert_received)) {
		k_sleep(K_MSEC(1));
	}
	TEST_ASSERT(!IS_FLAG_SET(g_stop_alert_received),
		    "Alert stopped while a client requests Mild Alert");

	/* Both clients passed before the last write reached this device */
	TEST_PASS_AND_EXIT("IAS two clients test passed\n");
}

static const struct bst_test_instance test_ias[] = {
	{
		.test_id = "ias",
		.test_main_f = test_main,
	},
	{
		.test_id = "ias_two_clients",
		.test_main_f = test_two_clients,
	},
	BSTEST_END_MARKER,
};

struct bst_test_list *test_ias_install(struct bst_test_list *tests)
{
	return bst_add_tests(tests, test_ias);
}
```
