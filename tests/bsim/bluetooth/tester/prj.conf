## CMakeLists.txt
```
# SPDX-License-Identifier: Apache-2.0

cmake_minimum_required(VERSION 3.28.0)

find_package(Zephyr REQUIRED HINTS $ENV{ZEPHYR_BASE})
project(tester_bsim)

# This contains babblesim-specific helpers, e.g. device synchronization.
add_subdirectory(${ZEPHYR_BASE}/tests/bsim/babblekit babblekit)
target_link_libraries(app PRIVATE babblekit)

zephyr_include_directories(
  ${BSIM_COMPONENTS_PATH}/libUtilv1/src/
  ${BSIM_COMPONENTS_PATH}/libPhyComv1/src/
  )

zephyr_include_directories(
  src/
  ${ZEPHYR_BASE}/tests/bluetooth/tester/src
  ${ZEPHYR_BASE}/tests/bluetooth/tester/src/btp
  ${ZEPHYR_BASE}/tests/bluetooth/tester/src/audio/btp
)

target_sources(app PRIVATE
  src/bsim_btp.c
  src/test_main.c
  src/audio/bap_broadcast_sink.c
  src/audio/bap_broadcast_source.c
  src/audio/bap_central.c
  src/audio/bap_peripheral.c
  src/audio/cap_broadcast_sink.c
  src/audio/cap_broadcast_source.c
  src/audio/cap_central.c
  src/audio/cap_peripheral.c
  src/audio/ccp_central.c
  src/audio/ccp_peripheral.c
  src/audio/csip_central.c
  src/audio/csip_peripheral.c
  src/audio/hap_central.c
  src/audio/hap_peripheral.c
  src/audio/mcp_central.c
  src/audio/mcp_peripheral.c
  src/audio/micp_central.c
  src/audio/micp_peripheral.c
  src/audio/pbp_sink.c
  src/audio/pbp_source.c
  src/audio/tmap_central.c
  src/audio/tmap_peripheral.c
  src/audio/vcp_central.c
  src/audio/vcp_peripheral.c
  src/host/gap_central.c
  src/host/gap_peripheral.c
  src/host/iso_broadcaster.c
  src/host/iso_sync_receiver.c
)
```

## Kconfig
```
# Copyright (c) 2025 Nordic Semiconductor ASA
# SPDX-License-Identifier: Apache-2.0

module = BSIM_BTTESTER
module-str = bsim_bttester
source "subsys/logging/Kconfig.template.log_config"

source "Kconfig.zephyr"
```

## Kconfig.sysbuild
```
# Copyright (c) 2023-2025 Nordic Semiconductor ASA
# SPDX-License-Identifier: Apache-2.0

source "${ZEPHYR_BASE}/tests/bluetooth/tester/Kconfig.sysbuild"

config NATIVE_SIMULATOR_PRIMARY_MCU_INDEX
	int
	# Let's pass the test arguments to the application MCU test
	# otherwise by default they would have gone to the net core.
	default 0 if $(BOARD_TARGET_STRING) = "NRF5340BSIM_NRF5340_CPUAPP"
```

## prj.conf
```kconfig
CONFIG_ASSERT=y
CONFIG_THREAD_NAME=y

# Should not be necessary, but the bluetooth/buf.h header file require Bluetooth to be enabled, and
# the header file is being included by some of the BTP header files
CONFIG_BT=y

CONFIG_UART_PIPE=n
CONFIG_SERIAL=y

CONFIG_LOG=y
CONFIG_LOG_FUNC_NAME_PREFIX_ERR=y
CONFIG_LOG_FUNC_NAME_PREFIX_WRN=y
CONFIG_BSIM_BTTESTER_LOG_LEVEL_DBG=y

CONFIG_SYSTEM_WORKQUEUE_STACK_IGNORE_MIN=y
```

## uart.overlay
```dts
/ {
	chosen {
		zephyr,console = &uart0;
	};
};
```

## boards/nrf52_bsim.overlay
```dts
/* SPDX-License-Identifier: Apache-2.0 */

&uart0 {
	hw-flow-control;
};
```

## src/btp.c
```c
/*
 * Copyright (c) 2025 Nordic Semiconductor ASA
 *
 * SPDX-License-Identifier: Apache-2.0
 */
#include <stdint.h>
#include <stddef.h>
#include <string.h>

#include <zephyr/drivers/uart_pipe.h>
#include <zephyr/kernel.h>
#include <zephyr/logging/log.h>
#include <zephyr/net_buf.h>
#include <zephyr/sys/util.h>
#include <zephyr/sys_clock.h>

#include "babblekit/testcase.h"

#include "btp/btp.h"

LOG_MODULE_REGISTER(bsim_btp, CONFIG_BTTESTER_LOG_LEVEL);

static uint8_t *btp_buffer;
static size_t btp_buffer_len;
static uart_pipe_recv_cb btp_cb;

K_FIFO_DEFINE(btp_rsp_fifo);
NET_BUF_POOL_FIXED_DEFINE(btp_rsp_pool, 1, BTP_MTU, 0, NULL);
K_FIFO_DEFINE(btp_evt_fifo);
NET_BUF_POOL_FIXED_DEFINE(btp_evt_pool, 100, BTP_MTU, 0, NULL);

static void wait_for_response(const struct btp_hdr *cmd_hdr)
{
	const struct btp_hdr *rsp_hdr;
	struct net_buf *buf;

	buf = k_fifo_get(&btp_rsp_fifo, K_SECONDS(1));
	TEST_ASSERT(buf != NULL);

	rsp_hdr = (struct btp_hdr *)buf->data;
	TEST_ASSERT(rsp_hdr->len <= BTP_MTU, "len %u > %d", rsp_hdr->len, BTP_MTU);

	LOG_DBG("rsp service %u and opcode %u len %u", cmd_hdr->service, cmd_hdr->opcode,
		rsp_hdr->len);

	TEST_ASSERT(rsp_hdr->service == cmd_hdr->service && rsp_hdr->opcode == cmd_hdr->opcode);

	net_buf_unref(buf);
}

/* BTP communication is inspired from `uart_pipe_rx` to achieve a similar API */
void bsim_btp_send_to_tester(const uint8_t *data, size_t len)
{
	const struct btp_hdr *cmd_hdr;
	size_t offset = len;

	TEST_ASSERT(data != NULL);
	TEST_ASSERT(btp_buffer != NULL);
	TEST_ASSERT(len <= btp_buffer_len, "len %zu > %zu", len, btp_buffer_len);
	TEST_ASSERT(len >= sizeof(*cmd_hdr), "len %zu <= %zu", len, sizeof(*cmd_hdr));

	memcpy(btp_buffer, data, len);

	cmd_hdr = (const struct btp_hdr *)data;
	LOG_DBG("cmd service %u and opcode %u", cmd_hdr->service, cmd_hdr->opcode);
	btp_buffer = btp_cb(btp_buffer, &offset);
	TEST_ASSERT(offset == 0U);

	wait_for_response(cmd_hdr);
}

void bsim_btp_register_tester(uint8_t *buffer, size_t len, uart_pipe_recv_cb cb)
{
	TEST_ASSERT(cb != NULL);
	TEST_ASSERT(buffer != NULL);
	TEST_ASSERT(len > sizeof(struct btp_hdr), "len %zu", len);
	TEST_ASSERT(len <= BTP_MTU, "len %zu > %d", len, BTP_MTU);

	btp_buffer = buffer;
	btp_buffer_len = len;
	btp_cb = cb;

	LOG_INF("btp registered with %p %zu %p", buffer, len, cb);
}

void bsim_btp_send_to_bsim(const uint8_t *data, size_t len)
{
	static struct net_buf *buf;
	bool full_evt;

	TEST_ASSERT(len >= 0);
	TEST_ASSERT(data != NULL);
	TEST_ASSERT(len <= BTP_MTU - sizeof(struct btp_hdr), "len %zu < %d", len, BTP_MTU);
	TEST_ASSERT(buf != NULL || (buf == NULL && len == sizeof(struct btp_hdr)), "len %zu buf %p",
		    len, buf);

	/* tester_send_with_index always sends the header first, and then any additional information
	 * afterwards. We thus need to reassemble the full event.
	 */
	if (buf == NULL) {
		const struct btp_hdr *hdr = (const struct btp_hdr *)data;

		LOG_DBG("hdr service %u and opcode %u", hdr->service, hdr->opcode);
		TEST_ASSERT(hdr->opcode != BTP_STATUS, "hdr service %u", hdr->service);

		if (hdr->opcode < BTP_EVENT_OPCODE) {
			buf = net_buf_alloc(&btp_rsp_pool, K_NO_WAIT);
			TEST_ASSERT(buf != NULL);
		} else {
			buf = net_buf_alloc(&btp_evt_pool, K_NO_WAIT);
			if (buf == NULL) {
				/* Discard the oldest event */
				buf = k_fifo_get(&btp_evt_fifo, K_NO_WAIT);
				TEST_ASSERT(buf != NULL);
				net_buf_unref(buf);

				buf = net_buf_alloc(&btp_evt_pool, K_NO_WAIT);
				TEST_ASSERT(buf != NULL);
			}
		}

		full_evt = hdr->len == 0; /* we are not awaiting additional data if hdr->len == 0*/
	} else {
		/* If buf != NULL then we have received the hdr and this is the additional data for
		 * the event/response. We always assume that we receive the rest here
		 */
		const struct btp_hdr *hdr = (const struct btp_hdr *)buf->data;

		TEST_ASSERT(buf != NULL && len == hdr->len, "len %zu hdr len %u", len, hdr->len);
		full_evt = true;
	}

	net_buf_add_mem(buf, data, len);

	if (full_evt) {
		const struct btp_hdr *hdr = (const struct btp_hdr *)buf->data;

		if (hdr->opcode < BTP_EVENT_OPCODE) {
			k_fifo_put(&btp_rsp_fifo, buf);
		} else {
			k_fifo_put(&btp_evt_fifo, buf);
		}

		buf = NULL;
	}
}

void bsim_btp_wait_for_evt(uint8_t service, uint8_t opcode, struct net_buf **out_buf)
{
	LOG_DBG("Waiting for evt with service %u and opcode %u", service, opcode);

	while (true) {
		const struct btp_hdr *hdr;
		struct net_buf *buf;

		buf = k_fifo_get(&btp_evt_fifo, K_FOREVER);
		TEST_ASSERT(buf != NULL);

		LOG_HEXDUMP_DBG(buf->data, buf->len, "evt");
		hdr = net_buf_pull_mem(buf, sizeof(struct btp_hdr));

		/* TODO: Verify length of event based on the service and opcode */
		if (hdr->service == service && hdr->opcode == opcode) {
			if (out_buf != NULL) {
				/* If the caller provides an out_buf, they are responsible for
				 * unref'ing it
				 */
				*out_buf = net_buf_ref(buf);
			}

			net_buf_unref(buf);
			return;
		}

		net_buf_unref(buf);
	}
}
```

## src/btp.h
```c
/*
 * Copyright (c) 2025 Nordic Semiconductor ASA
 *
 * SPDX-License-Identifier: Apache-2.0
 */
#include <stdint.h>
#include <string.h>
#include <zephyr/bluetooth/addr.h>
#include <zephyr/net_buf.h>

#include "btp/btp.h"

void btp_send_to_tester(const uint8_t *data, size_t len);
void btp_wait_for_evt(uint8_t service, uint8_t opcode, uint8_t evt_buffer[BTP_MTU]);

static inline void btp_core_register(uint8_t id)
{

	NET_BUF_SIMPLE_DEFINE(cmd_buffer, BTP_MTU);

	struct btp_hdr *cmd_hdr;
	struct btp_core_register_service_cmd *cmd;

	cmd_hdr = net_buf_simple_add(&cmd_buffer, sizeof(*cmd_hdr));
	cmd_hdr->service = BTP_SERVICE_ID_CORE;
	cmd_hdr->opcode = BTP_CORE_REGISTER_SERVICE;
	cmd_hdr->index = BTP_INDEX_NONE;
	cmd = net_buf_simple_add(&cmd_buffer, sizeof(*cmd));
	cmd->id = id;

	cmd_hdr->len = cmd_buffer.len - sizeof(*cmd_hdr);

	btp_send_to_tester(cmd_buffer.data, cmd_buffer.len);
}

static inline void btp_gap_set_discoverable(uint8_t discoverable)
{
	NET_BUF_SIMPLE_DEFINE(cmd_buffer, BTP_MTU);

	struct btp_hdr *cmd_hdr;
	struct btp_gap_set_discoverable_cmd *cmd;

	cmd_hdr = net_buf_simple_add(&cmd_buffer, sizeof(*cmd_hdr));
	cmd_hdr->service = BTP_SERVICE_ID_GAP;
	cmd_hdr->opcode = BTP_GAP_SET_DISCOVERABLE;
	cmd_hdr->index = BTP_INDEX;
	cmd = net_buf_simple_add(&cmd_buffer, sizeof(*cmd));
	cmd->discoverable = discoverable;

	cmd_hdr->len = cmd_buffer.len - sizeof(*cmd_hdr);

	btp_send_to_tester(cmd_buffer.data, cmd_buffer.len);
}

static inline void btp_gap_start_advertising(uint8_t adv_data_len, uint8_t scan_rsp_len,
					     const uint8_t adv_sr_data[], uint32_t duration,
					     uint8_t own_addr_type)
{
	NET_BUF_SIMPLE_DEFINE(cmd_buffer, BTP_MTU);

	struct btp_hdr *cmd_hdr;
	struct btp_gap_start_advertising_cmd *cmd;

	cmd_hdr = net_buf_simple_add(&cmd_buffer, sizeof(*cmd_hdr));
	cmd_hdr->service = BTP_SERVICE_ID_GAP;
	cmd_hdr->opcode = BTP_GAP_START_ADVERTISING;
	cmd_hdr->index = BTP_INDEX;
	cmd = net_buf_simple_add(&cmd_buffer, sizeof(*cmd));
	cmd->adv_data_len = adv_data_len;
	cmd->scan_rsp_len = scan_rsp_len;
	if (adv_data_len > 0U) {
		net_buf_simple_add_mem(&cmd_buffer, adv_sr_data, adv_data_len);
	}
	if (scan_rsp_len > 0U) {
		net_buf_simple_add_mem(&cmd_buffer, adv_sr_data, scan_rsp_len);
	}
	net_buf_simple_add_le32(&cmd_buffer, duration);
	net_buf_simple_add_u8(&cmd_buffer, own_addr_type);

	cmd_hdr->len = cmd_buffer.len - sizeof(*cmd_hdr);

	btp_send_to_tester(cmd_buffer.data, cmd_buffer.len);
}

static inline void btp_gap_start_discovery(uint8_t flags)
{
	NET_BUF_SIMPLE_DEFINE(cmd_buffer, BTP_MTU);

	struct btp_hdr *cmd_hdr;
	struct btp_gap_start_discovery_cmd *cmd;

	cmd_hdr = net_buf_simple_add(&cmd_buffer, sizeof(*cmd_hdr));
	cmd_hdr->service = BTP_SERVICE_ID_GAP;
	cmd_hdr->opcode = BTP_GAP_START_DISCOVERY;
	cmd_hdr->index = BTP_INDEX;
	cmd = net_buf_simple_add(&cmd_buffer, sizeof(*cmd));
	cmd->flags = flags;

	cmd_hdr->len = cmd_buffer.len - sizeof(*cmd_hdr);

	btp_send_to_tester(cmd_buffer.data, cmd_buffer.len);
}

static inline void btp_gap_connect(const bt_addr_le_t *address, uint8_t own_addr_type)
{
	NET_BUF_SIMPLE_DEFINE(cmd_buffer, BTP_MTU);

	struct btp_hdr *cmd_hdr;
	struct btp_gap_connect_cmd *cmd;

	cmd_hdr = net_buf_simple_add(&cmd_buffer, sizeof(*cmd_hdr));
	cmd_hdr->service = BTP_SERVICE_ID_GAP;
	cmd_hdr->opcode = BTP_GAP_START_DISCOVERY;
	cmd_hdr->index = BTP_INDEX;
	cmd = net_buf_simple_add(&cmd_buffer, sizeof(*cmd));
	bt_addr_le_copy(&cmd->address, address);
	cmd->own_addr_type = own_addr_type;

	cmd_hdr->len = cmd_buffer.len - sizeof(*cmd_hdr);

	btp_send_to_tester(cmd_buffer.data, cmd_buffer.len);
}
```

## src/gap_central.c
```c
/*
 * Copyright (c) 2025 Nordic Semiconductor ASA
 *
 * SPDX-License-Identifier: Apache-2.0
 */
#include <stdint.h>

#include <zephyr/sys/util_macro.h>

#include "babblekit/testcase.h"
#include "bstests.h"

#include "btp.h"

static void test_gap_central(void)
{
	uint8_t evt_buffer[BTP_MTU];

	btp_wait_for_evt(BTP_SERVICE_ID_CORE, BTP_CORE_EV_IUT_READY, evt_buffer);

	btp_core_register(BTP_SERVICE_ID_GAP);
	btp_gap_start_discovery(BTP_GAP_DISCOVERY_FLAG_LE);
	btp_wait_for_evt(BTP_SERVICE_ID_GAP, BTP_GAP_EV_DEVICE_FOUND, evt_buffer);

	TEST_PASS("PASSED\n");
}

static const struct bst_test_instance test_sample[] = {
	{
		.test_id = "gap_central",
		.test_descr = "Smoketest for the GAP central BT Tester behavior",
		.test_main_f = test_gap_central,
	},
	BSTEST_END_MARKER,
};

struct bst_test_list *test_gap_central_install(struct bst_test_list *tests)
{
	return bst_add_tests(tests, test_sample);
}
```

## src/gap_peripheral.c
```c
/*
 * Copyright (c) 2025 Nordic Semiconductor ASA
 *
 * SPDX-License-Identifier: Apache-2.0
 */
#include <stddef.h>
#include <stdint.h>

#include <zephyr/bluetooth/gap.h>
#include <zephyr/bluetooth/hci_types.h>
#include <zephyr/sys/util_macro.h>

#include "babblekit/testcase.h"
#include "bstests.h"

#include "btp.h"

static void test_gap_peripheral(void)
{
	uint8_t evt_buffer[BTP_MTU];

	btp_wait_for_evt(BTP_SERVICE_ID_CORE, BTP_CORE_EV_IUT_READY, evt_buffer);

	btp_core_register(BTP_SERVICE_ID_GAP);
	btp_gap_set_discoverable(BTP_GAP_GENERAL_DISCOVERABLE);
	btp_gap_start_advertising(0U, 0U, NULL, 0xFFFFU, BT_HCI_OWN_ADDR_PUBLIC);

	TEST_PASS("PASSED\n");
}

static const struct bst_test_instance test_sample[] = {
	{
		.test_id = "gap_peripheral",
		.test_descr = "Smoketest for the GAP central BT Tester behavior",
		.test_main_f = test_gap_peripheral,
	},
	BSTEST_END_MARKER,
};

struct bst_test_list *test_gap_peripheral_install(struct bst_test_list *tests)
{
	return bst_add_tests(tests, test_sample);
}
```

## src/test_main.c
```c
/*
 * Copyright (c) 2025 Nordic Semiconductor ASA
 *
 * SPDX-License-Identifier: Apache-2.0
 */
#include <stddef.h>

#include <bstests.h>

extern struct bst_test_list *test_bap_broadcast_sink_install(struct bst_test_list *tests);
extern struct bst_test_list *test_bap_broadcast_source_install(struct bst_test_list *tests);
extern struct bst_test_list *test_bap_central_install(struct bst_test_list *tests);
extern struct bst_test_list *test_bap_peripheral_install(struct bst_test_list *tests);
extern struct bst_test_list *test_cap_broadcast_sink_install(struct bst_test_list *tests);
extern struct bst_test_list *test_cap_broadcast_source_install(struct bst_test_list *tests);
extern struct bst_test_list *test_cap_central_install(struct bst_test_list *tests);
extern struct bst_test_list *test_cap_peripheral_install(struct bst_test_list *tests);
extern struct bst_test_list *test_ccp_central_install(struct bst_test_list *tests);
extern struct bst_test_list *test_ccp_peripheral_install(struct bst_test_list *tests);
extern struct bst_test_list *test_csip_central_install(struct bst_test_list *tests);
extern struct bst_test_list *test_csip_peripheral_install(struct bst_test_list *tests);
extern struct bst_test_list *test_gap_central_install(struct bst_test_list *tests);
extern struct bst_test_list *test_gap_peripheral_install(struct bst_test_list *tests);
extern struct bst_test_list *test_hap_central_install(struct bst_test_list *tests);
extern struct bst_test_list *test_hap_peripheral_install(struct bst_test_list *tests);
extern struct bst_test_list *test_mcp_central_install(struct bst_test_list *tests);
extern struct bst_test_list *test_mcp_peripheral_install(struct bst_test_list *tests);
extern struct bst_test_list *test_micp_central_install(struct bst_test_list *tests);
extern struct bst_test_list *test_micp_peripheral_install(struct bst_test_list *tests);
extern struct bst_test_list *test_pbp_sink_install(struct bst_test_list *tests);
extern struct bst_test_list *test_pbp_source_install(struct bst_test_list *tests);
extern struct bst_test_list *test_tmap_central_install(struct bst_test_list *tests);
extern struct bst_test_list *test_tmap_peripheral_install(struct bst_test_list *tests);
extern struct bst_test_list *test_vcp_central_install(struct bst_test_list *tests);
extern struct bst_test_list *test_vcp_peripheral_install(struct bst_test_list *tests);
extern struct bst_test_list *test_iso_broadcaster_install(struct bst_test_list *tests);
extern struct bst_test_list *test_iso_sync_receiver_install(struct bst_test_list *tests);

bst_test_install_t test_installers[] = {
	test_bap_broadcast_sink_install,
	test_bap_broadcast_source_install,
	test_bap_central_install,
	test_bap_peripheral_install,
	test_cap_broadcast_sink_install,
	test_cap_broadcast_source_install,
	test_cap_central_install,
	test_cap_peripheral_install,
	test_ccp_central_install,
	test_ccp_peripheral_install,
	test_csip_central_install,
	test_csip_peripheral_install,
	test_gap_central_install,
	test_gap_peripheral_install,
	test_hap_central_install,
	test_hap_peripheral_install,
	test_mcp_central_install,
	test_mcp_peripheral_install,
	test_micp_central_install,
	test_micp_peripheral_install,
	test_pbp_sink_install,
	test_pbp_source_install,
	test_tmap_central_install,
	test_tmap_peripheral_install,
	test_vcp_central_install,
	test_vcp_peripheral_install,
	test_iso_broadcaster_install,
	test_iso_sync_receiver_install,
	NULL,
};

int main(void)
{
	bst_main();
	return 0;
}
```
