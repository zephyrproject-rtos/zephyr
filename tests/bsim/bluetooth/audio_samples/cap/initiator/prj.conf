## CMakeLists.txt
```
# SPDX-License-Identifier: Apache-2.0

cmake_minimum_required(VERSION 3.20.0)

find_package(Zephyr REQUIRED HINTS $ENV{ZEPHYR_BASE})
project(cap_initiator_self_tests)

set(cap_initiator_path ${ZEPHYR_BASE}/samples/bluetooth/audio/cap_initiator)

target_sources(app PRIVATE
  ${cap_initiator_path}/src/main.c
  ${cap_initiator_path}/src/cap_initiator_tx.c
)

zephyr_sources_ifdef(CONFIG_SAMPLE_UNICAST ${cap_initiator_path}/src/cap_initiator_unicast.c)
zephyr_sources_ifdef(CONFIG_SAMPLE_BROADCAST ${cap_initiator_path}/src/cap_initiator_broadcast.c)

target_sources(app PRIVATE
  src/cap_initiator_sample_test.c
  src/test_main.c
)

zephyr_library_include_directories(${ZEPHYR_BASE}/samples/bluetooth)

zephyr_include_directories(
  ${BSIM_COMPONENTS_PATH}/libUtilv1/src/
  ${BSIM_COMPONENTS_PATH}/libPhyComv1/src/
  )
```

## Kconfig
```
# Copyright (c) 2024 Nordic Semiconductor ASA
# SPDX-License-Identifier: Apache-2.0

source "$(ZEPHYR_BASE)/samples/bluetooth/audio/cap_initiator/Kconfig"
```

## Kconfig.sysbuild
```
# Copyright (c) 2023-2024 Nordic Semiconductor ASA
# SPDX-License-Identifier: Apache-2.0

source "$(ZEPHYR_BASE)/samples/bluetooth/audio/cap_initiator/Kconfig.sysbuild"

config NATIVE_SIMULATOR_PRIMARY_MCU_INDEX
	int
	# Let's pass the test arguments to the application MCU test
	# otherwise by default they would have gone to the net core.
	default 0 if $(BOARD_TARGET_STRING) = "NRF5340BSIM_NRF5340_CPUAPP"
```

## prj.conf
```kconfig
# Please build using the sample configuration file:
# ${ZEPHYR_BASE}/samples/bluetooth/audio/cap_initiator/prj.conf
```

## src/cap_initiator_sample_test.c
```c
/*
 * Copyright (c) 2023-2025 Nordic Semiconductor ASA
 * Copyright (c) 2017-2019 Oticon A/S
 *
 * SPDX-License-Identifier: Apache-2.0
 */
#include <inttypes.h>
#include <stdint.h>

#include <zephyr/sys/util_macro.h>
#include <zephyr/toolchain.h>

#include "bs_types.h"
#include "bs_tracing.h"
#include "bs_utils.h"
#include "bstests.h"

#define WAIT_TIME 60 /* Seconds */

#define PASS_THRESHOLD 100 /* Audio packets */

extern enum bst_result_t bst_result;

#define FAIL(...)                                                                                  \
	do {                                                                                       \
		bst_result = Failed;                                                               \
		bs_trace_error_time_line(__VA_ARGS__);                                             \
	} while (0)

#define PASS(...)                                                                                  \
	do {                                                                                       \
		bst_result = Passed;                                                               \
		bs_trace_info_time(1, __VA_ARGS__);                                                \
	} while (0)

static void test_cap_initiator_sample_init(void)
{
	bst_ticker_set_next_tick_absolute(WAIT_TIME * 1e6);
	bst_result = In_progress;
}

static void test_cap_initiator_sample_tick(bs_time_t HW_device_time)
{
	ARG_UNUSED(HW_device_time);

	/*
	 * If in WAIT_TIME seconds we did not get enough packets through
	 * we consider the test failed
	 */

	if (IS_ENABLED(CONFIG_SAMPLE_UNICAST)) {
		extern uint64_t total_unicast_rx_iso_packet_count;
		extern uint64_t total_unicast_tx_iso_packet_count;

		bs_trace_info_time(2, "%" PRIu64 " unicast packets received, expected >= %i\n",
				   total_unicast_rx_iso_packet_count, PASS_THRESHOLD);
		bs_trace_info_time(2, "%" PRIu64 " unicast packets sent, expected >= %i\n",
				   total_unicast_tx_iso_packet_count, PASS_THRESHOLD);

		if (total_unicast_rx_iso_packet_count < PASS_THRESHOLD ||
		    total_unicast_tx_iso_packet_count < PASS_THRESHOLD) {
			FAIL("cap_initiator unicast FAILED (Did not pass after %d seconds)\n ",
			     WAIT_TIME);
			return;
		}
	}

	if (IS_ENABLED(CONFIG_SAMPLE_BROADCAST)) {
		extern uint64_t total_broadcast_tx_iso_packet_count;

		bs_trace_info_time(2, "%" PRIu64 " broadcast packets sent, expected >= %i\n",
				   total_broadcast_tx_iso_packet_count, PASS_THRESHOLD);

		if (total_broadcast_tx_iso_packet_count < PASS_THRESHOLD) {
			FAIL("cap_initiator broadcast FAILED (Did not pass after %d seconds)\n ",
			     WAIT_TIME);
			return;
		}
	}

	PASS("cap_initiator PASSED\n");
}

static const struct bst_test_instance test_sample[] = {
	{
		.test_id = "cap_initiator",
		.test_descr = "Test based on the unicast client sample. "
			      "It expects to be connected to a compatible unicast server, "
			      "waits for " STR(WAIT_TIME) " seconds, and checks how "
			      "many audio packets have been received correctly",
		.test_post_init_f = test_cap_initiator_sample_init,
		.test_tick_f = test_cap_initiator_sample_tick,
	},
	BSTEST_END_MARKER
};

/* TODO: Add test of reconnection */

struct bst_test_list *test_cap_initiator_sample_install(struct bst_test_list *tests)
{
	tests = bst_add_tests(tests, test_sample);
	return tests;
}
```

## src/test_main.c
```c
/*
 * Copyright (c) 2023-2024 Nordic Semiconductor ASA
 *
 * SPDX-License-Identifier: Apache-2.0
 */
#include <stddef.h>

#include <bstests.h>

extern struct bst_test_list *test_cap_initiator_sample_install(struct bst_test_list *tests);

bst_test_install_t test_installers[] = {test_cap_initiator_sample_install, NULL};
```
