## CMakeLists.txt
```
# SPDX-License-Identifier: Apache-2.0

cmake_minimum_required(VERSION 3.28.0)

find_package(Zephyr REQUIRED HINTS $ENV{ZEPHYR_BASE})
project(bap_unicast_client_self_tests)

set(unicast_client_path ${ZEPHYR_BASE}/samples/bluetooth/audio/bap_unicast_client)

target_sources(app PRIVATE
  ${unicast_client_path}/src/main.c
)

zephyr_sources_ifdef(CONFIG_LIBLC3 ${unicast_client_path}/src/stream_lc3.c)
zephyr_sources_ifdef(CONFIG_BT_AUDIO_TX ${unicast_client_path}/src/stream_tx.c)

target_sources(app PRIVATE
  src/unicast_client_sample_test.c
  src/test_main.c
)

zephyr_library_include_directories(${ZEPHYR_BASE}/samples/bluetooth)

zephyr_include_directories(
  ${BSIM_COMPONENTS_PATH}/libUtilv1/src/
  ${BSIM_COMPONENTS_PATH}/libPhyComv1/src/
  )
```

## Kconfig
```
# Copyright (c) 2024 Nordic Semiconductor ASA
# SPDX-License-Identifier: Apache-2.0

source "${ZEPHYR_BASE}/samples/bluetooth/audio/bap_unicast_client/Kconfig"
```

## Kconfig.sysbuild
```
# Copyright (c) 2023 Nordic Semiconductor ASA
# SPDX-License-Identifier: Apache-2.0

source "$(ZEPHYR_BASE)/samples/bluetooth/audio/bap_unicast_client/Kconfig.sysbuild"

config NATIVE_SIMULATOR_PRIMARY_MCU_INDEX
	int
	# Let's pass the test arguments to the application MCU test
	# otherwise by default they would have gone to the net core.
	default 0 if $(BOARD_TARGET_STRING) = "NRF5340BSIM_NRF5340_CPUAPP"
```

## prj.conf
```kconfig
# Please build using the sample configuration file:
# ${ZEPHYR_BASE}/samples/bluetooth/audio/bap_unicast_client/prj.conf
```

## boards/nrf5340bsim_nrf5340_cpuapp.conf
```kconfig
# This file content is just a copy of the equivalent one in the unicast client sample

# For LC3 the following configs are needed
CONFIG_FPU=y
CONFIG_LIBLC3=y

CONFIG_BT_BUF_EVT_RX_SIZE=255
CONFIG_BT_BUF_ACL_RX_SIZE=255
CONFIG_BT_BUF_ACL_TX_SIZE=251
CONFIG_BT_BUF_CMD_TX_SIZE=255
```

## src/test_main.c
```c
/*
 * Copyright (c) 2023 Nordic Semiconductor ASA
 *
 * SPDX-License-Identifier: Apache-2.0
 */
#include <stddef.h>

#include "bstests.h"

extern struct bst_test_list *test_unicast_client_sample_install(struct bst_test_list *tests);

bst_test_install_t test_installers[] = {
	test_unicast_client_sample_install,
	NULL
};
```

## src/unicast_client_sample_test.c
```c
/*
 * Copyright (c) 2023 Nordic Semiconductor ASA
 * Copyright (c) 2017-2019 Oticon A/S
 *
 * SPDX-License-Identifier: Apache-2.0
 */
#include <inttypes.h>
#include <stdint.h>

#include <zephyr/toolchain.h>

#include "bs_types.h"
#include "bs_tracing.h"
#include "bs_utils.h"
#include "bstests.h"

#define WAIT_TIME 20 /* Seconds */

#define PASS_THRESHOLD 100 /* Audio packets */

extern enum bst_result_t bst_result;

#define FAIL(...)					\
	do {						\
		bst_result = Failed;			\
		bs_trace_error_time_line(__VA_ARGS__);	\
	} while (0)

#define PASS(...)					\
	do {						\
		bst_result = Passed;			\
		bs_trace_info_time(1, __VA_ARGS__);	\
	} while (0)

static void test_unicast_client_sample_init(void)
{
	/* We set an absolute deadline in 30 seconds */
	bst_ticker_set_next_tick_absolute(WAIT_TIME*1e6);
	bst_result = In_progress;
}

static void test_unicast_client_sample_tick(bs_time_t HW_device_time)
{
	ARG_UNUSED(HW_device_time);

	/*
	 * If in WAIT_TIME seconds we did not get enough packets through
	 * we consider the test failed
	 */

	extern uint64_t unicast_audio_recv_ctr;

	bs_trace_info_time(2, "%"PRIu64" packets received, expected >= %i\n",
			   unicast_audio_recv_ctr, PASS_THRESHOLD);

	if (unicast_audio_recv_ctr >= PASS_THRESHOLD) {
		PASS("unicast_client PASSED\n");
		bs_trace_exit("Done, disconnecting from simulation\n");
	} else {
		FAIL("unicast_client FAILED (Did not pass after %i seconds)\n",
		     WAIT_TIME);
	}
}

static const struct bst_test_instance test_sample[] = {
	{
		.test_id = "unicast_client",
		.test_descr = "Test based on the unicast client sample. "
			      "It expects to be connected to a compatible unicast server, "
			      "waits for " STR(WAIT_TIME) " seconds, and checks how "
			      "many audio packets have been received correctly",
		.test_pre_init_f = test_unicast_client_sample_init,
		.test_tick_f = test_unicast_client_sample_tick,
	},
	BSTEST_END_MARKER
};

struct bst_test_list *test_unicast_client_sample_install(struct bst_test_list *tests)
{
	tests = bst_add_tests(tests, test_sample);
	return tests;
}
```
