## CMakeLists.txt
```
# SPDX-License-Identifier: Apache-2.0

cmake_minimum_required(VERSION 3.20.0)

find_package(Zephyr REQUIRED HINTS $ENV{ZEPHYR_BASE})
project(ccp_client_self_tets)

set(ccp_client_path ${ZEPHYR_BASE}/samples/bluetooth/ccp_client)

target_sources(app PRIVATE
  ${ccp_client_path}/src/main.c
)

target_sources(app PRIVATE
	src/test_main.c
)

zephyr_library_include_directories(${ZEPHYR_BASE}/samples/bluetooth)

zephyr_include_directories(
  ${BSIM_COMPONENTS_PATH}/libUtilv1/src/
  ${BSIM_COMPONENTS_PATH}/libPhyComv1/src/
  )
```

## Kconfig.sysbuild
```
# Copyright (c) 2023-2024 Nordic Semiconductor ASA
# SPDX-License-Identifier: Apache-2.0

source "${ZEPHYR_BASE}/samples/bluetooth/ccp_client/Kconfig.sysbuild"

config NATIVE_SIMULATOR_PRIMARY_MCU_INDEX
	int
	# Let's pass the test arguments to the application MCU test
	# otherwise by default they would have gone to the net core.
	default 0 if $(BOARD_TARGET_STRING) = "NRF5340BSIM_NRF5340_CPUAPP"
```

## prj.conf
```kconfig
# Please build using the sample configuration file:
# ${ZEPHYR_BASE}/samples/bluetooth/ccp_client/prj.conf
```

## src/test_main.c
```c
/*
 * Copyright (c) 2024 Nordic Semiconductor ASA
 *
 * SPDX-License-Identifier: Apache-2.0
 */

#include <inttypes.h>
#include <stddef.h>
#include <stdint.h>

#include "bs_types.h"
#include "bs_tracing.h"
#include "bs_utils.h"
#include "bstests.h"

#define WAIT_TIME 10 /* Seconds */

extern enum bst_result_t bst_result;

#define FAIL(...)                                                                                  \
	do {                                                                                       \
		bst_result = Failed;                                                               \
		bs_trace_error_time_line(__VA_ARGS__);                                             \
	} while (0)

#define PASS(...)                                                                                  \
	do {                                                                                       \
		bst_result = Passed;                                                               \
		bs_trace_info_time(1, __VA_ARGS__);                                                \
	} while (0)

static void test_ccp_client_sample_init(void)
{
	bst_ticker_set_next_tick_absolute(WAIT_TIME * 1e6);
	bst_result = In_progress;
}

static void test_ccp_client_sample_tick(bs_time_t HW_device_time)
{
	extern struct bt_ccp_client *client;

	/* If discovery was a success then client is non-NULL - Use as pass criteria */
	if (client == NULL) {
		FAIL("CCP client sample FAILED (Did not pass after %i seconds)\n", WAIT_TIME);
	} else {
		PASS("CCP client sample PASSED\n");
	}
}

static const struct bst_test_instance test_sample[] = {
	{
		.test_id = "ccp_client",
		.test_descr = "Test based on the CCP client sample. "
			      "It expects to be connected to a compatible CCP server, "
			      "waits for " STR(WAIT_TIME) " seconds, and checks how "
			      "many audio packets have been received correctly",
		.test_post_init_f = test_ccp_client_sample_init,
		.test_tick_f = test_ccp_client_sample_tick,
	},
	BSTEST_END_MARKER,
};

static struct bst_test_list *test_ccp_client_sample_install(struct bst_test_list *tests)
{
	tests = bst_add_tests(tests, test_sample);
	return tests;
}

bst_test_install_t test_installers[] = {test_ccp_client_sample_install, NULL};
```
