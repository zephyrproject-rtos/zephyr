## CMakeLists.txt
```
# SPDX-License-Identifier: Apache-2.0

cmake_minimum_required(VERSION 3.28.0)

find_package(Zephyr REQUIRED HINTS $ENV{ZEPHYR_BASE})
project(bsim_test_uart_bt)

add_subdirectory(${ZEPHYR_BASE}/tests/bluetooth/common/testlib testlib)
target_link_libraries(app PRIVATE testlib)

add_subdirectory(${ZEPHYR_BASE}/tests/bsim/babblekit babblekit)
target_link_libraries(app PRIVATE babblekit)

file(GLOB app_sources src/*.c)
target_sources(app PRIVATE ${app_sources})

zephyr_include_directories(
  ${BSIM_COMPONENTS_PATH}/libUtilv1/src/
  ${BSIM_COMPONENTS_PATH}/libPhyComv1/src/
  )
```

## prj.conf
```kconfig
# SPDX-License-Identifier: Apache-2.0

CONFIG_BT=y
CONFIG_BT_DEVICE_NAME="uart_bt tester"
CONFIG_BT_PERIPHERAL=y
CONFIG_BT_CENTRAL=y
CONFIG_BT_EXT_ADV=y
CONFIG_BT_GATT_CLIENT=y
CONFIG_BT_GATT_AUTO_DISCOVER_CCC=y
CONFIG_BT_ZEPHYR_NUS=y

CONFIG_SERIAL=y
CONFIG_UART_BT=y

CONFIG_ASSERT=y
```

## app.overlay
```dts
/*
 * SPDX-FileCopyrightText: Copyright The Zephyr Project Contributors
 * SPDX-License-Identifier: Apache-2.0
 */

/ {
	nus_uart: nus-uart {
		compatible = "zephyr,nus-uart";
		tx-fifo-size = <32>;
		rx-fifo-size = <32>;
	};
};
```

## src/main.c
```c
/*
 * SPDX-FileCopyrightText: Copyright The Zephyr Project Contributors
 * SPDX-License-Identifier: Apache-2.0
 */

#include "bstests.h"

extern struct bst_test_list *test_dut_install(struct bst_test_list *tests);
extern struct bst_test_list *test_peer_install(struct bst_test_list *tests);

bst_test_install_t test_installers[] = {
	test_dut_install,
	test_peer_install,
	NULL
};

int main(void)
{
	bst_main();
	return 0;
}
```

## src/common.h
```c
/*
 * SPDX-FileCopyrightText: Copyright The Zephyr Project Contributors
 * SPDX-License-Identifier: Apache-2.0
 */

#ifndef ZEPHYR_TESTS_BSIM_BLUETOOTH_HOST_MISC_UART_BT_SRC_COMMON_H_
#define ZEPHYR_TESTS_BSIM_BLUETOOTH_HOST_MISC_UART_BT_SRC_COMMON_H_

#include <zephyr/devicetree.h>
#include <zephyr/toolchain.h>

#define TX_FIFO_SIZE DT_PROP(DT_NODELABEL(nus_uart), tx_fifo_size)

/* Written by the DUT before any peer is subscribed. Longer than the TX FIFO,
 * so the writer finishes only if the driver drops what does not fit, and the
 * first subscriber receives the first TX_FIFO_SIZE bytes of it.
 */
#define UNSUBSCRIBED_MSG "unsubscribed-unsubscribed-unsubscribed-unsubscribed-unsubscribed-"
BUILD_ASSERT(sizeof(UNSUBSCRIBED_MSG) - 1 > TX_FIFO_SIZE);

#define SUBSCRIBED_MSG "subscribed"

#endif /* ZEPHYR_TESTS_BSIM_BLUETOOTH_HOST_MISC_UART_BT_SRC_COMMON_H_ */
```

## src/dut.c
```c
/*
 * SPDX-FileCopyrightText: Copyright The Zephyr Project Contributors
 * SPDX-License-Identifier: Apache-2.0
 */

#include <string.h>

#include <zephyr/kernel.h>
#include <zephyr/device.h>
#include <zephyr/drivers/uart.h>

#include <zephyr/bluetooth/bluetooth.h>
#include <zephyr/bluetooth/conn.h>

#include "testlib/adv.h"
#include "testlib/conn.h"

#include "babblekit/testcase.h"
#include "babblekit/flags.h"
#include "babblekit/sync.h"
#include "common.h"

DEFINE_FLAG_STATIC(flag_tx_done);

static const struct device *const uart_dev = DEVICE_DT_GET(DT_NODELABEL(nus_uart));

static const uint8_t *tx_buf;
static size_t tx_len;
static size_t tx_pos;

static void uart_cb(const struct device *dev, void *user_data)
{
	int n;

	if (uart_irq_tx_ready(dev) == 0) {
		return;
	}

	if (tx_pos == tx_len) {
		uart_irq_tx_disable(dev);
		SET_FLAG(flag_tx_done);
		return;
	}

	n = uart_fifo_fill(dev, &tx_buf[tx_pos], tx_len - tx_pos);
	if (n < 0) {
		TEST_FAIL("Failed to fill the TX FIFO (err %d)", n);
		return;
	}

	tx_pos += (size_t)n;
}

static void write_irq(const char *msg)
{
	tx_buf = (const uint8_t *)msg;
	tx_len = strlen(msg);
	tx_pos = 0;
	UNSET_FLAG(flag_tx_done);

	uart_irq_tx_enable(uart_dev);
}

static void dut_init(void)
{
	int err;

	TEST_ASSERT(device_is_ready(uart_dev), "UART over NUS device not ready");
	TEST_ASSERT(bk_sync_init() == 0, "Failed to open backchannel");

	err = uart_irq_callback_user_data_set(uart_dev, uart_cb, NULL);
	TEST_ASSERT(err == 0, "Failed to set UART callback (err %d)", err);

	err = bt_enable(NULL);
	TEST_ASSERT(err == 0, "Bluetooth init failed (err %d)", err);
}

static void advertise_and_wait_for_connection(void)
{
	struct bt_conn *conn = NULL;
	int err;

	err = bt_testlib_adv_conn(&conn, BT_ID_DEFAULT, bt_get_name());
	TEST_ASSERT(err == 0, "Failed to advertise and connect (err %d)", err);

	bt_testlib_conn_unref(&conn);
}

static void test_main(void)
{
	dut_init();

	write_irq(UNSUBSCRIBED_MSG);
	WAIT_FOR_FLAG(flag_tx_done);

	advertise_and_wait_for_connection();

	/* The peer has subscribed to the NUS TX characteristic. */
	bk_sync_wait();

	write_irq(SUBSCRIBED_MSG);
	WAIT_FOR_FLAG(flag_tx_done);

	/* The peer has checked what it received. */
	bk_sync_wait();

	TEST_PASS("DUT passed");
}

static const struct bst_test_instance test_dut[] = {
	{
		.test_id = "uart_bt_dut",
		.test_main_f = test_main,
	},
	BSTEST_END_MARKER
};

struct bst_test_list *test_dut_install(struct bst_test_list *tests)
{
	return bst_add_tests(tests, test_dut);
}
```

## src/peer.c
```c
/*
 * SPDX-FileCopyrightText: Copyright The Zephyr Project Contributors
 * SPDX-License-Identifier: Apache-2.0
 */

#include <string.h>

#include <zephyr/kernel.h>

#include <zephyr/bluetooth/att.h>
#include <zephyr/bluetooth/bluetooth.h>
#include <zephyr/bluetooth/conn.h>
#include <zephyr/bluetooth/gatt.h>
#include <zephyr/bluetooth/uuid.h>
#include <zephyr/bluetooth/services/nus.h>

#include "testlib/att_read.h"
#include "testlib/conn.h"
#include "testlib/scan.h"

#include "babblekit/testcase.h"
#include "babblekit/flags.h"
#include "babblekit/sync.h"
#include "common.h"

DEFINE_FLAG_STATIC(flag_subscribed);

static struct bt_conn *g_conn;
static struct bt_gatt_subscribe_params subscribe_params;

#define RX_BUF_SIZE (TX_FIFO_SIZE + sizeof(SUBSCRIBED_MSG))

static char rx_buf[RX_BUF_SIZE];
static atomic_t rx_len;

static uint8_t notify_cb(struct bt_conn *conn, struct bt_gatt_subscribe_params *params,
			 const void *data, uint16_t length)
{
	size_t len = (size_t)atomic_get(&rx_len);

	if (data == NULL) {
		return BT_GATT_ITER_STOP;
	}

	TEST_ASSERT(len + length <= sizeof(rx_buf), "Received %zu bytes, more than expected",
		    len + length);

	(void)memcpy(&rx_buf[len], data, length);
	(void)atomic_add(&rx_len, length);

	return BT_GATT_ITER_CONTINUE;
}

static void subscribed_cb(struct bt_conn *conn, uint8_t err,
			  struct bt_gatt_subscribe_params *params)
{
	TEST_ASSERT(err == 0, "Subscribe failed (err %u)", err);

	SET_FLAG(flag_subscribed);
}

static void connect_and_subscribe(void)
{
	static struct bt_gatt_discover_params ccc_discover_params;
	bt_addr_le_t dut_addr;
	uint16_t tx_chrc_value_handle;
	int err;

	UNSET_FLAG(flag_subscribed);

	err = bt_testlib_scan_find_name(&dut_addr, CONFIG_BT_DEVICE_NAME);
	TEST_ASSERT(err == 0, "Failed to find the DUT (err %d)", err);

	err = bt_testlib_connect(&dut_addr, &g_conn);
	TEST_ASSERT(err == 0, "Failed to connect to the DUT (err %d)", err);

	err = bt_testlib_gatt_discover_characteristic(&tx_chrc_value_handle, NULL, NULL, g_conn,
						      BT_UUID_DECLARE_128(BT_UUID_NUS_TX_CHAR_VAL),
						      BT_ATT_FIRST_ATTRIBUTE_HANDLE,
						      BT_ATT_LAST_ATTRIBUTE_HANDLE);
	TEST_ASSERT(err == 0, "NUS TX characteristic not found (err %d)", err);

	(void)memset(&subscribe_params, 0, sizeof(subscribe_params));
	subscribe_params.value_handle = tx_chrc_value_handle;
	subscribe_params.ccc_handle = BT_GATT_AUTO_DISCOVER_CCC_HANDLE;
	subscribe_params.end_handle = BT_ATT_LAST_ATTRIBUTE_HANDLE;
	subscribe_params.disc_params = &ccc_discover_params;
	subscribe_params.value = BT_GATT_CCC_NOTIFY;
	subscribe_params.notify = notify_cb;
	subscribe_params.subscribe = subscribed_cb;

	err = bt_gatt_subscribe(g_conn, &subscribe_params);
	TEST_ASSERT(err == 0, "Subscribe failed (err %d)", err);

	WAIT_FOR_FLAG(flag_subscribed);
}

static void expect_rx(const char *msg)
{
	const size_t expected_len = strlen(msg);

	while ((size_t)atomic_get(&rx_len) < expected_len) {
		(void)k_sleep(K_MSEC(10));
	}

	/* Leave room for anything the DUT should not have sent. */
	(void)k_sleep(K_MSEC(500));

	TEST_ASSERT((size_t)atomic_get(&rx_len) == expected_len &&
		    memcmp(rx_buf, msg, expected_len) == 0,
		    "Received \"%.*s\", expected \"%s\"",
		    (int)atomic_get(&rx_len), rx_buf, msg);

	(void)atomic_set(&rx_len, 0);
}

static void peer_init(void)
{
	int err;

	TEST_ASSERT(bk_sync_init() == 0, "Failed to open backchannel");

	err = bt_enable(NULL);
	TEST_ASSERT(err == 0, "Bluetooth init failed (err %d)", err);
}

static void test_main(void)
{
	char expected[RX_BUF_SIZE];

	(void)memcpy(expected, UNSUBSCRIBED_MSG, TX_FIFO_SIZE);
	(void)memcpy(&expected[TX_FIFO_SIZE], SUBSCRIBED_MSG, sizeof(SUBSCRIBED_MSG));

	peer_init();
	connect_and_subscribe();
	bk_sync_send();

	expect_rx(expected);
	bk_sync_send();

	TEST_PASS("Peer passed");
}

static const struct bst_test_instance test_peer[] = {
	{
		.test_id = "uart_bt_peer",
		.test_main_f = test_main,
	},
	BSTEST_END_MARKER
};

struct bst_test_list *test_peer_install(struct bst_test_list *tests)
{
	return bst_add_tests(tests, test_peer);
}
```
