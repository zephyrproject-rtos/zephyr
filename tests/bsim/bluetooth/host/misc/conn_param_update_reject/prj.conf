## CMakeLists.txt
```
# SPDX-License-Identifier: Apache-2.0

cmake_minimum_required(VERSION 3.28.0)

find_package(Zephyr REQUIRED HINTS $ENV{ZEPHYR_BASE})
project(bsim_test_conn_param_update_reject)

add_subdirectory(${ZEPHYR_BASE}/tests/bsim/babblekit babblekit)
target_link_libraries(app PRIVATE babblekit)

FILE(GLOB app_sources src/*.c)
target_sources(app PRIVATE ${app_sources} )

zephyr_include_directories(
  ${BSIM_COMPONENTS_PATH}/libUtilv1/src/
  ${BSIM_COMPONENTS_PATH}/libPhyComv1/src/
  )

add_subdirectory(${ZEPHYR_BASE}/tests/bluetooth/common/testlib testlib)
target_link_libraries(app PRIVATE testlib)
```

## prj.conf
```kconfig
CONFIG_ASSERT=y
CONFIG_BT=y
CONFIG_BT_DEVICE_NAME="param reject"
CONFIG_BT_PERIPHERAL=y
CONFIG_BT_CENTRAL=y
CONFIG_BT_USER_CONN_PARAM_REJECTED=y
```

## src/main.c
```c
/*
 * Verify the behaviour of the le_param_update_rejected connection callback.
 *
 * Scenario "peripheral" / "central":
 *   The peripheral (DUT) registers the callback and requests an
 *   application-initiated parameter update. The central rejects every parameter
 *   request via le_param_req, which results in the rejection being reported to
 *   the DUT either through the HCI Connection Parameter Request procedure or
 *   through the L2CAP CPUP fallback. The DUT verifies that the callback fires.
 *
 * Scenario "peripheral_auto" / "central":
 *   The peripheral does NOT request an update itself; instead the host
 *   auto-initiates one (CONFIG_BT_GAP_AUTO_UPDATE_CONN_PARAMS) which the central
 *   rejects. The DUT verifies that the rejection callback is NOT invoked, since
 *   it is only meant for application-initiated updates.
 *
 * Copyright (c) 2026 Sharon Lin
 *
 * SPDX-License-Identifier: Apache-2.0
 */

#include "babblekit/testcase.h"

void test_peripheral_main(void);
void test_peripheral_auto_main(void);
void test_central_main(void);

static const struct bst_test_instance test_def[] = {
	{
		.test_id = "peripheral",
		.test_descr = "DUT peripheral requesting a rejected parameter update",
		.test_main_f = test_peripheral_main,
	},
	{
		.test_id = "peripheral_auto",
		.test_descr = "DUT peripheral whose host-initiated update is rejected",
		.test_main_f = test_peripheral_auto_main,
	},
	{
		.test_id = "central",
		.test_descr = "Central rejecting the parameter update",
		.test_main_f = test_central_main,
	},
	BSTEST_END_MARKER,
};

struct bst_test_list *test_conn_param_update_reject_install(struct bst_test_list *tests)
{
	return bst_add_tests(tests, test_def);
}

bst_test_install_t test_installers[] = {test_conn_param_update_reject_install, NULL};

int main(void)
{
	bst_main();
	return 0;
}
```

## src/central.c
```c
/*
 * Central (tester) side of the conn_param_update_reject bsim test.
 *
 * Copyright (c) 2026 Sharon Lin
 *
 * SPDX-License-Identifier: Apache-2.0
 */

#include <stddef.h>
#include <errno.h>
#include <zephyr/kernel.h>
#include <zephyr/types.h>
#include <zephyr/bluetooth/bluetooth.h>
#include <zephyr/bluetooth/hci.h>
#include <zephyr/bluetooth/conn.h>

#include <testlib/conn.h>
#include "babblekit/testcase.h"
#include "babblekit/flags.h"
#include "babblekit/sync.h"

DEFINE_FLAG_STATIC(flag_is_connected);
DEFINE_FLAG_STATIC(flag_param_req_received);

static struct bt_conn *g_conn;

static void connected(struct bt_conn *conn, uint8_t err)
{
	if (err != 0) {
		TEST_FAIL("Failed to connect to %s (%u)", bt_conn_dst_str(conn), err);
		return;
	}

	printk("Connected to %s\n", bt_conn_dst_str(conn));

	__ASSERT_NO_MSG(g_conn == NULL);
	g_conn = bt_conn_ref(conn);
	SET_FLAG(flag_is_connected);
}

static void disconnected(struct bt_conn *conn, uint8_t reason)
{
	if (conn != g_conn) {
		return;
	}

	printk("Disconnected: %s (reason 0x%02x)\n", bt_conn_dst_str(conn), reason);

	bt_conn_drop(&g_conn);
	UNSET_FLAG(flag_is_connected);
}

static bool le_param_req(struct bt_conn *conn, struct bt_le_conn_param *param)
{
	printk("Rejecting connection parameter update request from %s\n", bt_conn_dst_str(conn));

	SET_FLAG(flag_param_req_received);

	return false;
}

static struct bt_conn_cb tester_callbacks = {
	.connected = connected,
	.disconnected = disconnected,
	.le_param_req = le_param_req,
};

static void device_found(const bt_addr_le_t *addr, int8_t rssi, uint8_t type,
			 struct net_buf_simple *ad)
{
	int err;
	struct bt_conn *conn;

	if (g_conn != NULL) {
		return;
	}

	if (type != BT_HCI_ADV_IND && type != BT_HCI_ADV_DIRECT_IND) {
		return;
	}

	printk("Device found: %s (RSSI %d)\n", bt_addr_le_str(addr), rssi);

	err = bt_le_scan_stop();
	if (err != 0) {
		TEST_FAIL("Could not stop scan: %d", err);
		return;
	}

	err = bt_conn_le_create(addr, BT_CONN_LE_CREATE_CONN, BT_LE_CONN_PARAM_DEFAULT, &conn);
	if (err != 0) {
		TEST_FAIL("Could not connect to peer: %d", err);
		return;
	}

	bt_conn_unref(conn);
}

void test_central_main(void)
{
	int err;

	err = bt_enable(NULL);
	if (err != 0) {
		TEST_FAIL("Bluetooth init failed (err %d)", err);
		return;
	}

	err = bk_sync_init();
	if (err != 0) {
		TEST_FAIL("Failed to initialize backchannel (err %d)", err);
		return;
	}

	err = bt_conn_cb_register(&tester_callbacks);
	__ASSERT_NO_MSG(err == 0);

	err = bt_le_scan_start(BT_LE_SCAN_PASSIVE, device_found);
	if (err != 0) {
		TEST_FAIL("Scanning failed to start (err %d)", err);
		return;
	}

	WAIT_FOR_FLAG(flag_is_connected);

	/* Wait for the peripheral to finish its test */
	bk_sync_wait();

	if (!IS_FLAG_SET(flag_param_req_received)) {
		TEST_FAIL("Central never received a parameter update request");
		return;
	}

	TEST_PASS("Central rejected the connection parameter update");
}
```

## src/dut.c
```c
/*
 * DUT (peripheral) side of the conn_param_update_reject bsim test.
 *
 * Copyright (c) 2026 Sharon Lin
 *
 * SPDX-License-Identifier: Apache-2.0
 */

#include <stddef.h>
#include <errno.h>
#include <zephyr/kernel.h>
#include <zephyr/types.h>
#include <zephyr/bluetooth/bluetooth.h>
#include <zephyr/bluetooth/hci.h>
#include <zephyr/bluetooth/conn.h>

#include <testlib/conn.h>
#include "babblekit/testcase.h"
#include "babblekit/flags.h"
#include "babblekit/sync.h"

DEFINE_FLAG_STATIC(flag_is_connected);
DEFINE_FLAG_STATIC(flag_param_rejected);

static struct bt_conn *g_conn;

static void connected(struct bt_conn *conn, uint8_t err)
{
	if (err != 0) {
		TEST_FAIL("Failed to connect to %s (%u)", bt_conn_dst_str(conn), err);
		return;
	}

	printk("Connected to %s\n", bt_conn_dst_str(conn));

	__ASSERT_NO_MSG(g_conn == NULL);
	g_conn = bt_conn_ref(conn);
	SET_FLAG(flag_is_connected);
}

static void disconnected(struct bt_conn *conn, uint8_t reason)
{
	if (conn != g_conn) {
		return;
	}

	printk("Disconnected: %s (reason 0x%02x)\n", bt_conn_dst_str(conn), reason);

	bt_conn_drop(&g_conn);
	UNSET_FLAG(flag_is_connected);
}

static void le_param_update_rejected(struct bt_conn *conn, uint8_t hci_err)
{
	printk("Connection parameter update rejected, hci_err 0x%02x\n", hci_err);

	if (hci_err == 0) {
		TEST_FAIL("Rejection reported with a success status");
		return;
	}

	SET_FLAG(flag_param_rejected);
}

static struct bt_conn_cb dut_callbacks = {
	.connected = connected,
	.disconnected = disconnected,
	.le_param_update_rejected = le_param_update_rejected,
};

void test_peripheral_main(void)
{
	int err;
	const struct bt_data ad[] = {
		BT_DATA_BYTES(BT_DATA_FLAGS, (BT_LE_AD_GENERAL | BT_LE_AD_NO_BREDR))};
	struct bt_le_conn_param *param = BT_LE_CONN_PARAM(0x0028, 0x0038, 0, 400);

	err = bt_enable(NULL);
	if (err != 0) {
		TEST_FAIL("Bluetooth init failed (err %d)", err);
		return;
	}

	err = bk_sync_init();
	if (err != 0) {
		TEST_FAIL("Failed to initialize backchannel (err %d)", err);
		return;
	}

	err = bt_conn_cb_register(&dut_callbacks);
	__ASSERT_NO_MSG(err == 0);

	err = bt_le_adv_start(BT_LE_ADV_CONN_FAST_1, ad, ARRAY_SIZE(ad), NULL, 0);
	if (err != 0) {
		TEST_FAIL("Advertising failed to start (err %d)", err);
		return;
	}

	WAIT_FOR_FLAG(flag_is_connected);

	/* Give the feature exchange time to complete before requesting an update */
	k_sleep(K_SECONDS(1));

	err = bt_conn_le_param_update(g_conn, param);
	if (err != 0) {
		TEST_FAIL("Parameter update request failed (err %d)", err);
		return;
	}

	WAIT_FOR_FLAG(flag_param_rejected);

	bk_sync_send();
	TEST_PASS("Peripheral received connection parameter update rejection");
}

void test_peripheral_auto_main(void)
{
	int err;
	const struct bt_data ad[] = {
		BT_DATA_BYTES(BT_DATA_FLAGS, (BT_LE_AD_GENERAL | BT_LE_AD_NO_BREDR))};

	err = bt_enable(NULL);
	if (err != 0) {
		TEST_FAIL("Bluetooth init failed (err %d)", err);
		return;
	}

	err = bk_sync_init();
	if (err != 0) {
		TEST_FAIL("Failed to initialize backchannel (err %d)", err);
		return;
	}

	err = bt_conn_cb_register(&dut_callbacks);
	__ASSERT_NO_MSG(err == 0);

	err = bt_le_adv_start(BT_LE_ADV_CONN_FAST_1, ad, ARRAY_SIZE(ad), NULL, 0);
	if (err != 0) {
		TEST_FAIL("Advertising failed to start (err %d)", err);
		return;
	}

	WAIT_FOR_FLAG(flag_is_connected);

	/* The host auto-initiates a parameter update around 5 seconds after
	 * connecting (CONFIG_BT_GAP_AUTO_UPDATE_CONN_PARAMS). Wait long enough for
	 * it to be sent and rejected by the central, then verify the rejection
	 * callback was NOT invoked: it is only meant for application-initiated
	 * updates.
	 */
	k_sleep(K_SECONDS(8));

	if (IS_FLAG_SET(flag_param_rejected)) {
		TEST_FAIL("Rejection callback fired for a host-initiated update");
		return;
	}

	bk_sync_send();
	TEST_PASS("Host-initiated update rejection did not trigger the callback");
}
```
