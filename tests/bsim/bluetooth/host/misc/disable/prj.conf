## CMakeLists.txt
```
# SPDX-License-Identifier: Apache-2.0

cmake_minimum_required(VERSION 3.28.0)

find_package(Zephyr REQUIRED HINTS $ENV{ZEPHYR_BASE})
project(bsim_test_disable)

FILE(GLOB app_sources src/*.c)
target_sources(app PRIVATE ${app_sources} )

zephyr_include_directories(
  ${BSIM_COMPONENTS_PATH}/libUtilv1/src/
  ${BSIM_COMPONENTS_PATH}/libPhyComv1/src/
  )

add_subdirectory(${ZEPHYR_BASE}/tests/bluetooth/common/testlib testlib)
add_subdirectory(${ZEPHYR_BASE}/tests/bsim/babblekit babblekit)
target_link_libraries(app PRIVATE
  testlib
  babblekit
)
```

## prj.conf
```kconfig
CONFIG_ASSERT=y
CONFIG_BT=y
CONFIG_BT_DEVICE_NAME="GATT tester"
CONFIG_BT_PERIPHERAL=y
CONFIG_BT_CENTRAL=y
CONFIG_BT_GATT_CLIENT=y
CONFIG_BT_ATT_PREPARE_COUNT=3
```

## src/main.c
```c
/*
 * Copyright (c) 2022 Nordic Semiconductor
 *
 * SPDX-License-Identifier: Apache-2.0
 */

#include "bstests.h"

extern struct bst_test_list *test_main_disable_install(struct bst_test_list *tests);
extern struct bst_test_list *test_gatt_server_install(struct bst_test_list *tests);
extern struct bst_test_list *test_gatt_client_install(struct bst_test_list *tests);

bst_test_install_t test_installers[] = {
	test_main_disable_install,
	test_gatt_server_install,
	test_gatt_client_install,
	NULL
};

int main(void)
{
	bst_main();
	return 0;
}
```

## src/common.h
```c
/**
 * Common functions and helpers for BSIM disable with GATT tests
 *
 * Copyright (c) 2022 Nordic Semiconductor ASA
 *
 * SPDX-License-Identifier: Apache-2.0
 */

#define CHRC_SIZE 10
#define LONG_CHRC_SIZE 40

#define TEST_SERVICE_UUID \
	BT_UUID_DECLARE_128(0x01, 0x23, 0x45, 0x67, 0x89, 0x01, 0x02, 0x03, \
			    0x04, 0x05, 0x06, 0x07, 0x08, 0x09, 0x00, 0x00)

#define TEST_CHRC_UUID \
	BT_UUID_DECLARE_128(0x01, 0x23, 0x45, 0x67, 0x89, 0x01, 0x02, 0x03, \
			    0x04, 0x05, 0x06, 0x07, 0x08, 0x09, 0xFF, 0x00)

#define TEST_LONG_CHRC_UUID \
	BT_UUID_DECLARE_128(0x01, 0x23, 0x45, 0x67, 0x89, 0x01, 0x02, 0x03, \
			    0x04, 0x05, 0x06, 0x07, 0x08, 0x09, 0xFF, 0x11)
```

## src/gatt_client_test.c
```c
/*
 * Copyright (c) 2022 Nordic Semiconductor ASA
 *
 * SPDX-License-Identifier: Apache-2.0
 */

#include <stddef.h>
#include <errno.h>
#include <zephyr/bluetooth/hci_types.h>
#include <zephyr/kernel.h>
#include <zephyr/types.h>
#include <zephyr/bluetooth/bluetooth.h>
#include <zephyr/bluetooth/hci.h>
#include <zephyr/bluetooth/conn.h>
#include <zephyr/bluetooth/uuid.h>
#include <zephyr/bluetooth/gatt.h>

#include "babblekit/testcase.h"
#include "babblekit/flags.h"
#include "common.h"

DEFINE_FLAG_STATIC(flag_is_connected);
DEFINE_FLAG_STATIC(flag_discover_complete);
DEFINE_FLAG_STATIC(flag_write_complete);
DEFINE_FLAG_STATIC(flag_read_complete);

static struct bt_conn *g_conn;
static uint16_t chrc_handle;
static uint16_t long_chrc_handle;
static const struct bt_uuid *test_svc_uuid = TEST_SERVICE_UUID;

#define NUM_ITERATIONS 10

#define ARRAY_ITEM(i, _) i
static uint8_t chrc_data[] = { LISTIFY(CHRC_SIZE, ARRAY_ITEM, (,)) }; /* 1, 2, 3 ... */
static uint8_t long_chrc_data[] = { LISTIFY(LONG_CHRC_SIZE, ARRAY_ITEM, (,)) }; /* 1, 2, 3 ... */

static void connected(struct bt_conn *conn, uint8_t err)
{
	if (err != 0) {
		TEST_FAIL("Failed to connect to %s (%u)", bt_conn_dst_str(conn), err);
		return;
	}

	printk("Connected to %s\n", bt_conn_dst_str(conn));

	g_conn = conn;
	SET_FLAG(flag_is_connected);
}

static void disconnected(struct bt_conn *conn, uint8_t reason)
{
	if (conn != g_conn) {
		return;
	}

	printk("Disconnected: %s (reason 0x%02x)\n", bt_conn_dst_str(conn), reason);

	bt_conn_drop(&g_conn);

	UNSET_FLAG(flag_is_connected);
}

static struct bt_conn_cb conn_callbacks = {
	.connected = connected,
	.disconnected = disconnected,
};

void device_found(const bt_addr_le_t *addr, int8_t rssi, uint8_t type,
		  struct net_buf_simple *ad)
{
	int err;

	if (g_conn != NULL) {
		return;
	}

	/* We're only interested in connectable events */
	if (type != BT_HCI_ADV_IND && type != BT_HCI_ADV_DIRECT_IND) {
		return;
	}

	printk("Device found: %s (RSSI %d)\n", bt_addr_le_str(addr), rssi);

	printk("Stopping scan\n");
	err = bt_le_scan_stop();
	if (err != 0) {
		TEST_FAIL("Could not stop scan: %d");
		return;
	}

	err = bt_conn_le_create(addr, BT_CONN_LE_CREATE_CONN,
				BT_LE_CONN_PARAM_DEFAULT, &g_conn);
	if (err != 0) {
		TEST_FAIL("Could not connect to peer: %d", err);
	}
}

static uint8_t discover_func(struct bt_conn *conn,
		const struct bt_gatt_attr *attr,
		struct bt_gatt_discover_params *params)
{
	int err;

	if (attr == NULL) {
		if (chrc_handle == 0 || long_chrc_handle == 0) {
			TEST_FAIL("Did not discover chrc (%x) or long_chrc (%x)", chrc_handle,
				  long_chrc_handle);
		}

		(void)memset(params, 0, sizeof(*params));

		SET_FLAG(flag_discover_complete);

		return BT_GATT_ITER_STOP;
	}

	printk("[ATTRIBUTE] handle %u\n", attr->handle);

	if (params->type == BT_GATT_DISCOVER_PRIMARY &&
	    bt_uuid_cmp(params->uuid, TEST_SERVICE_UUID) == 0) {
		printk("Found test service\n");
		params->uuid = NULL;
		params->start_handle = attr->handle + 1;
		params->type = BT_GATT_DISCOVER_CHARACTERISTIC;

		err = bt_gatt_discover(conn, params);
		if (err != 0) {
			TEST_FAIL("Discover failed (err %d)", err);
		}

		return BT_GATT_ITER_STOP;
	} else if (params->type == BT_GATT_DISCOVER_CHARACTERISTIC) {
		struct bt_gatt_chrc *chrc = (struct bt_gatt_chrc *)attr->user_data;

		if (bt_uuid_cmp(chrc->uuid, TEST_CHRC_UUID) == 0) {
			printk("Found chrc\n");
			chrc_handle = chrc->value_handle;
		} else if (bt_uuid_cmp(chrc->uuid, TEST_LONG_CHRC_UUID) == 0) {
			printk("Found long_chrc\n");
			long_chrc_handle = chrc->value_handle;
		}
	}

	return BT_GATT_ITER_CONTINUE;
}

static void gatt_discover(void)
{
	static struct bt_gatt_discover_params discover_params;
	int err;

	printk("Discovering services and characteristics\n");

	discover_params.uuid = test_svc_uuid;
	discover_params.func = discover_func;
	discover_params.start_handle = BT_ATT_FIRST_ATTRIBUTE_HANDLE;
	discover_params.end_handle = BT_ATT_LAST_ATTRIBUTE_HANDLE;
	discover_params.type = BT_GATT_DISCOVER_PRIMARY;

	err = bt_gatt_discover(g_conn, &discover_params);
	if (err != 0) {
		TEST_FAIL("Discover failed(err %d)", err);
	}

	WAIT_FOR_FLAG(flag_discover_complete);
	printk("Discover complete\n");
}

static void gatt_write_cb(struct bt_conn *conn, uint8_t err,
			  struct bt_gatt_write_params *params)
{
	if (err != BT_ATT_ERR_SUCCESS) {
		TEST_FAIL("Write failed: 0x%02X\n", err);
	}

	(void)memset(params, 0, sizeof(*params));

	SET_FLAG(flag_write_complete);
}

static void gatt_write(uint16_t handle)
{
	static struct bt_gatt_write_params write_params;
	int err;

	if (handle == chrc_handle) {
		printk("Writing to chrc\n");
		write_params.data = chrc_data;
		write_params.length = sizeof(chrc_data);
	} else if (handle) {
		printk("Writing to long_chrc\n");
		write_params.data = long_chrc_data;
		write_params.length = sizeof(long_chrc_data);
	}

	write_params.func = gatt_write_cb;
	write_params.handle = handle;

	UNSET_FLAG(flag_write_complete);

	err = bt_gatt_write(g_conn, &write_params);
	if (err != 0) {
		TEST_FAIL("bt_gatt_write failed: %d", err);
	}

	WAIT_FOR_FLAG(flag_write_complete);
	printk("success\n");
}

static uint8_t gatt_read_cb(struct bt_conn *conn, uint8_t err,
			    struct bt_gatt_read_params *params,
			    const void *data, uint16_t length)
{
	if (err != BT_ATT_ERR_SUCCESS) {
		TEST_FAIL("Read failed: 0x%02X\n", err);
	}

	if (params->single.handle == chrc_handle) {
		if (length != CHRC_SIZE || memcmp(data, chrc_data, length) != 0) {
			TEST_FAIL("chrc data different than expected", err);
		}
	} else if (params->single.handle == chrc_handle) {
		if (length != LONG_CHRC_SIZE || memcmp(data, long_chrc_data, length) != 0) {
			TEST_FAIL("long_chrc data different than expected", err);
		}
	}

	(void)memset(params, 0, sizeof(*params));

	SET_FLAG(flag_read_complete);

	return 0;
}

static void gatt_read(uint16_t handle)
{
	static struct bt_gatt_read_params read_params;
	int err;

	printk("Reading chrc\n");

	read_params.func = gatt_read_cb;
	read_params.handle_count = 1;
	read_params.single.handle = chrc_handle;
	read_params.single.offset = 0;

	UNSET_FLAG(flag_read_complete);

	err = bt_gatt_read(g_conn, &read_params);
	if (err != 0) {
		TEST_FAIL("bt_gatt_read failed: %d", err);
	}

	WAIT_FOR_FLAG(flag_read_complete);
	printk("success\n");
}

static void test_main(void)
{
	int err;

	bt_conn_cb_register(&conn_callbacks);

	for (int i = 0; i < NUM_ITERATIONS; i++) {

		err = bt_enable(NULL);
		if (err != 0) {
			TEST_FAIL("Bluetooth discover failed (err %d)", err);
		}
		printk("Bluetooth initialized\n");

		err = bt_le_scan_start(BT_LE_SCAN_PASSIVE, device_found);
		if (err != 0) {
			TEST_FAIL("Scanning failed to start (err %d)", err);
		}

		printk("Scanning successfully started\n");

		WAIT_FOR_FLAG(flag_is_connected);

		gatt_discover();

		/* Write and read a few times to ensure stateless behavior */
		for (size_t i = 0; i < 3; i++) {
			gatt_write(chrc_handle);
			gatt_read(chrc_handle);
			gatt_write(long_chrc_handle);
			gatt_read(long_chrc_handle);
		}

		err = bt_conn_disconnect(g_conn, BT_HCI_ERR_REMOTE_USER_TERM_CONN);
		if (err != 0) {
			TEST_FAIL("Disconnect failed (err %d)", err);
			return;
		}

		WAIT_FOR_FLAG_UNSET(flag_is_connected);

		err = bt_disable();
		if (err != 0) {
			TEST_FAIL("Bluetooth disable failed (err %d)", err);
		}
		printk("Bluetooth successfully disabled\n");
	}

	TEST_PASS("GATT client Passed\n");
}

static const struct bst_test_instance test_vcs[] = {
	{
		.test_id = "gatt_client",
		.test_main_f = test_main
	},
	BSTEST_END_MARKER
};

struct bst_test_list *test_gatt_client_install(struct bst_test_list *tests)
{
	return bst_add_tests(tests, test_vcs);
}
```

## src/gatt_server_test.c
```c
/*
 * Copyright (c) 2022 Nordic Semiconductor ASA
 *
 * SPDX-License-Identifier: Apache-2.0
 */

#include <stddef.h>
#include <errno.h>
#include <zephyr/kernel.h>
#include <zephyr/types.h>
#include <zephyr/bluetooth/bluetooth.h>
#include <zephyr/bluetooth/hci.h>
#include <zephyr/bluetooth/conn.h>
#include <zephyr/bluetooth/uuid.h>
#include <zephyr/bluetooth/gatt.h>

#include <babblekit/testcase.h>
#include <babblekit/flags.h>
#include "common.h"

extern enum bst_result_t bst_result;

DEFINE_FLAG_STATIC(flag_is_connected);

#define NUM_ITERATIONS 10

static void connected(struct bt_conn *conn, uint8_t err)
{
	if (err != 0) {
		TEST_FAIL("Failed to connect to %s (%u)", bt_conn_dst_str(conn), err);
		return;
	}

	printk("Connected to %s\n", bt_conn_dst_str(conn));

	SET_FLAG(flag_is_connected);
}

static void disconnected(struct bt_conn *conn, uint8_t reason)
{
	printk("Disconnected: %s (reason 0x%02x)\n", bt_conn_dst_str(conn), reason);

	UNSET_FLAG(flag_is_connected);
}

BT_CONN_CB_DEFINE(conn_callbacks) = {
	.connected = connected,
	.disconnected = disconnected,
};

static uint8_t chrc_data[CHRC_SIZE];
static uint8_t long_chrc_data[LONG_CHRC_SIZE];

static ssize_t read_test_chrc(struct bt_conn *conn,
			      const struct bt_gatt_attr *attr,
			      void *buf, uint16_t len, uint16_t offset)
{
	return bt_gatt_attr_read(conn, attr, buf, len, offset,
				 (void *)chrc_data, sizeof(chrc_data));
}

static ssize_t write_test_chrc(struct bt_conn *conn,
			       const struct bt_gatt_attr *attr,
			       const void *buf, uint16_t len,
			       uint16_t offset, uint8_t flags)
{
	printk("chrc len %u offset %u\n", len, offset);

	if (len > sizeof(chrc_data)) {
		printk("Invalid chrc length\n");
		return BT_GATT_ERR(BT_ATT_ERR_INVALID_ATTRIBUTE_LEN);
	} else if (offset + len > sizeof(chrc_data)) {
		printk("Invalid chrc offset and length\n");
		return BT_GATT_ERR(BT_ATT_ERR_INVALID_OFFSET);
	}

	if (flags != 0) {
		TEST_FAIL("Invalid flags %u", flags);
		return BT_GATT_ERR(BT_ATT_ERR_UNLIKELY);
	}

	(void)memcpy(chrc_data + offset, buf, len);

	return len;
}

static ssize_t read_long_test_chrc(struct bt_conn *conn,
				   const struct bt_gatt_attr *attr,
				   void *buf, uint16_t len, uint16_t offset)
{
	return bt_gatt_attr_read(conn, attr, buf, len, offset,
				 (void *)long_chrc_data, sizeof(long_chrc_data));
}

static ssize_t write_long_test_chrc(struct bt_conn *conn,
				    const struct bt_gatt_attr *attr,
				    const void *buf, uint16_t len,
				    uint16_t offset, uint8_t flags)
{
	static uint8_t prepare_count;

	printk("long_chrc len %u offset %u\n", len, offset);

	if (len > sizeof(long_chrc_data)) {
		printk("Invalid long_chrc length\n");
		return BT_GATT_ERR(BT_ATT_ERR_INVALID_ATTRIBUTE_LEN);
	} else if (offset + len > sizeof(long_chrc_data)) {
		printk("Invalid long_chrc offset and length\n");
		return BT_GATT_ERR(BT_ATT_ERR_INVALID_OFFSET);
	}

	if (flags & BT_GATT_WRITE_FLAG_PREPARE) {
		printk("prepare_count %u\n", prepare_count++);
		return BT_GATT_ERR(BT_ATT_ERR_SUCCESS);
	}

	(void)memcpy(long_chrc_data + offset, buf, len);
	prepare_count = 0;

	return len;
}

BT_GATT_SERVICE_DEFINE(test_svc,
	BT_GATT_PRIMARY_SERVICE(TEST_SERVICE_UUID),
	BT_GATT_CHARACTERISTIC(TEST_CHRC_UUID,
			       BT_GATT_CHRC_WRITE | BT_GATT_CHRC_READ,
			       BT_GATT_PERM_WRITE | BT_GATT_PERM_READ,
			       read_test_chrc, write_test_chrc, NULL),
	BT_GATT_CHARACTERISTIC(TEST_LONG_CHRC_UUID,
			       BT_GATT_CHRC_WRITE | BT_GATT_CHRC_READ,
			       BT_GATT_PERM_WRITE | BT_GATT_PERM_READ | BT_GATT_PERM_PREPARE_WRITE,
			       read_long_test_chrc, write_long_test_chrc, NULL),
);

static void test_main(void)
{
	int err;
	const struct bt_data ad[] = {
		BT_DATA_BYTES(BT_DATA_FLAGS, (BT_LE_AD_GENERAL | BT_LE_AD_NO_BREDR))
	};

	for (int i = 0; i < NUM_ITERATIONS; i++) {
		err = bt_enable(NULL);
		if (err != 0) {
			TEST_FAIL("Bluetooth init failed (err %d)", err);
			return;
		}

		printk("Bluetooth initialized\n");

		err = bt_le_adv_start(BT_LE_ADV_CONN_FAST_1, ad, ARRAY_SIZE(ad), NULL, 0);
		if (err != 0) {
			TEST_FAIL("Advertising failed to start (err %d)", err);
			return;
		}

		printk("Advertising successfully started\n");

		WAIT_FOR_FLAG(flag_is_connected);

		WAIT_FOR_FLAG_UNSET(flag_is_connected);

		err = bt_disable();
		if (err != 0) {
			TEST_FAIL("Bluetooth disable failed (err %d)", err);
			return;
		}

		printk("Bluetooth disabled\n");
	}

	TEST_PASS("GATT server passed");
}

static const struct bst_test_instance test_gatt_server[] = {
	{
		.test_id = "gatt_server",
		.test_main_f = test_main
	},
	BSTEST_END_MARKER
};

struct bst_test_list *test_gatt_server_install(struct bst_test_list *tests)
{
	return bst_add_tests(tests, test_gatt_server);
}
```

## src/main_disable.c
```c
/* main_disable.c - Application main entry point */

/*
 * Copyright (c) 2022 Nordic Semiconductor
 *
 * SPDX-License-Identifier: Apache-2.0
 */

#include <zephyr/bluetooth/bluetooth.h>

#define LOG_MODULE_NAME main_disable
#include <zephyr/logging/log.h>
LOG_MODULE_REGISTER(LOG_MODULE_NAME, LOG_LEVEL_DBG);

#include "babblekit/testcase.h"
#include "babblekit/flags.h"
#include "common.h"

extern enum bst_result_t bst_result;

#define NUM_ITERATIONS 35

static void test_disable_main(void)
{
	for (int i = 0; i < NUM_ITERATIONS; i++) {
		int err;

		err = bt_enable(NULL);
		if (err != 0) {
			TEST_FAIL("Enable failed (err %d)", err);
		}

		err = bt_disable();
		if (err) {
			TEST_FAIL("Enable failed (err %d)", err);
		}
	}

	TEST_PASS("Disable test passed");
}

static void test_disable_set_default_id(void)
{
	/* FIXME: Temporary workaround to get around a bug in the controller.
	 * The controller gets stuck in the POWER_CLOCK ISR without this.
	 * See open PR: https://github.com/zephyrproject-rtos/zephyr/pull/73342
	 * for more details.
	 */
	k_sleep(K_MSEC(1));

	for (int i = 0; i < NUM_ITERATIONS; i++) {
		int err;
		size_t id_count;
		bt_addr_le_t stored_id;
		bt_addr_le_t addr = {.type = BT_ADDR_LE_RANDOM,
				     .a = {.val = {i, 2, 3, 4, 5, 0xc0}}};

		err = bt_id_create(&addr, NULL);
		if (err != 0) {
			TEST_FAIL("Creating ID failed (err %d)", err);
		}

		err = bt_enable(NULL);
		if (err != 0) {
			TEST_FAIL("Enable failed (err %d)", err);
		}

		bt_id_get(NULL, &id_count);
		if (id_count != 1) {
			TEST_FAIL("Expected only one ID, but got: %u", id_count);
		}

		id_count = 1;
		bt_id_get(&stored_id, &id_count);
		if (id_count != 1) {
			TEST_FAIL("Expected only one ID, but got: %u", id_count);
		}

		if (!bt_addr_le_eq(&stored_id, &addr)) {
			TEST_FAIL("Expected stored ID to be equal to set ID: %s, %s",
				  bt_addr_le_str(&addr), bt_addr_le_str(&stored_id));
		}

		err = bt_disable();
		if (err) {
			TEST_FAIL("Enable failed (err %d)", err);
		}
	}

	TEST_PASS("Disable set default ID test passed");
}

K_SEM_DEFINE(ready_sem, 0, 1);

static void ready_cb(int err)
{
	if (err != 0) {
		TEST_FAIL("bt_enable ready callback error %d", err);
	} else {
		k_sem_give(&ready_sem);
	}
}

static void test_disable_async_init(void)
{
	/* Call bt_enable() with a ready callback so bt_init() runs
	 * asynchronously on the system workqueue. Immediately call
	 * bt_disable(); it must return -EAGAIN because init is still
	 * in progress.
	 *
	 * k_sched_lock() prevents the workqueue from running until
	 * k_sched_unlock() is called, so bt_disable() is guaranteed to
	 * observe the init work item as queued regardless of
	 * controller behavior.
	 */
	int err;

	k_sched_lock();

	err = bt_enable(ready_cb);
	if (err != 0) {
		k_sched_unlock();
		TEST_FAIL("bt_enable failed (err %d)", err);
	}

	err = bt_disable();
	k_sched_unlock();
	if (err != -EAGAIN) {
		TEST_FAIL("Expected -EAGAIN from bt_disable before init complete, got %d", err);
	}

	/* Wait for init to finish, then disable properly. */
	k_sem_take(&ready_sem, K_FOREVER);

	err = bt_disable();
	if (err != 0) {
		TEST_FAIL("bt_disable after init failed (err %d)", err);
	}

	TEST_PASS("disable async init test passed");
}

static const struct bst_test_instance test_def[] = {
	{
		.test_id = "disable",
		.test_descr = "disable_test",
		.test_main_f = test_disable_main
	},
	{
		.test_id = "disable_set_default_id",
		.test_descr = "disable_test where each iteration sets the default ID",
		.test_main_f = test_disable_set_default_id
	},
	{
		.test_id = "disable_async_init",
		.test_descr = "bt_disable during async bt_init returns -EAGAIN",
		.test_main_f = test_disable_async_init
	},
	BSTEST_END_MARKER
};

struct bst_test_list *test_main_disable_install(struct bst_test_list *tests)
{
	return bst_add_tests(tests, test_def);
}
```
