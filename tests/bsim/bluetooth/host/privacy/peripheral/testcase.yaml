## tests/bsim/bluetooth/host/privacy/peripheral/testcase.yaml
```yaml
common:
  build_only: true
  sysbuild: true
  tags:
    - bluetooth
  platform_allow:
    - nrf52_bsim/native
    - nrf5340bsim/nrf5340/cpuapp
  harness: bsim

tests:
  bluetooth.host.privacy.peripheral:
    harness_config:
      bsim_exe_name: tests_bsim_bluetooth_host_privacy_peripheral_prj_conf
  bluetooth.host.privacy.peripheral_rpa_expired:
    harness_config:
      bsim_exe_name: tests_bsim_bluetooth_host_privacy_peripheral_prj_rpa_expired_conf
    extra_args:
      EXTRA_CONF_FILE=prj_rpa_expired.conf
  bluetooth.host.privacy.peripheral_rpa_sharing:
    harness_config:
      bsim_exe_name: tests_bsim_bluetooth_host_privacy_peripheral_prj_rpa_sharing_conf
    extra_args:
      EXTRA_CONF_FILE=prj_rpa_sharing.conf
```

## tests/bsim/bluetooth/host/scan/slow/testcase.yaml
```yaml
common:
  build_only: true
  sysbuild: true
  tags:
    - bluetooth
  platform_allow:
    - nrf52_bsim/native
    - nrf5340bsim/nrf5340/cpuapp
  harness: bsim

tests:
  bluetooth.host.scan.slow:
    harness_config:
      bsim_exe_name: tests_bsim_bluetooth_host_scan_slow_prj_conf
```

## tests/bsim/bluetooth/host/scan/start_stop/testcase.yaml
```yaml
tests:
  bluetooth.host.scan.start_stop:
    build_only: true
    tags:
      - bluetooth
    platform_allow:
      - nrf52_bsim/native
    harness: bsim
    harness_config:
      bsim_exe_name: tests_bsim_bluetooth_host_scan_start_stop_prj_conf
```

## tests/bsim/bluetooth/host/security/bond_overwrite_denied/testcase.yaml
```yaml
tests:
  bluetooth.host.security.bond_overwrite_denied:
    build_only: true
    tags:
      - bluetooth
    platform_allow:
      - nrf52_bsim/native
    harness: bsim
    harness_config:
      bsim_exe_name: tests_bsim_bluetooth_host_security_bond_overwrite_denied_prj_conf
```

## tests/bsim/bluetooth/host/security/bond_per_connection/testcase.yaml
```yaml
tests:
  bluetooth.host.security.bond_per_connection:
    tags:
      - bluetooth
    platform_allow:
      - nrf52_bsim/native
    timeout: 30
    harness: bsim
    harness_config:
      bsim_exe_name: tests_bsim_bluetooth_host_security_bond_per_connection_prj_conf
      bsim_devices:
        - test_id: central
        - test_id: peripheral
      bsim_verbosity: 2
      bsim_sim_length: 60e6
      bsim_options:
        - -RealEncryption=1
```

## tests/bsim/bluetooth/host/security/ccc_update/testcase.yaml
```yaml
common:
  build_only: true
  tags:
    - bluetooth
  platform_allow:
    - nrf52_bsim/native
  harness: bsim

tests:
  bluetooth.host.security.ccc_update:
    harness_config:
      bsim_exe_name: tests_bsim_bluetooth_host_security_ccc_update_prj_conf
  bluetooth.host.security.ccc_update_no_lazy_load:
    harness_config:
      bsim_exe_name: tests_bsim_bluetooth_host_security_ccc_update_overlay-no_lazy_load_conf
    extra_args:
      EXTRA_CONF_FILE=overlay-no_lazy_load.conf
  bluetooth.host.security.ccc_update_no_long_wq:
    harness_config:
      bsim_exe_name: tests_bsim_bluetooth_host_security_ccc_update_overlay-no_long_wq_conf
    extra_args:
      EXTRA_CONF_FILE=overlay-no_long_wq.conf
```

## tests/bsim/bluetooth/host/security/id_addr_update/peripheral/testcase.yaml
```yaml
tests:
  bluetooth.host.security.id_addr_update.peripheral:
    build_only: true
    tags:
      - bluetooth
    platform_allow:
      - nrf52_bsim/native
    harness: bsim
    harness_config:
      bsim_exe_name: tests_bsim_bluetooth_host_security_id_addr_update_peripheral_prj_conf
```

## tests/bsim/bluetooth/host/security/id_addr_update/testcase.yaml
```yaml
tests:
  bluetooth.host.security.id_addr_update.test:
    no_build: true
    tags:
      - bluetooth
    platform_allow:
      - nrf52_bsim/native
    harness: bsim
    timeout: 30
    harness_config:
      bsim_devices:
        - test_id: central
          exe: tests_bsim_bluetooth_host_security_id_addr_update_central_prj_conf
        - test_id: peripheral
          exe: tests_bsim_bluetooth_host_security_id_addr_update_peripheral_prj_conf
      bsim_verbosity: 2
      bsim_sim_length: 60e6
      bsim_options:
        - -RealEncryption=1
```

## tests/bsim/bluetooth/host/security/ltk_request/testcase.yaml
```yaml
tests:
  bluetooth.host.security.ltk_request:
    build_only: true
    tags:
      - bluetooth
    platform_allow:
      - nrf52_bsim/native
      - nrf5340bsim/nrf5340/cpuapp
    integration_platforms:
      - nrf52_bsim/native
      - nrf5340bsim/nrf5340/cpuapp
    harness: bsim
    harness_config:
      bsim_exe_name: tests_bsim_bluetooth_host_security_ltk_request_prj_conf
```

## tests/bsim/bluetooth/host/security/ltk_request_hook/testcase.yaml
```yaml
tests:
  bluetooth.host.security.ltk_request_hook:
    build_only: true
    tags:
      - bluetooth
    platform_allow:
      - nrf52_bsim/native
    harness: bsim
    harness_config:
      bsim_exe_name: tests_bsim_bluetooth_host_security_ltk_request_hook_prj_conf
```

## tests/bsim/bluetooth/host/security/security_changed_callback/testcase.yaml
```yaml
tests:
  bluetooth.host.security.security_changed_callback:
    build_only: true
    tags:
      - bluetooth
    platform_allow:
      - nrf52_bsim/native
    harness: bsim
    harness_config:
      bsim_exe_name: tests_bsim_bluetooth_host_security_security_changed_callback_prj_conf
```

## tests/bsim/bluetooth/ll/bis/Kconfig
```kconfig
# Copyright (c) 2024 Nordic Semiconductor ASA
# SPDX-License-Identifier: Apache-2.0

config TEST_LL_INTERFACE
	bool "Test Broadcast ISO using internal LL interface"
	help
	  Test Broadcast ISO using internal LL interface.

config TEST_ISO_PACKING_INTERLEAVED
	bool "Test ISO interleaved packing"
	help
	  Test ISO interleaved packing. Note, this tests with single BIS to
	  ensure that using sequential or interleaved packing to create the BIS
	  still is valid when creating single BIS in a BIG.

menu "Zephyr Kernel"
source "Kconfig.zephyr"
endmenu
```

## tests/bsim/bluetooth/ll/bis/Kconfig.sysbuild
```kconfig
# Copyright 2023 Nordic Semiconductor ASA
# SPDX-License-Identifier: Apache-2.0

source "share/sysbuild/Kconfig"

config NET_CORE_BOARD
	string
	default "nrf5340bsim_nrf5340_cpunet" if $(BOARD) = "nrf5340bsim_nrf5340_cpuapp"
	default "nrf5340bsim/nrf5340/cpunet" if $(BOARD)$(BOARD_IDENTIFIER) = "nrf5340bsim/nrf5340/cpuapp"

config NATIVE_SIMULATOR_PRIMARY_MCU_INDEX
	int
	# Let's pass the test arguments to the application MCU test
	# otherwise by default they would have gone to the net core.
	default 0 if $(BOARD) = "nrf5340bsim_nrf5340_cpuapp"
	default 0 if $(BOARD) = "nrf5340bsim"
```

## tests/bsim/bluetooth/ll/bis/testcase.yaml
```yaml
common:
  build_only: true
  tags:
    - bluetooth
    - bsim_multi

tests:
  bluetooth.ll.bis:
    sysbuild: true
    platform_allow:
      - nrf52_bsim
      - nrf5340bsim/nrf5340/cpuapp
      - nrf5340bsim/nrf5340/cpunet
    integration_platforms:
      - nrf52_bsim
      - nrf5340bsim/nrf5340/cpuapp
      - nrf5340bsim/nrf5340/cpunet
    harness: bsim
    harness_config:
      bsim_exe_name: tests_bsim_bluetooth_ll_bis_prj_conf
  bluetooth.ll.bis_ticker_expire_info:
    extra_args: EXTRA_CONF_FILE=overlay-ticker_expire_info.conf
    platform_allow:
      - nrf52_bsim
      - nrf5340bsim/nrf5340/cpunet
    integration_platforms:
      - nrf52_bsim
      - nrf5340bsim/nrf5340/cpunet
    harness: bsim
    harness_config:
      bsim_exe_name: tests_bsim_bluetooth_ll_bis_prj_conf_overlay-ticker_expire_info_conf
  bluetooth.ll.bis_vs_dp:
    extra_args: CONF_FILE=prj_vs_dp.conf
    platform_allow:
      - nrf52_bsim
      - nrf5340bsim/nrf5340/cpunet
    integration_platforms:
      - nrf52_bsim
      - nrf5340bsim/nrf5340/cpunet
    harness: bsim
    harness_config:
      bsim_exe_name: tests_bsim_bluetooth_ll_bis_prj_vs_dp_conf
  bluetooth.ll.bis_past:
    extra_args: CONF_FILE=prj_past.conf
    platform_allow:
      - nrf52_bsim
      - nrf5340bsim/nrf5340/cpunet
    integration_platforms:
      - nrf52_bsim
      - nrf5340bsim/nrf5340/cpunet
    harness: bsim
    harness_config:
      bsim_exe_name: tests_bsim_bluetooth_ll_bis_prj_past_conf
```

## tests/bsim/bluetooth/ll/cis/Kconfig
```kconfig
# Copyright (c) 2022 Nordic Semiconductor ASA
# SPDX-License-Identifier: Apache-2.0

config TEST_USE_LEGACY_ADVERTISING
	bool "Use Legacy Connectable Advertising"
	help
	  Use legacy connectable advertising instead of extended advertising.

config TEST_CONNECT_ACL_FIRST
	bool "Connect ACLs first"
	help
	  Connect ACLs first

config TEST_MULTIPLE_PERIPERAL_CIS
	bool "Multiple Peripheral CIS"
	help
	  Multiple Peripheral CIS establishment.

config TEST_FT_SKIP_SUBEVENTS
	bool
	help
	  Skip central and/or peripheral subevent reception to test flush
	  timeout implementation.

config TEST_FT_PER_SKIP_SUBEVENTS
	bool "Skip peripheral role subevents to test Flush Timeout"
	select TEST_FT_SKIP_SUBEVENTS
	help
	  Skip peripheral role subevent reception to test flush timeout
	  implementation.

config TEST_FT_PER_SKIP_EVENTS_COUNT
	int "Skip peripheral ISO events count, all subevents in them"
	depends on TEST_FT_PER_SKIP_SUBEVENTS
	help
	  Skip peripheral ISO events count where all subevents are skipped.

config TEST_FT_CEN_SKIP_SUBEVENTS
	bool "Skip central role subevents to test Flush Timeout"
	select TEST_FT_SKIP_SUBEVENTS
	help
	  Skip central role subevent reception to test flush timeout
	  implementation.

config TEST_FT_CEN_SKIP_EVENTS_COUNT
	int "Skip central ISO events count, all subevents in them"
	depends on TEST_FT_CEN_SKIP_SUBEVENTS
	help
	  Skip central ISO events count where all subevents are skipped.

config BT_CTLR_SCAN_UNRESERVED
	default y if TEST_CONNECT_ACL_FIRST
	help
	  When CIS is created first, there isn't sufficient time available for
	  scanning to overlap with advertising events hence do not use
	  unreserved scanning so that the create connection can succeed within
	  its 3 second timeout.

menu "Zephyr Kernel"
source "Kconfig.zephyr"
endmenu
```

## tests/bsim/bluetooth/ll/conn/Kconfig
```kconfig
# Copyright (c) 2024 Nordic Semiconductor ASA
# SPDX-License-Identifier: Apache-2.0

config TEST_CONN_INTERVAL_1MS
	bool "Test 1 ms connection interval support"
	help
	  Test 1 ms connection interval support.

menu "Zephyr Kernel"
source "Kconfig.zephyr"
endmenu
```

## tests/bsim/bluetooth/ll/conn/Kconfig.sysbuild
```kconfig
# Copyright 2023 Nordic Semiconductor ASA
# SPDX-License-Identifier: Apache-2.0

source "share/sysbuild/Kconfig"

config NET_CORE_BOARD
	string
	default "nrf5340bsim_nrf5340_cpunet" if $(BOARD) = "nrf5340bsim_nrf5340_cpuapp"

config NATIVE_SIMULATOR_PRIMARY_MCU_INDEX
	int
	# Let's pass the test arguments to the application MCU test
	# otherwise by default they would have gone to the net core.
	default 0 if $(BOARD) = "nrf5340bsim_nrf5340_cpuapp"
```

## tests/bsim/bluetooth/ll/conn_param/Kconfig
```kconfig
# Copyright (c) 2022 Nordic Semiconductor ASA
# SPDX-License-Identifier: Apache-2.0

config TEST_BSIM_BT_CONN_PARAM
	bool "Test connection parameter requests on all connections"
	default y

config TEST_BSIM_BT_CONN_PARAM_OBSERVER_DISABLED
	bool "Disable Observer state simultaneous in Peripheral role"
	default y

menu "Zephyr Kernel"
source "Kconfig.zephyr"
endmenu
```

## tests/bsim/bluetooth/ll/throughput/Kconfig
```kconfig
# Copyright (c) 2025 Nordic Semiconductor ASA
# SPDX-License-Identifier: Apache-2.0

source "$(ZEPHYR_BASE)/samples/bluetooth/central_gatt_write/Kconfig"
```

## tests/bsim/bluetooth/samples/central_hr_peripheral_hr/Kconfig
```kconfig
# Copyright (c) 2023 Nordic Semiconductor ASA
# SPDX-License-Identifier: Apache-2.0

# source sample's Kconfig, if any
#   source "$(ZEPHYR_BASE)/samples/bluetooth/central_hr/Kconfig"
# OR
# source Zephyr Kernel's Kconfig, as below (not both)
menu "Zephyr Kernel"
source "Kconfig.zephyr"
endmenu
```

## tests/bsim/bluetooth/tester/Kconfig
```kconfig
# Copyright (c) 2025 Nordic Semiconductor ASA
# SPDX-License-Identifier: Apache-2.0

module = BSIM_BTTESTER
module-str = bsim_bttester
source "subsys/logging/Kconfig.template.log_config"

source "Kconfig.zephyr"
```

## tests/bsim/bluetooth/tester/testcase.yaml
```yaml
tests:
  bluetooth.tester_bsim:
    build_only: true
    tags:
      - bluetooth
    harness: bsim
    harness_config:
      bsim_exe_name: tests_bsim_bluetooth_tester_prj_conf
    platform_allow:
      - nrf52_bsim/native
```

## tests/bsim/net/sockets/echo_test/Kconfig
```kconfig
# Copyright (c) 2023 Nordic Semiconductor ASA
# SPDX-License-Identifier: Apache-2.0

source "$(ZEPHYR_BASE)/samples/net/sockets/echo_client/Kconfig"
```

## tests/bsim/net/sockets/echo_test/testcase.yaml
```yaml
common:
  platform_allow:
    - nrf52_bsim
  integration_platforms:
    - nrf52_bsim
  build_only: true
  tags: bluetooth

tests:
  net.sockets.echo_test_802154_bsim:
    extra_args: OVERLAY_CONFIG="overlay-802154.conf"
  net.sockets.echo_test_ot_bsim:
    extra_args: OVERLAY_CONFIG="overlay-ot.conf"
```
