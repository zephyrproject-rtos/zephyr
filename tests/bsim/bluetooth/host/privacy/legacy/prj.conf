## CMakeLists.txt
```
# SPDX-License-Identifier: Apache-2.0

cmake_minimum_required(VERSION 3.28.0)

find_package(Zephyr REQUIRED HINTS $ENV{ZEPHYR_BASE})
project(bsim_test_privacy_legacy)

add_subdirectory(${ZEPHYR_BASE}/tests/bsim/babblekit babblekit)
add_subdirectory(${ZEPHYR_BASE}/tests/bluetooth/common/testlib testlib)
target_link_libraries(app PRIVATE
  babblekit
  testlib
)

target_sources(app PRIVATE
  src/tester.c
  src/main.c
  src/dut.c
  src/scan_identity_adv.c
)

zephyr_include_directories(
  ${BSIM_COMPONENTS_PATH}/libUtilv1/src/
  ${BSIM_COMPONENTS_PATH}/libPhyComv1/src/
  )
```

## prj.conf
```kconfig
CONFIG_LOG=y
CONFIG_BT=y
CONFIG_BT_PERIPHERAL=y
CONFIG_BT_CENTRAL=y
CONFIG_BT_SMP=y
CONFIG_ASSERT=y

CONFIG_BT_PRIVACY=y
CONFIG_BT_FILTER_ACCEPT_LIST=y
CONFIG_BT_RPA_TIMEOUT=10
```

## src/main.c
```c
/*
 * Copyright (c) 2023 Nordic Semiconductor ASA
 *
 * SPDX-License-Identifier: Apache-2.0
 */

#include "bstests.h"

void tester_procedure(void);
void dut_procedure(void);
struct bst_test_list *test_scan_identity_adv_install(struct bst_test_list *tests);
struct bst_test_list *test_auto_identity_adv_install(struct bst_test_list *tests);

static const struct bst_test_instance test_to_add[] = {
	{
		.test_id = "central",
		.test_main_f = tester_procedure,
	},
	{
		.test_id = "peripheral",
		.test_main_f = dut_procedure,
	},
	BSTEST_END_MARKER,
};

static struct bst_test_list *install(struct bst_test_list *tests)
{
	return bst_add_tests(tests, test_to_add);
};

bst_test_install_t test_installers[] = {install, test_scan_identity_adv_install,
					test_auto_identity_adv_install, NULL};

int main(void)
{
	bst_main();
	return 0;
}
```

## src/auto_identity_adv.c
```c
/*
 * SPDX-FileCopyrightText: Copyright (c) 2026 Silicon Laboratories Inc.
 * SPDX-License-Identifier: Apache-2.0
 */

#include <stdint.h>

#include <zephyr/bluetooth/addr.h>
#include <zephyr/bluetooth/bluetooth.h>
#include <zephyr/bluetooth/conn.h>
#include <zephyr/bluetooth/controller.h>
#include <zephyr/bluetooth/hci_types.h>
#include <zephyr/kernel.h>
#include <zephyr/sys/util.h>

#include "babblekit/testcase.h"
#include "bstests.h"

/* Upper bound for cancelling the initiator and failing to restart it */
#define ATTEMPT_END_MAX K_SECONDS(1)

static K_SEM_DEFINE(attempt_end_sem, 0, 1);
static uint8_t attempt_err;

static void connected(struct bt_conn *conn, uint8_t err)
{
	ARG_UNUSED(conn);

	attempt_err = err;
	k_sem_give(&attempt_end_sem);
}

static void test_auto_identity_adv(void)
{
	/* A public identity address, so that the legacy advertiser does not use the random
	 * address that the initiator's RPA is set in
	 */
	static const uint8_t public_addr[BT_ADDR_SIZE] = {0x01, 0x02, 0x03, 0x04, 0x05, 0x06};
	/* A device that does not advertise, so that the procedure is still running */
	static const bt_addr_le_t peer_addr = {BT_ADDR_LE_RANDOM,
					       {{0x0A, 0x0B, 0x0C, 0x0D, 0x0E, 0xCF}}};
	static struct bt_conn_cb conn_cb = {
		.connected = connected,
	};
	struct bt_le_oob oob;
	int err;

	bt_ctlr_set_public_addr(public_addr);

	err = bt_enable(NULL);
	TEST_ASSERT(err == 0, "Bluetooth init failed (err %d)", err);

	err = bt_conn_cb_register(&conn_cb);
	TEST_ASSERT(err == 0, "Failed to register connection callbacks (err %d)", err);

	err = bt_le_filter_accept_list_add(&peer_addr);
	TEST_ASSERT(err == 0, "Failed to add the peer to the accept list (err %d)", err);

	err = bt_conn_le_create_auto(BT_CONN_LE_CREATE_CONN, BT_LE_CONN_PARAM_DEFAULT);
	TEST_ASSERT(err == 0, "Failed to start connecting (err %d)", err);

	/* While it is enabled, the Controller refuses a new random address, both for the rotation
	 * and for the restart of the initiator that the rotation cancels
	 */
	err = bt_le_adv_start(BT_LE_ADV_NCONN_IDENTITY, NULL, 0, NULL, 0);
	TEST_ASSERT(err == 0, "Failed to start advertising (err %d)", err);

	err = bt_le_oob_get_local(BT_ID_DEFAULT, &oob);
	TEST_ASSERT(err == 0, "Failed to rotate the RPAs (err %d)", err);

	TEST_ASSERT(k_sem_take(&attempt_end_sem, ATTEMPT_END_MAX) == 0,
		    "The connection procedure did not end");
	TEST_ASSERT(attempt_err == BT_HCI_ERR_UNSPECIFIED, "The procedure ended with 0x%02x",
		    attempt_err);

	/* The ended procedure can be started again once the random address can be set */
	err = bt_le_adv_stop();
	TEST_ASSERT(err == 0, "Failed to stop advertising (err %d)", err);
	err = bt_conn_le_create_auto(BT_CONN_LE_CREATE_CONN, BT_LE_CONN_PARAM_DEFAULT);
	TEST_ASSERT(err == 0, "Failed to start connecting again (err %d)", err);

	TEST_PASS_AND_EXIT("PASS");
}

static const struct bst_test_instance test_def[] = {
	{
		.test_id = "auto_identity_adv",
		.test_descr =
			"The automatic connection establishment procedure ends with an error "
			"when its initiator cannot be restarted after an RPA rotation next to "
			"a legacy identity advertiser, and can then be started again",
		.test_main_f = test_auto_identity_adv,
	},
	BSTEST_END_MARKER,
};

struct bst_test_list *test_auto_identity_adv_install(struct bst_test_list *tests)
{
	return bst_add_tests(tests, test_def);
}
```

## src/bs_bt_utils.c
```c
/*
 * Copyright (c) 2023 Nordic Semiconductor ASA
 *
 * SPDX-License-Identifier: Apache-2.0
 */

#include "bs_bt_utils.h"
#include "argparse.h"
#include "bs_pc_backchannel.h"

#define BS_SECONDS(dur_sec)    ((bs_time_t)dur_sec * 1000000)
#define TEST_TIMEOUT_SIMULATED BS_SECONDS(70)

void test_tick(bs_time_t HW_device_time)
{
	bs_trace_debug_time(0, "Simulation ends now.\n");
	if (bst_result != Passed) {
		bst_result = Failed;

		bs_trace_error("Test did not pass before simulation ended.\n");
	}
}

void test_init(void)
{
	bst_ticker_set_next_tick_absolute(TEST_TIMEOUT_SIMULATED);
	bst_result = In_progress;
}

#define CHANNEL_ID 0
#define MSG_SIZE 1

void backchannel_init(uint peer)
{
	uint device_number = get_device_nbr();
	uint device_numbers[] = { peer };
	uint channel_numbers[] = { CHANNEL_ID };
	uint *ch;

	ch = bs_open_back_channel(device_number, device_numbers,
				  channel_numbers, ARRAY_SIZE(channel_numbers));
	if (!ch) {
		FAIL("Unable to open backchannel\n");
	}
}

void backchannel_sync_send(void)
{
	uint8_t sync_msg[MSG_SIZE] = { get_device_nbr() };

	printk("Sending sync\n");
	bs_bc_send_msg(CHANNEL_ID, sync_msg, ARRAY_SIZE(sync_msg));
}

void backchannel_sync_wait(void)
{
	uint8_t sync_msg[MSG_SIZE];

	while (true) {
		if (bs_bc_is_msg_received(CHANNEL_ID) > 0) {
			bs_bc_receive_msg(CHANNEL_ID, sync_msg,
					  ARRAY_SIZE(sync_msg));
			if (sync_msg[0] != get_device_nbr()) {
				/* Received a message from another device, exit */
				break;
			}
		}

		k_sleep(K_MSEC(1));
	}

	printk("Sync received\n");
}
```

## src/bs_bt_utils.h
```c
/**
 * Common functions and helpers for BSIM ADV tests
 *
 * Copyright (c) 2023 Nordic Semiconductor ASA
 *
 * SPDX-License-Identifier: Apache-2.0
 */

#include "bs_tracing.h"
#include "bs_types.h"
#include "bstests.h"
#include "time_machine.h"

#include <errno.h>

#include <zephyr/sys/__assert.h>
#include <zephyr/bluetooth/bluetooth.h>
#include <zephyr/bluetooth/conn.h>
#include <zephyr/bluetooth/gatt.h>
#include <zephyr/bluetooth/hci.h>
#include <zephyr/bluetooth/uuid.h>
#include <zephyr/kernel.h>
#include <zephyr/types.h>

extern enum bst_result_t bst_result;

#define ASSERT(expr, ...)                                                                          \
	do {                                                                                       \
		if (!(expr)) {                                                                     \
			FAIL(__VA_ARGS__);                                                         \
		}                                                                                  \
	} while (0)

#define FAIL(...)                                                                                  \
	do {                                                                                       \
		bst_result = Failed;                                                               \
		bs_trace_error_time_line(__VA_ARGS__);                                             \
	} while (0)

#define PASS(...)                                                                                  \
	do {                                                                                       \
		bst_result = Passed;                                                               \
		bs_trace_info_time(1, __VA_ARGS__);                                                \
	} while (0)

#define CENTRAL_SIM_ID 0
#define PERIPHERAL_SIM_ID 1

void test_tick(bs_time_t HW_device_time);
void test_init(void);

void backchannel_init(uint peer);
void backchannel_sync_send(void);
void backchannel_sync_wait(void);
```

## src/dut.c
```c
/*
 * Copyright (c) 2023 Nordic Semiconductor ASA
 *
 * SPDX-License-Identifier: Apache-2.0
 */

#include <stdint.h>
#include <string.h>

#include <errno.h>

#include <zephyr/sys/__assert.h>
#include <zephyr/bluetooth/addr.h>
#include <zephyr/bluetooth/bluetooth.h>
#include <zephyr/bluetooth/conn.h>
#include <zephyr/bluetooth/gatt.h>
#include <zephyr/bluetooth/hci.h>
#include <zephyr/bluetooth/uuid.h>
#include <zephyr/kernel.h>
#include <zephyr/types.h>

#include <babblekit/testcase.h>
#include <babblekit/sync.h>

#include <zephyr/logging/log.h>
LOG_MODULE_REGISTER(dut, 4);

static const struct bt_data ad[] = {
	BT_DATA_BYTES(BT_DATA_FLAGS, (BT_LE_AD_GENERAL | BT_LE_AD_NO_BREDR)),
};

bt_addr_le_t dut_addr = {BT_ADDR_LE_RANDOM, {{0x0A, 0x89, 0x67, 0x45, 0x23, 0xC1}}};

static void set_public_addr(void)
{
	/* dummy irk so we don't get -EINVAL because of BT_PRIVACY=y */
	uint8_t irk[16];
	int err;

	for (uint8_t i = 0; i < 16; i++) {
		irk[i] = i;
	}

	err = bt_id_create(&dut_addr, irk);
	if (err) {
		TEST_FAIL("Failed to override addr %d", err);
	}
}

static void start_advertising(uint32_t options)
{
	int err;

	struct bt_le_adv_param param =
		BT_LE_ADV_PARAM_INIT(0, BT_GAP_ADV_FAST_INT_MIN_2, BT_GAP_ADV_FAST_INT_MAX_2, NULL);
	param.options |= options;

	err = bt_le_adv_start(&param, ad, ARRAY_SIZE(ad), NULL, 0);
	if (err) {
		TEST_FAIL("Failed to start advertising (err %d)", err);
	}
}

static void generate_new_rpa(void)
{
	/* This will generate a new RPA and mark it valid */
	struct bt_le_oob oob_local = { 0 };

	bt_le_oob_get_local(BT_ID_DEFAULT, &oob_local);
}

void dut_procedure(void)
{
	int err;

	/* open a backchannel to the peer */
	TEST_ASSERT(bk_sync_init() == 0);

	/* override public address so the scanner can test if we're using it or not */
	set_public_addr();

	LOG_DBG("enable bt");
	err = bt_enable(NULL);
	if (err) {
		TEST_FAIL("Failed to enable bluetooth (err %d)", err);
	}

	LOG_DBG("generate new RPA");
	generate_new_rpa();

	LOG_DBG("start adv with identity");
	start_advertising(BT_LE_ADV_OPT_CONN | BT_LE_ADV_OPT_USE_IDENTITY);

	/* wait for the tester to validate we're using our identity address */
	LOG_DBG("wait for validation by tester");
	bk_sync_wait();
	LOG_DBG("wait for validation by tester");
	err = bt_le_adv_stop();
	if (err) {
		TEST_FAIL("Failed to stop advertising (err %d)", err);
	}

	LOG_DBG("start adv with RPA");
	start_advertising(BT_LE_ADV_OPT_CONN);

	/* Test pass verdict is decided by the tester */
	TEST_PASS("DUT done");
}
```

## src/scan_identity_adv.c
```c
/*
 * SPDX-FileCopyrightText: Copyright (c) 2026 Silicon Laboratories Inc.
 * SPDX-License-Identifier: Apache-2.0
 */

#include <errno.h>
#include <stdint.h>

#include <zephyr/bluetooth/addr.h>
#include <zephyr/bluetooth/bluetooth.h>
#include <zephyr/bluetooth/controller.h>
#include <zephyr/bluetooth/gap.h>
#include <zephyr/kernel.h>
#include <zephyr/net_buf.h>
#include <zephyr/sys/util.h>

#include "babblekit/testcase.h"
#include "bstests.h"

/* Upper bound for the time between two reports of the advertiser, which advertises every
 * 100 to 150 ms
 */
#define REPORT_MAX_GAP K_SECONDS(1)

static K_SEM_DEFINE(report_sem, 0, 1);

/* The only other device is the advertiser */
static void scan_cb(const bt_addr_le_t *addr, int8_t rssi, uint8_t adv_type,
		    struct net_buf_simple *buf)
{
	ARGS_UNUSED(addr, rssi, adv_type, buf);

	k_sem_give(&report_sem);
}

static void expect_report(const char *when)
{
	TEST_ASSERT(k_sem_take(&report_sem, REPORT_MAX_GAP) == 0, "No advertising report %s", when);
}

static void test_scan_identity_adv(void)
{
	/* A public identity address, so that the legacy advertiser does not use the random
	 * address that the scanner's RPA is set in
	 */
	static const uint8_t public_addr[BT_ADDR_SIZE] = {0x01, 0x02, 0x03, 0x04, 0x05, 0x06};
	const struct bt_le_scan_param scan_param =
		BT_LE_SCAN_PARAM_INIT(BT_LE_SCAN_TYPE_ACTIVE, BT_LE_SCAN_OPT_NONE,
				      BT_GAP_SCAN_FAST_INTERVAL, BT_GAP_SCAN_FAST_WINDOW);
	int err;

	bt_ctlr_set_public_addr(public_addr);

	err = bt_enable(NULL);
	TEST_ASSERT(err == 0, "Bluetooth init failed (err %d)", err);

	err = bt_le_scan_start(&scan_param, scan_cb);
	TEST_ASSERT(err == 0, "Failed to start scanning (err %d)", err);

	/* While it is enabled, the Controller refuses a new random address for the scanner */
	err = bt_le_adv_start(BT_LE_ADV_NCONN_IDENTITY, NULL, 0, NULL, 0);
	TEST_ASSERT(err == 0, "Failed to start advertising (err %d)", err);

	expect_report("before the forced rotation");

	err = bt_le_rotate_rpa();
	TEST_ASSERT(err == -EACCES, "Rotating next to the identity advertiser returned %d", err);
	k_sem_reset(&report_sem);
	expect_report("after the forced rotation");

	/* The RPA timeout, restarted by the forced rotation, is not reported to the application */
	(void)k_sleep(K_SECONDS(CONFIG_BT_RPA_TIMEOUT));
	k_sem_reset(&report_sem);
	expect_report("after the RPA timeout");

	TEST_PASS_AND_EXIT("PASS");
}

static void test_advertiser(void)
{
	int err;

	err = bt_enable(NULL);
	TEST_ASSERT(err == 0, "Bluetooth init failed (err %d)", err);

	err = bt_le_adv_start(BT_LE_ADV_NCONN, NULL, 0, NULL, 0);
	TEST_ASSERT(err == 0, "Failed to start advertising (err %d)", err);

	/* Advertising goes on until the scanner ends the simulation */
	TEST_PASS("PASS");
}

static const struct bst_test_instance test_def[] = {
	{
		.test_id = "scan_identity_adv",
		.test_descr = "An active scanner keeps scanning when a legacy advertiser on the "
			      "public identity address keeps its RPA from being rotated, and "
			      "bt_le_rotate_rpa() reports it",
		.test_main_f = test_scan_identity_adv,
	},
	{
		.test_id = "advertiser",
		.test_descr = "Non-connectable advertiser for scan_identity_adv",
		.test_main_f = test_advertiser,
	},
	BSTEST_END_MARKER,
};

struct bst_test_list *test_scan_identity_adv_install(struct bst_test_list *tests)
{
	return bst_add_tests(tests, test_def);
}
```

## src/tester.c
```c
/*
 * Copyright (c) 2023 Nordic Semiconductor ASA
 *
 * SPDX-License-Identifier: Apache-2.0
 */

#include <stdint.h>
#include <errno.h>

#include <zephyr/sys/__assert.h>
#include <zephyr/bluetooth/addr.h>
#include <zephyr/bluetooth/bluetooth.h>
#include <zephyr/bluetooth/conn.h>
#include <zephyr/bluetooth/gatt.h>
#include <zephyr/bluetooth/hci.h>
#include <zephyr/bluetooth/uuid.h>
#include <zephyr/kernel.h>
#include <zephyr/types.h>

#include <babblekit/testcase.h>
#include <babblekit/sync.h>
#include <testlib/addr.h>

#include <common/bt_str.h>

#define EXPECTED_NUM_ROTATIONS 5

#include <zephyr/logging/log.h>
LOG_MODULE_REGISTER(tester, 4);

struct test_data_t {
	bool		id_addr_ok;
	bt_addr_le_t	old_addr;
	int64_t		old_time;
	int		rpa_rotations;
	bool            addr_set;
} static test_data;

extern bt_addr_le_t dut_addr;

static void cb_expect_rpa(const bt_addr_le_t *addr, int8_t rssi, uint8_t type,
			  struct net_buf_simple *ad)
{
	int64_t diff_ms, rpa_timeout_ms;

	if (bt_addr_le_eq(addr, &dut_addr)) {
		TEST_FAIL("DUT used identity addr instead of RPA");
	}

	/* Only save the address + time if this is the first scan */
	if (bt_addr_le_eq(&test_data.old_addr, BT_ADDR_LE_ANY)) {
		bt_addr_le_copy(&test_data.old_addr, addr);
		test_data.old_time = k_uptime_get();
		return;
	}

	/* Compare old and new address */
	if (bt_addr_le_eq(&test_data.old_addr, addr)) {
		return;
	}
	test_data.addr_set = true;
	LOG_DBG("Old addr: %s, New addr: %s", bt_addr_le_str(&test_data.old_addr),
		bt_addr_le_str(addr));

	test_data.rpa_rotations++;

	/* Ensure the RPA rotation occurs within +-10% of CONFIG_BT_RPA_TIMEOUT */
	diff_ms = k_uptime_get() - test_data.old_time;
	rpa_timeout_ms = CONFIG_BT_RPA_TIMEOUT * MSEC_PER_SEC;

	if (abs(diff_ms - rpa_timeout_ms) > (rpa_timeout_ms / 10)) {
		TEST_FAIL("RPA rotation did not occur within +-10%% of CONFIG_BT_RPA_TIMEOUT");
	}

	bt_addr_le_copy(&test_data.old_addr, addr);
	test_data.old_time = k_uptime_get();

	if (test_data.rpa_rotations > EXPECTED_NUM_ROTATIONS) {
		TEST_PASS("PASS");
	}
}

static void cb_expect_id(const bt_addr_le_t *addr, int8_t rssi, uint8_t type,
			 struct net_buf_simple *ad)
{
	LOG_DBG("Expecting addr: %s, Got addr: %s", bt_addr_le_str(&test_data.old_addr),
		bt_addr_le_str(addr));

	if (addr->type != BT_ADDR_LE_RANDOM) {
		TEST_FAIL("Expected public address (0x%x) got 0x%x", BT_ADDR_LE_RANDOM, addr->type);
	}

	if (!bt_addr_le_eq(&dut_addr, addr)) {
		TEST_FAIL("DUT not using identity address");
	}
}

static void scan_cb(const bt_addr_le_t *addr, int8_t rssi, uint8_t type, struct net_buf_simple *ad)
{
	/* The DUT advertises with the identity address first, to test
	 * that option, but also to allow the DUT time to start its
	 * scanner. The scanner must be ready to capture the one of
	 * first RPA advertisements to accurately judge the RPA
	 * timeout, which is measured from the first RPA advertisement.
	 */
	if (!test_data.id_addr_ok) {
		cb_expect_id(addr, rssi, type, ad);

		/* Tell DUT to switch to RPA */
		bk_sync_send();
		test_data.id_addr_ok = true;
	} else {
		cb_expect_rpa(addr, rssi, type, ad);
	}
}

void tester_procedure(void)
{
	int err;

	/* open a backchannel to the peer */
	TEST_ASSERT(bk_sync_init() == 0);

	err = bt_enable(NULL);
	if (err) {
		TEST_FAIL("Failed to enable bluetooth (err %d)", err);
	}

	err = bt_le_scan_start(BT_LE_SCAN_PASSIVE_CONTINUOUS, scan_cb);

	if (err) {
		TEST_FAIL("Failed to start scanning");
	}
}
```
