## CMakeLists.txt
```
# SPDX-License-Identifier: Apache-2.0

cmake_minimum_required(VERSION 3.28.0)

find_package(Zephyr HINTS $ENV{ZEPHYR_BASE})
project(slow)

# This contains a variety of helper functions that abstract away common tasks,
# like scanning, setting up a connection, querying the peer for a given
# characteristic, etc..
add_subdirectory(${ZEPHYR_BASE}/tests/bluetooth/common/testlib testlib)
target_link_libraries(app PRIVATE testlib)

# This contains babblesim-specific helpers, e.g. device synchronization.
add_subdirectory(${ZEPHYR_BASE}/tests/bsim/babblekit babblekit)
target_link_libraries(app PRIVATE babblekit)

zephyr_include_directories(
        $ENV{BSIM_COMPONENTS_PATH}/libUtilv1/src/
        $ENV{BSIM_COMPONENTS_PATH}/libPhyComv1/src/
)

target_sources(app PRIVATE
  src/main.c
  src/peer.c
  src/dut.c
)
```

## Kconfig.sysbuild
```
# Copyright (c) 2026 Nordic Semiconductor ASA
# SPDX-License-Identifier: Apache-2.0

source "share/sysbuild/Kconfig"

config NET_CORE_BOARD
	string
	default "nrf5340bsim/nrf5340/cpunet" if $(BOARD_TARGET_STRING) = "NRF5340BSIM_NRF5340_CPUAPP"

config NET_CORE_IMAGE_HCI_IPC
	bool "HCI IPC image on network core"
	default y
	depends on NET_CORE_BOARD != ""

config NATIVE_SIMULATOR_PRIMARY_MCU_INDEX
	int
	# Let's pass the test arguments to the application MCU test
	# otherwise by default they would have gone to the net core.
	default 0 if $(BOARD_TARGET_STRING)="NRF5340BSIM_NRF5340_CPUAPP"
```

## prj.conf
```kconfig
CONFIG_BT=y
CONFIG_BT_BROADCASTER=y
CONFIG_BT_CENTRAL=y
CONFIG_BT_OBSERVER=y
CONFIG_BT_EXT_ADV=y
CONFIG_BT_DEVICE_NAME="Scanner Test"
CONFIG_BT_TESTING=y

# Enable privacy with frequent address refreshes
CONFIG_BT_SMP=y
CONFIG_BT_PRIVACY=y
CONFIG_BT_RPA_TIMEOUT=2

# Host-side scan/event buffer large enough for receiving fragmented advertising reports.
CONFIG_BT_EXT_SCAN_BUF_SIZE=1100

# Log & debug options
CONFIG_LOG=y
CONFIG_LOG_RUNTIME_FILTERING=y
CONFIG_LOG_THREAD_ID_PREFIX=y

CONFIG_ASSERT=y
CONFIG_THREAD_NAME=y
CONFIG_LOG_THREAD_ID_PREFIX=y
CONFIG_ARCH_POSIX_TRAP_ON_FATAL=y
```

## src/main.c
```c
/*
 * Copyright (c) 2024 Nordic Semiconductor ASA
 *
 * SPDX-License-Identifier: Apache-2.0
 */

#include <stdbool.h>

#include <zephyr/kernel.h>

#include "bs_cmd_line.h"
#include "bs_tracing.h"
#include "bstests.h"
#include "babblekit/testcase.h"
#include "testlib/log_utils.h"

extern void entrypoint_dut(void);
extern void entrypoint_peer(void);
extern enum bst_result_t bst_result;

unsigned long runtime_log_level = LOG_LEVEL_INF;
bool use_chain_adv;

static void test_args(int argc, char *argv[])
{
	bs_args_struct_t args_struct[] = {
		{
			.dest = &runtime_log_level,
			.type = 'u',
			.name = "{0..4}",
			.option = "log_level",
			.descript = "Runtime log level (0=NONE .. 4=DBG)",
		},
		{
			.dest = &use_chain_adv,
			.type = 'b',
			.name = "{0, 1}",
			.option = "chain",
			.descript = "Use chained (~1000 B) advertising data",
		},
		ARG_TABLE_ENDMARKER,
	};

	bs_args_parse_all_cmd_line(argc, argv, args_struct);
}

static void test_end_cb(void)
{
	if (bst_result != Passed) {
		TEST_PRINT("Test failed.");
	}
}

static const struct bst_test_instance entrypoints[] = {
	{
		.test_id = "dut",
		.test_delete_f = test_end_cb,
		.test_main_f = entrypoint_dut,
		.test_args_f = test_args,
	},
	{
		.test_id = "peer",
		.test_delete_f = test_end_cb,
		.test_main_f = entrypoint_peer,
		.test_args_f = test_args,
	},
	BSTEST_END_MARKER,
};

static struct bst_test_list *install(struct bst_test_list *tests)
{
	return bst_add_tests(tests, entrypoints);
};

bst_test_install_t test_installers[] = {install, NULL};

int main(void)
{
	bst_main();

	return 0;
}
```

## src/data.h
```c
/* Copyright (c) 2024 Nordic Semiconductor ASA
 * SPDX-License-Identifier: Apache-2.0
 */

#include <zephyr/bluetooth/bluetooth.h>

static const struct bt_data peer_ad[] = {
	BT_DATA(BT_DATA_NAME_COMPLETE, CONFIG_BT_DEVICE_NAME, sizeof(CONFIG_BT_DEVICE_NAME) - 1),
};
```

## src/dut.c
```c
/* Copyright (c) 2024 Nordic Semiconductor ASA
 * SPDX-License-Identifier: Apache-2.0
 */

#include <zephyr/bluetooth/addr.h>
#include <zephyr/bluetooth/bluetooth.h>
#include <zephyr/bluetooth/testing.h>
#include <zephyr/kernel.h>
#include <zephyr/logging/log.h>
#include <zephyr/sys/atomic.h>
#include <zephyr/sys/atomic_builtin.h>

#include "testlib/log_utils.h"
#include "babblekit/flags.h"
#include "babblekit/testcase.h"

LOG_MODULE_REGISTER(dut, LOG_LEVEL_DBG);

extern unsigned long runtime_log_level;
extern bool use_chain_adv;

static atomic_t reassembly_timeout_count;
static atomic_t reassembly_complete_count;
static atomic_t reassembly_complete_after_timeout_count;

void bt_testing_trace_ext_adv_reassembly_timeout(void)
{
	atomic_inc(&reassembly_timeout_count);
}

void bt_testing_trace_ext_adv_reassembly_complete(void)
{
	atomic_inc(&reassembly_complete_count);

	if (atomic_get(&reassembly_timeout_count) > 0) {
		atomic_inc(&reassembly_complete_after_timeout_count);
	}
}

static void device_found(const bt_addr_le_t *addr, int8_t rssi, uint8_t type,
			 struct net_buf_simple *ad)
{
	k_msleep(500); /* simulate a slow memcpy (or user processing the scan data) */

	LOG_DBG("Device found: %s (RSSI %d), type %u, AD data len %u", bt_addr_le_str(addr),
		rssi, type, ad->len);
}

#define BT_LE_SCAN_ACTIVE_CONTINUOUS_WITH_DUPLICATES                                               \
	BT_LE_SCAN_PARAM(BT_LE_SCAN_TYPE_ACTIVE, 0, BT_GAP_SCAN_FAST_INTERVAL_MIN,                 \
			 BT_GAP_SCAN_FAST_WINDOW)

void entrypoint_dut(void)
{
	/* Test purpose:
	 *
	 * Verifies that the host can handle running out of HCI RX buffers.
	 *
	 * A scanner with privacy enabled sleeps in every advertising report
	 * callback, simulating slow processing on real hardware. This
	 * exhausts the event buffer pools.
	 *
	 * A short RPA timeout is used to prompt the host into periodically
	 * sending a bunch of commands to the controller. Those commands should
	 * not fail.
	 *
	 * There are two variants (selected via the "chain" argstest flag):
	 *   base  - peer sends default extended advertising data.
	 *   chain - peer sends ~1000 B across ~6 AUX_CHAIN_IND PDUs so
	 *           fragmented HCI ext adv reports (PARTIAL -> COMPLETE) are
	 *           produced. When buffers are exhausted the chain-aware
	 *           discard logic must drop entire chains and the host
	 *           reassembly timer must recover the slot.
	 *
	 * Note: The base test variant only fails by the stack crashing.
	 *
	 * The base variant is a regression test for
	 * https://github.com/zephyrproject-rtos/zephyr/issues/78223
	 *
	 * Two devices:
	 * - `dut`: active-scans with privacy ON
	 * - `peer`: extended advertiser
	 *
	 * [verdict]
	 * - dut is able to run for a long enough time without triggering asserts
	 */
	int err;

	TEST_START("DUT");

	/* Set the log level given by the `log_level` CLI argument */
	bt_testlib_log_level_set("dut", runtime_log_level);

	err = bt_enable(NULL);
	TEST_ASSERT(!err, "Bluetooth init failed (err %d)\n", err);

	LOG_DBG("Bluetooth initialised");

	err = bt_le_scan_start(BT_LE_SCAN_ACTIVE_CONTINUOUS_WITH_DUPLICATES, device_found);
	TEST_ASSERT(!err, "Scanner setup failed (err %d)\n", err);
	LOG_DBG("Explicit scanner started");

	/* 40 seconds ought to be enough for anyone */
	k_sleep(K_SECONDS(40));

	if (use_chain_adv) {
		atomic_val_t timeout_cnt = atomic_get(&reassembly_timeout_count);
		atomic_val_t complete_after_timeout_cnt =
			atomic_get(&reassembly_complete_after_timeout_count);
		atomic_val_t complete_cnt = atomic_get(&reassembly_complete_count);

		LOG_INF("Reassembly stats: timeout=%ld complete=%ld complete_after_timeout=%ld",
			timeout_cnt, complete_cnt, complete_after_timeout_cnt);

		TEST_ASSERT(timeout_cnt > 0,
			    "Expected at least one ext adv reassembly timeout");
		TEST_ASSERT(complete_after_timeout_cnt > 0,
			    "Expected fragmented reports to recover after timeout");
	}

	TEST_PASS_AND_EXIT("DUT passed");
}
```

## src/peer.c
```c
/* Copyright (c) 2024 Nordic Semiconductor ASA
 * SPDX-License-Identifier: Apache-2.0
 */

#include <string.h>

#include <zephyr/bluetooth/addr.h>
#include <zephyr/bluetooth/bluetooth.h>
#include <zephyr/kernel.h>
#include <zephyr/logging/log.h>
#include <zephyr/sys/atomic.h>
#include <zephyr/sys/atomic_builtin.h>

#include "testlib/log_utils.h"
#include "babblekit/flags.h"
#include "babblekit/testcase.h"

LOG_MODULE_REGISTER(peer, LOG_LEVEL_DBG);

extern unsigned long runtime_log_level;
extern bool use_chain_adv;

/* bt_data::data_len is uint8_t (max 255), so we use multiple entries
 * sharing the same backing buffer.
 */
static uint8_t mfg_data[250];

void entrypoint_peer(void)
{
	int err;

	TEST_START("peer");

	/* Set the log level given by the `log_level` CLI argument */
	bt_testlib_log_level_set("peer", runtime_log_level);

	err = bt_enable(NULL);
	TEST_ASSERT(!err, "Bluetooth init failed (err %d)\n", err);

	LOG_DBG("Bluetooth initialised");

	struct bt_le_ext_adv *adv;

	struct bt_le_adv_param adv_param = BT_LE_ADV_PARAM_INIT(
		BT_LE_ADV_OPT_EXT_ADV, BT_GAP_ADV_FAST_INT_MIN_1, BT_GAP_ADV_FAST_INT_MAX_1, NULL);

	err = bt_le_ext_adv_create(&adv_param, NULL, &adv);
	TEST_ASSERT(!err, "Failed to create advertising set: %d", err);
	LOG_DBG("Created extended advertising set.");

	if (use_chain_adv) {
		(void)memset(mfg_data, 0xAA, sizeof(mfg_data));

		const struct bt_data ad_chain[] = {
			BT_DATA(BT_DATA_MANUFACTURER_DATA, mfg_data, sizeof(mfg_data)),
			BT_DATA(BT_DATA_MANUFACTURER_DATA, mfg_data, sizeof(mfg_data)),
			BT_DATA(BT_DATA_MANUFACTURER_DATA, mfg_data, sizeof(mfg_data)),
			BT_DATA(BT_DATA_MANUFACTURER_DATA, mfg_data, sizeof(mfg_data)),
		};

		err = bt_le_ext_adv_set_data(adv, ad_chain, ARRAY_SIZE(ad_chain), NULL, 0U);
		TEST_ASSERT(err == 0, "Failed to set advertising data: %d", err);
		LOG_DBG("Set chain advertising data.");
	}

	err = bt_le_ext_adv_start(adv, BT_LE_EXT_ADV_START_DEFAULT);
	TEST_ASSERT(err == 0, "Failed to start extended advertising: %d", err);
	LOG_DBG("Started extended advertising.");

	TEST_PASS("Tester done");
}
```
