## CMakeLists.txt
```
# SPDX-License-Identifier: Apache-2.0

cmake_minimum_required(VERSION 3.28.0)

find_package(Zephyr REQUIRED HINTS $ENV{ZEPHYR_BASE})

project(scan_ext_filter_policy)

# This contains babblesim-specific helpers, e.g. device synchronization.
add_subdirectory(${ZEPHYR_BASE}/tests/bsim/babblekit babblekit)
target_link_libraries(app PRIVATE babblekit)

zephyr_include_directories(
  ${BSIM_COMPONENTS_PATH}/libUtilv1/src/
  ${BSIM_COMPONENTS_PATH}/libPhyComv1/src/
)

target_sources(app PRIVATE
  src/main.c
  src/dut.c
  src/peer.c
)
```

## prj.conf
```kconfig
CONFIG_BT=y
CONFIG_BT_DEVICE_NAME="ext-filter-policy"

# The peer advertises directed, the DUT scans.
CONFIG_BT_PERIPHERAL=y
CONFIG_BT_OBSERVER=y

# This is the object of the test.
CONFIG_BT_SCAN_EXT_FILTER_POLICY=y

CONFIG_ASSERT=y

CONFIG_LOG=y
```

## prj_ext_adv.conf
```kconfig
# Run the same test with the extended advertising and scanning commands. The
# advertising PDU stays a legacy ADV_DIRECT_IND, but it is reported to the host
# in an LE Extended Advertising Report instead of an LE Directed Advertising
# Report.
CONFIG_BT_EXT_ADV=y
```

## src/main.c
```c
/*
 * Copyright The Zephyr Project Contributors
 *
 * SPDX-License-Identifier: Apache-2.0
 */

#include <zephyr/kernel.h>

#include "bstests.h"

extern void entrypoint_dut(void);
extern void entrypoint_peer(void);

static const struct bst_test_instance entrypoints[] = {
	{
		.test_id = "dut",
		.test_main_f = entrypoint_dut,
	},
	{
		.test_id = "peer",
		.test_main_f = entrypoint_peer,
	},
	BSTEST_END_MARKER,
};

static struct bst_test_list *install(struct bst_test_list *tests)
{
	return bst_add_tests(tests, entrypoints);
};

bst_test_install_t test_installers[] = {install, NULL};

int main(void)
{
	bst_main();

	return 0;
}
```

## src/common.h
```c
/*
 * Copyright The Zephyr Project Contributors
 *
 * SPDX-License-Identifier: Apache-2.0
 */

#ifndef ZEPHYR_TESTS_BSIM_BLUETOOTH_HOST_SCAN_EXT_FILTER_POLICY_COMMON_H_
#define ZEPHYR_TESTS_BSIM_BLUETOOTH_HOST_SCAN_EXT_FILTER_POLICY_COMMON_H_

#include <zephyr/bluetooth/addr.h>

/* Target address of the directed advertisements sent by the peer.
 *
 * The two most significant bits of the address are 0b01, so a scanner sees it
 * as a resolvable private address. It is not derived from any IRK, so no
 * Controller can resolve it, which is the case the extended scanner filter
 * policies exist to report.
 */
#define TEST_TARGET_ADDR                                                                           \
	((bt_addr_le_t){.type = BT_ADDR_LE_RANDOM,                                                 \
			.a = {.val = {0x9a, 0x3d, 0xe0, 0x55, 0xb1, 0x7c}}})

#endif /* ZEPHYR_TESTS_BSIM_BLUETOOTH_HOST_SCAN_EXT_FILTER_POLICY_COMMON_H_ */
```

## src/dut.c
```c
/*
 * Copyright The Zephyr Project Contributors
 *
 * SPDX-License-Identifier: Apache-2.0
 */

#include <zephyr/bluetooth/addr.h>
#include <zephyr/bluetooth/bluetooth.h>
#include <zephyr/bluetooth/gap.h>
#include <zephyr/kernel.h>
#include <zephyr/logging/log.h>
#include <zephyr/net_buf.h>

#include "babblekit/flags.h"
#include "babblekit/sync.h"
#include "babblekit/testcase.h"

#include "common.h"

LOG_MODULE_REGISTER(dut, LOG_LEVEL_INF);

/* How long to scan before concluding that nothing is reported. The peer advertises every 100 to
 * 150 ms, so this covers many advertising events.
 */
#define SCAN_NOTHING_REPORTED_TIMEOUT K_SECONDS(2)

DEFINE_FLAG_STATIC(flag_directed_report);

static void scan_recv_cb(const struct bt_le_scan_recv_info *info, struct net_buf_simple *buf)
{
	bt_addr_le_t expected_target = TEST_TARGET_ADDR;

	if ((info->adv_props & BT_GAP_ADV_PROP_DIRECTED) == 0U) {
		return;
	}

	/* A directed advertisement whose target address the Controller resolved is reported
	 * without one, so direct_addr is NULL. Neither that nor a resolved target address is
	 * the advertisement this test is about.
	 */
	if (info->direct_addr == NULL || info->direct_addr->type != BT_ADDR_LE_UNRESOLVED) {
		return;
	}

	TEST_ASSERT(bt_addr_eq(&info->direct_addr->a, &expected_target.a),
		    "Reported target address does not match the advertised one");
	TEST_ASSERT(info->adv_type == BT_GAP_ADV_TYPE_ADV_DIRECT_IND,
		    "Unexpected advertising type %u", info->adv_type);
	TEST_ASSERT((info->adv_props & BT_GAP_ADV_PROP_CONNECTABLE) != 0U,
		    "Directed advertisement not reported as connectable");

	SET_FLAG(flag_directed_report);
}

static struct bt_le_scan_cb scan_callbacks = {
	.recv = scan_recv_cb,
};

static void scan_start(bool ext_filter_policy)
{
	struct bt_le_scan_param param = {
		.type = BT_LE_SCAN_TYPE_PASSIVE,
		.options = BT_LE_SCAN_OPT_NONE,
		.interval = BT_GAP_SCAN_FAST_INTERVAL,
		.window = BT_GAP_SCAN_FAST_WINDOW,
	};
	int err;

	if (ext_filter_policy) {
		param.options |= BT_LE_SCAN_OPT_EXT_FILTER_POLICY;
	}

	err = bt_le_scan_start(&param, NULL);
	TEST_ASSERT(err == 0, "Failed to start scanning (err %d)", err);
}

static void scan_stop(void)
{
	int err = bt_le_scan_stop();

	TEST_ASSERT(err == 0, "Failed to stop scanning (err %d)", err);
}

void entrypoint_dut(void)
{
	/* Test purpose:
	 *
	 * Verifies that a scanner using the extended scanner filter policy is reported
	 * directed advertisements whose target address is a resolvable private address the
	 * Controller cannot resolve, and that a scanner using the basic filter policy is not.
	 *
	 * Two devices:
	 * - `peer`: advertises directed at an unresolvable target address
	 * - `dut`: scans, first without and then with the extended scanner filter policy
	 *
	 * Procedure:
	 * - [dut] wait until the peer is advertising
	 * - [dut] scan without BT_LE_SCAN_OPT_EXT_FILTER_POLICY and check that the directed
	 *   advertisement is not reported
	 * - [dut] scan with BT_LE_SCAN_OPT_EXT_FILTER_POLICY and wait for the directed
	 *   advertisement to be reported
	 *
	 * [verdict]
	 * - nothing is reported while scanning with the basic filter policy
	 * - the directed advertisement is reported with the target address marked as
	 *   unresolved while scanning with the extended scanner filter policy
	 *
	 * The second phase reporting the advertisement is what proves the peer was on air
	 * during the first.
	 */
	int err;

	TEST_START("dut");

	err = bk_sync_init();
	TEST_ASSERT(err == 0, "Failed to initialize sync (err %d)", err);

	err = bt_enable(NULL);
	TEST_ASSERT(err == 0, "Can't enable Bluetooth (err %d)", err);

	err = bt_le_scan_cb_register(&scan_callbacks);
	TEST_ASSERT(err == 0, "Failed to register scan callbacks (err %d)", err);

	/* Wait until the peer is advertising. */
	bk_sync_wait();

	LOG_INF("Scan with the basic filter policy");
	scan_start(false);
	k_sleep(SCAN_NOTHING_REPORTED_TIMEOUT);
	scan_stop();

	TEST_ASSERT(!IS_FLAG_SET(flag_directed_report),
		    "Directed advertisement reported without the extended filter policy");

	LOG_INF("Scan with the extended scanner filter policy");
	scan_start(true);
	WAIT_FOR_FLAG(flag_directed_report);
	scan_stop();

	/* Let the peer know that it can stop advertising. */
	bk_sync_send();

	TEST_PASS("dut");
}
```

## src/peer.c
```c
/*
 * Copyright The Zephyr Project Contributors
 *
 * SPDX-License-Identifier: Apache-2.0
 */

#include <zephyr/bluetooth/bluetooth.h>
#include <zephyr/logging/log.h>

#include "babblekit/sync.h"
#include "babblekit/testcase.h"

#include "common.h"

LOG_MODULE_REGISTER(peer, LOG_LEVEL_INF);

void entrypoint_peer(void)
{
	/* Test purpose:
	 *
	 * Verifies that a scanner using the extended scanner filter policy is reported
	 * directed advertisements whose target address is a resolvable private address the
	 * Controller cannot resolve, and that a scanner using the basic filter policy is not.
	 *
	 * Two devices:
	 * - `peer`: advertises directed at an unresolvable target address
	 * - `dut`: scans, first without and then with the extended scanner filter policy
	 *
	 * Procedure:
	 * - [peer] start low duty cycle directed connectable advertising, with a target
	 *   address that is a resolvable private address no Controller can resolve
	 * - [peer] tell the DUT that the advertiser is on air
	 * - [peer] keep advertising until the DUT is done scanning
	 *
	 * [verdict]
	 * - the advertiser starts successfully
	 */
	bt_addr_le_t target = TEST_TARGET_ADDR;
	struct bt_le_adv_param param = *BT_LE_ADV_CONN_DIR_LOW_DUTY(&target);
	int err;

	TEST_START("peer");

	err = bk_sync_init();
	TEST_ASSERT(err == 0, "Failed to initialize sync (err %d)", err);

	err = bt_enable(NULL);
	TEST_ASSERT(err == 0, "Can't enable Bluetooth (err %d)", err);

	err = bt_le_adv_start(&param, NULL, 0, NULL, 0);
	TEST_ASSERT(err == 0, "Failed to start directed advertising (err %d)", err);

	LOG_INF("Directed advertising started");

	/* Let the DUT know that it can start scanning. */
	bk_sync_send();

	/* Keep advertising until the DUT is done scanning. Passing here would stop the
	 * advertiser while the DUT still needs it on air.
	 */
	bk_sync_wait();

	TEST_PASS("peer");
}
```
