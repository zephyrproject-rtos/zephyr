## CMakeLists.txt
```
# SPDX-License-Identifier: Apache-2.0

cmake_minimum_required(VERSION 3.28.0)

find_package(Zephyr REQUIRED HINTS $ENV{ZEPHYR_BASE})
project(bsim_test_adv_chain)

add_subdirectory(${ZEPHYR_BASE}/tests/bsim/babblekit babblekit)
target_link_libraries(app PRIVATE babblekit)

target_sources(app PRIVATE
  src/main.c
  ${ZEPHYR_BASE}/samples/bluetooth/broadcaster_multiple/src/broadcaster_multiple.c
  ${ZEPHYR_BASE}/samples/bluetooth/observer/src/observer.c
)

zephyr_include_directories(
  ${BSIM_COMPONENTS_PATH}/libUtilv1/src/
  ${BSIM_COMPONENTS_PATH}/libPhyComv1/src/
)
```

## prj.conf
```kconfig
CONFIG_BT=y

# Broadcaster
CONFIG_BT_BROADCASTER=y
CONFIG_BT_EXT_ADV=y
CONFIG_BT_EXT_ADV_MAX_ADV_SET=4
CONFIG_BT_DEVICE_NAME="Broadcaster Multiple"

# Enable Advertising Data chaining in Zephyr Bluetooth LE Controller
CONFIG_BT_CTLR_ADVANCED_FEATURES=y
CONFIG_BT_CTLR_ADV_RESERVE_MAX=n
CONFIG_BT_CTLR_ADV_DATA_CHAIN=y

# Zephyr Bluetooth LE Controller will need to use chain PDUs when AD data
# length > 191 bytes
# - 31 bytes will use 22 bytes for the default name in this sample plus 9 bytes
#   for manufacturer data
# - 191 bytes will use 22 bytes for the default name in this sample plus 169
#   bytes for manufacturer data
# - 277 bytes will use 22 bytes for the default name in this sample plus 255
#   bytes for manufacturer data
CONFIG_BT_CTLR_ADV_DATA_LEN_MAX=1650

# Increase Advertising PDU buffers to number of advertising sets times the
# number of chain PDUs per advertising set when using Zephyr Bluetooth LE
# Controller
CONFIG_BT_CTLR_ADV_DATA_BUF_MAX=6

# Enable Coded PHY
CONFIG_BT_CTLR_PHY_CODED=y

# Observer
CONFIG_BT_OBSERVER=y
CONFIG_BT_EXT_ADV=y

# Maximum Extended Scanning buffer size
CONFIG_BT_EXT_SCAN_BUF_SIZE=1650

# The Zephyr Controller does not combine all the 1650 bytes before
# fragmenting into 8 HCI reports, if a PDU has 255 bytes,
# it will generate 2 HCI reports and so we need to reserve 16 buffers
CONFIG_BT_BUF_EVT_RX_COUNT=10

# Set maximum scan data length for Extended Scanning in Bluetooth LE Controller
CONFIG_BT_CTLR_SCAN_DATA_LEN_MAX=1650

# Increase Zephyr Bluetooth LE Controller Rx buffer to receive complete chain
# of PDUs
CONFIG_BT_CTLR_RX_BUFFERS=9

# Enable scanning interleaved extended advertising in Zephyr Bluetooth LE
# Controller
CONFIG_BT_CTLR_ADVANCED_FEATURES=y
CONFIG_BT_CTLR_SCAN_AUX_SET=3
CONFIG_BT_CTLR_LOW_LAT_ULL=y
# CONFIG_BT_CTLR_SCAN_AUX_USE_CHAINS=y
# CONFIG_BT_CTLR_SCAN_AUX_CHAIN_COUNT=3
CONFIG_BT_CTLR_SCAN_UNRESERVED=y
# CONFIG_BT_TICKER_EXT_EXPIRE_INFO=y
```

## src/main.c
```c
/*
 * Copyright (c) 2022 Nordic Semiconductor ASA
 *
 * SPDX-License-Identifier: Apache-2.0
 */

#include <stddef.h>

#include <zephyr/kernel.h>

#include <zephyr/sys/printk.h>
#include <zephyr/sys/util.h>

#include <zephyr/bluetooth/bluetooth.h>
#include <zephyr/bluetooth/hci.h>

#include <babblekit/testcase.h>

#define NAME_LEN 30
#define AD_DATA_NAME_SIZE     (sizeof(CONFIG_BT_DEVICE_NAME) - 1U + 2U)
#define AD_DATA_MFG_DATA_SIZE (254U + 2U)
/*
 * for testing chaining the manufacturing data is duplicated, hence DATA_LEN needs to
 * add twice the size for this element
 */
#define DATA_LEN                 MIN((AD_DATA_NAME_SIZE + \
				      AD_DATA_MFG_DATA_SIZE + AD_DATA_MFG_DATA_SIZE), \
				     CONFIG_BT_CTLR_ADV_DATA_LEN_MAX)

BUILD_ASSERT(CONFIG_BT_EXT_ADV_MAX_ADV_SET >= 2, "Need minimum 2 advertising sets.");

/* One less extended advertising set as first one is legacy advertising in the broadcaster_multiple
 * sample.
 */
#define MAX_EXT_ADV_SET (CONFIG_BT_EXT_ADV_MAX_ADV_SET - 1)

static K_SEM_DEFINE(sem_recv, 0, 1);

static void test_adv_main(void)
{
	extern int broadcaster_multiple(void);
	int err;

	err = bt_enable(NULL);
	if (err) {
		TEST_FAIL("Bluetooth init failed");

		bs_trace_silent_exit(err);
		return;
	}

	err = broadcaster_multiple();
	if (err) {
		TEST_FAIL("Adv tests failed");
		bs_trace_silent_exit(err);
		return;
	}

	/* Successfully started advertising multiple sets */
	TEST_PASS("Adv tests passed");

	/* Let the scanner receive the reports */
	k_sleep(K_SECONDS(10));
}

static bool data_cb(struct bt_data *data, void *user_data)
{
	char *name = user_data;
	uint8_t len;

	switch (data->type) {
	case BT_DATA_NAME_SHORTENED:
	case BT_DATA_NAME_COMPLETE:
		len = MIN(data->data_len, NAME_LEN - 1);
		(void)memcpy(name, data->data, len);
		name[len] = '\0';
		return false;
	default:
		return true;
	}
}

static void scan_recv(const struct bt_le_scan_recv_info *info,
		      struct net_buf_simple *buf)
{
	static uint8_t sid[MAX_EXT_ADV_SET];
	static uint8_t sid_count;
	char name[NAME_LEN];
	uint8_t data_status;
	uint16_t data_len;

	data_status = BT_HCI_LE_ADV_EVT_TYPE_DATA_STATUS(info->adv_props);
	if (data_status) {
		printk("Received data status: %u\n", data_status);
		return;
	}

	data_len = buf->len;
	if (data_len != DATA_LEN) {
		printk("Received data length: %u\n", data_len);
		return;
	}

	(void)memset(name, 0, sizeof(name));
	bt_data_parse(buf, data_cb, name);

	if (strcmp(name, CONFIG_BT_DEVICE_NAME)) {
		printk("Wrong name %s\n", name);
		return;
	}

	for (uint8_t i = 0; i < sid_count; i++) {
		if (sid[i] == info->sid) {
			printk("Received SID %d\n", info->sid);
			return;
		}
	}

	sid[sid_count++] = info->sid;

	printk("Received advertising sets: %d\n", sid_count);

	if (sid_count < MAX_EXT_ADV_SET) {
		return;
	}

	k_sem_give(&sem_recv);
}

static struct bt_le_scan_cb scan_callbacks = {
	.recv = scan_recv,
};

static void test_scan_main(void)
{
	extern int observer_start(void);
	int err;

	err = bt_enable(NULL);
	if (err) {
		TEST_FAIL("Bluetooth init failed");

		bs_trace_silent_exit(err);
		return;
	}

	bt_le_scan_cb_register(&scan_callbacks);

	err = observer_start();
	if (err) {
		TEST_FAIL("Observer start failed");

		bs_trace_silent_exit(err);
		return;
	}

	/* Let the recv callback verify the reports */
	k_sleep(K_SECONDS(10));

	err = k_sem_take(&sem_recv, K_NO_WAIT);
	if (err) {
		TEST_FAIL("Scan receive failed");

		bs_trace_silent_exit(err);
		return;
	}

	TEST_PASS("Scan tests passed");

	bs_trace_silent_exit(0);
}

static const struct bst_test_instance test_def[] = {
	{
		.test_id = "adv",
		.test_descr = "Central GATT Write",
		.test_main_f = test_adv_main
	},
	{
		.test_id = "scan",
		.test_descr = "Peripheral GATT Write",
		.test_main_f = test_scan_main
	},
	BSTEST_END_MARKER
};

struct bst_test_list *test_adv_chain_install(struct bst_test_list *tests)
{
	return bst_add_tests(tests, test_def);
}

bst_test_install_t test_installers[] = {
	test_adv_chain_install,
	NULL
};

int main(void)
{
	bst_main();
	return 0;
}
```
