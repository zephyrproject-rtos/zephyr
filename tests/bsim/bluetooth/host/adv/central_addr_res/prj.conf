## CMakeLists.txt
```
# Copyright (c) 2026 Silicon Laboratories Inc.
# SPDX-License-Identifier: Apache-2.0

cmake_minimum_required(VERSION 3.28.0)

find_package(Zephyr REQUIRED HINTS $ENV{ZEPHYR_BASE})
project(bsim_test_adv_central_addr_res)

add_subdirectory(${ZEPHYR_BASE}/tests/bsim/babblekit babblekit)
target_link_libraries(app PRIVATE babblekit)

file(GLOB app_sources src/*.c)
target_sources(app PRIVATE ${app_sources})

zephyr_include_directories(
  ${BSIM_COMPONENTS_PATH}/libUtilv1/src/
  ${BSIM_COMPONENTS_PATH}/libPhyComv1/src/
  )
```

## prj.conf
```kconfig
CONFIG_BT=y
CONFIG_BT_DEVICE_NAME="CAR tester"
CONFIG_BT_PERIPHERAL=y
CONFIG_BT_CENTRAL=y
CONFIG_BT_SMP=y
CONFIG_BT_PRIVACY=y
CONFIG_BT_GATT_CLIENT=y
CONFIG_BT_EXT_ADV=y
```

## overlay-no_privacy.conf
```kconfig
# Without privacy the central does not have the Central Address Resolution
# characteristic, which shall be treated as address resolution not being
# supported.
CONFIG_BT_PRIVACY=n
```

## src/main.c
```c
/*
 * Copyright (c) 2026 Silicon Laboratories Inc.
 *
 * SPDX-License-Identifier: Apache-2.0
 */

#include "bstests.h"

extern struct bst_test_list *test_central_install(struct bst_test_list *tests);
extern struct bst_test_list *test_peripheral_install(struct bst_test_list *tests);

bst_test_install_t test_installers[] = {
	test_central_install,
	test_peripheral_install,
	NULL
};

int main(void)
{
	bst_main();
	return 0;
}
```

## src/central.c
```c
/*
 * Copyright (c) 2026 Silicon Laboratories Inc.
 *
 * SPDX-License-Identifier: Apache-2.0
 */

#include <zephyr/kernel.h>

#include <zephyr/bluetooth/bluetooth.h>
#include <zephyr/bluetooth/conn.h>
#include <zephyr/bluetooth/hci.h>

#include "babblekit/testcase.h"
#include "babblekit/flags.h"

DEFINE_FLAG_STATIC(flag_connected);
DEFINE_FLAG_STATIC(flag_bonded);

static struct bt_conn *g_conn;

static void connected(struct bt_conn *conn, uint8_t err)
{
	if (err != 0) {
		TEST_FAIL("Failed to connect to %s (%u)", bt_conn_dst_str(conn), err);
		return;
	}

	__ASSERT_NO_MSG(g_conn == conn);

	SET_FLAG(flag_connected);
}

static void disconnected(struct bt_conn *conn, uint8_t reason)
{
	if (conn != g_conn) {
		return;
	}

	bt_conn_drop(&g_conn);
	UNSET_FLAG(flag_connected);
}

static struct bt_conn_cb conn_callbacks = {
	.connected = connected,
	.disconnected = disconnected,
};

static void pairing_complete(struct bt_conn *conn, bool bonded)
{
	if (!bonded) {
		TEST_FAIL("Pairing did not create a bond");
		return;
	}

	SET_FLAG(flag_bonded);
}

static struct bt_conn_auth_info_cb auth_info_callbacks = {
	.pairing_complete = pairing_complete,
};

static void device_found(const bt_addr_le_t *addr, int8_t rssi, uint8_t type,
			 struct net_buf_simple *ad)
{
	int err;

	if (g_conn != NULL) {
		return;
	}

	if (type != BT_HCI_ADV_IND && type != BT_HCI_ADV_DIRECT_IND) {
		return;
	}

	err = bt_le_scan_stop();
	if (err != 0) {
		TEST_FAIL("Could not stop scan: %d", err);
		return;
	}

	err = bt_conn_le_create(addr, BT_CONN_LE_CREATE_CONN,
				BT_LE_CONN_PARAM_DEFAULT, &g_conn);
	if (err != 0) {
		TEST_FAIL("Could not connect to peer: %d", err);
	}
}

static void test_central(void)
{
	int err;

	bt_conn_cb_register(&conn_callbacks);

	err = bt_conn_auth_info_cb_register(&auth_info_callbacks);
	TEST_ASSERT(err == 0, "bt_conn_auth_info_cb_register failed (%d)", err);

	err = bt_enable(NULL);
	TEST_ASSERT(err == 0, "bt_enable failed (%d)", err);

	err = bt_le_scan_start(BT_LE_SCAN_PASSIVE, device_found);
	TEST_ASSERT(err == 0, "bt_le_scan_start failed (%d)", err);

	WAIT_FOR_FLAG(flag_connected);

	err = bt_conn_set_security(g_conn, BT_SECURITY_L2);
	TEST_ASSERT(err == 0, "bt_conn_set_security failed (%d)", err);

	WAIT_FOR_FLAG(flag_bonded);

	/* Stay connected long enough for the peripheral to read the Central
	 * Address Resolution characteristic.
	 */
	k_sleep(K_SECONDS(5));

	err = bt_conn_disconnect(g_conn, BT_HCI_ERR_REMOTE_USER_TERM_CONN);
	TEST_ASSERT(err == 0, "bt_conn_disconnect failed (%d)", err);

	WAIT_FOR_FLAG_UNSET(flag_connected);

	TEST_PASS("Central passed");
}

static const struct bst_test_instance test_inst[] = {
	{
		.test_id = "central",
		.test_main_f = test_central,
	},
	BSTEST_END_MARKER
};

struct bst_test_list *test_central_install(struct bst_test_list *tests)
{
	return bst_add_tests(tests, test_inst);
}
```

## src/peripheral.c
```c
/*
 * Copyright (c) 2026 Silicon Laboratories Inc.
 *
 * SPDX-License-Identifier: Apache-2.0
 */

#include <errno.h>

#include <zephyr/kernel.h>

#include <zephyr/bluetooth/addr.h>
#include <zephyr/bluetooth/bluetooth.h>
#include <zephyr/bluetooth/conn.h>
#include <zephyr/bluetooth/gap.h>

#include "babblekit/testcase.h"
#include "babblekit/flags.h"

DEFINE_FLAG_STATIC(flag_connected);
DEFINE_FLAG_STATIC(flag_bonded);
DEFINE_FLAG_STATIC(flag_support_read);

static enum bt_le_addr_res_support read_support;

static struct bt_conn *g_conn;

static void connected(struct bt_conn *conn, uint8_t err)
{
	if (err != 0) {
		TEST_FAIL("Failed to connect to %s (%u)", bt_conn_dst_str(conn), err);
		return;
	}

	g_conn = bt_conn_ref(conn);
	SET_FLAG(flag_connected);
}

static void disconnected(struct bt_conn *conn, uint8_t reason)
{
	if (conn != g_conn) {
		return;
	}

	bt_conn_drop(&g_conn);
	UNSET_FLAG(flag_connected);
}

static struct bt_conn_cb conn_callbacks = {
	.connected = connected,
	.disconnected = disconnected,
};

static void pairing_complete(struct bt_conn *conn, bool bonded)
{
	if (!bonded) {
		TEST_FAIL("Pairing did not create a bond");
		return;
	}

	SET_FLAG(flag_bonded);
}

static void addr_res_support_read(struct bt_conn *conn, enum bt_le_addr_res_support support)
{
	read_support = support;
	SET_FLAG(flag_support_read);
}

static struct bt_conn_auth_info_cb auth_info_callbacks = {
	.pairing_complete = pairing_complete,
	.addr_res_support_read = addr_res_support_read,
};

static void bond_addr_cb(const struct bt_bond_info *info, void *user_data)
{
	bt_addr_le_t *addr = user_data;

	bt_addr_le_copy(addr, &info->addr);
}

static void test_peripheral(bool expect_car_support)
{
	const struct bt_data ad[] = {
		BT_DATA_BYTES(BT_DATA_FLAGS, (BT_LE_AD_GENERAL | BT_LE_AD_NO_BREDR))
	};
	bt_addr_le_t peer = *BT_ADDR_LE_ANY;
	enum bt_le_addr_res_support support;
	struct bt_le_adv_param param;
	struct bt_le_ext_adv *adv;
	int err;

	bt_conn_cb_register(&conn_callbacks);

	err = bt_conn_auth_info_cb_register(&auth_info_callbacks);
	TEST_ASSERT(err == 0, "bt_conn_auth_info_cb_register failed (%d)", err);

	err = bt_enable(NULL);
	TEST_ASSERT(err == 0, "bt_enable failed (%d)", err);

	err = bt_le_adv_start(BT_LE_ADV_CONN_FAST_1, ad, ARRAY_SIZE(ad), NULL, 0);
	TEST_ASSERT(err == 0, "bt_le_adv_start failed (%d)", err);

	WAIT_FOR_FLAG(flag_connected);
	WAIT_FOR_FLAG(flag_bonded);

	WAIT_FOR_FLAG(flag_support_read);
	TEST_ASSERT(read_support == (expect_car_support ? BT_LE_ADDR_RES_SUPPORT_YES
							: BT_LE_ADDR_RES_SUPPORT_NO),
		    "Unexpected address resolution support %d reported", read_support);

	WAIT_FOR_FLAG_UNSET(flag_connected);

	bt_foreach_bond(BT_ID_DEFAULT, bond_addr_cb, &peer);
	TEST_ASSERT(!bt_addr_le_eq(&peer, BT_ADDR_LE_ANY), "No bond found");

	support = bt_le_bond_addr_res_support(BT_ID_DEFAULT, &peer);
	TEST_ASSERT(support == (expect_car_support ? BT_LE_ADDR_RES_SUPPORT_YES
						   : BT_LE_ADDR_RES_SUPPORT_NO),
		    "Unexpected address resolution support %d", support);

	param = *BT_LE_ADV_PARAM(BT_LE_ADV_OPT_CONN |
				 BT_LE_ADV_OPT_DIR_MODE_LOW_DUTY |
				 BT_LE_ADV_OPT_DIR_ADDR_RPA,
				 BT_GAP_ADV_FAST_INT_MIN_2,
				 BT_GAP_ADV_FAST_INT_MAX_2,
				 &peer);

	err = bt_le_adv_start(&param, NULL, 0, NULL, 0);

	if (expect_car_support) {
		TEST_ASSERT(err == 0,
			    "Directed advertising to a peer supporting address "
			    "resolution failed (%d)", err);

		err = bt_le_adv_stop();
		TEST_ASSERT(err == 0, "bt_le_adv_stop failed (%d)", err);
	} else {
		TEST_ASSERT(err == -ENOTSUP,
			    "Directed advertising to a peer without address "
			    "resolution was not refused with -ENOTSUP (%d)", err);
	}

	/* The same check applies when creating an extended advertising set */
	param.options |= BT_LE_ADV_OPT_EXT_ADV;

	err = bt_le_ext_adv_create(&param, NULL, &adv);
	if (expect_car_support) {
		TEST_ASSERT(err == 0, "bt_le_ext_adv_create failed (%d)", err);

		err = bt_le_ext_adv_delete(adv);
		TEST_ASSERT(err == 0, "bt_le_ext_adv_delete failed (%d)", err);
	} else {
		TEST_ASSERT(err == -ENOTSUP,
			    "Directed set creation was not refused with -ENOTSUP (%d)", err);
	}

	/* And when a set created without a target peer is updated to
	 * directed advertising.
	 */
	err = bt_le_ext_adv_create(BT_LE_EXT_ADV_CONN, NULL, &adv);
	TEST_ASSERT(err == 0, "bt_le_ext_adv_create failed (%d)", err);

	err = bt_le_ext_adv_update_param(adv, &param);
	if (expect_car_support) {
		TEST_ASSERT(err == 0, "bt_le_ext_adv_update_param failed (%d)", err);
	} else {
		TEST_ASSERT(err == -ENOTSUP,
			    "Directed param update was not refused with -ENOTSUP (%d)", err);
	}

	err = bt_le_ext_adv_delete(adv);
	TEST_ASSERT(err == 0, "bt_le_ext_adv_delete failed (%d)", err);

	TEST_PASS("Peripheral passed");
}

static void test_peripheral_car(void)
{
	test_peripheral(true);
}

static void test_peripheral_no_car(void)
{
	test_peripheral(false);
}

static const struct bst_test_instance test_inst[] = {
	{
		.test_id = "peripheral_car",
		.test_descr = "After bonding to a central that supports address resolution, "
			      "directed advertising with an RPA target address is allowed.",
		.test_main_f = test_peripheral_car,
	},
	{
		.test_id = "peripheral_no_car",
		.test_descr = "After bonding to a central without the Central Address "
			      "Resolution characteristic, directed advertising with an RPA "
			      "target address is refused.",
		.test_main_f = test_peripheral_no_car,
	},
	BSTEST_END_MARKER
};

struct bst_test_list *test_peripheral_install(struct bst_test_list *tests)
{
	return bst_add_tests(tests, test_inst);
}
```
