## CMakeLists.txt
```
# SPDX-License-Identifier: Apache-2.0

cmake_minimum_required(VERSION 3.28.0)

find_package(Zephyr REQUIRED HINTS $ENV{ZEPHYR_BASE})
project(bsim_test_audio)

add_subdirectory(${ZEPHYR_BASE}/tests/bsim/babblekit babblekit)
target_link_libraries(app PRIVATE babblekit)

target_sources(app PRIVATE
    src/common.c
    src/main.c
    src/per_adv_advertiser.c
    src/per_adv_sync.c
)

zephyr_include_directories(
  ${BSIM_COMPONENTS_PATH}/libUtilv1/src/
  ${BSIM_COMPONENTS_PATH}/libPhyComv1/src/
  ${ZEPHYR_BASE}/subsys/bluetooth/host/audio/
)
```

## prj.conf
```kconfig
CONFIG_BT=y
CONFIG_BT_DEVICE_NAME="test_per_adv"
CONFIG_BT_PERIPHERAL=y
CONFIG_BT_CENTRAL=y
CONFIG_BT_SMP=y
CONFIG_BT_PRIVACY=y

CONFIG_BT_EXT_ADV=y
CONFIG_BT_EXT_ADV_MAX_ADV_SET=2
CONFIG_BT_CTLR_ADVANCED_FEATURES=y
CONFIG_BT_CTLR_ADV_AUX_SET=2
CONFIG_BT_CTLR_ADV_DATA_BUF_MAX=3
CONFIG_BT_PER_ADV=y
CONFIG_BT_PER_ADV_SYNC=y

CONFIG_SYSTEM_WORKQUEUE_STACK_IGNORE_MIN=y
```

## prj_coded.conf
```kconfig
CONFIG_BT_CTLR_PHY_CODED=y
```

## prj_long_data.conf
```kconfig
CONFIG_BT_CTLR_ADV_DATA_BUF_MAX=2
CONFIG_BT_CTLR_ADV_AUX_PDU_BACK2BACK=y
CONFIG_BT_CTLR_ADV_SYNC_PDU_BACK2BACK=y

CONFIG_BT_PER_ADV_SYNC_BUF_SIZE=1650
CONFIG_BT_CTLR_ADV_DATA_LEN_MAX=1650
CONFIG_BT_CTLR_ADV_DATA_CHAIN=y
CONFIG_BT_CTLR_SCAN_DATA_LEN_MAX=1650
```

## prj_sync_term_leak.conf
```kconfig
# Chained (multi-PDU) periodic advertising, as prj_long_data.conf.
CONFIG_BT_CTLR_ADV_DATA_BUF_MAX=2
CONFIG_BT_CTLR_ADV_AUX_PDU_BACK2BACK=y
CONFIG_BT_CTLR_ADV_SYNC_PDU_BACK2BACK=y

CONFIG_BT_PER_ADV_SYNC_BUF_SIZE=1650
CONFIG_BT_CTLR_ADV_DATA_LEN_MAX=1650
CONFIG_BT_CTLR_ADV_DATA_CHAIN=y
CONFIG_BT_CTLR_SCAN_DATA_LEN_MAX=1650

# The detector: a single auxiliary context, so one stranded context is
# terminal and no later sync can establish.
CONFIG_BT_CTLR_SCAN_AUX_USE_CHAINS=n
CONFIG_BT_CTLR_SCAN_AUX_SET=1
```

## src/main.c
```c
/*
 * Copyright (c) 2023 Nordic Semiconductor ASA
 *
 * SPDX-License-Identifier: Apache-2.0
 */

#include <bstests.h>

extern struct bst_test_list *test_per_adv_sync(struct bst_test_list *tests);
extern struct bst_test_list *test_per_adv_advertiser(struct bst_test_list *tests);

bst_test_install_t test_installers[] = {
	test_per_adv_sync,
	test_per_adv_advertiser,
	NULL
};

int main(void)
{
	bst_main();
	return 0;
}
```

## src/common.c
```c
/*
 * Copyright (c) 2023 Nordic Semiconductor ASA
 *
 * SPDX-License-Identifier: Apache-2.0
 */

#include "common.h"

uint8_t mfg_data[254] = {
	0xFF, 0xFF, 0x00, 0x01, 0x02, 0x03, 0x04, 0x05, 0x06, 0x07, 0x08, 0x09, 0x0A, 0x0B, 0x0C,
	0x0D, 0x0E, 0x0F, 0x10, 0x11, 0x12, 0x13, 0x14, 0x15, 0x16, 0x17, 0x18, 0x19, 0x1A, 0x1B,
	0x1C, 0x1D, 0x1E, 0x1F, 0x20, 0x21, 0x22, 0x23, 0x24, 0x25, 0x26, 0x27, 0x28, 0x29, 0x2A,
	0x2B, 0x2C, 0x2D, 0x2E, 0x2F, 0x30, 0x31, 0x32, 0x33, 0x34, 0x35, 0x36, 0x37, 0x38, 0x39,
	0x3A, 0x3B, 0x3C, 0x3D, 0x3E, 0x3F, 0x40, 0x41, 0x42, 0x43, 0x44, 0x45, 0x46, 0x47, 0x48,
	0x49, 0x4A, 0x4B, 0x4C, 0x4D, 0x4E, 0x4F, 0x50, 0x51, 0x52, 0x53, 0x54, 0x55, 0x56, 0x57,
	0x58, 0x59, 0x5A, 0x5B, 0x5C, 0x5D, 0x5E, 0x5F, 0x60, 0x61, 0x62, 0x63, 0x64, 0x65, 0x66,
	0x67, 0x68, 0x69, 0x6A, 0x6B, 0x6C, 0x6D, 0x6E, 0x6F, 0x70, 0x71, 0x72, 0x73, 0x74, 0x75,
	0x76, 0x77, 0x78, 0x79, 0x7A, 0x7B, 0x7C, 0x7D, 0x7E, 0x7F, 0x80, 0x81, 0x82, 0x83, 0x84,
	0x85, 0x86, 0x87, 0x88, 0x89, 0x8A, 0x8B, 0x8C, 0x8D, 0x8E, 0x8F, 0x90, 0x91, 0x92, 0x93,
	0x94, 0x95, 0x96, 0x97, 0x98, 0x99, 0x9A, 0x9B, 0x9C, 0x9D, 0x9E, 0x9F, 0xA0, 0xA1, 0xA2,
	0xA3, 0xA4, 0xA5, 0xA6, 0xA7, 0xA8, 0xA9, 0xAA, 0xAB, 0xAC, 0xAD, 0xAE, 0xAF, 0xB0, 0xB1,
	0xB2, 0xB3, 0xB4, 0xB5, 0xB6, 0xB7, 0xB8, 0xB9, 0xBA, 0xBB, 0xBC, 0xBD, 0xBE, 0xBF, 0xC0,
	0xC1, 0xC2, 0xC3, 0xC4, 0xC5, 0xC6, 0xC7, 0xC8, 0xC9, 0xCA, 0xCB, 0xCC, 0xCD, 0xCE, 0xCF,
	0xD0, 0xD1, 0xD2, 0xD3, 0xD4, 0xD5, 0xD6, 0xD7, 0xD8, 0xD9, 0xDA, 0xDB, 0xDC, 0xDD, 0xDE,
	0xDF, 0xE0, 0xE1, 0xE2, 0xE3, 0xE4, 0xE5, 0xE6, 0xE7, 0xE8, 0xE9, 0xEA, 0xEB, 0xEC, 0xED,
	0xEE, 0xEF, 0xF0, 0xF1, 0xF2, 0xF3, 0xF4, 0xF5, 0xF6, 0xF7, 0xF8, 0xF9, 0xFA, 0xFB};
```

## src/common.h
```c
/**
 * Common functions and helpers
 *
 * Copyright (c) 2023 Nordic Semiconductor ASA
 *
 * SPDX-License-Identifier: Apache-2.0
 */

#ifndef ZEPHYR_TEST_BSIM_BT_AUDIO_TEST_
#define ZEPHYR_TEST_BSIM_BT_AUDIO_TEST_

#include <stdint.h>

#include <zephyr/bluetooth/gap.h>

extern uint8_t mfg_data[254];

/* per_adv_sync_term_leak: a terminate while the sync's chain is still being received strands the
 * auxiliary context. On nrf52_bsim the chain (two AUX_CHAIN_IND on 2M) ends 1.7 ms after the
 * synced callback, and terminates from the callback to then strand it. The scanner terminates
 * 0 to TERM_LEAK_SPAN_US after the callback, one step later on each sync, and syncs once per
 * periodic interval (BT_LE_PER_ADV_DEFAULT: at most BT_GAP_PER_ADV_SLOW_INT_MAX).
 */
#define TERM_LEAK_SPAN_US     2000U
#define TERM_LEAK_STEP_US     100U
#define TERM_LEAK_ITERATIONS  (TERM_LEAK_SPAN_US / TERM_LEAK_STEP_US + 1U)
#define TERM_LEAK_INTERVAL_MS BT_GAP_PER_ADV_INTERVAL_TO_MS(BT_GAP_PER_ADV_SLOW_INT_MAX)
/* A sync establishes at the next AUX_SYNC_IND; two intervals allow one missed */
#define TERM_LEAK_TIMEOUT_MS  (2U * TERM_LEAK_INTERVAL_MS)
/* The advertiser outlives the sweep: one interval for the scan that finds it, one per iteration */
#define TERM_LEAK_ADV_MS      ((TERM_LEAK_ITERATIONS + 1U) * TERM_LEAK_INTERVAL_MS)

#endif /* ZEPHYR_TEST_BSIM_BT_AUDIO_TEST_ */
```

## src/per_adv_advertiser.c
```c
/*
 * Copyright (c) 2023 Nordic Semiconductor ASA
 *
 * SPDX-License-Identifier: Apache-2.0
 */

#include <errno.h>
#include <zephyr/kernel.h>
#include <zephyr/types.h>
#include <zephyr/sys/clock.h>
#include <zephyr/sys/printk.h>
#include <zephyr/bluetooth/bluetooth.h>
#include <zephyr/bluetooth/hci.h>
#include <zephyr/bluetooth/conn.h>
#include <zephyr/bluetooth/uuid.h>
#include <zephyr/bluetooth/gatt.h>

#include "babblekit/testcase.h"
#include "babblekit/flags.h"
#include "common.h"

extern enum bst_result_t bst_result;

static struct bt_conn *g_conn;

DEFINE_FLAG_STATIC(flag_connected);
DEFINE_FLAG_STATIC(flag_bonded);

static void connected(struct bt_conn *conn, uint8_t err)
{
	if (err != BT_HCI_ERR_SUCCESS) {
		TEST_FAIL("Failed to connect to %s: %u", bt_conn_dst_str(conn), err);
		return;
	}

	printk("Connected to %s\n", bt_conn_dst_str(conn));
	g_conn = bt_conn_ref(conn);
	SET_FLAG(flag_connected);
}

static void disconnected(struct bt_conn *conn, uint8_t reason)
{
	printk("Disconnected: %s (reason %u)\n", bt_conn_dst_str(conn), reason);

	bt_conn_drop(&g_conn);
}

static struct bt_conn_cb conn_cbs = {
	.connected = connected,
	.disconnected = disconnected,
};

static void pairing_complete_cb(struct bt_conn *conn, bool bonded)
{
	if (conn == g_conn && bonded) {
		SET_FLAG(flag_bonded);
	}
}

static struct bt_conn_auth_info_cb auto_info_cbs = {
	.pairing_complete = pairing_complete_cb,
};

static void common_init(void)
{
	int err;

	err = bt_enable(NULL);

	if (err) {
		TEST_FAIL("Bluetooth init failed: %d", err);
		return;
	}
	printk("Bluetooth initialized\n");

	bt_conn_cb_register(&conn_cbs);
	bt_conn_auth_info_cb_register(&auto_info_cbs);
}

static void create_per_adv_set(struct bt_le_ext_adv **adv)
{
	int err;

	printk("Creating extended advertising set...");
	err = bt_le_ext_adv_create(BT_LE_EXT_ADV_NCONN, NULL, adv);
	if (err) {
		printk("Failed to create advertising set: %d\n", err);
		return;
	}
	printk("done.\n");

	printk("Setting periodic advertising parameters...");
	err = bt_le_per_adv_set_param(*adv, BT_LE_PER_ADV_DEFAULT);
	if (err) {
		printk("Failed to set periodic advertising parameters: %d\n",
		       err);
		return;
	}
	printk("done.\n");
}

#if defined(CONFIG_BT_CTLR_PHY_CODED)
static void create_per_adv_set_coded(struct bt_le_ext_adv **adv)
{
	int err;

	printk("Creating coded PHY extended advertising set...");
	err = bt_le_ext_adv_create(BT_LE_EXT_ADV_CODED_NCONN, NULL, adv);
	if (err) {
		printk("Failed to create advertising set: %d\n", err);
		return;
	}
	printk("done.\n");

	printk("Setting periodic advertising parameters...");
	err = bt_le_per_adv_set_param(*adv, BT_LE_PER_ADV_DEFAULT);
	if (err) {
		printk("Failed to set periodic advertising parameters: %d\n",
		       err);
		return;
	}
	printk("done.\n");
}
#endif /* CONFIG_BT_CTLR_PHY_CODED */

static void create_conn_adv_set(struct bt_le_ext_adv **adv)
{
	int err;

	printk("Creating connectable extended advertising set...");
	err = bt_le_ext_adv_create(BT_LE_EXT_ADV_CONN, NULL, adv);
	if (err) {
		printk("Failed to create advertising set: %d\n", err);
		return;
	}
	printk("done.\n");
}

static void start_ext_adv_set(struct bt_le_ext_adv *adv)
{
	int err;

	printk("Starting Extended Advertising...");
	err = bt_le_ext_adv_start(adv, BT_LE_EXT_ADV_START_DEFAULT);
	if (err) {
		printk("Failed to start extended advertising: %d\n", err);
		return;
	}
	printk("done.\n");
}

static void start_per_adv_set(struct bt_le_ext_adv *adv)
{
	int err;

	printk("Starting periodic advertising...");
	err = bt_le_per_adv_start(adv);
	if (err) {
		printk("Failed to start periodic advertising: %d\n", err);
		return;
	}
	printk("done.\n");
}

static void set_per_adv_data(struct bt_le_ext_adv *adv)
{
	int err;
	const struct bt_data ad[] = {
		BT_DATA(BT_DATA_MANUFACTURER_DATA, mfg_data, ARRAY_SIZE(mfg_data)),
		BT_DATA(BT_DATA_MANUFACTURER_DATA, mfg_data, ARRAY_SIZE(mfg_data))};

	printk("Setting Periodic Advertising Data...");
	err = bt_le_per_adv_set_data(adv, ad, ARRAY_SIZE(ad));
	if (err) {
		printk("Failed to set periodic advertising data: %d\n",
		       err);
		return;
	}
	printk("done.\n");
}

static void stop_ext_adv_set(struct bt_le_ext_adv *adv)
{
	int err;

	printk("Stopping Extended Advertising...");
	err = bt_le_ext_adv_stop(adv);
	if (err) {
		printk("Failed to stop extended advertising: %d\n",
		       err);
		return;
	}
	printk("done.\n");
}

static void stop_per_adv_set(struct bt_le_ext_adv *adv)
{
	int err;

	printk("Stopping Periodic Advertising...");
	err = bt_le_per_adv_stop(adv);
	if (err) {
		printk("Failed to stop periodic advertising: %d\n",
		       err);
		return;
	}
	printk("done.\n");
}

static void delete_adv_set(struct bt_le_ext_adv *adv)
{
	int err;

	printk("Delete extended advertising set...");
	err = bt_le_ext_adv_delete(adv);
	if (err) {
		printk("Failed Delete extended advertising set: %d\n", err);
		return;
	}
	printk("done.\n");
}

static void main_per_adv_advertiser(void)
{
	struct bt_le_ext_adv *per_adv;

	common_init();

	create_per_adv_set(&per_adv);

	start_per_adv_set(per_adv);
	start_ext_adv_set(per_adv);

	/* Advertise for a bit */
	k_sleep(K_SECONDS(10));

	stop_per_adv_set(per_adv);
	stop_ext_adv_set(per_adv);

	delete_adv_set(per_adv);
	per_adv = NULL;

	TEST_PASS("Periodic advertiser passed");
}

#if defined(CONFIG_BT_CTLR_PHY_CODED)
static void main_per_adv_advertiser_coded(void)
{
	struct bt_le_ext_adv *per_adv;

	common_init();

	create_per_adv_set_coded(&per_adv);

	start_per_adv_set(per_adv);
	start_ext_adv_set(per_adv);

	/* Advertise for a bit */
	k_sleep(K_SECONDS(10));

	stop_per_adv_set(per_adv);
	stop_ext_adv_set(per_adv);

	delete_adv_set(per_adv);
	per_adv = NULL;

	TEST_PASS("Periodic advertiser coded PHY passed");
}
#endif /* CONFIG_BT_CTLR_PHY_CODED */

static void main_per_adv_conn_advertiser(void)
{
	struct bt_le_ext_adv *conn_adv;
	struct bt_le_ext_adv *per_adv;

	common_init();

	create_per_adv_set(&per_adv);
	create_conn_adv_set(&conn_adv);

	start_per_adv_set(per_adv);
	start_ext_adv_set(per_adv);
	start_ext_adv_set(conn_adv);

	WAIT_FOR_FLAG(flag_connected);

	/* Advertise for a bit */
	k_sleep(K_SECONDS(10));

	stop_per_adv_set(per_adv);
	stop_ext_adv_set(per_adv);
	stop_ext_adv_set(conn_adv);

	delete_adv_set(per_adv);
	per_adv = NULL;
	delete_adv_set(conn_adv);
	conn_adv = NULL;

	TEST_PASS("Periodic advertiser passed");
}

static void main_per_adv_conn_privacy_advertiser(void)
{
	struct bt_le_ext_adv *conn_adv;
	struct bt_le_ext_adv *per_adv;

	common_init();

	create_conn_adv_set(&conn_adv);

	start_ext_adv_set(conn_adv);

	WAIT_FOR_FLAG(flag_connected);
	WAIT_FOR_FLAG(flag_bonded);

	/* Start periodic advertising after bonding so that the scanner gets
	 * the resolved address
	 */
	create_per_adv_set(&per_adv);
	start_per_adv_set(per_adv);
	start_ext_adv_set(per_adv);

	/* Advertise for a bit */
	k_sleep(K_SECONDS(10));

	stop_per_adv_set(per_adv);
	stop_ext_adv_set(per_adv);
	stop_ext_adv_set(conn_adv);

	delete_adv_set(per_adv);
	per_adv = NULL;
	delete_adv_set(conn_adv);
	conn_adv = NULL;

	TEST_PASS("Periodic advertiser passed");
}

static void main_per_adv_long_data_advertiser(void)
{
	struct bt_le_ext_adv *per_adv;

	common_init();

	create_per_adv_set(&per_adv);

	set_per_adv_data(per_adv);
	start_per_adv_set(per_adv);
	start_ext_adv_set(per_adv);

	/* Advertise for a bit */
	k_sleep(K_SECONDS(10));

	stop_per_adv_set(per_adv);
	stop_ext_adv_set(per_adv);

	delete_adv_set(per_adv);
	per_adv = NULL;

	TEST_PASS("Periodic long data advertiser passed");
}

static void main_per_adv_update_did(void)
{
	struct bt_le_ext_adv *per_adv;
	int err;

	common_init();

	err = bt_le_ext_adv_create(BT_LE_EXT_ADV_NCONN, NULL, &per_adv);
	if (err != 0) {
		TEST_FAIL("Failed to create advertising set: %d", err);
		return;
	}

	err = bt_le_per_adv_set_param(per_adv,
		BT_LE_PER_ADV_PARAM(BT_GAP_PER_ADV_SLOW_INT_MIN,
				    BT_GAP_PER_ADV_SLOW_INT_MAX,
				    BT_LE_PER_ADV_OPT_INCLUDE_ADI));
	if (err != 0) {
		TEST_FAIL("Failed to set periodic advertising parameters: %d", err);
		return;
	}

	set_per_adv_data(per_adv);
	start_per_adv_set(per_adv);
	start_ext_adv_set(per_adv);

	err = bt_le_per_adv_update_did(per_adv);
	if (err != 0) {
		TEST_FAIL("bt_le_per_adv_update_did failed: %d", err);
		return;
	}

	k_sleep(K_SECONDS(2));

	stop_per_adv_set(per_adv);
	stop_ext_adv_set(per_adv);

	delete_adv_set(per_adv);
	per_adv = NULL;

	TEST_PASS("Periodic advertising update DID passed");
}

static void main_per_adv_sync_term_leak_advertiser(void)
{
	struct bt_le_ext_adv *per_adv;

	common_init();

	create_per_adv_set(&per_adv);

	set_per_adv_data(per_adv);
	start_per_adv_set(per_adv);
	start_ext_adv_set(per_adv);

	(void)k_sleep(K_MSEC(TERM_LEAK_ADV_MS));

	stop_per_adv_set(per_adv);
	stop_ext_adv_set(per_adv);

	delete_adv_set(per_adv);
	per_adv = NULL;

	TEST_PASS("Periodic advertising sync terminate leak advertiser passed");
}

static const struct bst_test_instance per_adv_advertiser[] = {
	{
		.test_id = "per_adv_advertiser",
		.test_descr = "Basic periodic advertising test. "
			      "Will just start periodic advertising.",
		.test_main_f = main_per_adv_advertiser
	},
#if defined(CONFIG_BT_CTLR_PHY_CODED)
	{
		.test_id = "per_adv_advertiser_coded_phy",
		.test_descr = "Basic periodic advertising test on Coded PHY. "
			      "Advertiser and periodic advertiser uses Coded PHY",
		.test_main_f = main_per_adv_advertiser_coded
	},
#endif /* CONFIG_BT_CTLR_PHY_CODED */
	{
		.test_id = "per_adv_conn_advertiser",
		.test_descr = "Periodic advertising test with concurrent ACL "
			      "and PA sync.",
		.test_main_f = main_per_adv_conn_advertiser
	},
	{
		.test_id = "per_adv_conn_privacy_advertiser",
		.test_descr = "Periodic advertising test with concurrent ACL "
			      "with bonding and PA sync.",
		.test_main_f = main_per_adv_conn_privacy_advertiser
	},
	{
		.test_id = "per_adv_long_data_advertiser",
		.test_descr = "Periodic advertising test with a longer data length. "
			      "To test the reassembly of large data packets",
		.test_main_f = main_per_adv_long_data_advertiser
	},
	{
		.test_id = "per_adv_update_did",
		.test_descr = "Periodic advertising DID update test. "
			      "Verifies bt_le_per_adv_update_did returns success.",
		.test_main_f = main_per_adv_update_did
	},
	{
		.test_id = "per_adv_sync_term_leak_advertiser",
		.test_descr = "Advertises a chained periodic train for long enough "
			      "for the scanner to sweep sync/terminate cycles.",
		.test_main_f = main_per_adv_sync_term_leak_advertiser
	},
	BSTEST_END_MARKER
};

struct bst_test_list *test_per_adv_advertiser(struct bst_test_list *tests)
{
	return bst_add_tests(tests, per_adv_advertiser);
}
```

## src/per_adv_sync.c
```c
/*
 * Copyright (c) 2023 Nordic Semiconductor ASA
 *
 * SPDX-License-Identifier: Apache-2.0
 */

#include <errno.h>
#include <zephyr/kernel.h>
#include <zephyr/types.h>
#include <zephyr/sys/clock.h>
#include <zephyr/sys/printk.h>
#include <zephyr/bluetooth/bluetooth.h>
#include <zephyr/bluetooth/hci.h>
#include <zephyr/bluetooth/conn.h>
#include <zephyr/bluetooth/uuid.h>
#include <zephyr/bluetooth/gatt.h>

#include "babblekit/testcase.h"
#include "babblekit/flags.h"
#include "common.h"

extern enum bst_result_t bst_result;

static struct bt_conn *g_conn;
static bt_addr_le_t per_addr;
static uint8_t per_sid;

DEFINE_FLAG_STATIC(flag_connected);
DEFINE_FLAG_STATIC(flag_bonded);
DEFINE_FLAG_STATIC(flag_per_adv);
DEFINE_FLAG_STATIC(flag_per_adv_sync);
DEFINE_FLAG_STATIC(flag_per_adv_sync_lost);
DEFINE_FLAG_STATIC(flag_per_adv_recv);

static void connected(struct bt_conn *conn, uint8_t err)
{
	if (err != BT_HCI_ERR_SUCCESS) {
		TEST_FAIL("Failed to connect to %s: %u", bt_conn_dst_str(conn), err);
		return;
	}

	printk("Connected to %s\n", bt_conn_dst_str(conn));
	g_conn = bt_conn_ref(conn);
	SET_FLAG(flag_connected);
}

static void disconnected(struct bt_conn *conn, uint8_t reason)
{
	printk("Disconnected: %s (reason %u)\n", bt_conn_dst_str(conn), reason);

	bt_conn_drop(&g_conn);
}

static struct bt_conn_cb conn_cbs = {
	.connected = connected,
	.disconnected = disconnected,
};

static void pairing_complete_cb(struct bt_conn *conn, bool bonded)
{
	if (conn == g_conn && bonded) {
		SET_FLAG(flag_bonded);
	}
}

static struct bt_conn_auth_info_cb auto_info_cbs = {
	.pairing_complete = pairing_complete_cb,
};

static void scan_recv(const struct bt_le_scan_recv_info *info,
		      struct net_buf_simple *buf)
{
	if (!IS_FLAG_SET(flag_connected) &&
	    info->adv_props & BT_GAP_ADV_PROP_CONNECTABLE) {
		int err;

		printk("Stopping scan\n");
		err = bt_le_scan_stop();
		if (err != 0) {
			TEST_FAIL("Failed to stop scan: %d", err);
			return;
		}

		err = bt_conn_le_create(info->addr, BT_CONN_LE_CREATE_CONN,
					BT_LE_CONN_PARAM_DEFAULT, &g_conn);
		if (err != 0) {
			TEST_FAIL("Could not connect to peer: %d", err);
			return;
		}
	} else if (!IS_FLAG_SET(flag_per_adv) && info->interval != 0U) {

		per_sid = info->sid;
		bt_addr_le_copy(&per_addr, info->addr);

		SET_FLAG(flag_per_adv);
	}
}

static struct bt_le_scan_cb scan_callbacks = {
	.recv = scan_recv,
};

static void sync_cb(struct bt_le_per_adv_sync *sync,
		    struct bt_le_per_adv_sync_synced_info *info)
{
	printk("PER_ADV_SYNC[%u]: [DEVICE]: %s synced, "
	       "Interval 0x%04x (%u us)\n",
	       bt_le_per_adv_sync_get_index(sync), bt_addr_le_str(info->addr),
	       info->interval, BT_CONN_INTERVAL_TO_US(info->interval));

	SET_FLAG(flag_per_adv_sync);
}

static void term_cb(struct bt_le_per_adv_sync *sync,
		    const struct bt_le_per_adv_sync_term_info *info)
{
	printk("PER_ADV_SYNC[%u]: [DEVICE]: %s sync terminated\n",
	       bt_le_per_adv_sync_get_index(sync), bt_addr_le_str(info->addr));

	SET_FLAG(flag_per_adv_sync_lost);
}

static void recv_cb(struct bt_le_per_adv_sync *recv_sync,
		    const struct bt_le_per_adv_sync_recv_info *info,
		    struct net_buf_simple *buf)
{
	uint8_t buf_data_len;

	if (IS_FLAG_SET(flag_per_adv_recv)) {
		return;
	}

	printk("PER_ADV_SYNC[%u]: [DEVICE]: %s advertisement received\n",
	       bt_le_per_adv_sync_get_index(recv_sync), bt_addr_le_str(info->addr));

	while (buf->len > 0) {
		buf_data_len = (uint8_t)net_buf_simple_pull_le16(buf);
		if (buf->data[0] - 1 != sizeof(mfg_data) ||
			memcmp(buf->data, mfg_data, sizeof(mfg_data))) {
			TEST_FAIL("Unexpected adv data received");
		}
		net_buf_simple_pull(buf, ARRAY_SIZE(mfg_data));
	}

	SET_FLAG(flag_per_adv_recv);
}

static struct bt_le_per_adv_sync_cb sync_callbacks = {
	.synced = sync_cb,
	.term = term_cb,
	.recv = recv_cb,
};

static void common_init(void)
{
	int err;

	err = bt_enable(NULL);

	if (err) {
		TEST_FAIL("Bluetooth init failed: %d", err);
		return;
	}

	bt_le_scan_cb_register(&scan_callbacks);
	bt_le_per_adv_sync_cb_register(&sync_callbacks);
	bt_conn_cb_register(&conn_cbs);
	bt_conn_auth_info_cb_register(&auto_info_cbs);
}

static void start_scan(void)
{
	int err;

	printk("Start scanning...");

	err = bt_le_scan_start(IS_ENABLED(CONFIG_BT_CTLR_PHY_CODED) ?
			       BT_LE_SCAN_CODED_ACTIVE : BT_LE_SCAN_ACTIVE,
			       NULL);
	if (err) {
		TEST_FAIL("Failed to start scan: %d", err);
		return;
	}
	printk("done.\n");
}

static void create_pa_sync(struct bt_le_per_adv_sync **sync)
{
	struct bt_le_per_adv_sync_param sync_create_param = { 0 };
	int err;

	printk("Creating periodic advertising sync...");
	bt_addr_le_copy(&sync_create_param.addr, &per_addr);
	sync_create_param.options = 0;
	sync_create_param.sid = per_sid;
	sync_create_param.skip = 0;
	sync_create_param.timeout = 0x0a;
	err = bt_le_per_adv_sync_create(&sync_create_param, sync);
	if (err) {
		TEST_FAIL("Failed to create periodic advertising sync: %d", err);
		return;
	}
	printk("done.\n");

	printk("Waiting for periodic sync...\n");
	WAIT_FOR_FLAG(flag_per_adv_sync);
	printk("Periodic sync established.\n");
}

static void start_bonding(void)
{
	int err;

	printk("Setting security...");
	err = bt_conn_set_security(g_conn, BT_SECURITY_L2);
	if (err) {
		TEST_FAIL("Failed to set security: %d", err);
		return;
	}
	printk("done.\n");
}

static void unregister_cb(void)
{
	int err;

	err = bt_le_per_adv_sync_cb_unregister(&sync_callbacks);
	if (err != 0) {
		TEST_FAIL("Failed to unregister callbacks: %d", err);
	}
}

static void main_per_adv_sync(void)
{
	struct bt_le_per_adv_sync *sync = NULL;

	common_init();
	start_scan();

	printk("Waiting for periodic advertising...\n");
	WAIT_FOR_FLAG(flag_per_adv);
	printk("Found periodic advertising.\n");

	create_pa_sync(&sync);

	printk("Waiting for periodic sync lost...\n");
	WAIT_FOR_FLAG(flag_per_adv_sync_lost);

	TEST_PASS("Periodic advertising sync passed");
}

static void main_per_adv_sync_app_not_scanning(void)
{
	int err;
	struct bt_le_per_adv_sync *sync = NULL;

	common_init();
	start_scan();

	printk("Waiting for periodic advertising...\n");
	WAIT_FOR_FLAG(flag_per_adv);
	printk("Found periodic advertising.\n");

	printk("Stopping scan\n");
	err = bt_le_scan_stop();
	if (err != 0) {
		TEST_FAIL("Failed to stop scan: %d", err);
		return;
	}

	create_pa_sync(&sync);

	printk("Waiting for periodic sync lost...\n");
	WAIT_FOR_FLAG(flag_per_adv_sync_lost);

	TEST_PASS("Periodic advertising sync passed");
}

static void main_per_adv_conn_sync(void)
{
	struct bt_le_per_adv_sync *sync = NULL;

	common_init();
	start_scan();

	printk("Waiting for connection...");
	WAIT_FOR_FLAG(flag_connected);
	printk("done.\n");

	start_scan();

	printk("Waiting for periodic advertising...\n");
	WAIT_FOR_FLAG(flag_per_adv);
	printk("Found periodic advertising.\n");

	create_pa_sync(&sync);

	printk("Waiting for periodic sync lost...\n");
	WAIT_FOR_FLAG(flag_per_adv_sync_lost);

	TEST_PASS("Periodic advertising sync passed");
}

static void main_per_adv_conn_privacy_sync(void)
{
	struct bt_le_per_adv_sync *sync = NULL;

	common_init();
	start_scan();

	printk("Waiting for connection...");
	WAIT_FOR_FLAG(flag_connected);
	printk("done.\n");

	start_bonding();

	printk("Waiting for bonding...");
	WAIT_FOR_FLAG(flag_bonded);
	printk("done.\n");

	start_scan();

	printk("Waiting for periodic advertising...\n");
	WAIT_FOR_FLAG(flag_per_adv);
	printk("Found periodic advertising.\n");

	create_pa_sync(&sync);

	printk("Waiting for periodic sync lost...\n");
	WAIT_FOR_FLAG(flag_per_adv_sync_lost);

	TEST_PASS("Periodic advertising sync passed");
}

static void main_per_adv_long_data_sync(void)
{
#if (CONFIG_BT_PER_ADV_SYNC_BUF_SIZE > 0)
	struct bt_le_per_adv_sync *sync = NULL;

	common_init();
	start_scan();

	printk("Waiting for periodic advertising...\n");
	WAIT_FOR_FLAG(flag_per_adv);
	printk("Found periodic advertising.\n");

	create_pa_sync(&sync);

	printk("Waiting to receive periodic advertisement...\n");
	WAIT_FOR_FLAG(flag_per_adv_recv);

	printk("Waiting for periodic sync lost...\n");
	WAIT_FOR_FLAG(flag_per_adv_sync_lost);
#endif
	TEST_PASS("Periodic advertising long data sync passed");
}

static void main_per_adv_unregister_sync_cb(void)
{
	struct bt_le_per_adv_sync *sync = NULL;

	common_init();
	start_scan();

	printk("Waiting for periodic advertising...\n");
	WAIT_FOR_FLAG(flag_per_adv);
	printk("Found periodic advertising.\n");

	create_pa_sync(&sync);

	printk("Waiting to receive periodic advertisement...\n");
	WAIT_FOR_FLAG(flag_per_adv_recv);

	unregister_cb();
	UNSET_FLAG(flag_per_adv_recv);
	k_sleep(K_SECONDS(2));

	if (IS_FLAG_SET(flag_per_adv_recv)) {
		/* Rarely the testcase might fail here due to a race condition as brought up in:
		 * https://github.com/zephyrproject-rtos/zephyr/pull/98458#issuecomment-3474097193
		 */
		TEST_FAIL("Received a callback after bt_le_per_adv_sync_cb_unregister");
		return;
	}

	bt_le_per_adv_sync_cb_register(&sync_callbacks);
	WAIT_FOR_FLAG(flag_per_adv_recv);

	printk("Waiting for periodic sync lost...\n");
	WAIT_FOR_FLAG(flag_per_adv_sync_lost);
	TEST_PASS("Periodic advertising sync callback unregister passed");
}

/* Sync to a chained train and terminate while the chain is in flight, walking the terminate
 * instant across it (common.h). With one auxiliary context (BT_CTLR_SCAN_AUX_SET=1), a stranded
 * context stops any later sync.
 */

static void main_per_adv_sync_term_leak(void)
{
	struct bt_le_per_adv_sync_param sync_create_param = { 0 };
	struct bt_le_per_adv_sync *sync = NULL;
	uint32_t offset_us = 0U;
	int err;

	common_init();
	start_scan();

	printk("Waiting for periodic advertising...\n");
	WAIT_FOR_FLAG(flag_per_adv);
	printk("Found periodic advertising.\n");

	for (uint32_t i = 0U; i < TERM_LEAK_ITERATIONS; i++) {
		printk("Sync/terminate iteration %u, terminate offset %u us\n", i, offset_us);

		UNSET_FLAG(flag_per_adv_sync);
		UNSET_FLAG(flag_per_adv_recv);
		UNSET_FLAG(flag_per_adv_sync_lost);

		bt_addr_le_copy(&sync_create_param.addr, &per_addr);
		sync_create_param.options = 0;
		sync_create_param.sid = per_sid;
		sync_create_param.skip = 0;
		sync_create_param.timeout = 0x0a;

		err = bt_le_per_adv_sync_create(&sync_create_param, &sync);
		if (err != 0) {
			TEST_FAIL("Iteration %u: failed to create sync: %d", i, err);
		}

		WAIT_FOR_FLAG_TIMEOUT(flag_per_adv_sync, K_MSEC(TERM_LEAK_TIMEOUT_MS));
		if (!IS_FLAG_SET(flag_per_adv_sync)) {
			TEST_FAIL("Iteration %u: periodic sync never established. An "
				  "auxiliary context stranded by an earlier terminate is "
				  "never released, so the pool stays empty.", i);
		}

		/* Walk the terminate instant across the chain reception */
		(void)k_sleep(K_USEC(offset_us));
		offset_us += TERM_LEAK_STEP_US;

		err = bt_le_per_adv_sync_delete(sync);
		if (err != 0) {
			TEST_FAIL("Iteration %u: failed to delete sync: %d", i, err);
		}
		sync = NULL;
	}

	TEST_PASS("Periodic advertising sync terminate did not strand an auxiliary context");
}

static const struct bst_test_instance per_adv_sync[] = {
	{
		.test_id = "per_adv_sync",
		.test_descr = "Basic periodic advertising sync test. "
			      "Will just sync to a periodic advertiser.",
		.test_main_f = main_per_adv_sync
	},
	{
		.test_id = "per_adv_sync_app_not_scanning",
		.test_descr = "Basic periodic advertising sync test but where "
			      "the app stopped scanning before creating sync."
			      "Expect the host to start scanning automatically.",
		.test_main_f = main_per_adv_sync_app_not_scanning
	},
	{
		.test_id = "per_adv_conn_sync",
		.test_descr = "Periodic advertising sync test, but where there "
			      "is a connection between the advertiser and the "
			      "synchronized device.",
		.test_main_f = main_per_adv_conn_sync
	},
	{
		.test_id = "per_adv_conn_privacy_sync",
		.test_descr = "Periodic advertising sync test, but where "
			      "advertiser and synchronized device are bonded and using  "
			      "privacy",
		.test_main_f = main_per_adv_conn_privacy_sync
	},
	{
		.test_id = "per_adv_long_data_sync",
		.test_descr = "Periodic advertising sync test with larger "
			      "data length. Test is used to verify that "
			      "reassembly of long data is handled correctly.",
		.test_main_f = main_per_adv_long_data_sync
	},
	{
		.test_id = "per_adv_unregister_sync_cb",
		.test_descr = "Periodic advertising sync test, but sync callbacks "
			      "get unregistered. Test is used to verify that "
			      "the sync callbacks can be properly unregistered.",
		.test_main_f = main_per_adv_unregister_sync_cb
	},
	{
		.test_id = "per_adv_sync_term_leak",
		.test_descr = "Repeatedly sync to a chained periodic train and "
			      "terminate while a chain is in flight, sweeping the "
			      "terminate instant. Verifies that terminate does not "
			      "strand an auxiliary context.",
		.test_main_f = main_per_adv_sync_term_leak
	},
	BSTEST_END_MARKER
};

struct bst_test_list *test_per_adv_sync(struct bst_test_list *tests)
{
	return bst_add_tests(tests, per_adv_sync);
}
```

## src/per_adv_syncer.c
```c
/*
 * Copyright (c) 2023 Nordic Semiconductor ASA
 *
 * SPDX-License-Identifier: Apache-2.0
 */
#include <zephyr/kernel.h>

#include "bs_types.h"
#include "bs_tracing.h"
#include "time_machine.h"
#include "bstests.h"

#include <zephyr/types.h>
#include <zephyr/sys/printk.h>

#include <zephyr/bluetooth/bluetooth.h>

#include "common.h"

extern enum bst_result_t bst_result;

static struct bt_conn *g_conn;
static bt_addr_le_t per_addr;
static uint8_t per_sid;

CREATE_FLAG(flag_connected);
CREATE_FLAG(flag_bonded);
CREATE_FLAG(flag_per_adv);
CREATE_FLAG(flag_per_adv_sync);
CREATE_FLAG(flag_per_adv_sync_lost);
CREATE_FLAG(flag_per_adv_recv);

static void connected(struct bt_conn *conn, uint8_t err)
{
	char addr[BT_ADDR_LE_STR_LEN];

	bt_addr_le_to_str(bt_conn_get_dst(conn), addr, sizeof(addr));

	if (err != BT_HCI_ERR_SUCCESS) {
		FAIL("Failed to connect to %s: %u\n", addr, err);
		return;
	}

	printk("Connected to %s\n", addr);
	g_conn = bt_conn_ref(conn);
	SET_FLAG(flag_connected);
}

static void disconnected(struct bt_conn *conn, uint8_t reason)
{
	char addr[BT_ADDR_LE_STR_LEN];

	bt_addr_le_to_str(bt_conn_get_dst(conn), addr, sizeof(addr));

	printk("Disconnected: %s (reason %u)\n", addr, reason);

	bt_conn_unref(g_conn);
	g_conn = NULL;
}

static struct bt_conn_cb conn_cbs = {
	.connected = connected,
	.disconnected = disconnected,
};

static void pairing_complete_cb(struct bt_conn *conn, bool bonded)
{
	if (conn == g_conn && bonded) {
		SET_FLAG(flag_bonded);
	}
}

static struct bt_conn_auth_info_cb auto_info_cbs = {
	.pairing_complete = pairing_complete_cb,
};

static void scan_recv(const struct bt_le_scan_recv_info *info,
		      struct net_buf_simple *buf)
{
	if (!TEST_FLAG(flag_connected) &&
	    info->adv_props & BT_GAP_ADV_PROP_CONNECTABLE) {
		int err;

		printk("Stopping scan\n");
		err = bt_le_scan_stop();
		if (err != 0) {
			FAIL("Failed to stop scan: %d", err);
			return;
		}

		err = bt_conn_le_create(info->addr, BT_CONN_LE_CREATE_CONN,
					BT_LE_CONN_PARAM_DEFAULT, &g_conn);
		if (err != 0) {
			FAIL("Could not connect to peer: %d", err);
			return;
		}
	} else if (!TEST_FLAG(flag_per_adv) && info->interval != 0U) {

		per_sid = info->sid;
		bt_addr_le_copy(&per_addr, info->addr);

		SET_FLAG(flag_per_adv);
	}
}

static struct bt_le_scan_cb scan_callbacks = {
	.recv = scan_recv,
};

static void sync_cb(struct bt_le_per_adv_sync *sync,
		    struct bt_le_per_adv_sync_synced_info *info)
{
	char le_addr[BT_ADDR_LE_STR_LEN];

	bt_addr_le_to_str(info->addr, le_addr, sizeof(le_addr));

	printk("PER_ADV_SYNC[%u]: [DEVICE]: %s synced, "
	       "Interval 0x%04x (%u us)\n",
	       bt_le_per_adv_sync_get_index(sync), le_addr,
	       info->interval, BT_CONN_INTERVAL_TO_US(info->interval));

	SET_FLAG(flag_per_adv_sync);
}

static void term_cb(struct bt_le_per_adv_sync *sync,
		    const struct bt_le_per_adv_sync_term_info *info)
{
	char le_addr[BT_ADDR_LE_STR_LEN];

	bt_addr_le_to_str(info->addr, le_addr, sizeof(le_addr));

	printk("PER_ADV_SYNC[%u]: [DEVICE]: %s sync terminated\n",
	       bt_le_per_adv_sync_get_index(sync), le_addr);

	SET_FLAG(flag_per_adv_sync_lost);
}

static void recv_cb(struct bt_le_per_adv_sync *recv_sync,
		    const struct bt_le_per_adv_sync_recv_info *info,
		    struct net_buf_simple *buf)
{
	char le_addr[BT_ADDR_LE_STR_LEN];
	uint8_t buf_data_len;

	if (TEST_FLAG(flag_per_adv_recv)) {
		return;
	}

	bt_addr_le_to_str(info->addr, le_addr, sizeof(le_addr));
	printk("PER_ADV_SYNC[%u]: [DEVICE]: %s advertisment received\n",
	       bt_le_per_adv_sync_get_index(recv_sync), le_addr);

	while (buf->len > 0) {
		buf_data_len = (uint8_t)net_buf_simple_pull_le16(buf);
		if (buf->data[0] - 1 != sizeof(mfg_data) ||
			memcmp(buf->data, mfg_data, sizeof(mfg_data))) {
			FAIL("Unexpected adv data received\n");
		}
		net_buf_simple_pull(buf, ARRAY_SIZE(mfg_data));
	}

	SET_FLAG(flag_per_adv_recv);
}

static struct bt_le_per_adv_sync_cb sync_callbacks = {
	.synced = sync_cb,
	.term = term_cb,
	.recv = recv_cb,
};

static void common_init(void)
{
	int err;

	err = bt_enable(NULL);

	if (err) {
		FAIL("Bluetooth init failed: %d\n", err);
		return;
	}

	bt_le_scan_cb_register(&scan_callbacks);
	bt_le_per_adv_sync_cb_register(&sync_callbacks);
	bt_conn_cb_register(&conn_cbs);
	bt_conn_auth_info_cb_register(&auto_info_cbs);
}

static void start_scan(void)
{
	int err;

	printk("Start scanning...");

	err = bt_le_scan_start(IS_ENABLED(CONFIG_BT_CTLR_PHY_CODED) ?
			       BT_LE_SCAN_CODED_ACTIVE : BT_LE_SCAN_ACTIVE,
			       NULL);
	if (err) {
		FAIL("Failed to start scan: %d\n", err);
		return;
	}
	printk("done.\n");
}

static void create_pa_sync(struct bt_le_per_adv_sync **sync)
{
	struct bt_le_per_adv_sync_param sync_create_param = { 0 };
	int err;

	printk("Creating periodic advertising sync...");
	bt_addr_le_copy(&sync_create_param.addr, &per_addr);
	sync_create_param.options = 0;
	sync_create_param.sid = per_sid;
	sync_create_param.skip = 0;
	sync_create_param.timeout = 0x0a;
	err = bt_le_per_adv_sync_create(&sync_create_param, sync);
	if (err) {
		FAIL("Failed to create periodic advertising sync: %d\n", err);
		return;
	}
	printk("done.\n");

	printk("Waiting for periodic sync...\n");
	WAIT_FOR_FLAG(flag_per_adv_sync);
	printk("Periodic sync established.\n");
}

static void start_bonding(void)
{
	int err;

	printk("Setting security...");
	err = bt_conn_set_security(g_conn, BT_SECURITY_L2);
	if (err) {
		FAIL("Failed to set security: %d\n", err);
		return;
	}
	printk("done.\n");
}

static void main_per_adv_syncer(void)
{
	struct bt_le_per_adv_sync *sync = NULL;

	common_init();
	start_scan();

	printk("Waiting for periodic advertising...\n");
	WAIT_FOR_FLAG(flag_per_adv);
	printk("Found periodic advertising.\n");

	create_pa_sync(&sync);

	printk("Waiting for periodic sync lost...\n");
	WAIT_FOR_FLAG(flag_per_adv_sync_lost);

	PASS("Periodic advertising syncer passed\n");
}

static void main_per_adv_syncer_app_not_scanning(void)
{
	int err;
	struct bt_le_per_adv_sync *sync = NULL;

	common_init();
	start_scan();

	printk("Waiting for periodic advertising...\n");
	WAIT_FOR_FLAG(flag_per_adv);
	printk("Found periodic advertising.\n");

	printk("Stopping scan\n");
	err = bt_le_scan_stop();
	if (err != 0) {
		FAIL("Failed to stop scan: %d", err);
		return;
	}

	create_pa_sync(&sync);

	printk("Waiting for periodic sync lost...\n");
	WAIT_FOR_FLAG(flag_per_adv_sync_lost);

	PASS("Periodic advertising syncer passed\n");
}

static void main_per_adv_conn_syncer(void)
{
	struct bt_le_per_adv_sync *sync = NULL;

	common_init();
	start_scan();

	printk("Waiting for connection...");
	WAIT_FOR_FLAG(flag_connected);
	printk("done.\n");

	start_scan();

	printk("Waiting for periodic advertising...\n");
	WAIT_FOR_FLAG(flag_per_adv);
	printk("Found periodic advertising.\n");

	create_pa_sync(&sync);

	printk("Waiting for periodic sync lost...\n");
	WAIT_FOR_FLAG(flag_per_adv_sync_lost);

	PASS("Periodic advertising syncer passed\n");
}

static void main_per_adv_conn_privacy_syncer(void)
{
	struct bt_le_per_adv_sync *sync = NULL;

	common_init();
	start_scan();

	printk("Waiting for connection...");
	WAIT_FOR_FLAG(flag_connected);
	printk("done.\n");

	start_bonding();

	printk("Waiting for bonding...");
	WAIT_FOR_FLAG(flag_bonded);
	printk("done.\n");

	start_scan();

	printk("Waiting for periodic advertising...\n");
	WAIT_FOR_FLAG(flag_per_adv);
	printk("Found periodic advertising.\n");

	create_pa_sync(&sync);

	printk("Waiting for periodic sync lost...\n");
	WAIT_FOR_FLAG(flag_per_adv_sync_lost);

	PASS("Periodic advertising syncer passed\n");
}

static void main_per_adv_long_data_syncer(void)
{
#if (CONFIG_BT_PER_ADV_SYNC_BUF_SIZE > 0)
	struct bt_le_per_adv_sync *sync = NULL;

	common_init();
	start_scan();

	printk("Waiting for periodic advertising...\n");
	WAIT_FOR_FLAG(flag_per_adv);
	printk("Found periodic advertising.\n");

	create_pa_sync(&sync);

	printk("Waiting to receive periodic advertisment...\n");
	WAIT_FOR_FLAG(flag_per_adv_recv);

	printk("Waiting for periodic sync lost...\n");
	WAIT_FOR_FLAG(flag_per_adv_sync_lost);
#endif
	PASS("Periodic advertising long data syncer passed\n");
}

static const struct bst_test_instance per_adv_syncer[] = {
	{
		.test_id = "per_adv_syncer",
		.test_descr = "Basic periodic advertising sync test. "
			      "Will just sync to a periodic advertiser.",
		.test_post_init_f = test_init,
		.test_tick_f = test_tick,
		.test_main_f = main_per_adv_syncer
	},
	{
		.test_id = "per_adv_syncer_app_not_scanning",
		.test_descr = "Basic periodic advertising sync test but where "
			      "the app stopped scanning before creating sync."
			      "Expect the host to start scanning automatically.",
		.test_post_init_f = test_init,
		.test_tick_f = test_tick,
		.test_main_f = main_per_adv_syncer_app_not_scanning
	},
	{
		.test_id = "per_adv_conn_syncer",
		.test_descr = "Periodic advertising sync test, but where there "
			      "is a connection between the advertiser and the "
			      "syncer.",
		.test_post_init_f = test_init,
		.test_tick_f = test_tick,
		.test_main_f = main_per_adv_conn_syncer
	},
	{
		.test_id = "per_adv_conn_privacy_syncer",
		.test_descr = "Periodic advertising sync test, but where "
			      "advertiser and syncer are bonded and using  "
			      "privacy",
		.test_post_init_f = test_init,
		.test_tick_f = test_tick,
		.test_main_f = main_per_adv_conn_privacy_syncer
	},
	{
		.test_id = "per_adv_long_data_syncer",
		.test_descr = "Periodic advertising sync test with larger "
			      "data length. Test is used to verify that "
			      "reassembly of long data is handeled correctly.",
		.test_post_init_f = test_init,
		.test_tick_f = test_tick,
		.test_main_f = main_per_adv_long_data_syncer
	},
	BSTEST_END_MARKER
};

struct bst_test_list *test_per_adv_syncer(struct bst_test_list *tests)
{
	return bst_add_tests(tests, per_adv_syncer);
}
```
