## tests/bsim/bluetooth/host/adv/periodic/testcase.yaml
```yaml
common:
  tags:
    - bluetooth
  platform_allow:
    - nrf52_bsim/native
    - nrf5340bsim/nrf5340/cpunet
  harness: bsim

tests:
  bluetooth.host.adv.periodic:
    # nrf54l15bsim/nrf54l15/cpuapp not allowed as per_adv_conn_privacy.sh returns with
    # "The advertiser disconnects with reason 61 (BT_HCI_ERR_AUTH_FAIL)"
    harness_config:
      bsim_exe_name: tests_bsim_bluetooth_host_adv_periodic_prj_conf
      fixture:
        - bsim_multi_test
      tests_scripts:
        - tests_scripts/per_adv.sh
        - tests_scripts/per_adv_conn.sh
        - tests_scripts/per_adv_conn_privacy.sh
        - tests_scripts/per_adv_app_not_scanning.sh
        - tests_scripts/per_adv_unregister_sync_cb.sh
  bluetooth.host.adv.periodic.coded:
    platform_allow:
      - nrf54l15bsim/nrf54l15/cpuapp
    harness_config:
      bsim_exe_name: tests_bsim_bluetooth_host_adv_periodic_prj_coded_conf
      fixture:
        - bsim_multi_test
      tests_scripts:
        - tests_scripts/per_adv_app_not_scanning_coded.sh
    extra_args:
      EXTRA_CONF_FILE=prj_coded.conf
  bluetooth.host.adv.periodic.long_data:
    platform_allow:
      - nrf54l15bsim/nrf54l15/cpuapp
    harness_config:
      bsim_exe_name: tests_bsim_bluetooth_host_adv_periodic_prj_long_data_conf
      fixture:
        - bsim_multi_test
      tests_scripts:
        - tests_scripts/per_adv_long_data.sh
    extra_args:
      EXTRA_CONF_FILE=prj_long_data.conf
```

## tests/bsim/bluetooth/host/att/eatt/testcase.yaml
```yaml
common:
  build_only: true
  tags:
    - bluetooth
  platform_allow:
    - nrf52_bsim/native
  harness: bsim

tests:
  bluetooth.host.att.eatt.autoconnect:
    harness_config:
      bsim_exe_name: tests_bsim_bluetooth_host_att_eatt_prj_autoconnect_conf
    extra_args:
      EXTRA_CONF_FILE=prj_autoconnect.conf
  bluetooth.host.adt.eatt.collision:
    harness_config:
      bsim_exe_name: tests_bsim_bluetooth_host_att_eatt_prj_collision_conf
  bluetooth.host.att.eatt.lowres:
    harness_config:
      bsim_exe_name: tests_bsim_bluetooth_host_att_eatt_prj_lowres_conf
    extra_args:
      EXTRA_CONF_FILE=prj_lowres.conf
  bluetooth.host.att.eatt.multiple_conn:
    harness_config:
      bsim_exe_name: tests_bsim_bluetooth_host_att_eatt_prj_multiple_conn_conf
    extra_args:
      EXTRA_CONF_FILE=prj_multiple_conn.conf
```

## tests/bsim/bluetooth/host/att/eatt_notif/testcase.yaml
```yaml
tests:
  bluetooth.host.att.eatt_notif:
    build_only: true
    tags:
      - bluetooth
    platform_allow:
      - nrf52_bsim/native
      - nrf5340bsim/nrf5340/cpunet
    harness: bsim
    harness_config:
      bsim_exe_name: tests_bsim_bluetooth_host_att_eatt_notif_prj_conf
```

## tests/bsim/bluetooth/host/att/long_read/testcase.yaml
```yaml
tests:
  bluetooth.host.att.long_read:
    tags:
      - bluetooth
    platform_allow:
      - nrf52_bsim/native
    harness: bsim
    timeout: 30
    harness_config:
      bsim_exe_name: tests_bsim_bluetooth_host_att_long_read_prj_conf
      bsim_verbosity: 2
      bsim_sim_length: 60e6
      bsim_options:
        - -RealEncryption=1
        - -D=2
      bsim_devices:
        - test_id: the_test
        - test_id: the_test
```

## tests/bsim/bluetooth/host/att/mtu_update/testcase.yaml
```yaml
common:
  tags:
    - bluetooth
  platform_allow:
    - nrf52_bsim/native
  harness: bsim
  timeout: 30

tests:
  bluetooth.host.att.mtu_update.build_central:
    build_only: true
    harness_config:
      bsim_exe_name: tests_bsim_bluetooth_host_att_mtu_update_prj_central_conf
    extra_args:
      CONF_FILE=prj_central.conf

  bluetooth.host.att.mtu_update.build_peripheral:
    build_only: true
    harness_config:
      bsim_exe_name: tests_bsim_bluetooth_host_att_mtu_update_prj_peripheral_conf
    extra_args:
      CONF_FILE=prj_peripheral.conf

  bluetooth.host.att.mtu_update.test:
    no_build: true
    harness_config:
      bsim_verbosity: 2
      bsim_sim_length: 60e6
      bsim_options:
        - -RealEncryption=1
      bsim_devices:
        - test_id: central
          exe: tests_bsim_bluetooth_host_att_mtu_update_prj_central_conf
        - test_id: peripheral
          exe: tests_bsim_bluetooth_host_att_mtu_update_prj_peripheral_conf
      bsim_phy_options:
        - -argschannel
        - -at=40
```

## tests/bsim/bluetooth/host/att/open_close/testcase.yaml
```yaml
tests:
  bluetooth.host.att.open_close:
    tags:
      - bluetooth
    platform_allow:
      - nrf52_bsim/native
    timeout: 10
    harness: bsim
    harness_config:
      bsim_exe_name:
        - tests_bsim_bluetooth_host_att_open_close_prj_conf
      bsim_verbosity: 2
      bsim_sim_length: 200e6
      bsim_test_ids:
        - the_test
        - the_test
      bsim_options:
        - -RealEncryption=1
        - -D=2
```

## tests/bsim/bluetooth/host/att/pipeline/dut/Kconfig
```kconfig
# Copyright 2024 Nordic Semiconductor ASA
# SPDX-License-Identifier: Apache-2.0

# This file adds prompts to allow setting the symbols in a
# configuration file (e.g. 'prj.conf'), as needed for some of
# the test variants.

config BT_HCI_TX_PRIO
	prompt ""

config BT_RX_PRIO
	prompt ""

source "Kconfig.zephyr"
```

## tests/bsim/bluetooth/host/att/pipeline/dut/testcase.yaml
```yaml
common:
  build_only: true
  tags:
    - bluetooth
  platform_allow:
    - nrf52_bsim/native
  harness: bsim

tests:
  bluetooth.host.att.pipeline.dut:
    harness_config:
      bsim_exe_name: tests_bsim_bluetooth_host_att_pipeline_dut_prj_conf
  bluetooth.host.att.pipeline.dut_rx_tx_prio:
    harness_config:
      bsim_exe_name:
        tests_bsim_bluetooth_host_att_pipeline_dut_prj_conf_rx_tx_prio_invert_extra_conf
    extra_args:
      EXTRA_CONF_FILE=rx_tx_prio_invert.extra.conf
```

## tests/bsim/bluetooth/host/att/pipeline/testcase.yaml
```yaml
common:
  no_build: true
  tags:
    - bluetooth
  platform_allow:
    - nrf52_bsim/native
  timeout: 240
  harness: bsim
  harness_config:
    bsim_verbosity: 2
    bsim_sim_length: 100e6
    bsim_options:
      - -RealEncryption=1

tests:
  bluetooth.host.att.pipeline.shall_not_pipeline:
    harness_config:
      bsim_devices:
        - test_id: dut_1
          exe: tests_bsim_bluetooth_host_att_pipeline_dut_prj_conf_rx_tx_prio_invert_extra_conf
        - test_id: tester_1
          exe: tests_bsim_bluetooth_host_att_pipeline_tester_prj_conf

  bluetooth.host.att.pipeline.tolerate_pipeline:
    harness_config:
      bsim_devices:
        - test_id: dut
          exe: tests_bsim_bluetooth_host_att_pipeline_dut_prj_conf
        - test_id: dut
          exe: tests_bsim_bluetooth_host_att_pipeline_dut_prj_conf
        - test_id: tester
          exe: tests_bsim_bluetooth_host_att_pipeline_tester_prj_conf
```

## tests/bsim/bluetooth/host/att/pipeline/tester/testcase.yaml
```yaml
tests:
  bluetooth.host.att.pipeline.tester:
    tags:
      - bluetooth
    platform_allow:
      - nrf52_bsim/native
    harness: bsim
    harness_config:
      bsim_exe_name: tests_bsim_bluetooth_host_att_pipeline_tester_prj_conf
```

## tests/bsim/bluetooth/host/att/read_fill_buf/server/testcase.yaml
```yaml
tests:
  bluetooth.host.att.read_fill_buf.server:
    build_only: true
    tags:
      - bluetooth
    platform_allow:
      - nrf52_bsim/native
    harness: bsim
    harness_config:
      bsim_exe_name: tests_bsim_bluetooth_host_att_read_fill_buf_server_prj_conf
```

## tests/bsim/bluetooth/host/att/read_fill_buf/testcase.yaml
```yaml
tests:
  bluetooth.host.att.read_fill_buf.test_read_fil_buf:
    no_build: true
    tags:
      - bluetooth
    platform_allow:
      - nrf52_bsim/native
    timeout: 30
    harness: bsim
    harness_config:
      bsim_verbosity: 2
      bsim_sim_length: 60e6
      bsim_options:
        - -RealEncryption=1
      bsim_devices:
        - test_id: cli
          exe: tests_bsim_bluetooth_host_att_read_fill_buf_client_prj_conf
        - test_id: srv
          exe: tests_bsim_bluetooth_host_att_read_fill_buf_server_prj_conf
```

## tests/bsim/bluetooth/host/att/retry_on_sec_err/client/testcase.yaml
```yaml
tests:
  bluetooth.host.att.retry_on_sec_err.client:
    build_only: true
    tags:
      - bluetooth
    platform_allow:
      - nrf52_bsim/native
    harness: bsim
    harness_config:
      bsim_exe_name: tests_bsim_bluetooth_host_att_retry_on_sec_err_client_prj_conf
```

## tests/bsim/bluetooth/host/att/retry_on_sec_err/server/testcase.yaml
```yaml
tests:
  bluetooth.host.att.retry_on_sec_err.server:
    build_only: true
    tags:
      - bluetooth
    platform_allow:
      - nrf52_bsim/native
    harness: bsim
    harness_config:
      bsim_exe_name: tests_bsim_bluetooth_host_att_retry_on_sec_err_server_prj_conf
```

## tests/bsim/bluetooth/host/att/retry_on_sec_err/testcase.yaml
```yaml
common:
  no_build: true
  tags:
    - bluetooth
  platform_allow:
    - nrf52_bsim/native
  harness: bsim
  timeout: 30
  harness_config:
    bsim_verbosity: 2
    bsim_sim_length: 60e6
    bsim_options:
      - -RealEncryption=1

tests:
  bluetooth.host.att.retry_on_sec_err.retry_on_sec_err:
    harness_config:
      bsim_devices:
        - test_id: test_client
          exe: tests_bsim_bluetooth_host_att_retry_on_sec_err_client_prj_conf
        - test_id: test_server
          exe: tests_bsim_bluetooth_host_att_retry_on_sec_err_server_prj_conf

  bluetooth.host.att.retry_on_sec_err.retry_on_sec_err_sec_request:
    harness_config:
      bsim_devices:
        - test_id: test_client_security_request
          exe: tests_bsim_bluetooth_host_att_retry_on_sec_err_client_prj_conf
        - test_id: test_server_security_request
          exe: tests_bsim_bluetooth_host_att_retry_on_sec_err_server_prj_conf
```

## tests/bsim/bluetooth/host/att/sequential/dut/testcase.yaml
```yaml
tests:
  bluetooth.host.att.sequential.dut:
    build_only: true
    tags:
      - bluetooth
    platform_allow:
      - nrf52_bsim/native
    harness: bsim
    harness_config:
      bsim_exe_name: tests_bsim_bluetooth_host_att_sequential_dut_prj_conf
```

## tests/bsim/bluetooth/host/att/sequential/testcase.yaml
```yaml
tests:
  bluetooth.host.att.sequential.att_sequential:
    no_build: true
    tags:
      - bluetooth
    platform_allow:
      - nrf52_bsim/native
    timeout: 30
    harness: bsim
    harness_config:
      bsim_verbosity: 2
      bsim_sim_length: 10e6
      bsim_options:
        - -RealEncryption=0
      bsim_devices:
        - test_id: dut
          exe: tests_bsim_bluetooth_host_att_sequential_dut_prj_conf
        - test_id: tester
          exe: tests_bsim_bluetooth_host_att_sequential_tester_prj_conf
```

## tests/bsim/bluetooth/host/att/sequential/tester/testcase.yaml
```yaml
tests:
  bluetooth.host.att.sequential.tester:
    build_only: true
    tags:
      - bluetooth
    platform_allow:
      - nrf52_bsim/native
    harness: bsim
    harness_config:
      bsim_exe_name: tests_bsim_bluetooth_host_att_sequential_tester_prj_conf
```

## tests/bsim/bluetooth/host/att/timeout/testcase.yaml
```yaml
tests:
  bluetooth.host.att.timeout:
    build_only: true
    tags:
      - bluetooth
    platform_allow:
      - nrf52_bsim/native
    harness: bsim
    harness_config:
      bsim_exe_name: tests_bsim_bluetooth_host_att_timeout_prj_conf
```

## tests/bsim/bluetooth/host/central/testcase.yaml
```yaml
tests:
  bluetooth.host.central:
    build_only: true
    tags:
      - bluetooth
    platform_allow:
      - nrf52_bsim/native
      - nrf5340bsim/nrf5340/cpunet
    harness: bsim
    harness_config:
      bsim_exe_name: tests_bsim_bluetooth_host_central_prj_conf
```

## tests/bsim/bluetooth/host/gatt/authorization/testcase.yaml
```yaml
tests:
  bluetooth.host.gatt.authorization:
    build_only: true
    tags:
      - bluetooth
    platform_allow:
      - nrf52_bsim/native
      - nrf5340bsim/nrf5340/cpunet
    harness: bsim
    harness_config:
      bsim_exe_name: tests_bsim_bluetooth_host_gatt_authorization_prj_conf
```

## tests/bsim/bluetooth/host/gatt/caching/testcase.yaml
```yaml
common:
  build_only: true
  tags:
    - bluetooth
  platform_allow:
    - nrf52_bsim/native
    - nrf5340bsim/nrf5340/cpunet
  harness: bsim

tests:
  bluetooth.host.gatt.caching:
    harness_config:
      bsim_exe_name: tests_bsim_bluetooth_host_gatt_caching_prj_conf
  bluetooth.host.gatt.caching_psa_overlay:
    harness_config:
      bsim_exe_name: tests_bsim_bluetooth_host_gatt_caching_prj_conf_psa_overlay_conf
    extra_args:
      EXTRA_CONF_FILE=psa_overlay.conf
```

## tests/bsim/bluetooth/host/gatt/ccc_store/testcase.yaml
```yaml
common:
  build_only: true
  tags:
    - bluetooth
  platform_allow:
    - nrf52_bsim/native
  harness: bsim

tests:
  bluetooth.host.gatt.ccc_store:
    harness_config:
      bsim_exe_name: tests_bsim_bluetooth_host_gatt_ccc_store_prj_conf
  bluetooth.host.gatt.ccc_store_no_store_on_write:
    harness_config:
      bsim_exe_name: tests_bsim_bluetooth_host_gatt_ccc_store_overlay-no_store_on_write_conf
    extra_args:
      EXTRA_CONF_FILE=overlay-no_store_on_write.conf
  bluetooth.host.gatt.ccc_store_no_long_wq:
    harness_config:
      bsim_exe_name: tests_bsim_bluetooth_host_gatt_ccc_store_overlay-no_long_wq_conf
    extra_args:
      EXTRA_CONF_FILE=overlay-no_long_wq.conf
```

## tests/bsim/bluetooth/host/gatt/device_name/testcase.yaml
```yaml
tests:
  bluetooth.host.gatt.device_name:
    build_only: true
    tags:
      - bluetooth
    platform_allow:
      - nrf52_bsim/native
    harness: bsim
    harness_config:
      bsim_exe_name: tests_bsim_bluetooth_host_gatt_device_name_prj_conf
```

## tests/bsim/bluetooth/host/gatt/gap_svc/testcase.yaml
```yaml
tests:
  bluetooth.host.gatt.gap_svc:
    build_only: true
    tags:
      - bluetooth
    platform_allow:
      - nrf52_bsim/native
    harness: bsim
    harness_config:
      bsim_exe_name: tests_bsim_bluetooth_host_gatt_gap_svc_prj_conf
```
