## CMakeLists.txt
```
# SPDX-License-Identifier: Apache-2.0

cmake_minimum_required(VERSION 3.28.0)

find_package(Zephyr REQUIRED HINTS $ENV{ZEPHYR_BASE})
project(bsim_test_security_changed_callback)

add_subdirectory(${ZEPHYR_BASE}/tests/bsim/babblekit babblekit)
target_link_libraries(app PRIVATE babblekit)

target_sources(app PRIVATE
  src/bs_bt_utils.c
  src/central.c
  src/main.c
  src/peripheral.c
)

zephyr_include_directories(
  ${BSIM_COMPONENTS_PATH}/libUtilv1/src/
  ${BSIM_COMPONENTS_PATH}/libPhyComv1/src/
)
```

## prj.conf
```kconfig
CONFIG_BT_TESTING=y

CONFIG_BT=y
CONFIG_BT_PERIPHERAL=y
CONFIG_BT_CENTRAL=y

CONFIG_BT_SMP=y
CONFIG_BT_PRIVACY=y

CONFIG_SETTINGS=y
CONFIG_BT_SETTINGS=y
CONFIG_FLASH=y
CONFIG_NVS=y
CONFIG_FLASH_MAP=y
CONFIG_SETTINGS_NVS=y

CONFIG_ASSERT=y

CONFIG_LOG=y
CONFIG_BT_SMP_LOG_LEVEL_DBG=y

CONFIG_THREAD_NAME=y
CONFIG_LOG_THREAD_ID_PREFIX=y
```

## src/main.c
```c
/*
 * Copyright (c) 2023 Nordic Semiconductor ASA
 *
 * SPDX-License-Identifier: Apache-2.0
 */

#include "bs_bt_utils.h"
#include <bstests.h>

void central(void);
void peripheral_unpair_in_sec_cb(void);
void peripheral_disconnect_in_sec_cb(void);

static const struct bst_test_instance test_to_add[] = {
	{
		.test_id = "central",
		.test_main_f = central,
	},
	{
		.test_id = "peripheral_unpair_in_sec_cb",
		.test_main_f = peripheral_unpair_in_sec_cb,
	},
	{
		.test_id = "peripheral_disconnect_in_sec_cb",
		.test_main_f = peripheral_disconnect_in_sec_cb,
	},
	BSTEST_END_MARKER,
};

static struct bst_test_list *install(struct bst_test_list *tests)
{
	return bst_add_tests(tests, test_to_add);
};

bst_test_install_t test_installers[] = {install, NULL};

int main(void)
{
	bst_main();
	return 0;
}
```

## src/bs_bt_utils.c
```c
/*
 * Copyright (c) 2023 Nordic Semiconductor ASA
 *
 * SPDX-License-Identifier: Apache-2.0
 */

#include "bs_bt_utils.h"

#include <zephyr/logging/log.h>
#include <zephyr/settings/settings.h>

#include "babblekit/testcase.h"
#include "babblekit/flags.h"

LOG_MODULE_REGISTER(bs_bt_utils, LOG_LEVEL_DBG);

DEFINE_FLAG(flag_is_connected);
struct bt_conn *g_conn;

void wait_connected(void)
{
	LOG_DBG("Wait for connection...");
	WAIT_FOR_FLAG(flag_is_connected);
}

void wait_disconnected(void)
{
	WAIT_FOR_FLAG_UNSET(flag_is_connected);
}

static void security_changed(struct bt_conn *conn, bt_security_t level, enum bt_security_err err)
{
	LOG_DBG("security changed");
}

static void disconnected(struct bt_conn *conn, uint8_t reason)
{
	UNSET_FLAG(flag_is_connected);
}

static void connected(struct bt_conn *conn, uint8_t err)
{
	TEST_ASSERT((!g_conn || (conn == g_conn)), "Unexpected new connection.");

	if (!g_conn) {
		g_conn = bt_conn_ref(conn);
	}

	if (err != 0) {
		clear_g_conn();
		return;
	}

	SET_FLAG(flag_is_connected);
}

BT_CONN_CB_DEFINE(conn_callbacks) = {
	.connected = connected,
	.disconnected = disconnected,
	.security_changed = security_changed,
};

void clear_g_conn(void)
{
	TEST_ASSERT(g_conn != NULL, "Test error: No g_conn!\n");
	bt_conn_drop(&g_conn);
}

/* The following flags are raised by events and lowered by test code. */
DEFINE_FLAG(flag_pairing_complete);
DEFINE_FLAG(flag_bonded);
DEFINE_FLAG(flag_not_bonded);

static void pairing_complete(struct bt_conn *conn, bool bonded)
{
	LOG_INF("pairing complete");
	SET_FLAG(flag_pairing_complete);

	if (bonded) {
		SET_FLAG(flag_bonded);
		LOG_DBG("Bonded status: true");
	} else {
		SET_FLAG(flag_not_bonded);
		LOG_DBG("Bonded status: false");
	}
}

static void pairing_failed(struct bt_conn *conn, enum bt_security_err err)
{
	LOG_INF("Pairing failed");
}

static struct bt_conn_auth_info_cb bt_conn_auth_info_cb = {
	.pairing_complete = pairing_complete,
	.pairing_failed = pairing_failed,
};

void bs_bt_utils_setup(void)
{
	int err;

	err = bt_enable(NULL);
	TEST_ASSERT(!err, "bt_enable failed.");
	err = bt_conn_auth_info_cb_register(&bt_conn_auth_info_cb);
	TEST_ASSERT(!err, "bt_conn_auth_info_cb_register failed.");

	err = settings_load();
	if (err) {
		TEST_FAIL("Settings load failed (err %d)", err);
	}
}

static void stop_scan_and_connect(const bt_addr_le_t *addr,
				  int8_t rssi,
				  uint8_t type,
				  struct net_buf_simple *ad)
{
	int err;

	if (g_conn != NULL) {
		return;
	}

	printk("Got scan result, connecting.. dst %s, RSSI %d\n", bt_addr_le_str(addr), rssi);

	err = bt_le_scan_stop();
	TEST_ASSERT(!err, "Err bt_le_scan_stop %d", err);

	err = bt_conn_le_create(addr, BT_CONN_LE_CREATE_CONN, BT_LE_CONN_PARAM_DEFAULT, &g_conn);
	TEST_ASSERT(!err, "Err bt_conn_le_create %d", err);
}

void scan_connect_to_first_result(void)
{
	int err;

	err = bt_le_scan_start(BT_LE_SCAN_PASSIVE, stop_scan_and_connect);
	TEST_ASSERT(!err, "Err bt_le_scan_start %d", err);
}

void set_security(bt_security_t sec)
{
	int err;

	err = bt_conn_set_security(g_conn, sec);
	TEST_ASSERT(!err, "Err bt_conn_set_security %d", err);
}

void advertise_connectable(int id, bt_addr_le_t *directed_dst)
{
	int err;
	struct bt_le_adv_param param = {};

	param.id = id;
	param.interval_min = 0x0020;
	param.interval_max = 0x4000;
	param.options |= BT_LE_ADV_OPT_CONN;

	if (directed_dst) {
		param.options |= BT_LE_ADV_OPT_DIR_ADDR_RPA;
		param.peer = directed_dst;
	}

	err = bt_le_adv_start(&param, NULL, 0, NULL, 0);
	TEST_ASSERT(err == 0, "Advertising failed to start (err %d)", err);
}
```

## src/bs_bt_utils.h
```c
/**
 * Common functions and helpers for BSIM tests
 *
 * Copyright (c) 2023 Nordic Semiconductor ASA
 *
 * SPDX-License-Identifier: Apache-2.0
 */

#include <errno.h>
#include <stddef.h>
#include <stdint.h>

#include <zephyr/bluetooth/bluetooth.h>
#include <zephyr/bluetooth/conn.h>
#include <zephyr/bluetooth/gatt.h>
#include <zephyr/bluetooth/hci.h>
#include <zephyr/bluetooth/uuid.h>
#include <zephyr/kernel.h>
#include <zephyr/types.h>

#include <babblekit/testcase.h>
#include <babblekit/flags.h>

DECLARE_FLAG(flag_pairing_complete);
DECLARE_FLAG(flag_bonded);
DECLARE_FLAG(flag_not_bonded);

extern struct bt_conn *g_conn;
void wait_connected(void);
void wait_disconnected(void);
void clear_g_conn(void);
void bs_bt_utils_setup(void);
void scan_connect_to_first_result(void);
void set_security(bt_security_t sec);
void advertise_connectable(int id, bt_addr_le_t *directed_dst);
void set_bondable(bool enable);
```

## src/central.c
```c
/*
 * Copyright (c) 2023 Nordic Semiconductor ASA
 *
 * SPDX-License-Identifier: Apache-2.0
 */

#include <stdint.h>

#include <zephyr/logging/log.h>
#include <zephyr/bluetooth/addr.h>
#include <zephyr/bluetooth/conn.h>
#include <zephyr/bluetooth/bluetooth.h>

#include "bs_bt_utils.h"
#include <babblekit/testcase.h>
#include <babblekit/flags.h>

LOG_MODULE_REGISTER(test_central, LOG_LEVEL_DBG);

BUILD_ASSERT(CONFIG_BT_BONDABLE, "CONFIG_BT_BONDABLE must be enabled by default.");

void central(void)
{
	LOG_DBG("===== Central =====");

	bs_bt_utils_setup();

	scan_connect_to_first_result();
	wait_connected();
	set_security(BT_SECURITY_L2);

	TAKE_FLAG(flag_pairing_complete);
	TAKE_FLAG(flag_bonded);

	LOG_DBG("Wait for disconnection...");
	wait_disconnected();

	clear_g_conn();

	TEST_PASS("PASS");
}
```

## src/peripheral.c
```c
/*
 * Copyright (c) 2023 Nordic Semiconductor ASA
 *
 * SPDX-License-Identifier: Apache-2.0
 */

#include <stdint.h>
#include <string.h>

#include <zephyr/logging/log.h>
#include <zephyr/bluetooth/addr.h>
#include <zephyr/bluetooth/conn.h>
#include <zephyr/bluetooth/bluetooth.h>

#include "bs_bt_utils.h"
#include "babblekit/testcase.h"

LOG_MODULE_REGISTER(test_peripheral, LOG_LEVEL_DBG);

BUILD_ASSERT(CONFIG_BT_BONDABLE, "CONFIG_BT_BONDABLE must be enabled by default.");

static void pairing_complete_unpair(struct bt_conn *conn, bool bonded)
{
	TEST_FAIL("Pairing succeed");
}

static void peripheral_security_changed_unpair(struct bt_conn *conn,
					bt_security_t level,
					enum bt_security_err err)
{
	/* Try to trigger fault here */
	k_msleep(2000);
	LOG_INF("remove pairing...");
	bt_unpair(BT_ID_DEFAULT, bt_conn_get_dst(conn));
	LOG_DBG("unpaired");
}

void peripheral_unpair_in_sec_cb(void)
{
	LOG_DBG("===== Peripheral (will trigger unpair in sec changed cb) =====");

	int err;
	struct bt_conn_cb peripheral_cb = {};
	struct bt_conn_auth_info_cb peripheral_auth_info_cb = {};

	/* Call `bt_unpair` in security changed callback */

	peripheral_cb.security_changed = peripheral_security_changed_unpair;
	peripheral_auth_info_cb.pairing_complete = pairing_complete_unpair;

	bs_bt_utils_setup();

	bt_conn_cb_register(&peripheral_cb);
	err = bt_conn_auth_info_cb_register(&peripheral_auth_info_cb);
	TEST_ASSERT(!err, "bt_conn_auth_info_cb_register failed.");

	advertise_connectable(BT_ID_DEFAULT, NULL);
	wait_connected();

	wait_disconnected();

	clear_g_conn();

	TEST_PASS("PASS");
}

static void pairing_failed_disconnect(struct bt_conn *conn, enum bt_security_err err)
{
	TEST_FAIL("Pairing failed");
}

static void peripheral_security_changed_disconnect(struct bt_conn *conn,
						   bt_security_t level,
						   enum bt_security_err err)
{
	/* Try to trigger fault here */
	k_msleep(2000);
	LOG_INF("disconnecting...");
	bt_conn_disconnect(conn, BT_HCI_ERR_REMOTE_USER_TERM_CONN);
}

void peripheral_disconnect_in_sec_cb(void)
{
	LOG_DBG("===== Peripheral (will trigger unpair in sec changed cb) =====");

	int err;
	struct bt_conn_cb peripheral_cb = {};
	struct bt_conn_auth_info_cb peripheral_auth_info_cb = {};

	/* Disconnect in security changed callback */

	peripheral_cb.security_changed = peripheral_security_changed_disconnect;
	peripheral_auth_info_cb.pairing_failed = pairing_failed_disconnect;

	bs_bt_utils_setup();

	bt_conn_cb_register(&peripheral_cb);
	err = bt_conn_auth_info_cb_register(&peripheral_auth_info_cb);
	TEST_ASSERT(!err, "bt_conn_auth_info_cb_register failed.");

	advertise_connectable(BT_ID_DEFAULT, NULL);
	wait_connected();

	wait_disconnected();

	clear_g_conn();

	TEST_PASS("PASS");
}
```
