## CMakeLists.txt
```
# SPDX-License-Identifier: Apache-2.0

cmake_minimum_required(VERSION 3.28.0)

find_package(Zephyr REQUIRED HINTS $ENV{ZEPHYR_BASE})
project(bsim_test_host)

add_subdirectory(${ZEPHYR_BASE}/tests/bsim/babblekit babblekit)
target_link_libraries(app PRIVATE babblekit)

target_sources(app PRIVATE
  src/common.c
  src/main_collision.c
  src/main_autoconnect.c
  src/main_reconfigure.c
  src/main_lowres.c
  src/main.c
)


zephyr_include_directories(
  ${BSIM_COMPONENTS_PATH}/libUtilv1/src/
  ${BSIM_COMPONENTS_PATH}/libPhyComv1/src/
  )
```

## prj.conf
```kconfig
CONFIG_BT=y
CONFIG_BT_CENTRAL=y
CONFIG_BT_PERIPHERAL=y
CONFIG_BT_SMP=y
CONFIG_BT_L2CAP_DYNAMIC_CHANNEL=y
CONFIG_BT_DEVICE_NAME="EATT test"
CONFIG_BT_EATT=y
CONFIG_BT_L2CAP_ECRED=y
CONFIG_BT_EATT_MAX=5
CONFIG_BT_MAX_CONN=1
CONFIG_BT_EATT_AUTO_CONNECT=n

CONFIG_BT_TESTING=y
CONFIG_LOG=y
CONFIG_ASSERT=y

CONFIG_SYSTEM_WORKQUEUE_STACK_IGNORE_MIN=y
```

## prj_autoconnect.conf
```kconfig
CONFIG_BT_EATT_AUTO_CONNECT=y

CONFIG_BT_L2CAP_TX_MTU=200
CONFIG_BT_L2CAP_LOG_LEVEL_DBG=y
```

## prj_collision.conf
```kconfig
CONFIG_BT=y
CONFIG_BT_CENTRAL=y
CONFIG_BT_PERIPHERAL=y
CONFIG_BT_SMP=y
CONFIG_BT_L2CAP_DYNAMIC_CHANNEL=y
CONFIG_BT_DEVICE_NAME="EATT test"
CONFIG_BT_EATT=y
CONFIG_BT_L2CAP_ECRED=y
CONFIG_BT_EATT_MAX=5
CONFIG_BT_MAX_CONN=1
CONFIG_BT_EATT_AUTO_CONNECT=n

CONFIG_BT_TESTING=y
CONFIG_LOG=y
CONFIG_ASSERT=y
```

## prj_lowres.conf
```kconfig
CONFIG_BT_EATT_MAX=2

CONFIG_BT_L2CAP_LOG_LEVEL_DBG=y
```

## prj_multiple_conn.conf
```kconfig
CONFIG_BT_MAX_CONN=2
```

## src/main.c
```c
/*
 * Copyright (c) 2022 Nordic Semiconductor
 *
 * SPDX-License-Identifier: Apache-2.0
 */

#include <bstests.h>

extern struct bst_test_list *test_main_collision_install(struct bst_test_list *tests);
extern struct bst_test_list *test_main_autoconnect_install(struct bst_test_list *tests);
extern struct bst_test_list *test_main_reconfigure_install(struct bst_test_list *tests);
extern struct bst_test_list *test_main_lowres_install(struct bst_test_list *tests);

bst_test_install_t test_installers[] = {
	test_main_collision_install,
	test_main_autoconnect_install,
	test_main_reconfigure_install,
	test_main_lowres_install,
	NULL,
};

int main(void)
{
	bst_main();
	return 0;
}
```

## src/common.c
```c
/* common.c - Common test code */

/*
 * Copyright (c) 2022 Nordic Semiconductor
 *
 * SPDX-License-Identifier: Apache-2.0
 */

#include "babblekit/testcase.h"
#include "common.h"
#include "bsim_args_runner.h"

struct bt_conn *default_conn;

static const struct bt_data ad[] = {
	BT_DATA_BYTES(BT_DATA_FLAGS, (BT_LE_AD_GENERAL | BT_LE_AD_NO_BREDR)),
};

static volatile bool is_connected;
static volatile bool is_encrypted;

static void connected(struct bt_conn *conn, uint8_t conn_err)
{
	if (conn_err) {
		bt_conn_drop(&default_conn);

		TEST_FAIL("Failed to connect to %s (%u)", bt_conn_dst_str(conn), conn_err);
		return;
	}

	if (!default_conn) {
		default_conn = bt_conn_ref(conn);
	}

	printk("Connected: %s\n", bt_conn_dst_str(conn));
	is_connected = true;
}

static void disconnected(struct bt_conn *conn, uint8_t reason)
{
	printk("Disconnected: %s (reason 0x%02x)\n", bt_conn_dst_str(conn), reason);

	bt_conn_drop(&default_conn);
	is_connected = false;
	is_encrypted = false;
}

static void security_changed(struct bt_conn *conn, bt_security_t level,
			     enum bt_security_err security_err)
{
	if (security_err == BT_SECURITY_ERR_SUCCESS && level > BT_SECURITY_L1) {
		is_encrypted = true;
	}
}

BT_CONN_CB_DEFINE(conn_callbacks) = {
	.connected = connected,
	.disconnected = disconnected,
	.security_changed = security_changed,
};

static void device_found(const bt_addr_le_t *addr, int8_t rssi, uint8_t type,
			 struct net_buf_simple *ad)
{
	int err;

	err = bt_le_scan_stop();
	if (err) {
		TEST_FAIL("Stop LE scan failed (err %d)", err);
	}

	err = bt_conn_le_create(addr, BT_CONN_LE_CREATE_CONN, BT_LE_CONN_PARAM_DEFAULT,
				&default_conn);
	if (err) {
		TEST_FAIL("Create conn failed (err %d)", err);
	}

	printk("Device connected\n");
}

void central_setup_and_connect(void)
{
	int err;

	err = bt_enable(NULL);
	if (err) {
		TEST_FAIL("Can't enable Bluetooth (err %d)", err);
	}

	err = bt_le_scan_start(BT_LE_SCAN_ACTIVE, device_found);
	if (err) {
		TEST_FAIL("Scanning failed to start (err %d)", err);
	}

	while (!is_connected) {
		k_sleep(K_MSEC(100));
	}

	err = bt_conn_set_security(default_conn, BT_SECURITY_L2);
	if (err) {
		TEST_FAIL("Failed to start encryption procedure");
	}

	while (!is_encrypted) {
		k_sleep(K_MSEC(100));
	}
}

void peripheral_setup_and_connect(void)
{
	int err;

	err = bt_enable(NULL);
	if (err) {
		TEST_FAIL("Can't enable Bluetooth (err %d)", err);
	}

	err = bt_le_adv_start(BT_LE_ADV_CONN_FAST_1, ad, ARRAY_SIZE(ad), NULL, 0);
	if (err) {
		TEST_FAIL("Advertising failed to start (err %d)", err);
	}

	while (!is_connected) {
		k_sleep(K_MSEC(100));
	}

	/* Wait for central to start encryption */
	while (!is_encrypted) {
		k_sleep(K_MSEC(100));
	}
}

void wait_for_disconnect(void)
{
	while (is_connected) {
		k_sleep(K_MSEC(100));
	}
}

void disconnect(void)
{
	int err;

	err = bt_conn_disconnect(default_conn, BT_HCI_ERR_REMOTE_USER_TERM_CONN);
	if (err) {
		TEST_FAIL("Disconnection failed (err %d)", err);
	}

	while (is_connected) {
		k_sleep(K_MSEC(100));
	}
}
```

## src/common.h
```c
/* common.h - Common test code */

/*
 * Copyright (c) 2022 Nordic Semiconductor
 *
 * SPDX-License-Identifier: Apache-2.0
 */

#include <stddef.h>

#include <zephyr/types.h>
#include <zephyr/sys/printk.h>
#include <zephyr/sys/util.h>
#include <zephyr/sys/byteorder.h>

#include <zephyr/bluetooth/bluetooth.h>
#include <zephyr/bluetooth/conn.h>
#include <zephyr/bluetooth/att.h>

extern volatile int num_eatt_channels;
extern struct bt_conn *default_conn;

void central_setup_and_connect(void);
void peripheral_setup_and_connect(void);
void wait_for_disconnect(void);
void disconnect(void);
```

## src/main_autoconnect.c
```c
/* main_connect.c - Application main entry point */

/*
 * Copyright (c) 2022 Nordic Semiconductor
 *
 * SPDX-License-Identifier: Apache-2.0
 */

#include "babblekit/testcase.h"
#include "common.h"

static void test_peripheral_main(void)
{
	peripheral_setup_and_connect();

	while (bt_eatt_count(default_conn) < CONFIG_BT_EATT_MAX) {
		k_sleep(K_MSEC(10));
	}

	/* Do not disconnect until the central also has connected all channels */
	k_sleep(K_MSEC(1000));

	disconnect();

	TEST_PASS("EATT Peripheral tests Passed");
}

static void test_central_main(void)
{
	central_setup_and_connect();

	while (bt_eatt_count(default_conn) < CONFIG_BT_EATT_MAX) {
		k_sleep(K_MSEC(10));
	}

	wait_for_disconnect();

	TEST_PASS("EATT Central tests Passed");
}

static const struct bst_test_instance test_def[] = {
	{
		.test_id = "peripheral_autoconnect",
		.test_descr = "Peripheral autoconnect",
		.test_main_f = test_peripheral_main,
	},
	{
		.test_id = "central_autoconnect",
		.test_descr = "Central autoconnect",
		.test_main_f = test_central_main,
	},
	BSTEST_END_MARKER,
};

struct bst_test_list *test_main_autoconnect_install(struct bst_test_list *tests)
{
	return bst_add_tests(tests, test_def);
}
```

## src/main_collision.c
```c
/* main_collision.c - Application main entry point */

/*
 * Copyright (c) 2022 Nordic Semiconductor
 *
 * SPDX-License-Identifier: Apache-2.0
 */

#include <babblekit/testcase.h>
#include <babblekit/sync.h>
#include "common.h"

static void test_peripheral_main(void)
{
	int err;

	TEST_ASSERT(bk_sync_init() == 0, "Failed to open backchannel");

	peripheral_setup_and_connect();

	/*
	 * we need to sync with peer to ensure that we get collisions
	 */
	bk_sync_send();
	bk_sync_wait();

	err = bt_eatt_connect(default_conn, CONFIG_BT_EATT_MAX);
	if (err) {
		TEST_FAIL("Sending credit based connection request failed (err %d)", err);
	}

	while (bt_eatt_count(default_conn) < CONFIG_BT_EATT_MAX) {
		k_sleep(K_MSEC(10));
	}

	/* Do not disconnect until the central also has connected all channels */
	k_sleep(K_MSEC(1000));

	disconnect();

	TEST_PASS("EATT Peripheral tests Passed");
}

static void test_central_main(void)
{
	int err;

	TEST_ASSERT(bk_sync_init() == 0, "Failed to open backchannel");

	central_setup_and_connect();

	bk_sync_wait();
	bk_sync_send();

	err = bt_eatt_connect(default_conn, CONFIG_BT_EATT_MAX);
	if (err) {
		TEST_FAIL("Sending credit based connection request failed (err %d)", err);
	}

	while (bt_eatt_count(default_conn) < CONFIG_BT_EATT_MAX) {
		k_sleep(K_MSEC(10));
	}

	wait_for_disconnect();

	TEST_PASS("EATT Central tests Passed");
}

static const struct bst_test_instance test_def[] = {
	{
		.test_id = "peripheral",
		.test_descr = "Peripheral Collision",
		.test_main_f = test_peripheral_main,
	},
	{
		.test_id = "central",
		.test_descr = "Central Collision",
		.test_main_f = test_central_main,
	},
	BSTEST_END_MARKER,
};

struct bst_test_list *test_main_collision_install(struct bst_test_list *tests)
{
	return bst_add_tests(tests, test_def);
}
```

## src/main_lowres.c
```c
/* main_lowres.c - Application main entry point */

/*
 * Copyright (c) 2023 Nordic Semiconductor
 *
 * SPDX-License-Identifier: Apache-2.0
 */

#include <babblekit/testcase.h>
#include "common.h"

static void test_peripheral_main(void)
{
	peripheral_setup_and_connect();

	while (bt_eatt_count(default_conn) < CONFIG_BT_EATT_MAX) {
		k_sleep(K_MSEC(10));
	}

	disconnect();

	TEST_PASS("EATT Peripheral tests Passed");
}

static void test_central_main(void)
{
	central_setup_and_connect();

	/* Central (us) will try to open 5 channels.
	 * Peripheral will only accept and open 2.
	 *
	 * The purpose of the test is to verify that the accepted EATT channels
	 * still get opened when the response to the ecred conn req is "Some
	 * connections refused - not enough resources available".
	 */

	wait_for_disconnect();

	TEST_PASS("EATT Central tests Passed");
}

static const struct bst_test_instance test_def[] = {
	{
		.test_id = "peripheral_lowres",
		.test_descr = "Peripheral lowres",
		.test_main_f = test_peripheral_main,
	},
	{
		.test_id = "central_lowres",
		.test_descr = "Central lowres",
		.test_main_f = test_central_main,
	},
	BSTEST_END_MARKER,
};

struct bst_test_list *test_main_lowres_install(struct bst_test_list *tests)
{
	return bst_add_tests(tests, test_def);
}
```

## src/main_reconfigure.c
```c
/* main_reconfigure.c - Application main entry point */

/*
 * Copyright (c) 2022 Nordic Semiconductor
 *
 * SPDX-License-Identifier: Apache-2.0
 */

#include "babblekit/testcase.h"
#include "babblekit/flags.h"
#include "babblekit/sync.h"
#include "common.h"

#include <zephyr/bluetooth/gatt.h>

#define NEW_MTU 100

DEFINE_FLAG_STATIC(flag_reconfigured);

void att_mtu_updated(struct bt_conn *conn, uint16_t tx, uint16_t rx)
{
	printk("MTU Updated: tx %d, rx %d\n", tx, rx);

	if (rx == NEW_MTU || tx == NEW_MTU) {
		SET_FLAG(flag_reconfigured);
	}
}

static struct bt_gatt_cb cb = {
	.att_mtu_updated = att_mtu_updated,
};

static void test_peripheral_main(void)
{
	int err;

	TEST_ASSERT(bk_sync_init() == 0, "Failed to open backchannel");

	peripheral_setup_and_connect();

	bt_gatt_cb_register(&cb);

	/* Wait until all channels are established on both sides */
	while (bt_eatt_count(default_conn) < CONFIG_BT_EATT_MAX) {
		k_sleep(K_MSEC(10));
	}
	bk_sync_send();
	bk_sync_wait();

	WAIT_FOR_FLAG(flag_reconfigured);
	bk_sync_send();

	/* Wait for the reconfigured flag on the other end */
	bk_sync_wait();

	disconnect();

	err = bt_gatt_cb_unregister(&cb);
	if (err != 0) {
		TEST_FAIL("Unregister GATT callbacks failed (%d)", err);
		return;
	}

	TEST_PASS("EATT Peripheral tests Passed");
}

static void test_central_main(void)
{
	int err;

	TEST_ASSERT(bk_sync_init() == 0, "Failed to open backchannel");

	central_setup_and_connect();

	bt_gatt_cb_register(&cb);

	while (bt_eatt_count(default_conn) < CONFIG_BT_EATT_MAX) {
		k_sleep(K_MSEC(10));
	}

	err = bt_eatt_reconfigure(default_conn, NEW_MTU);
	if (err < 0) {
		TEST_FAIL("Reconfigure failed (%d)", err);
	}
	bk_sync_send();
	bk_sync_wait();

	WAIT_FOR_FLAG(flag_reconfigured);
	bk_sync_send();

	/* Wait for the reconfigured flag on the other end */
	bk_sync_wait();

	wait_for_disconnect();

	err = bt_gatt_cb_unregister(&cb);
	if (err != 0) {
		TEST_FAIL("Unregister GATT callbacks failed (%d)", err);
		return;
	}

	TEST_PASS("EATT Central tests Passed");
}

static const struct bst_test_instance test_def[] = {
	{
		.test_id = "peripheral_reconfigure",
		.test_descr = "Peripheral reconfigure",
		.test_main_f = test_peripheral_main,
	},
	{
		.test_id = "central_reconfigure",
		.test_descr = "Central reconfigure",
		.test_main_f = test_central_main,
	},
	BSTEST_END_MARKER,
};

struct bst_test_list *test_main_reconfigure_install(struct bst_test_list *tests)
{
	return bst_add_tests(tests, test_def);
}
```
