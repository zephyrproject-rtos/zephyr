## CMakeLists.txt
```
# SPDX-License-Identifier: Apache-2.0

cmake_minimum_required(VERSION 3.28.0)

find_package(Zephyr REQUIRED HINTS $ENV{ZEPHYR_BASE})

project(test_l2cap_server_unregister)

add_subdirectory(${ZEPHYR_BASE}/tests/bluetooth/common/testlib testlib)
target_link_libraries(app PRIVATE testlib)

add_subdirectory(${ZEPHYR_BASE}/tests/bsim/babblekit babblekit)
target_link_libraries(app PRIVATE babblekit)

zephyr_include_directories(
  ${BSIM_COMPONENTS_PATH}/libUtilv1/src/
  ${BSIM_COMPONENTS_PATH}/libPhyComv1/src/
)

target_sources(app PRIVATE
  src/main.c
  src/dut.c
  src/tester.c
)
```

## prj.conf
```kconfig
CONFIG_LOG=y
CONFIG_ASSERT=y
CONFIG_THREAD_NAME=y
CONFIG_LOG_THREAD_ID_PREFIX=y
CONFIG_ARCH_POSIX_TRAP_ON_FATAL=y

CONFIG_BT=y
CONFIG_BT_CENTRAL=y
CONFIG_BT_PERIPHERAL=y

# Dependency of testlib/adv and testlib/scan.
CONFIG_BT_EXT_ADV=y

# Dynamic channel depends on SMP
CONFIG_BT_SMP=y
CONFIG_BT_L2CAP_DYNAMIC_CHANNEL=y

# Disable auto-initiated procedures so they don't
# mess with the test's execution.
CONFIG_BT_AUTO_PHY_CENTRAL_NONE=y
CONFIG_BT_AUTO_DATA_LEN_UPDATE=n
CONFIG_BT_GAP_AUTO_UPDATE_CONN_PARAMS=n
```

## src/main.c
```c
/* Copyright (c) 2026 Xiaomi Corporation
 * SPDX-License-Identifier: Apache-2.0
 */

#include <zephyr/kernel.h>

#include "bstests.h"
#include "babblekit/testcase.h"

extern void entrypoint_dut(void);
extern void entrypoint_tester(void);
extern enum bst_result_t bst_result;

static void test_end_cb(void)
{
	if (bst_result != Passed) {
		TEST_PRINT("Test has not passed.");
	}
}

static const struct bst_test_instance entrypoints[] = {
	{
		.test_id = "l2cap/server_unregister/dut",
		.test_delete_f = test_end_cb,
		.test_main_f = entrypoint_dut,
	},
	{
		.test_id = "l2cap/server_unregister/tester",
		.test_delete_f = test_end_cb,
		.test_main_f = entrypoint_tester,
	},
	BSTEST_END_MARKER,
};

static struct bst_test_list *install(struct bst_test_list *tests)
{
	return bst_add_tests(tests, entrypoints);
};

bst_test_install_t test_installers[] = {install, NULL};

int main(void)
{
	bst_main();

	return 0;
}
```

## src/data.h
```c
/* Copyright (c) 2026 Xiaomi Corporation
 * SPDX-License-Identifier: Apache-2.0
 */

#ifndef ZEPHYR_TESTS_BSIM_BLUETOOTH_HOST_L2CAP_SERVER_UNREGISTER_SRC_DATA_H_
#define ZEPHYR_TESTS_BSIM_BLUETOOTH_HOST_L2CAP_SERVER_UNREGISTER_SRC_DATA_H_

/* Both sides use the same PSM number, so that an outgoing channel on the DUT
 * carries the PSM of the DUT's own server without having been accepted by it.
 */
#define TEST_DATA_L2CAP_PSM 0x0080
#define TEST_DATA_DUT_ADDR  BT_TESTLIB_ADDR_LE_RANDOM_C0_00_00_00_00_(0x01)

#endif /* ZEPHYR_TESTS_BSIM_BLUETOOTH_HOST_L2CAP_SERVER_UNREGISTER_SRC_DATA_H_ */
```

## src/dut.c
```c
/* Copyright (c) 2026 Xiaomi Corporation
 * SPDX-License-Identifier: Apache-2.0
 */

#include <errno.h>

#include <zephyr/bluetooth/bluetooth.h>
#include <zephyr/bluetooth/conn.h>
#include <zephyr/bluetooth/l2cap.h>
#include <zephyr/kernel.h>
#include <zephyr/logging/log.h>
#include <zephyr/net_buf.h>
#include <zephyr/sys/__assert.h>
#include <zephyr/sys/atomic.h>

#include <testlib/addr.h>
#include <testlib/adv.h>
#include <testlib/conn.h>

#include <babblekit/flags.h>
#include <babblekit/testcase.h>

#include "data.h"

LOG_MODULE_REGISTER(dut, LOG_LEVEL_INF);

DEFINE_FLAG(flag_accepted_connected);
DEFINE_FLAG(flag_accepted_disconnected);

static int chan_recv_cb(struct bt_l2cap_chan *chan, struct net_buf *buf)
{
	return 0;
}

static void accepted_connected_cb(struct bt_l2cap_chan *chan)
{
	SET_FLAG(flag_accepted_connected);
}

static void accepted_disconnected_cb(struct bt_l2cap_chan *chan)
{
	SET_FLAG(flag_accepted_disconnected);
}

static struct bt_l2cap_le_chan accepted_chan = {
	.chan.ops =
		&(const struct bt_l2cap_chan_ops){
			.connected = accepted_connected_cb,
			.disconnected = accepted_disconnected_cb,
			.recv = chan_recv_cb,
		},
};

static struct bt_l2cap_le_chan outgoing_chan = {
	.chan.ops =
		&(const struct bt_l2cap_chan_ops){
			.recv = chan_recv_cb,
		},
};

static int server_accept_cb(struct bt_conn *conn, struct bt_l2cap_server *server,
			    struct bt_l2cap_chan **chan)
{
	*chan = &accepted_chan.chan;

	return 0;
}

static struct bt_l2cap_server test_server = {
	.accept = server_accept_cb,
	.psm = TEST_DATA_L2CAP_PSM,
};

void entrypoint_dut(void)
{
	struct bt_conn *conn = NULL;
	int err;

	TEST_START("dut");

	err = bt_id_create(&TEST_DATA_DUT_ADDR, NULL);
	__ASSERT_NO_MSG(!err);

	err = bt_enable(NULL);
	__ASSERT_NO_MSG(!err);

	err = bt_l2cap_server_register(&test_server);
	TEST_ASSERT(err == 0, "register: %d", err);

	err = bt_testlib_adv_conn(&conn, BT_ID_DEFAULT, NULL);
	__ASSERT_NO_MSG(!err);

	/* The tester opens a channel that this server accepts. */
	WAIT_FOR_FLAG(flag_accepted_connected);

	err = bt_l2cap_server_unregister(&test_server);
	TEST_ASSERT(err == -EBUSY, "unregister with an accepted channel: %d", err);

	err = bt_l2cap_chan_disconnect(&accepted_chan.chan);
	TEST_ASSERT(err == 0, "chan disconnect: %d", err);
	WAIT_FOR_FLAG(flag_accepted_disconnected);

	err = bt_l2cap_server_unregister(&test_server);
	TEST_ASSERT(err == 0, "unregister once the channel is gone: %d", err);

	err = bt_l2cap_server_unregister(&test_server);
	TEST_ASSERT(err == -ENOENT, "unregister a second time: %d", err);

	err = bt_l2cap_server_register(&test_server);
	TEST_ASSERT(err == 0, "register again on the same PSM: %d", err);

	/* An outgoing channel carries the same PSM number, but it is not a
	 * channel this server accepted, so it must not block unregistering.
	 */
	err = bt_l2cap_chan_connect(conn, &outgoing_chan.chan, TEST_DATA_L2CAP_PSM);
	TEST_ASSERT(err == 0, "chan connect: %d", err);

	while (!atomic_test_bit(outgoing_chan.chan.status, BT_L2CAP_STATUS_OUT)) {
		k_sleep(K_MSEC(10));
	}

	err = bt_l2cap_server_unregister(&test_server);
	TEST_ASSERT(err == 0, "unregister with only an outgoing channel: %d", err);

	TEST_PASS_AND_EXIT("dut");
}
```

## src/tester.c
```c
/* Copyright (c) 2026 Xiaomi Corporation
 * SPDX-License-Identifier: Apache-2.0
 */

#include <errno.h>

#include <zephyr/bluetooth/bluetooth.h>
#include <zephyr/bluetooth/conn.h>
#include <zephyr/bluetooth/l2cap.h>
#include <zephyr/kernel.h>
#include <zephyr/logging/log.h>
#include <zephyr/net_buf.h>
#include <zephyr/sys/__assert.h>
#include <zephyr/sys/atomic.h>

#include <testlib/addr.h>
#include <testlib/conn.h>
#include <testlib/scan.h>

#include <babblekit/flags.h>
#include <babblekit/testcase.h>

#include "data.h"

LOG_MODULE_REGISTER(tester, LOG_LEVEL_INF);

static int chan_recv_cb(struct bt_l2cap_chan *chan, struct net_buf *buf)
{
	return 0;
}

static struct bt_l2cap_le_chan accepted_chan = {
	.chan.ops =
		&(const struct bt_l2cap_chan_ops){
			.recv = chan_recv_cb,
		},
};

static struct bt_l2cap_le_chan outgoing_chan = {
	.chan.ops =
		&(const struct bt_l2cap_chan_ops){
			.recv = chan_recv_cb,
		},
};

static int server_accept_cb(struct bt_conn *conn, struct bt_l2cap_server *server,
			    struct bt_l2cap_chan **chan)
{
	*chan = &accepted_chan.chan;

	return 0;
}

static struct bt_l2cap_server test_server = {
	.accept = server_accept_cb,
	.psm = TEST_DATA_L2CAP_PSM,
};

void entrypoint_tester(void)
{
	struct bt_conn *conn = NULL;
	int err;

	TEST_START("tester");

	err = bt_enable(NULL);
	__ASSERT_NO_MSG(!err);

	/* The DUT opens a channel to this server at the end of the test. */
	err = bt_l2cap_server_register(&test_server);
	TEST_ASSERT(err == 0, "register: %d", err);

	err = bt_testlib_connect(&TEST_DATA_DUT_ADDR, &conn);
	__ASSERT_NO_MSG(!err);

	err = bt_l2cap_chan_connect(conn, &outgoing_chan.chan, TEST_DATA_L2CAP_PSM);
	TEST_ASSERT(err == 0, "chan connect: %d", err);

	while (!atomic_test_bit(outgoing_chan.chan.status, BT_L2CAP_STATUS_OUT)) {
		k_sleep(K_MSEC(10));
	}

	TEST_PASS("tester");
}
```
