## CMakeLists.txt
```
# SPDX-License-Identifier: Apache-2.0

cmake_minimum_required(VERSION 3.28.0)

find_package(Zephyr REQUIRED HINTS $ENV{ZEPHYR_BASE})
project(bsim_test_l2cap)

add_subdirectory(${ZEPHYR_BASE}/tests/bsim/babblekit babblekit)
target_link_libraries(app PRIVATE babblekit)

add_subdirectory(${ZEPHYR_BASE}/tests/bluetooth/common/testlib testlib)
target_link_libraries(app PRIVATE testlib)

FILE(GLOB app_sources src/*.c)
target_sources(app PRIVATE ${app_sources} )

zephyr_include_directories(
  ${BSIM_COMPONENTS_PATH}/libUtilv1/src/
  ${BSIM_COMPONENTS_PATH}/libPhyComv1/src/
  )
```

## prj.conf
```kconfig
CONFIG_BT=y
CONFIG_BT_CENTRAL=y
CONFIG_BT_PERIPHERAL=y

# Dependency of testlib/adv and testlib/scan.
CONFIG_BT_EXT_ADV=y

CONFIG_BT_SMP=y
CONFIG_BT_BONDABLE=y
CONFIG_BT_L2CAP_DYNAMIC_CHANNEL=y
CONFIG_BT_DEVICE_NAME="L2CAP test"
CONFIG_BT_EATT=n
CONFIG_BT_L2CAP_ECRED=y

# TODO Figure out correct settings
CONFIG_BT_L2CAP_TX_MTU=2000
CONFIG_BT_BUF_ACL_RX_SIZE=69
CONFIG_BT_L2CAP_TX_BUF_COUNT=4
CONFIG_BT_BUF_ACL_TX_COUNT=4
CONFIG_BT_BUF_ACL_TX_SIZE=69
CONFIG_BT_CTLR_RX_BUFFERS=2
CONFIG_BT_CTLR_DATA_LENGTH_MAX=69

CONFIG_LOG=y

CONFIG_BT_L2CAP_LOG_LEVEL_DBG=y

CONFIG_ASSERT=y
```

## src/main.c
```c
/*
 * Copyright (c) 2022 Nordic Semiconductor
 *
 * SPDX-License-Identifier: Apache-2.0
 */

#include "bstests.h"

extern struct bst_test_list *test_main_l2cap_ecred_install(struct bst_test_list *tests);
extern struct bst_test_list *test_main_l2cap_server_unregister_install(struct bst_test_list *tests);

bst_test_install_t test_installers[] = {
	test_main_l2cap_ecred_install,
	test_main_l2cap_server_unregister_install,
	NULL
};

int main(void)
{
	bst_main();
	return 0;
}
```

## src/common.h
```c
/*
 * Common functions and helpers for L2CAP tests
 *
 * Copyright (c) 2022 Nordic Semiconductor ASA
 *
 * SPDX-License-Identifier: Apache-2.0
 */

#include <stddef.h>

#include <zephyr/types.h>
#include <zephyr/sys/util.h>
#include <zephyr/sys/byteorder.h>

#include <zephyr/bluetooth/bluetooth.h>
#include <zephyr/bluetooth/hci.h>
#include <zephyr/bluetooth/l2cap.h>
#include "bs_types.h"
#include "bs_tracing.h"
#include "bstests.h"
#include "bs_pc_backchannel.h"

#define CREATE_FLAG(flag) static atomic_t flag = (atomic_t)false
#define SET_FLAG(flag) (void)atomic_set(&flag, (atomic_t)true)
#define UNSET_FLAG(flag) (void)atomic_set(&flag, (atomic_t)false)
#define TEST_FLAG(flag) (atomic_get(&flag) == (atomic_t)true)
#define WAIT_FOR_FLAG_SET(flag)		   \
	while (!(bool)atomic_get(&flag)) { \
		(void)k_sleep(K_MSEC(1));  \
	}
#define WAIT_FOR_FLAG_UNSET(flag)	  \
	while ((bool)atomic_get(&flag)) { \
		(void)k_sleep(K_MSEC(1)); \
	}


#define WAIT_TIME (60e6) /* 60 seconds*/

#define FAIL(...)				       \
	do {					       \
		bst_result = Failed;		       \
		bs_trace_error_time_line(__VA_ARGS__); \
	} while (0)

#define PASS(...)				    \
	do {					    \
		bst_result = Passed;		    \
		bs_trace_info_time(1, __VA_ARGS__); \
	} while (0)

#define CENTRAL_ID 0
#define PERIPHERAL_ID 1
#define BACK_CHANNELS 1

void test_init(void);
void test_tick(bs_time_t HW_device_time);
void device_sync_init(uint device_nbr);
void device_sync_send(void);
void device_sync_wait(void);
```

## src/main_l2cap_ecred.c
```c
/* main_l2cap_ecred.c - Application main entry point */

/*
 * Copyright (c) 2022 Nordic Semiconductor
 *
 * SPDX-License-Identifier: Apache-2.0
 */

#include <stddef.h>

#include <zephyr/types.h>
#include <zephyr/sys/util.h>
#include <zephyr/sys/byteorder.h>

#include <zephyr/bluetooth/bluetooth.h>
#include <zephyr/bluetooth/hci.h>
#include <zephyr/bluetooth/l2cap.h>

#include "babblekit/testcase.h"
#include "babblekit/flags.h"
#include "babblekit/sync.h"

#define LOG_MODULE_NAME main_l2cap_ecred
#include <zephyr/logging/log.h>
LOG_MODULE_REGISTER(LOG_MODULE_NAME, LOG_LEVEL_DBG);

extern enum bst_result_t bst_result;

static struct bt_conn *default_conn;

static const struct bt_data ad[] = {
	BT_DATA_BYTES(BT_DATA_FLAGS, (BT_LE_AD_GENERAL | BT_LE_AD_NO_BREDR)),
};

#define DATA_MTU CONFIG_BT_L2CAP_TX_MTU
#define DATA_MPS 65
#define DATA_BUF_SIZE BT_L2CAP_SDU_BUF_SIZE(DATA_MTU)
#define L2CAP_CHANNELS 2
#define SERVERS 1
#define SDU_SEND_COUNT 200
#define ECRED_CHAN_MAX 5
#define LONG_MSG (DATA_MTU - 500)
#define SHORT_MSG (DATA_MPS - 2)
#define LONG_MSG_CHAN_IDX 0
#define SHORT_MSG_CHAN_IDX 1

NET_BUF_POOL_FIXED_DEFINE(rx_data_pool, L2CAP_CHANNELS, BT_L2CAP_BUF_SIZE(DATA_BUF_SIZE), 8, NULL);
NET_BUF_POOL_FIXED_DEFINE(tx_data_pool_0, 1, BT_L2CAP_SDU_BUF_SIZE(DATA_MTU),
			  CONFIG_BT_CONN_TX_USER_DATA_SIZE, NULL);
NET_BUF_POOL_FIXED_DEFINE(tx_data_pool_1, 1, BT_L2CAP_SDU_BUF_SIZE(DATA_MTU),
			  CONFIG_BT_CONN_TX_USER_DATA_SIZE, NULL);

static struct bt_l2cap_server servers[SERVERS];
void send_sdu_chan_worker(struct k_work *item);
struct channel {
	uint8_t chan_id; /* Internal number that identifies L2CAP channel. */
	struct bt_l2cap_le_chan le;
	bool in_use;
	size_t sdus_received;
	size_t bytes_to_send;
	uint8_t iteration;
	struct net_buf *buf;
	struct k_work work;
	struct k_work_q work_queue;
	uint8_t payload[DATA_MTU];
};
static struct channel channels[L2CAP_CHANNELS];

DEFINE_FLAG_STATIC(is_connected);
DEFINE_FLAG_STATIC(unsequenced_data);

#define T_STACK_SIZE 512
#define T_PRIORITY 5

static K_THREAD_STACK_ARRAY_DEFINE(stack_area, L2CAP_CHANNELS, T_STACK_SIZE);
static K_SEM_DEFINE(chan_conn_sem, 0, L2CAP_CHANNELS);
static K_SEM_DEFINE(all_chan_conn_sem, 0, 1);
static K_SEM_DEFINE(all_chan_disconn_sem, 0, 1);
static K_SEM_DEFINE(sent_sem, 0, L2CAP_CHANNELS);

static void init_workqs(void)
{
	for (int i = 0; i < L2CAP_CHANNELS; i++) {
		k_work_queue_init(&channels[i].work_queue);
		k_work_queue_start(&channels[i].work_queue, stack_area[i],
		K_THREAD_STACK_SIZEOF(*stack_area), T_PRIORITY, NULL);
	}
}

static struct net_buf *chan_alloc_buf_cb(struct bt_l2cap_chan *chan)
{
	LOG_DBG("Allocated on chan %p", chan);
	return net_buf_alloc(&rx_data_pool, K_NO_WAIT);
}

static int chan_recv_cb(struct bt_l2cap_chan *l2cap_chan, struct net_buf *buf)
{
	struct bt_l2cap_le_chan *l2cap_le_chan = CONTAINER_OF(
			l2cap_chan, struct bt_l2cap_le_chan, chan);
	struct channel *chan = CONTAINER_OF(l2cap_le_chan, struct channel, le);
	const uint32_t received_iterration = net_buf_pull_le32(buf);

	LOG_DBG("received_iterration %i sdus_received %i, chan_id: %d, data_length: %d",
		received_iterration, chan->sdus_received, chan->chan_id, buf->len);
	if (!IS_FLAG_SET(unsequenced_data) && received_iterration != chan->sdus_received) {
		TEST_FAIL("Received out of sequence data.");
	}

	const int retval = memcmp(buf->data + sizeof(received_iterration),
			    chan->payload + sizeof(received_iterration),
			    buf->len - sizeof(received_iterration));
	if (retval) {
		TEST_FAIL("Payload received didn't match expected value memcmp returned %i",
			  retval);
	}

	/*By the time we rx on long msg channel we should have already rx on short msg channel*/
	if (chan->chan_id == 0) {
		if (channels[SHORT_MSG_CHAN_IDX].sdus_received !=
			(channels[LONG_MSG_CHAN_IDX].sdus_received + 1)) {
			TEST_FAIL("Didn't receive on short msg channel first");
		}
	}

	chan->sdus_received++;

	return 0;
}

static void chan_sent_cb(struct bt_l2cap_chan *l2cap_chan)
{
	struct bt_l2cap_le_chan *l2cap_le_chan = CONTAINER_OF(
			l2cap_chan, struct bt_l2cap_le_chan, chan);
	struct channel *chan = CONTAINER_OF(l2cap_le_chan, struct channel, le);

	chan->buf = 0;
	k_sem_give(&sent_sem);

	LOG_DBG("chan_id: %d", chan->chan_id);
}

static void chan_connected_cb(struct bt_l2cap_chan *l2cap_chan)
{
	struct bt_l2cap_le_chan *l2cap_le_chan = CONTAINER_OF(
			l2cap_chan, struct bt_l2cap_le_chan, chan);
	struct channel *chan = CONTAINER_OF(l2cap_le_chan, struct channel, le);

	LOG_DBG("chan_id: %d", chan->chan_id);

	LOG_DBG("tx.mtu %d, tx.mps: %d, rx.mtu: %d, rx.mps %d", sys_cpu_to_le16(chan->le.tx.mtu),
		sys_cpu_to_le16(chan->le.tx.mps), sys_cpu_to_le16(chan->le.rx.mtu),
		sys_cpu_to_le16(chan->le.rx.mps));

	k_sem_give(&chan_conn_sem);

	if (k_sem_count_get(&chan_conn_sem) == L2CAP_CHANNELS) {
		k_sem_give(&all_chan_conn_sem);
		k_sem_reset(&all_chan_disconn_sem);
	}
}

static void chan_disconnected_cb(struct bt_l2cap_chan *l2cap_chan)
{
	struct bt_l2cap_le_chan *l2cap_le_chan = CONTAINER_OF(
			l2cap_chan, struct bt_l2cap_le_chan, chan);
	struct channel *chan = CONTAINER_OF(l2cap_le_chan, struct channel, le);

	LOG_DBG("chan_id: %d", chan->chan_id);

	chan->in_use = false;
	k_sem_take(&chan_conn_sem, K_FOREVER);

	if (k_sem_count_get(&chan_conn_sem) == 0) {
		k_sem_give(&all_chan_disconn_sem);
		k_sem_reset(&all_chan_conn_sem);
	}
}

static void chan_status_cb(struct bt_l2cap_chan *l2cap_chan, atomic_t *status)
{
	struct bt_l2cap_le_chan *l2cap_le_chan = CONTAINER_OF(
			l2cap_chan, struct bt_l2cap_le_chan, chan);
	struct channel *chan = CONTAINER_OF(l2cap_le_chan, struct channel, le);

	LOG_DBG("chan_id: %d, status: %ld", chan->chan_id, *status);
}

static void chan_released_cb(struct bt_l2cap_chan *l2cap_chan)
{
	struct bt_l2cap_le_chan *l2cap_le_chan = CONTAINER_OF(
			l2cap_chan, struct bt_l2cap_le_chan, chan);
	struct channel *chan = CONTAINER_OF(l2cap_le_chan, struct channel, le);

	LOG_DBG("chan_id: %d", chan->chan_id);
}

static void chan_reconfigured_cb(struct bt_l2cap_chan *l2cap_chan)
{
	struct bt_l2cap_le_chan *l2cap_le_chan = CONTAINER_OF(
			l2cap_chan, struct bt_l2cap_le_chan, chan);
	struct channel *chan = CONTAINER_OF(l2cap_le_chan, struct channel, le);

	LOG_DBG("chan_id: %d", chan->chan_id);
}

static const struct bt_l2cap_chan_ops l2cap_ops = {
	.alloc_buf = chan_alloc_buf_cb,
	.recv = chan_recv_cb,
	.sent = chan_sent_cb,
	.connected = chan_connected_cb,
	.disconnected = chan_disconnected_cb,
	.status = chan_status_cb,
	.released = chan_released_cb,
	.reconfigured = chan_reconfigured_cb,
};

static struct channel *get_free_channel(void)
{
	for (int idx = 0; idx < L2CAP_CHANNELS; idx++) {
		struct channel *chan = &channels[idx];

		if (chan->in_use) {
			continue;
		}

		chan->chan_id = idx;
		channels[idx].in_use = true;
		(void)memset(chan->payload, idx, sizeof(chan->payload));
		k_work_init(&chan->work, send_sdu_chan_worker);
		chan->le.chan.ops = &l2cap_ops;
		chan->le.rx.mtu = DATA_MTU;
		chan->le.rx.mps = DATA_MPS;

		return chan;
	}

	return NULL;
}

static void connect_num_channels(uint8_t num_l2cap_channels)
{
	struct bt_l2cap_chan *allocated_channels[ECRED_CHAN_MAX] = { NULL };

	for (int i = 0; i < num_l2cap_channels; i++) {
		struct channel *chan = get_free_channel();

		if (!chan) {
			TEST_FAIL("failed, chan not free");
			return;
		}

		allocated_channels[i] = &chan->le.chan;
	}

	const int err = bt_l2cap_ecred_chan_connect(default_conn, allocated_channels,
						     servers[0].psm);

	if (err) {
		TEST_FAIL("can't connect ecred %d ", err);
	}
}

static void disconnect_all_channels(void)
{
	for (int i = 0; i < ARRAY_SIZE(channels); i++) {
		if (channels[i].in_use) {
			LOG_DBG("Disconnecting channel: %d)", channels[i].chan_id);
			const int err = bt_l2cap_chan_disconnect(&channels[i].le.chan);

			if (err) {
				LOG_DBG("can't disconnect channel (err: %d)", err);
			}

			channels[i].in_use = false;
		}
	}
}

static int accept(struct bt_conn *conn, struct bt_l2cap_server *server,
		  struct bt_l2cap_chan **l2cap_chan)
{
	struct channel *chan;

	chan = get_free_channel();
	if (!chan) {
		return -ENOMEM;
	}

	*l2cap_chan = &chan->le.chan;

	return 0;
}

static struct bt_l2cap_server *get_free_server(void)
{
	for (int i = 0; i < SERVERS; i++) {
		if (servers[i].psm) {
			continue;
		}

		return &servers[i];
	}

	return NULL;
}

static void register_l2cap_server(void)
{
	struct bt_l2cap_server *server;

	server = get_free_server();
	if (!server) {
		TEST_FAIL("Failed to get free server");
		return;
	}

	server->accept = accept;
	server->psm = 0;

	if (bt_l2cap_server_register(server) < 0) {
		TEST_FAIL("Failed to get free server");
		return;
	}

	LOG_DBG("L2CAP server registered, PSM:0x%X", server->psm);
}

static void connected(struct bt_conn *conn, uint8_t conn_err)
{
	if (conn_err) {
		TEST_FAIL("Failed to connect to %s (%u)", bt_conn_dst_str(conn), conn_err);
		bt_conn_drop(&default_conn);
		return;
	}

	default_conn = bt_conn_ref(conn);
	LOG_DBG("%s", bt_conn_dst_str(conn));

	SET_FLAG(is_connected);
}

static void disconnected(struct bt_conn *conn, uint8_t reason)
{
	LOG_DBG("%s (reason 0x%02x)", bt_conn_dst_str(conn), reason);

	if (default_conn != conn) {
		TEST_FAIL("Conn mismatch disconnect %s %s)", default_conn, conn);
		return;
	}

	bt_conn_drop(&default_conn);
	UNSET_FLAG(is_connected);
}

BT_CONN_CB_DEFINE(conn_callbacks) = {
	.connected = connected,
	.disconnected = disconnected,
};

static void send_sdu(int iteration, int chan_idx, int bytes)
{
	struct bt_l2cap_chan *chan = &channels[chan_idx].le.chan;
	struct net_buf *buf;

	/* First 4 bytes in sent payload is iteration count */
	sys_put_le32(iteration, channels[chan_idx].payload);

	if (channels[chan_idx].buf != 0) {
		TEST_FAIL("Buf should have been deallocated by now");
		return;
	}

	if (chan_idx == 0) {
		buf = net_buf_alloc(&tx_data_pool_0, K_NO_WAIT);
	} else {
		buf = net_buf_alloc(&tx_data_pool_1, K_NO_WAIT);
	}

	if (buf == NULL) {
		TEST_FAIL("Failed to get buff on ch %i, iteration %i should never happen", chan_idx,
		     chan_idx);
	}

	channels[chan_idx].buf = buf;
	net_buf_reserve(buf, BT_L2CAP_SDU_CHAN_SEND_RESERVE);
	net_buf_add_mem(buf, channels[chan_idx].payload, bytes);

	LOG_DBG("bt_l2cap_chan_sending ch: %i bytes: %i iteration: %i", chan_idx, bytes, iteration);
	const int ret = bt_l2cap_chan_send(chan, buf);

	LOG_DBG("bt_l2cap_chan_send returned: %i", ret);

	if (ret < 0) {
		TEST_FAIL("Error: send failed error: %i", ret);
		channels[chan_idx].buf = 0;
		net_buf_unref(buf);
	}
}

void send_sdu_chan_worker(struct k_work *item)
{
	const struct channel *ch = CONTAINER_OF(item, struct channel, work);

	send_sdu(ch->iteration, ch->chan_id, ch->bytes_to_send);
}

static void send_sdu_concurrently(void)
{
	for (int i = 0; i < SDU_SEND_COUNT; i++) {
		for (int k = 0; k < L2CAP_CHANNELS; k++) {
			channels[k].iteration = i;
			/* Assign the right msg to the right channel */
			channels[k].bytes_to_send = (k == LONG_MSG_CHAN_IDX) ? LONG_MSG : SHORT_MSG;
			const int err = k_work_submit_to_queue(&channels[k].work_queue,
								&channels[k].work);

			if (err < 0) {
				TEST_FAIL("Failed to submit work to the queue, error: %d", err);
			}
		}

		/* Wait until messages on all of the channels has been sent */
		for (int l = 0; l < L2CAP_CHANNELS; l++) {
			k_sem_take(&sent_sem, K_FOREVER);
		}
	}
}

static int change_mtu_on_channels(int num_channels, int new_mtu)
{
	struct bt_l2cap_chan *reconf_channels[ECRED_CHAN_MAX] = { NULL };

	for (int i = 0; i < num_channels; i++) {
		reconf_channels[i] = &(&channels[i])->le.chan;
	}

	return bt_l2cap_ecred_chan_reconfigure(reconf_channels, new_mtu);
}

static void test_peripheral_main(void)
{
	TEST_ASSERT(bk_sync_init() == 0, "Failed to open backchannel");
	LOG_DBG("*L2CAP ECRED Peripheral started*");
	init_workqs();
	int err;

	err = bt_enable(NULL);
	if (err) {
		TEST_FAIL("Can't enable Bluetooth (err %d)", err);
		return;
	}

	LOG_DBG("Peripheral Bluetooth initialized.");
	LOG_DBG("Connectable advertising...");
	err = bt_le_adv_start(BT_LE_ADV_CONN_FAST_1, ad, ARRAY_SIZE(ad), NULL, 0);
	if (err) {
		TEST_FAIL("Advertising failed to start (err %d)", err);
		return;
	}

	LOG_DBG("Advertising started.");
	LOG_DBG("Peripheral waiting for connection...");
	WAIT_FOR_FLAG(is_connected);
	LOG_DBG("Peripheral Connected.");
	register_l2cap_server();
	connect_num_channels(L2CAP_CHANNELS);
	k_sem_take(&all_chan_conn_sem, K_FOREVER);

	/* Disconnect and reconnect channels *****************************************************/
	LOG_DBG("############# Disconnect and reconnect channels");
	disconnect_all_channels();
	k_sem_take(&all_chan_disconn_sem, K_FOREVER);

	connect_num_channels(L2CAP_CHANNELS);
	k_sem_take(&all_chan_conn_sem, K_FOREVER);

	LOG_DBG("Send sync after reconnection");
	bk_sync_send();

	/* Send bytes on both channels and expect ch 1 to receive all of them before ch 0 *********/
	LOG_DBG("############# Send bytes on both channels concurrently");
	send_sdu_concurrently();

	/* Change mtu size on all connected channels *********************************************/
	LOG_DBG("############# Change MTU of the channels");
	err = change_mtu_on_channels(L2CAP_CHANNELS, CONFIG_BT_L2CAP_TX_MTU + 10);

	if (err) {
		TEST_FAIL("MTU change failed (err %d)", err);
	}

	/* Read from both devices (Central and Peripheral) at the same time **********************/
	LOG_DBG("############# Read from both devices (Central and Peripheral) at the same time");
	LOG_DBG("Wait for sync before sending the msg");
	bk_sync_wait();
	LOG_DBG("Received sync");
	send_sdu(0, 1, 10);

	k_sem_take(&sent_sem, K_FOREVER);
	disconnect_all_channels();
	WAIT_FOR_FLAG_UNSET(is_connected);
	TEST_PASS("L2CAP ECRED Peripheral tests Passed");
	bs_trace_silent_exit(0);
}

static void device_found(const bt_addr_le_t *addr, int8_t rssi, uint8_t type,
			 struct net_buf_simple *ad)
{
	struct bt_le_conn_param *param;
	int err;

	err = bt_le_scan_stop();
	if (err) {
		TEST_FAIL("Stop LE scan failed (err %d)", err);
		return;
	}

	param = BT_LE_CONN_PARAM_DEFAULT;
	err = bt_conn_le_create(addr, BT_CONN_LE_CREATE_CONN, param, &default_conn);
	if (err) {
		TEST_FAIL("Create conn failed (err %d)", err);
		return;
	}
}

static void test_central_main(void)
{
	struct bt_le_scan_param scan_param = {
		.type = BT_LE_SCAN_TYPE_ACTIVE,
		.options = BT_LE_SCAN_OPT_NONE,
		.interval = BT_GAP_SCAN_FAST_INTERVAL,
		.window = BT_GAP_SCAN_FAST_WINDOW,
	};

	TEST_ASSERT(bk_sync_init() == 0, "Failed to open backchannel");

	LOG_DBG("*L2CAP ECRED Central started*");
	int err;

	err = bt_enable(NULL);
	if (err) {
		TEST_FAIL("Can't enable Bluetooth (err %d)", err);
		return;
	}
	LOG_DBG("Central Bluetooth initialized.\n");

	err = bt_le_scan_start(&scan_param, device_found);
	if (err) {
		TEST_FAIL("Scanning failed to start (err %d)", err);
		return;
	}

	LOG_DBG("Scanning successfully started\n");

	LOG_DBG("Central waiting for connection...\n");
	WAIT_FOR_FLAG(is_connected);
	LOG_DBG("Central Connected.\n");
	register_l2cap_server();

	LOG_DBG("Wait for sync after reconnection");
	bk_sync_wait();
	LOG_DBG("Received sync");

	/* Read from both devices (Central and Peripheral) at the same time **********************/
	LOG_DBG("############# Read from both devices (Central and Peripheral) at the same time");
	LOG_DBG("Send sync for SDU send");
	SET_FLAG(unsequenced_data);
	bk_sync_send();
	send_sdu(0, 1, 10);

	/* Wait until all of the channels are disconnected */
	k_sem_take(&all_chan_disconn_sem, K_FOREVER);

	LOG_DBG("Both l2cap channels disconnected, test over\n");

	UNSET_FLAG(unsequenced_data);
	LOG_DBG("received PDUs on long msg channel %i and short msg channel %i",
		channels[LONG_MSG_CHAN_IDX].sdus_received,
		channels[SHORT_MSG_CHAN_IDX].sdus_received);

	if (channels[LONG_MSG_CHAN_IDX].sdus_received < SDU_SEND_COUNT ||
	    channels[SHORT_MSG_CHAN_IDX].sdus_received < SDU_SEND_COUNT) {
		TEST_FAIL("received less than %i", SDU_SEND_COUNT);
	}

	/* Disconnect */
	LOG_DBG("Central Disconnecting....");
	err = bt_conn_disconnect(default_conn, BT_HCI_ERR_REMOTE_USER_TERM_CONN);
	bt_conn_unref(default_conn);
	LOG_DBG("Central tried to disconnect");

	if (err) {
		TEST_FAIL("Disconnection failed (err %d)", err);
		return;
	}

	LOG_DBG("Central Disconnected.");

	TEST_PASS("L2CAP ECRED Central tests Passed");
}

static const struct bst_test_instance test_def[] = {
	{
		.test_id = "peripheral",
		.test_descr = "Peripheral L2CAP ECRED",
		.test_main_f = test_peripheral_main
	},
	{
		.test_id = "central",
		.test_descr = "Central L2CAP ECRED",
		.test_main_f = test_central_main
	},
	BSTEST_END_MARKER
};

struct bst_test_list *test_main_l2cap_ecred_install(struct bst_test_list *tests)
{
	return bst_add_tests(tests, test_def);
}
```

## src/main_l2cap_rx_mps.c
```c
/* main_l2cap_rx_mps.c - Application-provided L2CAP RX MPS */

/*
 * Copyright (c) 2026 Xiaomi Corporation
 * SPDX-License-Identifier: Apache-2.0
 */

#include <errno.h>
#include <string.h>

#include <zephyr/bluetooth/bluetooth.h>
#include <zephyr/bluetooth/conn.h>
#include <zephyr/bluetooth/l2cap.h>
#include <zephyr/kernel.h>
#include <zephyr/logging/log.h>
#include <zephyr/net_buf.h>
#include <zephyr/sys/util.h>

#include <babblekit/flags.h>
#include <babblekit/testcase.h>

#include "bstests.h"

LOG_MODULE_REGISTER(main_l2cap_rx_mps, LOG_LEVEL_INF);

#define PSM_OK		0x0081
#define PSM_BAD_MPS	0x0082

/* The MPS values the central asks for: above the minimum of the
 * connection type, but below MTU + SDU header so that the stack cannot
 * have derived them from the MTU.
 */
#define LEGACY_MPS	25
#define ECRED_MPS	64
/* MTU of the test channels: large enough that the MPS values above are
 * below MTU + 2 (so with the alloc_buf callback set they exercise the
 * application-provided path), small enough to be a valid SDU size.
 */
#define CHAN_MTU	100
/* The MPS of the channels the peripheral hands back to a bad-MPS request. */
#define BAD_MPS		10

static struct bt_conn *default_conn;

DEFINE_FLAG_STATIC(is_connected);
DEFINE_FLAG_STATIC(chan_connected);
DEFINE_FLAG_STATIC(chan_disconnected);

static const struct bt_data ad[] = {
	BT_DATA_BYTES(BT_DATA_FLAGS, (BT_LE_AD_GENERAL | BT_LE_AD_NO_BREDR)),
};

static int recv_cb(struct bt_l2cap_chan *chan, struct net_buf *buf)
{
	net_buf_unref(buf);

	return 0;
}

/* No data is exchanged; the callback only opts the channels out of the
 * MTU truncation for channels without reassembly.
 */
NET_BUF_POOL_FIXED_DEFINE(rx_pool, 4,
			  BT_L2CAP_BUF_SIZE(BT_L2CAP_SDU_BUF_SIZE(CHAN_MTU)), 8, NULL);

static struct net_buf *alloc_buf_cb(struct bt_l2cap_chan *chan)
{
	return net_buf_alloc(&rx_pool, K_NO_WAIT);
}

static void connected_cb(struct bt_l2cap_chan *chan)
{
	SET_FLAG(chan_connected);
}

static void disconnected_cb(struct bt_l2cap_chan *chan)
{
	SET_FLAG(chan_disconnected);
}

static const struct bt_l2cap_chan_ops chan_ops = {
	.alloc_buf = alloc_buf_cb,
	.recv = recv_cb,
	.connected = connected_cb,
	.disconnected = disconnected_cb,
};

static void chan_init(struct bt_l2cap_le_chan *le, uint16_t mtu, uint16_t mps)
{
	memset(le, 0, sizeof(*le));
	le->chan.ops = &chan_ops;
	le->rx.mtu = mtu;
	le->rx.mps = mps;
}

static void connected(struct bt_conn *conn, uint8_t conn_err)
{
	if (conn_err != 0) {
		TEST_FAIL("Failed to connect to %s (%u)", bt_conn_dst_str(conn), conn_err);
		return;
	}

	default_conn = bt_conn_ref(conn);

	SET_FLAG(is_connected);
}

static void disconnected(struct bt_conn *conn, uint8_t reason)
{
	if (default_conn != conn) {
		TEST_FAIL("Conn mismatch disconnect %s %p)", bt_conn_dst_str(conn), conn);
		return;
	}

	bt_conn_drop(&default_conn);
	UNSET_FLAG(is_connected);
}

BT_CONN_CB_DEFINE(conn_callbacks) = {
	.connected = connected,
	.disconnected = disconnected,
};

static void device_found(const bt_addr_le_t *addr, int8_t rssi, uint8_t type,
			 struct net_buf_simple *ad)
{
	int err;

	err = bt_le_scan_stop();
	if (err != 0) {
		TEST_FAIL("Stop LE scan failed (err %d)", err);
		return;
	}

	err = bt_conn_le_create(addr, BT_CONN_LE_CREATE_CONN,
				BT_LE_CONN_PARAM_DEFAULT, &default_conn);
	if (err != 0) {
		TEST_FAIL("Create conn failed (err %d)", err);
		return;
	}
}

static void test_central_main(void)
{
	struct bt_l2cap_chan *ecred_chans[BT_L2CAP_ECRED_CHAN_MAX_PER_REQ] = { NULL };
	struct bt_l2cap_le_chan legacy;
	struct bt_l2cap_le_chan ecred;
	struct bt_le_scan_param scan_param = {
		.type = BT_LE_SCAN_TYPE_ACTIVE,
		.options = BT_LE_SCAN_OPT_NONE,
		.interval = BT_GAP_SCAN_FAST_INTERVAL,
		.window = BT_GAP_SCAN_FAST_WINDOW,
	};
	int err;

	err = bt_enable(NULL);
	if (err != 0) {
		TEST_FAIL("Can't enable Bluetooth (err %d)", err);
		return;
	}

	err = bt_le_scan_start(&scan_param, device_found);
	if (err != 0) {
		TEST_FAIL("Scanning failed to start (err %d)", err);
		return;
	}

	WAIT_FOR_FLAG(is_connected);

	/* Legacy LE credit based: an MPS below the minimum of 23 is rejected */
	chan_init(&legacy, CHAN_MTU, 22);
	err = bt_l2cap_chan_connect(default_conn, &legacy.chan, PSM_OK);
	TEST_ASSERT(err == -EINVAL, "legacy connect with rx.mps 22 returned %d", err);

	/* Legacy: an MPS within the range is kept, not adjusted */
	chan_init(&legacy, CHAN_MTU, LEGACY_MPS);
	err = bt_l2cap_chan_connect(default_conn, &legacy.chan, PSM_OK);
	TEST_ASSERT(err == 0, "legacy connect returned %d", err);

	WAIT_FOR_FLAG(chan_connected);
	TEST_ASSERT(legacy.rx.mps == LEGACY_MPS, "legacy rx.mps is %u, not %u",
		    legacy.rx.mps, LEGACY_MPS);
	UNSET_FLAG(chan_connected);

	err = bt_l2cap_chan_disconnect(&legacy.chan);
	TEST_ASSERT(err == 0, "legacy disconnect returned %d", err);
	WAIT_FOR_FLAG(chan_disconnected);
	UNSET_FLAG(chan_disconnected);

	/* Enhanced credit based: an MPS below BT_L2CAP_ECRED_MIN_MPS is rejected */
	chan_init(&ecred, CHAN_MTU, ECRED_MPS - 1);
	ecred_chans[0] = &ecred.chan;
	err = bt_l2cap_ecred_chan_connect(default_conn, ecred_chans, PSM_OK);
	TEST_ASSERT(err == -EINVAL, "ecred connect with rx.mps %u returned %d",
		    ECRED_MPS - 1, err);

	/* Enhanced credit based: the minimum is kept, not adjusted */
	chan_init(&ecred, CHAN_MTU, ECRED_MPS);
	err = bt_l2cap_ecred_chan_connect(default_conn, ecred_chans, PSM_OK);
	TEST_ASSERT(err == 0, "ecred connect returned %d", err);

	WAIT_FOR_FLAG(chan_connected);
	TEST_ASSERT(ecred.rx.mps == ECRED_MPS, "ecred rx.mps is %u, not %u",
		    ecred.rx.mps, ECRED_MPS);
	UNSET_FLAG(chan_connected);

	err = bt_l2cap_chan_disconnect(&ecred.chan);
	TEST_ASSERT(err == 0, "ecred disconnect returned %d", err);
	WAIT_FOR_FLAG(chan_disconnected);
	UNSET_FLAG(chan_disconnected);

	/* A server that hands back a channel with an invalid MPS refuses the
	 * connection instead of accepting it with an adjusted value.
	 */
	chan_init(&legacy, CHAN_MTU, LEGACY_MPS);
	err = bt_l2cap_chan_connect(default_conn, &legacy.chan, PSM_BAD_MPS);
	TEST_ASSERT(err == 0, "connect to the bad-MPS server returned %d", err);

	WAIT_FOR_FLAG(chan_disconnected);
	TEST_ASSERT(!IS_FLAG_SET(chan_connected), "the bad-MPS channel connected anyway");

	err = bt_conn_disconnect(default_conn, BT_HCI_ERR_REMOTE_USER_TERM_CONN);
	if (err != 0) {
		TEST_FAIL("Disconnection failed (err %d)", err);
		return;
	}

	TEST_PASS("L2CAP RX MPS central Passed");
}

static struct bt_l2cap_le_chan peer_legacy;
static struct bt_l2cap_le_chan peer_ecred;
static struct bt_l2cap_le_chan peer_bad_mps;

static uint16_t observed_tx_mps[2];
static uint8_t observed;
static uint8_t bad_mps_accepts;

static int accept_ok(struct bt_conn *conn, struct bt_l2cap_server *server,
		     struct bt_l2cap_chan **chan)
{
	/* The connections arrive in the order the central makes them: one LE
	 * credit based, then one enhanced credit based.
	 */
	*chan = (observed == 0) ? &peer_legacy.chan : &peer_ecred.chan;

	return 0;
}

static int accept_bad_mps(struct bt_conn *conn, struct bt_l2cap_server *server,
			  struct bt_l2cap_chan **chan)
{
	bad_mps_accepts++;
	*chan = &peer_bad_mps.chan;

	return 0;
}

static struct bt_l2cap_server server_ok = {
	.accept = accept_ok,
	.psm = PSM_OK,
};

static struct bt_l2cap_server server_bad_mps = {
	.accept = accept_bad_mps,
	.psm = PSM_BAD_MPS,
};

static void peer_connected_cb(struct bt_l2cap_chan *chan)
{
	struct bt_l2cap_le_chan *le_chan = BT_L2CAP_LE_CHAN(chan);

	if (observed < ARRAY_SIZE(observed_tx_mps)) {
		observed_tx_mps[observed] = le_chan->tx.mps;
	}
	observed++;

	SET_FLAG(chan_connected);
}

static const struct bt_l2cap_chan_ops peer_chan_ops = {
	.alloc_buf = alloc_buf_cb,
	.recv = recv_cb,
	.connected = peer_connected_cb,
	.disconnected = disconnected_cb,
};

static void test_peripheral_main(void)
{
	int err;

	err = bt_enable(NULL);
	if (err != 0) {
		TEST_FAIL("Can't enable Bluetooth (err %d)", err);
		return;
	}

	/* The MPS the peripheral receives is the one the central advertised,
	 * so the channels hand their rx endpoint to the stack: only the MTU
	 * is set, the MPS is derived.
	 */
	peer_legacy.chan.ops = &peer_chan_ops;
	peer_legacy.rx.mtu = CHAN_MTU;
	peer_ecred.chan.ops = &peer_chan_ops;
	peer_ecred.rx.mtu = CHAN_MTU;
	peer_bad_mps.chan.ops = &peer_chan_ops;
	peer_bad_mps.rx.mtu = CHAN_MTU;
	peer_bad_mps.rx.mps = BAD_MPS;

	err = bt_l2cap_server_register(&server_ok);
	if (err != 0) {
		TEST_FAIL("Failed to register server (err %d)", err);
		return;
	}

	err = bt_l2cap_server_register(&server_bad_mps);
	if (err != 0) {
		TEST_FAIL("Failed to register bad-MPS server (err %d)", err);
		return;
	}

	err = bt_le_adv_start(BT_LE_ADV_CONN_FAST_1, ad, ARRAY_SIZE(ad), NULL, 0);
	if (err != 0) {
		TEST_FAIL("Advertising failed to start (err %d)", err);
		return;
	}

	WAIT_FOR_FLAG(is_connected);

	/* One LE credit based and one enhanced credit based connection */
	for (int i = 0; i < 2; i++) {
		WAIT_FOR_FLAG(chan_connected);
		UNSET_FLAG(chan_connected);
		WAIT_FOR_FLAG(chan_disconnected);
		UNSET_FLAG(chan_disconnected);
	}

	WAIT_FOR_FLAG_UNSET(is_connected);

	TEST_ASSERT(observed == 2, "%u channels connected, not 2", observed);
	TEST_ASSERT(observed_tx_mps[0] == LEGACY_MPS,
		    "legacy tx.mps is %u, not %u", observed_tx_mps[0], LEGACY_MPS);
	TEST_ASSERT(observed_tx_mps[1] == ECRED_MPS,
		    "ecred tx.mps is %u, not %u", observed_tx_mps[1], ECRED_MPS);
	TEST_ASSERT(bad_mps_accepts == 1, "%u bad-MPS connections reached accept, not 1",
		    bad_mps_accepts);

	TEST_PASS("L2CAP RX MPS peripheral Passed");
}

static const struct bst_test_instance test_def[] = {
	{
		.test_id = "rx_mps_central",
		.test_descr = "Central L2CAP RX MPS",
		.test_main_f = test_central_main
	},
	{
		.test_id = "rx_mps_peripheral",
		.test_descr = "Peripheral L2CAP RX MPS",
		.test_main_f = test_peripheral_main
	},
	BSTEST_END_MARKER
};

struct bst_test_list *test_main_l2cap_rx_mps_install(struct bst_test_list *tests)
{
	return bst_add_tests(tests, test_def);
}
```

## src/main_l2cap_server_unregister.c
```c
/* main_l2cap_server_unregister.c - L2CAP server unregistration */

/*
 * Copyright (c) 2026 Xiaomi Corporation
 * SPDX-License-Identifier: Apache-2.0
 */

#include <errno.h>

#include <zephyr/bluetooth/bluetooth.h>
#include <zephyr/bluetooth/conn.h>
#include <zephyr/bluetooth/l2cap.h>
#include <zephyr/kernel.h>
#include <zephyr/logging/log.h>
#include <zephyr/net_buf.h>
#include <zephyr/sys/atomic.h>
#include <zephyr/sys/util.h>

#include <testlib/addr.h>
#include <testlib/adv.h>
#include <testlib/conn.h>
#include <testlib/scan.h>

#include <babblekit/flags.h>
#include <babblekit/testcase.h>

#include "bstests.h"

LOG_MODULE_REGISTER(main_l2cap_server_unregister, LOG_LEVEL_INF);

/* The DUT serves both PSMs, so that a lookup has to pick one server out of
 * the list. The tester serves PSM A as well, so that an outgoing channel on
 * the DUT carries the PSM of the DUT's own server without having been
 * accepted by it.
 */
#define TEST_DATA_L2CAP_PSM_A 0x0080U
#define TEST_DATA_L2CAP_PSM_B 0x0081U
#define TEST_DATA_DUT_ADDR    BT_TESTLIB_ADDR_LE_RANDOM_C0_00_00_00_00_(0x01)

static int chan_recv_cb(struct bt_l2cap_chan *chan, struct net_buf *buf)
{
	ARG_UNUSED(chan);
	ARG_UNUSED(buf);

	return 0;
}

DEFINE_FLAG_STATIC(flag_accepted_connected);
DEFINE_FLAG_STATIC(flag_accepted_disconnected);

/* What unregistering server B from inside its own accept() returned. */
static int unregister_in_accept;

static void accepted_connected_cb(struct bt_l2cap_chan *chan)
{
	ARG_UNUSED(chan);

	SET_FLAG(flag_accepted_connected);
}

static void accepted_disconnected_cb(struct bt_l2cap_chan *chan)
{
	ARG_UNUSED(chan);

	SET_FLAG(flag_accepted_disconnected);
}

static struct bt_l2cap_le_chan dut_accepted_chan = {
	.chan.ops =
		&(const struct bt_l2cap_chan_ops){
			.connected = accepted_connected_cb,
			.disconnected = accepted_disconnected_cb,
			.recv = chan_recv_cb,
		},
};

static struct bt_l2cap_le_chan dut_outgoing_chan = {
	.chan.ops =
		&(const struct bt_l2cap_chan_ops){
			.recv = chan_recv_cb,
		},
};

static int accept_unexpected_cb(struct bt_conn *conn, struct bt_l2cap_server *server,
				struct bt_l2cap_chan **chan)
{
	ARG_UNUSED(conn);
	ARG_UNUSED(server);
	ARG_UNUSED(chan);

	TEST_FAIL("server A was not supposed to get a connection request");

	return -ENOMEM;
}

static int dut_accept_cb(struct bt_conn *conn, struct bt_l2cap_server *server,
			 struct bt_l2cap_chan **chan)
{
	ARG_UNUSED(conn);

	/* The request being handled holds a reference to this server, so it
	 * cannot be unregistered from here.
	 */
	unregister_in_accept = bt_l2cap_server_unregister(server);

	*chan = &dut_accepted_chan.chan;

	return 0;
}

static struct bt_l2cap_server server_a = {
	.accept = accept_unexpected_cb,
	.psm = TEST_DATA_L2CAP_PSM_A,
};

static struct bt_l2cap_server server_b = {
	.accept = dut_accept_cb,
	.psm = TEST_DATA_L2CAP_PSM_B,
};

void entrypoint_dut(void)
{
	struct bt_conn *conn = NULL;
	int err;

	TEST_START("dut");

	err = bt_id_create(&TEST_DATA_DUT_ADDR, NULL);
	TEST_ASSERT(err == 0, "bt_id_create: %d", err);

	err = bt_enable(NULL);
	TEST_ASSERT(err == 0, "bt_enable: %d", err);

	err = bt_l2cap_server_register(&server_a);
	TEST_ASSERT(err == 0, "register server A: %d", err);

	err = bt_l2cap_server_register(&server_b);
	TEST_ASSERT(err == 0, "register server B: %d", err);

	err = bt_testlib_adv_conn(&conn, BT_ID_DEFAULT, NULL);
	TEST_ASSERT(err == 0, "adv_conn: %d", err);

	/* The tester opens a channel that server B accepts. */
	WAIT_FOR_FLAG(flag_accepted_connected);

	TEST_ASSERT(unregister_in_accept == -EBUSY, "unregister from accept(): %d",
		    unregister_in_accept);

	err = bt_l2cap_server_unregister(&server_b);
	TEST_ASSERT(err == -EBUSY, "unregister with an accepted channel: %d", err);

	/* Server A has no channels, so it goes even while server B is busy. */
	err = bt_l2cap_server_unregister(&server_a);
	TEST_ASSERT(err == 0, "unregister the idle server: %d", err);

	err = bt_l2cap_server_register(&server_a);
	TEST_ASSERT(err == 0, "register server A again on the same PSM: %d", err);

	err = bt_l2cap_chan_disconnect(&dut_accepted_chan.chan);
	TEST_ASSERT(err == 0, "chan disconnect: %d", err);
	WAIT_FOR_FLAG(flag_accepted_disconnected);

	err = bt_l2cap_server_unregister(&server_b);
	TEST_ASSERT(err == 0, "unregister once the channel is gone: %d", err);

	err = bt_l2cap_server_unregister(&server_b);
	TEST_ASSERT(err == -ENOENT, "unregister a second time: %d", err);

	/* An outgoing channel carries the PSM of server A, but it is not a
	 * channel that server accepted, so it must not block unregistering.
	 */
	err = bt_l2cap_chan_connect(conn, &dut_outgoing_chan.chan, TEST_DATA_L2CAP_PSM_A);
	TEST_ASSERT(err == 0, "chan connect: %d", err);

	while (!atomic_test_bit(dut_outgoing_chan.chan.status, BT_L2CAP_STATUS_OUT)) {
		k_sleep(K_MSEC(10));
	}

	err = bt_l2cap_server_unregister(&server_a);
	TEST_ASSERT(err == 0, "unregister with only an outgoing channel: %d", err);

	TEST_PASS_AND_EXIT("dut");
}

static struct bt_l2cap_le_chan tester_accepted_chan = {
	.chan.ops =
		&(const struct bt_l2cap_chan_ops){
			.recv = chan_recv_cb,
		},
};

static struct bt_l2cap_le_chan tester_outgoing_chan = {
	.chan.ops =
		&(const struct bt_l2cap_chan_ops){
			.recv = chan_recv_cb,
		},
};

static int tester_accept_cb(struct bt_conn *conn, struct bt_l2cap_server *server,
			    struct bt_l2cap_chan **chan)
{
	ARG_UNUSED(conn);
	ARG_UNUSED(server);

	*chan = &tester_accepted_chan.chan;

	return 0;
}

static struct bt_l2cap_server test_server = {
	.accept = tester_accept_cb,
	.psm = TEST_DATA_L2CAP_PSM_A,
};

void entrypoint_tester(void)
{
	struct bt_conn *conn = NULL;
	int err;

	TEST_START("tester");

	err = bt_enable(NULL);
	TEST_ASSERT(err == 0, "bt_enable: %d", err);

	/* The DUT opens a channel to this server at the end of the test. */
	err = bt_l2cap_server_register(&test_server);
	TEST_ASSERT(err == 0, "register: %d", err);

	err = bt_testlib_connect(&TEST_DATA_DUT_ADDR, &conn);
	TEST_ASSERT(err == 0, "connect: %d", err);

	err = bt_l2cap_chan_connect(conn, &tester_outgoing_chan.chan, TEST_DATA_L2CAP_PSM_B);
	TEST_ASSERT(err == 0, "chan connect: %d", err);

	while (!atomic_test_bit(tester_outgoing_chan.chan.status, BT_L2CAP_STATUS_OUT)) {
		k_sleep(K_MSEC(10));
	}

	TEST_PASS("tester");
}

static const struct bst_test_instance test_def[] = {
	{
		.test_id = "dut",
		.test_descr = "DUT L2CAP server unregister",
		.test_main_f = entrypoint_dut,
	},
	{
		.test_id = "tester",
		.test_descr = "Tester L2CAP server unregister",
		.test_main_f = entrypoint_tester,
	},
	BSTEST_END_MARKER
};

struct bst_test_list *test_main_l2cap_server_unregister_install(struct bst_test_list *tests)
{
	return bst_add_tests(tests, test_def);
}
```
