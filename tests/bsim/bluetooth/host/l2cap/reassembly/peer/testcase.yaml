## tests/bsim/bluetooth/host/l2cap/reassembly/peer/testcase.yaml
```yaml
tests:
  bluetooth.host.l2cap.reassembly.peer:
    build_only: true
    tags:
      - bluetooth
    platform_allow:
      - nrf52_bsim/native
    harness: bsim
    harness_config:
      bsim_exe_name: tests_bsim_bluetooth_host_l2cap_reassembly_peer_prj_conf
```

## tests/bsim/bluetooth/host/l2cap/reassembly/testcase.yaml
```yaml
tests:
  bluetooth.host.l2cap.reassembly.test:
    no_build: true
    tags:
      - bluetooth
    platform_allow:
      - nrf52_bsim/native
    timeout: 30
    harness: bsim
    harness_config:
      bsim_verbosity: 2
      bsim_sim_length: 10e6
      bsim_devices:
        - test_id: dut
          exe: tests_bsim_bluetooth_host_l2cap_reassembly_dut_prj_conf
          options:
            - -argstest
            - log_level
            - '3'
        - test_id: peer
          exe: tests_bsim_bluetooth_host_l2cap_reassembly_peer_prj_conf
```

## tests/bsim/bluetooth/host/l2cap/send_on_connect/testcase.yaml
```yaml
common:
  tags:
    - bluetooth
  platform_allow:
    - nrf52_bsim/native
    - nrf5340bsim/nrf5340/cpunet
  timeout: 120
  harness: bsim
  harness_config:
    bsim_verbosity: 2
    bsim_sim_length: 30e6

tests:
  bluetooth.host.l2cap.send_on_connect:
    harness_config:
      bsim_exe_name: tests_bsim_bluetooth_host_l2cap_send_on_connect_prj_conf
      bsim_devices:
        - test_id: central
        - test_id: peripheral

  bluetooth.host.l2cap.send_on_connect_ecred:
    harness_config:
      bsim_exe_name: tests_bsim_bluetooth_host_l2cap_send_on_connect_prj_conf_overlay-ecred_conf
      bsim_devices:
        - test_id: central
        - test_id: peripheral
    extra_args:
      EXTRA_CONF_FILE=overlay-ecred.conf
```

## tests/bsim/bluetooth/host/l2cap/split/dut/testcase.yaml
```yaml
tests:
  bluetooth.host.l2cap.split.dut:
    build_only: true
    tags:
      - bluetooth
    platform_allow:
      - nrf52_bsim/native
    harness: bsim
    harness_config:
      bsim_exe_name: tests_bsim_bluetooth_host_l2cap_split_dut_prj_conf
```

## tests/bsim/bluetooth/host/l2cap/split/testcase.yaml
```yaml
tests:
  bluetooth.host.l2cap.split.test:
    no_build: true
    tags:
      - bluetooth
    platform_allow:
      - nrf52_bsim/native
    timeout: 30
    harness: bsim
    harness_config:
      bsim_verbosity: 2
      bsim_sim_length: 30e6
      bsim_devices:
        - test_id: test_0
          exe: tests_bsim_bluetooth_host_l2cap_split_dut_prj_conf
        - test_id: test_0
          exe: tests_bsim_bluetooth_host_l2cap_split_tester_prj_conf
      bsim_options:
        - -RealEncryption=1
```

## tests/bsim/bluetooth/host/l2cap/split/tester/testcase.yaml
```yaml
tests:
  bluetooth.host.l2cap.split.tester:
    build_only: true
    tags:
      - bluetooth
    platform_allow:
      - nrf52_bsim/native
    harness: bsim
    harness_config:
      bsim_exe_name: tests_bsim_bluetooth_host_l2cap_split_tester_prj_conf
```

## tests/bsim/bluetooth/host/l2cap/stress/testcase.yaml
```yaml
common:
  tags:
    - bluetooth
  platform_allow:
    - nrf52_bsim/native
  timeout: 120
  harness: bsim
  harness_config:
    bsim_verbosity: 2
    bsim_sim_length: 400e6
    bsim_test_ids:
      - central
      - peripheral
      - peripheral
      - peripheral
      - peripheral
      - peripheral
      - peripheral

tests:
  bluetooth.host.l2cap.stress:
    harness_config:
      bsim_exe_name:
        - tests_bsim_bluetooth_host_l2cap_stress_prj_conf
  bluetooth.host.l2cap.stress_nofrag:
    harness_config:
      bsim_exe_name:
        - tests_bsim_bluetooth_host_l2cap_stress_prj_conf_overlay-nofrag_conf
    extra_args: EXTRA_CONF_FILE=overlay-nofrag.conf
  bluetooth.host.l2cap.stress_syswq:
    harness_config:
      bsim_exe_name:
        - tests_bsim_bluetooth_host_l2cap_stress_prj_conf_overlay-syswq_conf
    extra_args: EXTRA_CONF_FILE=overlay-syswq.conf
```

## tests/bsim/bluetooth/host/l2cap/userdata/testcase.yaml
```yaml
tests:
  bluetooth.host.l2cap.userdata:
    tags:
      - bluetooth
    platform_allow:
      - nrf52_bsim/native
    timeout: 2
    harness: bsim
    harness_config:
      bsim_exe_name:
        - tests_bsim_bluetooth_host_l2cap_userdata_prj_conf
      bsim_verbosity: 2
      bsim_sim_length: 5e6
      bsim_test_ids:
        - central
        - peripheral
```

## tests/bsim/bluetooth/host/misc/acl_tx_frag/testcase.yaml
```yaml
tests:
  bluetooth.host.mics.acl_tx_frag:
    build_only: true
    tags:
      - bluetooth
    platform_allow:
      - nrf52_bsim/native
    harness: bsim
    harness_config:
      bsim_exe_name: tests_bsim_bluetooth_host_misc_acl_tx_frag_prj_conf
```

## tests/bsim/bluetooth/host/misc/conn_stress/peripheral/testcase.yaml
```yaml
tests:
  bluetooth.host.misc.conn_stress.peripheral:
    tags:
      - bluetooth
    platform_allow:
      - nrf52_bsim/native
    harness: bsim
    harness_config:
      bsim_exe_name: tests_bsim_bluetooth_host_misc_conn_stress_peripheral_prj_conf
```

## tests/bsim/bluetooth/host/misc/disable/testcase.yaml
```yaml
tests:
  bluetooth.host.mics.disable:
    build_only: true
    tags:
      - bluetooth
    platform_allow:
      - nrf52_bsim/native
      - nrf5340bsim/nrf5340/cpunet
    harness: bsim
    harness_config:
      bsim_exe_name: tests_bsim_bluetooth_host_misc_disable_prj_conf
```

## tests/bsim/bluetooth/host/misc/disconnect/dut/testcase.yaml
```yaml
tests:
  bluetooth.host.misc.disconnect.dut:
    build_only: true
    tags:
      - bluetooth
    platform_allow:
      - nrf52_bsim/native
    harness: bsim
    harness_config:
      bsim_exe_name: tests_bsim_bluetooth_host_misc_disconnect_dut_prj_conf
```

## tests/bsim/bluetooth/host/misc/disconnect/testcase.yaml
```yaml
tests:
  bluetooth.host.misc.disconnect.test:
    no_build: true
    tags:
      - bluetooth
    platform_allow:
      - nrf52_bsim/native
    timeout: 30
    harness: bsim
    harness_config:
      bsim_verbosity: 2
      bsim_sim_length: 10e6
      bsim_devices:
        - test_id: dut
          exe: tests_bsim_bluetooth_host_misc_disconnect_dut_prj_conf
        - test_id: tester
          exe: tests_bsim_bluetooth_host_misc_disconnect_tester_prj_conf
      bsim_options:
        - -RealEncryption=0
```

## tests/bsim/bluetooth/host/misc/disconnect/tester/testcase.yaml
```yaml
tests:
  bluetooth.host.misc.disconnect.tester:
    build_only: true
    tags:
      - bluetooth
    platform_allow:
      - nrf52_bsim/native
    harness: bsim
    harness_config:
      bsim_exe_name: tests_bsim_bluetooth_host_misc_disconnect_tester_prj_conf
```

## tests/bsim/bluetooth/host/misc/hfc/testcase.yaml
```yaml
tests:
  bluetooth.host.mics.hfc:
    tags:
      - bluetooth
    platform_allow:
      - nrf52_bsim/native
    timeout: 60
    harness: bsim
    harness_config:
      bsim_exe_name:
        - tests_bsim_bluetooth_host_misc_hfc_prj_conf
      bsim_verbosity: 2
      bsim_sim_length: 60e6
      bsim_test_ids:
        - dut
        - peer
```

## tests/bsim/bluetooth/host/misc/hfc_multilink/dut/testcase.yaml
```yaml
tests:
  bluetooth.host.misc.hfc_multilink.dut:
    build_only: true
    sysbuild: true
    tags:
      - bluetooth
    platform_allow:
      - nrf52_bsim/native
      - nrf5340bsim/nrf5340/cpuapp
    harness: bsim
    harness_config:
      bsim_exe_name: tests_bsim_bluetooth_host_misc_hfc_multilink_dut_prj_conf
```

## tests/bsim/bluetooth/host/misc/hfc_multilink/testcase.yaml
```yaml
tests:
  bluetooth.host.misc.hfc_multilink.test:
    no_build: true
    tags:
      - bluetooth
    platform_allow:
      - nrf52_bsim/native
    timeout: 30
    harness: bsim
    harness_config:
      bsim_verbosity: 2
      bsim_sim_length: 10e6
      bsim_devices:
        - test_id: dut
          exe: tests_bsim_bluetooth_host_misc_hfc_multilink_dut_prj_conf
        - test_id: tester
          exe: tests_bsim_bluetooth_host_misc_hfc_multilink_tester_prj_conf
        - test_id: tester
          exe: tests_bsim_bluetooth_host_misc_hfc_multilink_tester_prj_conf
        - test_id: tester
          exe: tests_bsim_bluetooth_host_misc_hfc_multilink_tester_prj_conf
```

## tests/bsim/bluetooth/host/misc/hfc_multilink/tester/Kconfig
```kconfig
# Kconfig options for the test
#
# Copyright (c) 2024 Nordic Semiconductor ASA
# SPDX-License-Identifier: Apache-2.0

menu "Test configuration"

module = APP
module-str = app

source "subsys/logging/Kconfig.template.log_config"

endmenu

source "Kconfig.zephyr"
```

## tests/bsim/bluetooth/host/misc/hfc_multilink/tester/testcase.yaml
```yaml
tests:
  bluetooth.host.misc.hfc_multilink.tester:
    build_only: true
    sysbuild: true
    tags:
      - bluetooth
    platform_allow:
      - nrf52_bsim/native
      - nrf5340bsim/nrf5340/cpuapp
    harness: bsim
    harness_config:
      bsim_exe_name: tests_bsim_bluetooth_host_misc_hfc_multilink_tester_prj_conf
```

## tests/bsim/bluetooth/host/misc/sample_test/testcase.yaml
```yaml
tests:
  bluetooth.host.mics.sample_test:
    tags:
      - bluetooth
    platform_allow:
      - nrf52_bsim/native
    timeout: 30
    harness: bsim
    harness_config:
      bsim_exe_name: tests_bsim_bluetooth_host_misc_sample_test_prj_conf
      bsim_verbosity: 2
      bsim_sim_length: 2e6
      bsim_devices:
        - test_id: dut
        - test_id: peer
      bsim_options:
        - -argstest
        - log_level
        - '3'
```

## tests/bsim/bluetooth/host/misc/unregister_conn_cb/testcase.yaml
```yaml
tests:
  bluetooth.host.mics.unregister_conn_cb:
    build_only: true
    tags:
      - bluetooth
    platform_allow:
      - nrf52_bsim/native
      - nrf5340bsim/nrf5340/cpunet
    harness: bsim
    harness_config:
      bsim_exe_name: tests_bsim_bluetooth_host_misc_unregister_conn_cb_prj_conf
```

## tests/bsim/bluetooth/host/multirole_gatt_relay/testcase.yaml
```yaml
tests:
  bsim.bluetooth.host.multirole_gatt_relay:
    build_only: true
    tags:
      - bluetooth
    platform_allow:
      - nrf52_bsim/native
    harness: bsim
    harness_config:
      bsim_exe_name: tests_bsim_bluetooth_host_multirole_gatt_relay_prj_conf
```

## tests/bsim/bluetooth/host/privacy/central/testcase.yaml
```yaml
common:
  tags:
    - bluetooth
  platform_allow:
    - nrf52_bsim/native
    - nrf5340bsim/nrf5340/cpunet
  harness: bsim
  no_build: true
  harness_config:
    bsim_exe_name:
      - tests_bsim_bluetooth_host_privacy_central_prj_conf
    bsim_verbosity: 2
    bsim_sim_length: 60e6
    bsim_options:
      - -RealEncryption=1

tests:
  bluetooth.host.privacy.build_central:
    build_only: true
    no_build: false
  bluetooth.host.privacy.central:
    harness_config:
      bsim_test_ids:
        - central
        - peripheral
  bluetooth.host.privacy.central_short_conn_timeout:
    harness_config:
      bsim_test_ids:
        - central_connect_fails_with_short_rpa_timeout
  bluetooth.host.privacy.central_short_rpa_timeout:
    harness_config:
      bsim_test_ids:
        - central_connect_short_rpa_timeout
        - periph_delayed_start_of_conn_adv
```

## tests/bsim/bluetooth/host/privacy/device/testcase.yaml
```yaml
tests:
  bluetooth.host.privacy.device:
    build_only: true
    tags:
      - bluetooth
    platform_allow:
      - nrf52_bsim/native
    harness: bsim
    harness_config:
      bsim_exe_name: tests_bsim_bluetooth_host_privacy_device_prj_conf
```

## tests/bsim/bluetooth/host/privacy/legacy/testcase.yaml
```yaml
tests:
  bluetooth.host.privacy.legacy:
    build_only: true
    tags:
      - bluetooth
    platform_allow:
      - nrf52_bsim/native
    harness: bsim
    harness_config:
      bsim_exe_name: tests_bsim_bluetooth_host_privacy_legacy_prj_conf
```
