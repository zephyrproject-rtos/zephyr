## CMakeLists.txt
```
# SPDX-License-Identifier: Apache-2.0

cmake_minimum_required(VERSION 3.28.0)

find_package(Zephyr REQUIRED HINTS $ENV{ZEPHYR_BASE})

project(ecred_dut)

add_subdirectory(${ZEPHYR_BASE}/tests/bluetooth/common/testlib testlib)
target_link_libraries(app PRIVATE testlib)

add_subdirectory(${ZEPHYR_BASE}/tests/bsim/babblekit babblekit)
target_link_libraries(app PRIVATE babblekit)

zephyr_include_directories(
  ${BSIM_COMPONENTS_PATH}/libUtilv1/src/
  ${BSIM_COMPONENTS_PATH}/libPhyComv1/src/
)

target_sources(app PRIVATE
  src/main.c
  src/dut.c
)
```

## Kconfig
```
# Kconfig options for the test
#
# Only used as single point for log level configuration.
# Can be extended with any new kconfig, really.
#
# Copyright (c) 2024 Nordic Semiconductor ASA
# SPDX-License-Identifier: Apache-2.0

menu "Test configuration"

module = APP
module-str = app

source "subsys/logging/Kconfig.template.log_config"

endmenu

source "Kconfig.zephyr"
```

## prj.conf
```kconfig
CONFIG_BT=y
CONFIG_BT_DEVICE_NAME="ecred"
CONFIG_BT_CENTRAL=y

CONFIG_BT_SMP=y # Next config depends on it
CONFIG_BT_L2CAP_DYNAMIC_CHANNEL=y
CONFIG_BT_L2CAP_ECRED=y

# Disable auto-initiated procedures so they don't
# mess with the test's execution.
CONFIG_BT_AUTO_PHY_CENTRAL_NONE=y
CONFIG_BT_AUTO_DATA_LEN_UPDATE=n
CONFIG_BT_GAP_AUTO_UPDATE_CONN_PARAMS=n

# Dependency of testlib/adv and testlib/scan.
CONFIG_BT_EXT_ADV=y

CONFIG_ASSERT=y
CONFIG_LOG=y
CONFIG_THREAD_NAME=y
CONFIG_LOG_THREAD_ID_PREFIX=y

CONFIG_ARCH_POSIX_TRAP_ON_FATAL=y

# CONFIG_APP_LOG_LEVEL_DBG=y
# CONFIG_BT_L2CAP_LOG_LEVEL_DBG=y

# Don't print the bt init stuff
CONFIG_BT_HCI_CORE_LOG_LEVEL_WRN=y

CONFIG_SYSTEM_WORKQUEUE_STACK_IGNORE_MIN=y
```

## src/main.c
```c
/*
 * Copyright (c) 2024 Nordic Semiconductor ASA
 *
 * SPDX-License-Identifier: Apache-2.0
 */

#include <zephyr/kernel.h>

#include "bs_tracing.h"
#include "bstests.h"
#include "babblekit/testcase.h"

extern void entrypoint_dut(void);
extern enum bst_result_t bst_result;


static void test_end_cb(void)
{
	if (bst_result != Passed) {
		TEST_PRINT("Test has not passed.");
	}
}

static const struct bst_test_instance entrypoints[] = {
	{
		.test_id = "dut",
		.test_delete_f = test_end_cb,
		.test_main_f = entrypoint_dut,
	},
	BSTEST_END_MARKER,
};

static struct bst_test_list *install(struct bst_test_list *tests)
{
	return bst_add_tests(tests, entrypoints);
};

bst_test_install_t test_installers[] = {install, NULL};

int main(void)
{
	bst_main();

	return 0;
}
```

## src/dut.c
```c
/*
 * Copyright (c) 2024 Nordic Semiconductor ASA
 *
 * SPDX-License-Identifier: Apache-2.0
 */

#include <zephyr/kernel.h>
#include <zephyr/bluetooth/bluetooth.h>
#include <zephyr/bluetooth/conn.h>
#include <zephyr/bluetooth/l2cap.h>
#include <zephyr/logging/log.h>

#include <testlib/conn.h>
#include <testlib/scan.h>

#include <babblekit/flags.h>
#include <babblekit/testcase.h>

LOG_MODULE_REGISTER(dut, CONFIG_APP_LOG_LEVEL);

static atomic_t disconnected_channels;

static struct bt_l2cap_le_chan chans[4];

void sent_cb(struct bt_l2cap_chan *chan)
{
	LOG_DBG("%p", chan);
}

int recv_cb(struct bt_l2cap_chan *chan, struct net_buf *buf)
{
	LOG_DBG("%p", chan);

	return 0;
}

void l2cap_chan_connected_cb(struct bt_l2cap_chan *l2cap_chan)
{
	TEST_ASSERT("This shouldn't happen");
}

void l2cap_chan_disconnected_cb(struct bt_l2cap_chan *chan)
{
	atomic_inc(&disconnected_channels);
}

static struct bt_l2cap_chan_ops ops = {
	.connected = l2cap_chan_connected_cb,
	.disconnected = l2cap_chan_disconnected_cb,
	.recv = recv_cb,
	.sent = sent_cb,
};

void entrypoint_dut(void)
{
	/* Test purpose:
	 *
	 * Verify that a peer that doesn't support ECRED channels doesn't result
	 * in us keeping half-open channels.
	 *
	 * Two devices:
	 * - `dut`: tries to establish 4 ecred chans
	 * - `peer`: rejects the request
	 *
	 * Initial conditions:
	 * - Both devices are connected
	 *
	 * Procedure:
	 * - [dut] request to establish 4 ecred channels
	 * - [peer] reject command as unknown
	 * - [dut] get `disconnected` called on all 4 channels
	 *
	 * [verdict]
	 * - each channel gets the `disconnected` callback called
	 */
	int err;
	bt_addr_le_t peer = {};
	struct bt_conn *conn = NULL;

	TEST_START("dut");

	/* Initialize Bluetooth */
	err = bt_enable(NULL);
	TEST_ASSERT(err == 0, "Can't enable Bluetooth (err %d)", err);
	LOG_DBG("Bluetooth initialized");

	err = bt_testlib_scan_find_name(&peer, "ecred_peer");
	TEST_ASSERT(!err, "Failed to start scan (err %d)", err);

	/* Create a connection using that address */
	err = bt_testlib_connect(&peer, &conn);
	TEST_ASSERT(!err, "Failed to initiate connection (err %d)", err);

	LOG_DBG("Connected");

	LOG_INF("Send ECRED connection request");
	struct bt_l2cap_chan *chan_list[5] = {0};

	for (int i = 0; i < 4; i++) {
		/* Register the callbacks */
		chans[i].chan.ops = &ops;

		/* Add the channel to the connection request list */
		chan_list[i] = &chans[i].chan;
	}

	/* The PSM doesn't matter, as the peer doesn't support the command */
	err = bt_l2cap_ecred_chan_connect(conn, chan_list, 0x0080);
	TEST_ASSERT(!err, "Error connecting l2cap channels (err %d)\n", err);

	LOG_INF("Wait until peer rejects the channel establishment request");
	while (atomic_get(&disconnected_channels) < 4) {
		k_sleep(K_MSEC(10));
	}

	TEST_PASS_AND_EXIT("dut");
}
```
