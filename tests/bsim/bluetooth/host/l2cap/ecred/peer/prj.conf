## CMakeLists.txt
```
# SPDX-License-Identifier: Apache-2.0

cmake_minimum_required(VERSION 3.28.0)

find_package(Zephyr REQUIRED HINTS $ENV{ZEPHYR_BASE})

project(ecred_peer)

add_subdirectory(${ZEPHYR_BASE}/tests/bluetooth/common/testlib testlib)
target_link_libraries(app PRIVATE testlib)

add_subdirectory(${ZEPHYR_BASE}/tests/bsim/babblekit babblekit)
target_link_libraries(app PRIVATE babblekit)

zephyr_include_directories(
  ${BSIM_COMPONENTS_PATH}/libUtilv1/src/
  ${BSIM_COMPONENTS_PATH}/libPhyComv1/src/
)

target_sources(app PRIVATE
  src/main.c
  src/peer.c
)
```

## prj.conf
```kconfig
CONFIG_BT=y
CONFIG_BT_DEVICE_NAME="ecred_peer"
CONFIG_BT_PERIPHERAL=y

CONFIG_BT_SMP=y
CONFIG_BT_L2CAP_DYNAMIC_CHANNEL=y
CONFIG_BT_L2CAP_ECRED=n

# Disable auto-initiated procedures so they don't
# mess with the test's execution.
CONFIG_BT_AUTO_DATA_LEN_UPDATE=n
CONFIG_BT_GAP_AUTO_UPDATE_CONN_PARAMS=n

# Dependency of testlib/adv and testlib/scan.
CONFIG_BT_EXT_ADV=y

CONFIG_ASSERT=y
CONFIG_LOG=y
CONFIG_THREAD_NAME=y
CONFIG_LOG_THREAD_ID_PREFIX=y

CONFIG_ARCH_POSIX_TRAP_ON_FATAL=y

# CONFIG_APP_LOG_LEVEL_DBG=y
# CONFIG_BT_L2CAP_LOG_LEVEL_DBG=y

# Don't print the bt init stuff
CONFIG_BT_HCI_CORE_LOG_LEVEL_WRN=y

CONFIG_SYSTEM_WORKQUEUE_STACK_IGNORE_MIN=y
```

## src/main.c
```c
/*
 * Copyright (c) 2024 Nordic Semiconductor ASA
 *
 * SPDX-License-Identifier: Apache-2.0
 */

#include <zephyr/kernel.h>

#include <bs_tracing.h>
#include <bstests.h>
#include <babblekit/testcase.h>

extern void entrypoint_peer(void);
extern enum bst_result_t bst_result;


static void test_end_cb(void)
{
	if (bst_result != Passed) {
		TEST_PRINT("Test has not passed.");
	}
}

static const struct bst_test_instance entrypoints[] = {
	{
		.test_id = "peer",
		.test_delete_f = test_end_cb,
		.test_main_f = entrypoint_peer,
	},
	BSTEST_END_MARKER,
};

static struct bst_test_list *install(struct bst_test_list *tests)
{
	return bst_add_tests(tests, entrypoints);
};

bst_test_install_t test_installers[] = {install, NULL};

int main(void)
{
	bst_main();

	return 0;
}
```

## src/peer.c
```c
/*
 * Copyright (c) 2024 Nordic Semiconductor ASA
 *
 * SPDX-License-Identifier: Apache-2.0
 */

#include <zephyr/kernel.h>
#include <zephyr/bluetooth/bluetooth.h>
#include <zephyr/bluetooth/conn.h>
#include <zephyr/bluetooth/att.h>
#include <zephyr/bluetooth/gatt.h>
#include <zephyr/logging/log.h>

#include "testlib/adv.h"
#include "testlib/att_read.h"
#include "testlib/att_write.h"
#include "testlib/conn.h"

#include "babblekit/flags.h"
#include "babblekit/testcase.h"

void entrypoint_peer(void)
{
	int err;
	struct bt_conn *conn;

	/* Mark test as in progress. */
	TEST_START("peer");

	/* Initialize Bluetooth */
	err = bt_enable(NULL);
	TEST_ASSERT(err == 0, "Can't enable Bluetooth (err %d)", err);

	err = bt_testlib_adv_conn(&conn, BT_ID_DEFAULT, bt_get_name());
	TEST_ASSERT(!err, "Failed to start connectable advertising (err %d)", err);

	TEST_PASS("peer");
}
```
