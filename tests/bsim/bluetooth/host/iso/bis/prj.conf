## CMakeLists.txt
```
# SPDX-License-Identifier: Apache-2.0

cmake_minimum_required(VERSION 3.28.0)

find_package(Zephyr REQUIRED HINTS $ENV{ZEPHYR_BASE})

project(bsim_test_iso_bis)

add_subdirectory(${ZEPHYR_BASE}/tests/bsim/babblekit babblekit)
target_link_libraries(app PRIVATE babblekit)

target_sources(app PRIVATE
  src/bis_broadcaster.c
  src/bis_receiver.c
  src/main.c

  ${ZEPHYR_BASE}/tests/bsim/bluetooth/host/iso/common/iso_tx.c
)

zephyr_include_directories(
  ${BSIM_COMPONENTS_PATH}/libUtilv1/src/
  ${BSIM_COMPONENTS_PATH}/libPhyComv1/src/

  ${ZEPHYR_BASE}/tests/bsim/bluetooth/host/iso/common
)
```

## Kconfig.sysbuild
```
# Copyright (c) 2023-2025 Nordic Semiconductor ASA
# SPDX-License-Identifier: Apache-2.0

source "share/sysbuild/Kconfig"

config NET_CORE_BOARD
	string
	default "nrf5340bsim/nrf5340/cpunet" if $(BOARD_TARGET_STRING) = "NRF5340BSIM_NRF5340_CPUAPP"

config NET_CORE_IMAGE_HCI_IPC
	bool "HCI IPC image on network core"
	default y
	depends on NET_CORE_BOARD != ""


config NATIVE_SIMULATOR_PRIMARY_MCU_INDEX
	int
	# Let's pass the test arguments to the application MCU test
	# otherwise by default they would have gone to the net core.
	default 0 if $(BOARD_TARGET_STRING) = "NRF5340BSIM_NRF5340_CPUAPP"
```

## prj.conf
```kconfig
CONFIG_BT=y
CONFIG_LOG=y
CONFIG_ASSERT=y
CONFIG_BT_EXT_ADV=y
CONFIG_BT_PER_ADV=y
CONFIG_BT_PER_ADV_SYNC=y
CONFIG_BT_OBSERVER=y

CONFIG_BT_DEVICE_NAME="BIS test"

CONFIG_BT_ISO_BROADCASTER=y
CONFIG_BT_ISO_SYNC_RECEIVER=y
CONFIG_BT_ISO_MAX_CHAN=2
# The receiver_big_sync_term test uses two BIG handles
CONFIG_BT_EXT_ADV_MAX_ADV_SET=2
CONFIG_BT_ISO_MAX_BIG=2
CONFIG_BT_ISO_TX_BUF_COUNT=4
CONFIG_BT_ISO_RX_BUF_COUNT=4
CONFIG_BT_ISO_RX_MTU=600

CONFIG_BT_ISO_LOG_LEVEL_DBG=y
```

## controller.conf
```kconfig
# Controller ISO configs
CONFIG_BT_CTLR_ADV_ISO=y
CONFIG_BT_CTLR_ADV_ISO_STREAM_MAX=2
CONFIG_BT_CTLR_ADV_ISO_STREAM_COUNT=2
CONFIG_BT_CTLR_SYNC_ISO=y
CONFIG_BT_CTLR_SYNC_ISO_STREAM_MAX=2
CONFIG_BT_CTLR_SYNC_ISO_STREAM_COUNT=2
CONFIG_BT_CTLR_SCAN_SYNC_ISO_SET=2

CONFIG_BT_CTLR_ISO_TX_BUFFER_SIZE=204
CONFIG_BT_CTLR_ISO_TX_SDU_LEN_MAX=600
# The host may fragment a single SDU into 3, so CONFIG_BT_CTLR_ISO_TX_BUFFERS
# needs to be 3 x CONFIG_BT_ISO_TX_BUF_COUNT
CONFIG_BT_CTLR_ISO_TX_BUFFERS=12
CONFIG_BT_CTLR_ISOAL_SOURCES=2
CONFIG_BT_CTLR_ISOAL_SINKS=2

CONFIG_BT_ISO_RX_BUF_COUNT=4
# Match CONFIG_BT_CTLR_ISO_TX_SDU_LEN_MAX
CONFIG_BT_ISO_RX_MTU=600
```

## src/main.c
```c
/*
 * Copyright (c) 2024 Nordic Semiconductor
 *
 * SPDX-License-Identifier: Apache-2.0
 */

#include "bstests.h"

extern struct bst_test_list *test_main_bis_broadcaster_install(struct bst_test_list *tests);
extern struct bst_test_list *test_main_bis_receiver_install(struct bst_test_list *tests);

bst_test_install_t test_installers[] = {
	test_main_bis_broadcaster_install,
	test_main_bis_receiver_install,
	NULL,
};

int main(void)
{
	bst_main();
	return 0;
}
```

## src/bis_broadcaster.c
```c
/*
 * Copyright (c) 2024-2025 Nordic Semiconductor
 *
 * SPDX-License-Identifier: Apache-2.0
 */

#include <stdbool.h>
#include <stddef.h>
#include <stdint.h>

#include <zephyr/autoconf.h>
#include <zephyr/bluetooth/bluetooth.h>
#include <zephyr/bluetooth/gap.h>
#include <zephyr/bluetooth/hci_types.h>
#include <zephyr/bluetooth/iso.h>
#include <zephyr/kernel.h>
#include <zephyr/logging/log.h>
#include <zephyr/logging/log_core.h>
#include <zephyr/net_buf.h>
#include <zephyr/sys/clock.h>
#include <zephyr/sys/util.h>
#include <zephyr/toolchain.h>

#include "babblekit/flags.h"
#include "babblekit/sync.h"
#include "babblekit/testcase.h"
#include "bstests.h"
#include "common.h"
#include "iso_tx.h"

LOG_MODULE_REGISTER(bis_broadcaster, LOG_LEVEL_INF);

#define LATENCY_MS 10U /* 10ms */

extern enum bst_result_t bst_result;
static struct bt_iso_chan iso_chans[CONFIG_BT_ISO_MAX_CHAN];
static struct bt_iso_chan *default_chan = &iso_chans[0];

static struct bt_iso_chan_io_qos iso_tx = {
	.sdu = 0U,
	.phy = BT_GAP_LE_PHY_2M,
	.rtn = 1,
};

static struct bt_iso_chan_qos iso_qos = {
	.tx = &iso_tx,
	.rx = NULL,
};

DEFINE_FLAG_STATIC(flag_iso_connected);
DEFINE_FLAG_STATIC(flag_big_active);

static void iso_connected_cb(struct bt_iso_chan *chan)
{
	const struct bt_iso_chan_path hci_path = {
		.pid = BT_ISO_DATA_PATH_HCI,
		.format = BT_HCI_CODING_FORMAT_TRANSPARENT,
	};
	struct bt_iso_info info;
	int err;

	LOG_INF("ISO Channel %p connected", chan);

	err = bt_iso_chan_get_info(chan, &info);
	TEST_ASSERT(err == 0, "Failed to get BIS info: %d", err);

	TEST_ASSERT(!info.can_recv);
	TEST_ASSERT(info.can_send);
	TEST_ASSERT(info.type == BT_ISO_CHAN_TYPE_BROADCASTER);
	TEST_ASSERT((BT_GAP_ISO_INTERVAL_TO_US(info.iso_interval) % SDU_INTERVAL_US) == 0U,
		    "ISO interval %u (%u) shall be a multiple of the SDU interval %u",
		    BT_GAP_ISO_INTERVAL_TO_US(info.iso_interval), info.iso_interval,
		    SDU_INTERVAL_US);
	TEST_ASSERT(IN_RANGE(info.iso_interval, BT_ISO_ISO_INTERVAL_MIN, BT_ISO_ISO_INTERVAL_MAX),
		    "Invalid ISO interval 0x%04x", info.iso_interval);
	TEST_ASSERT(IN_RANGE(info.max_subevent, BT_ISO_NSE_MIN, BT_ISO_NSE_MAX),
		    "Invalid subevent number 0x%02x", info.max_subevent);
	TEST_ASSERT(IN_RANGE(info.broadcaster.sync_delay, BT_HCI_LE_BIG_SYNC_DELAY_MIN,
			     BT_HCI_LE_BIG_SYNC_DELAY_MAX),
		    "Invalid sync delay 0x%06x", info.broadcaster.sync_delay);
	TEST_ASSERT(IN_RANGE(info.broadcaster.latency, BT_HCI_LE_TRANSPORT_LATENCY_BIG_MIN,
			     BT_HCI_LE_TRANSPORT_LATENCY_BIG_MAX),
		    "Invalid transport latency 0x%06x", info.broadcaster.latency);
	TEST_ASSERT((info.broadcaster.pto % info.iso_interval) == 0U,
		    "PTO in ms %u shall be a multiple of the ISO interval %u", info.broadcaster.pto,
		    info.iso_interval);
	TEST_ASSERT(IN_RANGE((info.broadcaster.pto / info.iso_interval), BT_ISO_PTO_MIN,
			     BT_ISO_PTO_MAX),
		    "Invalid PTO 0x%x", (info.broadcaster.pto / info.iso_interval));
	TEST_ASSERT(info.broadcaster.phy == BT_GAP_LE_PHY_1M ||
			    info.broadcaster.phy == BT_GAP_LE_PHY_2M ||
			    info.broadcaster.phy == BT_GAP_LE_PHY_CODED,
		    "Invalid PHY 0x%02x", info.broadcaster.phy);
	TEST_ASSERT(IN_RANGE(info.broadcaster.bn, BT_ISO_BN_MIN, BT_ISO_BN_MAX),
		    "Invalid BN 0x%02x", info.broadcaster.bn);
	TEST_ASSERT(IN_RANGE(info.broadcaster.irc, BT_ISO_IRC_MIN, BT_ISO_IRC_MAX),
		    "Invalid IRC 0x%02x", info.broadcaster.irc);
	TEST_ASSERT(info.broadcaster.big_handle != 0xFF /* invalid BIG handle */,
		    "Invalid BIG handle 0x%02x", info.broadcaster.big_handle);
	TEST_ASSERT(
		IN_RANGE(info.broadcaster.bis_number, BT_ISO_BIS_INDEX_MIN, BT_ISO_BIS_INDEX_MAX),
		"Invalid BIS number 0x%02x", info.broadcaster.bis_number);

	err = bt_iso_setup_data_path(chan, BT_HCI_DATAPATH_DIR_HOST_TO_CTLR, &hci_path);
	TEST_ASSERT(err == 0, "Failed to set ISO data path: %d", err);

	if (chan == default_chan) {
		/* Register for TX to start sending */
		err = iso_tx_register(chan);
		TEST_ASSERT(err == 0, "Failed to register chan for TX: %d", err);

		SET_FLAG(flag_iso_connected);
	}
}

static void iso_disconnected_cb(struct bt_iso_chan *chan, uint8_t reason)
{
	LOG_INF("ISO Channel %p disconnected (reason 0x%02x)", chan, reason);

	if (chan == default_chan) {
		int err;

		err = iso_tx_unregister(chan);
		TEST_ASSERT(err == 0, "Failed to unregister chan for TX: %d", err);

		UNSET_FLAG(flag_iso_connected);
	}
}

static void big_started_cb(struct bt_iso_big *big)
{
	ARG_UNUSED(big);

	SET_FLAG(flag_big_active);
}

static void big_stopped_cb(struct bt_iso_big *big, uint8_t reason)
{
	ARG_UNUSED(big);
	ARG_UNUSED(reason);

	UNSET_FLAG(flag_big_active);
}

static void init(void)
{
	static struct bt_iso_chan_ops iso_ops = {
		.disconnected = iso_disconnected_cb,
		.connected = iso_connected_cb,
		.sent = iso_tx_sent_cb,
		.send_failed = iso_tx_send_failed_cb,
	};
	static struct bt_iso_big_cb big_cb = {
		.started = big_started_cb,
		.stopped = big_stopped_cb,
	};
	struct bt_le_local_features local_features;
	int err;

	err = bt_enable(NULL);
	TEST_ASSERT(err == 0, "Bluetooth enable failed: %d", err);

	err = bt_le_get_local_features(&local_features);
	TEST_ASSERT(err == 0, "Getting local features failed: %d", err);

	err = bt_iso_big_register_cb(&big_cb);
	TEST_ASSERT(err == 0, "Failed to register BIG callbacks: %d", err);

	TEST_ASSERT(local_features.iso_mtu >= BT_HCI_ISO_SDU_HDR_SIZE + 1,
		    "Invalid ISO MTU: %u < %d", local_features.iso_mtu,
		    BT_HCI_ISO_SDU_HDR_SIZE + 1);

	/* Default the SDU size to the maximum HCI ISO buffer size - SDU header */
	iso_qos.tx->sdu =
		MIN(local_features.iso_mtu - BT_HCI_ISO_SDU_HDR_SIZE, ARRAY_SIZE(mock_iso_data));

	for (size_t i = 0U; i < ARRAY_SIZE(iso_chans); i++) {
		iso_chans[i].ops = &iso_ops;
		iso_chans[i].qos = &iso_qos;
	}

	bk_sync_init();

	iso_tx_init();
}

static void create_ext_adv(struct bt_le_ext_adv **adv)
{
	int err;

	LOG_INF("Creating extended advertising set with periodic advertising");

	/* Create a non-connectable advertising set */
	err = bt_le_ext_adv_create(BT_LE_EXT_ADV_NCONN, NULL, adv);
	TEST_ASSERT(err == 0, "Unable to create extended advertising set: %d", err);

	/* Set periodic advertising parameters */
	err = bt_le_per_adv_set_param(*adv, BT_LE_PER_ADV_PARAM(BT_GAP_PER_ADV_FAST_INT_MIN_2,
								BT_GAP_PER_ADV_FAST_INT_MAX_2,
								BT_LE_PER_ADV_OPT_NONE));
	TEST_ASSERT(err == 0, "Failed to set periodic advertising parameters: %d", err);
}

static void start_ext_adv(struct bt_le_ext_adv *adv)
{
	int err;

	LOG_INF("Starting extended and periodic advertising");

	/* Start extended advertising */
	err = bt_le_ext_adv_start(adv, BT_LE_EXT_ADV_START_DEFAULT);
	TEST_ASSERT(err == 0, "Failed to start extended advertising: %d", err);

	/* Enable Periodic Advertising */
	err = bt_le_per_adv_start(adv);
	TEST_ASSERT(err == 0, "Failed to enable periodic advertising: %d", err);
}

static void terminate_ext_adv(struct bt_le_ext_adv **adv)
{
	int err;

	LOG_INF("Terminating extended and periodic advertising");

	err = bt_le_per_adv_stop(*adv);
	TEST_ASSERT(err == 0, "Failed to stop per_adv: %d", err);

	err = bt_le_ext_adv_stop(*adv);
	TEST_ASSERT(err == 0, "Failed to stop ext_adv: %d", err);

	err = bt_le_ext_adv_delete(*adv);
	TEST_ASSERT(err == 0, "Failed to delete ext_adv: %d", err);
	*adv = NULL;
}

static void create_big(struct bt_le_ext_adv *adv, size_t cnt, struct bt_iso_big **out_big)
{
	struct bt_iso_chan *channels[ARRAY_SIZE(iso_chans)];
	struct bt_iso_big_create_param param = {
		.packing = BT_ISO_PACKING_SEQUENTIAL,
		.framing = BT_ISO_FRAMING_UNFRAMED,
		.interval = SDU_INTERVAL_US,
		.bis_channels = channels,
		.latency = LATENCY_MS,
		.encryption = false,
		.num_bis = cnt,
	};
	int err;

	for (size_t i = 0U; i < cnt; i++) {
		channels[i] = &iso_chans[i];
	}

	LOG_INF("Creating BIG");

	err = bt_iso_big_create(adv, &param, out_big);
	TEST_ASSERT(err == 0, "Failed to create BIG: %d", err);

	WAIT_FOR_FLAG(flag_iso_connected);
	WAIT_FOR_FLAG(flag_big_active);
}

static void terminate_big(struct bt_iso_big *big)
{
	int err;

	LOG_INF("Terminating BIG");

	err = bt_iso_big_terminate(big);
	TEST_ASSERT(err == 0, "Failed to terminate BIG: %d", err);

	WAIT_FOR_FLAG_UNSET(flag_big_active);

	big = NULL;
}

static void reset_bluetooth(void)
{
	int err;

	LOG_INF("Resetting Bluetooth");

	err = bt_disable();
	TEST_ASSERT(err == 0, "Failed to disable: %d", err);

	err = bt_enable(NULL);
	TEST_ASSERT(err == 0, "Failed to re-enable: %d", err);
}

static void test_main(void)
{
	struct bt_le_ext_adv *adv;
	struct bt_iso_big *big;

	init();

	/* Create advertising set and BIG and start it and starting TXing */
	create_ext_adv(&adv);
	create_big(adv, 1U, &big);
	start_ext_adv(adv);

	/* Wait for receiver to tell us to terminate */
	bk_sync_wait();

	terminate_big(big);
	big = NULL;

	terminate_ext_adv(&adv);

	TEST_PASS("Test passed");
}

static void test_main_disable(void)
{
	struct bt_le_ext_adv *adv = NULL;
	struct bt_iso_big *big = NULL;

	init();

	/* Perform this loop for each state in DISABLE_STATE_COUNT */
	for (enum disable_states i = 0; i < DISABLE_STATE_COUNT; i++) {
		LOG_INF("Running iteration %d", i);

		/* Sync with sync receiver before doing the next step */
		bk_sync_send();
		bk_sync_wait();

		/* Create advertising set and BIG */
		create_ext_adv(&adv);

		create_big(adv, ARRAY_SIZE(iso_chans), &big);

		start_ext_adv(adv);

		/* Wait for sync receiver to have received data */
		bk_sync_wait();

		if (i == DISABLE_STATE_BROADCASTER) {
			reset_bluetooth();
			/* After a disable, all advertising sets and BIGs are removed */
			big = NULL;
			adv = NULL;
		} else if (i == DISABLE_STATE_SYNC_RECEIVER) {
			/* no-op we just keep the broadcast alive */
		} else if (i == DISABLE_STATE_BOTH) {
			reset_bluetooth();
			/* After a disable, all advertising sets and BIGs are removed */
			big = NULL;
			adv = NULL;
		}

		/* Wait for receiver to tell us to continue to the next test step */
		bk_sync_wait();

		if (big != NULL) {
			terminate_big(big);
			big = NULL;
		}

		if (adv != NULL) {
			terminate_ext_adv(&adv);
		}
	}

	TEST_PASS("Disable test passed");
}

static void test_main_fragment(void)
{
	struct bt_le_ext_adv *adv;
	struct bt_iso_big *big;
	uint32_t new_sdu_size;

	init();

	/* Multiple the SDU by 3 so that we always fragment over HCI with a BT_ISO_START,
	 * BT_ISO_CONT and BT_ISO_END
	 */
	new_sdu_size = iso_qos.tx->sdu * 3U;

	if (new_sdu_size > ISO_TX_SDU_SIZE) {
		TEST_FAIL("Not possible to use SDU size of 0x%08X (default SDU is 0x%04X)",
			  new_sdu_size, iso_qos.tx->sdu);
		return;
	}

	if (new_sdu_size > ARRAY_SIZE(mock_iso_data)) {
		TEST_FAIL("New SDU size (%u) needs to be smaller than the mock_iso_data size %zu",
			  new_sdu_size, ARRAY_SIZE(mock_iso_data));
		return;
	}

	iso_qos.tx->sdu = (uint16_t)new_sdu_size;

	/* Create advertising set and BIG and start it and starting TXing */
	create_ext_adv(&adv);
	create_big(adv, 1U, &big);
	start_ext_adv(adv);

	/* Wait for receiver to tell us to terminate */
	bk_sync_wait();

	terminate_big(big);
	big = NULL;

	terminate_ext_adv(&adv);

	TEST_PASS("Test passed");
}

static const struct bst_test_instance test_def[] = {
	{
		.test_id = "broadcaster",
		.test_descr = "Minimal BIS broadcaster that broadcast ISO data",
		.test_main_f = test_main,
	},
	{
		.test_id = "broadcaster_disable",
		.test_descr = "BIS broadcaster that tests bt_disable for ISO",
		.test_main_f = test_main_disable,
	},
	{
		.test_id = "broadcaster_fragment",
		.test_descr = "BIS broadcaster that tests fragmentation over HCI for ISO",
		.test_main_f = test_main_fragment,
	},
	BSTEST_END_MARKER,
};

struct bst_test_list *test_main_bis_broadcaster_install(struct bst_test_list *tests)
{
	return bst_add_tests(tests, test_def);
}
```

## src/bis_receiver.c
```c
/*
 * Copyright (c) 2024-2025 Nordic Semiconductor
 *
 * SPDX-License-Identifier: Apache-2.0
 */

#include <stdint.h>
#include <string.h>

#include <zephyr/autoconf.h>
#include <zephyr/bluetooth/bluetooth.h>
#include <zephyr/bluetooth/buf.h>
#include <zephyr/bluetooth/gap.h>
#include <zephyr/bluetooth/hci_types.h>
#include <zephyr/bluetooth/iso.h>
#include <zephyr/drivers/bluetooth.h>
#include <zephyr/logging/log.h>
#include <zephyr/net_buf.h>
#include <zephyr/sys/byteorder.h>
#include <zephyr/sys/util.h>

#include "babblekit/flags.h"
#include "babblekit/sync.h"
#include "babblekit/testcase.h"

#include "common.h"
#include "iso_tx.h"

LOG_MODULE_REGISTER(bis_receiver, LOG_LEVEL_INF);

#define PA_SYNC_INTERVAL_TO_TIMEOUT_RATIO 5U /* Set the timeout relative to interval */
/* The broadcaster will send SDUs from 0 to CONFIG_BT_ISO_RX_MTU in the SDU data length. We want to
 * receive at least 2 of each size to ensure correctness
 */
#define RX_CNT_TO_PASS                    (CONFIG_BT_ISO_RX_MTU * 2)

extern enum bst_result_t bst_result;

DEFINE_FLAG_STATIC(flag_broadcaster_found);
DEFINE_FLAG_STATIC(flag_iso_connected);
DEFINE_FLAG_STATIC(flag_data_received);
DEFINE_FLAG_STATIC(flag_pa_synced);
DEFINE_FLAG_STATIC(flag_biginfo);

static struct bt_iso_chan iso_chans[CONFIG_BT_ISO_MAX_CHAN];
/* When set, the receiver does not set up an ISO data path, so the controller never sends data */
static bool skip_data_path;
static struct bt_le_scan_recv_info broadcaster_info;
static bt_addr_le_t broadcaster_addr;
static uint8_t broadcaster_num_bis;

/** Log data as d_0 d_1 d_2 ... d_(n-2) d_(n-1) d_(n) to show the 3 first and 3 last octets
 *
 * Examples:
 * 01
 * 0102
 * 010203
 * 01020304
 * 0102030405
 * 010203040506
 * 010203...050607
 * 010203...060708
 * etc.
 */
static void iso_log_data(uint8_t *data, size_t data_len)
{
	/* Maximum number of octets from each end of the data */
	const uint8_t max_octets = 3;
	char data_str[35];
	size_t str_len;

	str_len = bin2hex(data, MIN(max_octets, data_len), data_str, sizeof(data_str));
	if (data_len > max_octets) {
		if (data_len > (max_octets * 2)) {
			static const char dots[] = "...";

			strcat(&data_str[str_len], dots);
			str_len += strlen(dots);
		}

		str_len += bin2hex(data + (data_len - MIN(max_octets, data_len - max_octets)),
				   MIN(max_octets, data_len - max_octets), data_str + str_len,
				   sizeof(data_str) - str_len);
	}

	LOG_DBG("\t %s", data_str);
}

static void iso_recv(struct bt_iso_chan *chan, const struct bt_iso_recv_info *info,
		     struct net_buf *buf)
{
	if (IS_FLAG_SET(flag_data_received)) {
		return;
	}

	if (info->flags & BT_ISO_FLAGS_VALID) {
		static uint16_t last_buf_len;
		static uint32_t last_ts;
		static size_t pass_cnt;
		static size_t rx_cnt;

		rx_cnt++;
		LOG_DBG("[%zu]: Incoming data channel %p len %u", rx_cnt, chan, buf->len);
		iso_log_data(buf->data, buf->len);

		if (memcmp(buf->data, mock_iso_data, buf->len) != 0) {
			TEST_FAIL("Unexpected data received");
		} else if (last_buf_len != 0U && buf->len != 1U && buf->len != last_buf_len + 1) {
			TEST_FAIL("Unexpected data length (%u) received (expected 1 or %u)",
				  buf->len, last_buf_len + 1);
		} else if (last_ts != 0U && info->ts > last_ts + 2 * SDU_INTERVAL_US) {
			TEST_FAIL("Unexpected timestamp (%u) received (expected %u)", info->ts,
				  last_ts + SDU_INTERVAL_US);
		} else if (pass_cnt++ > RX_CNT_TO_PASS) {
			LOG_INF("Data received");
			SET_FLAG(flag_data_received);
		} else {
			/* no op */
		}

		last_buf_len = buf->len;
		last_ts = info->ts;
	}
}

static void iso_connected(struct bt_iso_chan *chan)
{
	const struct bt_iso_chan_path hci_path = {
		.pid = BT_ISO_DATA_PATH_HCI,
		.format = BT_HCI_CODING_FORMAT_TRANSPARENT,
	};
	struct bt_iso_info info;
	int err;

	LOG_INF("ISO Channel %p connected", chan);

	err = bt_iso_chan_get_info(chan, &info);
	TEST_ASSERT(err == 0, "Failed to get BIS info: %d", err);

	TEST_ASSERT(info.can_recv);
	TEST_ASSERT(!info.can_send);
	TEST_ASSERT(info.type == BT_ISO_CHAN_TYPE_SYNC_RECEIVER);
	TEST_ASSERT(IN_RANGE(info.iso_interval, BT_ISO_ISO_INTERVAL_MIN, BT_ISO_ISO_INTERVAL_MAX),
		    "Invalid ISO interval 0x%04x", info.iso_interval);
	TEST_ASSERT(IN_RANGE(info.max_subevent, BT_ISO_NSE_MIN, BT_ISO_NSE_MAX),
		    "Invalid subevent number 0x%02x", info.max_subevent);
	TEST_ASSERT(IN_RANGE(info.sync_receiver.latency, BT_HCI_LE_TRANSPORT_LATENCY_BIG_MIN,
			     BT_HCI_LE_TRANSPORT_LATENCY_BIG_MAX),
		    "Invalid transport latency 0x%06x", info.sync_receiver.latency);
	TEST_ASSERT((info.sync_receiver.pto % info.iso_interval) == 0U,
		    "PTO in ms %u shall be a multiple of the ISO interval %u",
		    info.sync_receiver.pto, info.iso_interval);
	TEST_ASSERT(IN_RANGE((info.sync_receiver.pto / info.iso_interval), BT_ISO_PTO_MIN,
			     BT_ISO_PTO_MAX),
		    "Invalid PTO 0x%x", (info.sync_receiver.pto / info.iso_interval));
	TEST_ASSERT(IN_RANGE(info.sync_receiver.bn, BT_ISO_BN_MIN, BT_ISO_BN_MAX),
		    "Invalid BN 0x%02x", info.sync_receiver.bn);
	TEST_ASSERT(IN_RANGE(info.sync_receiver.irc, BT_ISO_IRC_MIN, BT_ISO_IRC_MAX),
		    "Invalid IRC 0x%02x", info.sync_receiver.irc);
	TEST_ASSERT(info.sync_receiver.big_handle != 0xFF /* invalid BIG handle */,
		    "Invalid BIG handle 0x%02x", info.sync_receiver.big_handle);
	TEST_ASSERT(
		IN_RANGE(info.sync_receiver.bis_number, BT_ISO_BIS_INDEX_MIN, BT_ISO_BIS_INDEX_MAX),
		"Invalid BIS number 0x%02x", info.sync_receiver.bis_number);

	SET_FLAG(flag_iso_connected);

	if (skip_data_path) {
		return;
	}

	err = bt_iso_setup_data_path(chan, BT_HCI_DATAPATH_DIR_CTLR_TO_HOST, &hci_path);
	TEST_ASSERT(err == 0, "Failed to setup ISO RX data path: %d\n", err);
}

static void iso_disconnected(struct bt_iso_chan *chan, uint8_t reason)
{
	LOG_INF("ISO Channel %p disconnected (reason 0x%02x)", chan, reason);

	UNSET_FLAG(flag_iso_connected);
}

static void broadcast_scan_recv(const struct bt_le_scan_recv_info *info, struct net_buf_simple *ad)
{
	if (IS_FLAG_SET(flag_broadcaster_found)) {
		/* no-op*/
		return;
	}

	LOG_INF("Broadcaster found");

	if (info->interval != 0U) {
		memcpy(&broadcaster_info, info, sizeof(broadcaster_info));
		bt_addr_le_copy(&broadcaster_addr, info->addr);
		SET_FLAG(flag_broadcaster_found);
	}
}

static void pa_synced_cb(struct bt_le_per_adv_sync *sync,
			 struct bt_le_per_adv_sync_synced_info *info)
{
	LOG_INF("PA synced");

	SET_FLAG(flag_pa_synced);
}

static void pa_term_cb(struct bt_le_per_adv_sync *sync,
		       const struct bt_le_per_adv_sync_term_info *info)
{
	LOG_INF("PA terminated");

	UNSET_FLAG(flag_pa_synced);
}

static void pa_biginfo_cb(struct bt_le_per_adv_sync *sync, const struct bt_iso_biginfo *biginfo)
{
	if (IS_FLAG_SET(flag_biginfo)) {
		/* no-op*/
		return;
	}

	LOG_INF("BIGInfo received");

	broadcaster_num_bis = biginfo->num_bis;
	SET_FLAG(flag_biginfo);
}

static void init(void)
{
	static struct bt_le_per_adv_sync_cb pa_sync_cbs = {
		.biginfo = pa_biginfo_cb,
		.synced = pa_synced_cb,
		.term = pa_term_cb,
	};
	static struct bt_le_scan_cb bap_scan_cb = {
		.recv = broadcast_scan_recv,
	};
	static struct bt_iso_chan_io_qos iso_rx = {
		.sdu = CONFIG_BT_ISO_RX_MTU,
	};
	static struct bt_iso_chan_ops iso_ops = {
		.recv = iso_recv,
		.connected = iso_connected,
		.disconnected = iso_disconnected,
	};
	static struct bt_iso_chan_qos iso_qos = {
		.rx = &iso_rx,
	};
	int err;

	err = bt_enable(NULL);
	TEST_ASSERT(err == 0, "Bluetooth enable failed (err %d)", err);

	for (size_t i = 0U; i < ARRAY_SIZE(iso_chans); i++) {
		iso_chans[i].ops = &iso_ops;
		iso_chans[i].qos = &iso_qos;
	}

	bt_le_per_adv_sync_cb_register(&pa_sync_cbs);
	bt_le_scan_cb_register(&bap_scan_cb);

	bk_sync_init();
}

static uint16_t interval_to_sync_timeout(uint16_t pa_interval)
{
	uint32_t interval_us;
	uint32_t timeout;

	/* Add retries and convert to unit in 10's of ms */
	interval_us = BT_GAP_PER_ADV_INTERVAL_TO_US(pa_interval);
	timeout =
		BT_GAP_US_TO_PER_ADV_SYNC_TIMEOUT(interval_us) * PA_SYNC_INTERVAL_TO_TIMEOUT_RATIO;

	/* Enforce restraints */
	timeout = CLAMP(timeout, BT_GAP_PER_ADV_MIN_TIMEOUT, BT_GAP_PER_ADV_MAX_TIMEOUT);

	return timeout;
}

static void scan_and_sync_pa(struct bt_le_per_adv_sync **out_sync)
{
	struct bt_le_per_adv_sync_param create_params = {0};
	int err;

	LOG_INF("Starting scan");
	err = bt_le_scan_start(BT_LE_SCAN_ACTIVE, NULL);
	TEST_ASSERT(err == 0, "Failed to start scan: %d", err);

	WAIT_FOR_FLAG(flag_broadcaster_found);

	bt_addr_le_copy(&create_params.addr, &broadcaster_addr);
	create_params.options = BT_LE_PER_ADV_SYNC_OPT_FILTER_DUPLICATE;
	create_params.sid = broadcaster_info.sid;
	create_params.skip = 0U;
	create_params.timeout = interval_to_sync_timeout(broadcaster_info.interval);

	LOG_INF("Creating PA sync");
	err = bt_le_per_adv_sync_create(&create_params, out_sync);
	TEST_ASSERT(err == 0, "Failed to sync to PA: %d", err);

	WAIT_FOR_FLAG(flag_pa_synced);

	LOG_INF("Stopping scan");
	err = bt_le_scan_stop();
	TEST_ASSERT(err == 0, "Failed to stop scan: %d", err);
}

static void sync_big(struct bt_le_per_adv_sync *sync, uint8_t cnt, struct bt_iso_big **out_big)
{
	struct bt_iso_chan *bis_channels[CONFIG_BT_ISO_MAX_CHAN];
	struct bt_iso_big_sync_param param = {
		.sync_timeout = interval_to_sync_timeout(broadcaster_info.interval),
		.bis_bitfield = BIT_MASK(cnt),
		.bis_channels = bis_channels,
		.mse = BT_ISO_SYNC_MSE_MIN,
		.encryption = false,
		.num_bis = cnt,
	};
	int err;

	TEST_ASSERT(cnt <= ARRAY_SIZE(bis_channels));
	for (size_t i = 0U; i < cnt; i++) {
		bis_channels[i] = &iso_chans[i];
	}

	LOG_INF("Creating BIG sync");
	err = bt_iso_big_sync(sync, &param, out_big);
	TEST_ASSERT(err == 0, "Failed to create BIG sync: %d");

	WAIT_FOR_FLAG(flag_iso_connected);
}

static void test_main(void)
{
	struct bt_le_per_adv_sync *sync;
	struct bt_iso_big *big;

	init();
	scan_and_sync_pa(&sync);
	WAIT_FOR_FLAG(flag_biginfo);
	sync_big(sync, MIN(broadcaster_num_bis, CONFIG_BT_ISO_MAX_CHAN), &big);

	LOG_INF("Waiting for data");
	WAIT_FOR_FLAG(flag_data_received);
	bk_sync_send();

	LOG_INF("Waiting for sync lost");
	WAIT_FOR_FLAG_UNSET(flag_pa_synced);
	WAIT_FOR_FLAG_UNSET(flag_iso_connected);

	TEST_PASS("Test passed");
}

/* Count the free buffers in the ISO RX pool by draining it and putting everything back */
static size_t count_free_iso_rx_bufs(void)
{
	struct net_buf *bufs[CONFIG_BT_ISO_RX_BUF_COUNT];
	size_t cnt = 0U;

	while (cnt < ARRAY_SIZE(bufs)) {
		bufs[cnt] = bt_buf_get_rx(BT_BUF_ISO_IN, K_NO_WAIT);
		if (bufs[cnt] == NULL) {
			break;
		}
		cnt++;
	}

	for (size_t i = 0U; i < cnt; i++) {
		net_buf_unref(bufs[i]);
	}

	return cnt;
}

/* Inject the first fragment (PB_Flag = Start) of an SDU for the BIS, as if it came from the
 * controller. The SDU is announced as `sdu_len` octets, but only `frag_len` octets are delivered,
 * and the remaining fragments never arrive.
 */
static void inject_iso_start_fragment(const struct bt_iso_chan *chan, uint16_t sdu_len,
				      uint8_t frag_len)
{
	const struct device *hci = DEVICE_DT_GET(DT_CHOSEN(zephyr_bt_hci));
	struct bt_hci_iso_hdr hdr;
	struct bt_hci_iso_sdu_hdr sdu_hdr;
	struct net_buf *buf;
	uint16_t handle;
	int ret;

	buf = bt_buf_get_rx(BT_BUF_ISO_IN, K_NO_WAIT);
	TEST_ASSERT(buf != NULL, "Failed to get ISO RX buffer");

	ret = bt_hci_get_conn_handle(chan->iso, &handle);
	TEST_ASSERT(ret == 0, "Failed to get ISO channel handle");

	hdr.handle = sys_cpu_to_le16(bt_iso_handle_pack(handle, BT_ISO_START, 0));
	hdr.len = sys_cpu_to_le16(sizeof(sdu_hdr) + frag_len);
	sdu_hdr.sn = sys_cpu_to_le16(0U);
	sdu_hdr.slen = sys_cpu_to_le16(bt_iso_pkt_len_pack(sdu_len, BT_ISO_DATA_VALID));

	net_buf_add_mem(buf, &hdr, sizeof(hdr));
	net_buf_add_mem(buf, &sdu_hdr, sizeof(sdu_hdr));
	net_buf_add_mem(buf, mock_iso_data, frag_len);

	bt_hci_recv(hci, buf);
}

/* Reproducer: a BIG sync ends while a BIS has a Start fragment in reassembly (iso->rx != NULL).
 * cleanup_big() drops the last reference to the BIS conn without calling bt_conn_reset_rx_state(),
 * so the ISO RX buffer is never returned to the pool.
 */
static void test_main_rx_start_leak(void)
{
	struct bt_le_per_adv_sync *sync;
	struct bt_iso_big *big;
	size_t free_before;
	size_t free_after;

	/* No data path: nothing but the injected fragment will reach the host RX path */
	skip_data_path = true;

	init();
	scan_and_sync_pa(&sync);
	WAIT_FOR_FLAG(flag_biginfo);
	sync_big(sync, 1U, &big);

	free_before = count_free_iso_rx_bufs();
	LOG_INF("Free ISO RX buffers before injection: %zu", free_before);
	TEST_ASSERT(free_before == CONFIG_BT_ISO_RX_BUF_COUNT, "Pool not full: %zu BUF_COUNT=%zu",
			free_before, CONFIG_BT_ISO_RX_BUF_COUNT);

	/* 10 of 50 octets: the Start fragment is kept in iso->rx waiting for the rest */
	inject_iso_start_fragment(&iso_chans[0], 50U, 10U);

	/* Let the host RX thread process it */
	k_msleep(100);

	free_after = count_free_iso_rx_bufs();
	LOG_INF("Free ISO RX buffers with Start fragment in reassembly: %zu", free_after);
	TEST_ASSERT(free_after == free_before - 1U,
		    "Start fragment not held in reassembly (free %zu, expected %zu)", free_after,
		    free_before - 1U);

	/* Tell the broadcaster to terminate the BIG, and wait for the BIG sync to be lost */
	bk_sync_send();
	WAIT_FOR_FLAG_UNSET(flag_pa_synced);
	WAIT_FOR_FLAG_UNSET(flag_iso_connected);

	/* Give the host time to finish cleanup_big() and the RX thread to settle */
	k_msleep(100);

	free_after = count_free_iso_rx_bufs();
	LOG_INF("Free ISO RX buffers after BIG sync lost: %zu", free_after);
	TEST_ASSERT(free_after == free_before,
		    "ISO RX buffer leaked on BIG sync lost: %zu of %zu buffers free", free_after,
		    free_before);

	TEST_PASS("Test passed");
}

static const struct bst_test_instance test_def[] = {
	{
		.test_id = "receiver",
		.test_descr = "receiver",
		.test_main_f = test_main,
	},
	{
		.test_id = "receiver_rx_start_leak",
		.test_descr = "receiver that checks for ISO RX buffer leak on BIG sync lost",
		.test_main_f = test_main_rx_start_leak,
	},
	BSTEST_END_MARKER,
};

struct bst_test_list *test_main_bis_receiver_install(struct bst_test_list *tests)
{
	return bst_add_tests(tests, test_def);
}
```

## src/common.c
```c
/*
 * Copyright (c) 2024 Nordic Semiconductor ASA
 *
 * SPDX-License-Identifier: Apache-2.0
 */
#include <string.h>

#include <zephyr/bluetooth/conn.h>
#include <zephyr/bluetooth/addr.h>
#include <zephyr/sys/printk.h>
#include <zephyr/sys/util.h>

#include "babblekit/flags.h"
#include "babblekit/testcase.h"

#include "common.h"

extern enum bst_result_t bst_result;

void test_init(void)
{
	bst_result = In_progress;
	bst_ticker_set_next_tick_absolute(WAIT_TIME);
}

void test_tick(bs_time_t HW_device_time)
{
	if (bst_result != Passed) {
		TEST_FAIL("Test failed (not passed after %" PRIu64 " us)", WAIT_TIME);
	}
}
```

## src/common.h
```c
/*
 * Common functions and helpers for ISO broadcast tests
 *
 * Copyright (c) 2024 Nordic Semiconductor ASA
 *
 * SPDX-License-Identifier: Apache-2.0
 */

#include <stdint.h>

#include <zephyr/sys/clock.h>

#include "bs_types.h"

#define WAIT_TIME (120 * USEC_PER_SEC)

enum disable_states {
	DISABLE_STATE_BROADCASTER,
	DISABLE_STATE_SYNC_RECEIVER,
	DISABLE_STATE_BOTH,
	DISABLE_STATE_COUNT,
};

void test_init(void);
void test_tick(bs_time_t HW_device_time);

#define SDU_INTERVAL_US 10U * USEC_PER_MSEC /* 10 ms */
```
