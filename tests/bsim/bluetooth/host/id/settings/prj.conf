## CMakeLists.txt
```
# SPDX-License-Identifier: Apache-2.0

cmake_minimum_required(VERSION 3.28.0)

find_package(Zephyr HINTS $ENV{ZEPHYR_BASE})
project(bsim_test_id_settings)

add_subdirectory(${ZEPHYR_BASE}/tests/bsim/babblekit babblekit)
target_link_libraries(app PRIVATE babblekit)

target_sources(app PRIVATE
  src/main.c
  src/dut.c
)

zephyr_include_directories(
        $ENV{BSIM_COMPONENTS_PATH}/libUtilv1/src/
        $ENV{BSIM_COMPONENTS_PATH}/libPhyComv1/src/
)
```

## prj.conf
```kconfig
CONFIG_BT=y
CONFIG_BT_PERIPHERAL=y
CONFIG_BT_DEVICE_NAME="ID Settings Test"

CONFIG_LOG=y

CONFIG_BT_ID_MAX=2

CONFIG_FLASH=y
CONFIG_FLASH_MAP=y
CONFIG_NVS=y
CONFIG_SETTINGS=y
CONFIG_BT_SETTINGS=y

# Increased stack due to settings API usage
CONFIG_SYSTEM_WORKQUEUE_STACK_SIZE=2048
CONFIG_SYSTEM_WORKQUEUE_STACK_IGNORE_MIN=y
```

## src/main.c
```c
/* Copyright (c) 2023 Nordic Semiconductor ASA
 * SPDX-License-Identifier: Apache-2.0
 */

#include <zephyr/kernel.h>

#include <bstests.h>
#include <string.h>

#include <zephyr/logging/log.h>

LOG_MODULE_REGISTER(bt_bsim_id_settings, LOG_LEVEL_DBG);

extern void run_dut1(void);
extern void run_dut2(void);

static const struct bst_test_instance test_def[] = {
	{
		.test_id = "dut1",
		.test_descr = "DUT 1",
		.test_main_f = run_dut1,
	},
	{
		.test_id = "dut2",
		.test_descr = "DUT 2",
		.test_main_f = run_dut2,
	},
	BSTEST_END_MARKER};

struct bst_test_list *test_id_settings_install(struct bst_test_list *tests)
{
	return bst_add_tests(tests, test_def);
}

bst_test_install_t test_installers[] = {test_id_settings_install, NULL};

int main(void)
{
	bst_main();
	return 0;
}
```

## src/common.h
```c
/* Copyright (c) 2023 Nordic Semiconductor ASA
 * SPDX-License-Identifier: Apache-2.0
 */

#include "bs_tracing.h"
#include "bstests.h"

#define FAIL(...)                                                                                  \
	do {                                                                                       \
		bst_result = Failed;                                                               \
		bs_trace_error_time_line(__VA_ARGS__);                                             \
	} while (0)

#define PASS(...)                                                                                  \
	do {                                                                                       \
		bst_result = Passed;                                                               \
		bs_trace_info_time(1, __VA_ARGS__);                                                \
	} while (0)

extern enum bst_result_t bst_result;
```

## src/dut.c
```c
/* Copyright (c) 2023 Nordic Semiconductor ASA
 * SPDX-License-Identifier: Apache-2.0
 */

#include <zephyr/kernel.h>
#include <zephyr/irq.h>

#include <zephyr/logging/log.h>
#include <zephyr/settings/settings.h>

#include <zephyr/bluetooth/bluetooth.h>
#include <zephyr/bluetooth/addr.h>

#include "babblekit/testcase.h"

LOG_MODULE_DECLARE(bt_bsim_id_settings, LOG_LEVEL_DBG);

void run_dut1(void)
{
	int err;
	size_t bt_id_count;

	LOG_DBG("Starting DUT 1");

	err = bt_enable(NULL);
	if (err) {
		TEST_FAIL("Bluetooth init failed (err %d)", err);
	}

	LOG_DBG("Bluetooth initialised");

	err = settings_load();
	if (err) {
		TEST_FAIL("Failed to load settings (err %d)", err);
	}

	bt_id_get(NULL, &bt_id_count);
	LOG_DBG("Number of Bluetooth identities after settings load: %d", bt_id_count);

	err = bt_id_create(NULL, NULL);
	if (err < 0) {
		TEST_FAIL("Failed to create a new identity (err %d)", err);
	}

	bt_id_get(NULL, &bt_id_count);
	LOG_DBG("Number of Bluetooth identities after identity creation: %d", bt_id_count);

	/* Wait for the workqueue to complete before switching device */
	k_msleep(100);

	TEST_PASS("Test passed (DUT 1)");
}

void run_dut2(void)
{
	int err;
	size_t bt_id_count;
	size_t expected_id_count = 2;

	LOG_DBG("Starting DUT 2");

	err = bt_enable(NULL);
	if (err) {
		TEST_FAIL("Bluetooth init failed (err %d)", err);
	}

	LOG_DBG("Bluetooth initialised");

	err = settings_load();
	if (err) {
		TEST_FAIL("Failed to load settings (err %d)", err);
	}

	LOG_DBG("Settings loaded");

	bt_id_get(NULL, &bt_id_count);
	if (bt_id_count != expected_id_count) {
		TEST_FAIL("Wrong ID count (got %d; expected %d)", bt_id_count, expected_id_count);
	}

	TEST_PASS("Test passed (DUT 2)");
}
```
