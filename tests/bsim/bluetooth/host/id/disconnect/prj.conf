## CMakeLists.txt
```
# SPDX-FileCopyrightText: Copyright The Zephyr Project Contributors
# SPDX-License-Identifier: Apache-2.0

cmake_minimum_required(VERSION 3.28.0)

find_package(Zephyr REQUIRED HINTS $ENV{ZEPHYR_BASE})
project(bsim_test_id_disconnect)

add_subdirectory(${ZEPHYR_BASE}/tests/bluetooth/common/testlib testlib)
target_link_libraries(app PRIVATE testlib)

add_subdirectory(${ZEPHYR_BASE}/tests/bsim/babblekit babblekit)
target_link_libraries(app PRIVATE babblekit)

target_sources(app PRIVATE
  src/central.c
  src/dut.c
  src/kept_keys.c
  src/main.c
)

zephyr_include_directories(
  ${BSIM_COMPONENTS_PATH}/libUtilv1/src/
  ${BSIM_COMPONENTS_PATH}/libPhyComv1/src/
)
```

## prj.conf
```kconfig
CONFIG_BT=y
CONFIG_BT_DEVICE_NAME="id disconnect"
CONFIG_BT_PERIPHERAL=y
CONFIG_BT_CENTRAL=y
CONFIG_BT_EXT_ADV=y
CONFIG_BT_ID_MAX=2
CONFIG_BT_MAX_CONN=2
CONFIG_BT_SMP=y
```

## src/main.c
```c
/*
 * SPDX-FileCopyrightText: Copyright The Zephyr Project Contributors
 * SPDX-License-Identifier: Apache-2.0
 */

#include "babblekit/testcase.h"

void test_peripheral_main(void);
void test_central_main(void);
void test_kept_keys_not_bonded_dut_main(void);
void test_kept_keys_not_bonded_peer_main(void);
void test_kept_keys_unpaired_dut_main(void);
void test_kept_keys_unpaired_peer_main(void);

static const struct bst_test_instance test_def[] = {
	{
		.test_id = "peripheral",
		.test_descr = "Peripheral deleting and resetting the identity of a connection",
		.test_main_f = test_peripheral_main,
	},
	{
		.test_id = "central",
		.test_descr = "Central expecting to be disconnected by the peripheral",
		.test_main_f = test_central_main,
	},
	{
		.test_id = "kept_keys_not_bonded_dut",
		.test_descr = "A kept connection object after pairing without bonding",
		.test_main_f = test_kept_keys_not_bonded_dut_main,
	},
	{
		.test_id = "kept_keys_not_bonded_peer",
		.test_descr = "Pairs without bonding, then bonds with another identity",
		.test_main_f = test_kept_keys_not_bonded_peer_main,
	},
	{
		.test_id = "kept_keys_unpaired_dut",
		.test_descr = "A kept connection object after unpairing its peer",
		.test_main_f = test_kept_keys_unpaired_dut_main,
	},
	{
		.test_id = "kept_keys_unpaired_peer",
		.test_descr = "Bonds, reconnects, then bonds with another identity",
		.test_main_f = test_kept_keys_unpaired_peer_main,
	},
	BSTEST_END_MARKER,
};

struct bst_test_list *test_id_disconnect_install(struct bst_test_list *tests)
{
	return bst_add_tests(tests, test_def);
}

bst_test_install_t test_installers[] = {test_id_disconnect_install, NULL};

int main(void)
{
	bst_main();
	return 0;
}
```

## src/central.c
```c
/*
 * SPDX-FileCopyrightText: Copyright (c) 2026 Silicon Laboratories Inc.
 * SPDX-License-Identifier: Apache-2.0
 */

#include <stdint.h>

#include <testlib/conn.h>
#include <testlib/scan.h>
#include <zephyr/bluetooth/addr.h>
#include <zephyr/bluetooth/bluetooth.h>
#include <zephyr/bluetooth/conn.h>
#include <zephyr/sys/printk.h>

#include "babblekit/sync.h"
#include "babblekit/testcase.h"

#define ROUNDS 2U

static struct bt_conn *connect_to_peripheral(void)
{
	struct bt_conn *conn = NULL;
	bt_addr_le_t peer;
	int err;

	err = bt_testlib_scan_find_name(&peer, CONFIG_BT_DEVICE_NAME);
	TEST_ASSERT(err == 0, "Scanning failed (err %d)", err);

	err = bt_testlib_connect(&peer, &conn);
	TEST_ASSERT(err == 0, "Connecting failed (err %d)", err);

	return conn;
}

void test_central_main(void)
{
	struct bt_conn *other_conn;
	struct bt_conn_info info;
	int err;

	err = bt_enable(NULL);
	TEST_ASSERT(err == 0, "Bluetooth init failed (err %d)", err);

	err = bk_sync_init();
	TEST_ASSERT(err == 0, "Backchannel init failed (err %d)", err);

	/* The peripheral first advertises with its default identity. That connection has to
	 * stay up while the identities of the following rounds are deleted and reset.
	 */
	other_conn = connect_to_peripheral();

	for (uint32_t round = 0U; round < ROUNDS; round++) {
		struct bt_conn *conn = connect_to_peripheral();

		bt_testlib_wait_disconnected(conn);
		bt_conn_drop(&conn);
		printk("Round %u disconnected\n", round);

		err = bt_conn_get_info(other_conn, &info);
		TEST_ASSERT(err == 0, "bt_conn_get_info failed (err %d)", err);
		TEST_ASSERT(info.state == BT_CONN_STATE_CONNECTED,
			    "The connection to the other identity went down (state %d)",
			    info.state);
	}

	/* Let the peripheral observe its own disconnection before ending the simulation */
	bk_sync_wait();
	TEST_PASS_AND_EXIT("Central done");
}
```

## src/dut.c
```c
/*
 * SPDX-FileCopyrightText: Copyright (c) 2026 Silicon Laboratories Inc.
 * SPDX-License-Identifier: Apache-2.0
 */

#include <stdint.h>

#include <testlib/adv.h>
#include <testlib/conn.h>
#include <zephyr/bluetooth/bluetooth.h>
#include <zephyr/bluetooth/conn.h>
#include <zephyr/sys/printk.h>

#include "babblekit/sync.h"
#include "babblekit/testcase.h"

static struct bt_conn *connect_with_id(uint8_t id)
{
	struct bt_conn *conn = NULL;
	struct bt_conn_info info;
	int err;

	err = bt_testlib_adv_conn(&conn, id, bt_get_name());
	TEST_ASSERT(err == 0, "Advertising with identity %u failed (err %d)", id, err);
	printk("Connected with identity %u\n", id);

	err = bt_conn_get_info(conn, &info);
	TEST_ASSERT(err == 0, "bt_conn_get_info failed (err %d)", err);
	TEST_ASSERT(info.id == id, "Connection uses identity %u, expected %u", info.id, id);

	return conn;
}

static void expect_disconnect(struct bt_conn **conn, struct bt_conn *other_conn, const char *what)
{
	struct bt_conn_info info;
	int err;

	bt_testlib_wait_disconnected(*conn);
	bt_conn_drop(conn);
	printk("Disconnected after %s\n", what);

	/* A connection of another identity is left alone */
	err = bt_conn_get_info(other_conn, &info);
	TEST_ASSERT(err == 0, "bt_conn_get_info failed (err %d)", err);
	TEST_ASSERT(info.state == BT_CONN_STATE_CONNECTED,
		    "%s changed the connection of the other identity (state %d)", what, info.state);
}

void test_peripheral_main(void)
{
	struct bt_conn *other_conn;
	struct bt_conn *conn;
	int id;
	int err;

	err = bt_enable(NULL);
	TEST_ASSERT(err == 0, "Bluetooth init failed (err %d)", err);

	err = bk_sync_init();
	TEST_ASSERT(err == 0, "Backchannel init failed (err %d)", err);

	/* A connection of the default identity, which has to stay up throughout */
	other_conn = connect_with_id(BT_ID_DEFAULT);

	/* Deleting the identity of an unbonded connection disconnects it */
	id = bt_id_create(NULL, NULL);
	TEST_ASSERT(id > BT_ID_DEFAULT, "Identity creation failed (err %d)", id);

	conn = connect_with_id((uint8_t)id);

	err = bt_id_delete((uint8_t)id);
	TEST_ASSERT(err == 0, "bt_id_delete failed (err %d)", err);
	expect_disconnect(&conn, other_conn, "bt_id_delete");

	/* Resetting the identity of an unbonded connection disconnects it */
	id = bt_id_create(NULL, NULL);
	TEST_ASSERT(id > BT_ID_DEFAULT, "Identity creation failed (err %d)", id);

	conn = connect_with_id((uint8_t)id);

	err = bt_id_reset((uint8_t)id, NULL, NULL);
	TEST_ASSERT(err == id, "bt_id_reset returned %d, expected %d", err, id);
	expect_disconnect(&conn, other_conn, "bt_id_reset");

	/* The central ends the simulation once it has been told the peripheral is done */
	bk_sync_send();
	TEST_PASS("Peripheral done");
}
```

## src/kept_keys.c
```c
/*
 * SPDX-FileCopyrightText: Copyright (c) 2026 Silicon Laboratories Inc.
 * SPDX-License-Identifier: Apache-2.0
 */

#include <stdint.h>

#include <testlib/adv.h>
#include <testlib/conn.h>
#include <testlib/scan.h>
#include <testlib/security.h>
#include <zephyr/bluetooth/addr.h>
#include <zephyr/bluetooth/bluetooth.h>
#include <zephyr/bluetooth/conn.h>
#include <zephyr/bluetooth/hci_types.h>

#include "babblekit/sync.h"
#include "babblekit/testcase.h"

#define DUT_NAME   "kept keys dut"
#define OTHER_NAME "kept keys other"

static void test_setup(void)
{
	int err;

	err = bk_sync_init();
	TEST_ASSERT(err == 0, "Failed to open the backchannel (err %d)", err);

	err = bt_enable(NULL);
	TEST_ASSERT(err == 0, "bt_enable failed (err %d)", err);
}

/* The only key slot, given up by the first peer, now holds the keys of another one */
static void dut_bond_other_peer_and_unpair_first(const bt_addr_le_t *first)
{
	struct bt_conn *conn = NULL;
	bt_addr_le_t other;
	int err;

	bt_testlib_conn_wait_free();

	/* The peer advertises with its other identity */
	bk_sync_send();

	err = bt_testlib_scan_find_name(&other, OTHER_NAME);
	TEST_ASSERT(err == 0, "The other peer was not found (err %d)", err);

	err = bt_testlib_connect(&other, &conn);
	TEST_ASSERT(err == 0, "Connecting failed (err %d)", err);

	err = bt_testlib_secure(conn, BT_SECURITY_L2);
	TEST_ASSERT(err == 0, "Pairing failed (err %d)", err);
	TEST_ASSERT(bt_le_bond_exists(BT_ID_DEFAULT, &other), "The other peer is not bonded");

	err = bt_testlib_disconnect(&conn, BT_HCI_ERR_REMOTE_USER_TERM_CONN);
	TEST_ASSERT(err == 0, "Disconnecting failed (err %d)", err);

	err = bt_unpair(BT_ID_DEFAULT, first);
	TEST_ASSERT(err == 0, "bt_unpair failed (err %d)", err);

	TEST_ASSERT(bt_le_bond_exists(BT_ID_DEFAULT, &other),
		    "bt_unpair removed another peer's bond");
}

static void dut_first_connection(struct bt_conn **kept, bt_addr_le_t *first)
{
	int err;

	err = bt_testlib_adv_conn(kept, BT_ID_DEFAULT, DUT_NAME);
	TEST_ASSERT(err == 0, "Advertising failed (err %d)", err);

	bt_addr_le_copy(first, bt_conn_get_dst(*kept));

	err = bt_testlib_wait_disconnected(*kept);
	TEST_ASSERT(err == 0, "Waiting for the disconnection failed (err %d)", err);
}

/* The keys of a peer that did not bond go with the disconnection, not with the kept object */
void test_kept_keys_not_bonded_dut_main(void)
{
	struct bt_conn *kept = NULL;
	bt_addr_le_t first;

	TEST_START("kept_keys_not_bonded_dut");

	test_setup();

	bt_set_bondable(false);
	dut_first_connection(&kept, &first);
	bt_set_bondable(true);

	dut_bond_other_peer_and_unpair_first(&first);

	bt_conn_drop(&kept);

	/* The peer ends the simulation once it has been told the DUT is done */
	TEST_PASS("kept_keys_not_bonded_dut");

	bk_sync_send();
}

/* Unpairing clears the keys that the kept object and a newer connection both refer to */
void test_kept_keys_unpaired_dut_main(void)
{
	struct bt_conn *kept = NULL;
	struct bt_conn *live = NULL;
	bt_addr_le_t first;
	int err;

	TEST_START("kept_keys_unpaired_dut");

	test_setup();

	dut_first_connection(&kept, &first);

	err = bt_testlib_adv_conn(&live, BT_ID_DEFAULT, DUT_NAME);
	TEST_ASSERT(err == 0, "Advertising failed (err %d)", err);

	/* The peer has encrypted the connection */
	bk_sync_wait();

	err = bt_unpair(BT_ID_DEFAULT, &first);
	TEST_ASSERT(err == 0, "bt_unpair failed (err %d)", err);

	err = bt_testlib_wait_disconnected(live);
	TEST_ASSERT(err == 0, "Waiting for the disconnection failed (err %d)", err);

	bt_conn_drop(&live);

	/* The peer has given up its only key slot too */
	bk_sync_wait();

	dut_bond_other_peer_and_unpair_first(&first);

	bt_conn_drop(&kept);

	/* The peer ends the simulation once it has been told the DUT is done */
	TEST_PASS("kept_keys_unpaired_dut");

	bk_sync_send();
}

static void peer_connect_and_secure(struct bt_conn **conn, bt_addr_le_t *dut)
{
	int err;

	err = bt_testlib_scan_find_name(dut, DUT_NAME);
	TEST_ASSERT(err == 0, "The DUT was not found (err %d)", err);

	err = bt_testlib_connect(dut, conn);
	TEST_ASSERT(err == 0, "Connecting failed (err %d)", err);

	err = bt_testlib_secure(*conn, BT_SECURITY_L2);
	TEST_ASSERT(err == 0, "Securing the connection failed (err %d)", err);
}

static void peer_disconnect(struct bt_conn **conn)
{
	int err;

	err = bt_testlib_disconnect(conn, BT_HCI_ERR_REMOTE_USER_TERM_CONN);
	TEST_ASSERT(err == 0, "Disconnecting failed (err %d)", err);
}

static void peer_be_other_peer(void)
{
	struct bt_conn *conn = NULL;
	int err;
	int id;

	/* The DUT is ready to connect */
	bk_sync_wait();

	id = bt_id_create(NULL, NULL);
	TEST_ASSERT(id > BT_ID_DEFAULT, "Creating an identity failed (err %d)", id);

	err = bt_testlib_adv_conn(&conn, id, OTHER_NAME);
	TEST_ASSERT(err == 0, "Advertising failed (err %d)", err);

	err = bt_testlib_wait_disconnected(conn);
	TEST_ASSERT(err == 0, "Waiting for the disconnection failed (err %d)", err);

	bt_conn_drop(&conn);

	/* The DUT has checked the result */
	bk_sync_wait();
}

void test_kept_keys_not_bonded_peer_main(void)
{
	struct bt_conn *conn = NULL;
	bt_addr_le_t dut;

	TEST_START("kept_keys_not_bonded_peer");

	test_setup();

	peer_connect_and_secure(&conn, &dut);
	peer_disconnect(&conn);

	peer_be_other_peer();

	TEST_PASS_AND_EXIT("kept_keys_not_bonded_peer");
}

void test_kept_keys_unpaired_peer_main(void)
{
	struct bt_conn *conn = NULL;
	bt_addr_le_t dut;
	int err;

	TEST_START("kept_keys_unpaired_peer");

	test_setup();

	peer_connect_and_secure(&conn, &dut);
	peer_disconnect(&conn);

	peer_connect_and_secure(&conn, &dut);
	bk_sync_send();

	err = bt_testlib_wait_disconnected(conn);
	TEST_ASSERT(err == 0, "Waiting for the disconnection failed (err %d)", err);

	bt_conn_drop(&conn);

	err = bt_unpair(BT_ID_DEFAULT, &dut);
	TEST_ASSERT(err == 0, "bt_unpair failed (err %d)", err);

	bk_sync_send();

	peer_be_other_peer();

	TEST_PASS_AND_EXIT("kept_keys_unpaired_peer");
}
```
