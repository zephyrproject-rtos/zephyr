## CMakeLists.txt
```
# SPDX-License-Identifier: Apache-2.0

cmake_minimum_required(VERSION 3.20.0)

find_package(Zephyr REQUIRED HINTS $ENV{ZEPHYR_BASE})
project(bsim_test_multirole_gatt_relay)

target_sources(app PRIVATE
  src/main.c
  ${ZEPHYR_BASE}/samples/bluetooth/peripheral_gatt_notify/src/peripheral_gatt_notify.c
  ${ZEPHYR_BASE}/samples/bluetooth/central_notify_receive/src/central_notify_receive.c
  ${ZEPHYR_BASE}/samples/bluetooth/central_peripheral_notify_send_receive/src/central_peripheral_notify.c
)

zephyr_include_directories(
  ${BSIM_COMPONENTS_PATH}/libUtilv1/src/
  ${BSIM_COMPONENTS_PATH}/libPhyComv1/src/
)
```

## Kconfig
```
# Copyright (c) 2025 Nordic Semiconductor ASA
# SPDX-License-Identifier: Apache-2.0

source "Kconfig.zephyr"
```

## prj.conf
```kconfig
CONFIG_BT=y
CONFIG_BT_CENTRAL=y
CONFIG_BT_PERIPHERAL=y
CONFIG_BT_GATT_CLIENT=y
CONFIG_BT_DEVICE_NAME="Zephyr Multirole Notify"
CONFIG_BT_MAX_CONN=2

# Maximum L2CAP size for one LL PDU size
CONFIG_BT_L2CAP_TX_MTU=247

# Auto initiated Data Length update on connection established
CONFIG_BT_AUTO_DATA_LEN_UPDATE=y
# Enable user initiated Data Length update support
CONFIG_BT_USER_DATA_LEN_UPDATE=y

# BT HCI Command Buffers
CONFIG_BT_BUF_CMD_TX_COUNT=4
CONFIG_BT_BUF_CMD_TX_SIZE=255

# BT HCI Event Buffers
CONFIG_BT_BUF_EVT_RX_COUNT=7
CONFIG_BT_BUF_EVT_RX_SIZE=255

# BT HCI Discardable Event Buffers
CONFIG_BT_BUF_EVT_DISCARDABLE_COUNT=3
CONFIG_BT_BUF_EVT_DISCARDABLE_SIZE=255

# BT HCI ACL TX Data Buffers
CONFIG_BT_BUF_ACL_TX_COUNT=6
CONFIG_BT_BUF_ACL_TX_SIZE=251

# BT HCI ACL RX Data Buffers
CONFIG_BT_BUF_ACL_RX_COUNT_EXTRA=1
CONFIG_BT_BUF_ACL_RX_SIZE=255

# Maximum LL ACL PDU length
CONFIG_BT_CTLR_DATA_LENGTH_MAX=251

CONFIG_CLOCK_CONTROL_NRF_K32SRC_100PPM=y

CONFIG_LOG=y
```

## src/main.c
```c
/*
 * Copyright (c) 2025 Nordic Semiconductor ASA
 *
 * SPDX-License-Identifier: Apache-2.0
 */

#include <stddef.h>

#include <zephyr/kernel.h>

#include <zephyr/sys/printk.h>
#include <zephyr/sys/util.h>

#include "bs_types.h"
#include "bs_tracing.h"
#include "time_machine.h"
#include "bstests.h"

/*
 * Test topology:
 *   Device 0: Central (central_notify_receive) - receives notifications from Device 1
 *   Device 1: Multirole (central_peripheral_notify) - peripheral to Dev 0, central to Dev 2
 *   Device 2: Peripheral (peripheral_gatt_notify) - sends notifications to Device 1
 *
 * Notification flow: Device 2 -> Device 1 -> Device 0
 */

/* Number of notifications to receive/send before declaring the test passed.
 * This needs to be large enough to ensure notifications flow for at least
 * one metrics interval (1 second) on each link.
 */
#define COUNT_PERIPHERAL  5000U
#define COUNT_MULTIROLE   5000U
#define COUNT_CENTRAL     5000U

extern uint32_t peripheral_gatt_notify(uint32_t count);
extern uint32_t central_peripheral_notify(uint32_t count);
extern uint32_t central_notify_receive(uint32_t count);

#define FAIL(...)					\
	do {						\
		bst_result = Failed;			\
		bs_trace_error_time_line(__VA_ARGS__);	\
	} while (0)

#define PASS(...)					\
	do {						\
		bst_result = Passed;			\
		bs_trace_info_time(1, __VA_ARGS__);	\
	} while (0)

extern enum bst_result_t bst_result;

static void test_central_main(void)
{
	uint32_t rate;

	rate = central_notify_receive(COUNT_CENTRAL);

	printk("%s: Notify RX Rate = %u bps\n", __func__, rate);
	if (rate > 0U) {
		PASS("Central tests passed\n");
	} else {
		FAIL("Central tests failed\n");
	}

	/* Give extra time for other devices to finish */
	k_sleep(K_SECONDS(1));

	bs_trace_silent_exit(0);
}

static void test_multirole_main(void)
{
	uint32_t rate;

	rate = central_peripheral_notify(COUNT_MULTIROLE);

	printk("%s: Notify TX Rate = %u bps\n", __func__, rate);
	if (rate > 0U) {
		PASS("Multirole tests passed\n");
	} else {
		FAIL("Multirole tests failed\n");
	}

	/* Give extra time for other devices to finish */
	k_sleep(K_SECONDS(1));

	bs_trace_silent_exit(0);
}

static void test_peripheral_main(void)
{
	uint32_t rate;

	rate = peripheral_gatt_notify(COUNT_PERIPHERAL);

	printk("%s: Notify TX Rate = %u bps\n", __func__, rate);
	if (rate > 0U) {
		PASS("Peripheral tests passed\n");
	} else {
		FAIL("Peripheral tests failed\n");
	}
}

static void test_init(void)
{
	bst_ticker_set_next_tick_absolute(600e6);
	bst_result = In_progress;
}

static void test_tick(bs_time_t HW_device_time)
{
	bst_result = Failed;
	bs_trace_error_line("Test multirole GATT relay timed out.\n");
}

static const struct bst_test_instance test_def[] = {
	{
		.test_id = "central",
		.test_descr = "Central Notify Receive",
		.test_pre_init_f = test_init,
		.test_tick_f = test_tick,
		.test_main_f = test_central_main,
	},
	{
		.test_id = "multirole",
		.test_descr = "Multirole Notify Send Receive",
		.test_pre_init_f = test_init,
		.test_tick_f = test_tick,
		.test_main_f = test_multirole_main,
	},
	{
		.test_id = "peripheral",
		.test_descr = "Peripheral GATT Notify",
		.test_pre_init_f = test_init,
		.test_tick_f = test_tick,
		.test_main_f = test_peripheral_main,
	},
	BSTEST_END_MARKER
};

struct bst_test_list *test_multirole_gatt_relay_install(struct bst_test_list *tests)
{
	return bst_add_tests(tests, test_def);
}

bst_test_install_t test_installers[] = {
	test_multirole_gatt_relay_install,
	NULL
};

int main(void)
{
	bst_main();
	return 0;
}
```
