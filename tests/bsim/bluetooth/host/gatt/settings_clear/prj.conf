## CMakeLists.txt
```
# SPDX-License-Identifier: Apache-2.0

cmake_minimum_required(VERSION 3.28.0)

find_package(Zephyr REQUIRED HINTS $ENV{ZEPHYR_BASE})

project(settings_clear)

add_subdirectory(${ZEPHYR_BASE}/tests/bluetooth/common/testlib testlib)
target_link_libraries(app PRIVATE testlib)

add_subdirectory(${ZEPHYR_BASE}/tests/bsim/babblekit babblekit)
target_link_libraries(app PRIVATE babblekit)

zephyr_include_directories(
  ${BSIM_COMPONENTS_PATH}/libUtilv1/src/
  ${BSIM_COMPONENTS_PATH}/libPhyComv1/src/
)

target_sources(app PRIVATE
  src/main.c
  src/bt_settings_hook.c
  src/server.c
  src/client.c
)
```

## prj.conf
```kconfig
CONFIG_BT_TESTING=y

CONFIG_BT=y
CONFIG_BT_CENTRAL=y
CONFIG_BT_PERIPHERAL=y
CONFIG_BT_DEVICE_NAME="GATT settings clear"

# Dependency of testlib/adv and testlib/scan.
CONFIG_BT_EXT_ADV=y

CONFIG_BT_AUTO_PHY_CENTRAL_NONE=y
CONFIG_BT_AUTO_DATA_LEN_UPDATE=n
CONFIG_BT_GAP_AUTO_UPDATE_CONN_PARAMS=n

CONFIG_BT_GATT_AUTO_DISCOVER_CCC=y
CONFIG_BT_GATT_AUTO_RESUBSCRIBE=n

CONFIG_BT_PRIVACY=n

CONFIG_BT_SMP=y
CONFIG_BT_GATT_CLIENT=y
CONFIG_BT_GATT_DYNAMIC_DB=y
CONFIG_BT_GATT_CACHING=y

CONFIG_SETTINGS=y
CONFIG_BT_SETTINGS=y
CONFIG_FLASH=y
CONFIG_NVS=y
CONFIG_FLASH_MAP=y
CONFIG_SETTINGS_NVS=y

CONFIG_LOG=y
CONFIG_ASSERT=y

CONFIG_THREAD_NAME=y
CONFIG_LOG_THREAD_ID_PREFIX=y

CONFIG_ARCH_POSIX_TRAP_ON_FATAL=y

CONFIG_HEAP_MEM_POOL_SIZE=2048
```

## src/main.c
```c
/*
 * Copyright (c) 2024 Nordic Semiconductor ASA
 *
 * SPDX-License-Identifier: Apache-2.0
 */

#include <zephyr/kernel.h>

#include <bs_tracing.h>
#include <bstests.h>
#include <babblekit/testcase.h>
#include <testlib/log_utils.h>

extern void server_procedure(void);
extern void client_procedure(void);
extern enum bst_result_t bst_result;

static void test_end_cb(void)
{
	if (bst_result != Passed) {
		TEST_PRINT("Test has not passed.");
	}
}

static const struct bst_test_instance entrypoints[] = {
	{
		.test_id = "server",
		.test_delete_f = test_end_cb,
		.test_main_f = server_procedure,
	},
	{
		.test_id = "client",
		.test_delete_f = test_end_cb,
		.test_main_f = client_procedure,
	},
	BSTEST_END_MARKER,
};

static struct bst_test_list *install(struct bst_test_list *tests)
{
	return bst_add_tests(tests, entrypoints);
};

bst_test_install_t test_installers[] = {install, NULL};

int main(void)
{
	bst_main();

	return 0;
}
```

## src/bt_settings_hook.c
```c
/*
 * Copyright (c) 2024 Nordic Semiconductor ASA
 *
 * SPDX-License-Identifier: Apache-2.0
 */

#include <stddef.h>
#include <string.h>

#include <zephyr/kernel.h>

#include <zephyr/logging/log.h>

#include "babblekit/testcase.h"

LOG_MODULE_REGISTER(bt_settings_hook, LOG_LEVEL_DBG);

struct settings_list_node {
	sys_snode_t node;
	char *key;
};

static K_MUTEX_DEFINE(settings_list_mutex);
static atomic_t settings_record_enabled = ATOMIC_INIT(0);

static sys_slist_t settings_list = SYS_SLIST_STATIC_INIT(settings_list);

static bool hash_stored;

bool bt_settings_hash_stored(void)
{
	return hash_stored;
}

static void add_key(const char *key)
{
	struct settings_list_node *new_node;
	size_t key_size = strlen(key);
	bool key_already_in = false;

	struct settings_list_node *loop_node;

	if (settings_record_enabled == 1) {
		k_mutex_lock(&settings_list_mutex, K_FOREVER);

		SYS_SLIST_FOR_EACH_CONTAINER(&settings_list, loop_node, node) {
			if (strcmp(loop_node->key, key) == 0) {
				key_already_in = true;
			}
		}

		if (!key_already_in) {
			new_node = k_malloc(sizeof(struct settings_list_node));
			TEST_ASSERT(new_node != NULL, "Failed to malloc new_node");

			new_node->key = k_malloc(sizeof(char) * key_size);
			TEST_ASSERT(new_node->key != NULL, "Failed to malloc new_node->key");

			memcpy(new_node->key, key, sizeof(char) * key_size);

			sys_slist_append(&settings_list, &new_node->node);
		}

		k_mutex_unlock(&settings_list_mutex);
	}
}

static void remove_key(const char *key)
{
	struct settings_list_node *loop_node, *prev_loop_node;

	prev_loop_node = NULL;

	if (settings_record_enabled == 1) {
		k_mutex_lock(&settings_list_mutex, K_FOREVER);

		SYS_SLIST_FOR_EACH_CONTAINER(&settings_list, loop_node, node) {
			if (strcmp(loop_node->key, key) == 0) {
				break;
			}

			prev_loop_node = loop_node;
		}

		if (loop_node != NULL) {
			sys_slist_remove(&settings_list, &prev_loop_node->node, &loop_node->node);

			k_free(loop_node->key);
			k_free(loop_node);
		}

		k_mutex_unlock(&settings_list_mutex);
	}
}

void start_settings_record(void)
{
	atomic_set(&settings_record_enabled, 1);
}

void stop_settings_record(void)
{
	atomic_set(&settings_record_enabled, 0);
}

void settings_list_cleanup(void)
{
	struct settings_list_node *loop_node, *next_loop_node, *prev_loop_node;

	prev_loop_node =  NULL;

	k_mutex_lock(&settings_list_mutex, K_FOREVER);

	SYS_SLIST_FOR_EACH_CONTAINER_SAFE(&settings_list, loop_node, next_loop_node, node) {
		sys_slist_remove(&settings_list, &prev_loop_node->node, &loop_node->node);

		k_free(loop_node->key);
		k_free(loop_node);
	}

	k_mutex_unlock(&settings_list_mutex);
}

int get_settings_list_size(void)
{
	struct settings_list_node *loop_node;
	int number_of_settings = 0;

	SYS_SLIST_FOR_EACH_CONTAINER(&settings_list, loop_node, node) {
		LOG_ERR("Setting registered: %s", loop_node->key);
		number_of_settings += 1;
	}

	return number_of_settings;
}

void bt_testing_settings_store_hook(const char *key, const void *value, size_t val_len)
{
	LOG_DBG("Store: %s", key);
	LOG_HEXDUMP_DBG(value, val_len, "Data:");

	/* Writing to flash takes more stack than an application has to reserve
	 * for the thread that loads its settings.
	 */
	TEST_ASSERT(strcmp(k_thread_name_get(k_current_get()), "main") != 0,
		    "Stored %s on the main thread", key);

	/* The database hash does not belong to a bond, and is stored in the
	 * background after settings_load() has returned.
	 */
	if (strcmp(key, "bt/hash") == 0) {
		hash_stored = true;
		return;
	}

	add_key(key);
}

void bt_testing_settings_delete_hook(const char *key)
{
	LOG_DBG("Delete: %s", key);

	remove_key(key);
}
```

## src/bt_settings_hook.h
```c
/*
 * Copyright (c) 2024 Nordic Semiconductor ASA
 *
 * SPDX-License-Identifier: Apache-2.0
 */

#ifndef ZEPHYR_TESTS_BSIM_BLUETOOTH_HOST_GATT_SETTINGS_CLEAR_SRC_BT_SETTINGS_HOOK_H_
#define ZEPHYR_TESTS_BSIM_BLUETOOTH_HOST_GATT_SETTINGS_CLEAR_SRC_BT_SETTINGS_HOOK_H_

#include <stdbool.h>

void start_settings_record(void);
void stop_settings_record(void);
void settings_list_cleanup(void);
int get_settings_list_size(void);
bool bt_settings_hash_stored(void);

#endif /* ZEPHYR_TESTS_BSIM_BLUETOOTH_HOST_GATT_SETTINGS_CLEAR_SRC_BT_SETTINGS_HOOK_H_ */
```

## src/client.c
```c
/*
 * Copyright (c) 2024 Nordic Semiconductor ASA
 *
 * SPDX-License-Identifier: Apache-2.0
 */

#include <zephyr/kernel.h>

#include <zephyr/bluetooth/bluetooth.h>
#include <zephyr/bluetooth/conn.h>
#include <zephyr/bluetooth/att.h>
#include <zephyr/bluetooth/gatt.h>

#include <zephyr/settings/settings.h>

#include <zephyr/logging/log.h>

#include <testlib/adv.h>
#include <testlib/att_read.h>
#include <testlib/conn.h>

#include <babblekit/flags.h>
#include <babblekit/sync.h>
#include <babblekit/testcase.h>

#include "common.h"

LOG_MODULE_REGISTER(client, LOG_LEVEL_DBG);

DEFINE_FLAG_STATIC(client_security_changed_flag);
DEFINE_FLAG_STATIC(client_is_subscribed_flag);

/* Subscription parameters have the same lifetime as a subscription.
 * That is the backing struct should stay valid until a call to
 * `bt_gatt_unsubscribe()` is made. Hence the `static`.
 */
static struct bt_gatt_subscribe_params sub_params;

/* This is "working memory" used by the `CONFIG_BT_GATT_AUTO_DISCOVER_CCC`
 * feature. It also has to stay valid until the end of the async call.
 */
static struct bt_gatt_discover_params ccc_disc_params;

static struct bt_conn_cb client_conn_cb;

static void security_changed(struct bt_conn *conn, bt_security_t level, enum bt_security_err err)
{
	TEST_ASSERT(err == 0, "Security update failed: %s level %u err %d", bt_conn_dst_str(conn),
		    level, err);

	LOG_DBG("Security changed: %s level %u", bt_conn_dst_str(conn), level);
	SET_FLAG(client_security_changed_flag);
}

void find_characteristic(struct bt_conn *conn,
			const struct bt_uuid *svc,
			const struct bt_uuid *chrc,
			uint16_t *chrc_value_handle)
{
	int err;
	uint16_t svc_handle;
	uint16_t svc_end_handle;
	uint16_t chrc_end_handle;

	err = bt_testlib_gatt_discover_primary(&svc_handle, &svc_end_handle, conn, svc,
					       BT_ATT_FIRST_ATTRIBUTE_HANDLE,
					       BT_ATT_LAST_ATTRIBUTE_HANDLE);
	TEST_ASSERT(err == 0, "Failed to discover service: %d", err);

	LOG_DBG("svc_handle: %u, svc_end_handle: %u", svc_handle, svc_end_handle);

	err = bt_testlib_gatt_discover_characteristic(chrc_value_handle, &chrc_end_handle,
						      NULL, conn, chrc, (svc_handle + 1),
						      svc_end_handle);
	TEST_ASSERT(err == 0, "Failed to get value handle: %d", err);

	LOG_DBG("chrc_value_handle: %u, chrc_end_handle: %u", *chrc_value_handle, chrc_end_handle);
}

static uint8_t received_notification(struct bt_conn *conn,
				     struct bt_gatt_subscribe_params *params,
				     const void *data,
				     uint16_t length)
{
	if (length) {
		LOG_INF("RX notification");
		LOG_HEXDUMP_DBG(data, length, "payload");
	}

	return BT_GATT_ITER_CONTINUE;
}

static void sub_cb(struct bt_conn *conn,
		   uint8_t err,
		   struct bt_gatt_subscribe_params *params)
{
	TEST_ASSERT(!err, "Subscribe failed (err %d)", err);

	TEST_ASSERT(params, "params is NULL");
	TEST_ASSERT(params->value, "Host shouldn't know we have unsubscribed");

	LOG_DBG("Subscribed to handle 0x%04x", params->value_handle);
	SET_FLAG(client_is_subscribed_flag);
}



static void subscribe(struct bt_conn *conn,
		      uint16_t handle,
		      bt_gatt_notify_func_t cb)
{
	int err;

	/* Subscribe to notifications */
	sub_params.notify = cb;
	sub_params.subscribe = sub_cb;
	sub_params.value = BT_GATT_CCC_NOTIFY;
	sub_params.value_handle = handle;
	sub_params.ccc_handle = BT_GATT_AUTO_DISCOVER_CCC_HANDLE;
	sub_params.disc_params = &ccc_disc_params;
	sub_params.end_handle = BT_ATT_LAST_ATTRIBUTE_HANDLE;

	err = bt_gatt_subscribe(conn, &sub_params);
	TEST_ASSERT(!err, "Subscribe failed (err %d)", err);

	WAIT_FOR_FLAG(client_is_subscribed_flag);
}

void client_procedure(void)
{
	int err;
	struct bt_conn *conn;
	uint16_t handle;

	TEST_START("client");

	err = bt_enable(NULL);
	TEST_ASSERT(err == 0, "Cannot enable Bluetooth (err %d)", err);

	LOG_DBG("Bluetooth initialized");

	err = settings_load();
	TEST_ASSERT(err == 0, "Failed to load settings (err %d)", err);

	err = bt_unpair(BT_ID_DEFAULT, BT_ADDR_LE_ANY);
	TEST_ASSERT(err == 0, "Failed to unpair (err %d)", err);

	client_conn_cb.connected = NULL;
	client_conn_cb.disconnected = NULL;
	client_conn_cb.security_changed = security_changed;
	client_conn_cb.identity_resolved = NULL;

	bt_conn_cb_register(&client_conn_cb);
	TEST_ASSERT(err == 0, "Failed to set server conn callbacks (err %d)", err);

	err = bt_testlib_adv_conn(&conn, BT_ID_DEFAULT, ADVERTISER_NAME);
	TEST_ASSERT(err == 0, "Failed to start connectable advertising (err %d)", err);

	WAIT_FOR_FLAG(client_security_changed_flag);

	find_characteristic(conn, test_service_uuid, test_characteristic_uuid, &handle);

	subscribe(conn, handle, received_notification);

	TEST_PASS("client");
}
```

## src/common.h
```c
/*
 * Copyright (c) 2024 Nordic Semiconductor ASA
 *
 * SPDX-License-Identifier: Apache-2.0
 */

#ifndef ZEPHYR_TESTS_BSIM_BLUETOOTH_HOST_GATT_SETTINGS_CLEAR_SRC_COMMON_H_
#define ZEPHYR_TESTS_BSIM_BLUETOOTH_HOST_GATT_SETTINGS_CLEAR_SRC_COMMON_H_

#include <zephyr/bluetooth/bluetooth.h>

#define ADVERTISER_NAME "Advertiser Pro II"

#define test_service_uuid                                                                          \
	BT_UUID_DECLARE_128(BT_UUID_128_ENCODE(0x2e2b8dc3, 0x06e0, 0x4f93, 0x9bb2, 0x734091c356f0))
#define test_characteristic_uuid                                                                   \
	BT_UUID_DECLARE_128(BT_UUID_128_ENCODE(0x2e2b8dc3, 0x06e0, 0x4f93, 0x9bb2, 0x734091c356f3))

#endif /* ZEPHYR_TESTS_BSIM_BLUETOOTH_HOST_GATT_SETTINGS_CLEAR_SRC_COMMON_H_ */
```

## src/server.c
```c
/*
 * Copyright (c) 2024 Nordic Semiconductor ASA
 *
 * SPDX-License-Identifier: Apache-2.0
 */

#include <zephyr/kernel.h>

#include <zephyr/bluetooth/bluetooth.h>
#include <zephyr/bluetooth/conn.h>
#include <zephyr/bluetooth/gatt.h>
#include <zephyr/bluetooth/uuid.h>

#include <zephyr/settings/settings.h>

#include <zephyr/logging/log.h>

#include "testlib/conn.h"
#include "testlib/scan.h"

#include "babblekit/flags.h"
#include "babblekit/sync.h"
#include "babblekit/testcase.h"

#include "common.h"
#include "bt_settings_hook.h"

LOG_MODULE_REGISTER(server, LOG_LEVEL_DBG);

DEFINE_FLAG_STATIC(ccc_cfg_changed_flag);
DEFINE_FLAG_STATIC(disconnected_flag);
DEFINE_FLAG_STATIC(security_changed_flag);

static struct bt_conn_cb server_conn_cb;

static void ccc_cfg_changed(const struct bt_gatt_attr *attr, uint16_t value)
{
	ARG_UNUSED(attr);

	bool notif_enabled = (value == BT_GATT_CCC_NOTIFY);

	LOG_INF("CCC Update: notification %s", notif_enabled ? "enabled" : "disabled");

	SET_FLAG(ccc_cfg_changed_flag);
}

BT_GATT_SERVICE_DEFINE(test_gatt_service, BT_GATT_PRIMARY_SERVICE(test_service_uuid),
		       BT_GATT_CHARACTERISTIC(test_characteristic_uuid, BT_GATT_CHRC_NOTIFY,
					      BT_GATT_PERM_NONE, NULL, NULL, NULL),
		       BT_GATT_CCC(ccc_cfg_changed, BT_GATT_PERM_READ | BT_GATT_PERM_WRITE));

static void disconnected(struct bt_conn *conn, uint8_t reason)
{
	LOG_DBG("Disconnected: %s (reason 0x%02x)", bt_conn_dst_str(conn), reason);

	SET_FLAG(disconnected_flag);
}

static void security_changed(struct bt_conn *conn, bt_security_t level, enum bt_security_err err)
{
	TEST_ASSERT(err == 0, "Security update failed: %s level %u err %d", bt_conn_dst_str(conn),
		    level, err);

	LOG_DBG("Security changed: %s level %u", bt_conn_dst_str(conn), level);
	SET_FLAG(security_changed_flag);
}

static void init_server_conn_callbacks(void)
{
	int err;

	server_conn_cb.connected = NULL;
	server_conn_cb.disconnected = disconnected;
	server_conn_cb.security_changed = security_changed;
	server_conn_cb.identity_resolved = NULL;

	err = bt_conn_cb_register(&server_conn_cb);
	TEST_ASSERT(err == 0, "Failed to set server conn callbacks (err %d)", err);
}

static void connect_and_set_security(struct bt_conn **conn)
{
	int err;
	bt_addr_le_t client = {};

	err = bt_testlib_scan_find_name(&client, ADVERTISER_NAME);
	TEST_ASSERT(err == 0, "Failed to start scan (err %d)", err);

	err = bt_testlib_connect(&client, conn);
	TEST_ASSERT(err == 0, "Failed to initiate connection (err %d)", err);

	err = bt_conn_set_security(*conn, BT_SECURITY_L2);
	TEST_ASSERT(err == 0, "Failed to set security (err %d)", err);

	WAIT_FOR_FLAG(security_changed_flag);
}

void server_procedure(void)
{
	/* Test purpose:
	 *
	 * Verifies that we are deleting GATT settings linked to a peer that we
	 * bonded with.
	 *
	 * Two devices:
	 * - `server`: GATT server, connect and elevate security
	 * - `client`: GATT client, when connected, will subscribe to CCC
	 *
	 * [verdict]
	 * - the server doesn't have settings leftover
	 */

	int err;
	struct bt_conn *conn = NULL;

	int number_of_settings_left = 0;

	TEST_START("server");

	err = bt_enable(NULL);
	TEST_ASSERT(err == 0, "Cannot enable Bluetooth (err %d)", err);

	LOG_DBG("Bluetooth initialized");

	err = settings_load();
	TEST_ASSERT(err == 0, "Failed to load settings (err %d)", err);

	/* The hash store is still pending: this load must not do it either. */
	err = settings_load();
	TEST_ASSERT(err == 0, "Failed to load settings again (err %d)", err);

	err = bt_unpair(BT_ID_DEFAULT, BT_ADDR_LE_ANY);
	TEST_ASSERT(err == 0, "(1) Failed to unpair (err %d)", err);

	start_settings_record();

	init_server_conn_callbacks();

	connect_and_set_security(&conn);

	WAIT_FOR_FLAG(ccc_cfg_changed_flag);

	/* Settings may be written to flash on disconnection. */
	err = bt_conn_disconnect(conn, BT_HCI_ERR_REMOTE_USER_TERM_CONN);
	TEST_ASSERT(err == 0, "Failed to disconnect (err %d)", err);

	WAIT_FOR_FLAG(disconnected_flag);

	err = bt_unpair(BT_ID_DEFAULT, BT_ADDR_LE_ANY);
	TEST_ASSERT(err == 0, "(2) Failed to unpair (err %d)", err);

	number_of_settings_left = get_settings_list_size();

	stop_settings_record();
	settings_list_cleanup();

	if (number_of_settings_left > 0) {
		TEST_FAIL("'bt_unpair' did not clear the settings properly.");
	}

	TEST_ASSERT(bt_settings_hash_stored(), "The database hash was not stored");

	TEST_PASS("server");
}
```
