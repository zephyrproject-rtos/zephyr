## CMakeLists.txt
```
# SPDX-License-Identifier: Apache-2.0

cmake_minimum_required(VERSION 3.20.0)

find_package(Zephyr REQUIRED HINTS $ENV{ZEPHYR_BASE})
project(bsim_test_gatt)

FILE(GLOB app_sources src/*.c)
target_sources(app PRIVATE ${app_sources} )

zephyr_include_directories(
  ${BSIM_COMPONENTS_PATH}/libUtilv1/src/
  ${BSIM_COMPONENTS_PATH}/libPhyComv1/src/
  )
```

## prj.conf
```kconfig
CONFIG_BT=y
CONFIG_BT_DEVICE_NAME="GATT tester"
CONFIG_BT_PERIPHERAL=y
CONFIG_BT_CENTRAL=y
CONFIG_BT_GATT_CLIENT=y
CONFIG_BT_GATT_DEFERRED_RSP=y
CONFIG_BT_GATT_READ_MULTIPLE=y
CONFIG_BT_ATT_PREPARE_COUNT=4

CONFIG_BT_SMP=y
CONFIG_BT_GATT_DYNAMIC_DB=y
CONFIG_BT_L2CAP_DYNAMIC_CHANNEL=y
CONFIG_BT_L2CAP_ECRED=y
CONFIG_BT_EATT=y
CONFIG_BT_EATT_MAX=1
CONFIG_BT_EATT_AUTO_CONNECT=n

CONFIG_ASSERT=y
CONFIG_BT_TESTING=y
```

## prepare_count_0.conf
```kconfig
CONFIG_BT_ATT_PREPARE_COUNT=0
```

## psa_overlay.conf
```kconfig
CONFIG_PSA_CRYPTO=y
CONFIG_PSA_CRYPTO_ENABLE_ALL=y
```

## src/main.c
```c
/*
 * Copyright (c) 2022 Nordic Semiconductor ASA
 *
 * SPDX-License-Identifier: Apache-2.0
 */

#include "bstests.h"

extern struct bst_test_list *test_gatt_server_install(struct bst_test_list *tests);
extern struct bst_test_list *test_gatt_client_install(struct bst_test_list *tests);
extern struct bst_test_list *test_gatt_deferred_client_install(struct bst_test_list *tests);
extern struct bst_test_list *test_gatt_deferred_server_install(struct bst_test_list *tests);

bst_test_install_t test_installers[] = {
	test_gatt_server_install,
	test_gatt_client_install,
	test_gatt_deferred_client_install,
	test_gatt_deferred_server_install,
	NULL
};

int main(void)
{
	bst_main();
	return 0;
}
```

## src/common.c
```c
/*
 * Copyright (c) 2022 Nordic Semiconductor ASA
 *
 * SPDX-License-Identifier: Apache-2.0
 */

#include "common.h"
#include "argparse.h"

void test_tick(bs_time_t HW_device_time)
{
	if (bst_result != Passed) {
		FAIL("test failed (not passed after %i seconds)\n", WAIT_TIME);
	}
}

void test_init(void)
{
	bst_ticker_set_next_tick_absolute(WAIT_TIME);
	bst_result = In_progress;
}

#define CHANNEL_ID 0
#define MSG_SIZE 1

void backchannel_init(void)
{
	uint device_number = get_device_nbr();
	uint peer_number = device_number ^ 1;
	uint device_numbers[] = { peer_number };
	uint channel_numbers[] = { CHANNEL_ID };
	uint *ch;

	ch = bs_open_back_channel(device_number, device_numbers, channel_numbers,
				  ARRAY_SIZE(channel_numbers));
	if (!ch) {
		FAIL("Unable to open backchannel\n");
	}
}

void backchannel_sync_send(void)
{
	uint8_t sync_msg[MSG_SIZE] = { get_device_nbr() };

	printk("Sending sync\n");
	bs_bc_send_msg(CHANNEL_ID, sync_msg, ARRAY_SIZE(sync_msg));
}

void backchannel_sync_wait(void)
{
	uint8_t sync_msg[MSG_SIZE];

	while (true) {
		if (bs_bc_is_msg_received(CHANNEL_ID) > 0) {
			bs_bc_receive_msg(CHANNEL_ID, sync_msg, ARRAY_SIZE(sync_msg));
			if (sync_msg[0] != get_device_nbr()) {
				/* Received a message from another device, exit */
				break;
			}
		}

		k_sleep(K_MSEC(1));
	}

	printk("Sync received\n");
}
```

## src/common.h
```c
/**
 * Common functions and helpers for BSIM GATT tests
 *
 * Copyright (c) 2022 Nordic Semiconductor ASA
 *
 * SPDX-License-Identifier: Apache-2.0
 */

#define TEST_SERVICE_UUID \
	BT_UUID_DECLARE_128(0x01, 0x23, 0x45, 0x67, 0x89, 0x01, 0x02, 0x03, \
			    0x04, 0x05, 0x06, 0x07, 0x08, 0x09, 0x00, 0x00)

#define TEST_CHRC_UUID \
	BT_UUID_DECLARE_128(0x01, 0x23, 0x45, 0x67, 0x89, 0x01, 0x02, 0x03, \
			    0x04, 0x05, 0x06, 0x07, 0x08, 0x09, 0xFF, 0x00)

#define TEST_ADDITIONAL_CHRC_UUID \
	BT_UUID_DECLARE_128(0x01, 0x23, 0x45, 0x67, 0x89, 0x01, 0x02, 0x03, \
			    0x04, 0x05, 0x06, 0x07, 0x08, 0x09, 0xFF, 0x11)
```

## src/deferred_rsp.h
```c
/*
 * Copyright (c) 2026 Xiaomi Corporation
 *
 * SPDX-License-Identifier: Apache-2.0
 */

/* Longer than what a response can carry with the default ATT MTU */
#define VALUE_SIZE 40U

/* Values of the second deferred and of the non-deferred characteristic,
 * short enough that a Read Multiple Response holds more than one of them
 */
#define VALUE2_SIZE     12U
#define SYNC_VALUE_SIZE 4U

/* Longer than any response can carry, so that reading this non-deferred
 * characteristic fills one on its own
 */
#define FILL_VALUE_SIZE 80U

#define BLOB_OFFSET 30U
#define WRITE_SIZE  4U

/* STAGE_PREP_REORDER prepares the same handle twice, the first fragment at
 * offset 0 and the second right after it, each with its own byte pattern so
 * the reassembled value shows whether the two kept their arrival order.
 */
#define REORDER_FIRST_BYTE  0x10U
#define REORDER_SECOND_BYTE 0x20U

/* The error the deferred callback responds with in STAGE_ERROR,
 * STAGE_MULT_ERROR and STAGE_EXEC_ERR
 */
#define TEST_DEFERRED_ERR 0x81U

enum test_stage {
	STAGE_MULT_SYNC,
	STAGE_READ,
	STAGE_BLOB,
	STAGE_TYPE,
	STAGE_ERROR,
	STAGE_WRITE,
	STAGE_PREPARE,
	STAGE_CMD,
	STAGE_MULT,
	STAGE_MULT_VL,
	STAGE_MULT_ERROR,
	STAGE_MULT_PERM,
	STAGE_MULT_FULL,
	STAGE_MULT_TUPLE,
	STAGE_MULT_INLINE_ERR,
	STAGE_NOW_ERR,
	STAGE_EXEC,
	STAGE_EXEC_ERR,
	STAGE_EXEC_EMPTY,
	STAGE_EXEC_MIXED,
	STAGE_EXEC_MIXED_ERR,
	/* Only reached when an enhanced bearer is open */
	STAGE_BEARERS,
	STAGE_PREP_EXEC,
	STAGE_PREP_REORDER,
	STAGE_PREP_MIXED,
	STAGE_PREP_POOL,
	STAGE_PIPELINE_EATT,
	STAGE_PIPELINE,
	/* Only used by the prepare-count-0 image, on its own enhanced bearer */
	STAGE_PREP0,
};

/* Requests deferred at the same time in STAGE_BEARERS, one per bearer */
#define BEARER_SLOTS 2U

/* Prepared values deferred at the same time in STAGE_PREP_REORDER, one per
 * bearer, both for the same handle at adjacent offsets
 */
#define PREP_SLOTS 2U

#define TEST_DEFERRED_SERVICE_UUID                                                                 \
	BT_UUID_DECLARE_128(0x21, 0x23, 0x45, 0x67, 0x89, 0x01, 0x02, 0x03, 0x04, 0x05, 0x06,      \
			    0x07, 0x08, 0x09, 0x00, 0x00)

#define TEST_DEFERRED_CHRC_UUID                                                                    \
	BT_UUID_DECLARE_128(0x21, 0x23, 0x45, 0x67, 0x89, 0x01, 0x02, 0x03, 0x04, 0x05, 0x06,      \
			    0x07, 0x08, 0x09, 0x01, 0x00)

#define TEST_CP_CHRC_UUID                                                                          \
	BT_UUID_DECLARE_128(0x21, 0x23, 0x45, 0x67, 0x89, 0x01, 0x02, 0x03, 0x04, 0x05, 0x06,      \
			    0x07, 0x08, 0x09, 0x02, 0x00)

#define TEST_DEFERRED2_CHRC_UUID                                                                   \
	BT_UUID_DECLARE_128(0x21, 0x23, 0x45, 0x67, 0x89, 0x01, 0x02, 0x03, 0x04, 0x05, 0x06,      \
			    0x07, 0x08, 0x09, 0x03, 0x00)

#define TEST_SYNC_CHRC_UUID                                                                        \
	BT_UUID_DECLARE_128(0x21, 0x23, 0x45, 0x67, 0x89, 0x01, 0x02, 0x03, 0x04, 0x05, 0x06,      \
			    0x07, 0x08, 0x09, 0x04, 0x00)

#define TEST_FILL_CHRC_UUID                                                                        \
	BT_UUID_DECLARE_128(0x21, 0x23, 0x45, 0x67, 0x89, 0x01, 0x02, 0x03, 0x04, 0x05, 0x06,      \
			    0x07, 0x08, 0x09, 0x05, 0x00)

/* Non-deferred value that still takes a prepared write, to put a non-deferred
 * value in the same Execute Write queue as a deferred one (STAGE_EXEC_MIXED).
 */
#define TEST_SYNCPREP_CHRC_UUID                                                                    \
	BT_UUID_DECLARE_128(0x21, 0x23, 0x45, 0x67, 0x89, 0x01, 0x02, 0x03, 0x04, 0x05, 0x06,      \
			    0x07, 0x08, 0x09, 0x06, 0x00)
```

## src/deferred_rsp_server_test.c
```c
/*
 * Copyright (c) 2026 Xiaomi Corporation
 *
 * SPDX-License-Identifier: Apache-2.0
 */

#include <errno.h>
#include <stddef.h>

#include <zephyr/bluetooth/att.h>
#include <zephyr/bluetooth/bluetooth.h>
#include <zephyr/bluetooth/conn.h>
#include <zephyr/bluetooth/gatt.h>
#include <zephyr/bluetooth/uuid.h>
#include <zephyr/kernel.h>

#include "host/att_internal.h"

#include "babblekit/flags.h"
#include "babblekit/sync.h"
#include "babblekit/testcase.h"
#include "deferred_rsp.h"

DEFINE_FLAG_STATIC(flag_is_connected);
DEFINE_FLAG_STATIC(flag_is_encrypted);
DEFINE_FLAG_STATIC(flag_test_done);

static struct bt_conn *g_conn;

static uint8_t chrc_value[VALUE_SIZE];
static uint8_t chrc2_value[VALUE2_SIZE];
static uint8_t sync_value[SYNC_VALUE_SIZE];
static uint8_t fill_value[FILL_VALUE_SIZE];

/* Non-deferred value written by its own method, prepared alongside a deferred
 * one so an Execute Write queue holds both (STAGE_EXEC_MIXED).
 */
static uint8_t mixed_value[WRITE_SIZE];

static void fill_values(void)
{
	for (size_t i = 0U; i < sizeof(chrc_value); i++) {
		chrc_value[i] = (uint8_t)i;
	}

	for (size_t i = 0U; i < sizeof(chrc2_value); i++) {
		chrc2_value[i] = (uint8_t)(0x80U + i);
	}

	for (size_t i = 0U; i < sizeof(sync_value); i++) {
		sync_value[i] = (uint8_t)(0xf0U + i);
	}

	for (size_t i = 0U; i < sizeof(fill_value); i++) {
		fill_value[i] = (uint8_t)(0x40U + i);
	}
}

static enum test_stage stage;
static bool command_seen;
static bool execute_seen;
static bool mixed_seen;
static bool use_eatt;

/* Values of the Execute Write in STAGE_EXEC and STAGE_EXEC_ERR seen so far */
static uint8_t exec_cnt;

/* Set from the call for one value of an Execute Write until it is responded to */
static bool exec_pending;

/* Set while a Prepare Write is deferred, so that an Execute Write applying its
 * value before the application has accepted it is caught
 */
static bool prep_deferred;

static uint32_t pending_id;
static const uint8_t *pending_value;
static uint16_t pending_len;
static uint8_t pending_err;
static bool pending_is_read;

static void respond_work_handler(struct k_work *work)
{
	/* Responding to one value of a Read Multiple can ask for the next one
	 * before returning, which overwrites the pending state
	 */
	uint32_t id = pending_id;
	const uint8_t *value = pending_value;
	uint16_t len = pending_len;
	uint8_t att_err = pending_err;
	bool is_read = pending_is_read;
	int err;

	if (att_err != 0U) {
		exec_pending = false;
		err = bt_gatt_deferred_error_rsp(id, BT_GATT_ERR(att_err));
	} else if (is_read) {
		err = bt_gatt_deferred_read_rsp(id, value, len);
	} else {
		/* Accepted, so an Execute Write may now apply the value */
		prep_deferred = false;
		exec_pending = false;
		err = bt_gatt_deferred_write_rsp(id);
	}

	if (err != 0) {
		TEST_FAIL("Deferred response failed (err %d)", err);

		return;
	}

	/* The request is done, so it cannot be responded to again */
	err = bt_gatt_deferred_error_rsp(id, BT_GATT_ERR(TEST_DEFERRED_ERR));
	if (err != -EINVAL) {
		TEST_FAIL("Stale request id accepted (err %d)", err);
	}
}

static K_WORK_DELAYABLE_DEFINE(respond_work, respond_work_handler);

/* STAGE_BEARERS defers a read on every bearer before responding to any of them */
static uint32_t bearer_id[BEARER_SLOTS];
static uint16_t bearer_offset[BEARER_SLOTS];

static void bearer_work_handler(struct k_work *work)
{
	/* Responded to in reverse order: each response has to reach its own bearer */
	for (uint8_t i = BEARER_SLOTS; i > 0U; i--) {
		uint16_t offset = bearer_offset[i - 1];
		int err;

		err = bt_gatt_deferred_read_rsp(bearer_id[i - 1], &chrc_value[offset],
						sizeof(chrc_value) - offset);
		if (err != 0) {
			TEST_FAIL("Deferred response %u failed (err %d)", i - 1, err);

			return;
		}

		/* That request is done, so it cannot be responded to again */
		err = bt_gatt_deferred_error_rsp(bearer_id[i - 1], BT_GATT_ERR(TEST_DEFERRED_ERR));
		if (err != -EINVAL) {
			TEST_FAIL("Stale request id %u accepted (err %d)", i - 1, err);

			return;
		}
	}
}

static K_WORK_DELAYABLE_DEFINE(bearer_work, bearer_work_handler);

/* STAGE_PREP_REORDER defers a Prepare Write on every bearer before accepting
 * any of them, so that the host holds more than one unaccepted prepare of the
 * same handle at once, each numbered on arrival.
 */
static uint32_t prep_id[PREP_SLOTS];
static uint16_t prep_offset[PREP_SLOTS];
static uint8_t prep_cnt;
static bool reorder_exec_seen;

static void prep_reorder_work_handler(struct k_work *work)
{
	/* Accepted in reverse arrival order: the value that arrived last is
	 * accepted first. The queue must still execute in arrival order, so
	 * the fragment at offset 0 is applied before the one after it.
	 */
	for (uint8_t i = PREP_SLOTS; i > 0U; i--) {
		int err;

		err = bt_gatt_deferred_write_rsp(prep_id[i - 1]);
		if (err != 0) {
			TEST_FAIL("Prepare accept %u failed (err %d)", i - 1, err);

			return;
		}

		/* That request is done, so it cannot be responded to again */
		err = bt_gatt_deferred_error_rsp(prep_id[i - 1], BT_GATT_ERR(TEST_DEFERRED_ERR));
		if (err != -EINVAL) {
			TEST_FAIL("Stale prepare id %u accepted (err %d)", i - 1, err);

			return;
		}
	}

	/* Both accepted, so the Execute Write may now apply their values */
	prep_deferred = false;
}

static K_WORK_DELAYABLE_DEFINE(prep_reorder_work, prep_reorder_work_handler);

/* STAGE_PREP_MIXED and STAGE_PREP_POOL hold the deferred prepare until the
 * non-deferred prepares of the stage have arrived on the other bearer
 */
static uint32_t waiting_prep_id;
static uint8_t syncprep_cnt;
/* STAGE_PREP_MIXED writes of the Execute Write, in the order they happened */
static uint8_t prep_mixed_writes;

static void waiting_prep_work_handler(struct k_work *work)
{
	int err;

	prep_deferred = false;
	err = bt_gatt_deferred_write_rsp(waiting_prep_id);
	if (err != 0) {
		TEST_FAIL("Accepting the waiting prepare failed (err %d)", err);
	}
}

static K_WORK_DELAYABLE_DEFINE(waiting_prep_work, waiting_prep_work_handler);

/* More than att_pool holds in this image */
#define HOLD_MAX 16U

/* STAGE_MULT_SYNC leaves a single ATT buffer free, which the response of a
 * non-deferred Read Multiple takes, so it must not need another one
 */
static struct net_buf *held[HOLD_MAX];
static size_t held_cnt;

static void hold_work_handler(struct k_work *work)
{
	struct net_buf *buf;

	/* This runs on the system work queue, where the allocation never waits */
	while (held_cnt < ARRAY_SIZE(held)) {
		buf = bt_att_create_pdu(g_conn, BT_ATT_OP_NOTIFY, 0);
		if (buf == NULL) {
			break;
		}

		held[held_cnt] = buf;
		held_cnt++;
	}

	if ((held_cnt == 0U) || (held_cnt == ARRAY_SIZE(held))) {
		TEST_FAIL("Holding %zu ATT buffers", held_cnt);

		return;
	}

	held_cnt--;
	net_buf_unref(held[held_cnt]);
	/* The client reads once the buffers are taken */
	bk_sync_send();
}

static K_WORK_DELAYABLE_DEFINE(hold_work, hold_work_handler);

static void release_held(void)
{
	while (held_cnt > 0U) {
		held_cnt--;
		net_buf_unref(held[held_cnt]);
	}
}

static int read_deferred_chrc(struct bt_conn *conn, uint32_t id, const struct bt_gatt_attr *attr,
			      uint16_t offset, uint16_t max_len)
{
	ARG_UNUSED(conn);
	ARG_UNUSED(attr);

	printk("deferred read offset %u max_len %u\n", offset, max_len);

	if (offset > sizeof(chrc_value)) {
		return BT_GATT_ERR(BT_ATT_ERR_INVALID_OFFSET);
	}

	if (stage == STAGE_BEARERS) {
		static uint8_t bearer_cnt;

		if (bearer_cnt >= BEARER_SLOTS) {
			TEST_FAIL("More than %u requests deferred at once", BEARER_SLOTS);

			return BT_GATT_ERR(BT_ATT_ERR_UNLIKELY);
		}

		bearer_id[bearer_cnt] = id;
		bearer_offset[bearer_cnt] = offset;
		bearer_cnt++;

		/* Held until every bearer has one, which only works if the
		 * host keeps the deferred state per bearer.
		 */
		if (bearer_cnt == BEARER_SLOTS) {
			k_work_schedule(&bearer_work, K_MSEC(10));
		}

		return 0;
	}

	if (stage == STAGE_MULT_INLINE_ERR) {
		/* Responded to from inside the callback */
		if (bt_gatt_deferred_error_rsp(id, BT_GATT_ERR(TEST_DEFERRED_ERR)) != 0) {
			TEST_FAIL("Inline response failed");

			return BT_GATT_ERR(BT_ATT_ERR_UNLIKELY);
		}

		return 0;
	}

	if (stage == STAGE_READ) {
		/* Not BT_GATT_ERR() of an ATT error, and the request stays open */
		if ((bt_gatt_deferred_error_rsp(id, TEST_DEFERRED_ERR) != -EINVAL) ||
		    (bt_gatt_deferred_error_rsp(id, 0) != -EINVAL) ||
		    (bt_gatt_deferred_error_rsp(id, -0x100) != -EINVAL)) {
			TEST_FAIL("An invalid error code was accepted");

			return BT_GATT_ERR(BT_ATT_ERR_UNLIKELY);
		}
	}

	pending_id = id;
	pending_value = &chrc_value[offset];
	pending_len = sizeof(chrc_value) - offset;
	pending_is_read = true;
	pending_err = (stage == STAGE_ERROR || stage == STAGE_MULT_ERROR) ? TEST_DEFERRED_ERR : 0U;

	if ((stage == STAGE_PIPELINE) || (stage == STAGE_PIPELINE_EATT) || (stage == STAGE_PREP0)) {
		if (stage == STAGE_PREP0) {
			/* The client sends its next request once this one is deferred */
			bk_sync_send();
		}

		/* No response: the bearer goes away first */
		return 0;
	}

	k_work_schedule(&respond_work, K_MSEC(10));

	return 0;
}

static int read_deferred_chrc2(struct bt_conn *conn, uint32_t id, const struct bt_gatt_attr *attr,
			       uint16_t offset, uint16_t max_len)
{
	ARG_UNUSED(conn);
	ARG_UNUSED(attr);

	printk("deferred read 2 offset %u max_len %u\n", offset, max_len);

	if (offset > sizeof(chrc2_value)) {
		return BT_GATT_ERR(BT_ATT_ERR_INVALID_OFFSET);
	}

	pending_id = id;
	pending_value = &chrc2_value[offset];
	pending_len = sizeof(chrc2_value) - offset;
	pending_is_read = true;
	pending_err = 0U;

	k_work_schedule(&respond_work, K_MSEC(10));

	return 0;
}

static ssize_t read_sync_chrc(struct bt_conn *conn, const struct bt_gatt_attr *attr, void *buf,
			      uint16_t len, uint16_t offset)
{
	return bt_gatt_attr_read(conn, attr, buf, len, offset, sync_value, sizeof(sync_value));
}

static ssize_t read_fill_chrc(struct bt_conn *conn, const struct bt_gatt_attr *attr, void *buf,
			      uint16_t len, uint16_t offset)
{
	return bt_gatt_attr_read(conn, attr, buf, len, offset, fill_value, sizeof(fill_value));
}

/* One value of an Execute Write, after the previous one has been responded to */
static int exec_value(uint32_t id, const struct bt_gatt_attr *attr, uint16_t len, uint16_t offset)
{
	const struct bt_uuid *expected = TEST_DEFERRED_CHRC_UUID;

	if (exec_pending) {
		TEST_FAIL("Next execute write value before the previous was responded to");

		return BT_GATT_ERR(BT_ATT_ERR_UNLIKELY);
	}

	if ((offset != 0U) || (len != WRITE_SIZE)) {
		TEST_FAIL("Unexpected execute write len %u offset %u", len, offset);

		return BT_GATT_ERR(BT_ATT_ERR_UNLIKELY);
	}

	pending_id = id;
	pending_is_read = false;
	pending_err = 0U;

	if (stage == STAGE_EXEC_EMPTY) {
		TEST_FAIL("A value survived the failed execute write");

		return BT_GATT_ERR(BT_ATT_ERR_UNLIKELY);
	}

	if ((stage == STAGE_EXEC) || (stage == STAGE_EXEC_ERR)) {
		/* In the order the client prepared them */
		if (exec_cnt == 1U) {
			expected = TEST_DEFERRED2_CHRC_UUID;
		}

		if ((exec_cnt > 1U) || (bt_uuid_cmp(attr->uuid, expected) != 0)) {
			TEST_FAIL("Execute write value %u is for the wrong attribute", exec_cnt);

			return BT_GATT_ERR(BT_ATT_ERR_UNLIKELY);
		}

		if ((stage == STAGE_EXEC_ERR) && (exec_cnt == 1U)) {
			pending_err = TEST_DEFERRED_ERR;
		}

		exec_cnt++;
	}

	execute_seen = true;
	exec_pending = true;
	k_work_schedule(&respond_work, K_MSEC(10));

	return 0;
}

static int write_deferred_chrc(struct bt_conn *conn, uint32_t id, const struct bt_gatt_attr *attr,
			       const void *buf, uint16_t len, uint16_t offset,
			       enum bt_gatt_attr_write_flag flags)
{
	printk("deferred write len %u offset %u flags 0x%02x id %u\n", len, offset, flags, id);

	if (conn != g_conn) {
		TEST_FAIL("Write for an unknown connection");

		return BT_GATT_ERR(BT_ATT_ERR_UNLIKELY);
	}

	if ((flags & BT_GATT_WRITE_FLAG_CMD) != 0U) {
		if ((id != BT_GATT_DEFERRED_REQ_ID_NONE) ||
		    (bt_gatt_deferred_write_rsp(id) != -EINVAL)) {
			TEST_FAIL("A write without a response can be responded to");

			return BT_GATT_ERR(BT_ATT_ERR_UNLIKELY);
		}

		command_seen = true;

		return 0;
	}

	if (id == BT_GATT_DEFERRED_REQ_ID_NONE) {
		/* An Execute Write that also holds a non-deferred value is not
		 * deferred: write before returning, as for a Write Command.
		 */
		if ((flags & BT_GATT_WRITE_FLAG_EXECUTE) == 0U) {
			TEST_FAIL("A request with a response has no id");

			return BT_GATT_ERR(BT_ATT_ERR_UNLIKELY);
		}

		if (bt_gatt_deferred_write_rsp(id) != -EINVAL) {
			TEST_FAIL("A non-deferred Execute Write can be responded to");

			return BT_GATT_ERR(BT_ATT_ERR_UNLIKELY);
		}

		if (stage == STAGE_EXEC_MIXED_ERR) {
			return BT_GATT_ERR(TEST_DEFERRED_ERR);
		}

		if ((offset != 0U) || (len != WRITE_SIZE)) {
			TEST_FAIL("Mixed execute write len %u offset %u", len, offset);

			return BT_GATT_ERR(BT_ATT_ERR_UNLIKELY);
		}

		if (stage == STAGE_PREP_MIXED) {
			prep_mixed_writes++;
		}

		/* Write the deferred value of the mixed Execute into its own
		 * store, so the shared chrc_value stays as the other stages
		 * expect it.
		 */
		(void)memcpy(mixed_value, buf, len);
		mixed_seen = true;

		return 0;
	}

	if ((flags & BT_GATT_WRITE_FLAG_EXECUTE) != 0U) {
		if (prep_deferred) {
			TEST_FAIL("Execute write applied an unaccepted prepare");

			return BT_GATT_ERR(BT_ATT_ERR_UNLIKELY);
		}

		if (stage == STAGE_PREP_REORDER) {
			const uint8_t *value = buf;

			/* One reassembled write of both fragments, in the order
			 * the client sent them, whatever order they were accepted in.
			 */
			if ((offset != 0U) || (len != (2U * WRITE_SIZE))) {
				TEST_FAIL("Reordered execute len %u offset %u", len, offset);

				return BT_GATT_ERR(BT_ATT_ERR_UNLIKELY);
			}

			for (uint16_t i = 0U; i < WRITE_SIZE; i++) {
				if ((value[i] != (uint8_t)(REORDER_FIRST_BYTE + i)) ||
				    (value[WRITE_SIZE + i] !=
				     (uint8_t)(REORDER_SECOND_BYTE + i))) {
					TEST_FAIL("Reordered execute byte %u is 0x%02x 0x%02x", i,
						  value[i], value[WRITE_SIZE + i]);

					return BT_GATT_ERR(BT_ATT_ERR_UNLIKELY);
				}
			}

			reorder_exec_seen = true;
			pending_id = id;
			pending_is_read = false;
			pending_err = 0U;
			k_work_schedule(&respond_work, K_MSEC(10));

			return 0;
		}

		return exec_value(id, attr, len, offset);
	}

	if ((flags & BT_GATT_WRITE_FLAG_PREPARE) != 0U) {
		prep_deferred = true;

		if ((stage == STAGE_PREP_MIXED) || (stage == STAGE_PREP_POOL)) {
			waiting_prep_id = id;
			/* The client sends its next request once this one is deferred */
			bk_sync_send();

			return 0;
		}

		if (stage == STAGE_PREP_REORDER) {
			if (prep_cnt >= PREP_SLOTS) {
				TEST_FAIL("More than %u prepares deferred at once", PREP_SLOTS);

				return BT_GATT_ERR(BT_ATT_ERR_UNLIKELY);
			}

			prep_id[prep_cnt] = id;
			prep_offset[prep_cnt] = offset;
			prep_cnt++;

			/* Held until both bearers have one, so the host carries
			 * two unaccepted prepares of this handle at the same
			 * time, then accepted in reverse arrival order.
			 */
			if (prep_cnt == PREP_SLOTS) {
				k_work_schedule(&prep_reorder_work, K_MSEC(10));
			} else {
				/* The client sends its next request once this one is deferred */
				bk_sync_send();
			}

			return 0;
		}
	}

	pending_id = id;
	pending_is_read = false;
	pending_err = 0U;

	/* STAGE_PREP_EXEC needs this one to still be deferred when the Execute
	 * Write the client sends on the other bearer arrives
	 */
	k_work_schedule(&respond_work, (stage == STAGE_PREP_EXEC) ? K_MSEC(200) : K_MSEC(10));
	if (stage == STAGE_PREP_EXEC) {
		/* The client sends its next request once this one is deferred */
		bk_sync_send();
	}

	return 0;
}

static ssize_t write_syncprep_chrc(struct bt_conn *conn, const struct bt_gatt_attr *attr,
				   const void *buf, uint16_t len, uint16_t offset, uint8_t flags)
{
	ARG_UNUSED(conn);
	ARG_UNUSED(attr);

	if ((flags & BT_GATT_WRITE_FLAG_PREPARE) != 0U) {
		syncprep_cnt++;
		if ((stage == STAGE_PREP_MIXED) ||
		    ((stage == STAGE_PREP_POOL) && (syncprep_cnt == CONFIG_BT_ATT_PREPARE_COUNT))) {
			k_work_schedule(&waiting_prep_work, K_MSEC(10));
		}

		/* Only queued now; the value is written on the Execute Write */
		return 0;
	}

	if ((stage == STAGE_PREP_MIXED) && (prep_mixed_writes != 1U)) {
		TEST_FAIL("Non-deferred value written before the deferred one that arrived first");

		return BT_GATT_ERR(BT_ATT_ERR_UNLIKELY);
	}

	if (stage == STAGE_PREP_MIXED) {
		prep_mixed_writes++;
	}

	if (offset != 0U) {
		return BT_GATT_ERR(BT_ATT_ERR_INVALID_OFFSET);
	}

	if (len != sizeof(mixed_value)) {
		return BT_GATT_ERR(BT_ATT_ERR_INVALID_ATTRIBUTE_LEN);
	}

	/* The host writes this non-deferred value itself, so there is nothing
	 * to defer even when it shares an Execute Write with a deferred one.
	 */
	(void)memcpy(mixed_value, buf, len);

	return len;
}

static ssize_t write_cp_chrc(struct bt_conn *conn, const struct bt_gatt_attr *attr, const void *buf,
			     uint16_t len, uint16_t offset, uint8_t flags)
{
	const uint8_t *value = buf;
	int err;

	if (len != 1U) {
		return BT_GATT_ERR(BT_ATT_ERR_INVALID_ATTRIBUTE_LEN);
	}

	if (((stage == STAGE_EXEC) || (stage == STAGE_EXEC_ERR)) && (exec_cnt != 2U)) {
		TEST_FAIL("Execute write of stage %u wrote %u of its 2 values", stage, exec_cnt);

		return BT_GATT_ERR(BT_ATT_ERR_UNLIKELY);
	}

	stage = value[0];
	exec_cnt = 0U;
	syncprep_cnt = 0U;
	printk("stage %u\n", stage);

	release_held();
	if (stage == STAGE_MULT_SYNC) {
		/* Once the response to this write has been sent */
		k_work_schedule(&hold_work, K_MSEC(300));
	}

	if ((stage == STAGE_PIPELINE) && use_eatt) {
		/* Only the enhanced bearer went, and its request with it */
		err = bt_gatt_deferred_read_rsp(pending_id, chrc_value, sizeof(chrc_value));
		if ((bt_eatt_count(conn) != 0U) || (err != -EINVAL)) {
			TEST_FAIL("%u enhanced bearers, late rsp %d", bt_eatt_count(conn), err);
		}
	}

	return len;
}

BT_GATT_SERVICE_DEFINE(test_deferred_svc, BT_GATT_PRIMARY_SERVICE(TEST_DEFERRED_SERVICE_UUID),
		       BT_GATT_DEFERRED_CHARACTERISTIC(TEST_DEFERRED_CHRC_UUID,
						       BT_GATT_CHRC_READ | BT_GATT_CHRC_WRITE,
						       BT_GATT_PERM_READ | BT_GATT_PERM_WRITE |
							       BT_GATT_PERM_PREPARE_WRITE,
						       read_deferred_chrc, write_deferred_chrc,
						       NULL),
		       BT_GATT_CHARACTERISTIC(TEST_CP_CHRC_UUID, BT_GATT_CHRC_WRITE,
					      BT_GATT_PERM_WRITE, NULL, write_cp_chrc, NULL),
		       BT_GATT_DEFERRED_CHARACTERISTIC(TEST_DEFERRED2_CHRC_UUID,
						       BT_GATT_CHRC_READ | BT_GATT_CHRC_WRITE,
						       BT_GATT_PERM_READ | BT_GATT_PERM_WRITE |
							       BT_GATT_PERM_PREPARE_WRITE,
						       read_deferred_chrc2, write_deferred_chrc,
						       NULL),
		       BT_GATT_CHARACTERISTIC(TEST_SYNC_CHRC_UUID, BT_GATT_CHRC_READ,
					      BT_GATT_PERM_READ, read_sync_chrc, NULL, NULL),
		       BT_GATT_CHARACTERISTIC(TEST_SYNCPREP_CHRC_UUID, BT_GATT_CHRC_WRITE,
					      BT_GATT_PERM_WRITE | BT_GATT_PERM_PREPARE_WRITE,
					      NULL, write_syncprep_chrc, NULL),
		       BT_GATT_CHARACTERISTIC(TEST_FILL_CHRC_UUID, BT_GATT_CHRC_READ,
					      BT_GATT_PERM_READ, read_fill_chrc, NULL, NULL));

static void connected(struct bt_conn *conn, uint8_t err)
{
	if (err != 0) {
		TEST_FAIL("Failed to connect to %s (%u)", bt_conn_dst_str(conn), err);

		return;
	}

	g_conn = bt_conn_ref(conn);

	SET_FLAG(flag_is_connected);
}

static void security_changed(struct bt_conn *conn, bt_security_t level,
			     enum bt_security_err security_err)
{
	if (security_err == BT_SECURITY_ERR_SUCCESS && level > BT_SECURITY_L1) {
		SET_FLAG(flag_is_encrypted);
	}
}

static void disconnected(struct bt_conn *conn, uint8_t reason)
{
	int err;

	printk("Disconnected: %s (reason 0x%02x)\n", bt_conn_dst_str(conn), reason);

	bt_conn_drop(&g_conn);

	if (stage == STAGE_PREP0) {
		/* The enhanced bearer was dropped for the pipelined prepare;
		 * the client ends the test by dropping the connection
		 */
		SET_FLAG(flag_test_done);

		return;
	}

	if (stage != STAGE_PIPELINE) {
		TEST_FAIL("Disconnected in stage %u", stage);

		return;
	}

	/* The bearer the request arrived on is gone */
	err = bt_gatt_deferred_read_rsp(pending_id, chrc_value, sizeof(chrc_value));
	if (err != -EINVAL) {
		TEST_FAIL("Deferred response accepted after disconnect (err %d)", err);

		return;
	}

	if (!command_seen) {
		TEST_FAIL("Write command was never seen");

		return;
	}

	if (!execute_seen) {
		TEST_FAIL("Execute write was never seen");

		return;
	}

	if (!mixed_seen) {
		TEST_FAIL("Mixed execute write was never seen");

		return;
	}

	if (use_eatt && !reorder_exec_seen) {
		TEST_FAIL("Reordered execute write was never seen");

		return;
	}

	if (use_eatt && (prep_mixed_writes != 2U)) {
		TEST_FAIL("Mixed prepares wrote %u values", prep_mixed_writes);

		return;
	}

	SET_FLAG(flag_test_done);
}

static struct bt_conn_cb conn_callbacks = {
	.connected = connected,
	.disconnected = disconnected,
	.security_changed = security_changed,
};

static void test_main_common(bool connect_eatt)
{
	const struct bt_data ad[] = {
		BT_DATA_BYTES(BT_DATA_FLAGS, (BT_LE_AD_GENERAL | BT_LE_AD_NO_BREDR)),
		BT_DATA(BT_DATA_NAME_COMPLETE, CONFIG_BT_DEVICE_NAME,
			sizeof(CONFIG_BT_DEVICE_NAME) - 1),
	};
	int err;

	TEST_ASSERT(bk_sync_init() == 0, "Failed to open backchannel");

	fill_values();
	use_eatt = connect_eatt;

	bt_conn_cb_register(&conn_callbacks);

	err = bt_enable(NULL);
	if (err != 0) {
		TEST_FAIL("Bluetooth init failed (err %d)", err);

		return;
	}

	err = bt_le_adv_start(BT_LE_ADV_CONN_FAST_1, ad, ARRAY_SIZE(ad), NULL, 0);
	if (err != 0) {
		TEST_FAIL("Advertising failed to start (err %d)", err);

		return;
	}

	if (connect_eatt) {
		WAIT_FOR_FLAG(flag_is_connected);
		WAIT_FOR_FLAG(flag_is_encrypted);

		err = bt_eatt_connect(g_conn, CONFIG_BT_EATT_MAX);
		if (err != 0) {
			TEST_FAIL("Failed to connect EATT channels (err %d)", err);

			return;
		}
	}

	WAIT_FOR_FLAG(flag_test_done);

	TEST_PASS("GATT server passed");
}

static void test_main_eatt(void)
{
	test_main_common(true);
}

static void test_main_no_eatt(void)
{
	test_main_common(false);
}

static const struct bst_test_instance test_deferred_server[] = {
	{
		.test_id = "gatt_server_deferred_eatt",
		.test_main_f = test_main_eatt,
	},
	{
		.test_id = "gatt_server_deferred_no_eatt",
		.test_main_f = test_main_no_eatt,
	},
	{
		/* Prepare-count-0 image: a deferred read, then a pipelined
		 * Prepare Write whose handler is compiled out
		 */
		.test_id = "gatt_server_prep0",
		.test_main_f = test_main_no_eatt,
	},
	BSTEST_END_MARKER,
};

struct bst_test_list *test_gatt_deferred_server_install(struct bst_test_list *tests)
{
	return bst_add_tests(tests, test_deferred_server);
}
```

## src/gatt_client_test.c
```c
/*
 * Copyright (c) 2022 Nordic Semiconductor ASA
 *
 * SPDX-License-Identifier: Apache-2.0
 */

#include <zephyr/kernel.h>
#include <zephyr/types.h>
#include <stddef.h>
#include <errno.h>

#include <zephyr/bluetooth/bluetooth.h>
#include <zephyr/bluetooth/hci.h>
#include <zephyr/bluetooth/conn.h>
#include <zephyr/bluetooth/uuid.h>
#include <zephyr/bluetooth/gatt.h>

#include "babblekit/testcase.h"
#include "babblekit/flags.h"
#include "babblekit/sync.h"
#include "common.h"

DEFINE_FLAG_STATIC(flag_is_connected);
DEFINE_FLAG_STATIC(flag_discover_complete);
DEFINE_FLAG_STATIC(flag_write_complete);
DEFINE_FLAG_STATIC(flag_chan_1_read);
DEFINE_FLAG_STATIC(flag_chan_2_read);
DEFINE_FLAG_STATIC(flag_db_hash_read);
DEFINE_FLAG_STATIC(flag_encrypted);

static struct bt_conn *g_conn;
static uint16_t chrc_handle;
static uint16_t csf_handle;
static const struct bt_uuid *test_svc_uuid = TEST_SERVICE_UUID;

static void connected(struct bt_conn *conn, uint8_t err)
{
	if (err != 0) {
		TEST_FAIL("Failed to connect to %s (%u)", bt_conn_dst_str(conn), err);

		return;
	}

	printk("Connected to %s\n", bt_conn_dst_str(conn));

	SET_FLAG(flag_is_connected);
}

static void disconnected(struct bt_conn *conn, uint8_t reason)
{
	if (conn != g_conn) {
		return;
	}

	printk("Disconnected: %s (reason 0x%02x)\n", bt_conn_dst_str(conn), reason);

	bt_conn_drop(&g_conn);

	UNSET_FLAG(flag_is_connected);
}

void security_changed(struct bt_conn *conn, bt_security_t level, enum bt_security_err err)
{
	if (err != BT_SECURITY_ERR_SUCCESS) {
		TEST_FAIL("Encryption failed");
	} else if (level < BT_SECURITY_L2) {
		TEST_FAIL("Insufficient security");
	} else {
		SET_FLAG(flag_encrypted);
	}
}

BT_CONN_CB_DEFINE(conn_callbacks) = {
	.connected = connected,
	.disconnected = disconnected,
	.security_changed = security_changed,
};

void device_found(const bt_addr_le_t *addr, int8_t rssi, uint8_t type, struct net_buf_simple *ad)
{
	int err;

	if (g_conn != NULL) {
		return;
	}

	/* We're only interested in connectable events */
	if (type != BT_HCI_ADV_IND && type != BT_HCI_ADV_DIRECT_IND) {
		return;
	}

	printk("Device found: %s (RSSI %d)\n", bt_addr_le_str(addr), rssi);

	printk("Stopping scan\n");
	err = bt_le_scan_stop();
	if (err != 0) {
		TEST_FAIL("Could not stop scan (err %d)");

		return;
	}

	err = bt_conn_le_create(addr, BT_CONN_LE_CREATE_CONN, BT_LE_CONN_PARAM_DEFAULT, &g_conn);
	if (err != 0) {
		TEST_FAIL("Could not connect to peer (err %d)", err);
	}
}

static uint8_t discover_func(struct bt_conn *conn, const struct bt_gatt_attr *attr,
			     struct bt_gatt_discover_params *params)
{
	int err;

	if (attr == NULL) {
		if (chrc_handle == 0) {
			TEST_FAIL("Did not discover chrc (%x)", chrc_handle);
		}

		(void)memset(params, 0, sizeof(*params));

		SET_FLAG(flag_discover_complete);

		return BT_GATT_ITER_STOP;
	}

	printk("[ATTRIBUTE] handle %u\n", attr->handle);

	if (params->type == BT_GATT_DISCOVER_PRIMARY &&
	    bt_uuid_cmp(params->uuid, TEST_SERVICE_UUID) == 0) {
		printk("Found test service\n");
		params->uuid = NULL;
		params->start_handle = attr->handle + 1;
		params->type = BT_GATT_DISCOVER_CHARACTERISTIC;

		err = bt_gatt_discover(conn, params);
		if (err != 0) {
			TEST_FAIL("Discover failed (err %d)", err);
		}

		return BT_GATT_ITER_STOP;
	} else if (params->type == BT_GATT_DISCOVER_CHARACTERISTIC) {
		const struct bt_gatt_chrc *chrc = (struct bt_gatt_chrc *)attr->user_data;

		if (bt_uuid_cmp(chrc->uuid, TEST_CHRC_UUID) == 0) {
			printk("Found chrc\n");
			chrc_handle = chrc->value_handle;

		} else if (bt_uuid_cmp(chrc->uuid, BT_UUID_GATT_CLIENT_FEATURES) == 0) {
			printk("Found csf\n");
			csf_handle = chrc->value_handle;
		}
	}

	return BT_GATT_ITER_CONTINUE;
}

static void gatt_discover(const struct bt_uuid *uuid, uint8_t type)
{
	static struct bt_gatt_discover_params discover_params;
	int err;

	printk("Discovering services and characteristics\n");

	discover_params.uuid = uuid;
	discover_params.func = discover_func;
	discover_params.start_handle = BT_ATT_FIRST_ATTRIBUTE_HANDLE;
	discover_params.end_handle = BT_ATT_LAST_ATTRIBUTE_HANDLE;
	discover_params.type = type;
	discover_params.chan_opt = BT_ATT_CHAN_OPT_NONE;

	UNSET_FLAG(flag_discover_complete);

	err = bt_gatt_discover(g_conn, &discover_params);
	if (err != 0) {
		TEST_FAIL("Discover failed (err %d)", err);
	}

	WAIT_FOR_FLAG(flag_discover_complete);
	printk("Discover complete\n");
}
static struct bt_gatt_read_params chan_1_read = {
	.handle_count = 1,
	.single = {
		.handle = 0, /* Will be set later */
		.offset = 0,
	},
	.chan_opt = BT_ATT_CHAN_OPT_NONE,
};
static struct bt_gatt_read_params chan_2_read = {
	.handle_count = 1,
	.single = {
		.handle = 0, /* Will be set later */
		.offset = 0,
	},
	.chan_opt = BT_ATT_CHAN_OPT_NONE,
};
static struct bt_gatt_read_params db_hash_read = {
	.handle_count = 0,
	.by_uuid = {
		.start_handle = BT_ATT_FIRST_ATTRIBUTE_HANDLE,
		.end_handle = BT_ATT_LAST_ATTRIBUTE_HANDLE,
		.uuid = BT_UUID_GATT_DB_HASH,
	},
	.chan_opt = BT_ATT_CHAN_OPT_NONE,
};

static void expect_status(uint8_t err, uint8_t status)
{
	if (err != status) {
		TEST_FAIL("Unexpected status from read: 0x%02X, expected 0x%02X", err, status);
	}
}

static uint8_t gatt_read_expect_success_cb(struct bt_conn *conn, uint8_t err,
					   struct bt_gatt_read_params *params, const void *data,
					   uint16_t length)
{
	printk("GATT read cb: err 0x%02X\n", err);
	expect_status(err, BT_ATT_ERR_SUCCESS);

	if (params == &db_hash_read) {
		SET_FLAG(flag_db_hash_read);
	} else if (params == &chan_1_read) {
		SET_FLAG(flag_chan_1_read);
	} else if (params == &chan_2_read) {
		SET_FLAG(flag_chan_2_read);
	} else {
		TEST_FAIL("Unexpected params");
	}

	return 0;
}

static uint8_t gatt_read_expect_err_unlikely_cb(struct bt_conn *conn, uint8_t err,
						struct bt_gatt_read_params *params,
						const void *data, uint16_t length)
{
	printk("GATT read cb: err 0x%02X\n", err);
	expect_status(err, BT_ATT_ERR_UNLIKELY);

	if (params == &chan_1_read) {
		SET_FLAG(flag_chan_1_read);
	} else if (params == &chan_2_read) {
		SET_FLAG(flag_chan_2_read);
	} else {
		TEST_FAIL("Unexpected params");
	}

	return 0;
}

static uint8_t gatt_read_expect_err_out_of_sync_cb(struct bt_conn *conn, uint8_t err,
						   struct bt_gatt_read_params *params,
						   const void *data, uint16_t length)
{
	printk("GATT read cb: err 0x%02X\n", err);
	expect_status(err, BT_ATT_ERR_DB_OUT_OF_SYNC);

	if (params == &chan_1_read) {
		SET_FLAG(flag_chan_1_read);
	} else if (params == &chan_2_read) {
		SET_FLAG(flag_chan_2_read);
	} else {
		TEST_FAIL("Unexpected params");
	}

	return 0;
}

static void gatt_read(struct bt_gatt_read_params *read_params)
{
	int err;

	printk("Reading\n");

	err = bt_gatt_read(g_conn, read_params);
	if (err != 0) {
		TEST_FAIL("bt_gatt_read failed: %d", err);
	}
}

static void write_cb(struct bt_conn *conn, uint8_t err, struct bt_gatt_write_params *params)
{
	if (err != BT_ATT_ERR_SUCCESS) {
		TEST_FAIL("Write failed: 0x%02X", err);
	}

	SET_FLAG(flag_write_complete);
}

static void enable_robust_caching(void)
{
	/* Client Supported Features Characteristic Value
	 * Bit 0: Robust Caching
	 * Bit 1: EATT
	 */
	static const uint8_t csf[] = { BIT(0) | BIT(1) };
	static struct bt_gatt_write_params write_params = {
		.func = write_cb,
		.offset = 0,
		.data = csf,
		.length = sizeof(csf),
		.chan_opt = BT_ATT_CHAN_OPT_NONE,
	};
	int err;

	printk("Writing to Client Supported Features Characteristic\n");

	write_params.handle = csf_handle;
	UNSET_FLAG(flag_write_complete);

	err = bt_gatt_write(g_conn, &write_params);
	if (err) {
		TEST_FAIL("bt_gatt_write failed (err %d)", err);
	}

	WAIT_FOR_FLAG(flag_write_complete);
	printk("Success\n");
}

static void test_main_common(bool connect_eatt)
{
	int err;

	TEST_ASSERT(bk_sync_init() == 0, "Failed to open backchannel");

	err = bt_enable(NULL);
	if (err != 0) {
		TEST_FAIL("Bluetooth discover failed (err %d)", err);
	}

	err = bt_le_scan_start(BT_LE_SCAN_PASSIVE, device_found);
	if (err != 0) {
		TEST_FAIL("Scanning failed to start (err %d)", err);
	}

	printk("Scanning successfully started\n");

	WAIT_FOR_FLAG(flag_is_connected);

	err = bt_conn_set_security(g_conn, BT_SECURITY_L2);
	if (err) {
		TEST_FAIL("Failed to start encryption procedure");
	}

	WAIT_FOR_FLAG(flag_encrypted);

	gatt_discover(test_svc_uuid, BT_GATT_DISCOVER_PRIMARY);
	gatt_discover(BT_UUID_GATT_CLIENT_FEATURES, BT_GATT_DISCOVER_CHARACTERISTIC);

	enable_robust_caching();

	if (connect_eatt) {
		while (bt_eatt_count(g_conn) < 1) {
			/* Wait for EATT channel to connect, in case it hasn't already */
			k_sleep(K_MSEC(10));
		}
	}

	/* Tell the server to register additional service */
	bk_sync_send();

	/* Wait for new service to be added by server */
	bk_sync_wait();

	chan_1_read.single.handle = chrc_handle;
	chan_2_read.single.handle = chrc_handle;
}

static void test_main_db_hash_read_eatt(void)
{
	test_main_common(true);

	/* Read the DB hash to become change-aware */
	db_hash_read.func = gatt_read_expect_success_cb;
	gatt_read(&db_hash_read);
	WAIT_FOR_FLAG(flag_db_hash_read);

	/* These shall now succeed */
	chan_1_read.func = gatt_read_expect_success_cb;
	chan_2_read.func = gatt_read_expect_success_cb;
	UNSET_FLAG(flag_chan_1_read);
	UNSET_FLAG(flag_chan_2_read);
	gatt_read(&chan_1_read);
	gatt_read(&chan_2_read);
	WAIT_FOR_FLAG(flag_chan_1_read);
	WAIT_FOR_FLAG(flag_chan_2_read);

	/* Signal to server that reads are done */
	bk_sync_send();

	TEST_PASS("GATT client Passed");
}

static void test_main_out_of_sync_eatt(void)
{
	test_main_common(true);

	chan_1_read.func = gatt_read_expect_err_out_of_sync_cb;
	chan_2_read.func = gatt_read_expect_err_out_of_sync_cb;
	gatt_read(&chan_1_read);
	gatt_read(&chan_2_read);

	/* Wait until received response on both reads. When robust caching is implemented
	 * on the client side, the waiting shall be done automatically by the host when
	 * reading the DB hash.
	 */
	WAIT_FOR_FLAG(flag_chan_1_read);
	WAIT_FOR_FLAG(flag_chan_2_read);

	/* Read the DB hash to become change-aware */
	db_hash_read.func = gatt_read_expect_success_cb;
	gatt_read(&db_hash_read);
	WAIT_FOR_FLAG(flag_db_hash_read);

	/* These shall now succeed */
	chan_1_read.func = gatt_read_expect_success_cb;
	chan_2_read.func = gatt_read_expect_success_cb;
	UNSET_FLAG(flag_chan_1_read);
	UNSET_FLAG(flag_chan_2_read);
	gatt_read(&chan_1_read);
	gatt_read(&chan_2_read);
	WAIT_FOR_FLAG(flag_chan_1_read);
	WAIT_FOR_FLAG(flag_chan_2_read);

	/* Signal to server that reads are done */
	bk_sync_send();

	TEST_PASS("GATT client Passed");
}

static void test_main_retry_reads_eatt(void)
{
	test_main_common(true);

	chan_1_read.func = gatt_read_expect_err_out_of_sync_cb;
	chan_2_read.func = gatt_read_expect_err_out_of_sync_cb;
	gatt_read(&chan_1_read);
	gatt_read(&chan_2_read);

	/* Wait until received response on both reads. When robust caching is implemented
	 * on the client side, the waiting shall be done automatically by the host when
	 * reading the DB hash.
	 */
	WAIT_FOR_FLAG(flag_chan_1_read);
	WAIT_FOR_FLAG(flag_chan_2_read);

	/* Retry the reads, these shall time out */
	chan_1_read.func = gatt_read_expect_err_unlikely_cb;
	chan_2_read.func = gatt_read_expect_err_unlikely_cb;
	UNSET_FLAG(flag_chan_1_read);
	UNSET_FLAG(flag_chan_2_read);
	gatt_read(&chan_1_read);
	gatt_read(&chan_2_read);
	WAIT_FOR_FLAG(flag_chan_1_read);
	WAIT_FOR_FLAG(flag_chan_2_read);

	/* Signal to server that reads are done */
	bk_sync_send();

	TEST_PASS("GATT client Passed");
}

static void test_main_db_hash_read_no_eatt(void)
{
	test_main_common(false);

	/* Read the DB hash to become change-aware */
	db_hash_read.func = gatt_read_expect_success_cb;
	gatt_read(&db_hash_read);
	WAIT_FOR_FLAG(flag_db_hash_read);

	/* Read shall now succeed */
	chan_1_read.func = gatt_read_expect_success_cb;
	UNSET_FLAG(flag_chan_1_read);
	gatt_read(&chan_1_read);
	WAIT_FOR_FLAG(flag_chan_1_read);

	/* Signal to server that reads are done */
	bk_sync_send();

	TEST_PASS("GATT client Passed");
}

static void test_main_out_of_sync_no_eatt(void)
{
	test_main_common(false);

	chan_1_read.func = gatt_read_expect_err_out_of_sync_cb;
	gatt_read(&chan_1_read);
	WAIT_FOR_FLAG(flag_chan_1_read);

	/* Read the DB hash to become change-aware */
	db_hash_read.func = gatt_read_expect_success_cb;
	gatt_read(&db_hash_read);
	WAIT_FOR_FLAG(flag_db_hash_read);

	/* Read shall now succeed */
	chan_1_read.func = gatt_read_expect_success_cb;
	UNSET_FLAG(flag_chan_1_read);
	gatt_read(&chan_1_read);
	WAIT_FOR_FLAG(flag_chan_1_read);

	/* Signal to server that reads are done */
	bk_sync_send();

	TEST_PASS("GATT client Passed");
}

static void test_main_retry_reads_no_eatt(void)
{
	test_main_common(false);

	chan_1_read.func = gatt_read_expect_err_out_of_sync_cb;
	gatt_read(&chan_1_read);
	WAIT_FOR_FLAG(flag_chan_1_read);

	/* Read again to become change-aware */
	chan_1_read.func = gatt_read_expect_success_cb;
	UNSET_FLAG(flag_chan_1_read);
	gatt_read(&chan_1_read);
	WAIT_FOR_FLAG(flag_chan_1_read);

	/* Signal to server that reads are done */
	bk_sync_send();

	TEST_PASS("GATT client Passed");
}

static const struct bst_test_instance test_vcs[] = {
	{
		.test_id = "gatt_client_db_hash_read_eatt",
		.test_main_f = test_main_db_hash_read_eatt,
	},
	{
		.test_id = "gatt_client_out_of_sync_eatt",
		.test_main_f = test_main_out_of_sync_eatt,
	},
	{
		.test_id = "gatt_client_retry_reads_eatt",
		.test_main_f = test_main_retry_reads_eatt,
	},
	{
		.test_id = "gatt_client_db_hash_read_no_eatt",
		.test_main_f = test_main_db_hash_read_no_eatt,
	},
	{
		.test_id = "gatt_client_out_of_sync_no_eatt",
		.test_main_f = test_main_out_of_sync_no_eatt,
	},
	{
		.test_id = "gatt_client_retry_reads_no_eatt",
		.test_main_f = test_main_retry_reads_no_eatt,
	},
	BSTEST_END_MARKER,
};

struct bst_test_list *test_gatt_client_install(struct bst_test_list *tests)
{
	return bst_add_tests(tests, test_vcs);
}
```

## src/gatt_server_test.c
```c
/*
 * Copyright (c) 2022 Nordic Semiconductor ASA
 *
 * SPDX-License-Identifier: Apache-2.0
 */

#include <zephyr/kernel.h>
#include <zephyr/types.h>
#include <stddef.h>
#include <errno.h>

#include <zephyr/bluetooth/bluetooth.h>
#include <zephyr/bluetooth/hci.h>
#include <zephyr/bluetooth/conn.h>
#include <zephyr/bluetooth/uuid.h>
#include <zephyr/bluetooth/gatt.h>

#include "babblekit/testcase.h"
#include "babblekit/flags.h"
#include "babblekit/sync.h"
#include "common.h"

extern enum bst_result_t bst_result;

DEFINE_FLAG_STATIC(flag_is_connected);
DEFINE_FLAG_STATIC(flag_is_encrypted);

static struct bt_conn *g_conn;

static void connected(struct bt_conn *conn, uint8_t err)
{
	if (err != 0) {
		TEST_FAIL("Failed to connect to %s (%u)", bt_conn_dst_str(conn), err);

		return;
	}

	printk("Connected to %s\n", bt_conn_dst_str(conn));

	g_conn = bt_conn_ref(conn);
	SET_FLAG(flag_is_connected);
}

static void disconnected(struct bt_conn *conn, uint8_t reason)
{
	if (conn != g_conn) {
		return;
	}

	printk("Disconnected: %s (reason 0x%02x)\n", bt_conn_dst_str(conn), reason);

	bt_conn_drop(&g_conn);

	UNSET_FLAG(flag_is_connected);
}

static void security_changed(struct bt_conn *conn, bt_security_t level,
			     enum bt_security_err security_err)
{
	if (security_err == BT_SECURITY_ERR_SUCCESS && level > BT_SECURITY_L1) {
		SET_FLAG(flag_is_encrypted);
	}
}

BT_CONN_CB_DEFINE(conn_callbacks) = {
	.connected = connected,
	.disconnected = disconnected,
	.security_changed = security_changed,
};

#define CHRC_SIZE 10
#define ARRAY_ITEM(i, _) i
static const uint8_t chrc_data[] = { LISTIFY(CHRC_SIZE, ARRAY_ITEM, (,)) }; /* 1, 2, 3 ... */

static ssize_t read_test_chrc(struct bt_conn *conn, const struct bt_gatt_attr *attr, void *buf,
			      uint16_t len, uint16_t offset)
{
	printk("Characteristic read\n");

	return bt_gatt_attr_read(conn, attr, buf, len, offset, (const void *)chrc_data, CHRC_SIZE);
}

BT_GATT_SERVICE_DEFINE(test_svc, BT_GATT_PRIMARY_SERVICE(TEST_SERVICE_UUID),
		       BT_GATT_CHARACTERISTIC(TEST_CHRC_UUID, BT_GATT_CHRC_READ, BT_GATT_PERM_READ,
					      read_test_chrc, NULL, NULL));

static struct bt_gatt_attr additional_attributes[] = {
	BT_GATT_CHARACTERISTIC(TEST_ADDITIONAL_CHRC_UUID, 0, BT_GATT_PERM_NONE, NULL, NULL, NULL),
};

static struct bt_gatt_service additional_gatt_service = BT_GATT_SERVICE(additional_attributes);

static void test_main_common(bool connect_eatt)
{
	int err;
	const struct bt_data ad[] = { BT_DATA_BYTES(BT_DATA_FLAGS,
						    (BT_LE_AD_GENERAL | BT_LE_AD_NO_BREDR)) };

	TEST_ASSERT(bk_sync_init() == 0, "Failed to open backchannel");

	err = bt_enable(NULL);
	if (err != 0) {
		TEST_FAIL("Bluetooth init failed (err %d)", err);

		return;
	}

	printk("Bluetooth initialized\n");

	err = bt_le_adv_start(BT_LE_ADV_CONN_FAST_1, ad, ARRAY_SIZE(ad), NULL, 0);
	if (err != 0) {
		TEST_FAIL("Advertising failed to start (err %d)", err);

		return;
	}

	printk("Advertising successfully started\n");

	WAIT_FOR_FLAG(flag_is_connected);

	if (connect_eatt) {
		WAIT_FOR_FLAG(flag_is_encrypted);

		err = bt_eatt_connect(g_conn, CONFIG_BT_EATT_MAX);
		if (err) {
			TEST_FAIL("Failed to connect EATT channels (err %d)", err);

			return;
		}
	}

	/* Wait for client to do discovery and configuration */
	bk_sync_wait();

	printk("Registering additional service\n");
	err = bt_gatt_service_register(&additional_gatt_service);
	if (err < 0) {
		TEST_FAIL("Registering additional service failed (err %d)", err);
	}

	/* Signal to client that additional service is registered */
	bk_sync_send();

	/* Wait for client to be done reading */
	bk_sync_wait();

	TEST_PASS("GATT server passed");
}

static void test_main_eatt(void)
{
	test_main_common(true);
}

static void test_main_no_eatt(void)
{
	test_main_common(false);
}

static const struct bst_test_instance test_gatt_server[] = {
	{
		.test_id = "gatt_server_eatt",
		.test_main_f = test_main_eatt,
	},
	{
		.test_id = "gatt_server_no_eatt",
		.test_main_f = test_main_no_eatt,
	},
	BSTEST_END_MARKER,
};

struct bst_test_list *test_gatt_server_install(struct bst_test_list *tests)
{
	return bst_add_tests(tests, test_gatt_server);
}
```
