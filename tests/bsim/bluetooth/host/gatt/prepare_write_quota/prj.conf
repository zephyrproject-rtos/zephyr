## CMakeLists.txt
```
# Copyright (c) 2026 Silicon Laboratories Inc.
# SPDX-License-Identifier: Apache-2.0

cmake_minimum_required(VERSION 3.28.0)

find_package(Zephyr REQUIRED HINTS $ENV{ZEPHYR_BASE})

project(prepare_write_quota)

add_subdirectory(${ZEPHYR_BASE}/tests/bluetooth/common/testlib testlib)
target_link_libraries(app PRIVATE testlib)

add_subdirectory(${ZEPHYR_BASE}/tests/bsim/babblekit babblekit)
target_link_libraries(app PRIVATE babblekit)

zephyr_include_directories(
  ${BSIM_COMPONENTS_PATH}/libUtilv1/src/
  ${BSIM_COMPONENTS_PATH}/libPhyComv1/src/
)

target_sources(app PRIVATE
  src/main.c
  src/server.c
  src/central.c
  src/kept_conn.c
)
```

## prj.conf
```kconfig
CONFIG_BT=y
CONFIG_BT_CENTRAL=y
CONFIG_BT_PERIPHERAL=y
CONFIG_BT_GATT_CLIENT=y

# Dependency of testlib/adv and testlib/scan.
CONFIG_BT_EXT_ADV=y

# The server takes two clients, and the shared prepare write pool gives each
# of them CONFIG_BT_ATT_PREPARE_COUNT / CONFIG_BT_MAX_CONN buffers, unless an
# overlay sets CONFIG_BT_ATT_PREPARE_COUNT_PER_CONN.
CONFIG_BT_MAX_CONN=2
CONFIG_BT_ATT_PREPARE_COUNT=6

CONFIG_LOG=y
CONFIG_ASSERT=y
```

## overlay-oversubscribed.conf
```kconfig
# Let one connection hold more than its equal share of the six buffers, so
# that the other connection can be left with fewer than its long write needs.
CONFIG_BT_ATT_PREPARE_COUNT_PER_CONN=4
```

## src/main.c
```c
/*
 * Copyright (c) 2026 Silicon Laboratories Inc.
 *
 * SPDX-License-Identifier: Apache-2.0
 */

#include <zephyr/kernel.h>

#include "bs_tracing.h"
#include "bstests.h"
#include "babblekit/testcase.h"

#include "common.h"

extern enum bst_result_t bst_result;

static void test_end_cb(void)
{
	if (bst_result != Passed) {
		TEST_PRINT("Test has not passed.");
	}
}

static const struct bst_test_instance entrypoints[] = {
	{
		.test_id = "server",
		.test_delete_f = test_end_cb,
		.test_main_f = server_procedure,
	},
	{
		.test_id = "holder",
		.test_delete_f = test_end_cb,
		.test_main_f = holder_procedure,
	},
	{
		.test_id = "writer",
		.test_delete_f = test_end_cb,
		.test_main_f = writer_procedure,
	},
	{
		.test_id = "kept_conn_dut",
		.test_delete_f = test_end_cb,
		.test_main_f = kept_conn_dut_procedure,
	},
	{
		.test_id = "kept_conn_peer",
		.test_delete_f = test_end_cb,
		.test_main_f = kept_conn_peer_procedure,
	},
	BSTEST_END_MARKER,
};

static struct bst_test_list *install(struct bst_test_list *tests)
{
	return bst_add_tests(tests, entrypoints);
}

bst_test_install_t test_installers[] = { install, NULL };

int main(void)
{
	bst_main();

	return 0;
}
```

## src/central.c
```c
/*
 * Copyright (c) 2026 Silicon Laboratories Inc.
 *
 * SPDX-License-Identifier: Apache-2.0
 */

#include <stdbool.h>
#include <string.h>

#include <zephyr/bluetooth/att.h>
#include <zephyr/bluetooth/bluetooth.h>
#include <zephyr/bluetooth/conn.h>
#include <zephyr/bluetooth/gatt.h>
#include <zephyr/bluetooth/hci.h>
#include <zephyr/kernel.h>
#include <zephyr/logging/log.h>
#include <zephyr/net_buf.h>
#include <zephyr/sys/byteorder.h>

#include "babblekit/flags.h"
#include "babblekit/sync.h"
#include "babblekit/testcase.h"
#include "testlib/att_read.h"
#include "testlib/att_write.h"
#include "testlib/conn.h"
#include "testlib/scan.h"

#include "common.h"

LOG_MODULE_REGISTER(central, LOG_LEVEL_INF);

DEFINE_FLAG_STATIC(flag_rsp);

static struct bt_conn *conn;
static int rsp_err;
static bool disconnect_expected;

static void disconnected(struct bt_conn *c, uint8_t reason)
{
	/* An unexpected disconnect would release the prepare writes queued on the server */
	if (!disconnect_expected) {
		TEST_FAIL("Disconnected from %s (reason 0x%02x)", conn_dst_str(c), reason);
	}
}

static struct bt_conn_cb conn_cb = {
	.disconnected = disconnected,
};

static uint16_t connect_and_find_chrc(void)
{
	bt_addr_le_t server = {};
	uint16_t svc_handle, svc_end_handle, chrc_handle, chrc_end_handle;
	int err;

	err = bt_conn_cb_register(&conn_cb);
	TEST_ASSERT(err == 0, "Failed to register connection callbacks (err %d)", err);

	err = bt_testlib_scan_find_name(&server, SERVER_NAME);
	TEST_ASSERT(err == 0, "Server not found (err %d)", err);

	err = bt_testlib_connect(&server, &conn);
	TEST_ASSERT(err == 0, "Connection failed (err %d)", err);

	err = bt_testlib_gatt_discover_primary(&svc_handle, &svc_end_handle, conn,
					       TEST_SERVICE_UUID, BT_ATT_FIRST_ATTRIBUTE_HANDLE,
					       BT_ATT_LAST_ATTRIBUTE_HANDLE);
	TEST_ASSERT(err == 0, "Service discovery failed (err %d)", err);

	err = bt_testlib_gatt_discover_characteristic(&chrc_handle, &chrc_end_handle, NULL, conn,
						      TEST_CHRC_UUID, svc_handle + 1,
						      svc_end_handle);
	TEST_ASSERT(err == 0, "Characteristic discovery failed (err %d)", err);

	LOG_INF("Connected to %s, characteristic value handle 0x%04x", conn_dst_str(conn),
		chrc_handle);

	return chrc_handle;
}

struct prep_write {
	uint16_t handle;
	uint16_t offset;
	const uint8_t *value;
	uint16_t len;
};

static void prep_write_rsp(struct bt_conn *c, int err, const void *pdu, uint16_t length,
			   void *user_data)
{
	const struct prep_write *pw = user_data;
	const struct bt_att_prepare_write_rsp *rsp = pdu;

	ARG_UNUSED(c);

	if (err == 0) {
		TEST_ASSERT(length == sizeof(*rsp) + pw->len, "Unexpected response length %u",
			    length);
		TEST_ASSERT(sys_le16_to_cpu(rsp->handle) == pw->handle,
			    "Response handle 0x%04x differs from the request",
			    sys_le16_to_cpu(rsp->handle));
		TEST_ASSERT(sys_le16_to_cpu(rsp->offset) == pw->offset,
			    "Response offset %u differs from the request",
			    sys_le16_to_cpu(rsp->offset));
		TEST_ASSERT(memcmp(rsp->value, pw->value, pw->len) == 0,
			    "Response value differs from the request");
	}

	rsp_err = err;
	SET_FLAG(flag_rsp);
}

/* Send one Prepare Write Request and return the ATT error code of the
 * response. Unlike bt_gatt_write(), this never follows up with an Execute
 * Write Request, so the server keeps what it accepted queued.
 */
static int prepare_write(struct prep_write *pw)
{
	struct bt_att_prepare_write_req *req_pdu;
	struct bt_att_req *req;
	int err;

	req = bt_att_req_alloc(BT_ATT_TIMEOUT);
	TEST_ASSERT(req != NULL, "Failed to allocate ATT request");

	req->func = prep_write_rsp;
	req->user_data = pw;

	req->buf = bt_att_create_pdu(conn, BT_ATT_OP_PREPARE_WRITE_REQ, sizeof(*req_pdu) + pw->len);
	TEST_ASSERT(req->buf != NULL, "Failed to allocate ATT PDU");
	bt_att_set_tx_meta_data(req->buf, NULL, NULL, BT_ATT_CHAN_OPT_UNENHANCED_ONLY);

	req_pdu = net_buf_add(req->buf, sizeof(*req_pdu));
	req_pdu->handle = sys_cpu_to_le16(pw->handle);
	req_pdu->offset = sys_cpu_to_le16(pw->offset);
	(void)net_buf_add_mem(req->buf, pw->value, pw->len);

	UNSET_FLAG(flag_rsp);

	err = bt_att_req_send(conn, req);
	TEST_ASSERT(err == 0, "Failed to send Prepare Write Request (err %d)", err);

	WAIT_FOR_FLAG(flag_rsp);

	return rsp_err;
}

void holder_procedure(void)
{
	static uint8_t chunk[PREP_CHUNK_SIZE];
	struct prep_write pw = { .value = chunk, .len = sizeof(chunk) };
	unsigned int accepted;
	int err;

	TEST_START("holder");

	err = bk_sync_init();
	TEST_ASSERT(err == 0, "Sync init failed");

	err = bt_enable(NULL);
	TEST_ASSERT(err == 0, "bt_enable failed (err %d)", err);

	pw.handle = connect_and_find_chrc();
	(void)memset(chunk, HOLDER_FILL, sizeof(chunk));

	/* Queue prepare writes until the server rejects one, then leave them
	 * queued: nothing below executes or cancels them.
	 */
	for (accepted = 0; accepted <= CONFIG_BT_ATT_PREPARE_COUNT; accepted++) {
		pw.offset = (uint16_t)(accepted * PREP_CHUNK_SIZE);

		err = prepare_write(&pw);
		if (err != 0) {
			break;
		}
	}

	TEST_ASSERT(err == BT_ATT_ERR_PREPARE_QUEUE_FULL,
		    "Expected Prepare Queue Full after %u accepted prepare writes, got 0x%02x",
		    accepted, err);
	TEST_ASSERT(accepted == PREP_QUOTA,
		    "Server queued %u prepare writes for one connection, expected %d", accepted,
		    PREP_QUOTA);

	LOG_INF("Holding %u queued prepare writes", accepted);

	/* Let the writer go, and stay connected until it is done */
	bk_sync_send();
	bk_sync_wait();

	TEST_PASS("holder");
}

void writer_procedure(void)
{
	static uint8_t value[CHRC_SIZE];
	uint16_t handle;
	int err;

	TEST_START("writer");

	err = bk_sync_init();
	TEST_ASSERT(err == 0, "Sync init failed");

	err = bt_enable(NULL);
	TEST_ASSERT(err == 0, "bt_enable failed (err %d)", err);

	/* Wait for the holder to fill its share of the server's prepare write pool */
	bk_sync_wait();

	handle = connect_and_find_chrc();
	writer_value_fill(value, sizeof(value));

	/* CHRC_SIZE octets do not fit in one Write Request at the default ATT
	 * MTU, so this becomes WRITER_PREPARES Prepare Write Requests followed
	 * by an Execute Write Request.
	 */
	err = bt_testlib_att_write(conn, BT_ATT_CHAN_OPT_UNENHANCED_ONLY, handle, value,
				   sizeof(value));
	if (WRITER_EXPECT_SUCCESS) {
		TEST_ASSERT(err == BT_ATT_ERR_SUCCESS, "Long write failed with ATT error 0x%02x",
			    err);
		LOG_INF("Long write of %zu octets succeeded", sizeof(value));
	} else {
		TEST_ASSERT(err == BT_ATT_ERR_PREPARE_QUEUE_FULL,
			    "Expected Prepare Queue Full, got ATT error 0x%02x", err);
		LOG_INF("Long write rejected with Prepare Queue Full, as expected");
	}

	/* Disconnecting tells the server that the write attempt is over */
	disconnect_expected = true;
	err = bt_testlib_disconnect(&conn, BT_HCI_ERR_REMOTE_USER_TERM_CONN);
	TEST_ASSERT(err == 0, "Disconnect failed (err %d)", err);

	/* Release the holder */
	bk_sync_send();

	TEST_PASS("writer");
}
```

## src/common.h
```c
/*
 * Copyright (c) 2026 Silicon Laboratories Inc.
 *
 * SPDX-License-Identifier: Apache-2.0
 */

#ifndef ZEPHYR_TESTS_BSIM_BLUETOOTH_HOST_GATT_PREPARE_WRITE_QUOTA_SRC_COMMON_H_
#define ZEPHYR_TESTS_BSIM_BLUETOOTH_HOST_GATT_PREPARE_WRITE_QUOTA_SRC_COMMON_H_

#include <stddef.h>
#include <stdint.h>

#include <zephyr/bluetooth/uuid.h>

#include "host/att_internal.h"

#define SERVER_NAME "prepare write quota"

#define TEST_SERVICE_UUID                                                                          \
	BT_UUID_DECLARE_128(0x6b, 0x4d, 0x0e, 0x2a, 0x9a, 0x07, 0x4c, 0x1e, 0x93, 0x52, 0x1b,      \
			    0x2f, 0xd7, 0x81, 0x00, 0x00)
#define TEST_CHRC_UUID                                                                             \
	BT_UUID_DECLARE_128(0x6b, 0x4d, 0x0e, 0x2a, 0x9a, 0x07, 0x4c, 0x1e, 0x93, 0x52, 0x1b,      \
			    0x2f, 0xd7, 0x81, 0x00, 0x01)

/* Prepare write buffers the server lets one connection hold: the explicit
 * CONFIG_BT_ATT_PREPARE_COUNT_PER_CONN, or else the equal share of the pool.
 */
#if CONFIG_BT_ATT_PREPARE_COUNT_PER_CONN > 0
#define PREP_QUOTA CONFIG_BT_ATT_PREPARE_COUNT_PER_CONN
#else
#define PREP_QUOTA (CONFIG_BT_ATT_PREPARE_COUNT / CONFIG_BT_MAX_CONN)
#endif

/* Prepare Write Requests the writer's long write takes: an equal share of the pool */
#define WRITER_PREPARES (CONFIG_BT_ATT_PREPARE_COUNT / CONFIG_BT_MAX_CONN)

/* Whether the writer's long write must succeed: only if what the holder may
 * leave in the pool covers it, which the default limit guarantees and an
 * over-subscribed configuration does not.
 */
#define WRITER_EXPECT_SUCCESS ((CONFIG_BT_ATT_PREPARE_COUNT - PREP_QUOTA) >= WRITER_PREPARES)

/* Value octets carried by one Prepare Write Request at the default ATT MTU,
 * which both clients keep since neither of them exchanges the MTU.
 */
#define PREP_CHUNK_SIZE (BT_ATT_DEFAULT_LE_MTU - sizeof(struct bt_att_prepare_write_req) - 1)

/* Characteristic value size: a long write of it takes WRITER_PREPARES buffers. */
#define CHRC_SIZE (WRITER_PREPARES * PREP_CHUNK_SIZE)

/* Octet the holder's prepare writes are filled with, unlike the writer's value */
#define HOLDER_FILL 0xffU

/* The value the writer writes and the server expects: 1, 2, 3, ... */
static inline void writer_value_fill(uint8_t *value, size_t len)
{
	for (size_t i = 0; i < len; i++) {
		value[i] = (uint8_t)(i + 1U);
	}
}

void server_procedure(void);
void holder_procedure(void);
void writer_procedure(void);
void kept_conn_dut_procedure(void);
void kept_conn_peer_procedure(void);

#endif /* ZEPHYR_TESTS_BSIM_BLUETOOTH_HOST_GATT_PREPARE_WRITE_QUOTA_SRC_COMMON_H_ */
```

## src/kept_conn.c
```c
/*
 * SPDX-FileCopyrightText: Copyright (c) 2026 Silicon Laboratories Inc.
 * SPDX-License-Identifier: Apache-2.0
 */

#include <errno.h>
#include <stdint.h>

#include <zephyr/bluetooth/addr.h>
#include <zephyr/bluetooth/bluetooth.h>
#include <zephyr/bluetooth/conn.h>
#include <zephyr/bluetooth/gatt.h>
#include <zephyr/bluetooth/hci_types.h>
#include <zephyr/kernel.h>
#include <zephyr/sys/util.h>

#include "babblekit/sync.h"
#include "babblekit/testcase.h"
#include "testlib/adv.h"
#include "testlib/conn.h"
#include "testlib/scan.h"

#include "common.h"

#define DUT_NAME "kept conn"

/* Several connection events: a notification or a disconnection has arrived by then */
#define RX_TIMEOUT K_SECONDS(1)

#define KEPT_CONN_SERVICE_UUID                                                                     \
	BT_UUID_DECLARE_128(0x6b, 0x4d, 0x0e, 0x2a, 0x9a, 0x07, 0x4c, 0x1e, 0x93, 0x52, 0x1b,      \
			    0x2f, 0xd7, 0x81, 0x01, 0x00)
#define KEPT_CONN_CHRC_UUID                                                                        \
	BT_UUID_DECLARE_128(0x6b, 0x4d, 0x0e, 0x2a, 0x9a, 0x07, 0x4c, 0x1e, 0x93, 0x52, 0x1b,      \
			    0x2f, 0xd7, 0x81, 0x01, 0x01)

BT_GATT_SERVICE_DEFINE(kept_conn_svc,
	BT_GATT_PRIMARY_SERVICE(KEPT_CONN_SERVICE_UUID),
	BT_GATT_CHARACTERISTIC(KEPT_CONN_CHRC_UUID, BT_GATT_CHRC_NOTIFY, BT_GATT_PERM_NONE,
			       NULL, NULL, NULL),
	BT_GATT_CCC(NULL, BT_GATT_PERM_READ | BT_GATT_PERM_WRITE),
);

#define CHRC_VALUE_ATTR (&kept_conn_svc.attrs[2])

static K_SEM_DEFINE(connected_sem, 0, 1);
static K_SEM_DEFINE(disconnected_sem, 0, 1);
static K_SEM_DEFINE(subscribed_sem, 0, 1);
static K_SEM_DEFINE(notified_sem, 0, 1);

static void connected(struct bt_conn *conn, uint8_t err)
{
	ARG_UNUSED(conn);

	if (err == BT_HCI_ERR_SUCCESS) {
		k_sem_give(&connected_sem);
	}
}

static void disconnected(struct bt_conn *conn, uint8_t reason)
{
	ARG_UNUSED(conn);
	ARG_UNUSED(reason);

	k_sem_give(&disconnected_sem);
}

static void test_setup(void)
{
	static struct bt_conn_cb conn_cb = {
		.connected = connected,
		.disconnected = disconnected,
	};
	int err;

	err = bk_sync_init();
	TEST_ASSERT(err == 0, "Failed to open the backchannel (err %d)", err);

	err = bt_conn_cb_register(&conn_cb);
	TEST_ASSERT(err == 0, "Failed to register connection callbacks (err %d)", err);

	err = bt_enable(NULL);
	TEST_ASSERT(err == 0, "bt_enable failed (err %d)", err);
}

static void check_lookup(const bt_addr_le_t *peer, const struct bt_conn *expected)
{
	struct bt_conn *found = bt_conn_lookup_addr_le(BT_ID_DEFAULT, peer);

	TEST_ASSERT(found == expected, "Lookup found conn %d, expected conn %d",
		    found != NULL ? bt_conn_index(found) : -1, bt_conn_index(expected));

	bt_conn_unref(found);
}

static void notify_peer(void)
{
	const uint8_t value = 0U;
	int err;

	err = bt_gatt_notify(NULL, CHRC_VALUE_ATTR, &value, sizeof(value));
	TEST_ASSERT(err == 0, "Notifying the connected peer failed (err %d)", err);

	/* The peer has received it */
	bk_sync_wait();
}

static void dut_peer_reconnects(const bt_addr_le_t *peer, const struct bt_conn *kept)
{
	struct bt_conn *other = NULL;
	struct bt_conn *live = NULL;
	int err;

	bt_testlib_conn_wait_free();

	err = bt_testlib_adv_conn(&live, BT_ID_DEFAULT, DUT_NAME);
	TEST_ASSERT(err == 0, "Advertising failed (err %d)", err);
	TEST_ASSERT(live != kept, "The new connection took the kept object");

	/* The peer has subscribed */
	bk_sync_wait();

	notify_peer();
	check_lookup(peer, live);

	k_sem_reset(&disconnected_sem);

	err = bt_unpair(BT_ID_DEFAULT, peer);
	TEST_ASSERT(err == 0, "bt_unpair failed (err %d)", err);

	err = k_sem_take(&disconnected_sem, RX_TIMEOUT);
	TEST_ASSERT(err == 0, "bt_unpair left the connection up");

	check_lookup(peer, kept);

	/* Both objects are still referenced, so there is none for another connection */
	err = bt_conn_le_create(peer, BT_CONN_LE_CREATE_CONN, BT_LE_CONN_PARAM_DEFAULT, &other);
	TEST_ASSERT(err == -ENOMEM, "Connecting without a free object gave err %d", err);

	bt_conn_drop(&live);
}

static void dut_connects(const bt_addr_le_t *peer, const struct bt_conn *kept)
{
	struct bt_conn *live = NULL;
	int err;

	bt_testlib_conn_wait_free();

	err = bt_testlib_connect(peer, &live);
	TEST_ASSERT(err == 0, "Connecting failed with the old object kept (err %d)", err);
	TEST_ASSERT(live != kept, "The new connection took the kept object");

	err = bt_testlib_wait_disconnected(live);
	TEST_ASSERT(err == 0, "Waiting for the disconnection failed (err %d)", err);

	bt_conn_drop(&live);
}

static void dut_advertises_directed(const bt_addr_le_t *peer, const struct bt_conn *kept)
{
	struct bt_conn *live;
	int err;

	bt_testlib_conn_wait_free();

	k_sem_reset(&connected_sem);

	err = bt_le_adv_start(BT_LE_ADV_CONN_DIR_LOW_DUTY(peer), NULL, 0, NULL, 0);
	TEST_ASSERT(err == 0, "Directed advertising failed with the old object kept (err %d)", err);

	err = k_sem_take(&connected_sem, K_FOREVER);
	TEST_ASSERT(err == 0, "Waiting for the connection failed (err %d)", err);

	live = bt_conn_lookup_addr_le(BT_ID_DEFAULT, peer);
	TEST_ASSERT(live != NULL && live != kept, "The connection is not found");

	err = bt_testlib_wait_disconnected(live);
	TEST_ASSERT(err == 0, "Waiting for the disconnection failed (err %d)", err);

	bt_conn_drop(&live);
}

/* The peer connects while an outgoing attempt to it is in progress */
static void dut_crossing_connection(const bt_addr_le_t *peer)
{
	struct bt_conn *initiating = NULL;
	struct bt_conn *live = NULL;
	int err;

	bt_testlib_conn_wait_free();

	err = bt_conn_le_create(peer, BT_CONN_LE_CREATE_CONN, BT_LE_CONN_PARAM_DEFAULT,
				&initiating);
	TEST_ASSERT(err == 0, "Starting the initiator failed (err %d)", err);

	bt_testlib_conn_wait_free();

	err = bt_testlib_adv_conn(&live, BT_ID_DEFAULT, DUT_NAME);
	TEST_ASSERT(err == 0, "Advertising failed (err %d)", err);

	/* The peer has subscribed */
	bk_sync_wait();

	notify_peer();
	check_lookup(peer, live);

	err = bt_conn_disconnect(initiating, BT_HCI_ERR_REMOTE_USER_TERM_CONN);
	TEST_ASSERT(err == 0, "Canceling the initiator failed (err %d)", err);

	err = bt_testlib_wait_disconnected(initiating);
	TEST_ASSERT(err == 0, "Waiting for the cancellation failed (err %d)", err);

	bt_conn_drop(&initiating);
	bt_conn_drop(&live);
}

void kept_conn_dut_procedure(void)
{
	struct bt_conn *kept = NULL;
	bt_addr_le_t peer;
	int err;

	TEST_START("kept_conn_dut");

	test_setup();

	err = bt_testlib_adv_conn(&kept, BT_ID_DEFAULT, DUT_NAME);
	TEST_ASSERT(err == 0, "Advertising failed (err %d)", err);

	bt_addr_le_copy(&peer, bt_conn_get_dst(kept));

	err = bt_testlib_wait_disconnected(kept);
	TEST_ASSERT(err == 0, "Waiting for the disconnection failed (err %d)", err);

	check_lookup(&peer, kept);

	dut_peer_reconnects(&peer, kept);
	dut_connects(&peer, kept);
	dut_advertises_directed(&peer, kept);

	bt_conn_drop(&kept);

	dut_crossing_connection(&peer);

	/* The peer ends the simulation once it has been told the DUT is done */
	TEST_PASS("kept_conn_dut");

	bk_sync_send();
}

static void subscribed(struct bt_conn *conn, uint8_t err, struct bt_gatt_subscribe_params *params)
{
	ARG_UNUSED(conn);
	ARG_UNUSED(params);

	TEST_ASSERT(err == 0, "Subscribing failed (ATT err 0x%02x)", err);

	k_sem_give(&subscribed_sem);
}

static uint8_t notified(struct bt_conn *conn, struct bt_gatt_subscribe_params *params,
			const void *data, uint16_t length)
{
	ARG_UNUSED(conn);
	ARG_UNUSED(params);
	ARG_UNUSED(length);

	if (data != NULL) {
		k_sem_give(&notified_sem);
	}

	return BT_GATT_ITER_CONTINUE;
}

static void peer_connect_and_subscribe(struct bt_conn **conn, bt_addr_le_t *dut)
{
	static struct bt_gatt_subscribe_params params;
	int err;

	err = bt_testlib_scan_find_name(dut, DUT_NAME);
	TEST_ASSERT(err == 0, "The DUT was not found (err %d)", err);

	err = bt_testlib_connect(dut, conn);
	TEST_ASSERT(err == 0, "Connecting failed (err %d)", err);

	/* Both devices run this image, so the handles on the DUT are the same as here */
	params = (struct bt_gatt_subscribe_params){
		.notify = notified,
		.subscribe = subscribed,
		.value = BT_GATT_CCC_NOTIFY,
		.value_handle = bt_gatt_attr_get_handle(CHRC_VALUE_ATTR),
		.ccc_handle = bt_gatt_attr_get_handle(CHRC_VALUE_ATTR) + 1U,
	};

	err = bt_gatt_subscribe(*conn, &params);
	TEST_ASSERT(err == 0, "Subscribing failed (err %d)", err);

	err = k_sem_take(&subscribed_sem, K_FOREVER);
	TEST_ASSERT(err == 0, "Waiting for the subscription failed (err %d)", err);

	bk_sync_send();
}

static void peer_receive_notification(void)
{
	int err;

	err = k_sem_take(&notified_sem, RX_TIMEOUT);
	TEST_ASSERT(err == 0, "No notification received");

	bk_sync_send();
}

static void peer_disconnect(struct bt_conn **conn)
{
	int err;

	err = bt_testlib_disconnect(conn, BT_HCI_ERR_REMOTE_USER_TERM_CONN);
	TEST_ASSERT(err == 0, "Disconnecting failed (err %d)", err);
}

void kept_conn_peer_procedure(void)
{
	struct bt_conn *conn = NULL;
	bt_addr_le_t dut;
	int err;

	TEST_START("kept_conn_peer");

	test_setup();

	/* The DUT keeps its reference to this connection */
	err = bt_testlib_scan_find_name(&dut, DUT_NAME);
	TEST_ASSERT(err == 0, "The DUT was not found (err %d)", err);

	err = bt_testlib_connect(&dut, &conn);
	TEST_ASSERT(err == 0, "Connecting failed (err %d)", err);

	peer_disconnect(&conn);

	k_sem_reset(&disconnected_sem);

	/* dut_peer_reconnects() */
	peer_connect_and_subscribe(&conn, &dut);
	peer_receive_notification();

	err = k_sem_take(&disconnected_sem, RX_TIMEOUT);
	TEST_ASSERT(err == 0, "The DUT's bt_unpair left the connection up");

	bt_conn_drop(&conn);

	/* dut_connects() */
	err = bt_testlib_adv_conn(&conn, BT_ID_DEFAULT, NULL);
	TEST_ASSERT(err == 0, "Advertising failed (err %d)", err);

	peer_disconnect(&conn);

	/* dut_advertises_directed() */
	err = bt_testlib_connect(&dut, &conn);
	TEST_ASSERT(err == 0, "Connecting failed (err %d)", err);

	peer_disconnect(&conn);

	/* dut_crossing_connection() */
	peer_connect_and_subscribe(&conn, &dut);
	peer_receive_notification();

	bk_sync_wait();

	TEST_PASS_AND_EXIT("kept_conn_peer");
}
```

## src/server.c
```c
/*
 * Copyright (c) 2026 Silicon Laboratories Inc.
 *
 * SPDX-License-Identifier: Apache-2.0
 */

#include <string.h>

#include <zephyr/bluetooth/bluetooth.h>
#include <zephyr/bluetooth/conn.h>
#include <zephyr/bluetooth/gatt.h>
#include <zephyr/kernel.h>
#include <zephyr/logging/log.h>
#include <zephyr/sys/util.h>

#include "babblekit/flags.h"
#include "babblekit/testcase.h"
#include "testlib/adv.h"
#include "testlib/conn.h"

#include "common.h"

LOG_MODULE_REGISTER(server, LOG_LEVEL_INF);

DEFINE_FLAG_STATIC(flag_written);

static uint8_t chrc_value[CHRC_SIZE];

static ssize_t write_chrc(struct bt_conn *conn, const struct bt_gatt_attr *attr, const void *buf,
			  uint16_t len, uint16_t offset, uint8_t flags)
{
	ARG_UNUSED(attr);

	LOG_INF("Write from %s: len %u offset %u flags 0x%02x", bt_conn_dst_str(conn), len, offset,
		flags);

	/* Without BT_GATT_PERM_PREPARE_WRITE only executed writes get here, and
	 * the writer's value arrives reassembled into a single write.
	 */
	TEST_ASSERT(offset == 0 && len == sizeof(chrc_value),
		    "Unexpected write of %u octets at offset %u", len, offset);

	(void)memcpy(chrc_value, buf, len);
	SET_FLAG(flag_written);

	return len;
}

BT_GATT_SERVICE_DEFINE(test_svc,
	BT_GATT_PRIMARY_SERVICE(TEST_SERVICE_UUID),
	BT_GATT_CHARACTERISTIC(TEST_CHRC_UUID, BT_GATT_CHRC_WRITE, BT_GATT_PERM_WRITE,
			       NULL, write_chrc, NULL),
);

void server_procedure(void)
{
	struct bt_conn *conns[CONFIG_BT_MAX_CONN] = {};
	uint8_t expected[CHRC_SIZE];
	int err;

	TEST_START("server");

	err = bt_enable(NULL);
	TEST_ASSERT(err == 0, "bt_enable failed (err %d)", err);

	/* Advertise until both clients are connected: the holder first, then the writer */
	ARRAY_FOR_EACH_PTR(conns, conn) {
		err = bt_testlib_adv_conn(conn, BT_ID_DEFAULT, SERVER_NAME);
		TEST_ASSERT(err == 0, "Advertising failed (err %d)", err);

		LOG_INF("Connected to %s", bt_conn_dst_str(*conn));
	}

	/* The writer disconnects once its write attempt is over */
	err = bt_testlib_wait_disconnected(conns[ARRAY_SIZE(conns) - 1]);
	TEST_ASSERT(err == 0, "Waiting for the writer to disconnect failed (err %d)", err);

	TEST_ASSERT(IS_FLAG_SET(flag_written) == WRITER_EXPECT_SUCCESS,
		    "The writer's value %s written", IS_FLAG_SET(flag_written) ? "was" : "was not");

	if (WRITER_EXPECT_SUCCESS) {
		writer_value_fill(expected, sizeof(expected));
		TEST_ASSERT(memcmp(chrc_value, expected, sizeof(expected)) == 0,
			    "Written value differs from the writer's value");
	}

	TEST_PASS("server");
}
```
