## tests/bsim/bluetooth/host/gatt/general/testcase.yaml
```yaml
tests:
  bluetooth.host.gatt.general:
    tags:
      - bluetooth
    platform_allow:
      - nrf52_bsim/native
      - nrf5340bsim/nrf5340/cpunet
    harness: bsim
    timeout: 2
    harness_config:
      bsim_exe_name:
        - tests_bsim_bluetooth_host_gatt_general_prj_conf
      bsim_verbosity: 2
      bsim_sim_length: 30e6
      bsim_test_ids:
        - gatt_client
        - gatt_server
      bsim_options:
        - -RealEncryption=1
```

## tests/bsim/bluetooth/host/gatt/notify/testcase.yaml
```yaml
common:
  tags:
    - bluetooth
  platform_allow:
    - nrf52_bsim/native
  harness: bsim
  timeout: 30
  no_build: true
  harness_config:
    bsim_exe_name: tests_bsim_bluetooth_host_gatt_notify_prj_conf
    bsim_verbosity: 2
    bsim_sim_length: 60e6
    bsim_options:
      - -RealEncryption=1

tests:
  bluetooth.host.gatt.build_notify:
    build_only: true
    no_build: false

  bluetooth.host.gatt.notify_enhanced_enhanced:
    harness_config:
      bsim_devices:
        - test_id: gatt_client_enhanced
        - test_id: gatt_server_enhanced

  bluetooth.host.gatt.notify_enhanced_mixed:
    harness_config:
      bsim_devices:
        - test_id: gatt_client_mixed
        - test_id: gatt_server_enhanced

  bluetooth.host.gatt.notify_enhanced_none:
    harness_config:
      bsim_devices:
        - test_id: gatt_client_none
        - test_id: gatt_server_enhanced

  bluetooth.host.gatt.notify_enhanced_unenhanced:
    harness_config:
      bsim_devices:
        - test_id: gatt_client_unenhanced
        - test_id: gatt_server_enhanced

  bluetooth.host.gatt.notify_mixed_enhanced:
    harness_config:
      bsim_devices:
        - test_id: gatt_client_enhanced
        - test_id: gatt_server_mixed

  bluetooth.host.gatt.notify_mixed_mixed:
    harness_config:
      bsim_devices:
        - test_id: gatt_client_mixed
        - test_id: gatt_server_mixed

  bluetooth.host.gatt.notify_mixed_none:
    harness_config:
      bsim_devices:
        - test_id: gatt_client_none
        - test_id: gatt_server_mixed

  bluetooth.host.gatt.notify_mixed_unenhanced:
    harness_config:
      bsim_devices:
        - test_id: gatt_client_unenhanced
        - test_id: gatt_server_mixed

  bluetooth.host.gatt.notify_none_enhanced:
    harness_config:
      bsim_devices:
        - test_id: gatt_client_enhanced
        - test_id: gatt_server_none

  bluetooth.host.gatt.notify_none_mixed:
    harness_config:
      bsim_devices:
        - test_id: gatt_client_mixed
        - test_id: gatt_server_none

  bluetooth.host.gatt.notify_none_none:
    harness_config:
      bsim_devices:
        - test_id: gatt_client_none
        - test_id: gatt_server_none

  bluetooth.host.gatt.notify_none_unenhanced:
    harness_config:
      bsim_devices:
        - test_id: gatt_client_unenhanced
        - test_id: gatt_server_none

  bluetooth.host.gatt.notify_unenhanced_enhanced:
    harness_config:
      bsim_devices:
        - test_id: gatt_client_enhanced
        - test_id: gatt_server_unenhanced

  bluetooth.host.gatt.notify_unenhanced_mixed:
    harness_config:
      bsim_devices:
        - test_id: gatt_client_mixed
        - test_id: gatt_server_unenhanced

  bluetooth.host.gatt.notify_unenhanced_none:
    harness_config:
      bsim_devices:
        - test_id: gatt_client_none
        - test_id: gatt_server_unenhanced

  bluetooth.host.gatt.notify_unenhanced_unenhanced:
    harness_config:
      bsim_devices:
        - test_id: gatt_client_unenhanced
        - test_id: gatt_server_unenhanced
```

## tests/bsim/bluetooth/host/gatt/notify_indicate_type/testcase.yaml
```yaml
tests:
  bluetooth.host.gatt.notify_indicate_type:
    build_only: true
    tags:
      - bluetooth
    platform_allow:
      - nrf52_bsim/native
    harness: bsim
    harness_config:
      bsim_exe_name: tests_bsim_bluetooth_host_gatt_notify_indicate_type_prj_conf
```

## tests/bsim/bluetooth/host/gatt/notify_multiple/testcase.yaml
```yaml
tests:
  bluetooth.host.gatt.notify_multiple:
    build_only: true
    tags:
      - bluetooth
    platform_allow:
      - nrf52_bsim/native
    harness: bsim
    harness_config:
      bsim_exe_name: tests_bsim_bluetooth_host_gatt_notify_multiple_prj_conf
```

## tests/bsim/bluetooth/host/gatt/notify_stress/testcase.yaml
```yaml
tests:
  bluetooth.host.gatt.notify_stress:
    build_only: true
    sysbuild: true
    tags:
      - bluetooth
    platform_allow:
      - nrf52_bsim/native
      - nrf5340bsim/nrf5340/cpuapp
    timeout: 150
    harness: bsim
    harness_config:
      bsim_exe_name: tests_bsim_bluetooth_host_gatt_notify_stress_prj_conf
      bsim_verbosity: 2
      bsim_sim_length: 70e6
      bsim_devices:
        - test_id: gatt_server_enhanced_notif_stress
        - test_id: gatt_client_enhanced_notif_stress
      bsim_options:
        - -RealEncryption=1
```

## tests/bsim/bluetooth/host/gatt/sc_indicate/testcase.yaml
```yaml
tests:
  bluetooth.host.gatt.sc_indicate:
    build_only: true
    tags:
      - bluetooth
    platform_allow:
      - nrf52_bsim/native
    harness: bsim
    harness_config:
      bsim_exe_name: tests_bsim_bluetooth_host_gatt_sc_indicate_prj_conf
  bluetooth.host.gatt.sc_indicate_privacy:
    build_only: true
    tags:
      - bluetooth
    platform_allow:
      - nrf52_bsim/native
    harness: bsim
    extra_args:
      - EXTRA_CONF_FILE=overlay-privacy.conf
    harness_config:
      bsim_exe_name: tests_bsim_bluetooth_host_gatt_sc_indicate_overlay-privacy_conf
```

## tests/bsim/bluetooth/host/gatt/settings/testcase.yaml
```yaml
common:
  tags:
    - bluetooth
  platform_allow:
    - nrf52_bsim/native
  harness: bsim
  timeout: 120
  harness_config:
    bsim_verbosity: 2
    bsim_sim_length: 30e6
    bsim_options:
      - -RealEncryption=1
      - -argstest

tests:
  bluetooth.host.gatt.settings:
    harness_config:
      bsim_exe_name: tests_bsim_bluetooth_host_gatt_settings_prj_conf
      bsim_devices:
        - test_id: client
          options:
            - '0'
            - '0'
            - 'client'
        - test_id: server
          options:
            - '0'
            - '6'
            - 'server'
        - test_id: server
          options:
            - '1'
            - '6'
            - 'server'
        - test_id: server
          options:
            - '2'
            - '6'
            - 'server'
        - test_id: server
          options:
            - '3'
            - '6'
            - 'server'
        - test_id: server
          options:
            - '4'
            - '6'
            - 'server'
        - test_id: server
          options:
            - '5'
            - '6'
            - 'server'
        - test_id: server
          options:
            - '6'
            - '6'
            - 'server'

  bluetooth.host.gatt.settings_priv:
    harness_config:
      bsim_exe_name: tests_bsim_bluetooth_host_gatt_settings_overlay-privacy_conf
      bsim_devices:
        - test_id: client
          options:
            - '0'
            - '0'
            - 'client_priv'
        - test_id: server
          options:
            - '0'
            - '6'
            - 'server_priv'
        - test_id: server
          options:
            - '1'
            - '6'
            - 'server_priv'
        - test_id: server
          options:
            - '2'
            - '6'
            - 'server_priv'
        - test_id: server
          options:
            - '3'
            - '6'
            - 'server_priv'
        - test_id: server
          options:
            - '4'
            - '6'
            - 'server_priv'
        - test_id: server
          options:
            - '5'
            - '6'
            - 'server_priv'
        - test_id: server
          options:
            - '6'
            - '6'
            - 'server_priv'
    extra_args:
      EXTRA_CONF_FILE=overlay-privacy.conf
```

## tests/bsim/bluetooth/host/gatt/settings_clear/testcase.yaml
```yaml
tests:
  bluetooth.host.gatt.settings_clear:
    build_only: true
    tags:
      - bluetooth
    platform_allow:
      - nrf5340bsim/nrf5340/cpunet
      - nrf52_bsim/native
    harness: bsim
    harness_config:
      bsim_exe_name: tests_bsim_bluetooth_host_gatt_settings_clear_prj_conf
```

## tests/bsim/bluetooth/host/id/settings/testcase.yaml
```yaml
common:
  tags:
    - bluetooth
  platform_allow:
    - nrf52_bsim/native
  harness: bsim
  timeout: 30
  harness_config:
    bsim_exe_name: tests_bsim_bluetooth_host_id_settings_prj_conf
    bsim_verbosity: 2
    bsim_sim_length: 60e6
    bsim_options:
      - -flash=id_settings.log.bin

tests:
  bluetooth.host.id.build_settings:
    build_only: true

  bluetooth.host.id.settings_dut2:
    no_build: true
    harness_config:
      bsim_devices:
        - test_id: dut2
          options:
            - -flash_rm

  bluetooth.host.id.settings_dut1:
    no_build: true
    harness_config:
      bsim_devices:
        - test_id: dut1
```

## tests/bsim/bluetooth/host/iso/bis/Kconfig.sysbuild
```kconfig
# Copyright (c) 2023-2025 Nordic Semiconductor ASA
# SPDX-License-Identifier: Apache-2.0

source "share/sysbuild/Kconfig"

config NET_CORE_BOARD
	string
	default "nrf5340bsim/nrf5340/cpunet" if $(BOARD_TARGET_STRING) = "NRF5340BSIM_NRF5340_CPUAPP"

config NET_CORE_IMAGE_HCI_IPC
	bool "HCI IPC image on network core"
	default y
	depends on NET_CORE_BOARD != ""


config NATIVE_SIMULATOR_PRIMARY_MCU_INDEX
	int
	# Let's pass the test arguments to the application MCU test
	# otherwise by default they would have gone to the net core.
	default 0 if $(BOARD_TARGET_STRING) = "NRF5340BSIM_NRF5340_CPUAPP"
```

## tests/bsim/bluetooth/host/iso/bis/testcase.yaml
```yaml
common:
  build_only: true
  tags:
    - bluetooth
  harness: bsim
  harness_config:
    bsim_exe_name: tests_bsim_bluetooth_host_iso_bis_prj_conf

tests:
  bluetooth.host.iso.bis:
    platform_allow:
      - nrf52_bsim/native
    extra_args:
      EXTRA_CONF_FILE=controller.conf
  bluetooth.host.iso.bis_nrf5340:
    sysbuild: true
    platform_allow:
      - nrf5340bsim/nrf5340/cpuapp
```

## tests/bsim/bluetooth/host/iso/cis/testcase.yaml
```yaml
tests:
  bluetooth.host.iso.cis:
    build_only: true
    tags:
      - bluetooth
    platform_allow:
      - nrf52_bsim/native
    harness: bsim
    harness_config:
      bsim_exe_name: tests_bsim_bluetooth_host_iso_cis_prj_conf
```

## tests/bsim/bluetooth/host/iso/frag/testcase.yaml
```yaml
tests:
  bluetooth.host.iso.frag:
    tags:
      - bluetooth
    platform_allow:
      - nrf52_bsim/native
    timeout: 2
    harness: bsim
    harness_config:
      bsim_exe_name:
        - tests_bsim_bluetooth_host_iso_frag_prj_conf
      bsim_verbosity: 2
      bsim_sim_length: 30e6
      bsim_test_ids:
        - broadcaster
```

## tests/bsim/bluetooth/host/iso/frag_2/testcase.yaml
```yaml
tests:
  bluetooth.host.iso.frag_2:
    build_only: true
    tags:
      - bluetooth
    platform_allow:
      - nrf52_bsim/native
    harness: bsim
    harness_config:
      bsim_exe_name: tests_bsim_bluetooth_host_iso_frag_2_prj_conf
```

## tests/bsim/bluetooth/host/l2cap/combined_build/testcase.yaml
```yaml
common:
  build_only: true
  tags:
    - bluetooth
  platform_allow:
    - nrf52_bsim/native
  harness: bsim

tests:
  bluetooth.host.l2cap.combined:
    harness_config:
      bsim_exe_name: tests_bsim_bluetooth_host_l2cap_combined_build_prj_conf
```

## tests/bsim/bluetooth/host/l2cap/credits/testcase.yaml
```yaml
common:
  build_only: true
  tags:
    - bluetooth
  platform_allow:
    - nrf52_bsim/native
  harness: bsim

tests:
  bluetooth.host.l2cap.credits:
    harness_config:
      bsim_exe_name: tests_bsim_bluetooth_host_l2cap_credits_prj_conf
  bluetooth.host.l2cap.credits_ecred:
    harness_config:
      bsim_exe_name: tests_bsim_bluetooth_host_l2cap_credits_prj_conf_overlay-ecred_conf
    extra_args: EXTRA_CONF_FILE="overlay-ecred.conf"
```

## tests/bsim/bluetooth/host/l2cap/credits_seg_recv/testcase.yaml
```yaml
common:
  tags:
    - bluetooth
  platform_allow:
    - nrf52_bsim/native
  harness: bsim
  timeout: 30
  harness_config:
    bsim_verbosity: 2
    bsim_sim_length: 30e6

tests:
  bluetooth.host.l2cap.credits_seg_recv:
    harness_config:
      bsim_exe_name: tests_bsim_bluetooth_host_l2cap_credits_seg_recv_prj_conf
      bsim_devices:
        - test_id: central
        - test_id: peripheral

  bluetooth.host.l2cap.credits_seg_recv_ecred:
    harness_config:
      bsim_exe_name: tests_bsim_bluetooth_host_l2cap_credits_seg_recv_prj_conf_overlay-ecred_conf
      bsim_devices:
        - test_id: central
        - test_id: peripheral
    extra_args: EXTRA_CONF_FILE=overlay-ecred.conf
```

## tests/bsim/bluetooth/host/l2cap/credits_seg_send/testcase.yaml
```yaml
common:
  build_only: true
  tags:
    - bluetooth
  platform_allow:
    - nrf52_bsim/native
  harness: bsim

tests:
  bluetooth.host.l2cap.credits_seg_send:
    harness_config:
      bsim_exe_name: tests_bsim_bluetooth_host_l2cap_credits_seg_send_prj_conf
  bluetooth.host.l2cap.credits_seg_send_mps_equal_acl_mtu:
    harness_config:
      bsim_exe_name: tests_bsim_bluetooth_host_l2cap_credits_seg_send_overlay-mps_equal_acl_mtu_conf
    extra_args: EXTRA_CONF_FILE="overlay-mps-equal-acl-mtu.conf"
```

## tests/bsim/bluetooth/host/l2cap/ecred/dut/Kconfig
```kconfig
# Kconfig options for the test
#
# Only used as single point for log level configuration.
# Can be extended with any new kconfig, really.
#
# Copyright (c) 2024 Nordic Semiconductor ASA
# SPDX-License-Identifier: Apache-2.0

menu "Test configuration"

module = APP
module-str = app

source "subsys/logging/Kconfig.template.log_config"

endmenu

source "Kconfig.zephyr"
```

## tests/bsim/bluetooth/host/l2cap/ecred/peer/testcase.yaml
```yaml
tests:
  bluetooth.host.l2cap.ecred.peer:
    build_only: true
    tags:
      - bluetooth
    platform_allow:
      - nrf52_bsim/native
    harness: bsim
    harness_config:
      bsim_exe_name: tests_bsim_bluetooth_host_l2cap_ecred_peer_prj_conf
```

## tests/bsim/bluetooth/host/l2cap/ecred/testcase.yaml
```yaml
tests:
  bluetooth.host.l2cap.ecred.peer:
    no_build: true
    tags:
      - bluetooth
    platform_allow:
      - nrf52_bsim/native
    timeout: 30
    harness: bsim
    harness_config:
      bsim_verbosity: 2
      bsim_sim_length: 10e6
      bsim_devices:
        - test_id: dut
          exe: tests_bsim_bluetooth_host_l2cap_ecred_dut_prj_conf
        - test_id: peer
          exe: tests_bsim_bluetooth_host_l2cap_ecred_peer_prj_conf
```

## tests/bsim/bluetooth/host/l2cap/einprogress/testcase.yaml
```yaml
tests:
  bluetooth.host.l2cap.einprogress:
    tags:
      - bluetooth
    platform_allow:
      - nrf52_bsim/native
    timeout: 120
    harness: bsim
    harness_config:
      bsim_exe_name: tests_bsim_bluetooth_host_l2cap_einprogress_prj_conf
      bsim_verbosity: 2
      bsim_sim_length: 10e6
      bsim_devices:
        - test_id: l2cap/einprogress/dut
        - test_id: l2cap/einprogress/tester
```

## tests/bsim/bluetooth/host/l2cap/general/testcase.yaml
```yaml
tests:
  bluetooth.host.l2cap.general:
    tags:
      - bluetooth
    platform_allow:
      - nrf52_bsim/native
    timeout: 120
    harness: bsim
    harness_config:
      bsim_exe_name:
        - tests_bsim_bluetooth_host_l2cap_general_prj_conf
      bsim_verbosity: 2
      bsim_sim_length: 60e6
      bsim_test_ids:
        - central
        - peripheral
```

## tests/bsim/bluetooth/host/l2cap/many_conns/testcase.yaml
```yaml
tests:
  bluetooth.host.l2cap.many_conns:
    tags:
      - bluetooth
    platform_allow:
      - nrf52_bsim/native
    timeout: 5
    harness: bsim
    harness_config:
      bsim_exe_name:
        - tests_bsim_bluetooth_host_l2cap_many_conns_prj_conf
      bsim_verbosity: 2
      bsim_sim_length: 10e6
      bsim_test_ids:
        - central
        - peripheral
        - peripheral
        - peripheral
        - peripheral
```
