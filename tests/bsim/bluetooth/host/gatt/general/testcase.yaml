## tests/bsim/bluetooth/host/l2cap/multilink_peripheral/testcase.yaml
```yaml
tests:
  bluetooth.host.l2cap.multilink_peripheral:
    tags:
      - bluetooth
    platform_allow:
      - nrf52_bsim/native
    timeout: 30
    harness: bsim
    harness_config:
      bsim_exe_name:
        - tests_bsim_bluetooth_host_l2cap_multilink_peripheral_prj_conf
      bsim_verbosity: 2
      bsim_sim_length: 40e6
      bsim_test_ids:
        - dut
        - central
        - central
      bsim_options:
        - -RealEncryption=1
        - "['', '-delay_init', '-delay_init']"
        - "['', '-start_offset=1e3', '-start_offset=10e3']"
```
