## CMakeLists.txt
```
# SPDX-License-Identifier: Apache-2.0

cmake_minimum_required(VERSION 3.28.0)

if(NOT DEFINED ENV{BSIM_COMPONENTS_PATH})
  message(FATAL_ERROR "This test requires the BabbleSim simulator. Please set  \
          the  environment variable BSIM_COMPONENTS_PATH to point to its       \
          components folder. More information can be found in                  \
          https://babblesim.github.io/folder_structure_and_env.html")
endif()

find_package(Zephyr HINTS $ENV{ZEPHYR_BASE})
project(bsim_test_auto_seq_req)

add_subdirectory(${ZEPHYR_BASE}/tests/bsim/babblekit babblekit)
target_link_libraries(app PRIVATE babblekit)

target_sources(app PRIVATE
  src/main.c
  src/central.c
  src/peripheral.c
  src/bs_bt_utils.c
)

zephyr_include_directories(
        $ENV{BSIM_COMPONENTS_PATH}/libUtilv1/src/
        $ENV{BSIM_COMPONENTS_PATH}/libPhyComv1/src/
)
```

## prj.conf
```kconfig
CONFIG_BT=y
CONFIG_BT_CENTRAL=y
CONFIG_BT_PERIPHERAL=y
CONFIG_BT_DEVICE_NAME="SC Indication Test"

CONFIG_LOG=y
CONFIG_BT_EXT_ADV=y

CONFIG_BT_SMP=y
CONFIG_BT_GATT_CLIENT=y

CONFIG_SETTINGS=y
CONFIG_BT_SETTINGS=y
CONFIG_FLASH=y
CONFIG_NVS=y
CONFIG_FLASH_MAP=y
CONFIG_SETTINGS_NVS=y

CONFIG_BT_GATT_DYNAMIC_DB=y

CONFIG_SYSTEM_WORKQUEUE_STACK_IGNORE_MIN=y
```

## overlay-privacy.conf
```kconfig
CONFIG_BT_PRIVACY=y
CONFIG_BT_RPA_TIMEOUT=1

# Ensure that we aren't pairing before calling set_security().
CONFIG_BT_ATT_RETRY_ON_SEC_ERR=n
```

## src/main.c
```c
/*
 * Copyright (c) 2023 Nordic Semiconductor ASA
 * Copyright (c) 2026 Silicon Laboratories Inc.
 *
 * SPDX-License-Identifier: Apache-2.0
 */

#include "bstests.h"
#include "bs_bt_utils.h"

extern void central(void);
extern void central_reserved_bit(void);
extern void peripheral(void);
extern void central_reboot_subscribe_bond(void);
extern void central_reboot_resubscribe(void);
extern void peripheral_reboot_bond(void);
extern void peripheral_reboot_indicate(void);

static const struct bst_test_instance test_to_add[] = {
	{
		.test_id = "central",
		.test_main_f = central,
	},
	{
		.test_id = "peripheral",
		.test_main_f = peripheral,
	},
	{
		.test_id = "central_reserved_bit",
		.test_descr = "Same as central, subscribing to Service Changed with a Reserved "
			      "bit set.",
		.test_main_f = central_reserved_bit,
	},
	{
		.test_id = "central_reboot_subscribe_bond",
		.test_descr = "Subscribe to Service Changed, then bond and disconnect. The bond "
			      "and the Service Changed configuration must survive a reboot.",
		.test_main_f = central_reboot_subscribe_bond,
	},
	{
		.test_id = "central_reboot_resubscribe",
		.test_descr = "After a reboot, re-arm the subscription from bond data, reconnect "
			      "and expect a Service Changed indication for a database change made "
			      "while disconnected.",
		.test_main_f = central_reboot_resubscribe,
	},
	{
		.test_id = "peripheral_reboot_bond",
		.test_descr = "Accept a connection from a client that subscribes to Service "
			      "Changed before bonding, persisting the bond and the Service "
			      "Changed configuration.",
		.test_main_f = peripheral_reboot_bond,
	},
	{
		.test_id = "peripheral_reboot_indicate",
		.test_descr = "After a reboot, change the database while the bonded client is "
			      "disconnected, then advertise so it can reconnect and receive the "
			      "Service Changed indication.",
		.test_main_f = peripheral_reboot_indicate,
	},
	BSTEST_END_MARKER,
};

static struct bst_test_list *install(struct bst_test_list *tests)
{
	return bst_add_tests(tests, test_to_add);
};

bst_test_install_t test_installers[] = {install, NULL};

int main(void)
{
	bst_main();
	return 0;
}
```

## src/bs_bt_utils.c
```c
/**
 * Copyright (c) 2023 Nordic Semiconductor ASA
 *
 * SPDX-License-Identifier: Apache-2.0
 */

#include <stdint.h>

#include <zephyr/bluetooth/gap.h>
#include <zephyr/bluetooth/conn.h>
#include <zephyr/bluetooth/bluetooth.h>
#include <zephyr/bluetooth/hci_types.h>

#include <zephyr/logging/log.h>
LOG_MODULE_REGISTER(test_utils, LOG_LEVEL_DBG);

#include "bs_bt_utils.h"

struct bt_conn *g_conn;
DEFINE_FLAG(flag_is_connected);

void wait_connected(void)
{
	LOG_DBG("Wait for connection...");
	WAIT_FOR_FLAG(flag_is_connected);
}

void wait_disconnected(void)
{
	LOG_DBG("Wait for disconnection...");
	WAIT_FOR_FLAG_UNSET(flag_is_connected);
}

static void security_changed(struct bt_conn *conn, bt_security_t level, enum bt_security_err err)
{
	LOG_DBG("security changed");
}

static void disconnected(struct bt_conn *conn, uint8_t reason)
{
	UNSET_FLAG(flag_is_connected);
}

struct bt_conn *get_g_conn(void)
{
	return g_conn;
}

void clear_g_conn(void)
{
	TEST_ASSERT(g_conn != NULL, "Test error: no g_conn!");
	bt_conn_drop(&g_conn);
}

static void connected(struct bt_conn *conn, uint8_t err)
{
	TEST_ASSERT((!g_conn || (conn == g_conn)), "Unexpected new connection.");

	if (!g_conn) {
		g_conn = bt_conn_ref(conn);
	}

	if (err != 0) {
		clear_g_conn();
		return;
	}

	SET_FLAG(flag_is_connected);
}

BT_CONN_CB_DEFINE(conn_callbacks) = {
	.connected = connected,
	.disconnected = disconnected,
	.security_changed = security_changed,
};

static void stop_scan_and_connect(const bt_addr_le_t *addr,
				  int8_t rssi,
				  uint8_t type,
				  struct net_buf_simple *ad)
{
	int err;

	if (g_conn != NULL) {
		return;
	}

	printk("Got scan result, connecting.. dst %s, RSSI %d\n", bt_addr_le_str(addr), rssi);

	err = bt_le_scan_stop();
	TEST_ASSERT(!err, "Err bt_le_scan_stop %d", err);

	err = bt_conn_le_create(addr, BT_CONN_LE_CREATE_CONN, BT_LE_CONN_PARAM_DEFAULT, &g_conn);
	TEST_ASSERT(!err, "Err bt_conn_le_create %d", err);
}

void scan_connect_to_first_result(void)
{
	int err;

	err = bt_le_scan_start(BT_LE_SCAN_PASSIVE, stop_scan_and_connect);
	TEST_ASSERT(!err, "Err bt_le_scan_start %d", err);
}

void disconnect(void)
{
	int err;

	err = bt_conn_disconnect(g_conn, BT_HCI_ERR_REMOTE_USER_TERM_CONN);
	TEST_ASSERT(!err, "bt_conn_disconnect failed (%d)", err);
}

void set_security(bt_security_t sec)
{
	int err;

	err = bt_conn_set_security(g_conn, sec);
	TEST_ASSERT(!err, "Err bt_conn_set_security %d", err);
}

void create_adv(struct bt_le_ext_adv **adv)
{
	int err;
	struct bt_le_adv_param params = {};

	params.options |= BT_LE_ADV_OPT_CONN;
	params.options |= BT_LE_ADV_OPT_EXT_ADV;

	params.id = BT_ID_DEFAULT;
	params.sid = 0;
	params.interval_min = BT_GAP_ADV_FAST_INT_MIN_2;
	params.interval_max = BT_GAP_ADV_FAST_INT_MAX_2;

	err = bt_le_ext_adv_create(&params, NULL, adv);
	TEST_ASSERT(!err, "bt_le_ext_adv_create failed (%d)", err);
}

void start_adv(struct bt_le_ext_adv *adv)
{
	int err;

	err = bt_le_ext_adv_start(adv, BT_LE_EXT_ADV_START_DEFAULT);
	TEST_ASSERT(!err, "bt_le_ext_adv_start failed (%d)", err);
}

void stop_adv(struct bt_le_ext_adv *adv)
{
	int err;

	err = bt_le_ext_adv_stop(adv);
	TEST_ASSERT(!err, "bt_le_ext_adv_stop failed (%d)", err);
}

/* The following flags are raised by events and lowered by test code. */
DEFINE_FLAG(flag_pairing_complete);
DEFINE_FLAG(flag_bonded);
DEFINE_FLAG(flag_not_bonded);

void pairing_complete(struct bt_conn *conn, bool bonded)
{
	LOG_DBG("pairing complete");
	SET_FLAG(flag_pairing_complete);

	if (bonded) {
		SET_FLAG(flag_bonded);
		LOG_DBG("Bonded status: true");
	} else {
		SET_FLAG(flag_not_bonded);
		LOG_DBG("Bonded status: false");
	}
}

void pairing_failed(struct bt_conn *conn, enum bt_security_err err)
{
	TEST_FAIL("Pairing failed");
}
```

## src/bs_bt_utils.h
```c
/**
 * Copyright (c) 2023 Nordic Semiconductor ASA
 *
 * SPDX-License-Identifier: Apache-2.0
 */

#include "bstests.h"
#include "bs_tracing.h"

#include <zephyr/bluetooth/conn.h>
#include <zephyr/bluetooth/uuid.h>

#include "babblekit/testcase.h"
#include "babblekit/flags.h"

DECLARE_FLAG(flag_pairing_complete);
DECLARE_FLAG(flag_bonded);
DECLARE_FLAG(flag_not_bonded);

void scan_connect_to_first_result(void);
struct bt_conn *get_g_conn(void);
void clear_g_conn(void);
void disconnect(void);
void wait_connected(void);
void wait_disconnected(void);
void create_adv(struct bt_le_ext_adv **adv);
void start_adv(struct bt_le_ext_adv *adv);
void stop_adv(struct bt_le_ext_adv *adv);
void set_security(bt_security_t sec);
void pairing_complete(struct bt_conn *conn, bool bonded);
void pairing_failed(struct bt_conn *conn, enum bt_security_err err);
```

## src/central.c
```c
/**
 * Copyright (c) 2023 Nordic Semiconductor ASA
 * Copyright (c) 2026 Silicon Laboratories Inc.
 *
 * SPDX-License-Identifier: Apache-2.0
 *
 */

#include <stdint.h>

#include <zephyr/kernel.h>

#include <zephyr/bluetooth/addr.h>
#include <zephyr/bluetooth/conn.h>
#include <zephyr/bluetooth/gatt.h>
#include <zephyr/bluetooth/uuid.h>
#include <zephyr/settings/settings.h>
#include <zephyr/bluetooth/bluetooth.h>

#include "babblekit/testcase.h"
#include "babblekit/flags.h"

#include <zephyr/logging/log.h>
LOG_MODULE_REGISTER(test_central, LOG_LEVEL_DBG);

#include "bs_bt_utils.h"

DEFINE_FLAG_STATIC(flag_discovered);
DEFINE_FLAG_STATIC(flag_subscribed);
DEFINE_FLAG_STATIC(flag_indicated);

enum GATT_HANDLES {
	SC,
	CCC,
	NUM_HANDLES,
};

static uint16_t gatt_handles[NUM_HANDLES] = {0};

static struct bt_gatt_subscribe_params subscribe_params;
static uint16_t subscribe_value = BT_GATT_CCC_INDICATE;

static void sc_subscribed(struct bt_conn *conn,
			  uint8_t err,
			  struct bt_gatt_subscribe_params *params)
{
	LOG_DBG("subscribed");
	SET_FLAG(flag_subscribed);
}

static uint8_t sc_indicated(struct bt_conn *conn,
			    struct bt_gatt_subscribe_params *params,
			    const void *data,
			    uint16_t length)
{
	LOG_DBG("indication received");

	SET_FLAG(flag_indicated);

	return BT_GATT_ITER_CONTINUE;
}

static void subscribe(void)
{
	int err;

	subscribe_params.ccc_handle = gatt_handles[CCC];
	subscribe_params.value_handle = gatt_handles[SC];
	subscribe_params.value = subscribe_value;
	subscribe_params.subscribe = sc_subscribed;
	subscribe_params.notify = sc_indicated;

	err = bt_gatt_subscribe(get_g_conn(), &subscribe_params);
	TEST_ASSERT(!err, "bt_gatt_subscribe failed (%d)", err);

	WAIT_FOR_FLAG(flag_subscribed);
}

static uint8_t discover_func(struct bt_conn *conn,
			     const struct bt_gatt_attr *attr,
			     struct bt_gatt_discover_params *params)
{
	if (attr == NULL) {
		for (size_t i = 0U; i < ARRAY_SIZE(gatt_handles); i++) {
			LOG_DBG("handle[%d] = 0x%x", i, gatt_handles[i]);
			TEST_ASSERT(gatt_handles[i] != 0, "did not find all handles");
		}

		(void)memset(params, 0, sizeof(*params));
		SET_FLAG(flag_discovered);

		return BT_GATT_ITER_STOP;
	}

	if (params->type == BT_GATT_DISCOVER_CHARACTERISTIC) {
		const struct bt_gatt_chrc *chrc = (struct bt_gatt_chrc *)attr->user_data;
		static const struct bt_uuid_16 ccc_uuid = BT_UUID_INIT_16(BT_UUID_GATT_CCC_VAL);

		if (bt_uuid_cmp(chrc->uuid, BT_UUID_GATT_SC) == 0) {
			int err;

			LOG_DBG("found sc");
			gatt_handles[SC] = chrc->value_handle;

			params->uuid = &ccc_uuid.uuid;
			params->start_handle = attr->handle + 2;
			params->type = BT_GATT_DISCOVER_DESCRIPTOR;

			err = bt_gatt_discover(conn, params);
			TEST_ASSERT(!err, "bt_gatt_discover failed (%d)", err);

			return BT_GATT_ITER_STOP;
		}

	} else if (params->type == BT_GATT_DISCOVER_DESCRIPTOR &&
		   bt_uuid_cmp(params->uuid, BT_UUID_GATT_CCC) == 0) {
		LOG_DBG("found ccc");
		gatt_handles[CCC] = attr->handle;
		SET_FLAG(flag_discovered);

		return BT_GATT_ITER_STOP;
	}

	return BT_GATT_ITER_CONTINUE;
}

static void gatt_discover(void)
{
	int err;
	static struct bt_gatt_discover_params discover_params;

	discover_params.uuid = NULL;
	discover_params.func = discover_func;
	discover_params.start_handle = BT_ATT_FIRST_ATTRIBUTE_HANDLE;
	discover_params.end_handle = BT_ATT_LAST_ATTRIBUTE_HANDLE;
	discover_params.type = BT_GATT_DISCOVER_CHARACTERISTIC;

	err = bt_gatt_discover(get_g_conn(), &discover_params);
	TEST_ASSERT(!err, "bt_gatt_discover failed (%d)", err);

	WAIT_FOR_FLAG(flag_discovered);

	LOG_DBG("sc handle: %d", gatt_handles[SC]);
	LOG_DBG("ccc handle: %d", gatt_handles[CCC]);
}

void central_reboot_subscribe_bond(void)
{
	int err;
	struct bt_conn_auth_info_cb bt_conn_auth_info_cb = {
		.pairing_failed = pairing_failed,
		.pairing_complete = pairing_complete,
	};

	err = bt_enable(NULL);
	TEST_ASSERT(!err, "bt_enable failed (%d)", err);

	err = bt_conn_auth_info_cb_register(&bt_conn_auth_info_cb);
	TEST_ASSERT(!err, "bt_conn_auth_info_cb_register failed.");

	err = settings_load();
	TEST_ASSERT(!err, "settings_load failed (%d)", err);

	scan_connect_to_first_result();
	wait_connected();

	/* Subscribe before there is a bond to persist the configuration
	 * against.
	 */
	gatt_discover();
	subscribe();

	set_security(BT_SECURITY_L2);

	TAKE_FLAG(flag_pairing_complete);
	TAKE_FLAG(flag_bonded);

	disconnect();
	wait_disconnected();
	clear_g_conn();

	TEST_PASS("PASS");
}

/* Attribute handles of the Service Changed characteristic value and its CCC.
 * The GATT service is the first service in the attribute table, so these are
 * fixed and can be used without a new discovery after the reboot.
 */
#define SC_VALUE_HANDLE 0x0003
#define SC_CCC_HANDLE   0x0004

static void bond_addr_cb(const struct bt_bond_info *info, void *user_data)
{
	bt_addr_le_t *addr = user_data;

	bt_addr_le_copy(addr, &info->addr);
}

void central_reboot_resubscribe(void)
{
	int err;
	bt_addr_le_t peer = *BT_ADDR_LE_ANY;

	err = bt_enable(NULL);
	TEST_ASSERT(!err, "bt_enable failed (%d)", err);

	err = settings_load();
	TEST_ASSERT(!err, "settings_load failed (%d)", err);

	bt_foreach_bond(BT_ID_DEFAULT, bond_addr_cb, &peer);
	TEST_ASSERT(!bt_addr_le_eq(&peer, BT_ADDR_LE_ANY), "no bond restored");

	/* Re-arm the subscription without writing the CCC, like a client that
	 * believes it is still subscribed. This must happen before connecting,
	 * since the server sends the Service Changed indication as soon as the
	 * connection is established.
	 */
	subscribe_params.ccc_handle = SC_CCC_HANDLE;
	subscribe_params.value_handle = SC_VALUE_HANDLE;
	subscribe_params.value = BT_GATT_CCC_INDICATE;
	subscribe_params.notify = sc_indicated;

	err = bt_gatt_resubscribe(BT_ID_DEFAULT, &peer, &subscribe_params);
	TEST_ASSERT(!err, "bt_gatt_resubscribe failed (%d)", err);

	scan_connect_to_first_result();
	wait_connected();

	set_security(BT_SECURITY_L2);

	/* wait for service change indication */
	WAIT_FOR_FLAG(flag_indicated);

	TEST_PASS("PASS");
}

void central(void)
{
	/*
	 * test goal: check that service changed indication is sent on
	 * reconnection when the server's GATT database has been updated since
	 * last connection
	 *
	 * the central will connect, bond with the peripheral and then
	 * disconnect after doing that, the central will try to connect again,
	 * this time it will not elevate the security
	 *
	 * to pass the test, the central will wait to receive the service
	 * changed indication
	 */

	int err;
	struct bt_conn_auth_info_cb bt_conn_auth_info_cb = {
		.pairing_failed = pairing_failed,
		.pairing_complete = pairing_complete,
	};

	err = bt_enable(NULL);
	TEST_ASSERT(!err, "bt_enable failed (%d)", err);

	err = bt_conn_auth_info_cb_register(&bt_conn_auth_info_cb);
	TEST_ASSERT(!err, "bt_conn_auth_info_cb_register failed.");

	err = settings_load();
	TEST_ASSERT(!err, "settings_load failed (%d)", err);

	scan_connect_to_first_result();
	wait_connected();

	/* Subscribe to SC CCC before pairing. For the privacy-enabled test case
	 * (CONFIG_BT_PRIVACY=y), the peripheral stores the SC configuration using
	 * the central's current RPA on its side.
	 */
	gatt_discover();
	subscribe();

	set_security(BT_SECURITY_L2);

	TAKE_FLAG(flag_pairing_complete);
	TAKE_FLAG(flag_bonded);

	disconnect();
	wait_disconnected();
	clear_g_conn();

#if defined(CONFIG_BT_PRIVACY)
	/* Wait for the RPA to rotate so the second connection uses
	 * a different random address.
	 */
	k_sleep(K_SECONDS(CONFIG_BT_RPA_TIMEOUT + 1));
#endif

	scan_connect_to_first_result();
	wait_connected();

	/* wait for service change indication */
	WAIT_FOR_FLAG(flag_indicated);

	TEST_PASS("PASS");
}

void central_reserved_bit(void)
{
	/* A server ignores a Reserved bit that a client sets anyway (Core 6.3,
	 * Vol 1, Part E, Section 2.4.1), so the subscription is still tracked
	 * while the client is disconnected.
	 */
	subscribe_value = BT_GATT_CCC_INDICATE | BIT(2);

	central();
}
```

## src/peripheral.c
```c
/**
 * Copyright (c) 2023 Nordic Semiconductor ASA
 * Copyright (c) 2026 Silicon Laboratories Inc.
 *
 * SPDX-License-Identifier: Apache-2.0
 *
 */

#include <stdint.h>

#include <zephyr/kernel.h>
#include <zephyr/bluetooth/addr.h>
#include <zephyr/bluetooth/conn.h>
#include <zephyr/bluetooth/gatt.h>
#include <zephyr/bluetooth/uuid.h>
#include <zephyr/settings/settings.h>
#include <zephyr/bluetooth/bluetooth.h>

#include "babblekit/testcase.h"

#include <zephyr/logging/log.h>
LOG_MODULE_REGISTER(test_peripheral, LOG_LEVEL_DBG);

#include "bs_bt_utils.h"

#define UUID_1 BT_UUID_DECLARE_128(0xdb, 0x1f, 0xe2, 0x52, 0xf3, 0xc6, 0x43, 0x66,                 \
				   0xb3, 0x92, 0x5d, 0xc6, 0xe7, 0xc9, 0x59, 0x9d)
#define UUID_2 BT_UUID_DECLARE_128(0x3f, 0xa4, 0x7f, 0x44, 0x2e, 0x2a, 0x43, 0x05,                 \
				   0xab, 0x38, 0x07, 0x8d, 0x16, 0xbf, 0x99, 0xf1)

static void new_svc_ccc_cfg_changed(const struct bt_gatt_attr *attr, uint16_t value)
{
	ARG_UNUSED(attr);

	bool notif_enabled = (value == BT_GATT_CCC_NOTIFY);

	LOG_DBG("CCC Update: notification %s", notif_enabled ? "enabled" : "disabled");
}

static struct bt_gatt_attr attrs[] = {
	BT_GATT_PRIMARY_SERVICE(UUID_1),
	BT_GATT_CHARACTERISTIC(UUID_2, BT_GATT_CHRC_NOTIFY, BT_GATT_PERM_NONE, NULL, NULL, NULL),
	BT_GATT_CCC(new_svc_ccc_cfg_changed, BT_GATT_PERM_READ | BT_GATT_PERM_WRITE),
};

static struct bt_gatt_service svc = {
	.attrs = attrs,
	.attr_count = ARRAY_SIZE(attrs),
};

void peripheral_reboot_bond(void)
{
	int err;
	struct bt_le_ext_adv *adv = NULL;

	err = bt_enable(NULL);
	TEST_ASSERT(!err, "bt_enable failed (%d)", err);

	err = settings_load();
	TEST_ASSERT(!err, "settings_load failed (%d)", err);

	create_adv(&adv);
	start_adv(adv);
	wait_connected();

	wait_disconnected();
	clear_g_conn();

	TEST_PASS("PASS");
}

void peripheral_reboot_indicate(void)
{
	int err;
	struct bt_le_ext_adv *adv = NULL;

	err = bt_enable(NULL);
	TEST_ASSERT(!err, "bt_enable failed (%d)", err);

	err = settings_load();
	TEST_ASSERT(!err, "settings_load failed (%d)", err);

	/* add a new service to trigger the service changed indication */
	err = bt_gatt_service_register(&svc);
	TEST_ASSERT(!err, "bt_gatt_service_register failed (%d)", err);
	LOG_DBG("New service added");

	create_adv(&adv);
	start_adv(adv);
	wait_connected();

	TEST_PASS("PASS");
}

void peripheral(void)
{
	/*
	 * test goal: check that service changed indication is sent on
	 * reconnection when the server's GATT database has been updated since
	 * last connection
	 *
	 * the peripheral will wait for connection/disconnection, when
	 * disconnected it will register a new service, when reconnecting, the
	 * central should receive an indication
	 */

	int err;
	struct bt_le_ext_adv *adv = NULL;

	err = bt_enable(NULL);
	TEST_ASSERT(!err, "bt_enable failed (%d)", err);

	err = settings_load();
	TEST_ASSERT(!err, "settings_load failed (%d)", err);

	create_adv(&adv);
	start_adv(adv);
	wait_connected();

	stop_adv(adv);

	wait_disconnected();
	clear_g_conn();

	/* add a new service to trigger the service changed indication */
	err = bt_gatt_service_register(&svc);
	TEST_ASSERT(!err, "bt_gatt_service_register failed (%d)", err);
	LOG_DBG("New service added");

#if defined(CONFIG_BT_PRIVACY)
	/* Wait so that the central has time to rotate its RPA. */
	k_sleep(K_SECONDS(CONFIG_BT_RPA_TIMEOUT + 1));
#endif

	start_adv(adv);
	wait_connected();

	TEST_PASS("Done");
}
```
