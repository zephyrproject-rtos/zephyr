## CMakeLists.txt
```
# SPDX-License-Identifier: Apache-2.0

cmake_minimum_required(VERSION 3.28.0)

find_package(Zephyr REQUIRED HINTS $ENV{ZEPHYR_BASE})
project(bsim_test_gatt)

add_subdirectory(${ZEPHYR_BASE}/tests/bsim/babblekit babblekit)
target_link_libraries(app PRIVATE babblekit)

FILE(GLOB app_sources src/*.c)
target_sources(app PRIVATE ${app_sources} )

zephyr_include_directories(
  ${BSIM_COMPONENTS_PATH}/libUtilv1/src/
  ${BSIM_COMPONENTS_PATH}/libPhyComv1/src/
  )
```

## prj.conf
```kconfig
CONFIG_BT=y
CONFIG_BT_DEVICE_NAME="GATT tester"
CONFIG_BT_PERIPHERAL=y
CONFIG_BT_CENTRAL=y
CONFIG_BT_GATT_CLIENT=y

CONFIG_BT_GATT_AUTO_DISCOVER_CCC=y

# gatt_server_many_peers gives a second identity a new address for each connection
CONFIG_BT_ID_MAX=2

CONFIG_BT_SMP=y
CONFIG_BT_L2CAP_DYNAMIC_CHANNEL=y
CONFIG_BT_L2CAP_ECRED=y
CONFIG_BT_EATT=y
CONFIG_BT_EATT_MAX=5

CONFIG_ASSERT=y
CONFIG_BT_TESTING=y
CONFIG_LOG=y
```

## src/common.c
```c
/*
 * Copyright (c) 2022 Nordic Semiconductor ASA
 *
 * SPDX-License-Identifier: Apache-2.0
 */

#include "common.h"

void test_tick(bs_time_t HW_device_time)
{
	if (bst_result != Passed) {
		FAIL("test failed (not passed after %i seconds)\n", WAIT_TIME);
	}
}

void test_init(void)
{
	bst_ticker_set_next_tick_absolute(WAIT_TIME);
	bst_result = In_progress;
}
```

## src/common.h
```c
/**
 * Common functions and helpers for BSIM GATT tests
 *
 * Copyright (c) 2022 Nordic Semiconductor ASA
 *
 * SPDX-License-Identifier: Apache-2.0
 */

#include <zephyr/toolchain.h>

#define CHRC_SIZE 10
#define LONG_CHRC_SIZE 40

#define TEST_SERVICE_UUID                                                                          \
	BT_UUID_DECLARE_128(0x01, 0x23, 0x45, 0x67, 0x89, 0x01, 0x02, 0x03, 0x04, 0x05, 0x06,      \
			    0x07, 0x08, 0x09, 0x00, 0x00)

#define TEST_CHRC_UUID                                                                             \
	BT_UUID_DECLARE_128(0x01, 0x23, 0x45, 0x67, 0x89, 0x01, 0x02, 0x03, 0x04, 0x05, 0x06,      \
			    0x07, 0x08, 0x09, 0xFF, 0x00)

#define TEST_LONG_CHRC_UUID                                                                        \
	BT_UUID_DECLARE_128(0x01, 0x23, 0x45, 0x67, 0x89, 0x01, 0x02, 0x03, 0x04, 0x05, 0x06,      \
			    0x07, 0x08, 0x09, 0xFF, 0x11)

#define TEST_WRITE_CHRC_UUID                                                                       \
	BT_UUID_DECLARE_128(0x01, 0x23, 0x45, 0x67, 0x89, 0x01, 0x02, 0x03, 0x04, 0x05, 0x06,      \
			    0x07, 0x08, 0x09, 0xFF, 0x22)

#define TEST_BOTH_CHRC_UUID                                                                        \
	BT_UUID_DECLARE_128(0x01, 0x23, 0x45, 0x67, 0x89, 0x01, 0x02, 0x03, 0x04, 0x05, 0x06,      \
			    0x07, 0x08, 0x09, 0xFF, 0x33)

#define NOTIFICATION_COUNT 10
BUILD_ASSERT(NOTIFICATION_COUNT % 2 == 0);

/* One peer more than a GATT client keeps subscriptions for */
#define SUB_PEER_COUNT (CONFIG_BT_MAX_PAIRED + CONFIG_BT_MAX_CONN + 1U)
```

## src/gatt_client_test.c
```c
/*
 * Copyright (c) 2022 Nordic Semiconductor ASA
 * Copyright (c) 2026 Xiaomi Corporation
 *
 * SPDX-License-Identifier: Apache-2.0
 */

#include <stddef.h>
#include <errno.h>

#include <zephyr/kernel.h>
#include <zephyr/types.h>
#include <zephyr/bluetooth/bluetooth.h>
#include <zephyr/bluetooth/hci.h>
#include <zephyr/bluetooth/conn.h>
#include <zephyr/bluetooth/uuid.h>
#include <zephyr/bluetooth/gatt.h>

#include "babblekit/testcase.h"
#include "babblekit/flags.h"
#include "common.h"

DEFINE_FLAG_STATIC(flag_is_connected);
DEFINE_FLAG_STATIC(flag_is_encrypted);
DEFINE_FLAG_STATIC(flag_discover_complete);
DEFINE_FLAG_STATIC(flag_short_subscribed);
DEFINE_FLAG_STATIC(flag_long_subscribed);
DEFINE_FLAG_STATIC(flag_short_unsubscribed);
DEFINE_FLAG_STATIC(flag_read_complete);
DEFINE_FLAG_STATIC(flag_write_complete);
DEFINE_FLAG_STATIC(flag_both_subscribed);

static struct bt_conn *g_conn;
static uint16_t chrc_handle;
static uint16_t long_chrc_handle;
static uint16_t write_chrc_handle;
static uint16_t both_chrc_handle;
static const struct bt_uuid *test_svc_uuid = TEST_SERVICE_UUID;

static void connected(struct bt_conn *conn, uint8_t err)
{
	if (err != 0) {
		TEST_FAIL("Failed to connect to %s (%u)", bt_conn_dst_str(conn), err);
		return;
	}

	printk("Connected to %s\n", bt_conn_dst_str(conn));

	SET_FLAG(flag_is_connected);
}

static void disconnected(struct bt_conn *conn, uint8_t reason)
{
	if (conn != g_conn) {
		return;
	}

	printk("Disconnected: %s (reason 0x%02x)\n", bt_conn_dst_str(conn), reason);

	bt_conn_drop(&g_conn);

	UNSET_FLAG(flag_is_connected);
}

void security_changed(struct bt_conn *conn, bt_security_t level, enum bt_security_err err)
{
	if (err) {
		TEST_FAIL("Encryption failure (%d)", err);
	} else if (level < BT_SECURITY_L2) {
		TEST_FAIL("Insufficient sec level (%d)", level);
	} else {
		SET_FLAG(flag_is_encrypted);
	}
}

BT_CONN_CB_DEFINE(conn_callbacks) = {
	.connected = connected,
	.disconnected = disconnected,
	.security_changed = security_changed,
};

void device_found(const bt_addr_le_t *addr, int8_t rssi, uint8_t type, struct net_buf_simple *ad)
{
	int err;

	if (g_conn != NULL) {
		return;
	}

	/* We're only interested in connectable events */
	if (type != BT_HCI_ADV_IND && type != BT_HCI_ADV_DIRECT_IND) {
		return;
	}

	printk("Device found: %s (RSSI %d)\n", bt_addr_le_str(addr), rssi);

	printk("Stopping scan\n");
	err = bt_le_scan_stop();
	if (err != 0) {
		TEST_FAIL("Could not stop scan: %d");
		return;
	}

	err = bt_conn_le_create(addr, BT_CONN_LE_CREATE_CONN, BT_LE_CONN_PARAM_DEFAULT, &g_conn);
	if (err != 0) {
		TEST_FAIL("Could not connect to peer: %d", err);
	}
}

static uint8_t discover_func(struct bt_conn *conn, const struct bt_gatt_attr *attr,
			     struct bt_gatt_discover_params *params)
{
	int err;

	if (attr == NULL) {
		if (chrc_handle == 0 || long_chrc_handle == 0) {
			TEST_FAIL("Did not discover chrc (%x) or long_chrc (%x)", chrc_handle,
			     long_chrc_handle);
		}

		(void)memset(params, 0, sizeof(*params));

		SET_FLAG(flag_discover_complete);

		return BT_GATT_ITER_STOP;
	}

	printk("[ATTRIBUTE] handle %u\n", attr->handle);

	if (params->type == BT_GATT_DISCOVER_PRIMARY &&
	    bt_uuid_cmp(params->uuid, TEST_SERVICE_UUID) == 0) {
		printk("Found test service\n");
		params->uuid = NULL;
		params->start_handle = attr->handle + 1;
		params->type = BT_GATT_DISCOVER_CHARACTERISTIC;

		err = bt_gatt_discover(conn, params);
		if (err != 0) {
			TEST_FAIL("Discover failed (err %d)", err);
		}

		return BT_GATT_ITER_STOP;
	} else if (params->type == BT_GATT_DISCOVER_CHARACTERISTIC) {
		const struct bt_gatt_chrc *chrc = (struct bt_gatt_chrc *)attr->user_data;

		if (bt_uuid_cmp(chrc->uuid, TEST_CHRC_UUID) == 0) {
			printk("Found chrc\n");
			chrc_handle = chrc->value_handle;
		} else if (bt_uuid_cmp(chrc->uuid, TEST_LONG_CHRC_UUID) == 0) {
			printk("Found long_chrc\n");
			long_chrc_handle = chrc->value_handle;
		} else if (bt_uuid_cmp(chrc->uuid, TEST_WRITE_CHRC_UUID) == 0) {
			printk("Found write_chrc\n");
			write_chrc_handle = chrc->value_handle;
		} else if (bt_uuid_cmp(chrc->uuid, TEST_BOTH_CHRC_UUID) == 0) {
			printk("Found both_chrc\n");
			both_chrc_handle = chrc->value_handle;
		}
	}

	return BT_GATT_ITER_CONTINUE;
}

static void gatt_discover(enum bt_att_chan_opt opt)
{
	static struct bt_gatt_discover_params discover_params;
	int err;

	printk("Discovering services and characteristics\n");

	discover_params.uuid = test_svc_uuid;
	discover_params.func = discover_func;
	discover_params.start_handle = BT_ATT_FIRST_ATTRIBUTE_HANDLE;
	discover_params.end_handle = BT_ATT_LAST_ATTRIBUTE_HANDLE;
	discover_params.type = BT_GATT_DISCOVER_PRIMARY;
	discover_params.chan_opt = opt;

	err = bt_gatt_discover(g_conn, &discover_params);
	if (err != 0) {
		TEST_FAIL("Discover failed(err %d)", err);
	}

	WAIT_FOR_FLAG(flag_discover_complete);
	printk("Discover complete\n");
}

static void test_short_subscribed(struct bt_conn *conn, uint8_t err,
				  struct bt_gatt_subscribe_params *params)
{
	if (err) {
		TEST_FAIL("Subscribe failed (err %d)", err);
	}

	SET_FLAG(flag_short_subscribed);

	if (!params) {
		printk("params NULL\n");
		return;
	}

	if (params->value_handle == chrc_handle) {
		printk("Subscribed to short characteristic\n");
	} else {
		TEST_FAIL("Unknown handle %d", params->value_handle);
	}
}

static void test_long_subscribed(struct bt_conn *conn, uint8_t err,
				 struct bt_gatt_subscribe_params *params)
{
	if (err) {
		TEST_FAIL("Subscribe failed (err %d)", err);
	}

	SET_FLAG(flag_long_subscribed);

	if (!params) {
		printk("params NULL\n");
		return;
	}

	if (params->value_handle == long_chrc_handle) {
		printk("Subscribed to long characteristic\n");
	} else {
		TEST_FAIL("Unknown handle %d", params->value_handle);
	}
}

static atomic_t num_notifications;
static volatile size_t num_short_unsub_notifications;
uint8_t test_notify(struct bt_conn *conn, struct bt_gatt_subscribe_params *params, const void *data,
		    uint16_t length)
{
	if (data == NULL) {
		if (params->value_handle == chrc_handle) {
			num_short_unsub_notifications++;
			SET_FLAG(flag_short_unsubscribed);
		}

		return BT_GATT_ITER_CONTINUE;
	}

	printk("Received notification #%ld with length %d\n", (long)atomic_inc(&num_notifications),
	       length);

	return BT_GATT_ITER_CONTINUE;
}

static void arm_short_unsubscribe(void)
{
	num_short_unsub_notifications = 0;
	UNSET_FLAG(flag_short_unsubscribed);
}

static void wait_for_short_unsubscribe(void)
{
	WAIT_FOR_FLAG(flag_short_unsubscribed);
	TEST_ASSERT(num_short_unsub_notifications == 1,
		    "Expected exactly one unsubscribe notification, got %zu",
		    num_short_unsub_notifications);
}

static struct bt_gatt_discover_params disc_params_short;
static struct bt_gatt_subscribe_params sub_params_short = {
	.notify = test_notify,
	.subscribe = test_short_subscribed,
	.ccc_handle = BT_GATT_AUTO_DISCOVER_CCC_HANDLE,
	.disc_params = &disc_params_short,
	.end_handle = BT_ATT_LAST_ATTRIBUTE_HANDLE,
	.value = BT_GATT_CCC_NOTIFY,
};
static struct bt_gatt_discover_params disc_params_long;
static struct bt_gatt_subscribe_params sub_params_long = {
	.notify = test_notify,
	.subscribe = test_long_subscribed,
	.ccc_handle = BT_GATT_AUTO_DISCOVER_CCC_HANDLE,
	.disc_params = &disc_params_long,
	.end_handle = BT_ATT_LAST_ATTRIBUTE_HANDLE,
	.value = BT_GATT_CCC_NOTIFY,
};

static void gatt_subscribe_short(enum bt_att_chan_opt opt)
{
	int err;

	sub_params_short.value = BT_GATT_CCC_NOTIFY;
	sub_params_short.value_handle = chrc_handle;
	sub_params_short.chan_opt = opt;
	err = bt_gatt_subscribe(g_conn, &sub_params_short);
	if (err < 0) {
		TEST_FAIL("Failed to subscribe");
	} else {
		printk("Subscribe request sent\n");
	}
}

static void gatt_unsubscribe_short(enum bt_att_chan_opt opt)
{
	int err;

	sub_params_short.value_handle = chrc_handle;
	sub_params_short.chan_opt = opt;
	err = bt_gatt_unsubscribe(g_conn, &sub_params_short);
	if (err < 0) {
		TEST_FAIL("Failed to unsubscribe");
	} else {
		printk("Unsubscribe request sent\n");
	}
}

static void gatt_subscribe_long(enum bt_att_chan_opt opt)
{
	int err;

	UNSET_FLAG(flag_long_subscribed);
	sub_params_long.value_handle = long_chrc_handle;
	sub_params_long.chan_opt = opt;
	err = bt_gatt_subscribe(g_conn, &sub_params_long);
	if (err < 0) {
		TEST_FAIL("Failed to subscribe");
	} else {
		printk("Subscribe request sent\n");
	}
}

static void gatt_unsubscribe_long(enum bt_att_chan_opt opt)
{
	int err;

	UNSET_FLAG(flag_long_subscribed);
	sub_params_long.value_handle = long_chrc_handle;
	sub_params_long.chan_opt = opt;
	err = bt_gatt_unsubscribe(g_conn, &sub_params_long);
	if (err < 0) {
		TEST_FAIL("Failed to unsubscribe");
	} else {
		printk("Unsubscribe request sent\n");
	}
}

static int try_unsubscribe_short(enum bt_att_chan_opt opt)
{
	sub_params_short.value_handle = chrc_handle;
	sub_params_short.chan_opt = opt;

	return bt_gatt_unsubscribe(g_conn, &sub_params_short);
}

static const uint8_t write_data[] = { 0x01, 0x02, 0x03, 0x04 };

static uint8_t read_func(struct bt_conn *conn, uint8_t err, struct bt_gatt_read_params *params,
			 const void *data, uint16_t length)
{
	if (err != 0) {
		TEST_FAIL("Read failed (err %u)", err);
	}

	if (data == NULL) {
		SET_FLAG(flag_read_complete);
		return BT_GATT_ITER_STOP;
	}

	return BT_GATT_ITER_CONTINUE;
}

static struct bt_gatt_read_params read_params;

static void gatt_read(enum bt_att_chan_opt opt)
{
	int err;

	read_params.func = read_func;
	read_params.handle_count = 1;
	read_params.single.handle = chrc_handle;
	read_params.single.offset = 0;
	read_params.chan_opt = opt;

	UNSET_FLAG(flag_read_complete);
	err = bt_gatt_read(g_conn, &read_params);
	if (err != 0) {
		TEST_FAIL("bt_gatt_read failed (err %d)", err);
	}
}

static void write_func(struct bt_conn *conn, uint8_t err, struct bt_gatt_write_params *params)
{
	if (err != 0) {
		TEST_FAIL("Write failed (err %u)", err);
	}

	SET_FLAG(flag_write_complete);
}

static struct bt_gatt_write_params write_params;

static void gatt_write(enum bt_att_chan_opt opt)
{
	int err;

	write_params.func = write_func;
	write_params.handle = write_chrc_handle;
	write_params.offset = 0;
	write_params.data = write_data;
	write_params.length = sizeof(write_data);
	write_params.chan_opt = opt;

	UNSET_FLAG(flag_write_complete);
	err = bt_gatt_write(g_conn, &write_params);
	if (err != 0) {
		TEST_FAIL("bt_gatt_write failed (err %d)", err);
	}
}

static void setup(void)
{
	int err;

	err = bt_enable(NULL);
	if (err != 0) {
		TEST_FAIL("Bluetooth discover failed (err %d)", err);
	}

	err = bt_le_scan_start(BT_LE_SCAN_PASSIVE, device_found);
	if (err != 0) {
		TEST_FAIL("Scanning failed to start (err %d)", err);
	}

	printk("Scanning successfully started\n");

	WAIT_FOR_FLAG(flag_is_connected);

	err = bt_conn_set_security(g_conn, BT_SECURITY_L2);
	if (err) {
		TEST_FAIL("Starting encryption procedure failed (%d)", err);
	}

	WAIT_FOR_FLAG(flag_is_encrypted);

	while (bt_eatt_count(g_conn) < CONFIG_BT_EATT_MAX) {
		k_sleep(K_MSEC(10));
	}

	printk("EATT connected\n");
}

static void test_main_none(void)
{
	setup();

	gatt_discover(BT_ATT_CHAN_OPT_NONE);
	gatt_subscribe_short(BT_ATT_CHAN_OPT_NONE);
	gatt_subscribe_long(BT_ATT_CHAN_OPT_NONE);
	WAIT_FOR_FLAG(flag_short_subscribed);
	WAIT_FOR_FLAG(flag_long_subscribed);
	printk("Subscribed\n");

	while (atomic_get(&num_notifications) < NOTIFICATION_COUNT) {
		k_sleep(K_MSEC(100));
	}

	gatt_unsubscribe_short(BT_ATT_CHAN_OPT_NONE);
	gatt_unsubscribe_long(BT_ATT_CHAN_OPT_NONE);
	WAIT_FOR_FLAG(flag_short_subscribed);
	WAIT_FOR_FLAG(flag_long_subscribed);

	printk("Unsubscribed\n");

	TEST_PASS("GATT client Passed");
}

static void test_main_unenhanced(void)
{
	setup();

	gatt_discover(BT_ATT_CHAN_OPT_UNENHANCED_ONLY);
	gatt_subscribe_short(BT_ATT_CHAN_OPT_UNENHANCED_ONLY);
	gatt_subscribe_long(BT_ATT_CHAN_OPT_UNENHANCED_ONLY);
	WAIT_FOR_FLAG(flag_short_subscribed);
	WAIT_FOR_FLAG(flag_long_subscribed);

	printk("Subscribed\n");

	while (atomic_get(&num_notifications) < NOTIFICATION_COUNT) {
		k_sleep(K_MSEC(100));
	}

	gatt_unsubscribe_short(BT_ATT_CHAN_OPT_UNENHANCED_ONLY);
	gatt_unsubscribe_long(BT_ATT_CHAN_OPT_UNENHANCED_ONLY);
	WAIT_FOR_FLAG(flag_short_subscribed);
	WAIT_FOR_FLAG(flag_long_subscribed);

	printk("Unsubscribed\n");

	TEST_PASS("GATT client Passed");
}

static void test_main_enhanced(void)
{
	setup();

	gatt_discover(BT_ATT_CHAN_OPT_ENHANCED_ONLY);
	gatt_subscribe_short(BT_ATT_CHAN_OPT_ENHANCED_ONLY);
	gatt_subscribe_long(BT_ATT_CHAN_OPT_ENHANCED_ONLY);
	WAIT_FOR_FLAG(flag_short_subscribed);
	WAIT_FOR_FLAG(flag_long_subscribed);

	printk("Subscribed\n");

	while (atomic_get(&num_notifications) < NOTIFICATION_COUNT) {
		k_sleep(K_MSEC(100));
	}

	gatt_unsubscribe_short(BT_ATT_CHAN_OPT_ENHANCED_ONLY);
	gatt_unsubscribe_long(BT_ATT_CHAN_OPT_ENHANCED_ONLY);
	WAIT_FOR_FLAG(flag_short_subscribed);
	WAIT_FOR_FLAG(flag_long_subscribed);

	printk("Unsubscribed\n");

	TEST_PASS("GATT client Passed");
}

static void test_main_mixed(void)
{
	setup();

	gatt_discover(BT_ATT_CHAN_OPT_ENHANCED_ONLY);
	gatt_subscribe_short(BT_ATT_CHAN_OPT_ENHANCED_ONLY);
	gatt_subscribe_long(BT_ATT_CHAN_OPT_UNENHANCED_ONLY);
	WAIT_FOR_FLAG(flag_short_subscribed);
	WAIT_FOR_FLAG(flag_long_subscribed);

	printk("Subscribed\n");

	while (atomic_get(&num_notifications) < NOTIFICATION_COUNT) {
		k_sleep(K_MSEC(100));
	}

	gatt_unsubscribe_short(BT_ATT_CHAN_OPT_UNENHANCED_ONLY);
	gatt_unsubscribe_long(BT_ATT_CHAN_OPT_ENHANCED_ONLY);
	WAIT_FOR_FLAG(flag_short_subscribed);
	WAIT_FOR_FLAG(flag_long_subscribed);

	printk("Unsubscribed\n");

	TEST_PASS("GATT client Passed");
}

static void test_main_racy(void)
{
	setup();

	gatt_discover(BT_ATT_CHAN_OPT_UNENHANCED_ONLY);

	gatt_subscribe_short(BT_ATT_CHAN_OPT_UNENHANCED_ONLY);
	WAIT_FOR_FLAG(flag_short_subscribed);

	UNSET_FLAG(flag_short_subscribed);
	gatt_unsubscribe_short(BT_ATT_CHAN_OPT_UNENHANCED_ONLY);
	wait_for_short_unsubscribe();

	UNSET_FLAG(flag_short_subscribed);
	arm_short_unsubscribe();
	gatt_subscribe_short(BT_ATT_CHAN_OPT_UNENHANCED_ONLY);
	gatt_unsubscribe_short(BT_ATT_CHAN_OPT_UNENHANCED_ONLY);

	wait_for_short_unsubscribe();

	UNSET_FLAG(flag_short_subscribed);
	arm_short_unsubscribe();
	gatt_subscribe_short(BT_ATT_CHAN_OPT_UNENHANCED_ONLY);
	gatt_subscribe_long(BT_ATT_CHAN_OPT_UNENHANCED_ONLY);
	WAIT_FOR_FLAG(flag_short_subscribed);
	WAIT_FOR_FLAG(flag_long_subscribed);
	printk("Subscribed\n");

	while (atomic_get(&num_notifications) < NOTIFICATION_COUNT) {
		k_sleep(K_MSEC(100));
	}

	gatt_unsubscribe_short(BT_ATT_CHAN_OPT_UNENHANCED_ONLY);
	gatt_unsubscribe_long(BT_ATT_CHAN_OPT_UNENHANCED_ONLY);
	WAIT_FOR_FLAG(flag_short_subscribed);
	WAIT_FOR_FLAG(flag_long_subscribed);

	printk("Unsubscribed\n");

	TEST_PASS("GATT client Passed");
}

static void test_main_reentrant(void)
{
	int err;

	setup();

	gatt_discover(BT_ATT_CHAN_OPT_NONE);

	gatt_subscribe_short(BT_ATT_CHAN_OPT_NONE);
	WAIT_FOR_FLAG(flag_short_subscribed);
	UNSET_FLAG(flag_short_subscribed);
	gatt_unsubscribe_short(BT_ATT_CHAN_OPT_NONE);
	wait_for_short_unsubscribe();

	UNSET_FLAG(flag_short_subscribed);
	arm_short_unsubscribe();
	gatt_subscribe_short(BT_ATT_CHAN_OPT_NONE);
	gatt_unsubscribe_short(BT_ATT_CHAN_OPT_NONE);
	wait_for_short_unsubscribe();

	err = try_unsubscribe_short(BT_ATT_CHAN_OPT_NONE);
	if (err != -EINVAL) {
		TEST_FAIL("Unsubscribe with no subscription: expected -EINVAL, got %d", err);
	}

	UNSET_FLAG(flag_short_subscribed);
	arm_short_unsubscribe();
	gatt_subscribe_short(BT_ATT_CHAN_OPT_NONE);
	err = try_unsubscribe_short(BT_ATT_CHAN_OPT_NONE);
	if (err != 0) {
		TEST_FAIL("Unsubscribe while subscribe pending: expected 0, got %d", err);
	}
	err = try_unsubscribe_short(BT_ATT_CHAN_OPT_NONE);
	if (err != -EINVAL) {
		TEST_FAIL("Repeated unsubscribe while pending: expected -EINVAL, got %d", err);
	}
	wait_for_short_unsubscribe();

	UNSET_FLAG(flag_short_subscribed);
	gatt_subscribe_short(BT_ATT_CHAN_OPT_NONE);
	WAIT_FOR_FLAG(flag_short_subscribed);

	UNSET_FLAG(flag_short_subscribed);
	arm_short_unsubscribe();
	err = try_unsubscribe_short(BT_ATT_CHAN_OPT_NONE);
	if (err != 0) {
		TEST_FAIL("Settled unsubscribe: expected 0, got %d", err);
	}
	wait_for_short_unsubscribe();
	err = try_unsubscribe_short(BT_ATT_CHAN_OPT_NONE);
	if (err != -EINVAL) {
		TEST_FAIL("Repeated settled unsubscribe: expected -EINVAL, got %d", err);
	}

	UNSET_FLAG(flag_short_subscribed);
	arm_short_unsubscribe();
	gatt_subscribe_short(BT_ATT_CHAN_OPT_NONE);
	gatt_subscribe_long(BT_ATT_CHAN_OPT_NONE);
	WAIT_FOR_FLAG(flag_short_subscribed);
	WAIT_FOR_FLAG(flag_long_subscribed);
	printk("Subscribed\n");

	while (atomic_get(&num_notifications) < NOTIFICATION_COUNT) {
		k_sleep(K_MSEC(100));
	}

	gatt_unsubscribe_short(BT_ATT_CHAN_OPT_NONE);
	gatt_unsubscribe_long(BT_ATT_CHAN_OPT_NONE);
	WAIT_FOR_FLAG(flag_short_subscribed);
	WAIT_FOR_FLAG(flag_long_subscribed);

	printk("Unsubscribed\n");

	TEST_PASS("GATT client Passed");
}

static void test_main_crosstraffic(void)
{
	setup();

	gatt_discover(BT_ATT_CHAN_OPT_UNENHANCED_ONLY);

	gatt_subscribe_short(BT_ATT_CHAN_OPT_UNENHANCED_ONLY);
	WAIT_FOR_FLAG(flag_short_subscribed);
	UNSET_FLAG(flag_short_subscribed);
	gatt_unsubscribe_short(BT_ATT_CHAN_OPT_UNENHANCED_ONLY);
	wait_for_short_unsubscribe();

	UNSET_FLAG(flag_short_subscribed);
	gatt_subscribe_short(BT_ATT_CHAN_OPT_UNENHANCED_ONLY);
	gatt_read(BT_ATT_CHAN_OPT_UNENHANCED_ONLY);
	gatt_write(BT_ATT_CHAN_OPT_UNENHANCED_ONLY);
	WAIT_FOR_FLAG(flag_short_subscribed);
	WAIT_FOR_FLAG(flag_read_complete);
	WAIT_FOR_FLAG(flag_write_complete);

	UNSET_FLAG(flag_short_subscribed);
	arm_short_unsubscribe();
	gatt_unsubscribe_short(BT_ATT_CHAN_OPT_UNENHANCED_ONLY);
	gatt_read(BT_ATT_CHAN_OPT_UNENHANCED_ONLY);
	gatt_write(BT_ATT_CHAN_OPT_UNENHANCED_ONLY);
	wait_for_short_unsubscribe();
	WAIT_FOR_FLAG(flag_read_complete);
	WAIT_FOR_FLAG(flag_write_complete);

	UNSET_FLAG(flag_short_subscribed);
	arm_short_unsubscribe();
	gatt_subscribe_short(BT_ATT_CHAN_OPT_UNENHANCED_ONLY);
	gatt_unsubscribe_short(BT_ATT_CHAN_OPT_UNENHANCED_ONLY);
	gatt_read(BT_ATT_CHAN_OPT_UNENHANCED_ONLY);
	gatt_write(BT_ATT_CHAN_OPT_UNENHANCED_ONLY);
	wait_for_short_unsubscribe();
	WAIT_FOR_FLAG(flag_read_complete);
	WAIT_FOR_FLAG(flag_write_complete);

	UNSET_FLAG(flag_short_subscribed);
	arm_short_unsubscribe();
	gatt_subscribe_short(BT_ATT_CHAN_OPT_UNENHANCED_ONLY);
	gatt_subscribe_long(BT_ATT_CHAN_OPT_UNENHANCED_ONLY);
	WAIT_FOR_FLAG(flag_short_subscribed);
	WAIT_FOR_FLAG(flag_long_subscribed);
	printk("Subscribed\n");

	while (atomic_get(&num_notifications) < NOTIFICATION_COUNT) {
		k_sleep(K_MSEC(100));
	}

	gatt_unsubscribe_short(BT_ATT_CHAN_OPT_UNENHANCED_ONLY);
	gatt_unsubscribe_long(BT_ATT_CHAN_OPT_UNENHANCED_ONLY);
	WAIT_FOR_FLAG(flag_short_subscribed);
	WAIT_FOR_FLAG(flag_long_subscribed);

	printk("Unsubscribed\n");

	TEST_PASS("GATT client Passed");
}

static void test_both_subscribed(struct bt_conn *conn, uint8_t err,
				 struct bt_gatt_subscribe_params *params)
{
	TEST_ASSERT(err == 0U, "Subscribe failed (err %u)", err);

	SET_FLAG(flag_both_subscribed);
}

static atomic_t num_both_values;

static uint8_t test_both_notify(struct bt_conn *conn, struct bt_gatt_subscribe_params *params,
				const void *data, uint16_t length)
{
	if (data != NULL) {
		printk("Received value #%ld with length %u\n", (long)atomic_inc(&num_both_values),
		       length);
	}

	return BT_GATT_ITER_CONTINUE;
}

static struct bt_gatt_discover_params disc_params_both;
static struct bt_gatt_subscribe_params sub_params_both = {
	.notify = test_both_notify,
	.subscribe = test_both_subscribed,
	.ccc_handle = BT_GATT_AUTO_DISCOVER_CCC_HANDLE,
	.disc_params = &disc_params_both,
	.end_handle = BT_ATT_LAST_ATTRIBUTE_HANDLE,
	.value = BT_GATT_CCC_NOTIFY | BT_GATT_CCC_INDICATE,
};

static void test_main_broadcast(void)
{
	int err;

	setup();

	gatt_discover(BT_ATT_CHAN_OPT_NONE);
	TEST_ASSERT(both_chrc_handle != 0U, "Did not discover both_chrc");

	sub_params_both.value_handle = both_chrc_handle;
	err = bt_gatt_subscribe(g_conn, &sub_params_both);
	TEST_ASSERT(err == 0, "Failed to subscribe (err %d)", err);
	WAIT_FOR_FLAG(flag_both_subscribed);

	/* The server broadcasts one indication and one notification */
	while (atomic_get(&num_both_values) < 2) {
		k_sleep(K_MSEC(10));
	}

	TEST_PASS_AND_EXIT("GATT client passed");
}

static void test_main_reserved_bit(void)
{
	int err;

	setup();

	gatt_discover(BT_ATT_CHAN_OPT_NONE);

	/* A server ignores a Reserved bit that a client sets anyway (Core 6.3,
	 * Vol 1, Part E, Section 2.4.1).
	 */
	sub_params_short.value = BT_GATT_CCC_NOTIFY | BIT(2);
	sub_params_short.value_handle = chrc_handle;
	err = bt_gatt_subscribe(g_conn, &sub_params_short);
	TEST_ASSERT(err == 0, "Failed to subscribe (err %d)", err);
	WAIT_FOR_FLAG(flag_short_subscribed);

	while (atomic_get(&num_notifications) < 1) {
		k_sleep(K_MSEC(10));
	}

	TEST_PASS_AND_EXIT("GATT client passed");
}

static atomic_t reads_outstanding;

static uint8_t fill_read_done(struct bt_conn *conn, uint8_t err, struct bt_gatt_read_params *params,
			      const void *data, uint16_t length)
{
	TEST_ASSERT(err == 0U, "Read failed (err %u)", err);

	(void)atomic_dec(&reads_outstanding);

	return BT_GATT_ITER_STOP;
}

/* Nothing waits for an ATT request on the thread that runs this, so a subscribe here fails at once
 * when they are used up
 */
static uint8_t fill_read_func(struct bt_conn *conn, uint8_t err, struct bt_gatt_read_params *params,
			      const void *data, uint16_t length)
{
	static struct bt_gatt_read_params fill_params[CONFIG_BT_ATT_TX_COUNT];
	int sub_err;

	TEST_ASSERT(err == 0U, "Read failed (err %u)", err);

	ARRAY_FOR_EACH_PTR(fill_params, fill) {
		fill->func = fill_read_done;
		fill->handle_count = 1;
		fill->single.handle = chrc_handle;

		if (bt_gatt_read(conn, fill) != 0) {
			break;
		}

		(void)atomic_inc(&reads_outstanding);
	}

	sub_params_short.value_handle = chrc_handle;
	sub_err = bt_gatt_subscribe(conn, &sub_params_short);
	TEST_ASSERT(sub_err == -ENOMEM, "Subscribe did not run out of requests (err %d)", sub_err);

	SET_FLAG(flag_read_complete);

	return BT_GATT_ITER_STOP;
}

/* A CCC discovery that could not start must not get in the way of the next subscribe */
static void test_main_subscribe_no_mem(void)
{
	int err;

	setup();

	gatt_discover(BT_ATT_CHAN_OPT_NONE);

	read_params.func = fill_read_func;
	read_params.handle_count = 1;
	read_params.single.handle = chrc_handle;
	err = bt_gatt_read(g_conn, &read_params);
	TEST_ASSERT(err == 0, "Failed to read (err %d)", err);
	WAIT_FOR_FLAG(flag_read_complete);

	while (atomic_get(&reads_outstanding) > 0) {
		k_sleep(K_MSEC(10));
	}

	err = bt_gatt_subscribe(g_conn, &sub_params_short);
	TEST_ASSERT(err == 0, "Failed to subscribe (err %d)", err);
	WAIT_FOR_FLAG(flag_short_subscribed);

	while (atomic_get(&num_notifications) < 1) {
		k_sleep(K_MSEC(10));
	}

	TEST_PASS_AND_EXIT("GATT client passed");
}

static const struct bst_test_instance test_vcs[] = {
	{
		.test_id = "gatt_client_none",
		.test_main_f = test_main_none,
	},
	{
		.test_id = "gatt_client_unenhanced",
		.test_main_f = test_main_unenhanced,
	},
	{
		.test_id = "gatt_client_enhanced",
		.test_main_f = test_main_enhanced,
	},
	{
		.test_id = "gatt_client_mixed",
		.test_main_f = test_main_mixed,
	},
	{
		.test_id = "gatt_client_racy",
		.test_main_f = test_main_racy,
	},
	{
		.test_id = "gatt_client_reentrant",
		.test_main_f = test_main_reentrant,
	},
	{
		.test_id = "gatt_client_crosstraffic",
		.test_main_f = test_main_crosstraffic,
	},
	{
		.test_id = "gatt_client_broadcast",
		.test_main_f = test_main_broadcast,
	},
	{
		.test_id = "gatt_client_reserved_bit",
		.test_main_f = test_main_reserved_bit,
	},
	{
		.test_id = "gatt_client_subscribe_no_mem",
		.test_main_f = test_main_subscribe_no_mem,
	},
	BSTEST_END_MARKER,
};

struct bst_test_list *test_gatt_client_install(struct bst_test_list *tests)
{
	return bst_add_tests(tests, test_vcs);
}
```

## src/gatt_server_test.c
```c
/*
 * Copyright (c) 2022 Nordic Semiconductor ASA
 * Copyright (c) 2026 Xiaomi Corporation
 *
 * SPDX-License-Identifier: Apache-2.0
 */
#include <stddef.h>
#include <errno.h>

#include <zephyr/kernel.h>
#include <zephyr/types.h>
#include <zephyr/bluetooth/bluetooth.h>
#include <zephyr/bluetooth/hci.h>
#include <zephyr/bluetooth/conn.h>
#include <zephyr/bluetooth/uuid.h>
#include <zephyr/bluetooth/gatt.h>

#include "babblekit/testcase.h"
#include "babblekit/flags.h"
#include "common.h"

extern enum bst_result_t bst_result;

DEFINE_FLAG_STATIC(flag_is_connected);
DEFINE_FLAG_STATIC(flag_short_subscribe);
DEFINE_FLAG_STATIC(flag_long_subscribe);
DEFINE_FLAG_STATIC(flag_both_subscribe);
DEFINE_FLAG_STATIC(flag_both_indicated);
DEFINE_FLAG_STATIC(flag_both_notified);

static struct bt_conn *g_conn;

#define ARRAY_ITEM(i, _) i
const uint8_t chrc_data[] = { LISTIFY(CHRC_SIZE, ARRAY_ITEM, (,)) }; /* 1, 2, 3 ... */
const uint8_t long_chrc_data[] = { LISTIFY(LONG_CHRC_SIZE, ARRAY_ITEM, (,)) }; /* 1, 2, 3 ... */

static void connected(struct bt_conn *conn, uint8_t err)
{
	if (err != 0) {
		TEST_FAIL("Failed to connect to %s (%u)", bt_conn_dst_str(conn), err);
		return;
	}

	printk("Connected to %s\n", bt_conn_dst_str(conn));

	g_conn = bt_conn_ref(conn);
	SET_FLAG(flag_is_connected);
}

static void disconnected(struct bt_conn *conn, uint8_t reason)
{
	if (conn != g_conn) {
		return;
	}

	printk("Disconnected: %s (reason 0x%02x)\n", bt_conn_dst_str(conn), reason);

	bt_conn_drop(&g_conn);

	UNSET_FLAG(flag_is_connected);
}

BT_CONN_CB_DEFINE(conn_callbacks) = {
	.connected = connected,
	.disconnected = disconnected,
};

static ssize_t read_test_chrc(struct bt_conn *conn, const struct bt_gatt_attr *attr, void *buf,
			      uint16_t len, uint16_t offset)
{
	printk("Read short\n");
	return bt_gatt_attr_read(conn, attr, buf, len, offset, (void *)chrc_data,
				 sizeof(chrc_data));
}

static ssize_t read_long_test_chrc(struct bt_conn *conn, const struct bt_gatt_attr *attr, void *buf,
				   uint16_t len, uint16_t offset)
{
	printk("Read long\n");
	return bt_gatt_attr_read(conn, attr, buf, len, offset, (void *)long_chrc_data,
				 sizeof(long_chrc_data));
}

static void short_subscribe(const struct bt_gatt_attr *attr, uint16_t value)
{
	const bool notif_enabled = (value == BT_GATT_CCC_NOTIFY);

	if (notif_enabled) {
		SET_FLAG(flag_short_subscribe);
	}

	printk("Short notifications %s\n", notif_enabled ? "enabled" : "disabled");
}

static void long_subscribe(const struct bt_gatt_attr *attr, uint16_t value)
{
	const bool notif_enabled = (value == BT_GATT_CCC_NOTIFY);

	if (notif_enabled) {
		SET_FLAG(flag_long_subscribe);
	}

	printk("Long notifications %s\n", notif_enabled ? "enabled" : "disabled");
}

static void both_subscribe(const struct bt_gatt_attr *attr, uint16_t value)
{
	if (value == (BT_GATT_CCC_NOTIFY | BT_GATT_CCC_INDICATE)) {
		SET_FLAG(flag_both_subscribe);
	}
}

static uint8_t write_chrc_data[CHRC_SIZE];

static ssize_t write_test_chrc(struct bt_conn *conn, const struct bt_gatt_attr *attr,
			       const void *buf, uint16_t len, uint16_t offset, uint8_t flags)
{
	printk("Write chrc\n");

	if (offset + len > sizeof(write_chrc_data)) {
		return BT_GATT_ERR(BT_ATT_ERR_INVALID_OFFSET);
	}

	(void)memcpy(write_chrc_data + offset, buf, len);

	return len;
}

BT_GATT_SERVICE_DEFINE(test_svc, BT_GATT_PRIMARY_SERVICE(TEST_SERVICE_UUID),
		       BT_GATT_CHARACTERISTIC(TEST_CHRC_UUID,
					      BT_GATT_CHRC_NOTIFY | BT_GATT_CHRC_READ,
					      BT_GATT_PERM_READ, read_test_chrc, NULL, NULL),
		       BT_GATT_CUD("Short test_svc format description", BT_GATT_PERM_READ),
		       BT_GATT_CCC(short_subscribe, BT_GATT_PERM_READ | BT_GATT_PERM_WRITE),
		       BT_GATT_CHARACTERISTIC(TEST_LONG_CHRC_UUID,
					      BT_GATT_CHRC_NOTIFY | BT_GATT_CHRC_READ,
					      BT_GATT_PERM_READ, read_long_test_chrc, NULL, NULL),
		       BT_GATT_CCC(long_subscribe, BT_GATT_PERM_READ | BT_GATT_PERM_WRITE),
		       BT_GATT_CHARACTERISTIC(TEST_WRITE_CHRC_UUID,
					      BT_GATT_CHRC_WRITE | BT_GATT_CHRC_WRITE_WITHOUT_RESP,
					      BT_GATT_PERM_WRITE, NULL, write_test_chrc, NULL),
		       BT_GATT_CHARACTERISTIC(TEST_BOTH_CHRC_UUID,
					      BT_GATT_CHRC_NOTIFY | BT_GATT_CHRC_INDICATE |
						      BT_GATT_CHRC_READ,
					      BT_GATT_PERM_READ, read_test_chrc, NULL, NULL),
		       BT_GATT_CCC(both_subscribe, BT_GATT_PERM_READ | BT_GATT_PERM_WRITE));

static volatile size_t num_notifications_sent;

static void notification_sent(struct bt_conn *conn, void *user_data)
{
	size_t *length = user_data;

	printk("Sent notification #%u with length %d\n", num_notifications_sent++, *length);
}

static void short_notify(enum bt_att_chan_opt opt)
{
	static size_t length = CHRC_SIZE;
	static struct bt_gatt_notify_params params = {
		.attr = &attr_test_svc[1],
		.data = chrc_data,
		.len = CHRC_SIZE,
		.func = notification_sent,
		.user_data = &length,
		.uuid = NULL,
	};
	int err;

	params.chan_opt = opt;

	do {
		err = bt_gatt_notify_cb(g_conn, &params);

		if (err == -ENOMEM) {
			k_sleep(K_MSEC(10));
		} else if (err) {
			TEST_FAIL("Short notify failed (err %d)", err);
		}
	} while (err);
}

static void long_notify(enum bt_att_chan_opt opt)
{
	static size_t length = LONG_CHRC_SIZE;
	static struct bt_gatt_notify_params params = {
		.attr = &attr_test_svc[5],
		.data = long_chrc_data,
		.len = LONG_CHRC_SIZE,
		.func = notification_sent,
		.user_data = &length,
		.uuid = NULL,
	};
	int err;

	params.chan_opt = opt;

	do {
		err = bt_gatt_notify_cb(g_conn, &params);

		if (err == -ENOMEM) {
			k_sleep(K_MSEC(10));
		} else if (err) {
			TEST_FAIL("Long notify failed (err %d)", err);
		}
	} while (err);
}

static void advertise_and_wait_connected(void)
{
	int err;
	const struct bt_data ad[] = {
		BT_DATA_BYTES(BT_DATA_FLAGS, (BT_LE_AD_GENERAL | BT_LE_AD_NO_BREDR)),
	};

	err = bt_enable(NULL);
	if (err != 0) {
		TEST_FAIL("Bluetooth init failed (err %d)", err);
		return;
	}

	printk("Bluetooth initialized\n");

	err = bt_le_adv_start(BT_LE_ADV_CONN_FAST_1, ad, ARRAY_SIZE(ad), NULL, 0);
	if (err != 0) {
		TEST_FAIL("Advertising failed to start (err %d)", err);
		return;
	}

	printk("Advertising successfully started\n");

	WAIT_FOR_FLAG(flag_is_connected);
}

static void setup(void)
{
	advertise_and_wait_connected();

	while (bt_eatt_count(g_conn) < CONFIG_BT_EATT_MAX) {
		k_sleep(K_MSEC(100));
	}
	printk("EATT connected\n");

	WAIT_FOR_FLAG(flag_short_subscribe);
	WAIT_FOR_FLAG(flag_long_subscribe);
}

static void test_main_none(void)
{
	setup();

	for (int i = 0; i < NOTIFICATION_COUNT / 2; i++) {
		short_notify(BT_ATT_CHAN_OPT_NONE);
		long_notify(BT_ATT_CHAN_OPT_NONE);
	}

	while (num_notifications_sent < NOTIFICATION_COUNT) {
		k_sleep(K_MSEC(100));
	}

	TEST_PASS("GATT server passed");
}

static void test_main_enhanced(void)
{
	setup();

	for (int i = 0; i < NOTIFICATION_COUNT / 2; i++) {
		short_notify(BT_ATT_CHAN_OPT_ENHANCED_ONLY);
		long_notify(BT_ATT_CHAN_OPT_ENHANCED_ONLY);
	}

	while (num_notifications_sent < NOTIFICATION_COUNT) {
		k_sleep(K_MSEC(100));
	}

	TEST_PASS("GATT server passed");
}

static void test_main_unenhanced(void)
{
	setup();

	for (int i = 0; i < NOTIFICATION_COUNT / 2; i++) {
		short_notify(BT_ATT_CHAN_OPT_UNENHANCED_ONLY);
		long_notify(BT_ATT_CHAN_OPT_UNENHANCED_ONLY);
	}

	while (num_notifications_sent < NOTIFICATION_COUNT) {
		k_sleep(K_MSEC(100));
	}

	TEST_PASS("GATT server passed");
}

static void test_main_mixed(void)
{
	setup();

	for (int i = 0; i < NOTIFICATION_COUNT / 2; i++) {
		short_notify(BT_ATT_CHAN_OPT_UNENHANCED_ONLY);
		long_notify(BT_ATT_CHAN_OPT_ENHANCED_ONLY);
	}

	while (num_notifications_sent < NOTIFICATION_COUNT) {
		k_sleep(K_MSEC(100));
	}

	TEST_PASS("GATT server passed");
}

static void both_indicated(struct bt_conn *conn, struct bt_gatt_indicate_params *params,
			   uint8_t err)
{
	TEST_ASSERT(err == 0U, "Indication failed (err 0x%02x)", err);

	SET_FLAG(flag_both_indicated);
}

static void both_notified(struct bt_conn *conn, void *user_data)
{
	SET_FLAG(flag_both_notified);
}

/* A client may enable notifications and indications at the same time, and is
 * then subscribed to both, so a broadcast of either kind has to reach it.
 */
static void test_main_broadcast(void)
{
	static struct bt_gatt_indicate_params ind_params = {
		.data = chrc_data,
		.len = CHRC_SIZE,
		.func = both_indicated,
	};
	static struct bt_gatt_notify_params ntf_params = {
		.data = chrc_data,
		.len = CHRC_SIZE,
		.func = both_notified,
	};
	const struct bt_gatt_attr *attr;
	int err;

	advertise_and_wait_connected();
	WAIT_FOR_FLAG(flag_both_subscribe);

	attr = bt_gatt_find_by_uuid(attr_test_svc, ARRAY_SIZE(attr_test_svc), TEST_BOTH_CHRC_UUID);
	TEST_ASSERT(attr != NULL, "Characteristic value not found");

	ind_params.attr = attr;
	err = bt_gatt_indicate(NULL, &ind_params);
	TEST_ASSERT(err == 0, "Indication broadcast failed (err %d)", err);
	WAIT_FOR_FLAG(flag_both_indicated);

	ntf_params.attr = attr;
	err = bt_gatt_notify_cb(NULL, &ntf_params);
	TEST_ASSERT(err == 0, "Notification broadcast failed (err %d)", err);
	WAIT_FOR_FLAG(flag_both_notified);

	/* The client ends the simulation once it has received both values */
	TEST_PASS("GATT server passed");
}

/* A client that sets a Reserved bit next to the notify bit is subscribed:
 * short_subscribe(), which compares the value with BT_GATT_CCC_NOTIFY, has to
 * see it that way, and a notification sent to all peers has to reach it.
 */
static void test_main_reserved_bit(void)
{
	int err;

	advertise_and_wait_connected();
	WAIT_FOR_FLAG(flag_short_subscribe);

	err = bt_gatt_notify(NULL, &attr_test_svc[1], chrc_data, CHRC_SIZE);
	TEST_ASSERT(err == 0, "Notification broadcast failed (err %d)", err);

	/* The client ends the simulation once it has received the value */
	TEST_PASS("GATT server passed");
}

/* The client meets a new peer on every connection: the server takes a new identity address each
 * time
 */
static void test_main_many_peers(void)
{
	const struct bt_data ad[] = {
		BT_DATA_BYTES(BT_DATA_FLAGS, (BT_LE_AD_GENERAL | BT_LE_AD_NO_BREDR)),
	};
	/* gatt_client_many_peers goes through SUB_PEER_COUNT peers twice */
	const uint32_t conn_count = 2U * SUB_PEER_COUNT;
	struct bt_le_adv_param param = *BT_LE_ADV_CONN_FAST_1;
	int err;

	err = bt_enable(NULL);
	TEST_ASSERT(err == 0, "Bluetooth init failed (err %d)", err);

	err = bt_id_create(NULL, NULL);
	TEST_ASSERT(err > 0, "Failed to create an identity (err %d)", err);
	param.id = (uint8_t)err;

	for (uint32_t conn_idx = 0U; conn_idx < conn_count; conn_idx++) {
		if (conn_idx > 0U) {
			err = bt_id_reset(param.id, NULL, NULL);
			TEST_ASSERT(err == param.id, "Failed to reset the identity (err %d)", err);
		}

		err = bt_le_adv_start(&param, ad, ARRAY_SIZE(ad), NULL, 0);
		TEST_ASSERT(err == 0, "Advertising failed to start (err %d)", err);

		WAIT_FOR_FLAG(flag_is_connected);

		if (conn_idx < conn_count - 1U) {
			WAIT_FOR_FLAG_UNSET(flag_is_connected);
		}
	}

	/* The client ends the simulation once it is done with the last peer */
	TEST_PASS("GATT server passed");
}

static const struct bst_test_instance test_gatt_server[] = {
	{
		.test_id = "gatt_server_none",
		.test_main_f = test_main_none,
	},
	{
		.test_id = "gatt_server_unenhanced",
		.test_main_f = test_main_unenhanced,
	},
	{
		.test_id = "gatt_server_enhanced",
		.test_main_f = test_main_enhanced,
	},
	{
		.test_id = "gatt_server_mixed",
		.test_main_f = test_main_mixed,
	},
	{
		.test_id = "gatt_server_broadcast",
		.test_main_f = test_main_broadcast,
	},
	{
		.test_id = "gatt_server_reserved_bit",
		.test_main_f = test_main_reserved_bit,
	},
	{
		.test_id = "gatt_server_many_peers",
		.test_main_f = test_main_many_peers,
	},
	BSTEST_END_MARKER,
};

struct bst_test_list *test_gatt_server_install(struct bst_test_list *tests)
{
	return bst_add_tests(tests, test_gatt_server);
}
```
