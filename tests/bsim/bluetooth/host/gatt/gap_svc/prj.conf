## CMakeLists.txt
```
# SPDX-License-Identifier: Apache-2.0

cmake_minimum_required(VERSION 3.20.0)

find_package(Zephyr REQUIRED HINTS $ENV{ZEPHYR_BASE})

project(gap_svc)

add_subdirectory(${ZEPHYR_BASE}/tests/bluetooth/common/testlib testlib)
target_link_libraries(app PRIVATE testlib)

add_subdirectory(${ZEPHYR_BASE}/tests/bsim/babblekit babblekit)
target_link_libraries(app PRIVATE babblekit)

zephyr_include_directories(
  ${BSIM_COMPONENTS_PATH}/libUtilv1/src/
  ${BSIM_COMPONENTS_PATH}/libPhyComv1/src/
)

target_sources(app PRIVATE
  src/main.c
  src/central.c
  src/peripheral.c
)
```

## prj.conf
```kconfig
CONFIG_BT_TESTING=y

CONFIG_BT=y
CONFIG_BT_DEVICE_NAME="GapSvc"
CONFIG_BT_PERIPHERAL=y
CONFIG_BT_CENTRAL=y
CONFIG_BT_HRS=y
# Dependency of testlib/adv and testlib/scan.
CONFIG_BT_EXT_ADV=y

CONFIG_BT_AUTO_PHY_UPDATE=n
CONFIG_BT_GATT_AUTO_UPDATE_MTU=n
CONFIG_BT_AUTO_DATA_LEN_UPDATE=n
CONFIG_BT_GAP_AUTO_UPDATE_CONN_PARAMS=n

CONFIG_BT_GATT_AUTO_DISCOVER_CCC=y
CONFIG_BT_GATT_AUTO_RESUBSCRIBE=n

CONFIG_BT_SMP=y
CONFIG_BT_GATT_CLIENT=y


# Testing locally redefined SVC implementation
CONFIG_BT_GAP_SVC_DEFAULT_IMPL=n

CONFIG_BT_DEVICE_NAME_DYNAMIC=y
CONFIG_BT_DEVICE_NAME_GATT_WRITABLE=y

CONFIG_BT_DEVICE_APPEARANCE_DYNAMIC=y
CONFIG_BT_DEVICE_APPEARANCE_GATT_WRITABLE=y
# Do not care about parameters below - simpler GAP implementation
CONFIG_BT_PRIVACY=n
CONFIG_BT_GAP_PERIPHERAL_PREF_PARAMS=n

# Other libraries
CONFIG_LOG=y
CONFIG_ASSERT=y

CONFIG_THREAD_NAME=y
CONFIG_LOG_THREAD_ID_PREFIX=y

CONFIG_ARCH_POSIX_TRAP_ON_FATAL=y
```

## src/main.c
```c
/*
 * Copyright (c) 2025 Koppel Electronic
 *
 * SPDX-License-Identifier: Apache-2.0
 */

#include "bstests.h"

extern struct bst_test_list *test_local_gap_svc_central_install(struct bst_test_list *tests);
extern struct bst_test_list *test_local_gap_svc_peripheral_install(struct bst_test_list *tests);

bst_test_install_t test_installers[] = {
	test_local_gap_svc_central_install,
	test_local_gap_svc_peripheral_install,
	NULL
};

int main(void)
{
	bst_main();
	return 0;
}
```

## src/central.c
```c
/** @file
 *  @brief Test local GATT Generic Access Service - central role
 *
 *  @note Most of the original code from "../device_name/client.c" used here.
 */
/*
 * Copyright (c) 2025 Koppel Electronic
 * Copyright (c) 2025 Nordic Semiconductor ASA
 *
 * SPDX-License-Identifier: Apache-2.0
 */

#include <zephyr/kernel.h>
#include <zephyr/sys/byteorder.h>

#include <zephyr/bluetooth/bluetooth.h>
#include <zephyr/bluetooth/hci.h>
#include <zephyr/bluetooth/conn.h>
#include <zephyr/bluetooth/uuid.h>
#include <zephyr/bluetooth/gatt.h>

#include <zephyr/logging/log.h>

#include "testlib/att.h"
#include "testlib/att_read.h"
#include "testlib/att_write.h"
#include "testlib/conn.h"

#include "babblekit/testcase.h"

LOG_MODULE_REGISTER(central, LOG_LEVEL_DBG);

/* Wait time in microseconds for the test to be finished */
#define WAIT_TIME 10e6

static struct bt_conn *default_conn;
static struct bt_conn *connected_conn;
struct k_sem connected_sem;

static void start_scan(void);


static bool eir_found(struct bt_data *data, void *user_data)
{
	bt_addr_le_t *addr = user_data;

	printk("[AD]: %u data_len %u\n", data->type, data->data_len);

	switch (data->type) {
	case BT_DATA_UUID16_SOME:
	case BT_DATA_UUID16_ALL:
		if (data->data_len % sizeof(uint16_t) != 0U) {
			printk("AD malformed\n");
			return true;
		}

		for (int i = 0; i < data->data_len; i += sizeof(uint16_t)) {
			struct bt_conn_le_create_param *create_param;
			struct bt_le_conn_param *param;
			const struct bt_uuid *uuid;
			uint16_t u16;
			int err;

			memcpy(&u16, &data->data[i], sizeof(u16));
			uuid = BT_UUID_DECLARE_16(sys_le16_to_cpu(u16));
			if (bt_uuid_cmp(uuid, BT_UUID_HRS)) {
				continue;
			}

			err = bt_le_scan_stop();
			if (err) {
				printk("Stop LE scan failed (err %d)\n", err);
				continue;
			}

			printk("Creating connection with Coded PHY support\n");
			param = BT_LE_CONN_PARAM_DEFAULT;
			create_param = BT_CONN_LE_CREATE_CONN;
			create_param->options |= BT_CONN_LE_OPT_CODED;
			err = bt_conn_le_create(addr, create_param, param,
						&default_conn);
			if (err) {
				printk("Create connection with Coded PHY support failed (err %d)\n",
				       err);

				printk("Creating non-Coded PHY connection\n");
				create_param->options &= ~BT_CONN_LE_OPT_CODED;
				err = bt_conn_le_create(addr, create_param,
							param, &default_conn);
				if (err) {
					printk("Create connection failed (err %d)\n", err);
					start_scan();
				}
			}

			return false;
		}
	default:
		break;
	}

	return true;
}

static void device_found(const bt_addr_le_t *addr, int8_t rssi, uint8_t type,
			 struct net_buf_simple *ad)
{
	char dev[BT_ADDR_LE_STR_LEN];

	bt_addr_le_to_str(addr, dev, sizeof(dev));
	printk("[DEVICE]: %s, AD evt type %u, AD data len %u, RSSI %i\n",
	       dev, type, ad->len, rssi);

	/* We're only interested in legacy connectable events or
	 * possible extended advertising that are connectable.
	 */
	if (type == BT_GAP_ADV_TYPE_ADV_IND ||
	    type == BT_GAP_ADV_TYPE_ADV_DIRECT_IND ||
	    type == BT_GAP_ADV_TYPE_EXT_ADV) {
		bt_data_parse(ad, eir_found, (void *)addr);
	}
}

static void start_scan(void)
{
	int err;

	/* Use active scanning and disable duplicate filtering to handle any
	 * devices that might update their advertising data at runtime.
	 */
	struct bt_le_scan_param scan_param = {
		.type       = BT_LE_SCAN_TYPE_ACTIVE,
		.options    = BT_LE_SCAN_OPT_CODED,
		.interval   = BT_GAP_SCAN_FAST_INTERVAL,
		.window     = BT_GAP_SCAN_FAST_WINDOW,
	};

	err = bt_le_scan_start(&scan_param, device_found);
	if (err) {
		printk("Scanning with Coded PHY support failed (err %d)\n", err);

		printk("Scanning without Coded PHY\n");
		scan_param.options &= ~BT_LE_SCAN_OPT_CODED;
		err = bt_le_scan_start(&scan_param, device_found);
		if (err) {
			printk("Scanning failed to start (err %d)\n", err);
			return;
		}
	}

	printk("Scanning successfully started\n");
}


static void connected(struct bt_conn *conn, uint8_t conn_err)
{
	char addr[BT_ADDR_LE_STR_LEN];

	bt_addr_le_to_str(bt_conn_get_dst(conn), addr, sizeof(addr));

	if (conn_err) {
		printk("Failed to connect to %s (%u)\n", addr, conn_err);

		bt_conn_unref(default_conn);
		default_conn = NULL;

		start_scan();
		return;
	}

	printk("Connected: %s\n", addr);

	if (conn == default_conn) {
		connected_conn = bt_conn_ref(conn);
		k_sem_give(&connected_sem);
	}
}

static void disconnected(struct bt_conn *conn, uint8_t reason)
{
	char addr[BT_ADDR_LE_STR_LEN];

	bt_addr_le_to_str(bt_conn_get_dst(conn), addr, sizeof(addr));

	printk("Disconnected: %s, reason 0x%02x %s\n", addr, reason, bt_hci_err_to_str(reason));

	if (default_conn != conn) {
		return;
	}

	struct bt_conn *conn_to_unref;

	conn_to_unref = connected_conn;
	connected_conn = NULL;
	bt_conn_unref(conn_to_unref);

	conn_to_unref = default_conn;
	default_conn = NULL;
	bt_conn_unref(conn_to_unref);

	start_scan();
}

static struct bt_conn_cb conn_callbacks = {
	.connected = connected,
	.disconnected = disconnected,
};

static void test_gap_name(struct bt_conn *conn)
{
	int err;
	char server_new_name[CONFIG_BT_DEVICE_NAME_MAX] = CONFIG_BT_DEVICE_NAME"-up";
	uint16_t chrc_handle;

	NET_BUF_SIMPLE_DEFINE(attr_value_buf, BT_ATT_MAX_ATTRIBUTE_LEN);

	err = bt_testlib_gatt_discover_characteristic(&chrc_handle,
						      NULL, NULL, conn,
						      BT_UUID_GAP_DEVICE_NAME,
						      BT_ATT_FIRST_ATTRIBUTE_HANDLE,
						      BT_ATT_LAST_ATTRIBUTE_HANDLE);
	TEST_ASSERT(err == 0, "Device Name characteristic not found (err %d)", err);

	LOG_DBG("Device Name characteristic found at handle %u", chrc_handle);

	/* Read Device name */
	err = bt_testlib_att_read_by_handle_sync(&attr_value_buf, NULL, NULL, conn,
						BT_ATT_CHAN_OPT_UNENHANCED_ONLY, chrc_handle, 0);
	TEST_ASSERT(err == 0, "Failed to read characteristic (err %d)", err);

	LOG_DBG("Device Name of the server: %.*s", attr_value_buf.len, attr_value_buf.data);

	net_buf_simple_reset(&attr_value_buf);

	/* Write new Device name */
	err = bt_testlib_att_write(conn,
				   BT_ATT_CHAN_OPT_UNENHANCED_ONLY,
				   chrc_handle,
				   server_new_name,
				   sizeof(server_new_name));
	TEST_ASSERT(err == BT_ATT_ERR_SUCCESS, "Got ATT error: %d", err);

	/* Verify new Device name */
	err = bt_testlib_att_read_by_handle_sync(&attr_value_buf, NULL, NULL, conn,
						BT_ATT_CHAN_OPT_UNENHANCED_ONLY, chrc_handle, 0);
	TEST_ASSERT(err == 0, "Failed to read characteristic (err %d)", err);

	TEST_ASSERT(attr_value_buf.len == strlen(server_new_name),
			"Unexpected Device Name length: %u (!=%u)",
			attr_value_buf.len, strlen(server_new_name));
	TEST_ASSERT(memcmp(attr_value_buf.data, server_new_name, attr_value_buf.len) == 0,
			"Unexpected Device Name value: %.*s",
			attr_value_buf.len, attr_value_buf.data);

	net_buf_simple_reset(&attr_value_buf);
}

static void test_gap_appearance(struct bt_conn *conn)
{
	int err;
	uint16_t chrc_handle;
	uint16_t appearance;

	NET_BUF_SIMPLE_DEFINE(attr_value_buf, BT_ATT_MAX_ATTRIBUTE_LEN);

	err = bt_testlib_gatt_discover_characteristic(&chrc_handle,
						      NULL, NULL, conn,
						      BT_UUID_GAP_APPEARANCE,
						      BT_ATT_FIRST_ATTRIBUTE_HANDLE,
						      BT_ATT_LAST_ATTRIBUTE_HANDLE);
	TEST_ASSERT(err == 0, "Device Appearance characteristic not found (err %d)", err);

	LOG_DBG("Device Appearance characteristic found at handle %u", chrc_handle);

	/* Read Device appearance */
	err = bt_testlib_att_read_by_handle_sync(&attr_value_buf, NULL, NULL, conn,
						BT_ATT_CHAN_OPT_UNENHANCED_ONLY, chrc_handle, 0);
	TEST_ASSERT(err == 0, "Failed to read characteristic (err %d)", err);
	TEST_ASSERT(attr_value_buf.len == sizeof(appearance),
			"Unexpected Appearance length: %u (!=%u)",
			attr_value_buf.len, sizeof(uint16_t));
	appearance = sys_le16_to_cpu(*(uint16_t *)attr_value_buf.data);
	LOG_DBG("Device Appearance of the server: %.4x", appearance);
	net_buf_simple_reset(&attr_value_buf);

	/* Write new Device appearance */
	appearance += 0x100;
	err = bt_testlib_att_write(conn, BT_ATT_CHAN_OPT_UNENHANCED_ONLY, chrc_handle,
				   (char *)&appearance, sizeof(appearance));
	TEST_ASSERT(err == BT_ATT_ERR_SUCCESS, "Got ATT error: %d", err);
}

static void test_local_gap_svc_central_main(void)
{
	int err;
	struct bt_conn *conn;

	k_sem_init(&connected_sem, 0, 1);
	bt_conn_cb_register(&conn_callbacks);

	err = bt_enable(NULL);
	TEST_ASSERT(err == 0, "Cannot enable Bluetooth (err %d)", err);

	LOG_INF("Bluetooth initialized");

	start_scan();

	/* Wait for connection */
	k_sem_take(&connected_sem, K_FOREVER);

	conn = bt_conn_ref(connected_conn);

	err = bt_testlib_att_exchange_mtu(conn);
	TEST_ASSERT(err == 0, "Failed to update MTU (err %d)", err);

	test_gap_name(conn);
	test_gap_appearance(conn);

	bt_conn_unref(conn);

	TEST_PASS("client");
}

static void test_local_gap_svc_central_init(void)
{
	bst_ticker_set_next_tick_absolute(WAIT_TIME);
	TEST_START("test_local_gap_svc_central");
}

static void test_local_gap_svc_central_tick(bs_time_t HW_device_time)
{
	/*
	 * If in WAIT_TIME seconds the testcase did not already pass
	 * (and finish) we consider it failed
	 */
	if (bst_result != Passed) {
		TEST_FAIL("test_local_gap_svc_central failed (not passed after %d seconds)",
		     (int)(WAIT_TIME / 1e6));
	}
}



static const struct bst_test_instance test_central[] = {
	{
		.test_id = "central",
		.test_descr = "GAP service local reimplementation - central role.",
		.test_main_f = test_local_gap_svc_central_main,
		.test_pre_init_f = test_local_gap_svc_central_init,
		.test_tick_f = test_local_gap_svc_central_tick,
	},
	BSTEST_END_MARKER
};

struct bst_test_list *test_local_gap_svc_central_install(struct bst_test_list *tests)
{
	tests = bst_add_tests(tests, test_central);
	return tests;
}
```

## src/peripheral.c
```c
/** @file
 *  @brief Test local GATT Generic Access Service - peripheral role
 */
/*
 * Copyright (c) 2025 Koppel Electronic
 *
 * SPDX-License-Identifier: Apache-2.0
 */

#include <zephyr/kernel.h>
#include <zephyr/sys/byteorder.h>
#include <zephyr/bluetooth/bluetooth.h>
#include <zephyr/bluetooth/gatt.h>

#include <zephyr/logging/log.h>

#include "babblekit/testcase.h"


LOG_MODULE_REGISTER(peripheral, LOG_LEVEL_DBG);

BUILD_ASSERT(IS_ENABLED(CONFIG_BT_DEVICE_NAME_GATT_WRITABLE),
	     "This test requires BT_DEVICE_NAME_GATT_WRITABLE to be enabled");
BUILD_ASSERT(IS_ENABLED(CONFIG_BT_DEVICE_APPEARANCE_GATT_WRITABLE),
	     "This test requires BT_DEVICE_APPEARANCE_GATT_WRITABLE to be enabled");
BUILD_ASSERT(!IS_ENABLED(CONFIG_BT_GAP_SVC_DEFAULT_IMPL),
	     "This test requires BT_GAP_SVC_DEFAULT_IMPL to be disabled");
BUILD_ASSERT(!IS_ENABLED(CONFIG_BT_PRIVACY),
	     "Simplified GAP implementation - BT_PRIVACY not implemented");
BUILD_ASSERT(!IS_ENABLED(CONFIG_BT_GAP_PERIPHERAL_PREF_PARAMS),
	     "Simplified GAP implementation - BT_GAP_PERIPHERAL_PREF_PARAMS not implemented");

/* Wait time in microseconds for the name and appearance to be changed */
#define WAIT_TIME 10e6
/* Name changed called in the test */
bool gap_svc_name_changed;
/* Appearance changed called in the test */
bool gap_svc_appearance_changed;

/* Advertising data */
static const struct bt_data ad[] = {
	BT_DATA_BYTES(BT_DATA_FLAGS, (BT_LE_AD_GENERAL | BT_LE_AD_NO_BREDR)),
	BT_DATA_BYTES(BT_DATA_UUID16_ALL,
		      BT_UUID_16_ENCODE(BT_UUID_HRS_VAL)),
};

/* -----------------------------------------------------------------------------
 * Local implementation of GAP service
 */

static ssize_t read_name(struct bt_conn *conn, const struct bt_gatt_attr *attr,
			 void *buf, uint16_t len, uint16_t offset)
{
	LOG_DBG("Name read called");

	const char *name = bt_get_name();

	return bt_gatt_attr_read(conn, attr, buf, len, offset, name,
				 strlen(name));
}

static ssize_t write_name(struct bt_conn *conn, const struct bt_gatt_attr *attr, const void *buf,
			  uint16_t len, uint16_t offset, uint8_t flags)
{
	LOG_DBG("Name changed called");
	/* adding one to fit the terminating null character */
	char value[CONFIG_BT_DEVICE_NAME_MAX + 1] = {};

	if (offset != 0) {
		return BT_GATT_ERR(BT_ATT_ERR_INVALID_OFFSET);
	}

	if (offset + len > CONFIG_BT_DEVICE_NAME_MAX) {
		return BT_GATT_ERR(BT_ATT_ERR_INVALID_ATTRIBUTE_LEN);
	}

	memcpy(value, buf, len);

	value[len] = '\0';

	bt_set_name(value);

	LOG_INF("Name changed to %s", value);
	gap_svc_name_changed = true;
	if (gap_svc_appearance_changed) {
		TEST_PASS("GAP service name and appearance changed successfully");
	}

	return len;
}

static ssize_t read_appearance(struct bt_conn *conn,
			       const struct bt_gatt_attr *attr, void *buf,
			       uint16_t len, uint16_t offset)
{
	uint16_t appearance = sys_cpu_to_le16(bt_get_appearance());

	return bt_gatt_attr_read(conn, attr, buf, len, offset, &appearance, sizeof(appearance));
}

static ssize_t write_appearance(struct bt_conn *conn, const struct bt_gatt_attr *attr,
			 const void *buf, uint16_t len, uint16_t offset,
			 uint8_t flags)
{
	LOG_DBG("Appearance write called");

	uint16_t appearance;
	int err;

	if (offset > 0) {
		return BT_GATT_ERR(BT_ATT_ERR_INVALID_OFFSET);
	}

	if (len != sizeof(appearance)) {
		return BT_GATT_ERR(BT_ATT_ERR_INVALID_ATTRIBUTE_LEN);
	}

	appearance = sys_get_le16(buf);

	err = bt_set_appearance(appearance);

	if (err) {
		return BT_GATT_ERR(BT_ATT_ERR_UNLIKELY);
	}

	LOG_INF("Appearance changed to 0x%04x", appearance);
	gap_svc_appearance_changed = true;
	if (gap_svc_name_changed) {
		TEST_PASS("GAP service name and appearance changed successfully");
	}

	return len;
}

BT_GATT_SERVICE_DEFINE(BT_GATT_GAP_SVC_DEFAULT_NAME,
	BT_GATT_PRIMARY_SERVICE(BT_UUID_GAP),
	/* Require pairing for writes to device name */
	BT_GATT_CHARACTERISTIC(BT_UUID_GAP_DEVICE_NAME,
			       BT_GATT_CHRC_READ | BT_GATT_CHRC_WRITE,
			       BT_GATT_PERM_READ | BT_GATT_PERM_WRITE,
			       read_name, write_name, NULL),
	BT_GATT_CHARACTERISTIC(BT_UUID_GAP_APPEARANCE,
			       BT_GATT_CHRC_READ | BT_GATT_CHRC_WRITE,
			       BT_GATT_PERM_READ | BT_GATT_PERM_WRITE,
			       read_appearance, write_appearance, NULL),
);

/* End of local implementation of GAP service
 * ---------------------------------------------------------------------------
 */

static void connected(struct bt_conn *conn, uint8_t conn_err)
{
	char addr[BT_ADDR_LE_STR_LEN];

	bt_addr_le_to_str(bt_conn_get_dst(conn), addr, sizeof(addr));

	if (conn_err) {
		TEST_FAIL("Failed to connect to %s (%u)", addr, conn_err);
		return;
	}

	gap_svc_name_changed = false;
	gap_svc_appearance_changed = false;

	LOG_INF("Connected: %s", addr);
}

static void disconnected(struct bt_conn *conn, uint8_t reason)
{
	char addr[BT_ADDR_LE_STR_LEN];

	bt_addr_le_to_str(bt_conn_get_dst(conn), addr, sizeof(addr));

	LOG_INF("Disconnected: %s (reason 0x%02x)", addr, reason);
}

static int start_advertising(void)
{
	int err;

	err = bt_le_adv_start(BT_LE_ADV_CONN_FAST_1, ad, ARRAY_SIZE(ad), NULL, 0);
	if (err) {
		TEST_FAIL("Advertising failed to start (err %d)", err);
	}

	return err;
}

static void recycled(void)
{
	start_advertising();
}

static struct bt_conn_cb conn_callbacks = {
	.connected = connected,
	.disconnected = disconnected,
	.recycled = recycled,
};

static void test_local_gap_svc_peripheral_main(void)
{
	int err;

	bt_conn_cb_register(&conn_callbacks);

	err = bt_enable(NULL);

	if (err) {
		TEST_FAIL("Bluetooth init failed (err %d)", err);
		return;
	}

	LOG_INF("Peripheral Bluetooth initialized");
	err = start_advertising();
	if (err) {
		return;
	}
	LOG_INF("Advertising successfully started");
}

static void test_local_gap_svc_peripheral_init(void)
{
	bst_ticker_set_next_tick_absolute(WAIT_TIME);
	TEST_START("test_local_gap_svc_peripheral");
}

static void test_local_gap_svc_peripheral_tick(bs_time_t HW_device_time)

{
	/*
	 * If in WAIT_TIME seconds the testcase did not already pass
	 * (and finish) we consider it failed
	 */
	if (bst_result != Passed) {
		TEST_FAIL("test_local_gap_svc_peripheral failed (not passed after %d seconds)",
		     (int)(WAIT_TIME / 1e6));
	}
}

static const struct bst_test_instance test_peripheral[] = {
	{
		.test_id = "peripheral",
		.test_descr = "GAP service local reimplementation - peripheral role.",
		.test_main_f = test_local_gap_svc_peripheral_main,
		.test_pre_init_f = test_local_gap_svc_peripheral_init,
		.test_tick_f = test_local_gap_svc_peripheral_tick,
	},
	BSTEST_END_MARKER
};

struct bst_test_list *test_local_gap_svc_peripheral_install(struct bst_test_list *tests)
{
	tests = bst_add_tests(tests, test_peripheral);
	return tests;
}
```
