## CMakeLists.txt
```
# SPDX-License-Identifier: Apache-2.0

cmake_minimum_required(VERSION 3.28.0)

find_package(Zephyr REQUIRED HINTS $ENV{ZEPHYR_BASE})
project(bsim_test_advx)

add_subdirectory("${ZEPHYR_BASE}/tests/bsim/babblekit" babblekit)
add_subdirectory("${ZEPHYR_BASE}/tests/bluetooth/common/testlib" testlib)
target_link_libraries(app PRIVATE
  babblekit
  testlib
)

target_sources(app PRIVATE
  "src/main.c"
  "src/scan_req_tgta.c"
  "src/anonymous.c"
  "src/connect.c"
  "src/sync_pdu_type.c"
)

zephyr_include_directories(
  ${BSIM_COMPONENTS_PATH}/libUtilv1/src/
  ${BSIM_COMPONENTS_PATH}/libPhyComv1/src/
  ${ZEPHYR_BASE}/subsys/bluetooth/controller/include
  )
```

## prj.conf
```kconfig
CONFIG_BT=y
CONFIG_BT_DEVICE_NAME="AdvX"
CONFIG_BT_BROADCASTER=y
CONFIG_BT_PERIPHERAL=y
CONFIG_BT_OBSERVER=y
CONFIG_BT_CENTRAL=y

CONFIG_BT_EXT_ADV=y
CONFIG_BT_PER_ADV=y
CONFIG_BT_PER_ADV_SYNC=y

CONFIG_BT_ID_MAX=2
CONFIG_BT_EXT_ADV_MAX_ADV_SET=2
CONFIG_BT_PER_ADV_SYNC_MAX=2

CONFIG_BT_CTLR_PRIVACY=y
CONFIG_BT_CTLR_ADV_EXT=y
CONFIG_BT_CTLR_ADV_PERIODIC=y
CONFIG_BT_CTLR_SYNC_PERIODIC=y

CONFIG_ASSERT=y

# The scan requests come from the identity address that the directed
# advertising of the scan request test is sent to
CONFIG_BT_SCAN_WITH_IDENTITY=y
CONFIG_BT_SCAN_EXT_FILTER_POLICY=y
CONFIG_BT_CTLR_SCAN_REQ_NOTIFY=y
CONFIG_BT_FILTER_ACCEPT_LIST=y

# With a single buffer, setting the scan response data of a scannable
# extended advertising set waits for a free PDU buffer that never comes
CONFIG_BT_CTLR_ADV_DATA_BUF_MAX=2
```

## src/anonymous.c
```c
/*
 * SPDX-FileCopyrightText: Copyright (c) 2026 Silicon Laboratories Inc.
 * SPDX-License-Identifier: Apache-2.0
 */

#include <stdbool.h>
#include <stdint.h>

#include <zephyr/bluetooth/addr.h>
#include <zephyr/bluetooth/bluetooth.h>
#include <zephyr/bluetooth/gap.h>
#include <zephyr/kernel.h>
#include <zephyr/net_buf.h>
#include <zephyr/sys/atomic.h>
#include <zephyr/sys/util.h>

#include "bstests.h"
#include "babblekit/testcase.h"

/* The static random identity address of the scanner, C0:00:00:00:00:02. The
 * directed advertising that test_data/gen_anonymous.py writes for
 * anonymous.sh has it as the TargetA.
 */
static const bt_addr_le_t scanner_addr = {
	.type = BT_ADDR_LE_RANDOM,
	.a = { { 0x02, 0x00, 0x00, 0x00, 0x00, 0xC0 } },
};

/* A device that is not in the simulation, C0:00:00:00:00:03. The directed
 * advertising that test_data/gen_anonymous.py writes for anonymous_other.sh
 * has it as the TargetA.
 */
static const bt_addr_le_t other_addr = {
	.type = BT_ADDR_LE_RANDOM,
	.a = { { 0x03, 0x00, 0x00, 0x00, 0x00, 0xC0 } },
};

/* The AD data of the anonymous advertising in AUX_ADV_INDs, which the
 * playback device of the test scripts sends: undirected, directed with the
 * TargetA in the AUX_ADV_IND, and directed with it in the ADV_EXT_IND
 */
#define AD_UNDIRECTED   0x01U
#define AD_DIRECTED     0x02U
#define AD_DIRECTED_PRI 0x03U

/* The advertising set of the playback device whose AUX_ADV_IND announces a
 * TxPower that its extended header has no room for, which may not be reported
 */
#define SID_TRUNCATED 6U

/* The kinds of anonymous advertising reported. The advertising sets of the
 * advertiser device have no ADI and no AD data, so the reports do not tell
 * them apart otherwise.
 */
#define REPORT_UNDIRECTED      BIT(0)
#define REPORT_DIRECTED        BIT(1)
#define REPORT_UNDIRECTED_AD   BIT(2)
#define REPORT_DIRECTED_AD     BIT(3)
#define REPORT_DIRECTED_PRI_AD BIT(4)
#define REPORT_OTHER           BIT(5)
#define REPORT_TRUNCATED       BIT(6)

static atomic_t reports;

static void adv_start(const bt_addr_le_t *peer)
{
	struct bt_le_adv_param param = BT_LE_ADV_PARAM_INIT(
		BT_LE_ADV_OPT_EXT_ADV | BT_LE_ADV_OPT_ANONYMOUS, BT_GAP_ADV_FAST_INT_MIN_2,
		BT_GAP_ADV_FAST_INT_MAX_2, peer);
	struct bt_le_ext_adv *adv;
	int err;

	if (peer != NULL) {
		param.options |= BT_LE_ADV_OPT_DIR_MODE_LOW_DUTY;
	}

	err = bt_le_ext_adv_create(&param, NULL, &adv);
	TEST_ASSERT(err == 0, "Advertising set create failed (err %d)", err);

	err = bt_le_ext_adv_start(adv, BT_LE_EXT_ADV_START_DEFAULT);
	TEST_ASSERT(err == 0, "Advertising start failed (err %d)", err);
}

/* Undirected anonymous advertising, and directed to the given device. The
 * Controller sends no AuxPtr without AD data.
 */
static void anon_adv(const bt_addr_le_t *peer)
{
	int err;

	err = bt_enable(NULL);
	TEST_ASSERT(err == 0, "Bluetooth init failed (err %d)", err);

	adv_start(NULL);
	adv_start(peer);
}

static void test_anon_adv(void)
{
	TEST_START("anon_adv");

	anon_adv(&scanner_addr);

	/* The scanner checks which of the sets it reports */
	TEST_PASS("anon_adv");
}

static void test_anon_adv_other(void)
{
	TEST_START("anon_adv_other");

	anon_adv(&other_addr);

	/* The scanner checks which of the sets it reports */
	TEST_PASS("anon_adv_other");
}

static bool ad_parse(struct bt_data *data, void *user_data)
{
	uint8_t *ad_value = user_data;

	if ((data->type == BT_DATA_MANUFACTURER_DATA) && (data->data_len == 1U)) {
		*ad_value = data->data[0];

		return false;
	}

	return true;
}

static void scan_recv(const struct bt_le_scan_recv_info *info, struct net_buf_simple *buf)
{
	bool is_directed = ((info->adv_props & BT_GAP_ADV_PROP_DIRECTED) != 0U);
	uint8_t ad_value = 0U;

	/* The Host reports anonymous advertising as from BT_ADDR_LE_ANY */
	if (!bt_addr_le_eq(info->addr, BT_ADDR_LE_ANY)) {
		return;
	}

	if (info->sid == SID_TRUNCATED) {
		(void)atomic_or(&reports, REPORT_TRUNCATED);

		return;
	}

	bt_data_parse(buf, ad_parse, &ad_value);

	if (ad_value == 0U) {
		(void)atomic_or(&reports, is_directed ? REPORT_DIRECTED : REPORT_UNDIRECTED);
	} else if (!is_directed && (ad_value == AD_UNDIRECTED)) {
		(void)atomic_or(&reports, REPORT_UNDIRECTED_AD);
	} else if (is_directed && (ad_value == AD_DIRECTED)) {
		(void)atomic_or(&reports, REPORT_DIRECTED_AD);
	} else if (is_directed && (ad_value == AD_DIRECTED_PRI)) {
		(void)atomic_or(&reports, REPORT_DIRECTED_PRI_AD);
	} else {
		(void)atomic_or(&reports, REPORT_OTHER);
	}
}

static struct bt_le_scan_cb scan_cb = {
	.recv = scan_recv,
};

static atomic_val_t scan(uint8_t options)
{
	/* Active, as anonymous.sh checks which advertising gets AUX_SCAN_REQs */
	struct bt_le_scan_param param = BT_LE_SCAN_PARAM_INIT(
		BT_LE_SCAN_TYPE_ACTIVE, options, BT_GAP_SCAN_FAST_INTERVAL,
		BT_GAP_SCAN_FAST_INTERVAL);
	int err;

	(void)atomic_clear(&reports);

	err = bt_le_scan_start(&param, NULL);
	TEST_ASSERT(err == 0, "Scan start failed (err %d)", err);

	/* Scan for a fixed time, as the kinds that are not reported are part
	 * of what is checked. The playback device of the test scripts sends
	 * for the first 6 seconds of the simulation, which three scans fit in.
	 */
	(void)k_sleep(K_SECONDS(2));

	err = bt_le_scan_stop();
	TEST_ASSERT(err == 0, "Scan stop failed (err %d)", err);

	return atomic_get(&reports);
}

static void scanner_init(void)
{
	bt_addr_le_t addr = scanner_addr;
	int err;

	err = bt_id_create(&addr, NULL);
	TEST_ASSERT(err >= 0, "Identity create failed (err %d)", err);

	err = bt_enable(NULL);
	TEST_ASSERT(err == 0, "Bluetooth init failed (err %d)", err);

	err = bt_le_scan_cb_register(&scan_cb);
	TEST_ASSERT(err == 0, "Scan callback register failed (err %d)", err);
}

static void test_anon_scan(void)
{
	const atomic_val_t to_scanner = REPORT_UNDIRECTED | REPORT_DIRECTED |
					REPORT_UNDIRECTED_AD | REPORT_DIRECTED_AD |
					REPORT_DIRECTED_PRI_AD;
	const bt_addr_le_t anon = { .type = BT_ADDR_LE_ANONYMOUS };
	atomic_val_t reported;
	int err;

	TEST_START("anon_scan");

	scanner_init();

	reported = scan(BT_LE_SCAN_OPT_NONE);
	TEST_ASSERT(reported == to_scanner, "Anonymous advertising reported as 0x%lx",
		    (unsigned long)reported);

	/* The Filter Accept List has no entry for anonymous advertising */
	reported = scan(BT_LE_SCAN_OPT_FILTER_ACCEPT_LIST);
	TEST_ASSERT(reported == 0, "Anonymous advertising reported as 0x%lx with the list",
		    (unsigned long)reported);

	err = bt_le_filter_accept_list_add(&anon);
	TEST_ASSERT(err == 0, "Filter Accept List add failed (err %d)", err);

	reported = scan(BT_LE_SCAN_OPT_FILTER_ACCEPT_LIST);
	TEST_ASSERT(reported == to_scanner,
		    "Anonymous advertising reported as 0x%lx with the anonymous entry",
		    (unsigned long)reported);

	TEST_PASS("anon_scan");
}

static void test_anon_scan_other(void)
{
	atomic_val_t reported;

	TEST_START("anon_scan_other");

	scanner_init();

	reported = scan(BT_LE_SCAN_OPT_NONE);
	TEST_ASSERT(reported == (REPORT_UNDIRECTED | REPORT_UNDIRECTED_AD),
		    "Anonymous advertising reported as 0x%lx", (unsigned long)reported);

	TEST_PASS("anon_scan_other");
}

static const struct bst_test_instance test_def[] = {
	{
		.test_id = "anon_adv",
		.test_descr = "Anonymous advertising, undirected and directed to the scanner",
		.test_main_f = test_anon_adv,
	},
	{
		.test_id = "anon_adv_other",
		.test_descr = "Anonymous advertising, undirected and directed to another device",
		.test_main_f = test_anon_adv_other,
	},
	{
		.test_id = "anon_scan",
		.test_descr = "Passive scanner of anonymous advertising to the scanner",
		.test_main_f = test_anon_scan,
	},
	{
		.test_id = "anon_scan_other",
		.test_descr = "Passive scanner of anonymous advertising to another device",
		.test_main_f = test_anon_scan_other,
	},
	BSTEST_END_MARKER,
};

struct bst_test_list *test_anonymous_install(struct bst_test_list *tests)
{
	return bst_add_tests(tests, test_def);
}
```

## src/connect.c
```c
/*
 * SPDX-FileCopyrightText: Copyright (c) 2026 Silicon Laboratories Inc.
 * SPDX-License-Identifier: Apache-2.0
 */

#include <stdint.h>

#include <zephyr/bluetooth/addr.h>
#include <zephyr/bluetooth/bluetooth.h>
#include <zephyr/bluetooth/conn.h>
#include <zephyr/bluetooth/gap.h>
#include <zephyr/bluetooth/hci_types.h>
#include <zephyr/kernel.h>

#include "bstests.h"
#include "babblekit/flags.h"
#include "babblekit/testcase.h"

/* The static random identity address of the advertiser, C0:00:00:00:00:01 */
static const bt_addr_le_t adv_addr = {
	.type = BT_ADDR_LE_RANDOM,
	.a = { { 0x01, 0x00, 0x00, 0x00, 0x00, 0xC0 } },
};

DEFINE_FLAG_STATIC(flag_connected);
DEFINE_FLAG_STATIC(flag_disconnected);

static void connected(struct bt_conn *conn, uint8_t err)
{
	if (err == BT_HCI_ERR_SUCCESS) {
		SET_FLAG(flag_connected);
	}
}

static void disconnected(struct bt_conn *conn, uint8_t reason)
{
	SET_FLAG(flag_disconnected);
}

static struct bt_conn_cb conn_cb = {
	.connected = connected,
	.disconnected = disconnected,
};

static void connection_check(void)
{
	WAIT_FOR_FLAG(flag_connected);

	/* A connection that only one of the two devices has entered ends there
	 * with the Connection Failed to be Established error after 6
	 * connection intervals, as no packet comes from the other one. Wait
	 * well beyond that and check that the connection is still up.
	 */
	(void)k_sleep(K_SECONDS(2));
	TEST_ASSERT(!IS_FLAG_SET(flag_disconnected), "Connection lost");
}

static void test_conn_adv(void)
{
	bt_addr_le_t addr = adv_addr;
	struct bt_le_ext_adv *adv;
	int err;

	TEST_START("conn_adv");

	err = bt_id_create(&addr, NULL);
	TEST_ASSERT(err >= 0, "Identity create failed (err %d)", err);

	err = bt_enable(NULL);
	TEST_ASSERT(err == 0, "Bluetooth init failed (err %d)", err);

	err = bt_conn_cb_register(&conn_cb);
	TEST_ASSERT(err == 0, "Callback register failed (err %d)", err);

	err = bt_le_ext_adv_create(BT_LE_EXT_ADV_CONN, NULL, &adv);
	TEST_ASSERT(err == 0, "Advertising set create failed (err %d)", err);

	err = bt_le_ext_adv_start(adv, BT_LE_EXT_ADV_START_DEFAULT);
	TEST_ASSERT(err == 0, "Advertising start failed (err %d)", err);

	connection_check();

	TEST_PASS("conn_adv");
}

static void test_conn_init_fal(void)
{
	int err;

	TEST_START("conn_init_fal");

	err = bt_enable(NULL);
	TEST_ASSERT(err == 0, "Bluetooth init failed (err %d)", err);

	err = bt_conn_cb_register(&conn_cb);
	TEST_ASSERT(err == 0, "Callback register failed (err %d)", err);

	err = bt_le_filter_accept_list_add(&adv_addr);
	TEST_ASSERT(err == 0, "Filter Accept List add failed (err %d)", err);

	err = bt_conn_le_create_auto(BT_CONN_LE_CREATE_CONN, BT_LE_CONN_PARAM_DEFAULT);
	TEST_ASSERT(err == 0, "Connection create failed (err %d)", err);

	connection_check();

	TEST_PASS("conn_init_fal");
}

static const struct bst_test_instance test_def[] = {
	{
		.test_id = "conn_adv",
		.test_descr = "Connectable extended advertising",
		.test_main_f = test_conn_adv,
	},
	{
		.test_id = "conn_init_fal",
		.test_descr = "Initiator with the Filter Accept List",
		.test_main_f = test_conn_init_fal,
	},
	BSTEST_END_MARKER,
};

struct bst_test_list *test_connect_install(struct bst_test_list *tests)
{
	return bst_add_tests(tests, test_def);
}
```

## src/scan_req_tgta.c
```c
/*
 * SPDX-FileCopyrightText: Copyright (c) 2026 Silicon Laboratories Inc.
 * SPDX-License-Identifier: Apache-2.0
 */

#include <stdint.h>

#include <zephyr/bluetooth/addr.h>
#include <zephyr/bluetooth/bluetooth.h>
#include <zephyr/bluetooth/gap.h>
#include <zephyr/kernel.h>
#include <zephyr/sys/util.h>

#include "bstests.h"
#include "babblekit/flags.h"
#include "babblekit/testcase.h"

/* The static random identity address of the scanner, C0:00:00:00:00:02 */
static const bt_addr_le_t scanner_addr = {
	.type = BT_ADDR_LE_RANDOM,
	.a = { { 0x02, 0x00, 0x00, 0x00, 0x00, 0xC0 } },
};

/* A resolvable private address that no device of the simulation resolves,
 * 40:00:00:00:00:03. The test script looks for it in the Tx dump of the
 * advertiser.
 */
static const bt_addr_le_t other_rpa = {
	.type = BT_ADDR_LE_RANDOM,
	.a = { { 0x03, 0x00, 0x00, 0x00, 0x00, 0x40 } },
};

DEFINE_FLAG_STATIC(flag_scanned);

static const struct bt_data sd[] = {
	BT_DATA(BT_DATA_NAME_COMPLETE, "TargetA", 7),
};

static void scanned(struct bt_le_ext_adv *adv, struct bt_le_ext_adv_scanned_info *info)
{
	if (bt_addr_le_eq(info->addr, &scanner_addr)) {
		SET_FLAG(flag_scanned);
	}
}

static void test_tgta_adv(void)
{
	static const struct bt_le_ext_adv_cb adv_cb = {
		.scanned = scanned,
	};
	struct bt_le_adv_param param = BT_LE_ADV_PARAM_INIT(
		BT_LE_ADV_OPT_EXT_ADV | BT_LE_ADV_OPT_SCANNABLE | BT_LE_ADV_OPT_NOTIFY_SCAN_REQ |
			BT_LE_ADV_OPT_DIR_MODE_LOW_DUTY,
		BT_GAP_ADV_FAST_INT_MIN_2, BT_GAP_ADV_FAST_INT_MAX_2, &scanner_addr);
	struct bt_le_ext_adv *adv;
	int err;

	TEST_START("tgta_adv");

	err = bt_enable(NULL);
	TEST_ASSERT(err == 0, "Bluetooth init failed (err %d)", err);

	err = bt_le_ext_adv_create(&param, &adv_cb, &adv);
	TEST_ASSERT(err == 0, "Advertising set create failed (err %d)", err);

	err = bt_le_ext_adv_set_data(adv, NULL, 0, sd, ARRAY_SIZE(sd));
	TEST_ASSERT(err == 0, "Scan response data set failed (err %d)", err);

	err = bt_le_ext_adv_start(adv, BT_LE_EXT_ADV_START_DEFAULT);
	TEST_ASSERT(err == 0, "Advertising start failed (err %d)", err);

	WAIT_FOR_FLAG(flag_scanned);
	TEST_PRINT("Scan request of the TargetA answered");

	err = bt_le_ext_adv_stop(adv);
	TEST_ASSERT(err == 0, "Advertising stop failed (err %d)", err);

	err = bt_le_ext_adv_delete(adv);
	TEST_ASSERT(err == 0, "Advertising set delete failed (err %d)", err);

	/* Notifications of scan requests that the stopped set answered can
	 * still be on their way from the Controller. Let them arrive before
	 * the flag is cleared, so that they do not count for the next set.
	 */
	(void)k_sleep(K_MSEC(500));
	UNSET_FLAG(flag_scanned);

	param.peer = &other_rpa;
	err = bt_le_ext_adv_create(&param, &adv_cb, &adv);
	TEST_ASSERT(err == 0, "Advertising set create failed (err %d)", err);

	err = bt_le_ext_adv_set_data(adv, NULL, 0, sd, ARRAY_SIZE(sd));
	TEST_ASSERT(err == 0, "Scan response data set failed (err %d)", err);

	err = bt_le_ext_adv_start(adv, BT_LE_EXT_ADV_START_DEFAULT);
	TEST_ASSERT(err == 0, "Advertising start failed (err %d)", err);

	/* The scanner sends scan requests to this set too, as its filter
	 * policy accepts directed advertising to an RPA that it can not
	 * resolve. Advertise long enough for tens of them, none of which may
	 * be answered.
	 */
	(void)k_sleep(K_SECONDS(5));
	TEST_ASSERT(!IS_FLAG_SET(flag_scanned),
		    "Scan request of another device than the TargetA answered");

	TEST_PASS("tgta_adv");
}

static void test_tgta_scan(void)
{
	struct bt_le_scan_param param = BT_LE_SCAN_PARAM_INIT(
		BT_LE_SCAN_TYPE_ACTIVE, BT_LE_SCAN_OPT_EXT_FILTER_POLICY,
		BT_GAP_SCAN_FAST_INTERVAL_MIN, BT_GAP_SCAN_FAST_WINDOW);
	bt_addr_le_t addr = scanner_addr;
	int err;

	TEST_START("tgta_scan");

	err = bt_id_create(&addr, NULL);
	TEST_ASSERT(err >= 0, "Identity create failed (err %d)", err);

	err = bt_enable(NULL);
	TEST_ASSERT(err == 0, "Bluetooth init failed (err %d)", err);

	err = bt_le_scan_start(&param, NULL);
	TEST_ASSERT(err == 0, "Scan start failed (err %d)", err);

	/* The advertiser checks which of the scan requests it answers */
	TEST_PASS("tgta_scan");
}

static const struct bst_test_instance test_def[] = {
	{
		.test_id = "tgta_adv",
		.test_descr = "Directed scannable advertising, to the scanner then to an RPA",
		.test_main_f = test_tgta_adv,
	},
	{
		.test_id = "tgta_scan",
		.test_descr = "Active scanner with the extended filter policy",
		.test_main_f = test_tgta_scan,
	},
	BSTEST_END_MARKER,
};

struct bst_test_list *test_scan_req_tgta_install(struct bst_test_list *tests)
{
	return bst_add_tests(tests, test_def);
}
```

## src/sync_pdu_type.c
```c
/*
 * SPDX-FileCopyrightText: Copyright (c) 2026 Nordic Semiconductor ASA
 * SPDX-License-Identifier: Apache-2.0
 */

#include <stdbool.h>
#include <stdint.h>

#include <zephyr/bluetooth/addr.h>
#include <zephyr/bluetooth/bluetooth.h>
#include <zephyr/bluetooth/gap.h>
#include <zephyr/bluetooth/hci_types.h>
#include <zephyr/kernel.h>
#include <zephyr/net_buf.h>
#include <zephyr/sys/atomic.h>
#include <zephyr/sys/byteorder.h>
#include <zephyr/sys/util.h>

#include "bstests.h"
#include "babblekit/testcase.h"

/* The static random address of the periodic advertising that the playback
 * device of sync_pdu_type.sh sends, C0:00:00:00:00:05, and its SID, as in
 * test_data/gen_sync_pdu_type.py
 */
static const bt_addr_le_t adv_addr = {
	.type = BT_ADDR_LE_RANDOM,
	.a = { { 0x05, 0x00, 0x00, 0x00, 0x00, 0xC0 } },
};

#define ADV_SID 1U

/* The kinds of AD data in the PDUs of the playback device: an AUX_SYNC_IND
 * without AuxPtr, an AUX_SYNC_IND with an AuxPtr, and a PDU of another type in
 * place of an AUX_SYNC_IND or AUX_CHAIN_IND
 */
#define AD_KIND_VALID   0x01U
#define AD_KIND_PARENT  0x02U
#define AD_KIND_INVALID 0x03U

/* The paEventCounter of the first periodic advertising event of each phase of
 * the playback, as in test_data/gen_sync_pdu_type.py:
 * - [0, EVT_VALID): PDUs of another type in place of the AUX_SYNC_INDs
 * - [EVT_VALID, EVT_CHAIN): AUX_SYNC_INDs
 * - [EVT_CHAIN, EVT_CHAIN_ALT): AUX_SYNC_INDs with an AuxPtr to a PDU of
 *   another type in place of the AUX_CHAIN_IND
 * - [EVT_CHAIN_ALT, EVT_LOST): as the phase before in the even events, as
 *   [EVT_VALID, EVT_CHAIN) in the odd ones
 * - [EVT_LOST, EVT_END): as [0, EVT_VALID)
 */
#define EVT_VALID     30U
#define EVT_CHAIN     60U
#define EVT_CHAIN_ALT 80U
#define EVT_LOST      100U
#define EVT_END       130U

/* The periodic advertising event with paEventCounter 0 starts 100 ms into the
 * simulation, and the events are 100 ms apart. From EVT_CHAIN to EVT_LOST,
 * each event starts 30 us later than that after the one before it, a drift
 * that only the drift compensation of every event keeps in the receive window,
 * and that adds up to less than 2 ms.
 */
#define EVT_START_MS(counter) (100U + ((counter) * 100U))

/* Synchronization timeout of 1 s, 10 periodic advertising events, in 10 ms
 * units
 */
#define SYNC_TIMEOUT    100U
#define SYNC_TIMEOUT_MS (SYNC_TIMEOUT * 10U)

static K_SEM_DEFINE(sem_sync, 0, 1);
static int64_t volatile synced_ms;
static int64_t volatile term_ms;
static uint8_t volatile term_reason;
static bool volatile is_synced;

static ATOMIC_DEFINE(reported, EVT_END);
static atomic_t reports_unexpected;

static void synced(struct bt_le_per_adv_sync *sync, struct bt_le_per_adv_sync_synced_info *info)
{
	synced_ms = k_uptime_get();
	is_synced = true;

	k_sem_give(&sem_sync);
}

static void term(struct bt_le_per_adv_sync *sync,
		 const struct bt_le_per_adv_sync_term_info *info)
{
	term_ms = k_uptime_get();
	term_reason = info->reason;

	k_sem_give(&sem_sync);
}

static void recv(struct bt_le_per_adv_sync *sync,
		 const struct bt_le_per_adv_sync_recv_info *info, struct net_buf_simple *buf)
{
	uint16_t counter;

	/* A single Manufacturer Specific Data structure with the kind of the
	 * PDU and its paEventCounter. Anything else is decoded from a PDU that
	 * is not part of the train, or is reassembled with data from one.
	 */
	if ((buf->len != 5U) || (buf->data[0] != 4U) ||
	    (buf->data[1] != BT_DATA_MANUFACTURER_DATA) || (buf->data[2] != AD_KIND_VALID)) {
		(void)atomic_inc(&reports_unexpected);

		return;
	}

	counter = sys_get_le16(&buf->data[3]);
	if (counter >= EVT_END) {
		(void)atomic_inc(&reports_unexpected);

		return;
	}

	atomic_set_bit(reported, counter);
}

static struct bt_le_per_adv_sync_cb sync_cb = {
	.synced = synced,
	.term = term,
	.recv = recv,
};

static void sync_create(void)
{
	struct bt_le_per_adv_sync_param param = {
		.options = BT_LE_PER_ADV_SYNC_OPT_NONE,
		.sid = ADV_SID,
		.skip = 0U,
		.timeout = SYNC_TIMEOUT,
	};
	struct bt_le_per_adv_sync *sync;
	int err;

	bt_addr_le_copy(&param.addr, &adv_addr);

	err = bt_le_per_adv_sync_create(&param, &sync);
	TEST_ASSERT(err == 0, "Periodic sync create failed (err %d)", err);
}

static void check_reported(uint16_t first, uint16_t last, uint16_t step)
{
	for (uint16_t counter = first; counter < last; counter += step) {
		TEST_ASSERT(atomic_test_bit(reported, counter),
			    "No report of periodic advertising event %u", counter);
	}
}

static void test_sync_pdu_type(void)
{
	struct bt_le_scan_param scan_param = BT_LE_SCAN_PARAM_INIT(
		BT_LE_SCAN_TYPE_PASSIVE, BT_LE_SCAN_OPT_NONE, BT_GAP_SCAN_FAST_INTERVAL_MIN,
		BT_GAP_SCAN_FAST_INTERVAL_MIN);
	uint32_t estab_failed = 0U;
	int err;

	TEST_START("sync_pdu_type");

	err = bt_enable(NULL);
	TEST_ASSERT(err == 0, "Bluetooth init failed (err %d)", err);

	bt_le_per_adv_sync_cb_register(&sync_cb);

	err = bt_le_scan_start(&scan_param, NULL);
	TEST_ASSERT(err == 0, "Scan start failed (err %d)", err);

	/* The PDUs of other types that the train has in place of the
	 * AUX_SYNC_INDs at first may not establish the synchronization. The
	 * Controller fails to establish it after six periodic advertising
	 * events, then the scanner tries again.
	 */
	sync_create();
	while (true) {
		(void)k_sem_take(&sem_sync, K_FOREVER);

		if (is_synced) {
			break;
		}

		TEST_ASSERT(term_reason == BT_HCI_ERR_CONN_FAIL_TO_ESTAB,
			    "Periodic sync establishment ended with reason 0x%02x", term_reason);
		estab_failed++;

		sync_create();
	}

	TEST_ASSERT(estab_failed > 0U, "No periodic sync establishment failed");
	TEST_ASSERT(synced_ms >= EVT_START_MS(EVT_VALID),
		    "Periodic sync established at %lld ms, before the first AUX_SYNC_IND",
		    synced_ms);

	err = bt_le_scan_stop();
	TEST_ASSERT(err == 0, "Scan stop failed (err %d)", err);

	/* The PDUs of other types in place of the AUX_CHAIN_INDs leave the
	 * parent AUX_SYNC_INDs to compensate the drift of the train, which
	 * keeps the synchronization up. Those in place of the AUX_SYNC_INDs at
	 * the end do not: the synchronization is lost with the timeout after
	 * the last AUX_SYNC_IND. The LE Periodic Advertising Sync Lost event
	 * has no reason, which the Host reports as unspecified.
	 */
	(void)k_sem_take(&sem_sync, K_FOREVER);
	TEST_ASSERT(term_reason == BT_HCI_ERR_UNSPECIFIED,
		    "Periodic sync terminated with reason 0x%02x", term_reason);
	TEST_ASSERT(term_ms > EVT_START_MS(EVT_LOST - 1U),
		    "Periodic sync lost at %lld ms, before the last AUX_SYNC_IND", term_ms);
	TEST_ASSERT(term_ms < EVT_START_MS(EVT_LOST + 1U) + SYNC_TIMEOUT_MS,
		    "Periodic sync lost at %lld ms, after the timeout", term_ms);

	/* Every AUX_SYNC_IND without AuxPtr is reported. One that follows an
	 * AUX_SYNC_IND whose AUX_CHAIN_IND was not received is reported only
	 * when the Controller has ended the report of that one as incomplete.
	 */
	check_reported(EVT_VALID, EVT_CHAIN, 1U);
	check_reported(EVT_CHAIN_ALT + 1U, EVT_LOST, 2U);

	/* No report has data of an AUX_SYNC_IND with an AuxPtr, or of a PDU of
	 * another type
	 */
	TEST_ASSERT(atomic_get(&reports_unexpected) == 0, "%ld unexpected reports",
		    (long)atomic_get(&reports_unexpected));

	TEST_PASS("sync_pdu_type");
}

static const struct bst_test_instance test_def[] = {
	{
		.test_id = "sync_pdu_type",
		.test_descr = "Periodic sync ignores PDUs of types other than AUX_SYNC_IND",
		.test_main_f = test_sync_pdu_type,
	},
	BSTEST_END_MARKER,
};

struct bst_test_list *test_sync_pdu_type_install(struct bst_test_list *tests)
{
	return bst_add_tests(tests, test_def);
}
```

## src/test_aux_connect.c
```c
/*
 * SPDX-FileCopyrightText: Copyright (c) 2026 Silicon Laboratories Inc.
 * SPDX-License-Identifier: Apache-2.0
 */

#include <stdbool.h>
#include <stddef.h>
#include <stdint.h>

#include <zephyr/bluetooth/addr.h>
#include <zephyr/bluetooth/bluetooth.h>
#include <zephyr/bluetooth/conn.h>
#include <zephyr/bluetooth/hci.h>
#include <zephyr/kernel.h>

#include "babblekit/testcase.h"
#include "bstests.h"

/* An extended advertiser allocates the node rx for a connection when it accepts
 * an AUX_CONNECT_REQ, before it transmits the AUX_CONNECT_RSP. In the sweep
 * rounds the peripheral stops advertising a little later after the start from
 * round to round, so that the stop moves across the AUX_CONNECT_REQ and
 * AUX_CONNECT_RSP of the central's connection attempt. In the last round, which
 * does not stop advertising, both have to be connected.
 */

/* Round 0 measures when the peripheral is connected after the start of
 * advertising, and the sweep rounds stop advertising from STOP_BEFORE_US before
 * that time on, STOP_STEP_US later from round to round.
 */
#define SWEEP_ROUNDS   34U
#define ROUNDS         (SWEEP_ROUNDS + 2U)
#define ROUND_MS       100U
#define FIRST_ROUND_MS 100U
#define ADV_DELAY_MS   10U
#define STOP_BEFORE_US 700U
#define STOP_STEP_US   25U

/* The central initiates before the peripheral starts advertising, and gives up
 * before the next round. A stop right after the AUX_CONNECT_RSP can leave the
 * central with a connection that fails after six connection intervals.
 */
#define SCAN_INTERVAL  0x0060 /* 60 ms */
#define CREATE_TIMEOUT 4U     /* 40 ms */
#define CONN_INTERVAL  0x0006 /* 7.5 ms */
#define WAIT_MS        70U
#define ADV_INTERVAL   0x0020 /* 20 ms */

static const bt_addr_le_t peripheral_addr = {
	.type = BT_ADDR_LE_RANDOM,
	.a.val = {0x02, 0x00, 0x00, 0x00, 0x00, 0xc0},
};

static K_SEM_DEFINE(connected_sem, 0, 1);
static K_SEM_DEFINE(disconnected_sem, 0, 1);
static uint8_t disconnected_reason;
static uint32_t connected_cycles;
static uint8_t connected_err;

static void connected(struct bt_conn *conn, uint8_t err)
{
	connected_cycles = k_cycle_get_32();
	connected_err = err;
	k_sem_give(&connected_sem);
}

static void disconnected(struct bt_conn *conn, uint8_t reason)
{
	disconnected_reason = reason;
	k_sem_give(&disconnected_sem);
}

static void round_wait(uint32_t round)
{
	/* Both devices start each round at the same time, however long the last one took */
	(void)k_sleep(K_TIMEOUT_ABS_MS(FIRST_ROUND_MS + (round * ROUND_MS)));
}

static void test_central_aux_connect_main(void)
{
	const struct bt_conn_le_create_param create_param = {
		.options = BT_CONN_LE_OPT_NONE,
		.interval = SCAN_INTERVAL,
		.window = SCAN_INTERVAL,
		.timeout = CREATE_TIMEOUT,
	};
	static struct bt_conn_cb conn_callbacks = {
		.connected = connected,
		.disconnected = disconnected,
	};
	uint32_t established = 0U;
	uint32_t missed = 0U;
	int err;

	TEST_START("central_aux_connect");

	err = bt_conn_cb_register(&conn_callbacks);
	TEST_ASSERT(err == 0, "Callback registration failed (err %d)", err);

	err = bt_enable(NULL);
	TEST_ASSERT(err == 0, "Bluetooth init failed (err %d)", err);

	for (uint32_t round = 0U; round < ROUNDS; round++) {
		const bool is_sweep = (round != 0U) && (round != (ROUNDS - 1U));
		struct bt_conn *conn = NULL;

		round_wait(round);

		err = bt_conn_le_create(&peripheral_addr, &create_param,
					BT_LE_CONN_PARAM(CONN_INTERVAL, CONN_INTERVAL, 0, 100),
					&conn);
		TEST_ASSERT(err == 0, "Round %u: create failed (err %d)", round, err);

		err = k_sem_take(&connected_sem, K_MSEC(WAIT_MS));
		TEST_ASSERT(err == 0, "Round %u: no result of the create", round);

		if (connected_err == BT_HCI_ERR_UNKNOWN_CONN_ID) {
			TEST_ASSERT(is_sweep, "Round %u: no connection without a stop", round);

			missed++;
			TEST_PRINT("Round %u: no connection", round);
		} else {
			TEST_ASSERT(connected_err == 0U, "Round %u: connection failed (0x%02x)",
				    round, connected_err);

			err = bt_conn_disconnect(conn, BT_HCI_ERR_REMOTE_USER_TERM_CONN);
			TEST_ASSERT(err == 0, "Round %u: disconnect failed (err %d)", round, err);

			err = k_sem_take(&disconnected_sem, K_MSEC(WAIT_MS));
			TEST_ASSERT(err == 0, "Round %u: no disconnection", round);

			if (is_sweep) {
				established++;
			} else {
				/* Only a connection that the peripheral has as well
				 * ends by the termination.
				 */
				TEST_ASSERT(disconnected_reason == BT_HCI_ERR_LOCALHOST_TERM_CONN,
					    "Round %u: disconnected with reason 0x%02x", round,
					    disconnected_reason);
			}

			TEST_PRINT("Round %u: connected", round);
		}

		bt_conn_drop(&conn);
	}

	TEST_ASSERT(missed != 0U, "No stop was early enough");
	TEST_ASSERT(established != 0U, "No stop was late enough");

	TEST_PASS_AND_EXIT("central_aux_connect: %u connected, %u not", established, missed);
}

static void test_peripheral_aux_connect_main(void)
{
	static struct bt_conn_cb conn_callbacks = {
		.connected = connected,
	};
	const struct bt_le_adv_param adv_param = {
		.id = BT_ID_DEFAULT,
		.options = BT_LE_ADV_OPT_CONN | BT_LE_ADV_OPT_EXT_ADV | BT_LE_ADV_OPT_USE_IDENTITY,
		.interval_min = ADV_INTERVAL,
		.interval_max = ADV_INTERVAL,
	};
	bt_addr_le_t addr = peripheral_addr;
	uint32_t connected_us = 0U;
	struct bt_le_ext_adv *adv;
	int err;

	TEST_START("peripheral_aux_connect");

	err = bt_conn_cb_register(&conn_callbacks);
	TEST_ASSERT(err == 0, "Callback registration failed (err %d)", err);

	err = bt_id_create(&addr, NULL);
	TEST_ASSERT(err == BT_ID_DEFAULT, "Identity creation failed (err %d)", err);

	err = bt_enable(NULL);
	TEST_ASSERT(err == 0, "Bluetooth init failed (err %d)", err);

	err = bt_le_ext_adv_create(&adv_param, NULL, &adv);
	TEST_ASSERT(err == 0, "Advertising set creation failed (err %d)", err);

	for (uint32_t round = 0U; round < ROUNDS; round++) {
		const bool is_sweep = (round != 0U) && (round != (ROUNDS - 1U));
		uint32_t start_cycles;

		round_wait(round);

		/* Start after the central initiates, so that its connection attempt
		 * falls in the first advertising event, the one that round 0 measures.
		 */
		(void)k_sleep(K_MSEC(ADV_DELAY_MS));

		/* A connection of an earlier sweep round does not count */
		k_sem_reset(&connected_sem);

		err = bt_le_ext_adv_start(adv, BT_LE_EXT_ADV_START_DEFAULT);
		TEST_ASSERT(err == 0, "Round %u: advertising failed to start (err %d)", round, err);

		start_cycles = k_cycle_get_32();

		if (is_sweep) {
			k_busy_wait(connected_us - STOP_BEFORE_US + ((round - 1U) * STOP_STEP_US));

			err = bt_le_ext_adv_stop(adv);
			TEST_ASSERT(err == 0, "Round %u: advertising failed to stop (err %d)",
				    round, err);

			continue;
		}

		err = k_sem_take(&connected_sem, K_MSEC(WAIT_MS));
		TEST_ASSERT((err == 0) && (connected_err == 0U), "Round %u: not connected", round);

		if (round == 0U) {
			connected_us = k_cyc_to_us_floor32(connected_cycles - start_cycles);
			TEST_ASSERT(connected_us > STOP_BEFORE_US,
				    "Round 0: connected %u us after the start of advertising",
				    connected_us);

			TEST_PRINT("Connected %u us after the start of advertising", connected_us);
		}
	}

	TEST_PASS("peripheral_aux_connect");
}

static const struct bst_test_instance test_aux_connect[] = {
	{
		.test_id = "central_aux_connect",
		.test_descr = "Initiates once per round, expects a connection without a stop.",
		.test_main_f = test_central_aux_connect_main,
	},
	{
		.test_id = "peripheral_aux_connect",
		.test_descr = "Advertises once per round, stops later from sweep round to round.",
		.test_main_f = test_peripheral_aux_connect_main,
	},
	BSTEST_END_MARKER,
};

struct bst_test_list *test_aux_connect_install(struct bst_test_list *tests)
{
	return bst_add_tests(tests, test_aux_connect);
}
```

## src/test_aux_connect_preempt.c
```c
/*
 * SPDX-FileCopyrightText: Copyright (c) 2026 Silicon Laboratories Inc.
 * SPDX-License-Identifier: Apache-2.0
 */

#include <stdbool.h>
#include <stddef.h>
#include <stdint.h>

#include <zephyr/bluetooth/addr.h>
#include <zephyr/bluetooth/bluetooth.h>
#include <zephyr/bluetooth/conn.h>
#include <zephyr/bluetooth/hci.h>
#include <zephyr/kernel.h>
#include <zephyr/sys/util.h>

#include "subsys/bluetooth/controller/util/memq.h"
#include "subsys/bluetooth/controller/util/mayfly.h"
#include "subsys/bluetooth/controller/ticker/ticker.h"
#include "subsys/bluetooth/controller/ll_sw/nordic/hal/nrf5/ticker.h"
#include "subsys/bluetooth/controller/ll_sw/pdu_df.h"
#include "subsys/bluetooth/controller/ll_sw/nordic/lll/pdu_vendor.h"
#include "subsys/bluetooth/controller/ll_sw/pdu.h"
#include "subsys/bluetooth/controller/ll_sw/lll.h"
#include "subsys/bluetooth/controller/ll_sw/lll_clock.h"
#include "subsys/bluetooth/controller/ll_sw/nordic/lll/lll_internal.h"

#include "babblekit/testcase.h"
#include "bstests.h"

/* In round 1, right after the peripheral's Controller has accepted the
 * AUX_CONNECT_REQ, the test prepares an event of its own whose preempt timeout
 * has already passed, so that it preempts the auxiliary event before the
 * AUX_CONNECT_RSP. That prepare has to be cancelled and the AUX_CONNECT_RSP has
 * to establish the connection, as in round 0. In round 2 the same prepare, made
 * while no event runs, has to run.
 */
#define ROUNDS         3U
#define ROUND_MS       200U
#define FIRST_ROUND_MS 100U
#define ADV_DELAY_MS   10U
#define ADV_INTERVAL   0x0020 /* 20 ms */
#define SCAN_INTERVAL  0x0060 /* 60 ms */
#define CREATE_TIMEOUT 10U    /* 100 ms */
#define CONN_INTERVAL  0x0006 /* 7.5 ms */
#define WAIT_MS        150U

/* Far enough back for any preempt timeout of the Controller to have passed */
#define PREPARE_BACK_US 10000U

static const bt_addr_le_t peripheral_addr = {
	.type = BT_ADDR_LE_RANDOM,
	.a.val = {0x02, 0x00, 0x00, 0x00, 0x00, 0xc0},
};

static K_SEM_DEFINE(connected_sem, 0, 1);
static K_SEM_DEFINE(disconnected_sem, 0, 1);
static uint8_t disconnected_reason;
static uint32_t connected_cycles;
static uint8_t connected_err;

static struct ull_hdr preemptor_ull;
static struct lll_hdr preemptor_lll = {
	.parent = &preemptor_ull,
};
static struct lll_prepare_param preemptor_prepare_param;
static uint32_t volatile preemptor_cancelled;
static uint32_t volatile preemptor_ran;
static uint32_t volatile rsp_count;
static int volatile preemptor_err;
static bool volatile preemptor_armed;

static void connected(struct bt_conn *conn, uint8_t err)
{
	connected_cycles = k_cycle_get_32();
	connected_err = err;
	k_sem_give(&connected_sem);
}

static void disconnected(struct bt_conn *conn, uint8_t reason)
{
	disconnected_reason = reason;
	k_sem_give(&disconnected_sem);
}

static void round_wait(uint32_t round)
{
	/* Both devices start each round at the same time, however long the last one took */
	(void)k_sleep(K_TIMEOUT_ABS_MS(FIRST_ROUND_MS + (round * ROUND_MS)));
}

static int preemptor_prepare_cb(struct lll_prepare_param *prepare_param)
{
	preemptor_ran++;

	/* End the event at once, as an event that finds itself stopped does */
	lll_abort_cb(NULL, prepare_param->param);

	return 0;
}

static void preemptor_abort_cb(struct lll_prepare_param *prepare_param, void *param)
{
	if (prepare_param != NULL) {
		preemptor_cancelled++;
	}

	lll_abort_cb(prepare_param, param);
}

static void preemptor_prepare(void *param)
{
	int err;

	err = lll_hfclock_on();
	if (err < 0) {
		preemptor_err = err;

		return;
	}

	/* Taken back by the done event, as for the prepare of a role */
	preemptor_ull.ref++;

	/* With its preempt timeout passed, lll.c asks the current event at once */
	preemptor_prepare_param.ticks_at_expire =
		(ticker_ticks_now_get() - HAL_TICKER_US_TO_TICKS(PREPARE_BACK_US)) &
		HAL_TICKER_CNTR_MASK;
	preemptor_prepare_param.param = &preemptor_lll;

	err = lll_prepare(lll_is_abort_cb, preemptor_abort_cb, preemptor_prepare_cb, 0,
			  &preemptor_prepare_param);
	if ((err != 0) && (err != -EINPROGRESS)) {
		preemptor_err = err;
	}
}

static memq_link_t preemptor_link;
static struct mayfly preemptor_mfy = {0, 0, &preemptor_link, NULL, preemptor_prepare};

/* Only declared: the linker option --wrap=radio_pkt_tx_set (see CMakeLists.txt)
 * resolves it to the HAL's radio_pkt_tx_set() and routes the Controller's calls
 * of radio_pkt_tx_set() to __wrap_radio_pkt_tx_set() below.
 */
void __real_radio_pkt_tx_set(void *tx_packet);

void __wrap_radio_pkt_tx_set(void *tx_packet)
{
	const struct pdu_adv *pdu = tx_packet;

	/* The radio ISR of an accepted AUX_CONNECT_REQ sets up the AUX_CONNECT_RSP:
	 * prepare the preemptor right after that ISR, from the same context.
	 */
	if (pdu->type == PDU_ADV_TYPE_AUX_CONNECT_RSP) {
		rsp_count++;

		if (preemptor_armed) {
			uint32_t ret;

			preemptor_armed = false;

			ret = mayfly_enqueue(TICKER_USER_ID_LLL, TICKER_USER_ID_LLL, 1U,
					     &preemptor_mfy);
			if (ret != 0U) {
				preemptor_err = -EBUSY;
			}
		}
	}

	__real_radio_pkt_tx_set(tx_packet);
}

static void test_central_aux_connect_preempt_main(void)
{
	const struct bt_conn_le_create_param create_param = {
		.options = BT_CONN_LE_OPT_NONE,
		.interval = SCAN_INTERVAL,
		.window = SCAN_INTERVAL,
		.timeout = CREATE_TIMEOUT,
	};
	static struct bt_conn_cb conn_callbacks = {
		.connected = connected,
		.disconnected = disconnected,
	};
	int err;

	TEST_START("central_aux_connect_preempt");

	err = bt_conn_cb_register(&conn_callbacks);
	TEST_ASSERT(err == 0, "Callback registration failed (err %d)", err);

	err = bt_enable(NULL);
	TEST_ASSERT(err == 0, "Bluetooth init failed (err %d)", err);

	for (uint32_t round = 0U; round < ROUNDS; round++) {
		struct bt_conn *conn = NULL;

		round_wait(round);

		err = bt_conn_le_create(&peripheral_addr, &create_param,
					BT_LE_CONN_PARAM(CONN_INTERVAL, CONN_INTERVAL, 0, 100),
					&conn);
		TEST_ASSERT(err == 0, "Round %u: create failed (err %d)", round, err);

		err = k_sem_take(&connected_sem, K_MSEC(WAIT_MS));
		TEST_ASSERT((err == 0) && (connected_err == 0U), "Round %u: not connected", round);

		err = bt_conn_disconnect(conn, BT_HCI_ERR_REMOTE_USER_TERM_CONN);
		TEST_ASSERT(err == 0, "Round %u: disconnect failed (err %d)", round, err);

		/* Only a connection that the peripheral has as well ends by the
		 * termination.
		 */
		err = k_sem_take(&disconnected_sem, K_MSEC(WAIT_MS));
		TEST_ASSERT((err == 0) && (disconnected_reason == BT_HCI_ERR_LOCALHOST_TERM_CONN),
			    "Round %u: disconnected with reason 0x%02x", round,
			    disconnected_reason);

		bt_conn_drop(&conn);
	}

	TEST_PASS_AND_EXIT("central_aux_connect_preempt");
}

static void test_peripheral_aux_connect_preempt_main(void)
{
	static struct bt_conn_cb conn_callbacks = {
		.connected = connected,
		.disconnected = disconnected,
	};
	const struct bt_le_adv_param adv_param = {
		.id = BT_ID_DEFAULT,
		.options = BT_LE_ADV_OPT_CONN | BT_LE_ADV_OPT_EXT_ADV | BT_LE_ADV_OPT_USE_IDENTITY,
		.interval_min = ADV_INTERVAL,
		.interval_max = ADV_INTERVAL,
	};
	bt_addr_le_t addr = peripheral_addr;
	uint32_t connected_us = 0U;
	struct bt_le_ext_adv *adv;
	int err;

	TEST_START("peripheral_aux_connect_preempt");

	err = bt_conn_cb_register(&conn_callbacks);
	TEST_ASSERT(err == 0, "Callback registration failed (err %d)", err);

	err = bt_id_create(&addr, NULL);
	TEST_ASSERT(err == BT_ID_DEFAULT, "Identity creation failed (err %d)", err);

	err = bt_enable(NULL);
	TEST_ASSERT(err == 0, "Bluetooth init failed (err %d)", err);

	err = bt_le_ext_adv_create(&adv_param, NULL, &adv);
	TEST_ASSERT(err == 0, "Advertising set creation failed (err %d)", err);

	for (uint32_t round = 0U; round < ROUNDS; round++) {
		uint32_t start_cycles;
		k_timeout_t timeout;
		uint32_t at_us;

		round_wait(round);

		/* Start after the central initiates, so that it connects in the first
		 * advertising event, the one that round 0 measures.
		 */
		(void)k_sleep(K_MSEC(ADV_DELAY_MS));

		if (round == 1U) {
			preemptor_armed = true;
		} else if (round == 2U) {
			uint32_t ret;

			ret = mayfly_enqueue(TICKER_USER_ID_THREAD, TICKER_USER_ID_LLL, 0U,
					     &preemptor_mfy);
			TEST_ASSERT(ret == 0U, "Round 2: prepare not enqueued (ret %u)", ret);

			/* Let the LLL run the prepare, which ends its event at once */
			(void)k_sleep(K_MSEC(1));

			TEST_ASSERT(preemptor_ran == 1U, "Round 2: a later prepare did not run");
		}

		k_sem_reset(&connected_sem);
		rsp_count = 0U;

		err = bt_le_ext_adv_start(adv, BT_LE_EXT_ADV_START_DEFAULT);
		TEST_ASSERT(err == 0, "Round %u: advertising failed to start (err %d)", round, err);

		start_cycles = k_cycle_get_32();

		/* After round 0, fail before a second AUX_CONNECT_RSP could come, an
		 * advertising interval later.
		 */
		timeout = (round == 0U) ? K_MSEC(WAIT_MS) : K_USEC(connected_us + 10000U);

		err = k_sem_take(&connected_sem, timeout);

		if (round == 1U) {
			TEST_ASSERT((preemptor_cancelled == 1U) && (preemptor_ran == 0U),
				    "Round 1: preempting prepare cancelled %u, run %u",
				    preemptor_cancelled, preemptor_ran);
		}

		TEST_ASSERT((err == 0) && (connected_err == 0U), "Round %u: not connected", round);

		/* The connection came with the AUX_CONNECT_RSP that the preemptor met */
		if (round == 1U) {
			TEST_ASSERT(rsp_count == 1U, "Round 1: connected after %u AUX_CONNECT_RSP",
				    rsp_count);
		}

		at_us = k_cyc_to_us_floor32(connected_cycles - start_cycles);
		if (round == 0U) {
			connected_us = at_us;
		}

		TEST_PRINT("Round %u: connected %u us after the start, %u AUX_CONNECT_RSP", round,
			   at_us, rsp_count);

		/* The central ends the simulation after the last round */
		if (round < (ROUNDS - 1U)) {
			err = k_sem_take(&disconnected_sem, K_MSEC(WAIT_MS));
			TEST_ASSERT(err == 0, "Round %u: not disconnected", round);
		}
	}

	TEST_ASSERT(preemptor_err == 0, "Preempting prepare failed (err %d)", preemptor_err);
	TEST_ASSERT(preemptor_ull.ref == 0U, "Preempting prepare left %u references",
		    preemptor_ull.ref);

	TEST_PASS("peripheral_aux_connect_preempt");
}

static const struct bst_test_instance test_aux_connect_preempt[] = {
	{
		.test_id = "central_aux_connect_preempt",
		.test_descr = "Initiates once per round, expects a connection on both sides.",
		.test_main_f = test_central_aux_connect_preempt_main,
	},
	{
		.test_id = "peripheral_aux_connect_preempt",
		.test_descr = "Advertises once per round, preempts the AUX_CONNECT_RSP in round 1.",
		.test_main_f = test_peripheral_aux_connect_preempt_main,
	},
	BSTEST_END_MARKER,
};

struct bst_test_list *test_aux_connect_preempt_install(struct bst_test_list *tests)
{
	return bst_add_tests(tests, test_aux_connect_preempt);
}
```
