## CMakeLists.txt
```
# SPDX-License-Identifier: Apache-2.0

cmake_minimum_required(VERSION 3.28.0)

find_package(Zephyr REQUIRED HINTS $ENV{ZEPHYR_BASE})
project(bsim_test_advx)

add_subdirectory("${ZEPHYR_BASE}/tests/bsim/babblekit" babblekit)
add_subdirectory("${ZEPHYR_BASE}/tests/bluetooth/common/testlib" testlib)
target_link_libraries(app PRIVATE
  babblekit
  testlib
)

target_sources(app PRIVATE
  "src/main.c"
  "src/aux_time.c"
  "src/scan_req_tgta.c"
  "src/anonymous.c"
  "src/connect.c"
)

zephyr_include_directories(
  ${BSIM_COMPONENTS_PATH}/libUtilv1/src/
  ${BSIM_COMPONENTS_PATH}/libPhyComv1/src/
  ${ZEPHYR_BASE}/subsys/bluetooth/controller/include
  ${ZEPHYR_BASE}/subsys/bluetooth/controller/ll_sw
  ${ZEPHYR_BASE}/subsys/bluetooth/controller/ll_sw/nordic/
  ${ZEPHYR_BASE}/subsys/bluetooth/controller/ll_sw/nordic/lll
  ${ZEPHYR_BASE}/subsys/bluetooth/controller/util
  ${ZEPHYR_BASE}/subsys/bluetooth/controller/hal
  )

# src/anonymous.c checks the Direct_Address_Type of the HCI event in its own
# bt_hci_le_adv_ext_report(), which hands the event on to the one of the Host
set_source_files_properties(${ZEPHYR_BASE}/subsys/bluetooth/host/scan.c
  DIRECTORY ${ZEPHYR_BASE}/subsys/bluetooth/host
  PROPERTIES COMPILE_DEFINITIONS bt_hci_le_adv_ext_report=real_bt_hci_le_adv_ext_report)
```

## prj.conf
```kconfig
CONFIG_BT=y
CONFIG_BT_DEVICE_NAME="AdvX"
CONFIG_BT_BROADCASTER=y
CONFIG_BT_PERIPHERAL=y
CONFIG_BT_OBSERVER=y
CONFIG_BT_CENTRAL=y

CONFIG_BT_EXT_ADV=y
CONFIG_BT_PER_ADV=y
CONFIG_BT_PER_ADV_SYNC=y

CONFIG_BT_ID_MAX=2
CONFIG_BT_EXT_ADV_MAX_ADV_SET=2
CONFIG_BT_PER_ADV_SYNC_MAX=2

CONFIG_BT_CTLR_PRIVACY=y
# The anonymous scan test has directed advertising whose TargetA, a
# resolvable private address, is in a PDU without AdvA
CONFIG_BT_CTLR_SCAN_TGTA_LOCAL_IRK=y
CONFIG_BT_CTLR_ADV_EXT=y
CONFIG_BT_CTLR_ADV_PERIODIC=y
CONFIG_BT_CTLR_SYNC_PERIODIC=y

CONFIG_ASSERT=y

# The scan requests come from the identity address that the directed
# advertising of the scan request test is sent to
CONFIG_BT_SCAN_WITH_IDENTITY=y
CONFIG_BT_SCAN_EXT_FILTER_POLICY=y
CONFIG_BT_CTLR_SCAN_REQ_NOTIFY=y
CONFIG_BT_FILTER_ACCEPT_LIST=y

# With a single buffer, setting the scan response data of a scannable
# extended advertising set waits for a free PDU buffer that never comes
CONFIG_BT_CTLR_ADV_DATA_BUF_MAX=2

CONFIG_BT_CTLR_ADV_DATA_LEN_MAX=191
```

## overlay-chained.conf
```kconfig
# Enable Advertising Data chaining in Zephyr Bluetooth LE Controller
CONFIG_BT_CTLR_ADVANCED_FEATURES=y
CONFIG_BT_CTLR_ADV_RESERVE_MAX=n
CONFIG_BT_CTLR_ADV_DATA_CHAIN=y

# Zephyr Bluetooth LE Controller will need to use chain PDUs when AD data
# length > 191 bytes
# - 31 bytes will use 22 bytes for the default name in this sample plus 9 bytes
#   for manufacturer data
# - 191 bytes will use 22 bytes for the default name in this sample plus 169
#   bytes for manufacturer data
# - 277 bytes will use 22 bytes for the default name in this sample plus 255
#   bytes for manufacturer data
CONFIG_BT_CTLR_ADV_DATA_LEN_MAX=1650
```

## src/anonymous.c
```c
/*
 * SPDX-FileCopyrightText: Copyright (c) 2026 Silicon Laboratories Inc.
 * SPDX-License-Identifier: Apache-2.0
 */

#include <stdbool.h>
#include <stdint.h>
#include <string.h>

#include <zephyr/bluetooth/addr.h>
#include <zephyr/bluetooth/bluetooth.h>
#include <zephyr/bluetooth/gap.h>
#include <zephyr/bluetooth/hci.h>
#include <zephyr/kernel.h>
#include <zephyr/net_buf.h>
#include <zephyr/sys/atomic.h>
#include <zephyr/sys/util.h>

#include "bstests.h"
#include "babblekit/testcase.h"
#include "host/hci_core.h"

/* The static random identity address of the scanner, C0:00:00:00:00:02. The
 * directed advertising that test_data/gen_anonymous.py writes for
 * anonymous.sh has it as the TargetA.
 */
static const bt_addr_le_t scanner_addr = {
	.type = BT_ADDR_LE_RANDOM,
	.a = { { 0x02, 0x00, 0x00, 0x00, 0x00, 0xC0 } },
};

/* A device that is not in the simulation, C0:00:00:00:00:03. The directed
 * advertising that test_data/gen_anonymous.py writes for anonymous_other.sh
 * has it as the TargetA.
 */
static const bt_addr_le_t other_addr = {
	.type = BT_ADDR_LE_RANDOM,
	.a = { { 0x03, 0x00, 0x00, 0x00, 0x00, 0xC0 } },
};

/* The AdvA of the directed advertising to a resolvable private address,
 * C0:00:00:00:00:05, which the playback device of anonymous.sh sends with the
 * AdvA only in the AUX_ADV_IND
 */
static const bt_addr_le_t rpa_directed_addr = {
	.type = BT_ADDR_LE_RANDOM,
	.a = { { 0x05, 0x00, 0x00, 0x00, 0x00, 0xC0 } },
};

/* The local IRK of the resolving list entry of the scanner, the IRK of the
 * sample data of the random address hash function ah (Core Spec v6.3, Vol 3,
 * Part H, Appendix D.7) in HCI octet order. The TargetA of the directed
 * advertising to a resolvable private address is generated from it.
 */
static const uint8_t local_irk[16] = {
	0x9b, 0x7d, 0x39, 0x0a, 0xa6, 0x10, 0x10, 0x34,
	0x05, 0xad, 0xc8, 0x57, 0xa3, 0x34, 0x02, 0xec,
};

/* The peer of the resolving list entry, a device that is not in the
 * simulation, C0:00:00:00:00:06, so that no AdvA selects the entry
 */
static const bt_addr_le_t rl_peer_addr = {
	.type = BT_ADDR_LE_RANDOM,
	.a = { { 0x06, 0x00, 0x00, 0x00, 0x00, 0xC0 } },
};

/* The AD data of the advertising in AUX_ADV_INDs, which the playback device
 * of the test scripts sends: anonymous undirected, directed with the TargetA
 * in the AUX_ADV_IND, and directed with it in the ADV_EXT_IND, and directed
 * with a resolvable private address that resolves with the local IRK and one
 * that does not: in the ADV_EXT_IND with the AdvA in the AUX_ADV_IND, and in the
 * AUX_ADV_IND without any AdvA, and the one that resolves in the AUX_ADV_IND
 * with the AdvA in the ADV_EXT_IND
 */
#define AD_UNDIRECTED             0x01U
#define AD_DIRECTED               0x02U
#define AD_DIRECTED_PRI           0x03U
#define AD_DIRECTED_RPA           0x04U
#define AD_DIRECTED_RPA_OTHER     0x05U
#define AD_DIRECTED_RPA_AUX       0x06U
#define AD_DIRECTED_RPA_AUX_OTHER 0x07U
#define AD_DIRECTED_RPA_AUX_ADVA  0x08U

/* The advertising sets of the playback device directed to the scanner with its
 * identity address, the one with the TargetA in the AUX_ADV_IND and the one with
 * it in the ADV_EXT_IND
 */
#define SID_DIRECTED     2U
#define SID_DIRECTED_PRI 3U

/* The advertising set of the playback device whose AUX_ADV_IND announces a
 * TxPower that its extended header has no room for, which may not be reported
 */
#define SID_TRUNCATED 6U

/* The advertising sets of the playback device directed to a resolvable private
 * address that resolves with the local IRK, as in the AD data above
 */
#define SID_RPA          7U
#define SID_RPA_AUX      9U
#define SID_RPA_AUX_ADVA 11U

/* The kinds of anonymous advertising reported. The advertising sets of the
 * advertiser device have no ADI and no AD data, so the reports do not tell
 * them apart otherwise.
 */
#define REPORT_UNDIRECTED        BIT(0)
#define REPORT_DIRECTED          BIT(1)
#define REPORT_UNDIRECTED_AD     BIT(2)
#define REPORT_DIRECTED_AD       BIT(3)
#define REPORT_DIRECTED_PRI_AD   BIT(4)
#define REPORT_OTHER             BIT(5)
#define REPORT_TRUNCATED         BIT(6)
#define REPORT_DIRECTED_RPA      BIT(7)
#define REPORT_RPA_OTHER         BIT(8)
#define REPORT_DIRECTED_RPA_AUX  BIT(9)
#define REPORT_DIRECTED_RPA_ADVA BIT(10)

static atomic_t reports;

static void adv_start(const bt_addr_le_t *peer)
{
	struct bt_le_adv_param param = BT_LE_ADV_PARAM_INIT(
		BT_LE_ADV_OPT_EXT_ADV | BT_LE_ADV_OPT_ANONYMOUS, BT_GAP_ADV_FAST_INT_MIN_2,
		BT_GAP_ADV_FAST_INT_MAX_2, peer);
	struct bt_le_ext_adv *adv;
	int err;

	if (peer != NULL) {
		param.options |= BT_LE_ADV_OPT_DIR_MODE_LOW_DUTY;
	}

	err = bt_le_ext_adv_create(&param, NULL, &adv);
	TEST_ASSERT(err == 0, "Advertising set create failed (err %d)", err);

	err = bt_le_ext_adv_start(adv, BT_LE_EXT_ADV_START_DEFAULT);
	TEST_ASSERT(err == 0, "Advertising start failed (err %d)", err);
}

/* Undirected anonymous advertising, and directed to the given device. The
 * Controller sends no AuxPtr without AD data.
 */
static void anon_adv(const bt_addr_le_t *peer)
{
	int err;

	err = bt_enable(NULL);
	TEST_ASSERT(err == 0, "Bluetooth init failed (err %d)", err);

	adv_start(NULL);
	adv_start(peer);
}

static void test_anon_adv(void)
{
	TEST_START("anon_adv");

	anon_adv(&scanner_addr);

	/* The scanner checks which of the sets it reports */
	TEST_PASS("anon_adv");
}

static void test_anon_adv_other(void)
{
	TEST_START("anon_adv_other");

	anon_adv(&other_addr);

	/* The scanner checks which of the sets it reports */
	TEST_PASS("anon_adv_other");
}

static bool ad_parse(struct bt_data *data, void *user_data)
{
	uint8_t *ad_value = user_data;

	if ((data->type == BT_DATA_MANUFACTURER_DATA) && (data->data_len == 1U)) {
		*ad_value = data->data[0];

		return false;
	}

	return true;
}

static void scan_recv(const struct bt_le_scan_recv_info *info, struct net_buf_simple *buf)
{
	bool is_directed = ((info->adv_props & BT_GAP_ADV_PROP_DIRECTED) != 0U);
	uint8_t ad_value = 0U;

	if (bt_addr_le_eq(info->addr, &rpa_directed_addr)) {
		bt_data_parse(buf, ad_parse, &ad_value);

		if (is_directed && (ad_value == AD_DIRECTED_RPA)) {
			(void)atomic_or(&reports, REPORT_DIRECTED_RPA);
		} else if (is_directed && (ad_value == AD_DIRECTED_RPA_AUX_ADVA)) {
			(void)atomic_or(&reports, REPORT_DIRECTED_RPA_ADVA);
		} else {
			(void)atomic_or(&reports, REPORT_RPA_OTHER);
		}

		return;
	}

	/* The Host reports anonymous advertising as from BT_ADDR_LE_ANY */
	if (!bt_addr_le_eq(info->addr, BT_ADDR_LE_ANY)) {
		return;
	}

	if (info->sid == SID_TRUNCATED) {
		(void)atomic_or(&reports, REPORT_TRUNCATED);

		return;
	}

	bt_data_parse(buf, ad_parse, &ad_value);

	if (ad_value == 0U) {
		(void)atomic_or(&reports, is_directed ? REPORT_DIRECTED : REPORT_UNDIRECTED);
	} else if (!is_directed && (ad_value == AD_UNDIRECTED)) {
		(void)atomic_or(&reports, REPORT_UNDIRECTED_AD);
	} else if (is_directed && (ad_value == AD_DIRECTED)) {
		(void)atomic_or(&reports, REPORT_DIRECTED_AD);
	} else if (is_directed && (ad_value == AD_DIRECTED_PRI)) {
		(void)atomic_or(&reports, REPORT_DIRECTED_PRI_AD);
	} else if (is_directed && (ad_value == AD_DIRECTED_RPA_AUX)) {
		(void)atomic_or(&reports, REPORT_DIRECTED_RPA_AUX);
	} else {
		(void)atomic_or(&reports, REPORT_OTHER);
	}
}

static struct bt_le_scan_cb scan_cb = {
	.recv = scan_recv,
};

/* The handler of the Host in scan.c, which CMakeLists.txt compiles under this
 * name, so that the HCI event reaches bt_hci_le_adv_ext_report() below first
 */
void real_bt_hci_le_adv_ext_report(struct net_buf *buf);

/* The Host gives the application a resolved Direct_Address_Type as the address
 * type it resolves to, so the HCI event is what tells whether the TargetA counted
 * as resolved (Core Spec v6.3, Vol 4, Part E, Section 7.7.65.13). The Controller
 * sends one report per event.
 */
void bt_hci_le_adv_ext_report(struct net_buf *buf)
{
	/* The TargetA that resolves with the local IRK, as in
	 * test_data/gen_anonymous.py
	 */
	static const bt_addr_t resolvable_rpa = {
		{ 0xAA, 0xFB, 0x0D, 0x94, 0x81, 0x70 },
	};
	const struct bt_hci_evt_le_ext_advertising_report *evt = (const void *)buf->data;
	const struct bt_hci_evt_le_ext_advertising_info *adv_info = &evt->adv_info[0];
	const uint8_t sid = adv_info->sid;

	if ((sid == SID_RPA) || (sid == SID_RPA_AUX) || (sid == SID_RPA_AUX_ADVA)) {
		TEST_ASSERT(adv_info->direct_addr.type == BT_ADDR_LE_RANDOM_ID,
			    "Set %u reported with Direct_Address_Type 0x%02x", sid,
			    adv_info->direct_addr.type);
		TEST_ASSERT(bt_addr_eq(&adv_info->direct_addr.a, &resolvable_rpa),
			    "Set %u reported without the TargetA as received", sid);
	} else if ((sid == SID_DIRECTED) || (sid == SID_DIRECTED_PRI)) {
		TEST_ASSERT(adv_info->direct_addr.type == BT_ADDR_LE_RANDOM,
			    "Set %u reported with Direct_Address_Type 0x%02x", sid,
			    adv_info->direct_addr.type);
	}

	real_bt_hci_le_adv_ext_report(buf);
}

static atomic_val_t scan(uint8_t options)
{
	/* Active, as anonymous.sh checks which advertising gets AUX_SCAN_REQs */
	struct bt_le_scan_param param = BT_LE_SCAN_PARAM_INIT(
		BT_LE_SCAN_TYPE_ACTIVE, options, BT_GAP_SCAN_FAST_INTERVAL,
		BT_GAP_SCAN_FAST_INTERVAL);
	int err;

	(void)atomic_clear(&reports);

	err = bt_le_scan_start(&param, NULL);
	TEST_ASSERT(err == 0, "Scan start failed (err %d)", err);

	/* Scan for a fixed time, as the kinds that are not reported are part
	 * of what is checked. The playback device of the test scripts sends
	 * for the first 6 seconds of the simulation, which three scans fit in.
	 */
	(void)k_sleep(K_SECONDS(2));

	err = bt_le_scan_stop();
	TEST_ASSERT(err == 0, "Scan stop failed (err %d)", err);

	return atomic_get(&reports);
}

/* A resolving list entry with the local IRK, and address resolution enabled,
 * through HCI, as the Host adds entries only for bonded peers
 */
static void local_irk_add(void)
{
	struct bt_hci_cp_le_set_addr_res_enable *enable;
	struct bt_hci_cp_le_add_dev_to_rl *entry;
	struct net_buf *buf;
	int err;

	buf = bt_hci_cmd_alloc(K_FOREVER);
	TEST_ASSERT(buf != NULL, "No HCI command buffer");

	entry = net_buf_add(buf, sizeof(*entry));
	bt_addr_le_copy(&entry->peer_id_addr, &rl_peer_addr);
	(void)memset(entry->peer_irk, 0, sizeof(entry->peer_irk));
	(void)memcpy(entry->local_irk, local_irk, sizeof(entry->local_irk));

	err = bt_hci_cmd_send_sync(BT_HCI_OP_LE_ADD_DEV_TO_RL, buf, NULL);
	TEST_ASSERT(err == 0, "Resolving list add failed (err %d)", err);

	buf = bt_hci_cmd_alloc(K_FOREVER);
	TEST_ASSERT(buf != NULL, "No HCI command buffer");

	enable = net_buf_add(buf, sizeof(*enable));
	enable->enable = BT_HCI_ADDR_RES_ENABLE;

	err = bt_hci_cmd_send_sync(BT_HCI_OP_LE_SET_ADDR_RES_ENABLE, buf, NULL);
	TEST_ASSERT(err == 0, "Address resolution enable failed (err %d)", err);
}

static void scanner_init(void)
{
	bt_addr_le_t addr = scanner_addr;
	int err;

	err = bt_id_create(&addr, NULL);
	TEST_ASSERT(err >= 0, "Identity create failed (err %d)", err);

	err = bt_enable(NULL);
	TEST_ASSERT(err == 0, "Bluetooth init failed (err %d)", err);

	local_irk_add();

	err = bt_le_scan_cb_register(&scan_cb);
	TEST_ASSERT(err == 0, "Scan callback register failed (err %d)", err);
}

static void test_anon_scan(void)
{
	/* The anonymous advertising to the scanner. The advertiser of the other
	 * directed advertising to a resolvable private address has an AdvA,
	 * which is not in the Filter Accept List.
	 */
	const atomic_val_t to_scanner = REPORT_UNDIRECTED | REPORT_DIRECTED |
					REPORT_UNDIRECTED_AD | REPORT_DIRECTED_AD |
					REPORT_DIRECTED_PRI_AD | REPORT_DIRECTED_RPA_AUX;
	const bt_addr_le_t anon = { .type = BT_ADDR_LE_ANONYMOUS };
	atomic_val_t reported;
	int err;

	TEST_START("anon_scan");

	scanner_init();

	reported = scan(BT_LE_SCAN_OPT_NONE);
	TEST_ASSERT(reported == (to_scanner | REPORT_DIRECTED_RPA | REPORT_DIRECTED_RPA_ADVA),
		    "Anonymous advertising reported as 0x%lx", (unsigned long)reported);

	/* The Filter Accept List has no entry for anonymous advertising, nor
	 * for the advertiser of the directed advertising to a resolvable
	 * private address
	 */
	reported = scan(BT_LE_SCAN_OPT_FILTER_ACCEPT_LIST);
	TEST_ASSERT(reported == 0, "Anonymous advertising reported as 0x%lx with the list",
		    (unsigned long)reported);

	err = bt_le_filter_accept_list_remove(&anon);
	TEST_ASSERT(err != 0, "Filter Accept List remove of the absent anonymous entry succeeded");

	err = bt_le_filter_accept_list_add(&anon);
	TEST_ASSERT(err == 0, "Filter Accept List add failed (err %d)", err);

	reported = scan(BT_LE_SCAN_OPT_FILTER_ACCEPT_LIST);
	TEST_ASSERT(reported == to_scanner,
		    "Anonymous advertising reported as 0x%lx with the anonymous entry",
		    (unsigned long)reported);

	TEST_PASS("anon_scan");
}

static void test_anon_scan_other(void)
{
	atomic_val_t reported;

	TEST_START("anon_scan_other");

	scanner_init();

	reported = scan(BT_LE_SCAN_OPT_NONE);
	TEST_ASSERT(reported == (REPORT_UNDIRECTED | REPORT_UNDIRECTED_AD),
		    "Anonymous advertising reported as 0x%lx", (unsigned long)reported);

	TEST_PASS("anon_scan_other");
}

static const struct bst_test_instance test_def[] = {
	{
		.test_id = "anon_adv",
		.test_descr = "Anonymous advertising, undirected and directed to the scanner",
		.test_main_f = test_anon_adv,
	},
	{
		.test_id = "anon_adv_other",
		.test_descr = "Anonymous advertising, undirected and directed to another device",
		.test_main_f = test_anon_adv_other,
	},
	{
		.test_id = "anon_scan",
		.test_descr = "Passive scanner of anonymous advertising to the scanner",
		.test_main_f = test_anon_scan,
	},
	{
		.test_id = "anon_scan_other",
		.test_descr = "Passive scanner of anonymous advertising to another device",
		.test_main_f = test_anon_scan_other,
	},
	BSTEST_END_MARKER,
};

struct bst_test_list *test_anonymous_install(struct bst_test_list *tests)
{
	return bst_add_tests(tests, test_def);
}
```

## src/aux_time.c
```c
/*
 * Copyright The Zephyr Project Contributors
 *
 * SPDX-License-Identifier: Apache-2.0
 */

#include <stddef.h>
#include <stdint.h>

#include <zephyr/kernel.h>

#include <zephyr/sys/printk.h>
#include <zephyr/sys/util.h>

#include <zephyr/bluetooth/bluetooth.h>
#include <zephyr/bluetooth/hci.h>

#include "mem.h"
#include "memq.h"
#include "lll.h"
#include "pdu_df.h"
#include "pdu_vendor.h"
#include "pdu.h"
#include "ccm.h"
#include "util.h"
#include "lll_adv_types.h"
#include "lll_adv.h"
#include "ull_adv_types.h"
#include "ull_adv_internal.h"
#include "ll.h"

#include "babblekit/testcase.h"

#define FILLER_BYTE(idx, val) (val)

static const uint8_t small_filler[10] = { LISTIFY(10, FILLER_BYTE, (,), 0xAA) };

static const uint8_t med_filler[180] = { LISTIFY(180, FILLER_BYTE, (,), 0xAA) };

static const struct bt_data ad_small[] = {
	BT_DATA_BYTES(BT_DATA_FLAGS, BT_LE_AD_NO_BREDR),
	BT_DATA(BT_DATA_MANUFACTURER_DATA, small_filler, sizeof(small_filler)),
};

static const struct bt_data ad_medium[] = {
	BT_DATA_BYTES(BT_DATA_FLAGS, BT_LE_AD_NO_BREDR),
	BT_DATA(BT_DATA_MANUFACTURER_DATA, med_filler, sizeof(med_filler)),
};

static struct ll_adv_aux_set *aux_set_get(struct bt_le_ext_adv *adv)
{
	struct ll_adv_set *adv_set;
	uint8_t handle;
	uint8_t err;

	err = ll_adv_set_by_hci_handle_get(bt_le_ext_adv_get_index(adv), &handle);
	if (err != 0U) {
		return NULL;
	}

	adv_set = ull_adv_set_get(handle);
	if ((adv_set == NULL) || (adv_set->lll.aux == NULL)) {
		return NULL;
	}

	return HDR_LLL2ULL(adv_set->lll.aux);
}

static void aux_time_check_conn(struct bt_le_ext_adv *adv)
{
	struct ll_adv_aux_set *aux;
	int err;
	uint32_t initial_ticks, ticks_1, ticks_2;

	aux = aux_set_get(adv);

	if (aux == NULL) {
		TEST_FAIL("No auxiliary set");
	}

	if (aux->is_started == 0U) {
		TEST_FAIL("Auxiliary set not started");
	}

	initial_ticks = aux->ull.ticks_slot;

	/* set adv_data then record how many ticks slots are reserved for it
	 */
	err = bt_le_ext_adv_set_data(adv, ad_small, ARRAY_SIZE(ad_small), NULL, 0);
	if (err != 0) {
		TEST_FAIL("Failed to set small adv data");
	}
	ticks_1 = aux->ull.ticks_slot;

	/* set a new adv_data PDU, this time larger
	 * verify if reserved tick slots increase
	 */
	err = bt_le_ext_adv_set_data(adv, ad_medium, ARRAY_SIZE(ad_medium), NULL, 0);
	if (err != 0) {
		TEST_FAIL("Failed to set medium adv data");
	}
	ticks_2 = aux->ull.ticks_slot;

	printk("%u, %u, %u\n", initial_ticks, ticks_1, ticks_2);

	if (initial_ticks >= ticks_1 || initial_ticks >= ticks_2 || ticks_1 >= ticks_2) {
		TEST_FAIL("Reserved tick slots for conn adv incorrectly computed");
	}
}

static void test_conn_adv_aux_time(void)
{
	struct bt_le_adv_param adv_param = {
		.id = BT_ID_DEFAULT,
		.sid = 0U,
		.secondary_max_skip = 0U,
		.options = BT_LE_ADV_OPT_EXT_ADV | BT_LE_ADV_OPT_NO_2M | BT_LE_ADV_OPT_CONN,
		.interval_min = BT_GAP_ADV_FAST_INT_MIN_2,
		.interval_max = BT_GAP_ADV_FAST_INT_MAX_2,
		.peer = NULL,
	};
	struct bt_le_ext_adv *adv;
	int err;

	err = bt_enable(NULL);
	if (err != 0) {
		TEST_FAIL("Bluetooth init failed (err %d)", err);
	}

	err = bt_le_ext_adv_create(&adv_param, NULL, &adv);
	if (err != 0) {
		TEST_FAIL("Failed to create advertising set (err %d)", err);
	}

	err = bt_le_ext_adv_start(adv, BT_LE_EXT_ADV_START_DEFAULT);
	if (err != 0) {
		TEST_FAIL("Failed to start advertising set (err %d)", err);
	}

	aux_time_check_conn(adv);

	err = bt_le_ext_adv_stop(adv);
	if (err != 0) {
		TEST_FAIL("Failed to stop advertising set (err %d)", err);
	}

	err = bt_le_ext_adv_delete(adv);
	if (err != 0) {
		TEST_FAIL("Failed to delete advertising set (err %d)", err);
	}

	TEST_PASS_AND_EXIT("Conn adv aux time reservation tests passed");
}

static const struct bst_test_instance test_def[] = {
	{
		.test_id = "conn_adv_aux_time",
		.test_descr = "Auxiliary event time reservation for connectable advertising",
		.test_main_f = test_conn_adv_aux_time
	},
	BSTEST_END_MARKER
};

struct bst_test_list *test_adv_aux_time_install(struct bst_test_list *tests)
{
	return bst_add_tests(tests, test_def);
}
```

## src/connect.c
```c
/*
 * SPDX-FileCopyrightText: Copyright (c) 2026 Silicon Laboratories Inc.
 * SPDX-License-Identifier: Apache-2.0
 */

#include <stdint.h>
#include <string.h>

#include <zephyr/bluetooth/addr.h>
#include <zephyr/bluetooth/bluetooth.h>
#include <zephyr/bluetooth/conn.h>
#include <zephyr/bluetooth/gap.h>
#include <zephyr/bluetooth/hci.h>
#include <zephyr/bluetooth/hci_types.h>
#include <zephyr/kernel.h>
#include <zephyr/net_buf.h>
#include <zephyr/sys/atomic.h>

#include "bstests.h"
#include "babblekit/flags.h"
#include "babblekit/testcase.h"
#include "testlib/conn.h"

/* The static random identity address of the advertiser, C0:00:00:00:00:01 */
static const bt_addr_le_t adv_addr = {
	.type = BT_ADDR_LE_RANDOM,
	.a = { { 0x01, 0x00, 0x00, 0x00, 0x00, 0xC0 } },
};

/* The static random identity address of the initiator, C0:00:00:00:00:02 */
static const bt_addr_le_t init_addr = {
	.type = BT_ADDR_LE_RANDOM,
	.a = {{0x02, 0x00, 0x00, 0x00, 0x00, 0xC0}},
};

DEFINE_FLAG_STATIC(flag_connected);
DEFINE_FLAG_STATIC(flag_disconnected);

static void connected(struct bt_conn *conn, uint8_t err)
{
	if (err == BT_HCI_ERR_SUCCESS) {
		SET_FLAG(flag_connected);
	}
}

static void disconnected(struct bt_conn *conn, uint8_t reason)
{
	SET_FLAG(flag_disconnected);
}

static struct bt_conn_cb conn_cb = {
	.connected = connected,
	.disconnected = disconnected,
};

static void connection_check(void)
{
	WAIT_FOR_FLAG(flag_connected);

	/* A connection that only one of the two devices has entered ends there
	 * with the Connection Failed to be Established error after 6
	 * connection intervals, as no packet comes from the other one. Wait
	 * well beyond that and check that the connection is still up.
	 */
	(void)k_sleep(K_SECONDS(2));
	TEST_ASSERT(!IS_FLAG_SET(flag_disconnected), "Connection lost");
}

static void test_conn_adv(void)
{
	bt_addr_le_t addr = adv_addr;
	struct bt_le_ext_adv *adv;
	int err;

	TEST_START("conn_adv");

	err = bt_id_create(&addr, NULL);
	TEST_ASSERT(err >= 0, "Identity create failed (err %d)", err);

	err = bt_enable(NULL);
	TEST_ASSERT(err == 0, "Bluetooth init failed (err %d)", err);

	err = bt_conn_cb_register(&conn_cb);
	TEST_ASSERT(err == 0, "Callback register failed (err %d)", err);

	err = bt_le_ext_adv_create(BT_LE_EXT_ADV_CONN, NULL, &adv);
	TEST_ASSERT(err == 0, "Advertising set create failed (err %d)", err);

	err = bt_le_ext_adv_start(adv, BT_LE_EXT_ADV_START_DEFAULT);
	TEST_ASSERT(err == 0, "Advertising start failed (err %d)", err);

	connection_check();

	TEST_PASS("conn_adv");
}

static void test_conn_adv_delayed(void)
{
	/* Start advertising only after the initiator has set up its connection */
	(void)k_sleep(K_SECONDS(1));

	test_conn_adv();
}

static void test_conn_init(void)
{
	struct bt_conn *conn = NULL;
	int err;

	TEST_START("conn_init");

	err = bt_enable(NULL);
	TEST_ASSERT(err == 0, "Bluetooth init failed (err %d)", err);

	err = bt_conn_cb_register(&conn_cb);
	TEST_ASSERT(err == 0, "Callback register failed (err %d)", err);

	err = bt_testlib_connect(&adv_addr, &conn);
	TEST_ASSERT(err == 0, "Connection failed (err %d)", err);

	connection_check();

	bt_testlib_conn_unref(&conn);

	TEST_PASS("conn_init");
}

static void test_conn_init_fal(void)
{
	int err;

	TEST_START("conn_init_fal");

	err = bt_enable(NULL);
	TEST_ASSERT(err == 0, "Bluetooth init failed (err %d)", err);

	err = bt_conn_cb_register(&conn_cb);
	TEST_ASSERT(err == 0, "Callback register failed (err %d)", err);

	err = bt_le_filter_accept_list_add(&adv_addr);
	TEST_ASSERT(err == 0, "Filter Accept List add failed (err %d)", err);

	err = bt_conn_le_create_auto(BT_CONN_LE_CREATE_CONN, BT_LE_CONN_PARAM_DEFAULT);
	TEST_ASSERT(err == 0, "Connection create failed (err %d)", err);

	connection_check();

	TEST_PASS("conn_init_fal");
}

static void bt_up(void)
{
	int err;

	err = bt_enable(NULL);
	TEST_ASSERT(err == 0, "Bluetooth init failed (err %d)", err);

	err = bt_conn_cb_register(&conn_cb);
	TEST_ASSERT(err == 0, "Callback register failed (err %d)", err);
}

static void init_fal_adv(const struct bt_conn_le_create_param *create_param)
{
	struct bt_le_ext_adv *adv;
	int err;

	/* An advertising set of our own, which does not use the Filter Accept List. Enabling any
	 * set updates the controller filters; a non-connectable one needs no connection object
	 * besides the one of the pending connection.
	 */
	err = bt_le_ext_adv_create(BT_LE_EXT_ADV_NCONN, NULL, &adv);
	TEST_ASSERT(err == 0, "Advertising set create failed (err %d)", err);

	err = bt_le_ext_adv_start(adv, BT_LE_EXT_ADV_START_DEFAULT);
	TEST_ASSERT(err == 0, "Advertising start failed (err %d)", err);

	/* Pause advertising around the Filter Accept List write, and enable it again while the
	 * connection to an accept listed device is pending.
	 */
	err = bt_le_ext_adv_stop(adv);
	TEST_ASSERT(err == 0, "Advertising stop failed (err %d)", err);

	err = bt_le_filter_accept_list_add(&adv_addr);
	TEST_ASSERT(err == 0, "Filter Accept List add failed (err %d)", err);

	err = bt_conn_le_create_auto(create_param, BT_LE_CONN_PARAM_DEFAULT);
	TEST_ASSERT(err == 0, "Connection create failed (err %d)", err);

	err = bt_le_ext_adv_start(adv, BT_LE_EXT_ADV_START_DEFAULT);
	TEST_ASSERT(err == 0, "Advertising restart failed (err %d)", err);

	connection_check();
}

static void test_conn_init_fal_adv(void)
{
	TEST_START("conn_init_fal_adv");

	bt_up();
	init_fal_adv(BT_CONN_LE_CREATE_CONN);

	TEST_PASS("conn_init_fal_adv");
}

static void test_conn_init_fal_adv_coded(void)
{
	/* Initiate on the LE Coded PHY only, which uses the coded scan set alone */
	const struct bt_conn_le_create_param create_param =
		BT_CONN_LE_CREATE_PARAM_INIT(BT_CONN_LE_OPT_CODED | BT_CONN_LE_OPT_NO_1M,
					     BT_GAP_SCAN_FAST_INTERVAL, BT_GAP_SCAN_FAST_INTERVAL);

	TEST_START("conn_init_fal_adv_coded");

	bt_up();
	init_fal_adv(&create_param);

	TEST_PASS("conn_init_fal_adv_coded");
}

static void test_conn_adv_coded_delayed(void)
{
	const struct bt_le_adv_param param = BT_LE_ADV_PARAM_INIT(
		BT_LE_ADV_OPT_EXT_ADV | BT_LE_ADV_OPT_CONN | BT_LE_ADV_OPT_CODED,
		BT_GAP_ADV_FAST_INT_MIN_2, BT_GAP_ADV_FAST_INT_MAX_2, NULL);
	bt_addr_le_t addr = adv_addr;
	struct bt_le_ext_adv *adv;
	int err;

	TEST_START("conn_adv_coded");

	err = bt_id_create(&addr, NULL);
	TEST_ASSERT(err >= 0, "Identity create failed (err %d)", err);

	err = bt_enable(NULL);
	TEST_ASSERT(err == 0, "Bluetooth init failed (err %d)", err);

	err = bt_conn_cb_register(&conn_cb);
	TEST_ASSERT(err == 0, "Callback register failed (err %d)", err);

	err = bt_le_ext_adv_create(&param, NULL, &adv);
	TEST_ASSERT(err == 0, "Advertising set create failed (err %d)", err);

	/* Start advertising only after the initiator has set up its connection */
	(void)k_sleep(K_SECONDS(1));

	err = bt_le_ext_adv_start(adv, BT_LE_EXT_ADV_START_DEFAULT);
	TEST_ASSERT(err == 0, "Advertising start failed (err %d)", err);

	connection_check();

	TEST_PASS("conn_adv_coded");
}

static void adv_fal_enable(void)
{
	bt_addr_le_t addr = adv_addr;
	int err;

	err = bt_id_create(&addr, NULL);
	TEST_ASSERT(err >= 0, "Identity create failed (err %d)", err);

	err = bt_enable(NULL);
	TEST_ASSERT(err == 0, "Bluetooth init failed (err %d)", err);

	err = bt_conn_cb_register(&conn_cb);
	TEST_ASSERT(err == 0, "Callback register failed (err %d)", err);

	err = bt_le_filter_accept_list_add(&init_addr);
	TEST_ASSERT(err == 0, "Filter Accept List add failed (err %d)", err);
}

static void adv_fal_start(void)
{
	/* Accept connection requests only from devices on the Filter Accept List */
	const struct bt_le_adv_param param = BT_LE_ADV_PARAM_INIT(
		BT_LE_ADV_OPT_EXT_ADV | BT_LE_ADV_OPT_CONN | BT_LE_ADV_OPT_FILTER_CONN,
		BT_GAP_ADV_FAST_INT_MIN_2, BT_GAP_ADV_FAST_INT_MAX_2, NULL);
	struct bt_le_ext_adv *adv;
	int err;

	err = bt_le_ext_adv_create(&param, NULL, &adv);
	TEST_ASSERT(err == 0, "Advertising set create failed (err %d)", err);

	err = bt_le_ext_adv_start(adv, BT_LE_EXT_ADV_START_DEFAULT);
	TEST_ASSERT(err == 0, "Advertising start failed (err %d)", err);
}

static void nconn_adv_start(void)
{
	struct bt_le_ext_adv *adv;
	int err;

	err = bt_le_ext_adv_create(BT_LE_EXT_ADV_NCONN, NULL, &adv);
	TEST_ASSERT(err == 0, "Advertising set create failed (err %d)", err);

	err = bt_le_ext_adv_start(adv, BT_LE_EXT_ADV_START_DEFAULT);
	TEST_ASSERT(err == 0, "Advertising start failed (err %d)", err);
}

static void scan_start(void)
{
	int err;

	/* A scan that does not use the Filter Accept List */
	err = bt_le_scan_start(BT_LE_SCAN_PASSIVE, NULL);
	TEST_ASSERT(err == 0, "Scan start failed (err %d)", err);
}

static void test_conn_adv_fal_scan(void)
{
	TEST_START("conn_adv_fal_scan");

	adv_fal_enable();
	adv_fal_start();
	scan_start();

	connection_check();

	TEST_PASS("conn_adv_fal_scan");
}

static void test_conn_adv_fal_adv(void)
{
	TEST_START("conn_adv_fal_adv");

	adv_fal_enable();
	adv_fal_start();

	/* A second advertising set, which does not use the Filter Accept List */
	nconn_adv_start();

	connection_check();

	TEST_PASS("conn_adv_fal_adv");
}

static void test_conn_adv1_fal_scan(void)
{
	struct bt_le_ext_adv *adv;
	int err;

	TEST_START("conn_adv1_fal_scan");

	adv_fal_enable();

	/* Take the first advertising set, so that the one using the list is not set 0 */
	err = bt_le_ext_adv_create(BT_LE_EXT_ADV_NCONN, NULL, &adv);
	TEST_ASSERT(err == 0, "Advertising set create failed (err %d)", err);

	adv_fal_start();
	scan_start();

	connection_check();

	TEST_PASS("conn_adv1_fal_scan");
}

static void test_conn_init_id_delayed(void)
{
	bt_addr_le_t addr = init_addr;
	struct bt_conn *conn = NULL;
	int err;

	TEST_START("conn_init_id_delayed");

	err = bt_id_create(&addr, NULL);
	TEST_ASSERT(err >= 0, "Identity create failed (err %d)", err);

	err = bt_enable(NULL);
	TEST_ASSERT(err == 0, "Bluetooth init failed (err %d)", err);

	err = bt_conn_cb_register(&conn_cb);
	TEST_ASSERT(err == 0, "Callback register failed (err %d)", err);

	/* Connect only after the advertiser has enabled its scan */
	(void)k_sleep(K_SECONDS(1));

	err = bt_testlib_connect(&adv_addr, &conn);
	TEST_ASSERT(err == 0, "Connection failed (err %d)", err);

	connection_check();

	bt_testlib_conn_unref(&conn);

	TEST_PASS("conn_init_id_delayed");
}

static atomic_t id_addr_reports;

static void scan_recv(const bt_addr_le_t *addr, int8_t rssi, uint8_t adv_type,
		      struct net_buf_simple *ad)
{
	if (bt_addr_le_eq(addr, &adv_addr)) {
		(void)atomic_inc(&id_addr_reports);
	}
}

static void rl_add_network_privacy(const bt_addr_le_t *peer)
{
	struct bt_hci_cp_le_add_dev_to_rl *cp;
	struct net_buf *buf;
	int err;

	/* A peer with an IRK, in the default Network Privacy mode, so that the controller must not
	 * report its identity address
	 */
	buf = bt_hci_cmd_alloc(K_FOREVER);
	TEST_ASSERT(buf != NULL, "HCI command alloc failed");

	cp = net_buf_add(buf, sizeof(*cp));
	bt_addr_le_copy(&cp->peer_id_addr, peer);
	(void)memset(cp->peer_irk, 0x11, sizeof(cp->peer_irk));
	(void)memset(cp->local_irk, 0, sizeof(cp->local_irk));

	err = bt_hci_cmd_send_sync(BT_HCI_OP_LE_ADD_DEV_TO_RL, buf, NULL);
	TEST_ASSERT(err == 0, "Resolving list add failed (err %d)", err);

	buf = bt_hci_cmd_alloc(K_FOREVER);
	TEST_ASSERT(buf != NULL, "HCI command alloc failed");

	net_buf_add_u8(buf, BT_HCI_ADDR_RES_ENABLE);

	err = bt_hci_cmd_send_sync(BT_HCI_OP_LE_SET_ADDR_RES_ENABLE, buf, NULL);
	TEST_ASSERT(err == 0, "Address resolution enable failed (err %d)", err);
}

static void test_scan_rl_adv(void)
{
	int err;

	TEST_START("scan_rl_adv");

	bt_up();
	rl_add_network_privacy(&adv_addr);

	/* Report every advertising PDU, so that no report is held back as a duplicate */
	err = bt_le_scan_start(BT_LE_SCAN_PARAM(BT_LE_SCAN_TYPE_PASSIVE, BT_LE_SCAN_OPT_NONE,
						BT_GAP_SCAN_FAST_INTERVAL, BT_GAP_SCAN_FAST_WINDOW),
			       scan_recv);
	TEST_ASSERT(err == 0, "Scan start failed (err %d)", err);

	(void)k_sleep(K_SECONDS(2));
	TEST_ASSERT(atomic_get(&id_addr_reports) == 0, "%ld reports of the identity address",
		    atomic_get(&id_addr_reports));

	/* An advertising set of our own, enabled while scanning */
	nconn_adv_start();

	(void)k_sleep(K_SECONDS(2));
	TEST_ASSERT(atomic_get(&id_addr_reports) == 0,
		    "%ld reports of the identity address after enabling advertising",
		    atomic_get(&id_addr_reports));

	TEST_PASS("scan_rl_adv");
}

static void test_nconn_adv_id(void)
{
	bt_addr_le_t addr = adv_addr;
	int err;

	TEST_START("nconn_adv_id");

	err = bt_id_create(&addr, NULL);
	TEST_ASSERT(err >= 0, "Identity create failed (err %d)", err);

	err = bt_enable(NULL);
	TEST_ASSERT(err == 0, "Bluetooth init failed (err %d)", err);

	/* Legacy advertising from the identity address, rather than from a non-resolvable private
	 * address, which the scanner checks against its resolving list on the primary channel
	 */
	err = bt_le_adv_start(BT_LE_ADV_NCONN_IDENTITY, NULL, 0, NULL, 0);
	TEST_ASSERT(err == 0, "Advertising start failed (err %d)", err);

	TEST_PASS("nconn_adv_id");
}

static const struct bst_test_instance test_def[] = {
	{
		.test_id = "conn_adv",
		.test_descr = "Connectable extended advertising",
		.test_main_f = test_conn_adv,
	},
	{
		.test_id = "conn_adv_delayed",
		.test_descr = "Connectable extended advertising started after one second",
		.test_main_f = test_conn_adv_delayed,
	},
	{
		.test_id = "conn_init",
		.test_descr = "Initiator",
		.test_main_f = test_conn_init,
	},
	{
		.test_id = "conn_init_fal",
		.test_descr = "Initiator with the Filter Accept List",
		.test_main_f = test_conn_init_fal,
	},
	{
		.test_id = "conn_init_fal_adv",
		.test_descr = "Initiator with the Filter Accept List that enables an advertising "
			      "set while connecting",
		.test_main_f = test_conn_init_fal_adv,
	},
	{
		.test_id = "conn_adv_fal_scan",
		.test_descr = "Connectable extended advertising with the Filter Accept List that "
			      "enables a scan",
		.test_main_f = test_conn_adv_fal_scan,
	},
	{
		.test_id = "conn_adv_fal_adv",
		.test_descr = "Connectable extended advertising with the Filter Accept List that "
			      "enables a second advertising set",
		.test_main_f = test_conn_adv_fal_adv,
	},
	{
		.test_id = "conn_adv1_fal_scan",
		.test_descr =
			"Connectable extended advertising with the Filter Accept List on a set "
			"other than the first, that enables a scan",
		.test_main_f = test_conn_adv1_fal_scan,
	},
	{
		.test_id = "conn_adv_coded_delayed",
		.test_descr =
			"Connectable extended advertising on LE Coded started after one second",
		.test_main_f = test_conn_adv_coded_delayed,
	},
	{
		.test_id = "conn_init_fal_adv_coded",
		.test_descr =
			"Initiator on LE Coded only with the Filter Accept List that enables an "
			"advertising set while connecting",
		.test_main_f = test_conn_init_fal_adv_coded,
	},
	{
		.test_id = "conn_init_id_delayed",
		.test_descr = "Initiator with a fixed identity that connects after one second",
		.test_main_f = test_conn_init_id_delayed,
	},
	{
		.test_id = "scan_rl_adv",
		.test_descr =
			"Scanner with a Network Privacy peer in the resolving list that enables "
			"advertising, and must not report the peer's identity address",
		.test_main_f = test_scan_rl_adv,
	},
	{
		.test_id = "nconn_adv_id",
		.test_descr = "Non-connectable legacy advertiser using its identity address",
		.test_main_f = test_nconn_adv_id,
	},
	BSTEST_END_MARKER,
};

struct bst_test_list *test_connect_install(struct bst_test_list *tests)
{
	return bst_add_tests(tests, test_def);
}
```

## src/scan_req_tgta.c
```c
/*
 * SPDX-FileCopyrightText: Copyright (c) 2026 Silicon Laboratories Inc.
 * SPDX-License-Identifier: Apache-2.0
 */

#include <stdint.h>

#include <zephyr/bluetooth/addr.h>
#include <zephyr/bluetooth/bluetooth.h>
#include <zephyr/bluetooth/gap.h>
#include <zephyr/kernel.h>
#include <zephyr/sys/util.h>

#include "bstests.h"
#include "babblekit/flags.h"
#include "babblekit/testcase.h"

/* The static random identity address of the scanner, C0:00:00:00:00:02 */
static const bt_addr_le_t scanner_addr = {
	.type = BT_ADDR_LE_RANDOM,
	.a = { { 0x02, 0x00, 0x00, 0x00, 0x00, 0xC0 } },
};

/* A resolvable private address that no device of the simulation resolves,
 * 40:00:00:00:00:03. The test script looks for it in the Tx dump of the
 * advertiser.
 */
static const bt_addr_le_t other_rpa = {
	.type = BT_ADDR_LE_RANDOM,
	.a = { { 0x03, 0x00, 0x00, 0x00, 0x00, 0x40 } },
};

DEFINE_FLAG_STATIC(flag_scanned);

static const struct bt_data sd[] = {
	BT_DATA(BT_DATA_NAME_COMPLETE, "TargetA", 7),
};

static void scanned(struct bt_le_ext_adv *adv, struct bt_le_ext_adv_scanned_info *info)
{
	if (bt_addr_le_eq(info->addr, &scanner_addr)) {
		SET_FLAG(flag_scanned);
	}
}

static void test_tgta_adv(void)
{
	static const struct bt_le_ext_adv_cb adv_cb = {
		.scanned = scanned,
	};
	struct bt_le_adv_param param = BT_LE_ADV_PARAM_INIT(
		BT_LE_ADV_OPT_EXT_ADV | BT_LE_ADV_OPT_SCANNABLE | BT_LE_ADV_OPT_NOTIFY_SCAN_REQ |
			BT_LE_ADV_OPT_DIR_MODE_LOW_DUTY,
		BT_GAP_ADV_FAST_INT_MIN_2, BT_GAP_ADV_FAST_INT_MAX_2, &scanner_addr);
	struct bt_le_ext_adv *adv;
	int err;

	TEST_START("tgta_adv");

	err = bt_enable(NULL);
	TEST_ASSERT(err == 0, "Bluetooth init failed (err %d)", err);

	err = bt_le_ext_adv_create(&param, &adv_cb, &adv);
	TEST_ASSERT(err == 0, "Advertising set create failed (err %d)", err);

	err = bt_le_ext_adv_set_data(adv, NULL, 0, sd, ARRAY_SIZE(sd));
	TEST_ASSERT(err == 0, "Scan response data set failed (err %d)", err);

	err = bt_le_ext_adv_start(adv, BT_LE_EXT_ADV_START_DEFAULT);
	TEST_ASSERT(err == 0, "Advertising start failed (err %d)", err);

	WAIT_FOR_FLAG(flag_scanned);
	TEST_PRINT("Scan request of the TargetA answered");

	err = bt_le_ext_adv_stop(adv);
	TEST_ASSERT(err == 0, "Advertising stop failed (err %d)", err);

	err = bt_le_ext_adv_delete(adv);
	TEST_ASSERT(err == 0, "Advertising set delete failed (err %d)", err);

	/* Notifications of scan requests that the stopped set answered can
	 * still be on their way from the Controller. Let them arrive before
	 * the flag is cleared, so that they do not count for the next set.
	 */
	(void)k_sleep(K_MSEC(500));
	UNSET_FLAG(flag_scanned);

	param.peer = &other_rpa;
	err = bt_le_ext_adv_create(&param, &adv_cb, &adv);
	TEST_ASSERT(err == 0, "Advertising set create failed (err %d)", err);

	err = bt_le_ext_adv_set_data(adv, NULL, 0, sd, ARRAY_SIZE(sd));
	TEST_ASSERT(err == 0, "Scan response data set failed (err %d)", err);

	err = bt_le_ext_adv_start(adv, BT_LE_EXT_ADV_START_DEFAULT);
	TEST_ASSERT(err == 0, "Advertising start failed (err %d)", err);

	/* The scanner sends scan requests to this set too, as its filter
	 * policy accepts directed advertising to an RPA that it can not
	 * resolve. Advertise long enough for tens of them, none of which may
	 * be answered.
	 */
	(void)k_sleep(K_SECONDS(5));
	TEST_ASSERT(!IS_FLAG_SET(flag_scanned),
		    "Scan request of another device than the TargetA answered");

	TEST_PASS("tgta_adv");
}

static void test_tgta_scan(void)
{
	struct bt_le_scan_param param = BT_LE_SCAN_PARAM_INIT(
		BT_LE_SCAN_TYPE_ACTIVE, BT_LE_SCAN_OPT_EXT_FILTER_POLICY,
		BT_GAP_SCAN_FAST_INTERVAL_MIN, BT_GAP_SCAN_FAST_WINDOW);
	bt_addr_le_t addr = scanner_addr;
	int err;

	TEST_START("tgta_scan");

	err = bt_id_create(&addr, NULL);
	TEST_ASSERT(err >= 0, "Identity create failed (err %d)", err);

	err = bt_enable(NULL);
	TEST_ASSERT(err == 0, "Bluetooth init failed (err %d)", err);

	err = bt_le_scan_start(&param, NULL);
	TEST_ASSERT(err == 0, "Scan start failed (err %d)", err);

	/* The advertiser checks which of the scan requests it answers */
	TEST_PASS("tgta_scan");
}

static const struct bst_test_instance test_def[] = {
	{
		.test_id = "tgta_adv",
		.test_descr = "Directed scannable advertising, to the scanner then to an RPA",
		.test_main_f = test_tgta_adv,
	},
	{
		.test_id = "tgta_scan",
		.test_descr = "Active scanner with the extended filter policy",
		.test_main_f = test_tgta_scan,
	},
	BSTEST_END_MARKER,
};

struct bst_test_list *test_scan_req_tgta_install(struct bst_test_list *tests)
{
	return bst_add_tests(tests, test_def);
}
```

## src/sync_pdu_type.c
```c
/*
 * SPDX-FileCopyrightText: Copyright (c) 2026 Nordic Semiconductor ASA
 * SPDX-License-Identifier: Apache-2.0
 */

#include <stdbool.h>
#include <stdint.h>

#include <zephyr/bluetooth/addr.h>
#include <zephyr/bluetooth/bluetooth.h>
#include <zephyr/bluetooth/gap.h>
#include <zephyr/bluetooth/hci_types.h>
#include <zephyr/kernel.h>
#include <zephyr/net_buf.h>
#include <zephyr/sys/atomic.h>
#include <zephyr/sys/byteorder.h>
#include <zephyr/sys/util.h>

#include "bstests.h"
#include "babblekit/testcase.h"

/* The static random address of the periodic advertising that the playback
 * device of sync_pdu_type.sh sends, C0:00:00:00:00:05, and its SID, as in
 * test_data/gen_sync_pdu_type.py
 */
static const bt_addr_le_t adv_addr = {
	.type = BT_ADDR_LE_RANDOM,
	.a = { { 0x05, 0x00, 0x00, 0x00, 0x00, 0xC0 } },
};

#define ADV_SID 1U

/* The kinds of AD data in the PDUs of the playback device: an AUX_SYNC_IND
 * without AuxPtr, an AUX_SYNC_IND with an AuxPtr, and a PDU of another type in
 * place of an AUX_SYNC_IND or AUX_CHAIN_IND
 */
#define AD_KIND_VALID   0x01U
#define AD_KIND_PARENT  0x02U
#define AD_KIND_INVALID 0x03U

/* The paEventCounter of the first periodic advertising event of each phase of
 * the playback, as in test_data/gen_sync_pdu_type.py:
 * - [0, EVT_VALID): PDUs of another type in place of the AUX_SYNC_INDs
 * - [EVT_VALID, EVT_CHAIN): AUX_SYNC_INDs
 * - [EVT_CHAIN, EVT_CHAIN_ALT): AUX_SYNC_INDs with an AuxPtr to a PDU of
 *   another type in place of the AUX_CHAIN_IND
 * - [EVT_CHAIN_ALT, EVT_LOST): as the phase before in the even events, as
 *   [EVT_VALID, EVT_CHAIN) in the odd ones
 * - [EVT_LOST, EVT_END): as [0, EVT_VALID)
 */
#define EVT_VALID     30U
#define EVT_CHAIN     60U
#define EVT_CHAIN_ALT 80U
#define EVT_LOST      100U
#define EVT_END       130U

/* The periodic advertising event with paEventCounter 0 starts 100 ms into the
 * simulation, and the events are 100 ms apart. From EVT_CHAIN to EVT_LOST,
 * each event starts 30 us later than that after the one before it, a drift
 * that only the drift compensation of every event keeps in the receive window,
 * and that adds up to less than 2 ms.
 */
#define EVT_START_MS(counter) (100U + ((counter) * 100U))

/* Synchronization timeout of 1 s, 10 periodic advertising events, in 10 ms
 * units
 */
#define SYNC_TIMEOUT    100U
#define SYNC_TIMEOUT_MS (SYNC_TIMEOUT * 10U)

static K_SEM_DEFINE(sem_sync, 0, 1);
static int64_t volatile synced_ms;
static int64_t volatile term_ms;
static uint8_t volatile term_reason;
static bool volatile is_synced;

static ATOMIC_DEFINE(reported, EVT_END);
static atomic_t reports_unexpected;

static void synced(struct bt_le_per_adv_sync *sync, struct bt_le_per_adv_sync_synced_info *info)
{
	synced_ms = k_uptime_get();
	is_synced = true;

	k_sem_give(&sem_sync);
}

static void term(struct bt_le_per_adv_sync *sync,
		 const struct bt_le_per_adv_sync_term_info *info)
{
	term_ms = k_uptime_get();
	term_reason = info->reason;

	k_sem_give(&sem_sync);
}

static void recv(struct bt_le_per_adv_sync *sync,
		 const struct bt_le_per_adv_sync_recv_info *info, struct net_buf_simple *buf)
{
	uint16_t counter;

	/* A single Manufacturer Specific Data structure with the kind of the
	 * PDU and its paEventCounter. Anything else is decoded from a PDU that
	 * is not part of the train, or is reassembled with data from one.
	 */
	if ((buf->len != 5U) || (buf->data[0] != 4U) ||
	    (buf->data[1] != BT_DATA_MANUFACTURER_DATA) || (buf->data[2] != AD_KIND_VALID)) {
		(void)atomic_inc(&reports_unexpected);

		return;
	}

	counter = sys_get_le16(&buf->data[3]);
	if (counter >= EVT_END) {
		(void)atomic_inc(&reports_unexpected);

		return;
	}

	atomic_set_bit(reported, counter);
}

static struct bt_le_per_adv_sync_cb sync_cb = {
	.synced = synced,
	.term = term,
	.recv = recv,
};

static void sync_create(void)
{
	struct bt_le_per_adv_sync_param param = {
		.options = BT_LE_PER_ADV_SYNC_OPT_NONE,
		.sid = ADV_SID,
		.skip = 0U,
		.timeout = SYNC_TIMEOUT,
	};
	struct bt_le_per_adv_sync *sync;
	int err;

	bt_addr_le_copy(&param.addr, &adv_addr);

	err = bt_le_per_adv_sync_create(&param, &sync);
	TEST_ASSERT(err == 0, "Periodic sync create failed (err %d)", err);
}

static void check_reported(uint16_t first, uint16_t last, uint16_t step)
{
	for (uint16_t counter = first; counter < last; counter += step) {
		TEST_ASSERT(atomic_test_bit(reported, counter),
			    "No report of periodic advertising event %u", counter);
	}
}

static void test_sync_pdu_type(void)
{
	struct bt_le_scan_param scan_param = BT_LE_SCAN_PARAM_INIT(
		BT_LE_SCAN_TYPE_PASSIVE, BT_LE_SCAN_OPT_NONE, BT_GAP_SCAN_FAST_INTERVAL_MIN,
		BT_GAP_SCAN_FAST_INTERVAL_MIN);
	uint32_t estab_failed = 0U;
	int err;

	TEST_START("sync_pdu_type");

	err = bt_enable(NULL);
	TEST_ASSERT(err == 0, "Bluetooth init failed (err %d)", err);

	bt_le_per_adv_sync_cb_register(&sync_cb);

	err = bt_le_scan_start(&scan_param, NULL);
	TEST_ASSERT(err == 0, "Scan start failed (err %d)", err);

	/* The PDUs of other types that the train has in place of the
	 * AUX_SYNC_INDs at first may not establish the synchronization. The
	 * Controller fails to establish it after six periodic advertising
	 * events, then the scanner tries again.
	 */
	sync_create();
	while (true) {
		(void)k_sem_take(&sem_sync, K_FOREVER);

		if (is_synced) {
			break;
		}

		TEST_ASSERT(term_reason == BT_HCI_ERR_CONN_FAIL_TO_ESTAB,
			    "Periodic sync establishment ended with reason 0x%02x", term_reason);
		estab_failed++;

		sync_create();
	}

	TEST_ASSERT(estab_failed > 0U, "No periodic sync establishment failed");
	TEST_ASSERT(synced_ms >= EVT_START_MS(EVT_VALID),
		    "Periodic sync established at %lld ms, before the first AUX_SYNC_IND",
		    synced_ms);

	err = bt_le_scan_stop();
	TEST_ASSERT(err == 0, "Scan stop failed (err %d)", err);

	/* The PDUs of other types in place of the AUX_CHAIN_INDs leave the
	 * parent AUX_SYNC_INDs to compensate the drift of the train, which
	 * keeps the synchronization up. Those in place of the AUX_SYNC_INDs at
	 * the end do not: the synchronization is lost with the timeout after
	 * the last AUX_SYNC_IND. The LE Periodic Advertising Sync Lost event
	 * has no reason, which the Host reports as unspecified.
	 */
	(void)k_sem_take(&sem_sync, K_FOREVER);
	TEST_ASSERT(term_reason == BT_HCI_ERR_UNSPECIFIED,
		    "Periodic sync terminated with reason 0x%02x", term_reason);
	TEST_ASSERT(term_ms > EVT_START_MS(EVT_LOST - 1U),
		    "Periodic sync lost at %lld ms, before the last AUX_SYNC_IND", term_ms);
	TEST_ASSERT(term_ms < EVT_START_MS(EVT_LOST + 1U) + SYNC_TIMEOUT_MS,
		    "Periodic sync lost at %lld ms, after the timeout", term_ms);

	/* Every AUX_SYNC_IND without AuxPtr is reported. One that follows an
	 * AUX_SYNC_IND whose AUX_CHAIN_IND was not received is reported only
	 * when the Controller has ended the report of that one as incomplete.
	 */
	check_reported(EVT_VALID, EVT_CHAIN, 1U);
	check_reported(EVT_CHAIN_ALT + 1U, EVT_LOST, 2U);

	/* No report has data of an AUX_SYNC_IND with an AuxPtr, or of a PDU of
	 * another type
	 */
	TEST_ASSERT(atomic_get(&reports_unexpected) == 0, "%ld unexpected reports",
		    (long)atomic_get(&reports_unexpected));

	TEST_PASS("sync_pdu_type");
}

static const struct bst_test_instance test_def[] = {
	{
		.test_id = "sync_pdu_type",
		.test_descr = "Periodic sync ignores PDUs of types other than AUX_SYNC_IND",
		.test_main_f = test_sync_pdu_type,
	},
	BSTEST_END_MARKER,
};

struct bst_test_list *test_sync_pdu_type_install(struct bst_test_list *tests)
{
	return bst_add_tests(tests, test_def);
}
```
