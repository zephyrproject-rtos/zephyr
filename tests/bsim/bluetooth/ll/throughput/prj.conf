## CMakeLists.txt
```
# SPDX-License-Identifier: Apache-2.0

cmake_minimum_required(VERSION 3.28.0)

find_package(Zephyr REQUIRED HINTS $ENV{ZEPHYR_BASE})
project(bsim_test_gatt_write)

target_sources(app PRIVATE
  src/main.c
  ${ZEPHYR_BASE}/samples/bluetooth/central_gatt_write/src/gatt_write_common.c
  ${ZEPHYR_BASE}/samples/bluetooth/central_gatt_write/src/central_gatt_write.c
  ${ZEPHYR_BASE}/samples/bluetooth/peripheral_gatt_write/src/peripheral_gatt_write.c
)

zephyr_include_directories(
  ${BSIM_COMPONENTS_PATH}/libUtilv1/src/
  ${BSIM_COMPONENTS_PATH}/libPhyComv1/src/
  ${ZEPHYR_BASE}/samples/bluetooth/central_gatt_write/src
)
```

## Kconfig
```
# Copyright (c) 2025 Nordic Semiconductor ASA
# SPDX-License-Identifier: Apache-2.0

source "$(ZEPHYR_BASE)/samples/bluetooth/central_gatt_write/Kconfig"
```

## prj.conf
```kconfig
CONFIG_BT=y
CONFIG_BT_CENTRAL=y
CONFIG_BT_PERIPHERAL=y
CONFIG_BT_SMP=y
CONFIG_BT_GATT_CLIENT=y

# Maximum L2CAP size for one LL PDU size
CONFIG_BT_L2CAP_TX_MTU=247

# Auto initiated PHY update on connection established
CONFIG_BT_AUTO_PHY_PERIPHERAL_2M=y
# Enable user initiated PHY update support
CONFIG_BT_USER_PHY_UPDATE=y

# Auto initiated Data Length update on connection established
CONFIG_BT_AUTO_DATA_LEN_UPDATE=y
# Enable user initiated Data Length update support
CONFIG_BT_USER_DATA_LEN_UPDATE=y

# Perform one iteration of PHY and Connection Updates
CONFIG_USE_CONN_UPDATE_ITERATION_ONCE=y
CONFIG_USE_PHY_UPDATE_ITERATION_ONCE=y

# BT HCI Command Buffers
# Greater than BT_BUF_ACL_TX_COUNT, to be able to Send Host Number of Completed Packets commands
CONFIG_BT_BUF_CMD_TX_COUNT=4
CONFIG_BT_BUF_CMD_TX_SIZE=255

# BT HCI Event Buffers
# Greater than BT_BUF_ACL_TX_COUNT, to be able to receive Number of Completed Packets events
CONFIG_BT_BUF_EVT_RX_COUNT=7
CONFIG_BT_BUF_EVT_RX_SIZE=255

# BT HCI Discardable Event Buffers
CONFIG_BT_BUF_EVT_DISCARDABLE_COUNT=3
CONFIG_BT_BUF_EVT_DISCARDABLE_SIZE=255

# BT HCI ACL TX Data Buffers
CONFIG_BT_BUF_ACL_TX_COUNT=6
CONFIG_BT_BUF_ACL_TX_SIZE=251

# BT HCI ACL RX Data Buffers
CONFIG_BT_BUF_ACL_RX_COUNT_EXTRA=1
CONFIG_BT_BUF_ACL_RX_SIZE=255

# Maximum LL ACL PDU length
CONFIG_BT_CTLR_DATA_LENGTH_MAX=251

# Enable Coded PHY Support
CONFIG_BT_CTLR_PHY_CODED=y

CONFIG_LOG=y

# Enable optimizations, this test is very long, enabling optimizations will speed it up
# considerably. If somebody wants to debug an issue locally, and this optimization level challenges
# it, they can always set NO_OPTIMIZATIONS
CONFIG_DEBUG_OPTIMIZATIONS=y
```

## extra-notify.conf
```kconfig
# Copyright The Zephyr Project Contributors
# SPDX-License-Identifier: Apache-2.0

# Exercise the GATT Notification throughput path instead of GATT Write without
# Response. USE_FULL_DUPLEX defaults to y, so both peers subscribe to and notify
# each other (full-duplex), matching the Write path's bidirectional coverage.
CONFIG_USE_NOTIFY=y
```

## overlay-no_phy_update.conf
```kconfig
# Disable user initiated PHY update support
CONFIG_BT_USER_PHY_UPDATE=n
```

## overlay-notify.conf
```kconfig
# Copyright (c) 2025 Nordic Semiconductor ASA
# SPDX-License-Identifier: Apache-2.0

# Exercise the one-directional GATT Notification throughput path instead of the
# full-duplex GATT Write without Response path.
CONFIG_USE_NOTIFY=y
```

## overlay-notify_simplex.conf
```kconfig
# Copyright The Zephyr Project Contributors
# SPDX-License-Identifier: Apache-2.0

# Exercise the one-directional (simplex) GATT Notification throughput path: only
# the peripheral notifies and the central subscribes and receives.
CONFIG_USE_NOTIFY=y
CONFIG_USE_FULL_DUPLEX=n
```

## src/main.c
```c
/*
 * Copyright (c) 2022 Nordic Semiconductor ASA
 *
 * SPDX-License-Identifier: Apache-2.0
 */

#include <stddef.h>

#include <zephyr/kernel.h>

#include <zephyr/sys/printk.h>
#include <zephyr/sys/util.h>

#include "bs_types.h"
#include "bs_tracing.h"
#include "time_machine.h"
#include "bstests.h"

/* There are 13 iterations of PHY update every 5 seconds, and based on actual
 * simulation COUNT iterations are sufficient to finish these iterations with
 * a stable 2M throughput value to be verified. If Central and Peripheral take
 * different duration to complete these iterations, the test will fail due to
 * the throughput calculated over one second duration will be low due to the
 * connection being disconnected before the other device could complete all the
 * iterations.
 * If the PHY and connection update iterations complete before the below number
 * of iterations, then a COUNT_THROUGHPUT number of write operations are
 * performed and throughput calculated. Note, `count` value in the central and
 * peripheral sample is referenced using a pointer and the pointer will be used
 * to setup the throughput measurement countdown.
 */
#if defined(CONFIG_USE_NOTIFY) && !defined(CONFIG_USE_FULL_DUPLEX)
/* Simplex GATT Notify is one-directional: only the peripheral transmits, and
 * every notification it sends is received by the central (1:1). The two counts
 * must therefore be equal. Unlike the full-duplex paths (where the peripheral
 * count is intentionally higher), a higher peripheral count here would make the
 * central reach its target first, exit, and disconnect the peripheral before it
 * finishes. The count spans the PHY and connection update sweep and ends a few
 * seconds after the link settles at 2M, so the rate is measured at steady state
 * without a long redundant tail.
 */
#define COUNT_CENTRAL    35000U
#define COUNT_PERIPHERAL 35000U
#elif defined(CONFIG_BT_USER_PHY_UPDATE)
/* Full-duplex Write or Notify: both peers transmit independently, so the higher
 * peripheral count lets the central reach its target and disconnect first.
 */
#define COUNT_CENTRAL    17000U
#define COUNT_PERIPHERAL 17600U
#else /* !CONFIG_BT_USER_PHY_UPDATE */
#define COUNT_CENTRAL    180000U
#define COUNT_PERIPHERAL 180000U
#endif /* !CONFIG_BT_USER_PHY_UPDATE */

/* Write Throughput calculation:
 *  Measure interval = 1 s
 *  Connection interval = 50 ms
 *  No. of connection intervals = 20
 *  Single Tx time, 2M PHY = 1064 us
 *  tIFS = 150 us
 *  Single Tx duration = 1214 us
 *  Full duplex Tx-Rx duration = 2428 us
 *  Implementation dependent event overhead = 340 us
 *  Max. incomplete PDU time = 1064 us
 *  Max. radio idle time per 1 second = (1064 + 340) * 20 = 28080 us
 *  Packets per 1 second = (1000000 - 28080) / 2428 = 400.297
 *  GATT Write data length = 244 bytes
 *  Throughput = 400 * 244 * 8 = 780800 bps
 */
#define WRITE_RATE 780800 /* GATT Write bps recorded in this test */

/* Notify Throughput calculation:
 *  Simplex (one-directional): only the peripheral transmits data PDUs; the
 *  central replies with empty PDUs. At 2M PHY with a 50 ms connection interval
 *  the measured notify throughput is ~1.37 Mbps (700 * 244 * 8 bps).
 *  Full-duplex: both peers notify simultaneously, so each direction matches the
 *  full-duplex Write rate (WRITE_RATE) since Notify and Write without Response
 *  have identical airtime.
 */
#define NOTIFY_RATE 1366400

extern uint32_t central_gatt_write(uint32_t count);
extern uint32_t peripheral_gatt_write(uint32_t count);

#define FAIL(...)					\
	do {						\
		bst_result = Failed;			\
		bs_trace_error_time_line(__VA_ARGS__);	\
	} while (0)

#define PASS(...)					\
	do {						\
		bst_result = Passed;			\
		bs_trace_info_time(1, __VA_ARGS__);	\
	} while (0)

extern enum bst_result_t bst_result;

static void test_central_main(void)
{
	uint32_t write_rate;

	write_rate = central_gatt_write(COUNT_CENTRAL);

	printk("%s: Write Rate = %u bps\n", __func__, write_rate);
#if defined(CONFIG_USE_NOTIFY) && !defined(CONFIG_USE_FULL_DUPLEX)
	if (write_rate == NOTIFY_RATE) {
		PASS("Central tests passed\n");
	} else {
		FAIL("Central tests failed\n");
	}
#else
	if (write_rate == WRITE_RATE) {
		PASS("Central tests passed\n");
	} else {
		FAIL("Central tests failed\n");
	}
#endif

	/* Give extra time for peripheral side to finish its iterations */
	k_sleep(K_SECONDS(1));

	bs_trace_silent_exit(0);
}

static void test_peripheral_main(void)
{
	uint32_t write_rate;

	write_rate = peripheral_gatt_write(COUNT_PERIPHERAL);

	printk("%s: Write Rate = %u bps\n", __func__, write_rate);
#if defined(CONFIG_USE_NOTIFY) && !defined(CONFIG_USE_FULL_DUPLEX)
	if (write_rate == NOTIFY_RATE) {
		PASS("Peripheral tests passed\n");
	} else {
		FAIL("Peripheral tests failed\n");
	}
#else
	if (write_rate == WRITE_RATE) {
		PASS("Peripheral tests passed\n");
	} else {
		FAIL("Peripheral tests failed\n");
	}
#endif
}

static void test_gatt_write_init(void)
{
	bst_ticker_set_next_tick_absolute(1500e6);
	bst_result = In_progress;
}

static void test_gatt_write_tick(bs_time_t HW_device_time)
{
	bst_result = Failed;
	bs_trace_error_line("Test GATT Write finished.\n");
}

static const struct bst_test_instance test_def[] = {
	{
		.test_id = "central",
		.test_descr = "Central GATT Write",
		.test_pre_init_f = test_gatt_write_init,
		.test_tick_f = test_gatt_write_tick,
		.test_main_f = test_central_main
	},
	{
		.test_id = "peripheral",
		.test_descr = "Peripheral GATT Write",
		.test_pre_init_f = test_gatt_write_init,
		.test_tick_f = test_gatt_write_tick,
		.test_main_f = test_peripheral_main
	},
	BSTEST_END_MARKER
};

struct bst_test_list *test_gatt_write_install(struct bst_test_list *tests)
{
	return bst_add_tests(tests, test_def);
}

bst_test_install_t test_installers[] = {
	test_gatt_write_install,
	NULL
};

int main(void)
{
	bst_main();
	return 0;
}
```
