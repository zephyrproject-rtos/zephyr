## CMakeLists.txt
```
# SPDX-License-Identifier: Apache-2.0

cmake_minimum_required(VERSION 3.28.0)

find_package(Zephyr REQUIRED HINTS $ENV{ZEPHYR_BASE})
project(bsim_test_ll_ext_adv)

add_subdirectory("${ZEPHYR_BASE}/tests/bsim/babblekit" babblekit)
target_link_libraries(app PRIVATE babblekit)

target_sources(app PRIVATE
  "src/main.c"
  "src/scan_req_tgta.c"
  "src/anonymous.c"
  "src/connect.c"
)

zephyr_include_directories(
  "${BSIM_COMPONENTS_PATH}/libUtilv1/src/"
  "${BSIM_COMPONENTS_PATH}/libPhyComv1/src/"
)
```

## prj.conf
```kconfig
CONFIG_BT=y
CONFIG_BT_DEVICE_NAME="LL ext adv"
CONFIG_BT_BROADCASTER=y
CONFIG_BT_OBSERVER=y
CONFIG_BT_CENTRAL=y
CONFIG_BT_PERIPHERAL=y
CONFIG_BT_EXT_ADV=y
CONFIG_BT_EXT_ADV_MAX_ADV_SET=2
CONFIG_BT_FILTER_ACCEPT_LIST=y
CONFIG_BT_SCAN_WITH_IDENTITY=y
CONFIG_BT_CTLR_SCAN_REQ_NOTIFY=y
CONFIG_ASSERT=y

# With a single buffer, setting the scan response data of a scannable
# extended advertising set waits for a free PDU buffer that never comes
CONFIG_BT_CTLR_ADV_DATA_BUF_MAX=2
```

## src/main.c
```c
/*
 * Copyright The Zephyr Project Contributors
 *
 * SPDX-License-Identifier: Apache-2.0
 */

#include "bstests.h"

struct bst_test_list *test_scan_req_tgta_install(struct bst_test_list *tests);
struct bst_test_list *test_anonymous_install(struct bst_test_list *tests);
struct bst_test_list *test_connect_install(struct bst_test_list *tests);

bst_test_install_t test_installers[] = {
	test_scan_req_tgta_install,
	test_anonymous_install,
	test_connect_install,
	NULL,
};

int main(void)
{
	bst_main();

	return 0;
}
```

## src/anonymous.c
```c
/*
 * Copyright The Zephyr Project Contributors
 *
 * SPDX-License-Identifier: Apache-2.0
 */

#include <stdbool.h>
#include <stdint.h>

#include <zephyr/bluetooth/addr.h>
#include <zephyr/bluetooth/bluetooth.h>
#include <zephyr/bluetooth/gap.h>
#include <zephyr/kernel.h>
#include <zephyr/net_buf.h>
#include <zephyr/sys/atomic.h>
#include <zephyr/sys/util.h>

#include "bstests.h"
#include "babblekit/testcase.h"

#define SCANNER_ADDR "R:C0:00:00:00:00:02"

/* A device that is not in the simulation */
#define OTHER_ADDR "R:C0:00:00:00:00:03"

/* The AD data of the anonymous advertising in AUX_ADV_INDs, which the
 * playback device of the test scripts sends, undirected and directed
 */
#define AD_UNDIRECTED 0x01U
#define AD_DIRECTED   0x02U

/* The kinds of anonymous advertising reported. The advertising sets of the
 * advertiser device have no ADI and no AD data, so the reports do not tell
 * them apart otherwise.
 */
#define REPORT_UNDIRECTED    BIT(0)
#define REPORT_DIRECTED      BIT(1)
#define REPORT_UNDIRECTED_AD BIT(2)
#define REPORT_DIRECTED_AD   BIT(3)

static atomic_t reports;

static void adv_start(const bt_addr_le_t *peer)
{
	struct bt_le_adv_param param = BT_LE_ADV_PARAM_INIT(
		BT_LE_ADV_OPT_EXT_ADV | BT_LE_ADV_OPT_ANONYMOUS, BT_GAP_ADV_FAST_INT_MIN_2,
		BT_GAP_ADV_FAST_INT_MAX_2, peer);
	struct bt_le_ext_adv *adv;
	int err;

	if (peer != NULL) {
		param.options |= BT_LE_ADV_OPT_DIR_MODE_LOW_DUTY;
	}

	err = bt_le_ext_adv_create(&param, NULL, &adv);
	TEST_ASSERT(err == 0, "Advertising set create failed (err %d)", err);

	err = bt_le_ext_adv_start(adv, BT_LE_EXT_ADV_START_DEFAULT);
	TEST_ASSERT(err == 0, "Advertising start failed (err %d)", err);
}

/* Undirected anonymous advertising, and directed to the given device. The
 * Controller sends no AuxPtr without AD data.
 */
static void anon_adv(const char *peer)
{
	bt_addr_le_t peer_addr;
	int err;

	err = bt_addr_le_from_str(peer, &peer_addr);
	TEST_ASSERT(err == 0, "Invalid address (err %d)", err);

	err = bt_enable(NULL);
	TEST_ASSERT(err == 0, "Bluetooth init failed (err %d)", err);

	adv_start(NULL);
	adv_start(&peer_addr);
}

static void test_anon_adv(void)
{
	TEST_START("anon_adv");

	anon_adv(SCANNER_ADDR);

	/* The scanner checks which of the sets it reports */
	TEST_PASS("anon_adv");
}

static void test_anon_adv_other(void)
{
	TEST_START("anon_adv_other");

	anon_adv(OTHER_ADDR);

	/* The scanner checks which of the sets it reports */
	TEST_PASS("anon_adv_other");
}

static bool ad_parse(struct bt_data *data, void *user_data)
{
	uint8_t *ad_value = user_data;

	if ((data->type == BT_DATA_MANUFACTURER_DATA) && (data->data_len == 1U)) {
		*ad_value = data->data[0];

		return false;
	}

	return true;
}

static void scan_recv(const struct bt_le_scan_recv_info *info, struct net_buf_simple *buf)
{
	bool is_directed = ((info->adv_props & BT_GAP_ADV_PROP_DIRECTED) != 0U);
	uint8_t ad_value = 0U;

	/* The Host reports anonymous advertising as from BT_ADDR_LE_ANY */
	if (!bt_addr_le_eq(info->addr, BT_ADDR_LE_ANY)) {
		return;
	}

	bt_data_parse(buf, ad_parse, &ad_value);

	if (ad_value == 0U) {
		atomic_or(&reports, is_directed ? REPORT_DIRECTED : REPORT_UNDIRECTED);
	} else if (ad_value == (is_directed ? AD_DIRECTED : AD_UNDIRECTED)) {
		atomic_or(&reports, is_directed ? REPORT_DIRECTED_AD : REPORT_UNDIRECTED_AD);
	}
}

static struct bt_le_scan_cb scan_cb = {
	.recv = scan_recv,
};

static atomic_val_t scan(void)
{
	struct bt_le_scan_param param = BT_LE_SCAN_PARAM_INIT(
		BT_LE_SCAN_TYPE_PASSIVE, BT_LE_SCAN_OPT_NONE, BT_GAP_SCAN_FAST_INTERVAL,
		BT_GAP_SCAN_FAST_INTERVAL);
	int err;

	atomic_clear(&reports);

	err = bt_le_scan_start(&param, NULL);
	TEST_ASSERT(err == 0, "Scan start failed (err %d)", err);

	k_sleep(K_SECONDS(3));

	err = bt_le_scan_stop();
	TEST_ASSERT(err == 0, "Scan stop failed (err %d)", err);

	return atomic_get(&reports);
}

static void scanner_init(void)
{
	bt_addr_le_t addr;
	int err;

	err = bt_addr_le_from_str(SCANNER_ADDR, &addr);
	TEST_ASSERT(err == 0, "Invalid address (err %d)", err);

	err = bt_id_create(&addr, NULL);
	TEST_ASSERT(err >= 0, "Identity create failed (err %d)", err);

	err = bt_enable(NULL);
	TEST_ASSERT(err == 0, "Bluetooth init failed (err %d)", err);

	bt_le_scan_cb_register(&scan_cb);
}

static void test_anon_scan(void)
{
	atomic_val_t reported;

	TEST_START("anon_scan");

	scanner_init();

	reported = scan();
	TEST_ASSERT(reported == (REPORT_UNDIRECTED | REPORT_DIRECTED | REPORT_UNDIRECTED_AD |
				 REPORT_DIRECTED_AD),
		    "Anonymous advertising reported as 0x%lx", (unsigned long)reported);

	TEST_PASS("anon_scan");
}

static void test_anon_scan_other(void)
{
	atomic_val_t reported;

	TEST_START("anon_scan_other");

	scanner_init();

	reported = scan();
	TEST_ASSERT(reported == (REPORT_UNDIRECTED | REPORT_UNDIRECTED_AD),
		    "Anonymous advertising reported as 0x%lx", (unsigned long)reported);

	TEST_PASS("anon_scan_other");
}

static const struct bst_test_instance test_def[] = {
	{
		.test_id = "anon_adv",
		.test_descr = "Anonymous advertising, undirected and directed to the scanner",
		.test_main_f = test_anon_adv,
	},
	{
		.test_id = "anon_adv_other",
		.test_descr = "Anonymous advertising, undirected and directed to another device",
		.test_main_f = test_anon_adv_other,
	},
	{
		.test_id = "anon_scan",
		.test_descr = "Passive scanner of anonymous advertising to the scanner",
		.test_main_f = test_anon_scan,
	},
	{
		.test_id = "anon_scan_other",
		.test_descr = "Passive scanner of anonymous advertising to another device",
		.test_main_f = test_anon_scan_other,
	},
	BSTEST_END_MARKER,
};

struct bst_test_list *test_anonymous_install(struct bst_test_list *tests)
{
	return bst_add_tests(tests, test_def);
}
```

## src/connect.c
```c
/*
 * Copyright The Zephyr Project Contributors
 *
 * SPDX-License-Identifier: Apache-2.0
 */

#include <stdint.h>

#include <zephyr/bluetooth/addr.h>
#include <zephyr/bluetooth/bluetooth.h>
#include <zephyr/bluetooth/conn.h>
#include <zephyr/bluetooth/gap.h>
#include <zephyr/bluetooth/hci_types.h>
#include <zephyr/kernel.h>

#include "bstests.h"
#include "babblekit/flags.h"
#include "babblekit/testcase.h"

#define ADV_ADDR "R:C0:00:00:00:00:01"

DEFINE_FLAG_STATIC(flag_connected);
DEFINE_FLAG_STATIC(flag_disconnected);

static void connected(struct bt_conn *conn, uint8_t err)
{
	if (err == BT_HCI_ERR_SUCCESS) {
		SET_FLAG(flag_connected);
	}
}

static void disconnected(struct bt_conn *conn, uint8_t reason)
{
	SET_FLAG(flag_disconnected);
}

BT_CONN_CB_DEFINE(conn_cb) = {
	.connected = connected,
	.disconnected = disconnected,
};

static void connection_check(void)
{
	for (int i = 0; (i < 50) && !IS_FLAG_SET(flag_connected); i++) {
		k_sleep(K_MSEC(100));
	}

	TEST_ASSERT(IS_FLAG_SET(flag_connected), "Not connected");

	/* A peripheral that the central did not see connect loses the
	 * connection when the first connection events do not come.
	 */
	k_sleep(K_SECONDS(2));
	TEST_ASSERT(!IS_FLAG_SET(flag_disconnected), "Connection lost");
}

static void test_conn_adv(void)
{
	struct bt_le_ext_adv *adv;
	bt_addr_le_t addr;
	int err;

	TEST_START("conn_adv");

	err = bt_addr_le_from_str(ADV_ADDR, &addr);
	TEST_ASSERT(err == 0, "Invalid address (err %d)", err);

	err = bt_id_create(&addr, NULL);
	TEST_ASSERT(err >= 0, "Identity create failed (err %d)", err);

	err = bt_enable(NULL);
	TEST_ASSERT(err == 0, "Bluetooth init failed (err %d)", err);

	err = bt_le_ext_adv_create(BT_LE_EXT_ADV_CONN, NULL, &adv);
	TEST_ASSERT(err == 0, "Advertising set create failed (err %d)", err);

	err = bt_le_ext_adv_start(adv, BT_LE_EXT_ADV_START_DEFAULT);
	TEST_ASSERT(err == 0, "Advertising start failed (err %d)", err);

	connection_check();

	TEST_PASS("conn_adv");
}

static void test_conn_init(void)
{
	struct bt_conn *conn;
	bt_addr_le_t addr;
	int err;

	TEST_START("conn_init");

	err = bt_addr_le_from_str(ADV_ADDR, &addr);
	TEST_ASSERT(err == 0, "Invalid address (err %d)", err);

	err = bt_enable(NULL);
	TEST_ASSERT(err == 0, "Bluetooth init failed (err %d)", err);

	err = bt_conn_le_create(&addr, BT_CONN_LE_CREATE_CONN, BT_LE_CONN_PARAM_DEFAULT, &conn);
	TEST_ASSERT(err == 0, "Connection create failed (err %d)", err);

	bt_conn_unref(conn);

	connection_check();

	TEST_PASS("conn_init");
}

static void test_conn_init_fal(void)
{
	bt_addr_le_t addr;
	int err;

	TEST_START("conn_init_fal");

	err = bt_addr_le_from_str(ADV_ADDR, &addr);
	TEST_ASSERT(err == 0, "Invalid address (err %d)", err);

	err = bt_enable(NULL);
	TEST_ASSERT(err == 0, "Bluetooth init failed (err %d)", err);

	err = bt_le_filter_accept_list_add(&addr);
	TEST_ASSERT(err == 0, "Filter Accept List add failed (err %d)", err);

	err = bt_conn_le_create_auto(BT_CONN_LE_CREATE_CONN, BT_LE_CONN_PARAM_DEFAULT);
	TEST_ASSERT(err == 0, "Connection create failed (err %d)", err);

	connection_check();

	TEST_PASS("conn_init_fal");
}

static const struct bst_test_instance test_def[] = {
	{
		.test_id = "conn_adv",
		.test_descr = "Connectable extended advertising",
		.test_main_f = test_conn_adv,
	},
	{
		.test_id = "conn_init",
		.test_descr = "Initiator",
		.test_main_f = test_conn_init,
	},
	{
		.test_id = "conn_init_fal",
		.test_descr = "Initiator with the Filter Accept List",
		.test_main_f = test_conn_init_fal,
	},
	BSTEST_END_MARKER,
};

struct bst_test_list *test_connect_install(struct bst_test_list *tests)
{
	return bst_add_tests(tests, test_def);
}
```

## src/scan_req_tgta.c
```c
/*
 * Copyright The Zephyr Project Contributors
 *
 * SPDX-License-Identifier: Apache-2.0
 */

#include <stdint.h>

#include <zephyr/bluetooth/addr.h>
#include <zephyr/bluetooth/bluetooth.h>
#include <zephyr/bluetooth/gap.h>
#include <zephyr/bluetooth/hci.h>
#include <zephyr/kernel.h>
#include <zephyr/net_buf.h>
#include <zephyr/sys/byteorder.h>
#include <zephyr/sys/util.h>

#include "bstests.h"
#include "babblekit/flags.h"
#include "babblekit/testcase.h"

#define SCANNER_ADDR "R:C0:00:00:00:00:02"

/* A resolvable private address that no device of the simulation resolves */
#define OTHER_RPA "R:40:00:00:00:00:03"

DEFINE_FLAG_STATIC(flag_scanned);

static bt_addr_le_t scanner_addr;

static const struct bt_data sd[] = {
	BT_DATA(BT_DATA_NAME_COMPLETE, "TargetA", 7),
};

static void scanned(struct bt_le_ext_adv *adv, struct bt_le_ext_adv_scanned_info *info)
{
	if (bt_addr_le_eq(info->addr, &scanner_addr)) {
		SET_FLAG(flag_scanned);
	}
}

static const struct bt_le_ext_adv_cb adv_cb = {
	.scanned = scanned,
};

static void test_tgta_adv(void)
{
	struct bt_le_adv_param param = BT_LE_ADV_PARAM_INIT(
		BT_LE_ADV_OPT_EXT_ADV | BT_LE_ADV_OPT_SCANNABLE | BT_LE_ADV_OPT_NOTIFY_SCAN_REQ |
			BT_LE_ADV_OPT_DIR_MODE_LOW_DUTY,
		BT_GAP_ADV_FAST_INT_MIN_2, BT_GAP_ADV_FAST_INT_MAX_2, &scanner_addr);
	struct bt_le_ext_adv *adv;
	bt_addr_le_t other_addr;
	int err;

	TEST_START("tgta_adv");

	err = bt_addr_le_from_str(SCANNER_ADDR, &scanner_addr);
	TEST_ASSERT(err == 0, "Invalid address (err %d)", err);

	err = bt_addr_le_from_str(OTHER_RPA, &other_addr);
	TEST_ASSERT(err == 0, "Invalid address (err %d)", err);

	err = bt_enable(NULL);
	TEST_ASSERT(err == 0, "Bluetooth init failed (err %d)", err);

	err = bt_le_ext_adv_create(&param, &adv_cb, &adv);
	TEST_ASSERT(err == 0, "Advertising set create failed (err %d)", err);

	err = bt_le_ext_adv_set_data(adv, NULL, 0, sd, ARRAY_SIZE(sd));
	TEST_ASSERT(err == 0, "Scan response data set failed (err %d)", err);

	err = bt_le_ext_adv_start(adv, BT_LE_EXT_ADV_START_DEFAULT);
	TEST_ASSERT(err == 0, "Advertising start failed (err %d)", err);

	WAIT_FOR_FLAG(flag_scanned);
	TEST_PRINT("Scan request of the TargetA answered");

	err = bt_le_ext_adv_stop(adv);
	TEST_ASSERT(err == 0, "Advertising stop failed (err %d)", err);

	err = bt_le_ext_adv_delete(adv);
	TEST_ASSERT(err == 0, "Advertising set delete failed (err %d)", err);

	/* The notifications of the requests answered before the stop come
	 * first.
	 */
	k_sleep(K_MSEC(500));
	UNSET_FLAG(flag_scanned);

	param.peer = &other_addr;
	err = bt_le_ext_adv_create(&param, &adv_cb, &adv);
	TEST_ASSERT(err == 0, "Advertising set create failed (err %d)", err);

	err = bt_le_ext_adv_set_data(adv, NULL, 0, sd, ARRAY_SIZE(sd));
	TEST_ASSERT(err == 0, "Scan response data set failed (err %d)", err);

	err = bt_le_ext_adv_start(adv, BT_LE_EXT_ADV_START_DEFAULT);
	TEST_ASSERT(err == 0, "Advertising start failed (err %d)", err);

	/* The scanner keeps sending scan requests, as its filter policy accepts
	 * directed advertising to an RPA that it can not resolve.
	 */
	k_sleep(K_SECONDS(5));
	TEST_ASSERT(!IS_FLAG_SET(flag_scanned),
		    "Scan request of another device than the TargetA answered");

	TEST_PASS("tgta_adv");
}

static void test_tgta_scan(void)
{
	struct bt_hci_cp_le_set_ext_scan_enable *cp_enable;
	struct bt_hci_cp_le_set_random_address *cp_addr;
	struct bt_hci_cp_le_set_ext_scan_param *cp;
	struct bt_hci_ext_scan_phy *phy;
	struct net_buf *buf;
	bt_addr_le_t addr;
	int err;

	TEST_START("tgta_scan");

	err = bt_addr_le_from_str(SCANNER_ADDR, &addr);
	TEST_ASSERT(err == 0, "Invalid address (err %d)", err);

	err = bt_id_create(&addr, NULL);
	TEST_ASSERT(err >= 0, "Identity create failed (err %d)", err);

	err = bt_enable(NULL);
	TEST_ASSERT(err == 0, "Bluetooth init failed (err %d)", err);

	/* The Host has no API for the extended scanner filter policies, so the
	 * scanner is set up with HCI commands, the identity address being the
	 * random address of the scan requests.
	 */
	buf = bt_hci_cmd_alloc(K_FOREVER);
	TEST_ASSERT(buf != NULL, "No command buffer");

	cp_addr = net_buf_add(buf, sizeof(*cp_addr));
	bt_addr_copy(&cp_addr->bdaddr, &addr.a);

	err = bt_hci_cmd_send_sync(BT_HCI_OP_LE_SET_RANDOM_ADDRESS, buf, NULL);
	TEST_ASSERT(err == 0, "Random address set failed (err %d)", err);

	buf = bt_hci_cmd_alloc(K_FOREVER);
	TEST_ASSERT(buf != NULL, "No command buffer");

	cp = net_buf_add(buf, sizeof(*cp));
	cp->own_addr_type = BT_HCI_OWN_ADDR_RANDOM;
	cp->filter_policy = BT_HCI_LE_SCAN_FP_EXT_NO_FILTER;
	cp->phys = BT_HCI_LE_EXT_SCAN_PHY_1M;

	phy = net_buf_add(buf, sizeof(*phy));
	phy->type = BT_HCI_LE_SCAN_ACTIVE;
	phy->interval = sys_cpu_to_le16(BT_GAP_SCAN_FAST_INTERVAL_MIN);
	phy->window = sys_cpu_to_le16(BT_GAP_SCAN_FAST_WINDOW);

	err = bt_hci_cmd_send_sync(BT_HCI_OP_LE_SET_EXT_SCAN_PARAM, buf, NULL);
	TEST_ASSERT(err == 0, "Scan parameters set failed (err %d)", err);

	buf = bt_hci_cmd_alloc(K_FOREVER);
	TEST_ASSERT(buf != NULL, "No command buffer");

	cp_enable = net_buf_add(buf, sizeof(*cp_enable));
	cp_enable->enable = BT_HCI_LE_SCAN_ENABLE;
	cp_enable->filter_dup = BT_HCI_LE_SCAN_FILTER_DUP_DISABLE;
	cp_enable->duration = 0U;
	cp_enable->period = 0U;

	err = bt_hci_cmd_send_sync(BT_HCI_OP_LE_SET_EXT_SCAN_ENABLE, buf, NULL);
	TEST_ASSERT(err == 0, "Scan enable failed (err %d)", err);

	/* The advertiser checks which of the scan requests it answers */
	TEST_PASS("tgta_scan");
}

static const struct bst_test_instance test_def[] = {
	{
		.test_id = "tgta_adv",
		.test_descr = "Directed scannable advertising, to the scanner then to an RPA",
		.test_main_f = test_tgta_adv,
	},
	{
		.test_id = "tgta_scan",
		.test_descr = "Active scanner with the extended filter policy",
		.test_main_f = test_tgta_scan,
	},
	BSTEST_END_MARKER,
};

struct bst_test_list *test_scan_req_tgta_install(struct bst_test_list *tests)
{
	return bst_add_tests(tests, test_def);
}
```
