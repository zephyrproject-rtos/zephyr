## CMakeLists.txt
```
# Copyright (c) 2022 Google LLC
# SPDX-License-Identifier: Apache-2.0

cmake_minimum_required(VERSION 3.28.0)
include(ExternalProject)

if(BOARD STREQUAL "unit_testing" OR BOARD STREQUAL "unit_testing/unit_testing")
  find_package(Zephyr COMPONENTS unittest REQUIRED HINTS $ENV{ZEPHYR_BASE})
  set(target testbinary)
  # Set the target binary for the 'core' external project. The path to this must match the one set
  # below in ExternalProject_Add's CMAKE_INSTALL_PREFIX
  add_compile_definitions(FAIL_TARGET_BINARY="${CMAKE_BINARY_DIR}/core/bin/testbinary")
else()
  find_package(Zephyr REQUIRED HINTS $ENV{ZEPHYR_BASE})
  set(target app)
  # Set the target binary for the 'core' external project. The path to this must match the one set
  # below in ExternalProject_Add's CMAKE_INSTALL_PREFIX
  add_compile_definitions(FAIL_TARGET_BINARY="${CMAKE_BINARY_DIR}/core/bin/zephyr.exe")
endif()

# Create the project and set the sources for the target
project(fail)
target_sources(${target} PRIVATE src/main.cpp)

# Find which CONFIG_ZTEST_FAIL_TEST_* choice was set so we can pass it to the external project
# Once we find the config, we'll need to prepend a '-D' and append '=y' so we can pass it to the
# 'core' project as a cmake argument.
get_cmake_property(_vars VARIABLES)
string(REGEX MATCHALL "(^|;)CONFIG_ZTEST_FAIL_TEST_[A-Za-z0-9_]+" fail_test_config "${_vars}")
list(FILTER fail_test_config EXCLUDE REGEX "^$")
list(TRANSFORM fail_test_config PREPEND "-D")
list(TRANSFORM fail_test_config APPEND "=y")
if(CONFIG_ZTEST_FAIL_ON_ASSUME)
  list(APPEND fail_test_config "-DCONFIG_ZTEST_FAIL_ON_ASSUME=y")
endif()

# Add the 'core' external project which will mirror the configs of this project.
ExternalProject_Add(core
    SOURCE_DIR ${CMAKE_CURRENT_LIST_DIR}/core
    CMAKE_ARGS
      -DBOARD:STRING=${BOARD}/${BOARD_QUALIFIERS}
      -DCMAKE_INSTALL_PREFIX:PATH=${CMAKE_BINARY_DIR}/core
      ${fail_test_config}
)
add_dependencies(${target} core)
```

## Kconfig
```
# Copyright (c) 2022 Google LLC
# SPDX-License-Identifier: Apache-2.0

choice ZTEST_FAIL_TEST
	prompt "Select the type of failure to test"

config ZTEST_FAIL_TEST_ASSERT_AFTER
	bool "Add a failed assert in the after phase"

config ZTEST_FAIL_TEST_ASSERT_TEARDOWN
	bool "Add a failed assert in the teardown phase"

config ZTEST_FAIL_TEST_ASSUME_AFTER
	bool "Add a failed assume in the after phase"

config ZTEST_FAIL_TEST_ASSUME_TEARDOWN
	bool "Add a failed assume in the teardown phase"

config ZTEST_FAIL_TEST_PASS_AFTER
	bool "Add a call to ztest_test_pass() in the after phase"

config ZTEST_FAIL_TEST_PASS_TEARDOWN
	bool "Add a call to ztest_test_pass() in the teardown phase"

config ZTEST_FAIL_TEST_UNEXPECTED_ASSUME
	bool "Add a test which fails a zassume() call"

endchoice

config TEST_ERROR_STRING
	string
	default "ERROR: cannot fail in test phase 'after()', bailing" if ZTEST_FAIL_TEST_ASSERT_AFTER
	default "ERROR: cannot fail in test phase 'teardown()', bailing" if ZTEST_FAIL_TEST_ASSERT_TEARDOWN
	default "ERROR: cannot skip in test phase 'after()', bailing" if ZTEST_FAIL_TEST_ASSUME_AFTER && !ZTEST_FAIL_ON_ASSUME
	default "ERROR: cannot skip in test phase 'teardown()', bailing" if ZTEST_FAIL_TEST_ASSUME_TEARDOWN && !ZTEST_FAIL_ON_ASSUME
	default "ERROR: cannot fail in test phase 'after()', bailing" if ZTEST_FAIL_TEST_ASSUME_AFTER && ZTEST_FAIL_ON_ASSUME
	default "ERROR: cannot fail in test phase 'teardown()', bailing" if ZTEST_FAIL_TEST_ASSUME_TEARDOWN && ZTEST_FAIL_ON_ASSUME
	default "ERROR: cannot pass in test phase 'after()', bailing" if ZTEST_FAIL_TEST_PASS_AFTER
	default "ERROR: cannot pass in test phase 'teardown()', bailing" if ZTEST_FAIL_TEST_PASS_TEARDOWN
	default "Assumption failed at " if ZTEST_FAIL_TEST_UNEXPECTED_ASSUME

source "Kconfig.zephyr"
```

## prj.conf
```kconfig
# Copyright (c) 2022 Google LLC
# SPDX-License-Identifier: Apache-2.0

CONFIG_ZTEST=y

CONFIG_CPP=y
CONFIG_EXTERNAL_LIBCPP=y
```

## src/main.cpp
```c
/* Copyright (c) 2022 Google LLC
 * SPDX-License-Identifier: Apache-2.0
 */

#include <array>
#include <iostream>
#include <regex>
#include <string>
#include <zephyr/ztest.h>

ZTEST_SUITE(fail, nullptr, nullptr, nullptr, nullptr, nullptr);

ZTEST(fail, test_framework)
{
	auto found_error_string = false;
	char buffer[sizeof(CONFIG_TEST_ERROR_STRING)] = {0};
	std::string result;

	/* Start running the target binary. This binary is expected to fail. */
	auto pipe = popen(FAIL_TARGET_BINARY, "r");

	zassert_not_null(pipe, "Failed to execute '" FAIL_TARGET_BINARY "'");

	/* Wait for the binary to finish running and grab the output */
	while (!feof(pipe)) {
		if (fgets(buffer, ARRAY_SIZE(buffer), pipe) != nullptr) {
			if (found_error_string) {
				/* Already found the error string, no need to do any more string
				 * manipulation.
				 */
				continue;
			}

			/* Append the buffer to the result string */
			result += buffer;

			/* Check if result contains the right error string */
			found_error_string |=
				(result.find(CONFIG_TEST_ERROR_STRING) != std::string::npos);

			/* If the result string is longer than the expected string,
			 * we can prune it
			 */
			auto prune_length = static_cast<int>(result.length()) -
					    static_cast<int>(sizeof(CONFIG_TEST_ERROR_STRING));
			if (prune_length > 0) {
				result.erase(0, prune_length);
			}
		}
	}
	auto rc = WEXITSTATUS(pclose(pipe));

	zassert_equal(1, rc, "Test binary expected to fail with return code 1, but got %d", rc);
	zassert_true(found_error_string, "Test binary did not produce the expected error string \""
		     CONFIG_TEST_ERROR_STRING "\"");
}
```
