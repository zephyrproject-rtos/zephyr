## tests/ztest/assert/testcase.yaml
```yaml
tests:
  testing.ztest.assert:
    platform_allow: native_posix

common:
  harness: console
  harness_config:
    type: multi_line
    ordered: false
    regex:
      # Assertions
      - "Assertion failed at [\\S]+:[\\d]+: [\\S]+_between_inclusive: [\\w]+ not between [\\d]+ and [\\d]+ inclusive"
      - "Assertion failed at [\\S]+:[\\d]+: [\\S]+_equal: [\\w]+ not equal to [\\w]+"
      - "Assertion failed at [\\S]+:[\\d]+: [\\S]+_equal_ptr+: [\\w]+ equal to [\\w]+"
      - "Assertion failed at [\\S]+:[\\d]+: [\\S]+_false: [\\w]+ is true"
      - "Assertion failed at [\\S]+:[\\d]+: [\\S]+_is_null: [\\w]+ is not NULL"
      - "Assertion failed at [\\S]+:[\\d]+: [\\S]+_mem_equal: [\\w]+ not equal to [\\w]+"
      - "Assertion failed at [\\S]+:[\\d]+: [\\S]+_not_equal: [\\w]+ equal to [\\w]+"
      - "Assertion failed at [\\S]+:[\\d]+: [\\S]+_not_null: [\\w]+ is NULL"
      - "Assertion failed at [\\S]+:[\\d]+: [\\S]+_ok: [\\w]+ is non-zero"
      - "Assertion failed at [\\S]+:[\\d]+: [\\S]+_true: [\\w]+ is false"
      - "Assertion failed at [\\S]+:[\\d]+: [\\S]+_unreachable: Reached unreachable code"
      - "Assertion failed at [\\S]+:[\\d]+: [\\S]+_within: [\\w]+ not within [\\d]+ \\+/- [\\d]+"
      # Assumptions
      - "Assumption failed at [\\S]+:[\\d]+: [\\S]+_between_inclusive: [\\w]+ not between [\\d]+ and [\\d]+ inclusive"
      - "Assumption failed at [\\S]+:[\\d]+: [\\S]+_equal: [\\w]+ not equal to [\\w]+"
      - "Assumption failed at [\\S]+:[\\d]+: [\\S]+_equal_ptr+: [\\w]+ equal to [\\w]+"
      - "Assumption failed at [\\S]+:[\\d]+: [\\S]+_false: [\\w]+ is true"
      - "Assumption failed at [\\S]+:[\\d]+: [\\S]+_is_null: [\\w]+ is not NULL"
      - "Assumption failed at [\\S]+:[\\d]+: [\\S]+_mem_equal: [\\w]+ not equal to [\\w]+"
      - "Assumption failed at [\\S]+:[\\d]+: [\\S]+_not_equal: [\\w]+ equal to [\\w]+"
      - "Assumption failed at [\\S]+:[\\d]+: [\\S]+_not_null: [\\w]+ is NULL"
      - "Assumption failed at [\\S]+:[\\d]+: [\\S]+_ok: [\\w]+ is non-zero"
      - "Assumption failed at [\\S]+:[\\d]+: [\\S]+_true: [\\w]+ is false"
      - "Assumption failed at [\\S]+:[\\d]+: [\\S]+_within: [\\w]+ not within [\\d]+ \\+/- [\\d]+"
      # Suite result
      - "SUITE PASS"
```

## tests/ztest/automain/testcase.yaml
```yaml
tests:
  testing.ztest.automain:
    tags:
      - test_framework
      - pearl_gecko
    integration_platforms:
      - native_posix
```

## tests/ztest/base/Kconfig
```kconfig
# Copyright 2022 Google LLC
#
# SPDX-License-Identifier: Apache-2.0

config BUGxxxxx
	bool
	default y

source "Kconfig.zephyr"
```

## tests/ztest/base/testcase.yaml
```yaml
common:
  tags:
    - test_framework
tests:
  testing.ztest.base:
    type: unit
  testing.ztest.base.cpp:
    extra_args: CONF_FILE=prj_cpp.conf
    platform_allow:
      - native_posix
      - native_sim
      - native_sim/native/64
    integration_platforms:
      - native_sim
  testing.ztest.base.verbose_0:
    extra_args: CONF_FILE=prj_verbose_0.conf
    integration_platforms:
      - native_sim
  testing.ztest.base.verbose_0_userspace:
    filter: CONFIG_USERSPACE
    extra_args: CONF_FILE=prj_verbose_0.conf
    tags:
      - userspace
    extra_configs:
      - CONFIG_TEST_USERSPACE=y
    integration_platforms:
      - qemu_x86
  testing.ztest.base.verbose_1:
    extra_args: CONF_FILE=prj_verbose_1.conf
    integration_platforms:
      - native_sim
  testing.ztest.base.verbose_2:
    extra_args: CONF_FILE=prj_verbose_2.conf
    integration_platforms:
      - native_sim
```

## tests/ztest/busy_sim/testcase.yaml
```yaml
common:
  tags: test_framework
  depends_on: counter
tests:
  testing.ztest.busy_sim:
    platform_allow: nrf52840dk_nrf52840
  testing.ztest.busy_sim_nrf52840dk_pin:
    platform_allow: nrf52840dk_nrf52840
    extra_args: DTC_OVERLAY_FILE=boards/nrf52840dk_nrf52840_pin.overlay
```

## tests/ztest/custom_output/testcase.yaml
```yaml
tests:
  testing.ztest.regular_output:
    tags: test_framework
    integration_platforms:
      - native_posix
  testing.ztest.customized_output:
    extra_args: CONF_FILE=prj_customized_output.conf
    tags: test_framework
    integration_platforms:
      - native_posix
    harness: console
    harness_config:
      ordered: true
      regex:
        - "1: Test [test_assert_pass] reported (PASS) no. 1"
        - "2: Test [test_assert_pass] reported (PASS) no. 2"
        - "3: Test [test_assert_pass] reported (PASS) no. 3"
        - "4: Test [test_assert_skip] reported {SKIPPED} no. 1"
        - "5: Test [test_assert_skip] reported {SKIPPED} no. 2"
```

## tests/ztest/error_hook/testcase.yaml
```yaml
common:
  platform_key:
    - arch
  tags:
    - test_framework
tests:
  testing.ztest.error_hook:
    filter: CONFIG_ARCH_HAS_USERSPACE
    arch_exclude:
      - posix
    tags:
      - userspace
    ignore_faults: true
  testing.ztest.error_hook.no_userspace:
    extra_args: CONF_FILE=prj_no_userspace.conf
    ignore_faults: true
```

## tests/ztest/fail/Kconfig
```kconfig
# Copyright (c) 2022 Google LLC
# SPDX-License-Identifier: Apache-2.0

choice ZTEST_FAIL_TEST
	prompt "Select the type of failure to test"

config ZTEST_FAIL_TEST_ASSERT_AFTER
	bool "Add a failed assert in the after phase"

config ZTEST_FAIL_TEST_ASSERT_TEARDOWN
	bool "Add a failed assert in the teardown phase"

config ZTEST_FAIL_TEST_ASSUME_AFTER
	bool "Add a failed assume in the after phase"

config ZTEST_FAIL_TEST_ASSUME_TEARDOWN
	bool "Add a failed assume in the teardown phase"

config ZTEST_FAIL_TEST_PASS_AFTER
	bool "Add a call to ztest_test_pass() in the after phase"

config ZTEST_FAIL_TEST_PASS_TEARDOWN
	bool "Add a call to ztest_test_pass() in the teardown phase"

config ZTEST_FAIL_TEST_UNEXPECTED_ASSUME
	bool "Add a test which fails a zassume() call"

endchoice

config TEST_ERROR_STRING
	string
	default "ERROR: cannot fail in test phase 'after()', bailing" if ZTEST_FAIL_TEST_ASSERT_AFTER
	default "ERROR: cannot fail in test phase 'teardown()', bailing" if ZTEST_FAIL_TEST_ASSERT_TEARDOWN
	default "ERROR: cannot skip in test phase 'after()', bailing" if ZTEST_FAIL_TEST_ASSUME_AFTER && !ZTEST_FAIL_ON_ASSUME
	default "ERROR: cannot skip in test phase 'teardown()', bailing" if ZTEST_FAIL_TEST_ASSUME_TEARDOWN && !ZTEST_FAIL_ON_ASSUME
	default "ERROR: cannot fail in test phase 'after()', bailing" if ZTEST_FAIL_TEST_ASSUME_AFTER && ZTEST_FAIL_ON_ASSUME
	default "ERROR: cannot fail in test phase 'teardown()', bailing" if ZTEST_FAIL_TEST_ASSUME_TEARDOWN && ZTEST_FAIL_ON_ASSUME
	default "ERROR: cannot pass in test phase 'after()', bailing" if ZTEST_FAIL_TEST_PASS_AFTER
	default "ERROR: cannot pass in test phase 'teardown()', bailing" if ZTEST_FAIL_TEST_PASS_TEARDOWN
	default "Assumption failed at " if ZTEST_FAIL_TEST_UNEXPECTED_ASSUME

source "Kconfig.zephyr"
```

## tests/ztest/fail/testcase.yaml
```yaml
# Copyright (c) 2022 Google LLC
# SPDX-License-Identifier: Apache-2.0

common:
  tags:
    - test_framework
  # test has dependencies on host libc
  platform_allow:
    - unit_testing
    - native_sim
    - native_sim/native/64
  integration_platforms:
    - native_sim
tests:
  testing.fail.unit.assert_after:
    type: unit
    extra_configs:
      - CONFIG_ZTEST_FAIL_TEST_ASSERT_AFTER=y
  testing.fail.unit.assert_teardown:
    type: unit
    extra_configs:
      - CONFIG_ZTEST_FAIL_TEST_ASSERT_TEARDOWN=y
  testing.fail.unit.assume_after:
    type: unit
    extra_configs:
      - CONFIG_ZTEST_FAIL_TEST_ASSUME_AFTER=y
  testing.fail.unit.assume_teardown:
    type: unit
    extra_configs:
      - CONFIG_ZTEST_FAIL_TEST_ASSUME_TEARDOWN=y
  testing.fail.unit.pass_after:
    type: unit
    extra_configs:
      - CONFIG_ZTEST_FAIL_TEST_PASS_AFTER=y
  testing.fail.unit.pass_teardown:
    type: unit
    extra_configs:
      - CONFIG_ZTEST_FAIL_TEST_PASS_TEARDOWN=y
  testing.fail.zephyr.assert_after:
    extra_configs:
      - CONFIG_ZTEST_FAIL_TEST_ASSERT_AFTER=y
  testing.fail.zephyr.assert_teardown:
    extra_configs:
      - CONFIG_ZTEST_FAIL_TEST_ASSERT_TEARDOWN=y
  testing.fail.zephyr.assume_after:
    extra_configs:
      - CONFIG_ZTEST_FAIL_TEST_ASSUME_AFTER=y
  testing.fail.zephyr.assume_teardown:
    extra_configs:
      - CONFIG_ZTEST_FAIL_TEST_ASSUME_TEARDOWN=y
  testing.fail.zephyr.pass_after:
    extra_configs:
      - CONFIG_ZTEST_FAIL_TEST_PASS_AFTER=y
  testing.fail.zephyr.pass_teardown:
    extra_configs:
      - CONFIG_ZTEST_FAIL_TEST_PASS_TEARDOWN=y
  testing.fail.unit.fail_on_bad_assumption:
    type: unit
    extra_configs:
      - CONFIG_ZTEST_FAIL_TEST_UNEXPECTED_ASSUME=y
  testing.fail.zephyr.fail_on_bad_assumption:
    extra_configs:
      - CONFIG_ZTEST_FAIL_TEST_UNEXPECTED_ASSUME=y
```

## tests/ztest/mock/testcase.yaml
```yaml
tests:
  testing.ztest.mock:
    arch_exclude: arm
    tags: test_framework
    integration_platforms:
      - native_posix
  testing.ztest.unit:
    tags: test_framework
    type: unit
```

## tests/ztest/mock_fff/testcase.yaml
```yaml
tests:
  testing.ztest.mock_fff:
    filter: CONFIG_ZEPHYR_FFF_MODULE
    tags: test_framework
    integration_platforms:
      - native_posix
  testing.ztest.mock_fff_global:
    filter: CONFIG_ZEPHYR_FFF_MODULE
    tags: test_framework
    extra_args: CONF_FILE=prj_global.conf
    integration_platforms:
      - native_posix
```

## tests/ztest/register/testcase.yaml
```yaml
tests:
  testing.ztest.register:
    tags: test_framework
    integration_platforms:
      - native_posix
```

## tests/ztest/repeat/testcase.yaml
```yaml
tests:
  testing.ztest.repeat_suite_regex:
    platform_allow: qemu_x86
    harness: console
    harness_config:
      ztest_suite_repeat: 3
      ztest_test_repeat: 2
      type: multi_line
      regex:
        - "Running TESTSUITE testsuite"
        - "Running TESTSUITE testsuite"
        - "Running TESTSUITE testsuite"

  testing.ztest.repeat_testcase_regex:
    platform_allow: qemu_x86
    harness: console
    harness_config:
      ztest_suite_repeat: 1
      ztest_test_repeat: 5
      type: multi_line
      regex:
        - "START - test_repeating"
        - "START - test_repeating"
        - "START - test_repeating"
        - "START - test_repeating"
        - "START - test_repeating"

  testing.ztest.repeat_regex:
    platform_allow: qemu_x86
    harness: ztest
```

## tests/ztest/shell/Kconfig
```kconfig
# Copyright (c) 2023, Meta
# SPDX-License-Identifier: Apache-2.0

config TEST_ZTEST_SHELL
	bool
	default y
	help
	  Enables whitebox testing of ztest_shell_filter()

source "Kconfig.zephyr"
```

## tests/ztest/shell/testcase.yaml
```yaml
tests:
  testing.ztest.shell:
    platform_allow:
      - qemu_x86
    tags: test_framework
    harness: pytest
    harness_config:
      pytest_dut_scope: session
```

## tests/ztest/summary/testcase.yaml
```yaml
tests:
  testing.ztest.summary.shared_unit_test:
    platform_key:
      - arch
    tags:
      - test_framework
```

## tests/ztest/test/base/testcase.yaml
```yaml
tests:
  test:
    tags: test_framework
    type: unit
  test_verbose_0:
    extra_args: CONF_FILE=prj_verbose_0.conf
    tags: test_framework
  test_verbose_1:
    extra_args: CONF_FILE=prj_verbose_1.conf
    tags: test_framework
  test_verbose_2:
    extra_args: CONF_FILE=prj_verbose_2.conf
    tags: test_framework
```

## tests/ztest/test/mock/testcase.yaml
```yaml
tests:
  test:
    arch_exclude: arm
    tags: test_framework
  test_unit:
    tags: test_framework
    type: unit
```

## tests/ztest/zexpect/testcase.yaml
```yaml
# Copyright (c) 2022 Google Inc
# SPDX-License-Identifier: Apache-2.0

common:
  integration_platforms:
    - native_sim
  tags:
    - test_framework
tests:
  testing.ztest.expect:
    integration_platforms:
      - native_sim
  testing.ztest.expect_cpp:
    extra_configs:
      - CONFIG_CPP=y
  testing.ztest.expect.unit:
    type: unit
```

## tests/ztest/ztest_param/testcase.yaml
```yaml
tests:
  testing.ztest.ztest_params.ztest_params:
    platform_allow:
      - qemu_x86
    tags: test_framework
    harness: pytest
```

## tests/ztest/ztest_params/testcase.yaml
```yaml
tests:
  testing.ztest.ztest_params.ztest_params:
    tags:
      - test_framework
```

## tests/ztest/ztress/testcase.yaml
```yaml
common:
  tags:
    - test_framework
  platform_type:
    - qemu
  platform_key:
    - arch
tests:
  testing.ztest.ztress:
    integration_platforms:
      - qemu_x86
```

## tsi_core/sample.yaml
```yaml
sample:
  description: TSI Core platform - M85
  name: m85
common:
  tags: introduction
  integration_platforms:
    - tsi/skyp/m85
  harness: console
  harness_config:
    type: one_line
    regex:
tests:
  sample.m85:
    tags: introduction
```

## usb/Kconfig
```kconfig
# Kconfig - USB device stack configuration options

#
# Copyright (c) 2016 Wind River Systems, Inc.
#
# Licensed under the Apache License, Version 2.0 (the "License");
# you may not use this file except in compliance with the License.
# You may obtain a copy of the License at
#
#     http://www.apache.org/licenses/LICENSE-2.0
#
# Unless required by applicable law or agreed to in writing, software
# distributed under the License is distributed on an "AS IS" BASIS,
# WITHOUT WARRANTIES OR CONDITIONS OF ANY KIND, either express or implied.
# See the License for the specific language governing permissions and
# limitations under the License.
#

menuconfig USB_DEVICE_STACK
	bool
	prompt "USB device stack"
	depends on USB
	default n
	help
	Enable USB device stack.

if USB_DEVICE_STACK

config USB_DEBUG
	bool
	prompt "Enable USB debug options for the entire USB stack"
	default n
	help
	This option enables the debug features for the USB device stack.

endif # USB_DEVICE_STACK
```
