/*
 * Copyright (c) 2021 Nordic Semiconductor ASA
 *
 * SPDX-License-Identifier: Apache-2.0
 */

&timer0 {
	interrupts = <8 0>;
	status = "okay";
};

/ {
	busy-sim {
		compatible = "vnd,busy-sim";
		counter = <&timer0>;
		active-gpios = <&gpio0 27 GPIO_ACTIVE_HIGH>;
		status = "okay";
	};
};
