## CMakeLists.txt
```
# Copyright 2025 Arduino SA
# SPDX-License-Identifier: Apache-2.0

cmake_minimum_required(VERSION 3.28.0)

find_package(Zephyr REQUIRED HINTS $ENV{ZEPHYR_BASE})

# will never be created so the check runs every time
set(output_file ${PROJECT_BINARY_DIR}/validate_tracing_output.txt)

add_custom_command(
  COMMENT "Testing Kconfig value origin traces"
  OUTPUT ${output_file}
  DEPENDS
    ${logical_target_for_zephyr_elf}
    $<$<TARGET_EXISTS:native_runner_executable>:native_runner_executable>
  COMMAND ${PYTHON_EXECUTABLE} ${APPLICATION_SOURCE_DIR}/validate_tracing.py ${DOTCONFIG}
  COMMAND ${WEST} build -t traceconfig
)

add_custom_target(validate_traces ALL DEPENDS ${output_file})

project(check_tracing)

target_sources(app PRIVATE src/main.c)
```

## Kconfig
```
# Copyright 2025 Arduino SA
# SPDX-License-Identifier: Apache-2.0

# Note that line numbers in this file are important for test scripts. Ensure
# these match the expectations in validate_srcrefs.py.

source "Kconfig.zephyr"

config MAIN_FLAG
	bool

config MAIN_FLAG_DEPENDENCY
	bool "Main Feature Dependency"
	default y
	depends on MAIN_FLAG

config MAIN_FLAG_SELECT
	bool "Main Feature Dependent"
	select MAIN_FLAG

choice MULTIPLE_CHOICES
	prompt "Multiple Choice Option"

config FIRST_CHOICE
	bool "First Choice Option"
	depends on !MAIN_FLAG

config SECOND_CHOICE
	bool "Second Choice Option"

endchoice

config UNSET_FLAG
	bool "Disabled Feature"
```

## prj.conf
```kconfig
# Copyright 2025 Arduino SA
# SPDX-License-Identifier: Apache-2.0

# Note that line numbers in this file are important for test scripts. Ensure
# these match the expectations in validate_srcrefs.py.

CONFIG_MAIN_FLAG_SELECT=y
```

## src/main.c
```c
/*
 * Copyright 2025 Arduino SA
 *
 * SPDX-License-Identifier: Apache-2.0
 */

int main(void)
{
	return 0;
}
```
