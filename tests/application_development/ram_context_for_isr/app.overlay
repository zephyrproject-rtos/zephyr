/*
 * Copyright (c) 2025 Silicon Laboratories Inc.
 *
 * SPDX-License-Identifier: Apache-2.0
 */

/ {
	#address-cells = <1>;
	#size-cells = <1>;

	fakedriver: fakedriver@E0000000 {
		compatible = "fakedriver";
		reg = <0xE0000000 0x2000>;
		zephyr,mutable;
		status = "okay";
	};
};
