## CMakeLists.txt
```
# Copyright (c) 2025 Silicon Laboratories Inc.
# SPDX-License-Identifier: Apache-2.0

cmake_minimum_required(VERSION 3.28.0)

find_package(Zephyr REQUIRED HINTS $ENV{ZEPHYR_BASE})

project(ram_context_for_isr)

FILE(GLOB app_sources src/*.c)
target_sources(app PRIVATE ${app_sources})

zephyr_include_directories(${CMAKE_CURRENT_SOURCE_DIR}/include)

if(CONFIG_CPU_CORTEX_M_HAS_VTOR)
  zephyr_code_relocate(FILES ${ZEPHYR_BASE}/arch/arm/core/cortex_m/isr_wrapper.c LOCATION RAM)
  zephyr_code_relocate(FILES ${ZEPHYR_BASE}/arch/arm/core/cortex_m/exc_exit.c LOCATION RAM)
endif()

zephyr_code_relocate(FILES ${CMAKE_CURRENT_SOURCE_DIR}/src/main.c FILTER ".test_irq_callback" LOCATION RAM)
zephyr_code_relocate(FILES ${CMAKE_CURRENT_SOURCE_DIR}/src/fake_driver.c FILTER ".fake_driver_isr" LOCATION RAM)

# Only needed because the fake driver is defined in tests folder
zephyr_linker_sources(SECTIONS sections-rom.ld)
```

## Kconfig
```
# Copyright (c) 2025 Muhmmad Waleed Badar
#
# SPDX-License-Identifier: Apache-2.0

source "Kconfig.zephyr"

config TEST_IRQ_NUM
	int "Test IRQ number"
	default 42 if BOARD_QEMU_CORTEX_M3
	default 14 if GIC
	default 22 if SOC_SERIES_DA1469X
	default 18 if SOC_SERIES_STM32C0X
	default 1 if (SOC_SERIES_NPCX9 || SOC_SERIES_NPCX7 || SOC_SERIES_NPCK3)
	default 1 if SOC_FAMILY_MCXA
	default 29 if SOC_K32L2B31A
	default 28 if (SOC_SERIES_NRF54L || SOC_SERIES_RTL8752H)
	default 52 if SOC_SERIES_EFR32BG22
	default 11 if (SOC_MAX32650 || SOC_MAX32655 || SOC_MAX32660)
	default 434 if SOC_SERIES_NRF92
	default 0
	help
	  IRQ number to use for testing purposes. This should be an
	  available/unused IRQ on the target platform.

	  Platform-specific defaults:
	  - QEMU Cortex-M3: 42 (available test IRQ)
	  - GIC platforms: 14 (available test SGI - Software Generated Interrupt)
	  - DA1469X series: 22 (available test IRQ)
	  - STM32C0X series: 18 (available test IRQ)
	  - NPCX9, NPCX7, NPCK3 series: 1 (unused IRQ not mapped to MIWU groups)
	  - MCXA family: 1 (unused CMC IRQ; NUM_IRQS - 1 is reserved on some SoCs)
	  - K32L2B31A: 29 (available test IRQ)
	  - EFR32BG22: 52 (available test IRQ (SW0 - SGI), (NUM_IRQS - 1) equates to EUART0 TX)
	  - RTL8752H: 28 (available test IRQ, (NUM_IRQS - 1) equates to UART2))
	  - MAX32650, MAX32655, MAX32660: 11 (NUM_IRQS is derived from devicetree
	    here, so (NUM_IRQS - 1) is always an enabled node's own IRQ)
	  - NRF92 series: 434 as (NUM_IRQS - 1) interrupt is used by serial console
	  - Other platforms: 0 (magic config value to select the last IRQ: NUM_IRQS - 1)

config TEST_IRQ_PRIO
	int "Test IRQ priority"
	default 160 if GIC
	default 1
	help
	  Platform-specific defaults:
	  - GIC platforms: IRQ_DEFAULT_PRIORITY (system default)
	  - Other platforms: 1 (high priority for testing)
```

## prj.conf
```kconfig
CONFIG_COVERAGE=n
CONFIG_ZTEST=y
CONFIG_SRAM_VECTOR_TABLE=y
CONFIG_SRAM_SW_ISR_TABLE=y
CONFIG_CODE_DATA_RELOCATION_SRAM=y
CONFIG_DEVICE_MUTABLE=y
CONFIG_TRACING_ISR=n
CONFIG_STACK_SENTINEL=n
CONFIG_PM=n
```

## boards/frdm_mcxw23_mcxw236.conf
```kconfig
# Copyright (c) 2026 NXP
# SPDX-License-Identifier: Apache-2.0

# UTICK0_IRQn = 8, defined by NXP CMSIS and unused in current Zephyr DTS.
# Default TEST_IRQ_NUM resolves to IRQ 60 (CDOG_IRQn) which cannot be
# software-triggered via NVIC_SetPendingIRQ on this platform.
CONFIG_TEST_IRQ_NUM=8
CONFIG_TEST_FIND_FREE_IRQ=n
```

## boards/nrf54l15dk_nrf54l15_cpuapp.conf
```kconfig
#
# Copyright (c) 2025 Nordic Semiconductor ASA
#
# SPDX-License-Identifier: LicenseRef-Nordic-5-Clause
#
CONFIG_CRACEN_LIB_KMU=n
```

## app.overlay
```dts
/*
 * Copyright (c) 2025 Silicon Laboratories Inc.
 *
 * SPDX-License-Identifier: Apache-2.0
 */

/ {
	#address-cells = <1>;
	#size-cells = <1>;

	fakedriver: fakedriver@E0000000 {
		compatible = "fakedriver";
		reg = <0xE0000000 0x2000>;
		zephyr,mutable;
		status = "okay";
	};
};
```

## boards/nucleo_c071rb.overlay
```dts
/*
 * Copyright The Zephyr Project Contributors
 *
 * SPDX-License-Identifier: Apache-2.0
 */

#include "../app.overlay"

&fakedriver {
	interrupt-parent = <&nvic>;
	interrupts = <18 1>;
};
```

## boards/qemu_cortex_m3.overlay
```dts
/*
 * Copyright The Zephyr Project Contributors
 *
 * SPDX-License-Identifier: Apache-2.0
 */

#include "../app.overlay"

&fakedriver {
	interrupt-parent = <&nvic>;
	interrupts = <42 1>;
};
```

## dts/bindings/fakedriver.yml
```yaml
# Copyright (c) 2025 Silicon Laboratories
# SPDX-License-Identifier: Apache-2.0

description: Properties for fake driver.

compatible: "fakedriver"

include: [base.yaml, mutable.yaml]
```

## src/main.c
```c
/*
 * Copyright (c) 2025 Silicon Laboratories Inc.
 *
 * SPDX-License-Identifier: Apache-2.0
 */

/**
 * @file
 * @brief Test for driver relocation to RAM for ISRs
 *
 * This test demonstrates how to use the fake_driver and verify
 * that the callback are properly relocated to RAM.
 */

#if !defined(CONFIG_CPU_CORTEX_M)
#error project can only run on Cortex-M for now
#endif

#include <zephyr/ztest.h>
#include <fake_driver.h>

static volatile bool test_flag;

static void test_irq_callback(const struct device *dev, void *user_data)
{
	uintptr_t func_addr = (uintptr_t)test_irq_callback;
	uintptr_t driver_isr_addr, arch_isr_wrapper_addr;

	test_flag = true;

	/* Retrieve the caller address (the arch specific isr wrapper since driver isr will be
	 * optimized by the compiler)
	 */
	__asm__ volatile("mov %0, lr" : "=r"(arch_isr_wrapper_addr));

	/* retrieve the fake_driver_isr function address that was stored in user_data */
	driver_isr_addr = (uintptr_t)user_data;

	/* Check that the function and its call stack are in RAM */
	zassert_true(func_addr >= DT_CHOSEN_SRAM_ADDR &&
			     func_addr <= DT_CHOSEN_SRAM_ADDR + DT_CHOSEN_SRAM_SIZE,
		     "%s is not in RAM! Address: 0x%lx", __func__, func_addr);

	zassert_true(driver_isr_addr >= DT_CHOSEN_SRAM_ADDR &&
			     driver_isr_addr <= DT_CHOSEN_SRAM_ADDR + DT_CHOSEN_SRAM_SIZE,
		     "fake_driver_isr is not in RAM! Address: 0x%lx", driver_isr_addr);

	zassert_true(arch_isr_wrapper_addr >= DT_CHOSEN_SRAM_ADDR &&
			     arch_isr_wrapper_addr <=
				     DT_CHOSEN_SRAM_ADDR + DT_CHOSEN_SRAM_SIZE,
		     "arch_isr_wrapper_addr is not in RAM! Address: 0x%lx", arch_isr_wrapper_addr);

	TC_PRINT("Callback function address: 0x%lx\n", func_addr);
	TC_PRINT("Driver ISR address: 0x%lx\n", driver_isr_addr);
	TC_PRINT("Arch ISR wrapper address: 0x%lx\n", arch_isr_wrapper_addr);
}

ZTEST(ram_context_for_isr, test_fake_driver_in_ram)
{
	const struct device *dev = DEVICE_DT_GET(DT_NODELABEL(fakedriver));
	const struct fake_driver_api *api = DEVICE_API_GET(fake, dev);
	uintptr_t dev_addr = (uintptr_t)dev;

	zassert_true(dev_addr >= DT_CHOSEN_SRAM_ADDR &&
			     dev_addr <= DT_CHOSEN_SRAM_ADDR + DT_CHOSEN_SRAM_SIZE,
		     "fake driver device is not in RAM! Address: 0x%lx", dev_addr);

	TC_PRINT("Fake driver device address: 0x%lx\n", dev_addr);

	zassert_not_null(api, "Failed to get fake driver API");

	api->register_irq_callback(dev, test_irq_callback, NULL);
	test_flag = false;

	NVIC_SetPendingIRQ(TEST_IRQ_NUM);

	k_busy_wait(1000);

	zassert_true(test_flag, "ISR callback was not called");
}

ZTEST_SUITE(ram_context_for_isr, NULL, NULL, NULL, NULL, NULL);
```

## include/fake_driver.h
```c
/*
 * Copyright (c) 2025 Silicon Laboratories Inc.
 *
 * SPDX-License-Identifier: Apache-2.0
 */

#ifndef ZEPHYR_INCLUDE_DRIVERS_FAKE_DRIVER_H_
#define ZEPHYR_INCLUDE_DRIVERS_FAKE_DRIVER_H_

#ifdef __cplusplus
extern "C" {
#endif

#if CONFIG_TEST_IRQ_NUM == 0
/* For all the other platforms, use the last available IRQ line for testing. */
#ifdef CONFIG_MULTI_LEVEL_INTERRUPTS
#define TEST_IRQ_NUM (CONFIG_2ND_LVL_ISR_TBL_OFFSET - 1)
#else
#define TEST_IRQ_NUM  (CONFIG_NUM_IRQS - 1)
#endif
#else
#define TEST_IRQ_NUM CONFIG_TEST_IRQ_NUM
#endif

typedef void (*fake_driver_irq_callback_t)(const struct device *dev, void *user_data);

struct fake_driver_config {
	void (*irq_config_func)(void);
	uint16_t irq_num;
	uint8_t irq_priority;
};

struct fake_driver_data {
	fake_driver_irq_callback_t irq_callback;
	void *user_data;
};

__subsystem struct fake_driver_api {
	int (*configure)(const struct device *dev, int config);
	int (*register_irq_callback)(const struct device *dev, fake_driver_irq_callback_t cb,
				     void *user_data);
};

#ifdef __cplusplus
}
#endif

#endif /* ZEPHYR_INCLUDE_DRIVERS_FAKE_DRIVER_H_ */
```

## src/fake_driver.c
```c
/*
 * Copyright (c) 2025 Silicon Laboratories Inc.
 *
 * SPDX-License-Identifier: Apache-2.0
 */

#include <cmsis_core.h>
#include <zephyr/device.h>
#include <zephyr/irq.h>
#include <zephyr/ztest.h>
#include <zephyr/interrupt_util.h>
#include "fake_driver.h"

#define DT_DRV_COMPAT fakedriver

static void fake_driver_isr(const void *arg)
{
	const struct device *dev = (const struct device *)arg;
	struct fake_driver_data *data = dev->data;

	/* Store the address of fake_driver_isr in user_data because it will be optimized by the
	 * compiler (even with __noinline__ attribute)
	 */
	data->user_data = (void *)&fake_driver_isr;

	if (data->irq_callback != NULL) {
		data->irq_callback(dev, data->user_data);
	}
}

#ifdef CONFIG_TEST_FIND_FREE_IRQ
/* Scan NVIC for a free IRQ */

#if CONFIG_2ND_LVL_ISR_TBL_OFFSET > 0
#define TEST_1ST_LEVEL_INTERRUPTS_MAX (CONFIG_2ND_LVL_ISR_TBL_OFFSET - 1)
#else
#define TEST_1ST_LEVEL_INTERRUPTS_MAX (CONFIG_NUM_IRQS - 1)
#endif

static unsigned int get_test_irq(void)
{
	return get_available_nvic_line(TEST_1ST_LEVEL_INTERRUPTS_MAX);
}
#else /* CONFIG_TEST_FIND_FREE_IRQ */

#if CONFIG_TEST_IRQ_NUM == 0
/* For all the other platforms, use the last available IRQ line for testing. */
#ifdef CONFIG_MULTI_LEVEL_INTERRUPTS
#define TEST_IRQ_NUM (CONFIG_2ND_LVL_ISR_TBL_OFFSET - 1)
#else
#define TEST_IRQ_NUM  (CONFIG_NUM_IRQS - 1)
#endif
#else
#define TEST_IRQ_NUM CONFIG_TEST_IRQ_NUM
#endif

BUILD_ASSERT(TEST_IRQ_NUM >= 0,
	     "CONFIG_TEST_IRQ_NUM defines the test IRQ when CONFIG_TEST_FIND_FREE_IRQ is disabled");

static unsigned int get_test_irq(void)
{
	return TEST_IRQ_NUM;
}
#endif /* CONFIG_TEST_FIND_FREE_IRQ */

static int fake_driver_register_irq_callback(const struct device *dev,
					     fake_driver_irq_callback_t cb, void *user_data)
{
	struct fake_driver_data *data = dev->data;

	data->irq_callback = cb;
	data->user_data = user_data;

	return 0;
}

DEVICE_API(fake, fake_driver_func) = {
	.register_irq_callback = fake_driver_register_irq_callback,
};

static int fake_driver_init(const struct device *dev)
{
	struct fake_driver_data *data = dev->data;

	data->irq_num = get_test_irq();
	data->irq_callback = NULL;
	data->user_data = NULL;

	(void)irq_connect_dynamic(data->irq_num, CONFIG_TEST_IRQ_PRIO, fake_driver_isr, dev, 0);
	irq_enable(data->irq_num);

	return 0;
}

#define FAKE_INIT(inst)                                                                            \
	static struct fake_driver_data fake_driver_data_##inst;                                    \
	                                                                                           \
	DEVICE_DT_INST_DEFINE(inst, &fake_driver_init, NULL, &fake_driver_data_##inst, NULL,       \
			      PRE_KERNEL_1, CONFIG_KERNEL_INIT_PRIORITY_DEFAULT, &fake_driver_func);

DT_INST_FOREACH_STATUS_OKAY(FAKE_INIT)
```
