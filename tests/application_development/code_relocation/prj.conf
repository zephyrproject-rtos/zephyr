## CMakeLists.txt
```
# SPDX-License-Identifier: Apache-2.0
# Copyright 2022, 2026 NXP

cmake_minimum_required(VERSION 3.28.0)

find_package(Zephyr REQUIRED HINTS $ENV{ZEPHYR_BASE})
project(code_relocation)

cmake_file_api(QUERY API_VERSION 1 CODEMODEL 2)

FILE(GLOB app_sources src/*.c)
target_sources(app PRIVATE ${app_sources})

add_custom_target(check_relocation_metadata
  COMMAND "${CMAKE_COMMAND}"
    "-DBUILD_DIR=${CMAKE_BINARY_DIR}"
    "-DRELOCATION_DICT=${ZEPHYR_BINARY_DIR}/relocation_dict.txt"
    "-DTEST_SOURCE_DIR=${CMAKE_CURRENT_SOURCE_DIR}"
    -P "${CMAKE_CURRENT_SOURCE_DIR}/check_relocation.cmake"
  COMMENT "Checking code relocation metadata"
  VERBATIM
)
add_dependencies(app check_relocation_metadata)

if(CONFIG_BOARD_QEMU_XTENSA)
    set(RAM_PHDR PHDR sram0_phdr)
    set(SRAM2_PHDR PHDR sram2_phdr)
endif()

# Code relocation feature
zephyr_code_relocate(FILES src/test_file1.c ${SRAM2_PHDR} LOCATION SRAM2)

zephyr_code_relocate(FILES ${CMAKE_CURRENT_SOURCE_DIR}/src/test_file2.c ${RAM_PHDR} LOCATION RAM FILTER ".*sram")

# Add custom library that we can relocate code for
add_subdirectory(test_lib)
target_link_libraries(app PUBLIC test_lib)
target_include_directories(app PUBLIC ${CMAKE_CURRENT_LIST_DIR}/test_lib)
# Relocate library code
zephyr_code_relocate(LIBRARY test_lib LOCATION SRAM2)

# Forward a generator expression through multiple target properties.
set(reloc_files src/test_file4.c src/test_file5.c)
set(genex_expr
  ${CMAKE_CURRENT_LIST_DIR}/$<JOIN:${reloc_files},$<SEMICOLON>${CMAKE_CURRENT_LIST_DIR}/>)
add_library(relocation_sources INTERFACE)
target_sources(relocation_sources INTERFACE "${genex_expr}")
add_library(forwarded_relocation_sources INTERFACE)
target_sources(forwarded_relocation_sources INTERFACE
  "$<TARGET_PROPERTY:relocation_sources,INTERFACE_SOURCES>"
)
zephyr_code_relocate(
  FILES "$<TARGET_PROPERTY:forwarded_relocation_sources,INTERFACE_SOURCES>" LOCATION SRAM2
)

zephyr_code_relocate(FILES src/test_file3.c LOCATION SRAM2_LITERAL)
zephyr_code_relocate(FILES src/test_file3.c LOCATION SRAM2_TEXT)
zephyr_code_relocate(FILES src/test_file3.c LOCATION RAM_DATA)
zephyr_code_relocate(FILES src/test_file3.c LOCATION SRAM2_BSS)

zephyr_late_relocation(SRAM2)

# Test NOKEEP support. Placing both KEEP and NOKEEP symbols in the same location
# (this and test_file2.c in RAM) should work fine.
zephyr_code_relocate(FILES ${ZEPHYR_BASE}/kernel/sem.c ${RAM_PHDR} LOCATION RAM NOKEEP)

if(CONFIG_RELOCATE_TO_ITCM)
zephyr_code_relocate(FILES ${ZEPHYR_BASE}/lib/libc/minimal/source/string/string.c
  LOCATION ITCM_TEXT)
endif()

zephyr_linker_sources(SECTIONS custom-sections.ld)
```

## Kconfig
```
# Copyright (c) 2022, NXP
# SPDX-License-Identifier: Apache-2.0

config RELOCATE_TO_ITCM
	bool "test with code relocate to itcm"

config TEST_SPLIT_RAM_LOAD_DATA
	bool "Test split RAM-load data initialization"
	select ARCH_DATA_COPY_FOR_RAM_LOAD_SPLIT

source "Kconfig.zephyr"
```

## prj.conf
```kconfig
CONFIG_CODE_DATA_RELOCATION=y
CONFIG_COVERAGE=n
CONFIG_ZTEST=y
CONFIG_HAVE_CUSTOM_LINKER_SCRIPT=y
```

## prj_riscv.conf
```kconfig
CONFIG_CODE_DATA_RELOCATION=y
CONFIG_ZTEST=y
CONFIG_HAVE_CUSTOM_LINKER_SCRIPT=y
CONFIG_CUSTOM_LINKER_SCRIPT="linker_riscv_qemu_sram2.ld"
```

## prj_split_ram_load.conf
```kconfig
CONFIG_TEST_SPLIT_RAM_LOAD_DATA=y
CONFIG_XIP=n
```

## prj_stm32_non_xip_copy.conf
```kconfig
CONFIG_CODE_DATA_RELOCATION=y
CONFIG_COVERAGE=n
CONFIG_ZTEST=y

# Relocated code/data is copied with XIP disabled
CONFIG_CODE_DATA_RELOCATION_COPY_ALL=y

# Disable XIP
CONFIG_XIP=n
CONFIG_FLASH_SIZE=0
CONFIG_FLASH_BASE_ADDRESS=0

# Enable relocation to ITCM test
CONFIG_RELOCATE_TO_ITCM=y
CONFIG_MINIMAL_LIBC=y
```

## prj_xtensa.conf
```kconfig
CONFIG_CODE_DATA_RELOCATION=y
CONFIG_ZTEST=y
CONFIG_HAVE_CUSTOM_LINKER_SCRIPT=y
CONFIG_CUSTOM_LINKER_SCRIPT="linker_xtensa_qemu_sram2.ld"
```

## boards/adp_xc7k_ae350_clic.conf
```kconfig
CONFIG_MINIMAL_LIBC=y
CONFIG_RELOCATE_TO_ITCM=y
CONFIG_CUSTOM_LINKER_SCRIPT="linker_riscv_qemu_sram2.ld"
```

## boards/adp_xc7k_ae350.overlay
```dts
/*
 * Copyright (c) 2026 Andes Technology Corporation
 *
 * SPDX-License-Identifier: Apache-2.0
 */
/ {
	chosen {
		zephyr,itcm = &ilm;
	};
};

&dram {
	/* avoid overlap with ilm and dlm region. */
	reg = <0x00400000 0x3fc00000>;
};

&ilm {
	status = "okay";
};
```

## src/main.c
```c
/*
 * Copyright (c) 2018 Intel Corporation.
 * Copyright (c) 2022, NXP
 *
 * SPDX-License-Identifier: Apache-2.0
 */

#include <zephyr/kernel.h>
#include <zephyr/sys/printk.h>
#include <zephyr/ztest.h>

/* This function will allow execute from sram region.
 * This is needed only for this sample because by default all soc will
 * disable the execute from SRAM.
 * An application that requires that the code be executed from SRAM will
 *  have to configure the region appropriately in arm_mpu_regions.c.
 */

#if (defined(CONFIG_ARM_MPU) && !defined(CONFIG_CPU_HAS_NXP_SYSMPU))
#include <cmsis_core.h>
void disable_mpu_rasr_xn(void)
{
	uint32_t index;
	/* Kept the max index as 8(irrespective of soc) because the sram
	 * would most likely be set at index 2.
	 */
	for (index = 0U; index < 8; index++) {
		MPU->RNR = index;
#if defined(CONFIG_ARMV8_M_BASELINE) || defined(CONFIG_ARMV8_M_MAINLINE)
		if (MPU->RBAR & MPU_RBAR_XN_Msk) {
			MPU->RBAR ^= MPU_RBAR_XN_Msk;
		}
#else
		if (MPU->RASR & MPU_RASR_XN_Msk) {
			MPU->RASR ^= MPU_RASR_XN_Msk;
		}
#endif /* CONFIG_ARMV8_M_BASELINE || CONFIG_ARMV8_M_MAINLINE */
	}

}
#endif	/* CONFIG_ARM_MPU */

/* override the default memcpy as zephyr will call this before relocation happens */
__boot_func
void  arch_early_memcpy(void *dst, const void *src, size_t n)
{
	/* attempt word-sized copying only if buffers have identical alignment */
	unsigned char *d_byte = (unsigned char *)dst;
	const unsigned char *s_byte = (const unsigned char *)src;
	/* do byte-sized copying until finished */

	while (n > 0) {
		*(d_byte++) = *(s_byte++);
		n--;
	}
}

__boot_func
void arch_early_memset(void *dst, int c, size_t n)
{
	/* do byte-sized initialization until word-aligned or finished */

	unsigned char *d_byte = (unsigned char *)dst;
	unsigned char c_byte = (unsigned char)c;

	while (n > 0) {
		*(d_byte++) = c_byte;
		n--;
	}
}

void *relocate_code_setup(void)
{
#if (defined(CONFIG_ARM_MPU) && !defined(CONFIG_CPU_HAS_NXP_SYSMPU))
	disable_mpu_rasr_xn();
#endif	/* CONFIG_ARM_MPU */
	return NULL;
}

ZTEST_SUITE(code_relocation, NULL, relocate_code_setup, NULL, NULL, NULL);
```

## src/test_file1.c
```c
/*
 * Copyright (c) 2012-2014 Wind River Systems, Inc.
 *
 * SPDX-License-Identifier: Apache-2.0
 */

#include <zephyr/kernel.h>
#include <zephyr/sys/printk.h>
#include <zephyr/ztest.h>

#include "test_lib.h"

/*
 * These values will typically be placed in the appropriate sections, but may be moved around
 * by the compiler; for instance var_sram2_data might end up in .rodata if the compiler can prove
 * that it's never modified. To prevent that, we explicitly specify sections.
 */
__in_section(data, sram2, var) uint32_t var_sram2_data = 10U;
__in_section(bss, sram2, var) uint32_t var_sram2_bss;
K_SEM_DEFINE(test, 0, 1);
__in_section(rodata, sram2, var) const uint32_t var_sram2_rodata = 100U;

__in_section(custom_section, static, var) uint32_t var_custom_data = 1U;

extern void function_in_sram(int32_t value);
extern void function_not_relocated(int32_t value);
void function_in_custom_section(void);

#define HAS_SRAM2_DATA_SECTION (CONFIG_ARM)

ZTEST(code_relocation, test_function_in_sram2)
{
	extern uintptr_t __ram_text_reloc_start;
	extern uintptr_t __ram_text_reloc_end;
	extern uintptr_t __sram2_text_reloc_start;
	extern uintptr_t __sram2_text_reloc_end;
	extern uintptr_t __sram2_data_reloc_start;
	extern uintptr_t __sram2_data_reloc_end;
	extern uintptr_t __sram2_bss_reloc_start;
	extern uintptr_t __sram2_bss_reloc_end;
	extern uintptr_t __sram2_rodata_reloc_start;
	extern uintptr_t __sram2_rodata_reloc_end;
	extern uintptr_t __custom_section_start;
	extern uintptr_t __custom_section_end;

	/* Print values from sram2 */
	printk("Address of var_sram2_data %p\n", &var_sram2_data);
	printk("Address of k_sem_give %p\n", &k_sem_give);
	printk("Address of var_sram2_rodata %p\n", &var_sram2_rodata);
	printk("Address of var_sram2_bss %p\n\n", &var_sram2_bss);

	zassert_between_inclusive((uintptr_t)&var_sram2_data,
		(uintptr_t)&__sram2_data_reloc_start,
		(uintptr_t)&__sram2_data_reloc_end,
		"var_sram2_data not in sram2 region");
	zassert_between_inclusive((uintptr_t)&k_sem_give,
		(uintptr_t)&__sram2_text_reloc_start,
		(uintptr_t)&__sram2_text_reloc_end,
		"k_sem_give not in sram_text region");
	zassert_between_inclusive((uintptr_t)&var_sram2_rodata,
		(uintptr_t)&__sram2_rodata_reloc_start,
		(uintptr_t)&__sram2_rodata_reloc_end,
		"var_sram2_rodata not in sram2_rodata region");
	zassert_between_inclusive((uintptr_t)&var_sram2_bss,
		(uintptr_t)&__sram2_bss_reloc_start,
		(uintptr_t)&__sram2_bss_reloc_end,
		"var_sram2_bss not in sram2_bss region");

	/* Print values from sram */
	printk("Address of function_in_sram %p\n", &function_in_sram);
	zassert_between_inclusive((uintptr_t)&function_in_sram,
		(uintptr_t)&__ram_text_reloc_start,
		(uintptr_t)&__ram_text_reloc_end,
		"function_in_sram is not in ram region");
	function_in_sram(var_sram2_data);

	/* Print values from non-relocated function */
	printk("Address of function_not_relocated %p\n", &function_not_relocated);
	zassert_between_inclusive((uintptr_t)&function_not_relocated,
		(uintptr_t)&__text_region_start,
		(uintptr_t)&__text_region_end,
		"function_not_relocated is not in flash region");
	function_not_relocated(var_sram2_data);
	/* Call library function */
	relocated_library();

	/* Print values which were placed using attributes */
	printk("Address of custom_section, func placed using attributes %p\n",
	       &function_in_custom_section);
	printk("Address of custom_section data placed using attributes %p\n\n",
	       &var_custom_data);
	zassert_between_inclusive((uintptr_t)&function_in_custom_section,
		(uintptr_t)&__custom_section_start,
		(uintptr_t)&__custom_section_end,
		"function_in_custom_section not in custom_section region");
	zassert_between_inclusive((uintptr_t)&var_custom_data,
		(uintptr_t)&__custom_section_start,
		(uintptr_t)&__custom_section_end,
		"var_custom_data not in custom_section region");

	k_sem_give(&test);
}

ZTEST(code_relocation, test_small_data_in_sram2)
{
	extern uintptr_t __sram2_data_reloc_start;
	extern uintptr_t __sram2_data_reloc_end;
	extern uintptr_t __sram2_bss_reloc_start;
	extern uintptr_t __sram2_bss_reloc_end;
	extern uintptr_t __sram2_rodata_reloc_start;
	extern uintptr_t __sram2_rodata_reloc_end;
	static uint32_t var_sram2_small_data = 20U;
	static uint32_t var_sram2_small_bss;
	static const uint32_t var_sram2_small_rodata = 30U;

	zassert_between_inclusive(
		(uintptr_t)&var_sram2_small_data, (uintptr_t)&__sram2_data_reloc_start,
		(uintptr_t)&__sram2_data_reloc_end, "var_sram2_small_data not in sram2 region");
	zassert_between_inclusive(
		(uintptr_t)&var_sram2_small_bss, (uintptr_t)&__sram2_bss_reloc_start,
		(uintptr_t)&__sram2_bss_reloc_end, "var_sram2_small_bss not in sram2_bss region");
	zassert_equal(var_sram2_small_data, 20U);
	zassert_equal(var_sram2_small_bss, 0U);
	zassert_between_inclusive((uintptr_t)&var_sram2_small_rodata,
				  (uintptr_t)&__sram2_rodata_reloc_start,
				  (uintptr_t)&__sram2_rodata_reloc_end,
				  "var_sram2_small_rodata not in sram2_rodata region");
	zassert_equal(var_sram2_small_rodata, 30U);
}

__in_section(custom_section, static, fun) void function_in_custom_section(void)
{
}
```

## src/test_file2.c
```c
/*
 * Copyright (c) 2012-2014 Wind River Systems, Inc.
 * Copyright (c) 2022, NXP
 *
 * SPDX-License-Identifier: Apache-2.0
 */

#include <zephyr/kernel.h>
#include <zephyr/sys/printk.h>
#include <zephyr/ztest.h>

void function_in_sram(int32_t value)
{
	char src[8] = "data\n";
	char dst[8];

	printk("Hello World! %s\n", CONFIG_BOARD);
	memcpy(dst, src, 8);
	printk("Address of memcpy %p\n\n", &memcpy);
	zassert_mem_equal(src, dst, 8, "memcpy compare error");
}

void function_not_relocated(int32_t value)
{
	char src[8] = "data\n";
	char dst[8];

	printk("Hello World! %s\n", CONFIG_BOARD);
	memcpy(dst, src, 8);
	printk("Address of memcpy %p\n\n", &memcpy);
	zassert_mem_equal(src, dst, 8, "memcpy compare error");
}
```

## src/test_file3.c
```c
/*
 * Copyright (c) 2012-2014 Wind River Systems, Inc.
 *
 * SPDX-License-Identifier: Apache-2.0
 */

#include <zephyr/kernel.h>
#include <zephyr/sys/printk.h>
#include <zephyr/ztest.h>

__in_section(data, sram, var) uint32_t var_file3_sram_data = 10U;
__in_section(bss, sram2, var) uint32_t var_file3_sram2_bss;

ZTEST(code_relocation, test_function_in_split_multiple)
{
	extern uintptr_t __data_start;
	extern uintptr_t __data_end;
	extern uintptr_t __sram2_bss_reloc_start;
	extern uintptr_t __sram2_bss_reloc_end;

	printk("Address of var_file3_sram_data %p\n", &var_file3_sram_data);
	printk("Address of var_file3_sram2_bss %p\n\n", &var_file3_sram2_bss);

	zassert_between_inclusive((uintptr_t)&var_file3_sram_data,
		(uintptr_t)&__data_start,
		(uintptr_t)&__data_end,
		"var_file3_sram_data not in sram_data region");
	zassert_between_inclusive((uintptr_t)&var_file3_sram2_bss,
		(uintptr_t)&__sram2_bss_reloc_start,
		(uintptr_t)&__sram2_bss_reloc_end,
		"var_file3_sram2_bss not in sram2_bss region");
}
```

## src/test_file4.c
```c
/*
 * Copyright (c) 2022, NXP
 *
 * SPDX-License-Identifier: Apache-2.0
 */

#include <zephyr/kernel.h>
#include <zephyr/sys/printk.h>
#include <zephyr/ztest.h>

__in_section(data, sram2, var) uint32_t var_file4_sram2_data = 10U;
__in_section(bss, sram2, var) uint32_t var_file4_sram2_bss;

ZTEST(code_relocation, test_function_genex_relocate_1)
{
	/* Files given as a generator expression are not relocated with LTO */
	Z_TEST_SKIP_IFDEF(CONFIG_LTO);

	extern uintptr_t __sram2_data_reloc_start;
	extern uintptr_t __sram2_data_reloc_end;
	extern uintptr_t __sram2_bss_reloc_start;
	extern uintptr_t __sram2_bss_reloc_end;

	printk("Address of var_file4_sram2_data %p\n", &var_file4_sram2_data);
	printk("Address of var_file4_sram2_bss %p\n\n", &var_file4_sram2_bss);

	zassert_between_inclusive((uintptr_t)&var_file4_sram2_data,
		(uintptr_t)&__sram2_data_reloc_start,
		(uintptr_t)&__sram2_data_reloc_end,
		"var_file4_sram2_data not in sram2_data region");
	zassert_between_inclusive((uintptr_t)&var_file4_sram2_bss,
		(uintptr_t)&__sram2_bss_reloc_start,
		(uintptr_t)&__sram2_bss_reloc_end,
		"var_file4_sram2_bss not in sram2_bss region");
}
```

## src/test_file5.c
```c
/*
 * Copyright (c) 2022, NXP
 *
 * SPDX-License-Identifier: Apache-2.0
 */

#include <zephyr/kernel.h>
#include <zephyr/sys/printk.h>
#include <zephyr/ztest.h>

__in_section(data, sram2, var) uint32_t var_file5_sram2_data = 10U;
__in_section(bss, sram2, var) uint32_t var_file5_sram2_bss;

ZTEST(code_relocation, test_function_genex_relocate_2)
{
	/* Files given as a generator expression are not relocated with LTO */
	Z_TEST_SKIP_IFDEF(CONFIG_LTO);

	extern uintptr_t __sram2_data_reloc_start;
	extern uintptr_t __sram2_data_reloc_end;
	extern uintptr_t __sram2_bss_reloc_start;
	extern uintptr_t __sram2_bss_reloc_end;

	printk("Address of var_file5_sram2_data %p\n", &var_file5_sram2_data);
	printk("Address of var_file5_sram2_bss %p\n\n", &var_file5_sram2_bss);

	zassert_between_inclusive((uintptr_t)&var_file5_sram2_data,
		(uintptr_t)&__sram2_data_reloc_start,
		(uintptr_t)&__sram2_data_reloc_end,
		"var_file5_sram2_data not in sram2_data region");
	zassert_between_inclusive((uintptr_t)&var_file5_sram2_bss,
		(uintptr_t)&__sram2_bss_reloc_start,
		(uintptr_t)&__sram2_bss_reloc_end,
		"var_file5_sram2_bss not in sram2_bss region");
}
```

## src/test_file6.c
```c
/*
 * Copyright (c) 2026 Qualcomm Innovation Center, Inc. All rights reserved.
 *
 * SPDX-License-Identifier: Apache-2.0
 */

#include <zephyr/ztest.h>

#ifdef TEST_RUNTIME_BUILTINS_RELOCATION

extern float __aeabi_fadd(float lhs, float rhs);
extern float __aeabi_fdiv(float lhs, float rhs);
extern float __aeabi_fmul(float lhs, float rhs);

__attribute__((noinline))
static float relocated_float_operation(float lhs, float rhs)
{
	return (lhs * rhs) / (lhs + rhs);
}

ZTEST(code_relocation, test_runtime_builtins_relocation)
{
	extern uintptr_t __sram2_text_reloc_start;
	extern uintptr_t __sram2_text_reloc_end;
	volatile float lhs = 6.0f;
	volatile float rhs = 4.0f;
	volatile float result;

	result = relocated_float_operation(lhs, rhs);
	zassert_equal(result, 2.4f);

	zassert_between_inclusive((uintptr_t)&relocated_float_operation,
		(uintptr_t)&__sram2_text_reloc_start,
		(uintptr_t)&__sram2_text_reloc_end,
		"floating-point caller was not relocated");

	/* Verify that dependencies from the runtime archive were also relocated. */
	zassert_between_inclusive((uintptr_t)&__aeabi_fadd,
		(uintptr_t)&__sram2_text_reloc_start,
		(uintptr_t)&__sram2_text_reloc_end,
		"__aeabi_fadd from the runtime archive was not relocated");
	zassert_between_inclusive((uintptr_t)&__aeabi_fmul,
		(uintptr_t)&__sram2_text_reloc_start,
		(uintptr_t)&__sram2_text_reloc_end,
		"__aeabi_fmul from the runtime archive was not relocated");
	zassert_between_inclusive((uintptr_t)&__aeabi_fdiv,
		(uintptr_t)&__sram2_text_reloc_start,
		(uintptr_t)&__sram2_text_reloc_end,
		"__aeabi_fdiv from the runtime archive was not relocated");
}

#endif /* TEST_RUNTIME_BUILTINS_RELOCATION */
```
