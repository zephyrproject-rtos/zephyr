## tests/application_development/omit_zephyr_stdint/testcase.yaml
```yaml
common:
  tags: toolchain
  build_only: true
  arch_allow:
    - arm
    - arm64
tests:
  buildsystem.app_dev.omit_zephyr_stdint.enabled:
    extra_configs:
      - CONFIG_OMIT_ZEPHYR_STDINT_FOR_APPS=y
    platform_allow:
      - qemu_cortex_m3
      - qemu_cortex_a53
  buildsystem.app_dev.omit_zephyr_stdint.disabled:
    platform_allow:
      - qemu_cortex_m3
      - qemu_cortex_a53
```

## tests/application_development/ram_context_for_isr/Kconfig
```kconfig
# Copyright (c) 2025 Muhmmad Waleed Badar
#
# SPDX-License-Identifier: Apache-2.0

source "Kconfig.zephyr"

config TEST_IRQ_NUM
	int "Test IRQ number"
	default 42 if BOARD_QEMU_CORTEX_M3
	default 14 if GIC
	default 22 if SOC_SERIES_DA1469X
	default 18 if SOC_SERIES_STM32C0X
	default 1 if (SOC_SERIES_NPCX9 || SOC_SERIES_NPCX7 || SOC_SERIES_NPCK3)
	default 29 if SOC_K32L2B31A
	default 0
	help
	  IRQ number to use for testing purposes. This should be an
	  available/unused IRQ on the target platform.

	  Platform-specific defaults:
	  - QEMU Cortex-M3: 42 (available test IRQ)
	  - GIC platforms: 14 (available test SGI - Software Generated Interrupt)
	  - DA1469X series: 22 (available test IRQ)
	  - STM32C0X series: 18 (available test IRQ)
	  - NPCX9, NPCX7, NPCK3 series: 1 (unused IRQ not mapped to MIWU groups)
	  - K32L2B31A: 29 (available test IRQ)
	  - Other platforms: 0 (magic config value to select the last IRQ: NUM_IRQS - 1)

config TEST_IRQ_PRIO
	int "Test IRQ priority"
	default 160 if GIC
	default 1
	help
	  Platform-specific defaults:
	  - GIC platforms: IRQ_DEFAULT_PRIORITY (system default)
	  - Other platforms: 1 (high priority for testing)
```

## tests/application_development/ram_context_for_isr/boards/frdm_mcxw23_mcxw236.conf
```kconfig
# Copyright (c) 2026 NXP
# SPDX-License-Identifier: Apache-2.0

# UTICK0_IRQn = 8, defined by NXP CMSIS and unused in current Zephyr DTS.
# Default TEST_IRQ_NUM resolves to IRQ 60 (CDOG_IRQn) which cannot be
# software-triggered via NVIC_SetPendingIRQ on this platform.
CONFIG_TEST_IRQ_NUM=8
```

## tests/application_development/ram_context_for_isr/boards/nrf54l15dk_nrf54l15_cpuapp.conf
```kconfig
#
# Copyright (c) 2025 Nordic Semiconductor ASA
#
# SPDX-License-Identifier: LicenseRef-Nordic-5-Clause
#
CONFIG_CRACEN_LIB_KMU=n
```

## tests/application_development/ram_context_for_isr/dts/bindings/fakedriver.yml
```yaml
# Copyright (c) 2025 Silicon Laboratories
# SPDX-License-Identifier: Apache-2.0

description: Properties for fake driver.

compatible: "fakedriver"

include: [base.yaml, mutable.yaml]
```

## tests/application_development/ram_context_for_isr/testcase.yaml
```yaml
common:
  tags: linker
  arch_allow: arm
  filter: CONFIG_CPU_CORTEX_M_HAS_VTOR
tests:
  application_development.ram_context_for_isr:
    # Exclude mps3/corstone310 because it uses another mechanism to support relocation
    # of the vector table (CONFIG_ROMSTART_RELOCATION_ROM).
    # (Temporarily) Exclude STM32C0 platforms as last IRQ in vector is always used.
    platform_exclude:
      - mps3/corstone310/an555
      - mps3/corstone310/fvp
      - mps4/corstone315/fvp
      - mps4/corstone320/fvp
      - imx943_evk/mimx94398/m33
      - imx943_evk/mimx94398/m33/ddr
      - frdm_mcxc444/mcxc444
      - frdm_mcxc242/mcxc242
      - frdm_mcxn947/mcxn947/cpu0/qspi
      - hexiwear/mkw40z4
      - frdm_kw41z/mkw41z4
      - frdm_kl25z/mkl25z4
      - stm32c0116_dk/stm32c011xx
      - nucleo_c031c6/stm32c031xx
      - nucleo_c071rb/stm32c071xx
      - nucleo_c092rc/stm32c092xx
```

## tests/application_development/software_bill_of_materials/testcase.yaml
```yaml
common:
  tags:
    - spdx
  integration_platforms:
    - qemu_cortex_m3
  platform_allow:
    - qemu_cortex_m3
  harness: ctest
tests:
  buildsystem.sbom.spdx: {}
```

## tests/application_development/software_bill_of_materials/unused_module/Kconfig
```kconfig
# SPDX-FileCopyrightText: Copyright The Zephyr Project Contributors
# SPDX-License-Identifier: Apache-2.0

config SBOM_UNUSED_MODULE
	bool "Build the sbom_unused_module sources"
	help
	  When enabled, compiles sources from sbom_unused_module. It is left disabled for this test
	  so the source stays out of the build.
```

## tests/application_development/stdthread/testcase.yaml
```yaml
tests:
  application_development.cpp.stdthread:
    platform_whitelist: native_posix native_posix_64
    toolchain_exclude: xcc
    min_flash: 54
    tags: cpp
  application_development.cpp.stdthread.exceptions:
    platform_whitelist: native_posix native_posix_64
    toolchain_exclude: xcc
    min_flash: 54
    tags: cpp
    extra_configs:
        - CONFIG_EXCEPTIONS=y
```

## tests/application_development/vector_table_relocation/testcase.yaml
```yaml
common:
  tags: linker
tests:
  application_development.vector_table_relocation.arm:
    arch_allow: arm
    filter: CONFIG_CPU_CORTEX_M_HAS_VTOR
    # Exclude mps3/corstone310 because it uses another mechanism to support relocation
    # of the vector table (CONFIG_ROMSTART_RELOCATION_ROM).
    platform_exclude:
      - mps3/corstone310/an555
      - mps3/corstone310/fvp
      - mps4/corstone315/fvp
      - mps4/corstone320/fvp

  application_development.vector_table_relocation.dtcm:
    arch_allow: arm
    # Exclude STM32F4 series due to architectural constraints. STM32F4 CCM is only accessible
    # over the D-bus but exception vectors are fetched over the I-bus.
    # As such, the vector table can't be relocated to CCM.
    filter: CONFIG_CPU_CORTEX_M_HAS_VTOR and dt_chosen_enabled("zephyr,dtcm")
            and not CONFIG_SOC_SERIES_STM32F4X
    extra_configs:
      - CONFIG_ARM_VECTOR_TABLE_DTCM=y

  application_development.vector_table_relocation.itcm:
    arch_allow: arm
    filter: CONFIG_CPU_CORTEX_M_HAS_VTOR and dt_chosen_enabled("zephyr,itcm")
    extra_configs:
      - CONFIG_ARM_VECTOR_TABLE_ITCM=y
```

## tests/arch/arc/arc_dsp_sharing/testcase.yaml
```yaml
tests:
  arch.arc.dsp_sharing.test_load_store:
    filter: CONFIG_ISA_ARCV2 and CONFIG_CPU_HAS_DSP
    platform_allow: nsim/nsim_em11d
  arch.arc.dsp_sharing.test_calculation:
    filter: CONFIG_ISA_ARCV2 and CONFIG_CPU_HAS_DSP
    toolchain_allow: arcmwdt
    platform_allow: nsim/nsim_em11d
```

## tests/arch/arc/arc_nocache/testcase.yaml
```yaml
tests:
  arch.arc.nocache:
    filter: CONFIG_NOCACHE_MEMORY and CONFIG_DCACHE
    platform_allow: nsim/nsim_hs/mpuv6
```

## tests/arch/arc/arc_vpx_lock/testcase.yaml
```yaml
tests:
  arch.arc.vpx_lock:
    filter: CONFIG_ISA_ARCV2
    toolchain_allow: arcmwdt
    platform_allow: nsim/nsim_vpx5
  arch.arc.vpx_lock.cpu_mask:
    filter: CONFIG_ISA_ARCV2 and (CONFIG_MP_MAX_NUM_CPUS > 1)
    toolchain_allow: arcmwdt
    platform_allow: nsim/nsim_vpx5
    extra_configs:
      - CONFIG_SCHED_CPU_MASK=y
```

## tests/arch/arc/interrupt-controller/testcase.yaml
```yaml
common:
  filter: CONFIG_SOC_NSIM
  arch_allow: arc
tests:
  arch.arc.interrupt-controller:
    tags: arc interrupt
```

## tests/arch/arm/arm_custom_interrupt/testcase.yaml
```yaml
common:
  filter: CONFIG_ARMV6_M_ARMV8_M_BASELINE or CONFIG_ARMV7_M_ARMV8_M_MAINLINE
  tags:
    - arm
    - interrupt
  ignore_faults: true
  arch_allow: arm
tests:
  arch.arm.custom_interrupt:
    filter: not CONFIG_TRUSTED_EXECUTION_NONSECURE
    platform_exclude:
      - imx95_evk/mimx9596/m7
      - imx95_evk/mimx9596/m7/ddr
      - imx95_evk/mimx9596/m7/flash
```

## tests/arch/arm/arm_hardfault_validation/testcase.yaml
```yaml
tests:
  arch.arm.interrupt.hardfault_validation:
    filter: not CONFIG_TRUSTED_EXECUTION_NONSECURE and CONFIG_ARMV7_M_ARMV8_M_MAINLINE
    arch_allow: arm
    tags: arm
```

## tests/arch/arm/arm_interrupt/testcase.yaml
```yaml
common:
  filter: CONFIG_ARMV6_M_ARMV8_M_BASELINE or CONFIG_ARMV7_M_ARMV8_M_MAINLINE
  tags:
    - arm
    - fpu
    - interrupt
  ignore_faults: true
  arch_allow: arm
tests:
  arch.arm.interrupt:
    filter: not CONFIG_TRUSTED_EXECUTION_NONSECURE
  arch.arm.interrupt.no_optimizations:
    filter: not CONFIG_TRUSTED_EXECUTION_NONSECURE
    extra_configs:
      - CONFIG_NO_OPTIMIZATIONS=y
      - CONFIG_ZTEST_WARN_NO_OPTIMIZATIONS=n
      - CONFIG_IDLE_STACK_SIZE=512
      - CONFIG_MAIN_STACK_SIZE=2048
  arch.arm.interrupt.extra_exception_info:
    filter: not CONFIG_TRUSTED_EXECUTION_NONSECURE
    extra_configs:
      - CONFIG_EXTRA_EXCEPTION_INFO=y
```

## tests/arch/arm/arm_irq_advanced_features/Kconfig
```kconfig
# Copyright (c) 2026 Nordic Semiconductor ASA
# SPDX-License-Identifier: Apache-2.0

config TEST_DIRECT_IRQ_MAX
	int "Max offset of direct IRQ used for the test"
	default NUM_IRQS

source "Kconfig.zephyr"
```

## tests/arch/arm/arm_irq_advanced_features/boards/imx95_evk_mimx9596_m7.conf
```kconfig
# Copyright 2026 NXP
# SPDX-License-Identifier: Apache-2.0
# On imx95_evk/mimx9596/m7, IRQ 233 = IRQSTEER_9_IRQn (interrupt aggregator)
# which cannot be software-triggered. Use IRQ 204 (Reserved220_IRQn) instead.
CONFIG_TEST_DIRECT_IRQ_MAX=205
```

## tests/arch/arm/arm_irq_advanced_features/testcase.yaml
```yaml
common:
  filter: CONFIG_ARMV6_M_ARMV8_M_BASELINE or CONFIG_ARMV7_M_ARMV8_M_MAINLINE
  tags:
    - arm
    - interrupt
  arch_allow: arm
tests:
  arch.arm.irq_advanced_features:
    filter: not CONFIG_TRUSTED_EXECUTION_NONSECURE
    platform_exclude:
      - kit_xmc72_evk/xmc7200d_e272k8384/m7_0
      - kit_xmc72_evk/xmc7200d_e272k8384/m7_1
      - kit_t2g_b_h_lite/cyt4bf8cds/m7_0
      - kit_t2g_b_h_lite/cyt4bf8cds/m7_1
      - kit_t2g_b_h_evk/cyt4bfbche/m7_0
      - kit_t2g_b_h_evk/cyt4bfbche/m7_1
  arch.arm.irq_advanced_features.secure_fw:
    filter: CONFIG_TRUSTED_EXECUTION_SECURE
```

## tests/arch/arm/arm_irq_armv6_zero_latency/testcase.yaml
```yaml
common:
  filter: CONFIG_CPU_CORTEX_M0 or CONFIG_CPU_CORTEX_M0PLUS or CONFIG_CPU_CORTEX_M1
  tags: armv6-m zero latency interrupt
  arch_allow: arm
tests:
  arch.arm.interrupt.irq_armv6_zero_latency:
    filter: not CONFIG_TRUSTED_EXECUTION_NONSECURE
```

## tests/arch/arm/arm_irq_vector_table/Kconfig
```kconfig
# SPDX-License-Identifier: Apache-2.0

config NUM_IRQS
	int "Number of IRQs for this test, made overridable in the .conf file"
	default 3

config ISR_OFFSET
	int "isr offset from vector table"
	default 0

source "Kconfig.zephyr"
```

## tests/arch/arm/arm_irq_vector_table/boards/apollo510_evb.conf
```kconfig
 # start of software interrupt number
CONFIG_ISR_OFFSET=92
CONFIG_UART_INTERRUPT_DRIVEN=n
```
