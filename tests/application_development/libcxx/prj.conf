## prj.conf
```kconfig
CONFIG_NEWLIB_LIBC=y
CONFIG_CPLUSPLUS=y
CONFIG_LIB_CPLUSPLUS=y
CONFIG_STD_CPP17=y
CONFIG_ZTEST=y
CONFIG_ZTEST_STACKSIZE=4096
CONFIG_MAIN_STACK_SIZE=2048
CONFIG_EXCEPTIONS=y
CONFIG_NEWLIB_LIBC_NANO=n
```

## src/main.cpp
```c
/*
 * Copyright (c) 2019 Nordic Semiconductor ASA
 *
 * SPDX-License-Identifier: Apache-2.0
 */

#include <ztest.h>

BUILD_ASSERT(__cplusplus == 201703);

extern void test_array(void);
extern void test_make_unique(void);
extern void test_vector(void);

void test_main(void)
{
	TC_PRINT("version %u\n", (uint32_t)__cplusplus);
	ztest_test_suite(libcxx_tests,
			 ztest_unit_test(test_array),
			 ztest_unit_test(test_vector),
			 ztest_unit_test(test_make_unique)
		);

	ztest_run_test_suite(libcxx_tests);
}
```
