## tests/power/multicore/lmt/testcase.yaml
```yaml
tests:
  test:
    platform_whitelist: quark_se_c1000_devboard
    extra_args: TEST_CASE=sleep-success
    tags: powermanagement
```

## tests/power/power_states/testcase.yaml
```yaml
tests:
  power_management.power_states:
    filter: (CONFIG_SOC_QUARK_SE_C1000 or CONFIG_SOC_QUARK_SE_C1000_SS)
    platform_exclude: tinytile arduino_101 arduino_101_sss
    tags: power
    depends_on: rtc
```

## tests/pytest/pytest_sample/testcase.yaml
```yaml
tests:
  pytest.sample:
    platform_allow: qemu_x86 qemu_x86_64
    harness: pytest
```

## tests/samples/subsys/factory_data/testcase.yaml
```yaml
tests:
  samples.factory_data:
    platform_allow: >
      native_posix
      native_posix_64
    tags: factory_data
```

## tests/stress_tests/mutex_stress/testcase.yaml
```yaml
tests:
  stress.mutex:
    tags: stress
    # With multiple CPUs, it's eaiser to reproduce issues.
    filter: (CONFIG_MP_NUM_CPUS > 1)
    slow: true
```

## tests/subsys/app_event_manager/testcase.yaml
```yaml
tests:
  app_event_manager.core:
    integration_platforms:
      - nrf51dk_nrf51422
      - nrf52dk_nrf52832
      - nrf52840dk_nrf52840
      - nrf9160dk_nrf9160_ns
      - qemu_cortex_m3
    tags: app_event_manager
  app_event_manager.size_enabled:
    extra_args: OVERLAY_CONFIG=overlay-event_size.conf
    integration_platforms:
      - nrf51dk_nrf51422
      - nrf52dk_nrf52832
      - nrf52840dk_nrf52840
      - nrf9160dk_nrf9160_ns
      - qemu_cortex_m3
    tags: app_event_manager
```

## tests/subsys/bindesc/definition/testcase.yaml
```yaml
common:
  platform_allow:
    - native_sim
  integration_platforms:
    - native_sim
  tags: bindesc
tests:
  bindesc.define:
    platform_allow:
      - native_sim
      - qemu_x86
      - qemu_cortex_m0
      - qemu_cortex_m3
      - qemu_cortex_r5
      - qemu_arc/qemu_arc_em
      - qemu_arc/qemu_arc_hs
      - qemu_arc/qemu_arc_hs5x
      - qemu_arc/qemu_arc_hs6x
      - qemu_riscv32
      - qemu_riscv32e
      - qemu_riscv64
  bindesc.define.c99:
    extra_configs:
      - CONFIG_STD_C99=y
  bindesc.define.c11:
    extra_configs:
      - CONFIG_STD_C11=y
  bindesc.define.c17:
    extra_configs:
      - CONFIG_STD_C17=y
  bindesc.define.gnu99:
    extra_configs:
      - CONFIG_STD_C99=y
      - CONFIG_GNU_C_EXTENSIONS=y
  bindesc.define.gnu11:
    extra_configs:
      - CONFIG_STD_C11=y
      - CONFIG_GNU_C_EXTENSIONS=y
  bindesc.define.gnu17:
    extra_configs:
      - CONFIG_STD_C17=y
      - CONFIG_GNU_C_EXTENSIONS=y
```

## tests/subsys/bindesc/reading/testcase.yaml
```yaml
common:
  platform_allow:
    - native_sim
  integration_platforms:
    - native_sim
  tags: bindesc
tests:
  bindesc.read:
    platform_allow:
      - native_sim
  bindesc.read.c17:
    extra_configs:
      - CONFIG_STD_C17=y
  bindesc.read.gnu17:
    extra_configs:
      - CONFIG_STD_C17=y
      - CONFIG_GNU_C_EXTENSIONS=y
```

## tests/subsys/boot_info/boards/native_posix.conf
```kconfig
# Copyright (c) 2023 Laczen
# SPDX-License-Identifier: Apache-2.0
CONFIG_BBRAM=y
CONFIG_BBRAM_EMUL=y
```

## tests/subsys/boot_info/boards/nrf52dk_nrf52832.conf
```kconfig
# Copyright (c) 2023 Laczen
# SPDX-License-Identifier: Apache-2.0
CONFIG_MULTITHREADING=y
CONFIG_RETAINED_MEM=y
CONFIG_ZTEST_STACK_SIZE=8192
```

## tests/subsys/boot_info/boards/nucleo_f411re.conf
```kconfig
# Copyright (c) 2023 Laczen
# SPDX-License-Identifier: Apache-2.0
CONFIG_BBRAM=y
CONFIG_COUNTER=y
CONFIG_BBRAM_STM32=y
```

## tests/subsys/boot_info/boards/qemu_cortex_m3.conf
```kconfig
# Copyright (c) 2023 Laczen
# SPDX-License-Identifier: Apache-2.0
CONFIG_USERSPACE=y
```

## tests/subsys/boot_info/boards/qemu_x86.conf
```kconfig
# Copyright (c) 2023 Laczen
# SPDX-License-Identifier: Apache-2.0
CONFIG_ZTEST=y
CONFIG_ZTEST_NEW_API=y
CONFIG_ZTEST_STACK_SIZE=8192
CONFIG_EEPROM=y
CONFIG_EEPROM_SIMULATOR=y
```

## tests/subsys/boot_info/testcase.yaml
```yaml
common:
  depends_on: boot_info
  tags: boot_info
  platform_allow:
    - qemu_cortex_m3
    - qemu_x86
    - native_posix
    - nucleo_f411re
tests:
  boot_info.cortex_m3.api:
    platform_allow: qemu_cortex_m3
    timeout: 60
  boot_info.qemu_x86.api:
    platform_allow: qemu_x86
    timeout: 60
```

## tests/subsys/can/frame/testcase.yaml
```yaml
common:
  platform_whitelist: native_posix qemu_x86 qemu_cortex_m3
tests:
  can.frame:
    tags: net
```

## tests/subsys/canbus/frame/testcase.yaml
```yaml
common:
  platform_allow: native_posix native_posix_64 qemu_x86 qemu_cortex_m3 qemu_leon3 qemu_riscv32 qemu_riscv64
tests:
  can.frame:
    tags: net
```

## tests/subsys/canbus/isotp/conformance/Kconfig
```kconfig
# SPDX-License-Identifier: Apache-2.0

config TEST_USE_CAN_FD_MODE
	bool "Use CAN-FD"
	select CAN_FD_MODE

config TEST_ISOTP_TX_DL
	int "TX_DL to be used"
	default 8
	help
	  ISO-TP TX_DL value.
	  Valid values are 8, 12, 16, 20, 24, 32, 48 and 64.

source "Kconfig.zephyr"
```

## tests/subsys/canbus/isotp/conformance/testcase.yaml
```yaml
#
# There are 4 different test cases that have to be considered:
#
# | Case # | Controller type        | Selected mode        |  Example board |
# +--------+------------------------+----------------------+----------------+
# |    1   | Classical CAN only     | CONFIG_CAN_FD_MODE=n | nucleo_f072    |
# |    2   | Classical CAN only     | CONFIG_CAN_FD_MODE=y | nucleo_f072    |
# |    3   | Classical CAN + CAN FD | CONFIG_CAN_FD_MODE=n | native_sim     |
# |    4   | Classical CAN + CAN FD | CONFIG_CAN_FD_MODE=y | native_sim     |
#
# The test-specific CONFIG_TEST_USE_CAN_FD_MODE is used to decide if the test should use
# CAN FD independent of CONFIG_CAN_FD_MODE configuration.
#

common:
  platform_exclude:
    - mimxrt1180_evk/mimxrt1189/cm33
    - mimxrt1180_evk/mimxrt1189/cm7
tests:
  # cases 1, 3
  canbus.isotp.conformance:
    tags:
      - can
      - isotp
    depends_on: can
    filter: dt_chosen_enabled("zephyr,canbus") and not dt_compat_enabled("kvaser,pcican")
  # case 2
  canbus.isotp.conformance.fd.unused:
    tags:
      - can
      - isotp
    extra_configs:
      - CONFIG_TEST_USE_CAN_FD_MODE=n
      - CONFIG_CAN_FD_MODE=y
    depends_on: can
    filter: dt_chosen_enabled("zephyr,canbus") and not dt_compat_enabled("kvaser,pcican")
  # case 4
  canbus.isotp.conformance.fd.txdl_32:
    tags:
      - can
      - isotp
    extra_configs:
      - CONFIG_TEST_USE_CAN_FD_MODE=y
      - CONFIG_TEST_ISOTP_TX_DL=32
      - CONFIG_CAN_FD_MODE=y
    depends_on: can
    filter: dt_chosen_enabled("zephyr,canbus") and not dt_compat_enabled("kvaser,pcican")
  # case 4
  canbus.isotp.conformance.fd.txdl_64:
    tags:
      - can
      - isotp
    extra_configs:
      - CONFIG_TEST_USE_CAN_FD_MODE=y
      - CONFIG_TEST_ISOTP_TX_DL=64
      - CONFIG_CAN_FD_MODE=y
    depends_on: can
    filter: dt_chosen_enabled("zephyr,canbus") and not dt_compat_enabled("kvaser,pcican")
```

## tests/subsys/canbus/isotp/implementation/testcase.yaml
```yaml
tests:
  canbus.isotp.implementation:
    tags:
      - can
      - isotp
    depends_on: can
    filter: dt_chosen_enabled("zephyr,canbus") and not dt_compat_enabled("kvaser,pcican")
      and not dt_compat_enabled("xlnx,canfd-2.0")
```

## tests/subsys/cpp/cxx/testcase.yaml
```yaml
tests:
  cpp.main:
    integration_platforms:
      - mps2_an385
    tags: cpp
    toolchain_exclude: xcc
```

## tests/subsys/cpp/libcxx/testcase.yaml
```yaml
tests:
  cpp.libcxx.newlib:
    filter: TOOLCHAIN_HAS_NEWLIB == 1
    toolchain_exclude: xcc
    min_flash: 54
    min_ram: 24
    tags: cpp
    extra_configs:
      - CONFIG_NEWLIB_LIBC=y
      - CONFIG_NEWLIB_LIBC_NANO=n
      - CONFIG_EXCEPTIONS=y
    integration_platforms:
      - mps2_an385
  cpp.libcxx.newlib_nano:
    filter: TOOLCHAIN_HAS_NEWLIB == 1
    toolchain_exclude: xcc
    min_flash: 54
    tags: cpp
    timeout: 60
    extra_configs:
      - CONFIG_NEWLIB_LIBC=y
      - CONFIG_NEWLIB_LIBC_NANO=y
    integration_platforms:
      - mps2_an385
  cpp.libcxx.arcmwdtlib:
    toolchain_allow: arcmwdt
    platform_allow: nsim_hs nsim_em
    min_flash: 54
    tags: cpp
    extra_configs:
      - CONFIG_ARCMWDT_LIBC=y
```

## tests/subsys/cpu_freq/cpu_freq_soc/boards/frdm_mcxn236.conf
```kconfig
#Copyright 2025 NXP
#SPDX-License-Identifier: Apache-2.0

CONFIG_CPU_FREQ_PSTATE_SET_SOC=y
CONFIG_CPU_FREQ_POLICY_ON_DEMAND=n
CONFIG_CPU_FREQ_INTERVAL_MS=1000000
```

## tests/subsys/cpu_freq/cpu_freq_soc/testcase.yaml
```yaml
common:
  tags: cpu_freq

tests:
  # Use the SoC version of cpu_freq_pstate_set()
  subsys.cpu_freq.soc:
    platform_allow:
      - native_sim
      - native_sim/native/64
    integration_platforms:
      - native_sim
      - native_sim/native/64

  # Use the stub version of cpu_freq_pstate_set()
  subsys.cpu_freq.stub:
    extra_dtc_overlay_files:
      - pstate-stub.overlay
    platform_allow:
      - qemu_cortex_a53/qemu_cortex_a53/smp
    integration_platforms:
      - qemu_cortex_a53/qemu_cortex_a53/smp
    extra_configs:
      - CONFIG_CPU_FREQ_PSTATE_SET_STUB=y
```
