/*
 * Copyright (c) 2025 Microchip Technology Inc.
 *
 * SPDX-License-Identifier: Apache-2.0
 */

/* Microchip MEC use its 32 KHz based RTOS timer by default.
 * Allow the test to build by switching to Cortex-M4 SysTick.
 */

&rtimer {
	status = "disabled";
};

&systick {
	status = "okay";
};
