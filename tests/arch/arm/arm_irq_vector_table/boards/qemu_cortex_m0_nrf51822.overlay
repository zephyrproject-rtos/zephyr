/ {
	chosen {
		/* The test is setting up a custom interrupt table which only allows a very
		 * limited number of platform IRQs and that is not the "standard" table generated
		 * by CONFIG_GEN_ISR_TABLES. The problem is that NRF5 entropy driver would enable
		 * an IRQ which is not in this list, therefore causing a runtime crash in the
		 * test. As a consequence we need to disable this driver.
		 */
		/delete-property/ zephyr,entropy;
	};
};
