## tests/arch/arm/arm_irq_vector_table/boards/mimxrt1170_evk_mimxrt1176_cm4.conf
```kconfig
# Copyright 2025 NXP
# SPDX-License-Identifier: Apache-2.0
CONFIG_ISR_OFFSET=4
CONFIG_NUM_IRQS=7
```

## tests/arch/arm/arm_irq_vector_table/boards/nrf54h20dk_nrf54h20_cpuapp.conf
```kconfig
# Copyright (c) 2025 Nordic Semiconductor
# SPDX-License-Identifier: Apache-2.0

CONFIG_POWER_DOMAIN=n
```

## tests/arch/arm/arm_irq_zero_latency_levels/testcase.yaml
```yaml
common:
  filter: (CONFIG_ARMV6_M_ARMV8_M_BASELINE or CONFIG_ARMV7_M_ARMV8_M_MAINLINE) and
    not CONFIG_SOC_FAMILY_NORDIC_NRF
  tags:
    - arm
    - interrupt
  arch_allow: arm
tests:
  arch.arm.irq_zero_latency_levels:
    filter: not CONFIG_TRUSTED_EXECUTION_NONSECURE
    integration_platforms:
      - mps2/an521/cpu1
    platform_exclude:
      - kit_xmc72_evk/xmc7200d_e272k8384/m7_0
      - kit_xmc72_evk/xmc7200d_e272k8384/m7_1
      - kit_t2g_b_h_lite/cyt4bf8cds/m7_0
      - kit_t2g_b_h_lite/cyt4bf8cds/m7_1
      - kit_t2g_b_h_evk/cyt4bfbche/m7_0
      - kit_t2g_b_h_evk/cyt4bfbche/m7_1
  arch.arm.irq_zero_latency_levels.secure_fw:
    filter: CONFIG_TRUSTED_EXECUTION_SECURE
    integration_platforms:
      - mps2/an521/cpu0
```

## tests/arch/arm/arm_mem_protect/testcase.yaml
```yaml
tests:
  arch.arm.mem_protect.syscalls:
    arch_allow: arm
    filter: CONFIG_CPU_CORTEX_R and CONFIG_ARCH_HAS_USERSPACE
    tags: arm userspace
```

## tests/arch/arm/arm_mpu_pxn/testcase.yaml
```yaml
common:
  filter: CONFIG_ARM_MPU_PXN
  tags:
    - arm
    - mpu
  platform_allow:
    - mps3/corstone300/an547
    - mps3/corstone300/fvp
    - mps3/corstone310/fvp
tests:
  # To verify that region marked with PXN attribute can be executed from unprivileged code
  # and cannot be executed from privileged code
  arch.arm.pxn_with_userspace:
    extra_configs:
      - CONFIG_USERSPACE=y
  # To verify that region marked *without* PXN attribute can be executed from privileged code
  arch.arm.pxn_without_userspace:
    extra_configs:
      - CONFIG_USERSPACE=n
```

## tests/arch/arm/arm_mpu_regions/testcase.yaml
```yaml
tests:
  arch.mpu_regions.arm:
    platform_allow: mps2_an385
    tags: sram mpu
```

## tests/arch/arm/arm_mpu_wt/testcase.yaml
```yaml
tests:
  arch.arm.mpu.write_through:
    tags:
      - arm
      - mpu
      - cache
      - dma
    arch_allow:
      - arm
    filter: CONFIG_ARM_MPU and dt_alias_exists("test-dma")
    integration_platforms:
      - mimxrt1180_evk/mimxrt1189/cm33
      - mimxrt1180_evk/mimxrt1189/cm7
    extra_configs:
      - CONFIG_ARM_MPU_SRAM_WRITE_THROUGH=y
```

## tests/arch/arm/arm_no_multithreading/boards/bt510.conf
```kconfig
# SPDX-License-Identifier: Apache-2.0

# Enable I2C only with no drivers for single threaded operation
CONFIG_SENSOR=n
CONFIG_LIS2DH=n
CONFIG_LIS2DH_TRIGGER_GLOBAL_THREAD=n
CONFIG_LIS2DH_OPER_MODE_LOW_POWER=n
CONFIG_SI7055=n
```

## tests/arch/arm/arm_no_multithreading/testcase.yaml
```yaml
common:
  filter: CONFIG_ARMV6_M_ARMV8_M_BASELINE or CONFIG_ARMV7_M_ARMV8_M_MAINLINE
  tags: arm
  arch_allow: arm
tests:
  arch.arm.no-mt:
    filter: not CONFIG_TRUSTED_EXECUTION_NONSECURE
    platform_allow:
      - qemu_cortex_m0
      - qemu_cortex_m3
      - mps2/an385
      - mps2/an521/cpu0
      - mps3/corstone300/an547
      - nrf52840dk/nrf52840
      - nrf9160dk/nrf9160
      - nrf51dk/nrf51822
      - xg29_rb4412a
    integration_platforms:
      - qemu_cortex_m0
```

## tests/arch/arm/arm_pacbti/testcase.yaml
```yaml
common:
  tags:
    - arm
  platform_allow:
    - mps3/corstone310/fvp
    - mps3/corstone310/fvp/ns
    - mps4/corstone315/fvp
    - mps4/corstone320/fvp
tests:
  arch.arm.pacbti.standard:
    # TODO: remove skip after Zephyr sdk makes GCC 14.3 as default
    skip: true
    extra_configs:
      - CONFIG_ARM_PACBTI_STANDARD=y
      - CONFIG_ARM_PAC_PER_THREAD=y
      - CONFIG_USERSPACE=y
```

## tests/arch/arm/arm_ramfunc/testcase.yaml
```yaml
tests:
  arch.arm.ramfunc:
    filter: CONFIG_ARCH_HAS_RAMFUNC_SUPPORT
    tags: arm userspace
    arch_allow: arm
    extra_configs:
      - CONFIG_PICOLIBC_HEAP_SIZE=0
```

## tests/arch/arm/arm_runtime_nmi/testcase.yaml
```yaml
tests:
  arch.interrupt.arm.nmi:
    filter: CONFIG_ARMV6_M_ARMV8_M_BASELINE or CONFIG_ARMV7_M_ARMV8_M_MAINLINE and not CONFIG_BUILD_WITH_TFM
    arch_allow: arm
    tags: nmi interrupt arm
```

## tests/arch/arm/arm_sw_vector_relay/testcase.yaml
```yaml
tests:
  arch.arm.sw_vector_relay:
    filter: CONFIG_ARMV6_M_ARMV8_M_BASELINE or CONFIG_ARMV7_M_ARMV8_M_MAINLINE
    tags: arm
    arch_whitelist: arm
```

## tests/arch/arm/arm_switch/testcase.yaml
```yaml
tests:
  arch.arm.switch:
    arch_allow: arm
    platform_allow:
      - qemu_cortex_m3
      - mps2/an385
      - mps2/an386
      - mps2/an521/cpu0
      - mps2/an521/cpu1
      - mps3/corstone300/fvp
      - mps3/corstone310/fvp
      - mps4/corstone320/fvp
    filter: CONFIG_CPU_CORTEX_M and CONFIG_USE_SWITCH
    tags:
      - arm
```

## tests/arch/arm/arm_thread_swap/testcase.yaml
```yaml
common:
  filter: CONFIG_ARMV6_M_ARMV8_M_BASELINE or CONFIG_ARMV7_M_ARMV8_M_MAINLINE
  tags: arm
  arch_allow: arm
tests:
  arch.arm.swap.common:
    filter: not CONFIG_TRUSTED_EXECUTION_NONSECURE
  arch.arm.swap.common.no_optimizations:
    filter: not CONFIG_TRUSTED_EXECUTION_NONSECURE
    extra_configs:
      - CONFIG_NO_OPTIMIZATIONS=y
      - CONFIG_IDLE_STACK_SIZE=512
    min_flash: 192
  arch.arm.swap.common.fpu_sharing:
    filter: not CONFIG_TRUSTED_EXECUTION_NONSECURE and CONFIG_ARMV7_M_ARMV8_M_FP
    extra_configs:
      - CONFIG_FPU=y
      - CONFIG_FPU_SHARING=y
  arch.arm.swap.common.fpu_sharing.no_optimizations:
    filter: not CONFIG_TRUSTED_EXECUTION_NONSECURE and CONFIG_ARMV7_M_ARMV8_M_FP
    extra_configs:
      - CONFIG_FPU=y
      - CONFIG_FPU_SHARING=y
      - CONFIG_NO_OPTIMIZATIONS=y
      - CONFIG_IDLE_STACK_SIZE=512
    min_flash: 192
```

## tests/arch/arm/arm_thread_swap_tz/Kconfig
```kconfig
# SPDX-License-Identifier: Apache-2.0
# Copyright (c) 2021 Nordic Semiconductor ASA

config ARM_STORE_EXC_RETURN
	bool
	default y if ARM_NONSECURE_FIRMWARE
	help
	  Redefine this with looser requirements, so the EXC_RETURN value can
	  be checked in the test. This essentially tests that the official
	  requirements are sane.

source "Kconfig.zephyr"
```

## tests/arch/arm/arm_thread_swap_tz/testcase.yaml
```yaml
common:
  filter: (CONFIG_TFM_BOARD != "") and CONFIG_ARM_NONSECURE_FIRMWARE
  tags: arm fpu tfm
  arch_allow: arm
tests:
  arch.arm.swap.tz:
    # NOTE: this platform disables FPU access in TFM.
    platform_exclude: mps3_an547_ns nucleo_l552ze_q_ns
  arch.arm.swap.tz_off:
    extra_configs:
      - CONFIG_ARM_NONSECURE_PREEMPTIBLE_SECURE_CALLS=n
    # NOTE: this platform disables FPU access in TFM.
    platform_exclude: mps3_an547_ns nucleo_l552ze_q_ns
```

## tests/arch/arm/arm_tz_wrap_func/boards/ek_ra4m2.conf
```kconfig
# Copyright (c) 2025 Vincent Jardin, Free Mobile
# SPDX-License-Identifier: Apache-2.0

# TrustZone configuration for EK-RA4M2
CONFIG_ARM_TRUSTZONE_M=y
```

## tests/arch/arm/arm_tz_wrap_func/testcase.yaml
```yaml
tests:
  arch.arm.tz_wrap_func:
    arch_allow: arm
    tags:
      - arm
      - tz_ns
      - tz_wrap_func
    filter: CONFIG_CPU_CORTEX_M
    integration_platforms:
      - mps2/an385
```

## tests/arch/arm/arm_user_stack_test/testcase.yaml
```yaml
common:
  tags:
    - arm
  timeout: 120
  # TODO: remove the platform_exclude once the MPS2 issue is fixed
  # (this seems to be an issue with QEMU as these tests pass in FVP)
  platform_exclude:
    - mps2/an385
    - mps2/an386
tests:
  arch.arm.user.stack:
    filter: CONFIG_CPU_CORTEX_M
    extra_configs:
      - CONFIG_USERSPACE=y
  arch.arm.user.stack.float:
    filter: CONFIG_CPU_CORTEX_M and CONFIG_CPU_HAS_FPU
    extra_configs:
      - CONFIG_USERSPACE=y
      - CONFIG_FPU=y
      - CONFIG_FPU_SHARING=y
```
