/*
 * Copyright (c) 2025 Silicon Laboratories Inc.
 *
 * SPDX-License-Identifier: Apache-2.0
 */

/ {
	#address-cells = <1>;
	#size-cells = <1>;

	fakedriver: fakedriver@e0000000 {
		compatible = "fakedriver";
		reg = <0xe0000000 0x2000>;
		zephyr,mutable;
		status = "okay";
	};
};
