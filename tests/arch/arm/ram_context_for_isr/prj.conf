## Kconfig
```
# Copyright (c) 2025 Muhmmad Waleed Badar
#
# SPDX-License-Identifier: Apache-2.0

source "Kconfig.zephyr"

config TEST_IRQ_NUM
	int "Test IRQ number"
	depends on !TEST_FIND_FREE_IRQ
	help
	  IRQ number to use for testing purposes. This should be an
	  available/unused IRQ on the target platform.

config TEST_IRQ_PRIO
	int "Test IRQ priority"
	default 1
	help
	  Platform-specific defaults:
	  - GIC platforms: IRQ_DEFAULT_PRIORITY (system default)
	  - Other platforms: 1 (high priority for testing)

config TEST_FIND_FREE_IRQ
	bool "Find a free IRQ during test initialization"
	default y
	depends on CPU_CORTEX_M
	help
	  Test environment can find a free IRQ to run the tests. Platforms willing to
	  use a specific IRQ for this test should have this configuration disabled
	  and set the target IRQ number in TEST_IRQ_NUM.

	  This option is available only on Cortex-M based platforms.
```

## prj.conf
```kconfig
CONFIG_COVERAGE=n
CONFIG_ZTEST=y
CONFIG_SRAM_VECTOR_TABLE=y
CONFIG_SRAM_SW_ISR_TABLE=y
CONFIG_CODE_DATA_RELOCATION_SRAM=y
CONFIG_DEVICE_MUTABLE=y
CONFIG_TRACING_ISR=n
CONFIG_STACK_SENTINEL=n
CONFIG_DYNAMIC_INTERRUPTS=y
CONFIG_PM=n
```

## app.overlay
```dts
/*
 * Copyright (c) 2025 Silicon Laboratories Inc.
 *
 * SPDX-License-Identifier: Apache-2.0
 */

/ {
	#address-cells = <1>;
	#size-cells = <1>;

	fakedriver: fakedriver@e0000000 {
		compatible = "fakedriver";
		reg = <0xe0000000 0x2000>;
		zephyr,mutable;
		status = "okay";
	};
};
```

## src/main.c
```c
/*
 * Copyright (c) 2025 Silicon Laboratories Inc.
 *
 * SPDX-License-Identifier: Apache-2.0
 */

/**
 * @file
 * @brief Test for driver relocation to RAM for ISRs
 *
 * This test demonstrates how to use the fake_driver and verify
 * that the callback are properly relocated to RAM.
 */

#if !defined(CONFIG_CPU_CORTEX_M)
#error project can only run on Cortex-M for now
#endif

#include <zephyr/ztest.h>
#include "fake_driver.h"

static volatile bool test_flag;

static void test_irq_callback(const struct device *dev, void *user_data)
{
	uintptr_t func_addr = (uintptr_t)test_irq_callback;
	uintptr_t driver_isr_addr, arch_isr_wrapper_addr;

	test_flag = true;

	/* Retrieve the caller address (the arch specific isr wrapper since driver isr will be
	 * optimized by the compiler)
	 */
	__asm__ volatile("mov %0, lr" : "=r"(arch_isr_wrapper_addr));

	/* retrieve the fake_driver_isr function address that was stored in user_data */
	driver_isr_addr = (uintptr_t)user_data;

	/* Check that the function and its call stack are in RAM */
	zassert_true(func_addr >= DT_CHOSEN_SRAM_ADDR &&
			     func_addr <= DT_CHOSEN_SRAM_ADDR + DT_CHOSEN_SRAM_SIZE,
		     "%s is not in RAM! Address: 0x%lx", __func__, func_addr);

	zassert_true(driver_isr_addr >= DT_CHOSEN_SRAM_ADDR &&
			     driver_isr_addr <= DT_CHOSEN_SRAM_ADDR + DT_CHOSEN_SRAM_SIZE,
		     "fake_driver_isr is not in RAM! Address: 0x%lx", driver_isr_addr);

	zassert_true(arch_isr_wrapper_addr >= DT_CHOSEN_SRAM_ADDR &&
			     arch_isr_wrapper_addr <=
				     DT_CHOSEN_SRAM_ADDR + DT_CHOSEN_SRAM_SIZE,
		     "arch_isr_wrapper_addr is not in RAM! Address: 0x%lx", arch_isr_wrapper_addr);

	TC_PRINT("Callback function address: 0x%lx\n", func_addr);
	TC_PRINT("Driver ISR address: 0x%lx\n", driver_isr_addr);
	TC_PRINT("Arch ISR wrapper address: 0x%lx\n", arch_isr_wrapper_addr);
}

ZTEST(ram_context_for_isr, test_fake_driver_in_ram)
{
	const struct device *dev = DEVICE_DT_GET(DT_NODELABEL(fakedriver));
	const struct fake_driver_api *api = DEVICE_API_GET(fake, dev);
	struct fake_driver_data *data = dev->data;
	uintptr_t dev_addr = (uintptr_t)dev;

	zassert_true(dev_addr >= DT_CHOSEN_SRAM_ADDR &&
			     dev_addr <= DT_CHOSEN_SRAM_ADDR + DT_CHOSEN_SRAM_SIZE,
		     "fake driver device is not in RAM! Address: 0x%lx", dev_addr);

	TC_PRINT("Fake driver device address: 0x%lx\n", dev_addr);
	TC_PRINT("Fake driver device interrupt: %u\n", data->irq_num);

	zassert_not_null(api, "Failed to get fake driver API");

	api->register_irq_callback(dev, test_irq_callback, NULL);
	test_flag = false;

	NVIC_SetPendingIRQ(data->irq_num);

	k_busy_wait(1000);

	zassert_true(test_flag, "ISR callback was not called");
}

ZTEST_SUITE(ram_context_for_isr, NULL, NULL, NULL, NULL, NULL);
```

## include/fake_driver.h
```c
/*
 * Copyright (c) 2025 Silicon Laboratories Inc.
 *
 * SPDX-License-Identifier: Apache-2.0
 */

#ifndef ZEPHYR_INCLUDE_DRIVERS_FAKE_DRIVER_H_
#define ZEPHYR_INCLUDE_DRIVERS_FAKE_DRIVER_H_

#ifdef __cplusplus
extern "C" {
#endif

typedef void (*fake_driver_irq_callback_t)(const struct device *dev, void *user_data);

struct fake_driver_data {
	fake_driver_irq_callback_t irq_callback;
	void *user_data;
	uint16_t irq_num;
};

__subsystem struct fake_driver_api {
	int (*register_irq_callback)(const struct device *dev, fake_driver_irq_callback_t cb,
				     void *user_data);
};

#ifdef __cplusplus
}
#endif

#endif /* ZEPHYR_INCLUDE_DRIVERS_FAKE_DRIVER_H_ */
```

## src/fake_driver.c
```c
/*
 * Copyright (c) 2025 Silicon Laboratories Inc.
 *
 * SPDX-License-Identifier: Apache-2.0
 */

#include <cmsis_core.h>
#include <zephyr/device.h>
#include <zephyr/irq.h>
#include <zephyr/ztest.h>
#include <zephyr/interrupt_util.h>
#include "fake_driver.h"

#define DT_DRV_COMPAT fakedriver

static void fake_driver_isr(const void *arg)
{
	const struct device *dev = (const struct device *)arg;
	struct fake_driver_data *data = dev->data;

	/* Store the address of fake_driver_isr in user_data because it will be optimized by the
	 * compiler (even with __noinline__ attribute)
	 */
	data->user_data = (void *)&fake_driver_isr;

	if (data->irq_callback != NULL) {
		data->irq_callback(dev, data->user_data);
	}
}

#ifdef CONFIG_TEST_FIND_FREE_IRQ
/* Scan NVIC for a free IRQ */

#if CONFIG_2ND_LVL_ISR_TBL_OFFSET > 0
#define TEST_1ST_LEVEL_INTERRUPTS_MAX (CONFIG_2ND_LVL_ISR_TBL_OFFSET - 1)
#else
#define TEST_1ST_LEVEL_INTERRUPTS_MAX (CONFIG_NUM_IRQS - 1)
#endif

static unsigned int get_test_irq(void)
{
	return get_available_nvic_line(TEST_1ST_LEVEL_INTERRUPTS_MAX);
}
#else /* CONFIG_TEST_FIND_FREE_IRQ */
static unsigned int get_test_irq(void)
{
	return CONFIG_TEST_IRQ_NUM;
}
#endif /* CONFIG_TEST_FIND_FREE_IRQ */

static int fake_driver_register_irq_callback(const struct device *dev,
					     fake_driver_irq_callback_t cb, void *user_data)
{
	struct fake_driver_data *data = dev->data;

	data->irq_callback = cb;
	data->user_data = user_data;

	return 0;
}

DEVICE_API(fake, fake_driver_func) = {
	.register_irq_callback = fake_driver_register_irq_callback,
};

static int fake_driver_init(const struct device *dev)
{
	struct fake_driver_data *data = dev->data;

	data->irq_num = get_test_irq();
	data->irq_callback = NULL;
	data->user_data = NULL;

	(void)irq_connect_dynamic(data->irq_num, CONFIG_TEST_IRQ_PRIO, fake_driver_isr, dev, 0);
	irq_enable(data->irq_num);

	return 0;
}

#define FAKE_INIT(inst)                                                                            \
	static struct fake_driver_data fake_driver_data_##inst;                                    \
	                                                                                           \
	DEVICE_DT_INST_DEFINE(inst, &fake_driver_init, NULL, &fake_driver_data_##inst, NULL,       \
			      PRE_KERNEL_1, CONFIG_KERNEL_INIT_PRIORITY_DEFAULT, &fake_driver_func);

DT_INST_FOREACH_STATUS_OKAY(FAKE_INIT)
```
