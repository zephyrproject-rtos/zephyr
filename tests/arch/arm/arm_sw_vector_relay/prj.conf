## CMakeLists.txt
```
# SPDX-License-Identifier: Apache-2.0

cmake_minimum_required(VERSION 3.28.0)

find_package(Zephyr REQUIRED HINTS $ENV{ZEPHYR_BASE})
project(arm_sw_vector_relay)

FILE(GLOB app_sources src/*.c)
target_sources(app PRIVATE ${app_sources})
```

## Kconfig
```
# Copyright (c) 2026 NXP
# SPDX-License-Identifier: Apache-2.0

source "Kconfig.zephyr"

config TEST_SKIP_IRQS
	string "Vector-table entries excluded from relay verification"
	default ""
	help
	  Comma-separated vector-table entry numbers that the relay test must
	  not verify. Use this for board-required vector-table contents that
	  cannot contain the vector relay handler.
```

## prj.conf
```kconfig
CONFIG_ZTEST=y
CONFIG_SW_VECTOR_RELAY=y
```

## boards/lpcxpresso11u68.conf
```kconfig
# The LPC11U68 boot ROM stores its vector-table checksum in word 7.
CONFIG_TEST_SKIP_IRQS="7"
```

## src/main.c
```c
/*
 * Copyright (c) 2020 Nordic Semiconductor ASA
 *
 * SPDX-License-Identifier: Apache-2.0
 */

#if !defined(CONFIG_CPU_CORTEX_M)
#error test can only run on Cortex-M MCUs
#endif

#include <zephyr/ztest.h>

ZTEST_SUITE(arm_sw_vector_relay, NULL, NULL, NULL, NULL, NULL);
```

## src/arm_sw_vector_relay.c
```c
/*
 * Copyright (c) 2020 Nordic Semiconductor ASA.
 *
 * SPDX-License-Identifier: Apache-2.0
 */

#include <zephyr/ztest.h>
#include <zephyr/linker/linker-defs.h>
#include <zephyr/internal/syscall_handler.h>
#include <zephyr/toolchain.h>

#include <cmsis_core.h>

extern uint32_t _vector_table;
extern uint32_t __vector_relay_handler;
extern uint32_t _vector_table_pointer;

static bool skip_irq(int irq)
{
	const char *list = CONFIG_TEST_SKIP_IRQS;

	while (*list != '\0') {
		int entry = 0;

		while (*list == ' ' || *list == ',') {
			list++;
		}

		while (*list >= '0' && *list <= '9') {
			entry = (entry * 10) + (*list - '0');
			list++;
		}

		if (entry == irq) {
			return true;
		}

		while (*list != '\0' && *list != ',') {
			list++;
		}
	}

	return false;
}

/**
 * @brief Test the ARM Software Vector Relay functionality.
 *
 * This test verifies the correctness of the ARM software vector relay mechanism.
 * @ingroup kernel_arch_interrupt_tests
 */
ZTEST(arm_sw_vector_relay, test_arm_sw_vector_relay)
{
	uint32_t vector_relay_table_addr = (uint32_t)&__vector_relay_table;
	uint32_t vector_relay_handler_func = (uint32_t)&__vector_relay_handler;

	/* Verify that the vector relay table entries (except first two
	 * entries for MSP and ResetHandler) point to the relay handling
	 * function.
	 */
	const uint32_t *vector_relay_table_addr_val = (uint32_t *)(vector_relay_table_addr);

	for (int i = 2; i < 16 + CONFIG_NUM_IRQS; i++) {
		if (skip_irq(i)) {
			continue;
		}

		zassert_true(vector_relay_table_addr_val[i] == vector_relay_handler_func,
			     "vector relay table not pointing to the relay handler: 0x%x, 0x%x\n",
			     vector_relay_table_addr_val[i], vector_relay_handler_func);
	}

#if defined(CONFIG_CPU_CORTEX_M_HAS_VTOR)

	uint32_t vector_table_addr = (uint32_t)&_vector_table;

	/* Verify that the forwarding vector table and the real
	 * interrupt vector table respect the VTOR.TBLOFF alignment
	 * requirements.
	 */
	uint32_t mask = MAX(128, Z_POW2_CEIL(4 * (16 + CONFIG_NUM_IRQS))) - 1;

	zassert_true(((vector_table_addr)&mask) == 0, "vector table not properly aligned: 0x%x\n",
		     vector_table_addr);
	zassert_true(((vector_relay_table_addr)&mask) == 0,
		     "vector relay table not properly aligned: 0x%x\n", vector_relay_table_addr);

	/* Verify that the VTOR points to the real vector table,
	 * NOT the table that contains the forwarding function.
	 */
#ifdef CONFIG_SRAM_VECTOR_TABLE
	zassert_true(SCB->VTOR == (uint32_t)&_sram_vector_start,
#else
	zassert_true(SCB->VTOR == (uint32_t)_vector_start,
#endif
		     "VTOR not pointing to the real vector table\n");
#else
	/* If VTOR is not present then we already need to forward interrupts
	 * before loading any child chain-loadable image.
	 */
	zassert_true(_vector_table_pointer == (uint32_t)_vector_start,
		     "vector table pointer not pointing to vector start, 0x%x, 0x%x\n",
		     _vector_table_pointer, (uint32_t)_vector_start);
#endif
}
```
