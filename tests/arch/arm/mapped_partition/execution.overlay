/*
 * SPDX-FileCopyrightText: Copyright The Zephyr Project Contributors
 * SPDX-License-Identifier: Apache-2.0
 */

#include "common.dtsi"

&flash0 {
	test_partition: partition@10000 {
		compatible = "zephyr,mapped-partition";
		reg = <0x10000 0x30000>, <0x0 0x20000>;
		reg-names = "cpu-mapped", "execution";
	};
};

&{/zephyr,user} {
	expected-rom-size = <0x20000>;
	expected-storage-offset = <0x10000>;
};
