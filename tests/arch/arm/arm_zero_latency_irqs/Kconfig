## tests/arch/arm/arm_zero_latency_irqs/Kconfig
```kconfig
# SPDX-License-Identifier: Apache-2.0

config TEST_IRQ_NUM_SPECIFIED
	bool
	default y if SOC_SERIES_CC32XX

config TEST_IRQ_NUM
	int
	depends on TEST_IRQ_NUM_SPECIFIED
	default 163 if SOC_SERIES_CC32XX # Pick the Camera IRQ
	help
	  Allow for a board/SoC specific IRQ to be selected if the logic
	  in the code to auto determine and IRQ doesn't work

source "Kconfig.zephyr"
```

## tests/arch/arm/ram_context_for_isr/Kconfig
```kconfig
# Copyright (c) 2025 Muhmmad Waleed Badar
#
# SPDX-License-Identifier: Apache-2.0

source "Kconfig.zephyr"

config TEST_IRQ_NUM
	int "Test IRQ number"
	depends on !TEST_FIND_FREE_IRQ
	help
	  IRQ number to use for testing purposes. This should be an
	  available/unused IRQ on the target platform.

config TEST_IRQ_PRIO
	int "Test IRQ priority"
	default 1
	help
	  Platform-specific defaults:
	  - GIC platforms: IRQ_DEFAULT_PRIORITY (system default)
	  - Other platforms: 1 (high priority for testing)

config TEST_FIND_FREE_IRQ
	bool "Find a free IRQ during test initialization"
	default y
	depends on CPU_CORTEX_M
	help
	  Test environment can find a free IRQ to run the tests. Platforms willing to
	  use a specific IRQ for this test should have this configuration disabled
	  and set the target IRQ number in TEST_IRQ_NUM.

	  This option is available only on Cortex-M based platforms.
```

## tests/arch/arm64/arm64_gicv3_its/testcase.yaml
```yaml
tests:
  arch.arm64.gicv3_its:
    build_only: true
    platform_allow: fvp_base_revc_2xaem/v8a
    skip: true
```

## tests/arch/arm64/arm64_high_addresses/testcase.yaml
```yaml
common:
  arch_allow: arm64
  platform_exclude:
    - rza3ul_smarc
  tags:
    - arm
    - userspace
  build_only: true

tests:
  arch.arm64.high_addr.high_sram_low_vm:
    extra_configs:
      - CONFIG_KERNEL_VM_BASE=0x00400000
    extra_args:
      - EXTRA_DTC_OVERLAY_FILE="high_address.overlay"

  arch.arm64.high_addr.low_sram_high_vm:
    extra_configs:
      - CONFIG_KERNEL_VM_BASE=0x200880000
    extra_args:
      - EXTRA_DTC_OVERLAY_FILE="low_address.overlay"

  arch.arm64.high_addr.high_sram_equal_vm:
    extra_configs:
      - CONFIG_KERNEL_VM_BASE=0x200880000
    extra_args:
      - EXTRA_DTC_OVERLAY_FILE="high_address.overlay"

  arch.arm64.high_addr.high_sram_high_vm:
    extra_configs:
      - CONFIG_KERNEL_VM_BASE=0x200800000
    extra_args:
      - EXTRA_DTC_OVERLAY_FILE="high_address.overlay"

  arch.arm64.high_addr.high_sram_low_vm.picolibc:
    tags: picolibc
    extra_configs:
      - CONFIG_KERNEL_VM_BASE=0x00400000
      - CONFIG_PICOLIBC=y
    extra_args:
      - EXTRA_DTC_OVERLAY_FILE="high_address.overlay"

  arch.arm64.high_addr.low_sram_high_vm.picolibc:
    tags: picolibc
    extra_configs:
      - CONFIG_KERNEL_VM_BASE=0x200880000
      - CONFIG_PICOLIBC=y
    extra_args:
      - EXTRA_DTC_OVERLAY_FILE="low_address.overlay"

  arch.arm64.high_addr.high_sram_equal_vm.picolibc:
    tags: picolibc
    extra_configs:
      - CONFIG_KERNEL_VM_BASE=0x200880000
      - CONFIG_PICOLIBC=y
    extra_args:
      - EXTRA_DTC_OVERLAY_FILE="high_address.overlay"

  arch.arm64.high_addr.high_sram_high_vm.picolibc:
    tags: picolibc
    extra_configs:
      - CONFIG_KERNEL_VM_BASE=0x200800000
      - CONFIG_PICOLIBC=y
    extra_args:
      - EXTRA_DTC_OVERLAY_FILE="high_address.overlay"
```

## tests/arch/arm64/arm64_isa_features/testcase.yaml
```yaml
common:
  arch_allow: arm64
  tags: arm64

tests:
  arch.arm64.isa_features:
    integration_platforms:
      - fvp_base_revc_2xaem/v9a
```

## tests/arch/arm64/arm64_mmu_mem_attr/testcase.yaml
```yaml
common:
  arch_allow: arm64
  tags:
    - arm64
    - mmu
    - mem_attr
  min_ram: 16
  timeout: 60

tests:
  arch.arm64.mmu.mem_attr:
    platform_allow:
      - qemu_cortex_a53
      - fvp_base_revc_2xaem/v8a
      - versalnet_apu
    integration_platforms:
      - qemu_cortex_a53
    extra_configs:
      - CONFIG_MEM_ATTR=y
      - CONFIG_CACHE_MANAGEMENT=y
```

## tests/arch/arm64/arm64_pacbti/testcase.yaml
```yaml
common:
  tags:
    - arm64
    - pacbti
    - security
  timeout: 30
  filter: CONFIG_ARMV9_A
tests:
  arch.arm64.pacbti:
    integration_platforms:
      - fvp_base_revc_2xaem/v9a
  arch.arm64.pacbti.user:
    integration_platforms:
      - fvp_base_revc_2xaem/v9a
    extra_configs:
      - CONFIG_TEST_USERSPACE=y
```

## tests/arch/arm64/arm64_psci/testcase.yaml
```yaml
tests:
  arch.arm64.psci:
    arch_allow: arm
    tags: arm psci drivers userspace
    filter: CONFIG_PM_CPU_OPS_PSCI
```

## tests/arch/arm64/arm64_smc_call/Kconfig
```kconfig
# Copyright (c) 2022 Arm Limited (or its affiliates). All rights reserved.
# SPDX-License-Identifier: Apache-2.0

config SMC_CALL_USE_HVC
	bool "Set smc call method to hvc"

source "Kconfig.zephyr"
```

## tests/arch/arm64/arm64_smc_call/testcase.yaml
```yaml
tests:
  arch.arm64.smc_call.smc:
    platform_allow: fvp_base_revc_2xaemv8a/fvp_base_revc_2xaemv8a/smp/ns
    tags:
      - arm
      - smc
      - drivers
      - userspace
```

## tests/arch/arm64/arm64_sve_ctx/testcase.yaml
```yaml
tests:
  arch.arm64.sve_ctx:
    arch_allow: arm64
    filter: CONFIG_ARM64_SVE
    integration_platforms:
      - fvp_base_revc_2xaem/v9a
    tags:
      - sve
      - arm64
      - context_switch
```

## tests/arch/arm64/arm64_sve_stress/testcase.yaml
```yaml
tests:
  arch.arm64.sve_stress:
    arch_allow: arm64
    filter: CONFIG_FPU and CONFIG_FPU_SHARING
    integration_platforms:
      - fvp_base_revc_2xaem/v8a
      - fvp_base_revc_2xaem/v9a
    tags:
      - sve
      - neon
      - arm64
      - context_switch
      - stress
    timeout: 120
    slow: true
```

## tests/arch/arm64/arm_psci/testcase.yaml
```yaml
tests:
  arch.arm64.psci:
    arch_allow: arm
    tags: arm psci drivers userspace
    filter: PM_CPU_OPS_PSCI
```

## tests/arch/common/interrupt/Kconfig
```kconfig
# SPDX-License-Identifier: Apache-2.0
# Copyright (c) 2024 Meta Platforms

config TEST_MULTILEVEL_IRQ
	bool "Build the tests in multilevel_irq.c"
	depends on MULTI_LEVEL_INTERRUPTS

source "Kconfig.zephyr"
```

## tests/arch/common/interrupt/testcase.yaml
```yaml
common:
  tags:
    - kernel
    - interrupt
tests:
  arch.interrupt:
    platform_exclude: qemu_cortex_m0
    filter: not CONFIG_TRUSTED_EXECUTION_NONSECURE
  arch.interrupt.qemu_cortex_m0:
    platform_allow: qemu_cortex_m0
    filter: not CONFIG_TRUSTED_EXECUTION_NONSECURE
    extra_configs:
      - CONFIG_QEMU_ICOUNT=y
  arch.interrupt.minimallibc:
    filter: not CONFIG_TRUSTED_EXECUTION_NONSECURE and CONFIG_MINIMAL_LIBC_SUPPORTED
    platform_exclude: qemu_cortex_m0
    tags:
      - libc
    extra_configs:
      - CONFIG_MINIMAL_LIBC=y
  arch.interrupt.qemu_cortex_m0.minimallibc:
    filter: not CONFIG_TRUSTED_EXECUTION_NONSECURE and CONFIG_MINIMAL_LIBC_SUPPORTED
    platform_allow: qemu_cortex_m0
    tags:
      - libc
    extra_configs:
      - CONFIG_QEMU_ICOUNT=y
      - CONFIG_MINIMAL_LIBC=y
  arch.shared_interrupt:
    platform_exclude:
      # excluded because of failures during test_prevent_interruption
      - qemu_cortex_m0
      # On it8xxx2_evb, current trigger_irq implementation of RISC-V architecture
      # does not trigger interrupts
      - it8xxx2_evb
      - max32655evkit/max32655/rv32
      - max32690evkit/max32690/rv32
      - max78002evkit/max78002/rv32
    arch_exclude:
      # test needs 2 working interrupt lines
      - xtensa
      # TODO: make test work on this arch
      - mips
    extra_configs:
      - CONFIG_SHARED_INTERRUPTS=y
    filter: not CONFIG_TRUSTED_EXECUTION_NONSECURE
  arch.shared_interrupt.lto: &shared-interrupt-lto
    platform_exclude:
      # excluded because of failures during test_prevent_interruption
      - qemu_cortex_m0
      - max32655evkit/max32655/rv32
      - max32690evkit/max32690/rv32
      - max78002evkit/max78002/rv32
      # excluded because of assertion during test_isr_offload_job_identi (issue #98658)
      - mpfs_icicle/polarfire/u54/smp
    arch_exclude:
      # test needs 2 working interrupt lines
      - xtensa
      # TODO: make test work on this arch
      - mips
    tags:
      - lto
    extra_configs:
      - CONFIG_SHARED_INTERRUPTS=y
      - CONFIG_TEST_USERSPACE=n
      - CONFIG_ISR_TABLES_LOCAL_DECLARATION=y
      - CONFIG_LTO=y
    # CONFIG_CODE_DATA_RELOCATION causes a build error (issue #69730)
    filter: >
      not CONFIG_TRUSTED_EXECUTION_NONSECURE and CONFIG_ISR_TABLES_LOCAL_DECLARATION_SUPPORTED
      and not CONFIG_CODE_DATA_RELOCATION
  arch.shared_interrupt.lto.speed:
    <<: *shared-interrupt-lto
    extra_configs:
      - CONFIG_SHARED_INTERRUPTS=y
      - CONFIG_TEST_USERSPACE=n
      - CONFIG_ISR_TABLES_LOCAL_DECLARATION=y
      - CONFIG_LTO=y
      - CONFIG_SPEED_OPTIMIZATIONS=y
  arch.interrupt.multilevel:
    filter: CONFIG_MULTI_LEVEL_INTERRUPTS
    extra_args:
      - EXTRA_DTC_OVERLAY_FILE="multilevel_irq.overlay"
    extra_configs:
      - CONFIG_TEST_MULTILEVEL_IRQ=y
  arch.interrupt.multilevel_l3:
    filter: CONFIG_MULTI_LEVEL_INTERRUPTS
    extra_args:
      - EXTRA_DTC_OVERLAY_FILE="multilevel_irq.overlay"
    extra_configs:
      - CONFIG_TEST_MULTILEVEL_IRQ=y
      - CONFIG_3RD_LEVEL_INTERRUPTS=y
      - CONFIG_3RD_LEVEL_INTERRUPT_BITS=11
```

## tests/arch/common/ramfunc/testcase.yaml
```yaml
tests:
  arch.common.ramfunc:
    filter: CONFIG_ARCH_HAS_RAMFUNC_SUPPORT and not CONFIG_ARM_MPU_PXN
    tags:
      - arm
      - userspace
    arch_allow:
      - arm
      - riscv
    extra_configs:
      - CONFIG_COMMON_LIBC_MALLOC_ARENA_SIZE=0
```

## tests/arch/common/semihost/testcase.yaml
```yaml
tests:
  arch.common.semihost:
    arch_allow:
      - arm
      - arm64
      - riscv
    platform_type:
      - qemu
```

## tests/arch/common/stack_unwind/testcase.yaml
```yaml
common:
  harness: console
  ignore_faults: true
  ignore_qemu_crash: true
  tags: kernel
tests:
  arch.common.stack_unwind.riscv_fp:
    arch_allow: riscv
    integration_platforms:
      - qemu_riscv32e
      - qemu_riscv32
      - qemu_riscv64
    extra_configs:
      - CONFIG_FRAME_POINTER=y
    harness_config:
      type: multi_line
      regex:
        - "E: call trace:"
        - "E:       0: fp: \\w+ ra: \\w+"
        - "E:       1: fp: \\w+ ra: \\w+"
  arch.common.stack_unwind.riscv_sp:
    arch_allow: riscv
    integration_platforms:
      - qemu_riscv32e
      - qemu_riscv32
      - qemu_riscv64
    harness_config:
      type: multi_line
      regex:
        - "E: call trace:"
        - "E:       0: sp: \\w+ ra: \\w+"
        - "E:       1: sp: \\w+ ra: \\w+"
  arch.common.stack_unwind.x86:
    arch_allow: x86
    extra_configs:
      - CONFIG_NO_OPTIMIZATIONS=y
      - CONFIG_OMIT_FRAME_POINTER=n
    integration_platforms:
      - qemu_x86
      - qemu_x86_64
    harness_config:
      type: multi_line
      regex:
        - "E: call trace:"
        - "E:      0: \\w+"
        - "E:      1: \\w+"
  arch.common.stack_unwind.arm64:
    arch_allow:
      - arm64
    integration_platforms:
      - qemu_cortex_a53
    extra_configs:
      - CONFIG_FRAME_POINTER=y
    harness_config:
      type: multi_line
      regex:
        - "E: call trace:"
        - "E:      0: fp: \\w+ lr: \\w+"
        - "E:      1: fp: \\w+ lr: \\w+"
  arch.common.stack_unwind.symtab:
    arch_allow:
      - riscv
      - arm64
    integration_platforms:
      - qemu_riscv32e
      - qemu_riscv32
      - qemu_riscv64
      - qemu_cortex_a53
    extra_configs:
      - CONFIG_FRAME_POINTER=y
      - CONFIG_SYMTAB=y
    harness_config:
      type: multi_line
      regex:
        - "\\[func1\\+0x\\w+\\]"
        - "\\[func2\\+0x\\w+\\]"
        - "\\[func1\\+0x\\w+\\]"
        - "\\[func2\\+0x\\w+\\]"
        - "\\[func1\\+0x\\w+\\]"
```

## tests/arch/common/timing/testcase.yaml
```yaml
common:
  filter: CONFIG_ARCH_HAS_TIMING_FUNCTIONS
  platform_type:
    - mcu
    - native
tests:
  arch.common.timing:
    tags:
      - timing
      - arch
```

## tests/arch/riscv/bit_manipulation/testcase.yaml
```yaml
tests:
  arch.riscv.bit_manipulation:
    arch_allow: riscv
    filter: >
      CONFIG_RISCV_ISA_EXT_ZBA or CONFIG_RISCV_ISA_EXT_ZBB or
      CONFIG_RISCV_ISA_EXT_ZBC or CONFIG_RISCV_ISA_EXT_ZBS
```

## tests/arch/riscv/compressed/testcase.yaml
```yaml
tests:
  arch.riscv.compressed:
    arch_allow: riscv
    filter: >
      CONFIG_RISCV_ISA_EXT_ZCA or CONFIG_RISCV_ISA_EXT_ZCB or
      CONFIG_RISCV_ISA_EXT_ZCD or CONFIG_RISCV_ISA_EXT_ZCF or
      CONFIG_RISCV_ISA_EXT_ZCMP or CONFIG_RISCV_ISA_EXT_ZCMT
    harness: console
    ignore_faults: true
    harness_config:
      type: one_line
      regex:
        - "Fatal error expected as part of test case."
```

## tests/arch/riscv/fatal/Kconfig
```kconfig
# Copyright (c) 2024 Meta Platforms
# SPDX-License-Identifier: Apache-2.0

choice
	prompt "Fatal type"
	default TEST_RISCV_FATAL_PANIC

config TEST_RISCV_FATAL_PANIC
	bool "Panic induced fault"
	help
	  Tests the error handling via `z_riscv_fatal_error()`

config TEST_RISCV_FATAL_ILLEGAL_INSTRUCTION
	bool "Illegal instruction induced fault"
	help
	  Tests the error handling via `_Fault()`

endchoice

source "Kconfig.zephyr"
```

## tests/arch/riscv/fatal/testcase.yaml
```yaml
common:
  ignore_faults: true
  harness: console
  ignore_qemu_crash: true
  tags:
    - kernel
    - riscv
  platform_allow:
    - qemu_riscv64
tests:
  arch.riscv64.fatal:
    harness_config:
      type: multi_line
      regex:
        - "E:      a0: 0000000000000004    t0: 0000000000000000"
        - "E:      a1: a1ff0000ff000b11    t1: d1ff0000ff000606"
        - "E:      a2: a2ff0000ff000c12    t2: d2ff0000ff000707"
        - "E:      a3: a3ff0000ff000d13    t3: d3ff0000ff001c28"
        - "E:      a4: a4ff0000ff000e14    t4: d4ff0000ff001d29"
        - "E:      a5: a5ff0000ff000f15    t5: d5ff0000ff001e30"
        - "E:      a6: a6ff0000ff001016    t6: d6ff0000ff001f31"
        - "E:      a7: a7ff0000ff001117"
        - "E:      ra: dada0000ff000101"
        - "E:      s0: c0ff0000ff000808    s6: c6ff0000ff001622"
        - "E:      s1: c1ff0000ff000909    s7: c7ff0000ff001723"
        - "E:      s2: c2ff0000ff001218    s8: c8ff0000ff001824"
        - "E:      s3: c3ff0000ff001319    s9: c9ff0000ff001925"
        - "E:      s4: c4ff0000ff001420   s10: c10ff000ff001a26"
        - "E:      s5: c5ff0000ff001521   s11: c11ff000ff001b27"
```
