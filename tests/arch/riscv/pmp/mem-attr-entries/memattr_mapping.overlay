/*
 * Copyright (c) 2025 Google LLC
 *
 * SPDX-License-Identifier: Apache-2.0
 */

#include <zephyr/dt-bindings/memory-attr/memory-attr-riscv.h>

/ {
	memattr_region1: memattr_region1@80000000 {
		compatible = "zephyr,memory-region";
		reg = <0x80000000 0x20000>;
		zephyr,memory-region = "MEMATTR_REGION1";
		zephyr,memory-attr = <(DT_MEM_RISCV_TYPE_IO_R |
				      DT_MEM_RISCV_TYPE_IO_W |
				      DT_MEM_RISCV_TYPE_IO_X)>;
	};

	memattr_region2: memattr_region2@80000000 {
		compatible = "zephyr,memory-region";
		reg = <0x80020000 0x30000>;
		zephyr,memory-region = "MEMATTR_REGION2";
		zephyr,memory-attr = <(DT_MEM_RISCV_TYPE_IO_R |
				      DT_MEM_RISCV_TYPE_IO_W |
				      DT_MEM_RISCV_TYPE_IO_X)>;
	};
};
