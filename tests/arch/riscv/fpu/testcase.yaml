## tests/arch/riscv/fpu/testcase.yaml
```yaml
# SPDX-FileCopyrightText: Copyright The Zephyr Project Contributors
# SPDX-License-Identifier: Apache-2.0

tests:
  arch.riscv.fpu:
    arch_allow: riscv
    tags:
      - arch
      - fpu
    filter: CONFIG_RISCV_ISA_EXT_ZFINX and CONFIG_FPU
    integration_platforms:
      - qemu_riscv32/qemu_virt_riscv32/zfinx
```

## tests/arch/riscv/fpu_sharing/testcase.yaml
```yaml
tests:
  arch.riscv.fpu_sharing:
    arch_allow: riscv
    filter: CONFIG_CPU_HAS_FPU and not CONFIG_RISCV_IMPRECISE_FPU_STATE_TRACKING
```

## tests/arch/riscv/pm_s2ram/testcase.yaml
```yaml
common:
  build_only: true
  arch_allow: riscv
  tags:
    - pm
    - riscv
tests:
  arch.riscv.pm_s2ram.clint:
    platform_allow:
      - qemu_riscv32
    integration_platforms:
      - qemu_riscv32
  arch.riscv.pm_s2ram.clic:
    platform_allow:
      - gd32vf103v_eval
    integration_platforms:
      - gd32vf103v_eval
```

## tests/arch/riscv/pmp/clear-pmp-unlocked-entries/testcase.yaml
```yaml
common:
  platform_allow:
    - qemu_riscv32
    - qemu_riscv32e
    - qemu_riscv64
  filter: CONFIG_RISCV_PMP and not CONFIG_RISCV_ALWAYS_SWITCH_THROUGH_ECALL
  ignore_faults: true

tests:
  arch.riscv.pmp.clear.unlocked.entries: {}
```

## tests/arch/riscv/pmp/mem-attr-entries/testcase.yaml
```yaml
common:
  platform_allow:
    - qemu_riscv32
    - qemu_riscv32e
    - qemu_riscv64
  filter: CONFIG_RISCV_PMP

tests:
  arch.riscv.pmp.memattr.entries:
    extra_args:
      DTC_OVERLAY_FILE="memattr_mapping.overlay"
```

## tests/arch/riscv/pmp/no-multithreading/testcase.yaml
```yaml
common:
  platform_allow:
    - qemu_riscv32
    - qemu_riscv32e
    - qemu_riscv64
  filter: CONFIG_RISCV_PMP
  ignore_faults: true

tests:
  arch.riscv.pmp.no-mt.isr-stack-guard:
    extra_args: EXTRA_CFLAGS=-DPMP_TEST_FUNC_IDX=0
  arch.riscv.pmp.no-mt.main-stack-guard:
    extra_args: EXTRA_CFLAGS=-DPMP_TEST_FUNC_IDX=1
```

## tests/arch/riscv/pmp/pmp-custom-regions/testcase.yaml
```yaml
common:
  platform_allow:
    - qemu_riscv32
    - qemu_riscv64
  filter: CONFIG_RISCV_PMP
  tags: pmp

tests:
  arch.riscv.pmp.soc_regions:
    harness: ztest
```

## tests/arch/riscv/pmp/pmp-decode-region/testcase.yaml
```yaml
common:
  platform_allow:
    - qemu_riscv32/qemu_virt_riscv32
    - qemu_riscv32/qemu_virt_riscv32/smp
    - qemu_riscv32e
    - qemu_riscv64
  filter: CONFIG_RISCV_PMP

tests:
  arch.riscv.pmp.decode.region: {}
```

## tests/arch/riscv/pmp/pmp-napot-multi-slots/Kconfig
```kconfig
# Copyright (c) 2026 Picoheart.
# SPDX-License-Identifier: Apache-2.0

mainmenu "pmp tests"

source "Kconfig.zephyr"

config PMP_NAPOT_TEST
	bool "Test pmp"
	select PMP_NO_TOR
	help
	  help the testcase select PMP_NO_TOR.
```

## tests/arch/riscv/pmp/pmp-napot-multi-slots/testcase.yaml
```yaml
common:
  platform_allow:
    - qemu_riscv64
  filter: CONFIG_RISCV_PMP
  tags: pmp

tests:
  arch.riscv.pmp.napot_multi_slots:
    harness: ztest
```

## tests/arch/riscv/stack_unwind/testcase.yaml
```yaml
tests:
  arch.riscv.stack_unwind:
    arch_allow: riscv
    harness: console
    harness_config:
      type: multi_line
      regex:
        - ".* Call trace begin:"
        - ".* 0: fp: \\w+   ra: \\w+"
        - ".* 1: fp: \\w+   ra: \\w+"
```

## tests/arch/riscv/test_build_cpp/testcase.yaml
```yaml
# Copyright (c) 2025 Google LLC
# SPDX-License-Identifier: Apache-2.0

tests:
  # Verify struct _cpu_arch struct _thread_arch are compatible with C++
  # when specific configs are enabled.
  arch.riscv.test_build_cpp:
    build_only: true
    tags:
      - riscv
    arch_allow: riscv
    extra_configs:
      - CONFIG_USERSPACE=n
      - CONFIG_SMP=n
      - CONFIG_FPU_SHARING=n
```

## tests/arch/riscv/userspace/riscv_gp/testcase.yaml
```yaml
common:
  ignore_faults: true
  ignore_qemu_crash: true
  tags: kernel riscv
  platform_allow:
    - qemu_riscv64
tests:
  arch.riscv64.riscv_gp: {}
```

## tests/arch/x86/boot_page_table/testcase.yaml
```yaml
tests:
  kernel.memory_protection.x86.bootpage.validation:
    platform_whitelist: qemu_x86
    tags: mmu
```

## tests/arch/x86/cet/testcase.yaml
```yaml
common:
  ignore_faults: true
  tags:
    - kernel
    - cet
  filter: CONFIG_X86_CPU_HAS_CET

tests:
  arch.x86.cet.kernel.ibt:
    arch_allow: x86
    extra_configs:
      - CONFIG_X86_CET_IBT=y
```

## tests/arch/x86/cpu_scrubs_regs/testcase.yaml
```yaml
tests:
  arch.x86.syscalls.cpu_scrubs_regs:
    arch_allow: x86
    filter: CONFIG_ARCH_HAS_USERSPACE
    tags:
      - kernel
      - security
      - userspace
      - scrub
      - registers
    integration_platforms:
      - qemu_x86
```

## tests/arch/x86/hybrid/testcase.yaml
```yaml
tests:
  arch.x86.hybrid:
    arch_allow: x86
    integration_platforms:
      - intel_rpl_s_crb
    filter: (CONFIG_MP_MAX_NUM_CPUS > 1) and CONFIG_X86_PC_COMPATIBLE
```

## tests/arch/x86/info/testcase.yaml
```yaml
tests:
  arch.x86.info:
    arch_allow: x86
    harness: console
    harness_config:
        type: one_line
        regex:
          - "info: complete"
    filter: CONFIG_X86_PC_COMPATIBLE
  arch.x86.info.userspace:
    arch_allow: x86
    extra_configs:
      - CONFIG_TEST_USERSPACE=y
    harness: console
    harness_config:
        type: one_line
        regex:
          - "info: complete"
    filter: CONFIG_X86_PC_COMPATIBLE
```

## tests/arch/x86/nmi/testcase.yaml
```yaml
common:
  arch_allow: x86
  filter: CONFIG_X86_64
  tags: interrupt nmi
tests:
  arch.interrupt.nmi:
    extra_configs:
      - CONFIG_USERSPACE=n
  arch.interrupt.nmi.kpti:
    extra_configs:
      - CONFIG_USERSPACE=y
```

## tests/arch/x86/pagetables/testcase.yaml
```yaml
tests:
  arch.x86.pagetables:
    arch_allow: x86
    tags:
      - userspace
      - mmu
    filter: CONFIG_MMU
    extra_configs:
      - CONFIG_COMMON_LIBC_MALLOC_ARENA_SIZE=0
```

## tests/arch/x86/static_idt/testcase.yaml
```yaml
tests:
  arch.x86.interrupt:
    ignore_faults: true
    arch_allow: x86
    filter: not CONFIG_X86_64
    tags:
      - interrupt
      - idt
```
