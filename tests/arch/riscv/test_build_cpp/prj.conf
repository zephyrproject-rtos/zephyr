## CMakeLists.txt
```
# Copyright (c) 2025 Google Inc.
# SPDX-License-Identifier: Apache-2.0

cmake_minimum_required(VERSION 3.20.0)
find_package(Zephyr REQUIRED HINTS $ENV{ZEPHYR_BASE})
project(test_build_cpp)

FILE(GLOB app_sources src/*.cpp)
target_sources(app PRIVATE ${app_sources})
```

## prj.conf
```kconfig
# Copyright 2025 Google LLC
# SPDX-License-Identifier: Apache-2.0

CONFIG_CPP=y
```

## src/main.cpp
```c
/*
* Copyright (c) 2025 Google
 * SPDX-License-Identifier: Apache-2.0
 */

#include <zephyr/toolchain.h>

BUILD_ASSERT(CONFIG_CPP, "C++ must be enabled");

int main(void)
{
	return 0;
}
```
