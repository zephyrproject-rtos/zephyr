## CMakeLists.txt
```
# SPDX-License-Identifier: Apache-2.0

cmake_minimum_required(VERSION 3.20.0)
find_package(Zephyr REQUIRED HINTS $ENV{ZEPHYR_BASE})
project(m68k_fatal)

target_sources(app PRIVATE src/main.c)
```

## Kconfig
```
# Copyright (c) 2026 Dimitri Varpusvuori
# SPDX-License-Identifier: Apache-2.0

choice TEST_M68K_FATAL_TYPE
	prompt "Fatal exception to trigger"
	default TEST_M68K_FATAL_ILLEGAL_INSTRUCTION

config TEST_M68K_FATAL_ILLEGAL_INSTRUCTION
	bool "Illegal instruction"

config TEST_M68K_FATAL_UNHANDLED_TRAP
	bool "Unhandled TRAP #0"

endchoice

source "Kconfig.zephyr"
```

## prj.conf
```kconfig
CONFIG_LOG=y
CONFIG_EXCEPTION_DEBUG=y
```

## src/main.c
```c
/*
 * Copyright (c) 2026 Dimitri Varpusvuori
 *
 * SPDX-License-Identifier: Apache-2.0
 */

#include <zephyr/kernel.h>

int main(void)
{
#if defined(CONFIG_TEST_M68K_FATAL_ILLEGAL_INSTRUCTION)
	__asm__ volatile (".word 0x4afc");
#else
	__asm__ volatile ("trap #0");
#endif

	CODE_UNREACHABLE;
}
```
