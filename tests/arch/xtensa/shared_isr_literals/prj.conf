## CMakeLists.txt
```
# SPDX-FileCopyrightText: Copyright The Zephyr Project Contributors
# SPDX-License-Identifier: Apache-2.0

cmake_minimum_required(VERSION 3.28.0)

# Place common ROM sections before ordinary text to exercise their literal placement.
set(soc_linker_script "$ENV{ZEPHYR_BASE}/soc/cdns/dc233c/include/xtensa-dc233c.ld")
set_property(DIRECTORY APPEND PROPERTY CMAKE_CONFIGURE_DEPENDS "${soc_linker_script}")
file(READ "${soc_linker_script}" linker_script)
if(NOT linker_script MATCHES "  [.]text : HDR_MMU_PAGE_ALIGN")
  message(FATAL_ERROR "Cannot locate the dc233c text section")
endif()
string(REPLACE "#include <zephyr/linker/common-rom.ld>" "" linker_script "${linker_script}")
string(REPLACE "  .text : HDR_MMU_PAGE_ALIGN"
  "#include <zephyr/linker/common-rom.ld>\n  .text : HDR_MMU_PAGE_ALIGN"
  linker_script "${linker_script}"
)
file(WRITE "${CMAKE_CURRENT_BINARY_DIR}/early-common.ld" "${linker_script}")

find_package(Zephyr REQUIRED HINTS $ENV{ZEPHYR_BASE})
project(shared_isr_literals)

# Function instrumentation makes z_shared_isr emit literal loads even at -Os.
set_source_files_properties("${ZEPHYR_BASE}/arch/common/shared_irq.c"
  TARGET_DIRECTORY arch__common
  PROPERTIES COMPILE_OPTIONS "-finstrument-functions"
)
target_sources(app PRIVATE
  src/main.c
)
```

## prj.conf
```kconfig
# SPDX-FileCopyrightText: Copyright The Zephyr Project Contributors
# SPDX-License-Identifier: Apache-2.0

CONFIG_ZTEST=y
CONFIG_SHARED_INTERRUPTS=y
CONFIG_HAVE_CUSTOM_LINKER_SCRIPT=y
CONFIG_CUSTOM_LINKER_SCRIPT="${APPLICATION_BINARY_DIR}/early-common.ld"
```

## src/main.c
```c
/*
 * SPDX-FileCopyrightText: Copyright The Zephyr Project Contributors
 * SPDX-License-Identifier: Apache-2.0
 */

#include <zephyr/sw_isr_table.h>
#include <zephyr/ztest.h>

void __cyg_profile_func_enter(void *function, void *caller)
{
	ARG_UNUSED(function);
	ARG_UNUSED(caller);
}

void __cyg_profile_func_exit(void *function, void *caller)
{
	ARG_UNUSED(function);
	ARG_UNUSED(caller);
}

static void client_isr(const void *arg)
{
	uint32_t *calls = (uint32_t *)arg;

	(*calls)++;
}

ZTEST(shared_isr_literals, test_dispatch)
{
	uint32_t calls[2] = {0U, 0U};
	struct z_shared_isr_table_entry entry = {.client_num = 2U};

	entry.clients[0].isr = client_isr;
	entry.clients[0].arg = &calls[0];
	entry.clients[1].isr = client_isr;
	entry.clients[1].arg = &calls[1];

	z_shared_isr(&entry);
	zassert_equal(calls[0], 1U, "First client was not called once");
	zassert_equal(calls[1], 1U, "Second client was not called once");
}

ZTEST_SUITE(shared_isr_literals, NULL, NULL, NULL, NULL, NULL);
```
