## CMakeLists.txt
```
# SPDX-FileCopyrightText: Copyright The Zephyr Project Contributors
# SPDX-License-Identifier: Apache-2.0

cmake_minimum_required(VERSION 3.28.0)
find_package(Zephyr REQUIRED HINTS $ENV{ZEPHYR_BASE})
project(xtensa_ctors)

target_sources(app PRIVATE src/main.cpp)

# Model the legacy CRT object names and constructor-list markers.
foreach(marker IN ITEMS BEGIN END)
  string(TOLOWER "${marker}" marker_name)
  set(crt_object "${CMAKE_CURRENT_BINARY_DIR}/crt${marker_name}.o")
  add_custom_command(
    OUTPUT "${crt_object}"
    COMMAND ${CMAKE_C_COMPILER} -c "${CMAKE_CURRENT_SOURCE_DIR}/src/crt.c"
      -DCRT_${marker}=1 -o "${crt_object}"
    DEPENDS src/crt.c
    VERBATIM
  )
  target_sources(app PRIVATE "${crt_object}")
endforeach()
```

## prj.conf
```kconfig
# SPDX-FileCopyrightText: Copyright The Zephyr Project Contributors
# SPDX-License-Identifier: Apache-2.0

CONFIG_CPP=y
CONFIG_ZTEST=y
```

## src/main.cpp
```c
/*
 * SPDX-FileCopyrightText: Copyright The Zephyr Project Contributors
 * SPDX-License-Identifier: Apache-2.0
 */

#include <zephyr/ztest.h>

static unsigned int initialized;

struct instance {
	instance()
	{
		initialized++;
	}
};

static instance first;
static instance second;

extern "C" void crt_init(void)
{
	initialized++;
}

static void legacy_init(void)
{
	initialized++;
}

static void (*const legacy_callback)(void) __attribute__((section(".ctors"), used)) = legacy_init;

ZTEST(ctors, test_initializers)
{
	zassert_equal(initialized, 4U, "initializer missing or called more than once");
}

ZTEST_SUITE(ctors, NULL, NULL, NULL, NULL, NULL);
```

## src/crt.c
```c
/*
 * SPDX-FileCopyrightText: Copyright The Zephyr Project Contributors
 * SPDX-License-Identifier: Apache-2.0
 */

#include <stdint.h>

#ifdef CRT_BEGIN
const uint32_t crt_begin __attribute__((section(".ctors"))) = UINT32_MAX;

extern void crt_init(void);

/* Modern CRT initializer callbacks must remain callable. */
void (*const crt_callback)(void) __attribute__((section(".init_array"))) = crt_init;
#else
const uint32_t crt_end __attribute__((section(".ctors"))) = 0U;
#endif
```
