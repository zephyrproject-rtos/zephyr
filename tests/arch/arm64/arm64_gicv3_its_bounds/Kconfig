## tests/arch/arm64/arm64_gicv3_its_bounds/Kconfig
```kconfig
# Copyright (c) 2026 Process Mission
# SPDX-License-Identifier: Apache-2.0

config NUM_IRQS
	int "Number of IRQs for the LPI boundary test"

source "Kconfig.zephyr"
```

## tests/arch/m68k/fatal/Kconfig
```kconfig
# Copyright (c) 2026 Dimitri Varpusvuori
# SPDX-License-Identifier: Apache-2.0

choice TEST_M68K_FATAL_TYPE
	prompt "Fatal exception to trigger"
	default TEST_M68K_FATAL_ILLEGAL_INSTRUCTION

config TEST_M68K_FATAL_ILLEGAL_INSTRUCTION
	bool "Illegal instruction"

config TEST_M68K_FATAL_UNHANDLED_TRAP
	bool "Unhandled TRAP #0"

endchoice

source "Kconfig.zephyr"
```

## tests/arch/tricore/reboot/Kconfig
```kconfig
# SPDX-FileCopyrightText: Copyright (c) 2024 Infineon Technologies AG,
# SPDX-FileCopyrightText: or an affiliate of Infineon Technologies AG. All rights reserved.
# SPDX-FileCopyrightText: Copyright (c) 2026 Linumiz
#
# SPDX-License-Identifier: Apache-2.0

config TEST_REBOOT_COLD
	bool "Request a cold reboot instead of a warm one"

source "Kconfig.zephyr"
```

## tests/arch/tricore/soak/Kconfig
```kconfig
# SPDX-FileCopyrightText: Copyright (c) 2024 Infineon Technologies AG,
# SPDX-FileCopyrightText: or an affiliate of Infineon Technologies AG. All rights reserved.
# SPDX-FileCopyrightText: Copyright (c) 2026 Linumiz
#
# SPDX-License-Identifier: Apache-2.0

config TRICORE_SOAK_SECONDS
	int "TriCore soak duration in seconds"
	default 20
	help
	  How long the concurrent soak workload runs before the invariants
	  (no CSA leak, no fault, no sleep stall) are checked.

source "Kconfig.zephyr"
```

## tests/arch/xtensa/bss_clear/Kconfig
```kconfig
# SPDX-FileCopyrightText: Copyright The Zephyr Project Contributors
# SPDX-License-Identifier: Apache-2.0

source "Kconfig.zephyr"

config TEST_SKIP_BSS_CLEAR
	bool "Skip Xtensa startup BSS clearing"
	select SKIP_BSS_CLEAR
```
