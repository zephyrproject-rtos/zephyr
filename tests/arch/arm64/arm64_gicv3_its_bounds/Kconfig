## tests/benchmarks/kernel_latency/Kconfig
```kconfig
# SPDX-FileCopyrightText: Copyright The Zephyr Project Contributors
# SPDX-License-Identifier: Apache-2.0

mainmenu "Kernel Latency Benchmark"

config KERNEL_BENCH_NUM_SAMPLES
	int "Number of samples per benchmark"
	default 1000
	help
	  Samples recorded for each benchmark. Percentiles need enough of
	  them to resolve: p99 needs a hundred, p99.9 a thousand. Raise
	  CONFIG_ZTEST_BENCHMARK_MAX_SAMPLES to match.

source "Kconfig.zephyr"
```

## tests/benchmarks/signal/Kconfig
```kconfig
# Copyright (c) 2026, Friedt Professional Engineering Services, Inc
#
# SPDX-License-Identifier: Apache-2.0

mainmenu "Signal Benchmark"

source "Kconfig.zephyr"

config TEST_DURATION_S
	int "Number of seconds to run the test"
	default 5
	help
	   Duration for the test, in seconds.

config TEST_STACK_SIZE
	int "Size of each thread stack in this test"
	default 1024 if 64BIT
	default 1024 if SPARC
	default 512
	help
	  The minimal stack size required to run a minimal thread.
```

## tests/benchmarks/signal/testcase.yaml
```yaml
common:
  tags:
    - kernel
    - benchmark
  min_ram: 64
  integration_platforms:
    - qemu_riscv64/qemu_virt_riscv64/smp
    - qemu_riscv32
    - mps2/an385
    - qemu_cortex_a53/qemu_cortex_a53/smp
    - qemu_x86
    - qemu_x86_64
  harness: console
  harness_config:
    type: one_line
    record:
      regex:
        - "(?P<time>.*), (?P<cores>.*), (?P<retries>.*), (?P<signals>.*), (?P<retry_rate>.*), (?P<signal_rate>.*)"
    regex:
      - "PROJECT EXECUTION SUCCESSFUL"
tests:
  benchmark.kernel.signal: {}
  benchmark.kernel.signal.userspace:
    filter: CONFIG_ARCH_HAS_USERSPACE and CONFIG_ARCH_SUPPORTS_USERSPACE_SIGNALS
    extra_configs:
      - CONFIG_USERSPACE=y
```

## tests/bluetooth/audio/aics_client/Kconfig
```kconfig
# SPDX-FileCopyrightText: Copyright (c) 2026 Silicon Laboratories Inc.
# SPDX-License-Identifier: Apache-2.0

config BT_AUDIO
	bool
	default y

config BT_BUF_ACL_RX_SIZE
	int
	default 69

config BT_BUF_ACL_TX_COUNT
	int
	default 5

config BT_BUF_EVT_RX_COUNT
	int
	default 10

config BT_CONN
	bool
	default y

config BT_LOG
	bool
	default y

config BT_MAX_CONN
	int
	default 1

config BT_MAX_PAIRED
	int
	default 1

config BT_SMP
	bool
	default y

source "Kconfig"
source "subsys/bluetooth/audio/Kconfig"
source "subsys/bluetooth/Kconfig.logging"
```

## tests/bluetooth/classic/bumble/rfcomm/Kconfig
```kconfig
# SPDX-FileCopyrightText: Copyright 2026 NXP
#
# SPDX-License-Identifier: Apache-2.0

config TEST_RFCOMM_MAX_CHANNEL_COUNT
	int "Maximum RFCOMM channel count"
	depends on BT_RFCOMM
	default 16
	range 2 31
	help
	  The maximum number of RFCOMM channels that can be created for testing.
	  Simply increasing the value of this configuration parameter may lead to disconnections
	  caused by connection timeouts. In such cases, you can appropriately increase the number
	  of transmit buffers—defined by `CONFIG_BT_L2CAP_TX_BUF_COUNT` to prevent timeouts and
	  subsequent disconnections, thereby avoiding test failures.

config BT_BUF_ACL_RX_COUNT_EXTRA
	default TEST_RFCOMM_MAX_CHANNEL_COUNT

config BT_L2CAP_TX_BUF_COUNT
	default 10 if TEST_RFCOMM_MAX_CHANNEL_COUNT > 20
	default 7 if TEST_RFCOMM_MAX_CHANNEL_COUNT > 15
	default 5 if TEST_RFCOMM_MAX_CHANNEL_COUNT > 10

source "Kconfig.zephyr"

module = TEST_CLASSIC_RFCOMM_SIM
module-str = test_classic_rfcomm_sim
source "subsys/logging/Kconfig.template.log_config"
```

## tests/bluetooth/classic/l2cap_default_seg/Kconfig
```kconfig
# Copyright 2026 NXP
# SPDX-License-Identifier: Apache-2.0

config BT_L2CAP_APPL
	bool
	default y
	help
	  This symbol is a config macro.

if BT_L2CAP_APPL

module = BT_L2CAP_APPL
module-str = "Bluetooth L2CAP application"
source "subsys/logging/Kconfig.template.log_config"

endif # BT_L2CAP_APPL

source "Kconfig.zephyr"
```

## tests/bluetooth/classic/l2cap_psm_reconnect/Kconfig
```kconfig
# Copyright 2026 NXP
# SPDX-License-Identifier: Apache-2.0

config L2CAP_CHAN_MAX_COUNT
	int "L2CAP_CHAN_MAX_COUNT"
	default 1
	help
	  This symbol is a config macro.

source "Kconfig.zephyr"
```

## tests/bluetooth/classic/sim/l2cap/Kconfig
```kconfig
# Copyright 2026 NXP
#
# SPDX-License-Identifier: Apache-2.0


config TEST_L2CAP_MAX_CHANNEL_COUNT
	int "Maximum L2CAP channel count"
	depends on BT_CLASSIC
	default 16
	range 2 255
	help
	  The maximum number of L2CAP channels that can be created for testing.

config BT_BUF_ACL_RX_COUNT_EXTRA
	default TEST_L2CAP_MAX_CHANNEL_COUNT

source "Kconfig.zephyr"

config TEST_L2CAP_SERVER_TX_DATA_POOL_COUNT
	int "L2CAP server TX data pool count"
	default BT_L2CAP_MAX_WINDOW_SIZE if BT_L2CAP_RET_FC
	default 1
	range BT_L2CAP_MAX_WINDOW_SIZE 255 if BT_L2CAP_RET_FC
	range 1 255
	help
	  The number of buffers in the L2CAP server TX data pool.

config TEST_L2CAP_SERVER_RX_DATA_POOL_COUNT
	int "L2CAP server RX data pool count"
	depends on BT_CLASSIC
	default BT_L2CAP_MAX_WINDOW_SIZE if BT_L2CAP_RET_FC
	default 1
	range BT_L2CAP_MAX_WINDOW_SIZE 255 if BT_L2CAP_RET_FC
	range 1 255
	help
	  The number of buffers in the L2CAP server RX data pool.

config TEST_L2CAP_SERVER_MTU
	int "L2CAP server MTU"
	depends on BT_CLASSIC
	default 672
	range 23 65535
	help
	  The maximum transmission unit (MTU) size for the L2CAP server.

config TEST_L2CAP_CLIENT_TX_DATA_POOL_COUNT
	int "L2CAP client TX data pool count"
	default BT_L2CAP_MAX_WINDOW_SIZE if BT_L2CAP_RET_FC
	default 1
	range BT_L2CAP_MAX_WINDOW_SIZE 255 if BT_L2CAP_RET_FC
	range 1 255
	help
	  The number of buffers in the L2CAP client TX data pool.

config TEST_L2CAP_CLIENT_RX_DATA_POOL_COUNT
	int "L2CAP client RX data pool count"
	depends on BT_CLASSIC
	default BT_L2CAP_MAX_WINDOW_SIZE if BT_L2CAP_RET_FC
	default 1
	range BT_L2CAP_MAX_WINDOW_SIZE 255 if BT_L2CAP_RET_FC
	range 1 255
	help
	  The number of buffers in the L2CAP client RX data pool.

config TEST_L2CAP_CLIENT_MTU
	int "L2CAP client MTU"
	depends on BT_CLASSIC
	default 672
	range 23 65535
	help
	  The maximum transmission unit (MTU) size for the L2CAP client.

module = TEST_CLASSIC_L2CAP_SIM
module-str = test_classic_l2cap_sim
source "subsys/logging/Kconfig.template.log_config"
```

## tests/bluetooth/hci_uart_3wire/dts/bindings/zephyr,bt-hci-test.yaml
```yaml
# SPDX-FileCopyrightText: Copyright (c) 2026 Silicon Laboratories Inc.
# SPDX-License-Identifier: Apache-2.0

description: Bluetooth HCI for test purposes

compatible: "zephyr,bt-hci-test"

include: bt-hci.yaml

properties:
  bt-hci-name:
    default: "Mock Controller"
  bt-hci-bus:
    default: "virtual"
```

## tests/bluetooth/host_disable/Kconfig
```kconfig
# SPDX-FileCopyrightText: Copyright The Zephyr Project Contributors
# SPDX-License-Identifier: Apache-2.0

config TEST_DRIVER_NO_CLOSE
	bool "Give the test HCI driver no close() op"
	help
	  Build the test HCI driver without a close() op, as several in-tree
	  HCI drivers are, so that bt_disable() cannot close the transport.

config TEST_CTLR_STOPS
	bool "Run only the test with a controller that stops responding"
	help
	  Run only the test where the controller answers HCI Reset and then
	  stops responding. The Host asserts in that test, so no other test can
	  run after it.

config TEST_SEND_BLOCKS
	bool "Run only the test with a driver that blocks in send()"
	help
	  Run only the test where the driver stays in send() for longer than
	  the command timeout of the Host. The Host asserts in that test, so no
	  other test can run after it.

source "Kconfig.zephyr"
```

## tests/bluetooth/host_ecc_context/Kconfig
```kconfig
# SPDX-FileCopyrightText: Copyright (c) 2026 Silicon Laboratories Inc.
# SPDX-License-Identifier: Apache-2.0

config TEST_ATOMIC_OPERATIONS_C
	bool "Use the atomic operations implemented in C"
	select ATOMIC_OPERATIONS_C
	help
	  Use the atomic operations implemented in C, which zephyr/sys/atomic.h
	  prefers to the compiler builtins: they are functions of their own,
	  which a test can wrap to run something just before an atomic
	  operation of the Host.

source "Kconfig.zephyr"
```

## tests/bluetooth/host_iso_tx/dts/bindings/zephyr,bt-hci-test.yaml
```yaml
# SPDX-FileCopyrightText: Copyright The Zephyr Project Contributors
# SPDX-License-Identifier: Apache-2.0

description: |
  Bluetooth HCI for test purposes. Unlike the test bindings that set the
  "no-reset" quirk, this one leaves the quirks empty, so that the Host resets
  the controller when it is enabled and disabled.

compatible: "zephyr,bt-hci-test"

include: bt-hci.yaml

properties:
  bt-hci-name:
    default: "test"
  bt-hci-bus:
    default: "virtual"
```

## tests/bluetooth/host_keys/Kconfig
```kconfig
# SPDX-FileCopyrightText: Copyright The Zephyr Project Contributors
# SPDX-License-Identifier: Apache-2.0

config TEST_RL_SIZE
	int "Resolving list size reported by the test driver"
	default 8
	help
	  Zero makes the host resolve addresses itself.

source "Kconfig.zephyr"
```

## tests/bluetooth/host_sco_data/dts/bindings/zephyr,bt-hci-test.yaml
```yaml
# SPDX-FileCopyrightText: Copyright The Zephyr Project Contributors
# SPDX-License-Identifier: Apache-2.0

description: Bluetooth HCI test device

compatible: "zephyr,bt-hci-test"

include: bt-hci.yaml

properties:
  bt-hci-name:
    default: "test"
  bt-hci-bus:
    default: "virtual"
```
