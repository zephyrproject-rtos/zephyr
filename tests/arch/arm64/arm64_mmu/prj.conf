## CMakeLists.txt
```
# SPDX-License-Identifier: Apache-2.0

cmake_minimum_required(VERSION 3.20.0)

find_package(Zephyr REQUIRED HINTS $ENV{ZEPHYR_BASE})
project(arm64_mmu)

target_include_directories(app PRIVATE
  ${ZEPHYR_BASE}/kernel/include
  ${ZEPHYR_BASE}/arch/${ARCH}/include
  ${ZEPHYR_BASE}
  )

# The table accounting suite asserts exact table counts, which only hold
# without memory domains; the domain suite needs them. One per build.
target_sources_ifndef(CONFIG_USERSPACE app PRIVATE src/main.c)
target_sources_ifdef(CONFIG_USERSPACE app PRIVATE src/domain_attrs.c)
```

## prj.conf
```kconfig
CONFIG_ASSERT=y
CONFIG_LOG=y
CONFIG_LOG_MODE_MINIMAL=y
CONFIG_ZTEST=y
CONFIG_ARM_MMU=y
CONFIG_MMU_PAGE_SIZE=0x1000
CONFIG_ARM64_VA_BITS_36=y
CONFIG_ARM64_PA_BITS_36=y
CONFIG_MAX_XLAT_TABLES=8
```

## src/main.c
```c
/*
 * Copyright (c) 2024 BayLibre, SAS
 *
 * SPDX-License-Identifier: Apache-2.0
 */

#include <zephyr/kernel.h>
#include <zephyr/ztest.h>
#include <kernel_arch_interface.h>

/*
 * Virtual and physical addresses used to exercise MMU page table recycling.
 * Those are completely arbitrary addresses away from any existing addresses
 * (no worry, the test will fail otherwise). Those addresses don't have
 * to be valid as we won't attempt any access to the mapped memory.
 */
#define TEST_VIRT_ADDR	0x456560000
#define TEST_PHYS_ADDR	0x123230000

/* special test hooks in arch/arm64/core/mmu.c for test purpose */
extern int arm64_mmu_nb_free_tables(void);
extern int arm64_mmu_tables_total_usage(void);

/* initial states to compare against */
static int initial_nb_free_tables;
static int initial_tables_usage;

static void *arm64_mmu_test_init(void)
{
	/* get initial states */
	initial_nb_free_tables = arm64_mmu_nb_free_tables();
	initial_tables_usage = arm64_mmu_tables_total_usage();

	TC_PRINT("  Total page tables:           %d\n", CONFIG_MAX_XLAT_TABLES);
	TC_PRINT("  Initial free tables:         %d\n", initial_nb_free_tables);
	TC_PRINT("  Initial total table usage:   %#x\n", initial_tables_usage);

	zassert_true(initial_nb_free_tables > 1,
		     "initial_nb_free_tables = %d", initial_nb_free_tables);
	zassert_true(initial_tables_usage > 1,
		     "initial_tables_usage = %d", initial_tables_usage);

	return NULL;
}

static int mem_map_test(uintptr_t virt_addr, uintptr_t phys_addr, size_t size)
{
	int ret;

	ret = arch_mem_map((void *)virt_addr, phys_addr, size, K_MEM_ARM_NORMAL_NC);
	zassert_ok(ret, "arch_mem_map() returned %d", ret);

	int mapped_nb_free_tables = arm64_mmu_nb_free_tables();
	int mapped_tables_usage = arm64_mmu_tables_total_usage();

	TC_PRINT("  After arch_mem_map:\n");
	TC_PRINT("   current free tables:        %d\n", mapped_nb_free_tables);
	TC_PRINT("   current total table usage:  %#x\n", mapped_tables_usage);

	zassert_true(mapped_nb_free_tables < initial_nb_free_tables,
		     "%d vs %d", mapped_nb_free_tables, initial_nb_free_tables);
	zassert_true(mapped_tables_usage > initial_tables_usage,
		     "%#x vs %#x", mapped_tables_usage, initial_tables_usage);

	ret = arch_mem_unmap((void *)virt_addr, size);
	zassert_ok(ret, "arch_mem_unmap() returned %d", ret);

	int unmapped_nb_free_tables = arm64_mmu_nb_free_tables();
	int unmapped_tables_usage = arm64_mmu_tables_total_usage();

	TC_PRINT("  After arch_mem_unmap:\n");
	TC_PRINT("   current free tables:        %d\n", unmapped_nb_free_tables);
	TC_PRINT("   current total table usage:  %#x\n", unmapped_tables_usage);

	zassert_true(unmapped_nb_free_tables == initial_nb_free_tables,
		     "%d vs %d", unmapped_nb_free_tables, initial_nb_free_tables);
	zassert_true(unmapped_tables_usage == initial_tables_usage,
		     "%#x vs %#x", unmapped_tables_usage, initial_tables_usage);

	int tables_used = unmapped_nb_free_tables - mapped_nb_free_tables;
	return tables_used;
}

ZTEST(arm64_mmu, test_arm64_mmu_01_single_page)
{
	/*
	 * Let's map a single page to start with. This will allocate
	 * multiple tables to reach the deepest level.
	 */
	uintptr_t virt = TEST_VIRT_ADDR;
	uintptr_t phys = TEST_PHYS_ADDR;
	size_t size    = CONFIG_MMU_PAGE_SIZE;

	int tables_used = mem_map_test(virt, phys, size);

	zassert_true(tables_used == 2, "used %d tables", tables_used);
}

ZTEST(arm64_mmu, test_arm64_mmu_02_single_block)
{
	/*
	 * Same thing as above, except that we expect a block mapping
	 * this time. Both addresses and the size must be properly aligned.
	 * Table allocation won't go as deep as for a page.
	 */
	int table_entries = CONFIG_MMU_PAGE_SIZE / sizeof(uint64_t);
	size_t block_size = table_entries * CONFIG_MMU_PAGE_SIZE;
	uintptr_t virt = TEST_VIRT_ADDR & ~(block_size - 1);
	uintptr_t phys = TEST_PHYS_ADDR & ~(block_size - 1);

	int tables_used = mem_map_test(virt, phys, block_size);

	zassert_true(tables_used == 1, "used %d tables", tables_used);
}

ZTEST(arm64_mmu, test_arm64_mmu_03_block_and_page)
{
	/*
	 * Same thing as above, except that we expect a block mapping
	 * followed by a page mapping to exercise range splitting.
	 * To achieve that we simply increase the size by one page and keep
	 * starting addresses aligned to a block.
	 */
	int table_entries = CONFIG_MMU_PAGE_SIZE / sizeof(uint64_t);
	size_t block_size = table_entries * CONFIG_MMU_PAGE_SIZE;
	uintptr_t virt = TEST_VIRT_ADDR & ~(block_size - 1);
	uintptr_t phys = TEST_PHYS_ADDR & ~(block_size - 1);
	size_t size = block_size + CONFIG_MMU_PAGE_SIZE;

	int tables_used = mem_map_test(virt, phys, size);

	zassert_true(tables_used == 2, "used %d tables", tables_used);
}

ZTEST(arm64_mmu, test_arm64_mmu_04_page_and_block)
{
	/*
	 * Same thing as above, except that we expect a page mapping
	 * followed by a block mapping to exercise range splitting.
	 * To achieve that we increase the size by one page and decrease
	 * starting addresses by one page below block alignment.
	 */
	int table_entries = CONFIG_MMU_PAGE_SIZE / sizeof(uint64_t);
	size_t block_size = table_entries * CONFIG_MMU_PAGE_SIZE;
	uintptr_t virt = (TEST_VIRT_ADDR & ~(block_size - 1)) - CONFIG_MMU_PAGE_SIZE;
	uintptr_t phys = (TEST_PHYS_ADDR & ~(block_size - 1)) - CONFIG_MMU_PAGE_SIZE;
	size_t size = block_size + CONFIG_MMU_PAGE_SIZE;

	int tables_used = mem_map_test(virt, phys, size);

	zassert_true(tables_used == 2, "used %d tables", tables_used);
}

ZTEST(arm64_mmu, test_arm64_mmu_05_hole_in_block)
{
	/*
	 * Create a block mapping.
	 */
	int table_entries = CONFIG_MMU_PAGE_SIZE / sizeof(uint64_t);
	size_t block_size = table_entries * CONFIG_MMU_PAGE_SIZE;
	uintptr_t virt = TEST_VIRT_ADDR & ~(block_size - 1);
	uintptr_t phys = TEST_PHYS_ADDR & ~(block_size - 1);
	size_t size = block_size;
	int ret;

	ret = arch_mem_map((void *)virt, phys, size, K_MEM_ARM_NORMAL_NC);
	zassert_ok(ret, "arch_mem_map() returned %d", ret);

	int mapped_nb_free_tables = arm64_mmu_nb_free_tables();
	int mapped_tables_usage = arm64_mmu_tables_total_usage();

	TC_PRINT("  After arch_mem_map:\n");
	TC_PRINT("   current free tables:        %d\n", mapped_nb_free_tables);
	TC_PRINT("   current total table usage:  %#x\n", mapped_tables_usage);

	zassert_true(mapped_nb_free_tables < initial_nb_free_tables,
		     "%d vs %d", mapped_nb_free_tables, initial_nb_free_tables);
	zassert_true(mapped_tables_usage > initial_tables_usage,
		     "%#x vs %#x", mapped_tables_usage, initial_tables_usage);

	/*
	 * Now poke a hole in the middle of this block mapping, effectively
	 * splitting it in two disjoint sub-mappings.
	 */
	ret = arch_mem_unmap((void *)(virt + CONFIG_MMU_PAGE_SIZE), CONFIG_MMU_PAGE_SIZE);
	zassert_ok(ret, "arch_mem_unmap() returned %d", ret);

	int split_nb_free_tables = arm64_mmu_nb_free_tables();
	int split_tables_usage = arm64_mmu_tables_total_usage();

	TC_PRINT("  After first arch_mem_unmap:\n");
	TC_PRINT("   current free tables:        %d\n", split_nb_free_tables);
	TC_PRINT("   current total table usage:  %#x\n", split_tables_usage);

	zassert_true(split_nb_free_tables < mapped_nb_free_tables,
		     "%d vs %d", split_nb_free_tables, mapped_nb_free_tables);
	zassert_true(split_tables_usage > mapped_tables_usage,
		     "%#x vs %#x", split_tables_usage, mapped_tables_usage);

	/*
	 * Make sure the hole is actually freed.
	 */
	zassert_true(arch_page_phys_get((void *)(virt + CONFIG_MMU_PAGE_SIZE), NULL)
		     == -EFAULT, "");

	/*
	 * Then free it all.
	 */
	ret = arch_mem_unmap((void *)virt, size);
	zassert_ok(ret, "arch_mem_unmap() returned %d", ret);

	int unmapped_nb_free_tables = arm64_mmu_nb_free_tables();
	int unmapped_tables_usage = arm64_mmu_tables_total_usage();

	TC_PRINT("  After second arch_mem_unmap:\n");
	TC_PRINT("   current free tables:        %d\n", unmapped_nb_free_tables);
	TC_PRINT("   current total table usage:  %#x\n", unmapped_tables_usage);

	zassert_true(unmapped_nb_free_tables == initial_nb_free_tables,
		     "%d vs %d", unmapped_nb_free_tables, initial_nb_free_tables);
	zassert_true(unmapped_tables_usage == initial_tables_usage,
		     "%#x vs %#x", unmapped_tables_usage, initial_tables_usage);
}

ZTEST_SUITE(arm64_mmu, NULL, arm64_mmu_test_init, NULL, NULL, NULL);
```

## src/domain_attrs.c
```c
/*
 * Copyright (c) 2026 BayLibre, SAS
 *
 * SPDX-License-Identifier: Apache-2.0
 */

/*
 * A domain-private mapping is built over whatever the kernel already has
 * mapped for the range. Which bits come from the partition and which are
 * kept from the kernel entry is the contract these tests pin down: the
 * partition grants access, the entry says what the memory is and where it
 * lives.
 */

#include <zephyr/kernel.h>
#include <zephyr/ztest.h>
#include <kernel_arch_interface.h>
#include <arch/arm64/core/mmu.h>

/* test hooks in arch/arm64/core/mmu.c */
extern int arm64_mmu_pte_get(struct arm_mmu_ptables *ptables, uintptr_t virt, uint64_t *desc,
			     unsigned int *level);

/*
 * Arbitrary addresses well away from anything the image maps, with the
 * virtual address deliberately different from the physical one.
 */
#define TEST_VIRT	0x556560000
#define TEST_PHYS	0x223230000
#define TEST_SIZE	CONFIG_MMU_PAGE_SIZE

#define MEMTYPE_MASK	(PTE_BLOCK_DESC_MEMTYPE(7) | PTE_BLOCK_DESC_INNER_SHARE)

static struct k_mem_domain test_domain;

static uint64_t kernel_pte(uintptr_t virt)
{
	unsigned int level;
	uint64_t desc;

	zassert_ok(arm64_mmu_pte_get(NULL, virt, &desc, &level),
		   "no kernel entry for %#lx", virt);
	return desc;
}

static uint64_t domain_pte(uintptr_t virt)
{
	unsigned int level;
	uint64_t desc;

	zassert_ok(arm64_mmu_pte_get(&test_domain.arch.ptables, virt, &desc, &level),
		   "no domain entry for %#lx", virt);
	return desc;
}

static struct k_mem_partition test_part;

static void add_partition(uintptr_t virt, size_t size, k_mem_partition_attr_t attr)
{
	test_part.start = virt;
	test_part.size = size;
	test_part.attr = attr;

	zassert_ok(k_mem_domain_add_partition(&test_domain, &test_part),
		   "k_mem_domain_add_partition(%#lx) failed", virt);
}

static void before(void *unused)
{
	ARG_UNUSED(unused);
	test_part.size = 0;
	zassert_ok(k_mem_domain_init(&test_domain, 0, NULL), "k_mem_domain_init() failed");
}

static void after(void *unused)
{
	ARG_UNUSED(unused);

	if (test_part.size != 0) {
		(void)k_mem_domain_remove_partition(&test_domain, &test_part);
	}
	(void)k_mem_domain_deinit(&test_domain);
	arch_mem_unmap((void *)TEST_VIRT, TEST_SIZE);
}

/*
 * The partition grants access to what the kernel entry maps, so the output
 * address stays the kernel's physical address rather than becoming the
 * virtual one.
 */
ZTEST(arm64_mmu_domain, test_partition_keeps_output_address)
{
	arch_mem_map((void *)TEST_VIRT, TEST_PHYS, TEST_SIZE, K_MEM_PERM_RW);

	add_partition(TEST_VIRT, TEST_SIZE, K_MEM_PARTITION_P_RW_U_RW);

	uint64_t desc = domain_pte(TEST_VIRT);

	zassert_equal(desc & PTE_PHYSADDR_MASK, TEST_PHYS,
		      "output address %#llx, expected %#lx", desc & PTE_PHYSADDR_MASK, TEST_PHYS);
	zassert_true((desc & PTE_BLOCK_DESC_AP_ELx) != 0, "EL0 access not granted");
	zassert_true((desc & PTE_BLOCK_DESC_NG) != 0, "private mapping must be non-global");
	zassert_true((desc & PTE_BLOCK_DESC_AF) != 0, "access flag lost");
}

/*
 * A partition says who may touch the memory, not what the memory is, so the
 * memory type and shareability stay those of the kernel entry.
 */
ZTEST(arm64_mmu_domain, test_partition_keeps_memory_type)
{
	arch_mem_map((void *)TEST_VIRT, TEST_PHYS, TEST_SIZE, K_MEM_ARM_DEVICE_nGnRE);

	uint64_t kdesc = kernel_pte(TEST_VIRT);

	add_partition(TEST_VIRT, TEST_SIZE, K_MEM_PARTITION_P_RW_U_RW);

	uint64_t desc = domain_pte(TEST_VIRT);

	zassert_equal(desc & MEMTYPE_MASK, kdesc & MEMTYPE_MASK,
		      "memory type %#llx, expected %#llx", desc & MEMTYPE_MASK,
		      kdesc & MEMTYPE_MASK);
}

/* A read-only partition over writable memory is read-only to the domain. */
ZTEST(arm64_mmu_domain, test_partition_read_only)
{
	arch_mem_map((void *)TEST_VIRT, TEST_PHYS, TEST_SIZE, K_MEM_PERM_RW);

	add_partition(TEST_VIRT, TEST_SIZE, K_MEM_PARTITION_P_RO_U_RO);

	uint64_t desc = domain_pte(TEST_VIRT);

	zassert_true((desc & PTE_BLOCK_DESC_AP_RO) != 0, "partition is not read-only");
	zassert_true((desc & PTE_SW_WRITABLE) == 0, "read-only partition marked writable");
	zassert_true((desc & PTE_BLOCK_DESC_AP_ELx) != 0, "EL0 access not granted");
}

/*
 * Access can only be granted to memory that is actually mapped: a partition
 * over a range the kernel has nothing for leaves the domain with nothing.
 */
ZTEST(arm64_mmu_domain, test_partition_over_unmapped_range)
{
	unsigned int level;
	uint64_t desc;

	zassert_equal(arm64_mmu_pte_get(NULL, TEST_VIRT, &desc, &level), -ENOENT,
		      "test address is already mapped");

	add_partition(TEST_VIRT, TEST_SIZE, K_MEM_PARTITION_P_RW_U_RW);

	zassert_equal(arm64_mmu_pte_get(&test_domain.arch.ptables, TEST_VIRT, &desc, &level),
		      -ENOENT, "unmapped range gained a domain entry %#llx", desc);
}

/*
 * Removing a partition hands the range back to what the kernel has for it,
 * so the domain ends up with the kernel entry again.
 */
ZTEST(arm64_mmu_domain, test_partition_remove_restores_entry)
{
	arch_mem_map((void *)TEST_VIRT, TEST_PHYS, TEST_SIZE, K_MEM_PERM_RW);

	uint64_t kdesc = kernel_pte(TEST_VIRT);

	add_partition(TEST_VIRT, TEST_SIZE, K_MEM_PARTITION_P_RW_U_RW);
	zassert_not_equal(domain_pte(TEST_VIRT), kdesc, "partition did not change the entry");

	zassert_ok(k_mem_domain_remove_partition(&test_domain, &test_part));
	test_part.size = 0;

	zassert_equal(domain_pte(TEST_VIRT), kdesc,
		      "entry %#llx after removal, expected %#llx", domain_pte(TEST_VIRT), kdesc);
}

/*
 * A partition covering part of a block has to split it in the domain, and
 * only the covered part becomes reachable from EL0. The kernel keeps its
 * block: the split belongs to the domain.
 */
ZTEST(arm64_mmu_domain, test_partition_over_part_of_a_block)
{
	size_t block_size = (CONFIG_MMU_PAGE_SIZE / sizeof(uint64_t)) * CONFIG_MMU_PAGE_SIZE;
	uintptr_t virt = ROUND_DOWN(TEST_VIRT, block_size);
	uintptr_t phys = ROUND_DOWN(TEST_PHYS, block_size);
	uintptr_t outside = virt + block_size - CONFIG_MMU_PAGE_SIZE;
	unsigned int klevel, level;
	uint64_t kdesc;

	arch_mem_map((void *)virt, phys, block_size, K_MEM_PERM_RW);
	zassert_ok(arm64_mmu_pte_get(NULL, virt, &kdesc, &klevel));

	add_partition(virt, CONFIG_MMU_PAGE_SIZE, K_MEM_PARTITION_P_RW_U_RW);

	uint64_t covered, uncovered;

	zassert_ok(arm64_mmu_pte_get(&test_domain.arch.ptables, virt, &covered, &level));
	zassert_true(level > klevel, "block not split: level %u, kernel level %u", level, klevel);
	zassert_true((covered & PTE_BLOCK_DESC_AP_ELx) != 0, "covered page has no EL0 access");
	zassert_equal(covered & PTE_PHYSADDR_MASK, phys, "covered page moved");

	zassert_ok(arm64_mmu_pte_get(&test_domain.arch.ptables, outside, &uncovered, &level));
	zassert_true((uncovered & PTE_BLOCK_DESC_AP_ELx) == 0,
		     "EL0 access leaked to the rest of the block");
	zassert_equal(uncovered & PTE_PHYSADDR_MASK, phys + block_size - CONFIG_MMU_PAGE_SIZE,
		      "rest of the block moved");

	uint64_t kdesc_after;

	zassert_ok(arm64_mmu_pte_get(NULL, virt, &kdesc_after, &level));
	zassert_equal(kdesc_after, kdesc, "kernel entry changed by a domain partition");
	zassert_equal(level, klevel, "kernel block was split");

	(void)k_mem_domain_remove_partition(&test_domain, &test_part);
	test_part.size = 0;
	arch_mem_unmap((void *)virt, block_size);
}

ZTEST_SUITE(arm64_mmu_domain, NULL, NULL, before, after, NULL);
```
