/*
 * Copyright (c) 2020 Henrik Brix Andersen <henrik@brixandersen.dk>
 *
 * SPDX-License-Identifier: Apache-2.0
 */

/ {
	chosen {
		/* Cortex-M1 DTCM is No-Execute (NX). Use BRAM instead. */
		zephyr,sram = &bram0;
	};
};
