## CMakeLists.txt
```
# SPDX-FileCopyrightText: Copyright The Zephyr Project Contributors
# SPDX-License-Identifier: Apache-2.0

cmake_minimum_required(VERSION 3.28.0)
find_package(Zephyr REQUIRED HINTS $ENV{ZEPHYR_BASE})
project(isr_table_manual_vectors)

target_sources(app PRIVATE src/main.c)

add_custom_target(isr_manual_vectors_check ALL
  COMMAND ${PYTHON_EXECUTABLE} ${CMAKE_CURRENT_SOURCE_DIR}/check_vectors.py
          $<TARGET_FILE_DIR:${logical_target_for_zephyr_elf}>
  DEPENDS ${logical_target_for_zephyr_elf} ${CMAKE_CURRENT_SOURCE_DIR}/check_vectors.py
  VERBATIM
)
```

## prj.conf
```kconfig
# SPDX-FileCopyrightText: Copyright The Zephyr Project Contributors
# SPDX-License-Identifier: Apache-2.0

CONFIG_ISR_TABLES_LOCAL_DECLARATION=y
CONFIG_LTO=y
CONFIG_DYNAMIC_INTERRUPTS=n
CONFIG_SHARED_INTERRUPTS=n
```

## src/main.c
```c
/*
 * SPDX-FileCopyrightText: Copyright The Zephyr Project Contributors
 * SPDX-License-Identifier: Apache-2.0
 */

#include <zephyr/sys/util.h>

BUILD_ASSERT(IS_ENABLED(CONFIG_ISR_TABLES_LOCAL_DECLARATION));
BUILD_ASSERT(!IS_ENABLED(CONFIG_GEN_IRQ_VECTOR_TABLE));

/* Do not reference the manual table here: that would hide missing LTO roots. */
int main(void)
{
	return 0;
}
```
