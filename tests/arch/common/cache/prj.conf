## CMakeLists.txt
```
# SPDX-License-Identifier: Apache-2.0

cmake_minimum_required(VERSION 3.28.0)
find_package(Zephyr REQUIRED HINTS $ENV{ZEPHYR_BASE})
project(cache_api)

FILE(GLOB app_sources src/*.c)
target_sources(app PRIVATE ${app_sources})
```

## prj.conf
```kconfig
CONFIG_ZTEST=y
CONFIG_TEST_USERSPACE=y
CONFIG_CACHE_MANAGEMENT=y
CONFIG_DCACHE=y
```

## boards/qemu_cortex_a9.conf
```kconfig
CONFIG_CACHE_MANAGEMENT=y
```

## src/test_cache_api.c
```c
/*
 * Copyright (c) 2016 Intel Corporation
 *
 * SPDX-License-Identifier: Apache-2.0
 */

#include <zephyr/ztest.h>
#include <zephyr/cache.h>

/**
 * @brief Architecture cache management API tests
 * @defgroup tests_arch_cache_api Cache management API
 * @ingroup all_tests
 * @{
 */

#define SIZE	(4096)

static ZTEST_BMEM uint8_t user_buffer[SIZE];

/**
 * @brief Verify that the instruction-cache management API is callable and
 *        returns a supported status.
 *
 * @details
 * Exercises every instruction-cache maintenance entry point exposed by the
 * cache API. The purpose is to confirm that the architecture/SoC layer
 * provides a consistent implementation: each operation must either complete
 * successfully (0) or explicitly report that it is not supported (-ENOTSUP).
 * No other return value is acceptable. On platforms where the i-cache cannot
 * be operated on safely (e.g. Xtensa MMU, where the user buffer is not
 * executable and a range invalidate would raise an instruction-fetch
 * prohibited exception) the whole case is skipped to avoid partial coverage.
 *
 * Test steps:
 * - Skip the test on configurations where i-cache operations are unsafe.
 * - Call the whole-cache flush, invalidate and flush-and-invalidate ops.
 * - Call the by-range flush, invalidate and flush-and-invalidate ops over a
 *   known buffer.
 *
 * Expected result:
 * - Every call returns 0 or -ENOTSUP.
 *
 * @see sys_cache_instr_flush_all()
 * @see sys_cache_instr_invd_all()
 * @see sys_cache_instr_flush_and_invd_all()
 * @see sys_cache_instr_flush_range()
 * @see sys_cache_instr_invd_range()
 * @see sys_cache_instr_flush_and_invd_range()
 * @verifies ZEP-SRS-19-6
 * @verifies ZEP-SRS-19-17
 * @verifies ZEP-SRS-19-18
 * @verifies ZEP-SRS-19-19
 * @verifies ZEP-SRS-19-22
 */
ZTEST(cache_api, test_instr_cache_api)
{
	int ret;

#ifdef CONFIG_XTENSA_MMU
	/* With MMU enabled, user_buffer is not marked as executable.
	 * Invalidating the i-cache by region will cause an instruction
	 * fetch prohibited exception. So skip all i-cache tests,
	 * instead of just the range ones to avoid confusions of
	 * only running the test partially.
	 */
	ztest_test_skip();
#endif

	ret = sys_cache_instr_flush_all();
	zassert_true((ret == 0) || (ret == -ENOTSUP));

	ret = sys_cache_instr_invd_all();
	zassert_true((ret == 0) || (ret == -ENOTSUP));

	ret = sys_cache_instr_flush_and_invd_all();
	zassert_true((ret == 0) || (ret == -ENOTSUP));

	ret = sys_cache_instr_flush_range(user_buffer, SIZE);
	zassert_true((ret == 0) || (ret == -ENOTSUP));

	ret = sys_cache_instr_invd_range(user_buffer, SIZE);
	zassert_true((ret == 0) || (ret == -ENOTSUP));

	ret = sys_cache_instr_flush_and_invd_range(user_buffer, SIZE);
	zassert_true((ret == 0) || (ret == -ENOTSUP));
}

/**
 * @brief Verify that the data-cache management API is callable and returns a
 *        supported status.
 *
 * @details
 * Exercises the data-cache maintenance entry points from supervisor mode.
 * Each operation must either complete successfully (0) or report that it is
 * not supported (-ENOTSUP); any other value indicates a broken
 * architecture/SoC cache backend. Both whole-cache and by-range variants are
 * covered so a platform that implements one granularity but not the other is
 * still validated.
 *
 * Test steps:
 * - Call the whole-cache flush, invalidate and flush-and-invalidate ops. The
 *   invalidate is issued after a flush so it cannot drop dirty lines the
 *   framework still relies on.
 * - Call the by-range flush, invalidate and flush-and-invalidate ops over a
 *   known buffer.
 *
 * Expected result:
 * - Every call returns 0 or -ENOTSUP.
 *
 * @see sys_cache_data_flush_all()
 * @see sys_cache_data_invd_all()
 * @see sys_cache_data_flush_and_invd_all()
 * @see sys_cache_data_flush_range()
 * @see sys_cache_data_invd_range()
 * @see sys_cache_data_flush_and_invd_range()
 * @verifies ZEP-SRS-19-5
 * @verifies ZEP-SRS-19-7
 * @verifies ZEP-SRS-19-15
 * @verifies ZEP-SRS-19-16
 * @verifies ZEP-SRS-19-21
 */
ZTEST(cache_api, test_data_cache_api)
{
	int ret;

	ret = sys_cache_data_flush_all();
	zassert_true((ret == 0) || (ret == -ENOTSUP));

#if !defined(CONFIG_XTENSA)
	/* Xtensa with Windowed ABI may write to stack due to window
	 * over-/under-flow. So we cannot invalidate all cache lines here
	 * or the data written will be lost forever, which will possibly
	 * result in CPU fault. So skip this test on Xtensa.
	 */

	/* Flush first so the whole-cache invalidate does not discard dirty
	 * lines that the test framework still depends on.
	 */
	ret = sys_cache_data_invd_all();
	zassert_true((ret == 0) || (ret == -ENOTSUP));
#endif /* !CONFIG_XTENSA */

	ret = sys_cache_data_flush_and_invd_all();
	zassert_true((ret == 0) || (ret == -ENOTSUP));

	ret = sys_cache_data_flush_range(user_buffer, SIZE);
	zassert_true((ret == 0) || (ret == -ENOTSUP));

	ret = sys_cache_data_invd_range(user_buffer, SIZE);
	zassert_true((ret == 0) || (ret == -ENOTSUP));

	ret = sys_cache_data_flush_and_invd_range(user_buffer, SIZE);
	zassert_true((ret == 0) || (ret == -ENOTSUP));

}

/**
 * @brief Verify that the by-range data-cache API is callable from user mode.
 *
 * @details
 * Repeats the by-range data-cache maintenance operations from an unprivileged
 * (user-mode) thread to confirm they are reachable without faulting and honor
 * the same return-value contract as in supervisor mode. The buffer operated on
 * lives in user-accessible memory (ZTEST_BMEM). Only the range variants are
 * exercised, since those are the operations a user thread can legitimately
 * request against its own buffer.
 *
 * Test steps:
 * - From a user-mode thread, call the by-range data-cache flush, invalidate
 *   and flush-and-invalidate ops over a user-accessible buffer.
 *
 * Expected result:
 * - Every call returns 0 or -ENOTSUP, and no user-mode fault occurs.
 *
 * @see sys_cache_data_flush_range()
 * @see sys_cache_data_invd_range()
 * @see sys_cache_data_flush_and_invd_range()
 * @verifies ZEP-SRS-19-5
 * @verifies ZEP-SRS-19-15
 * @verifies ZEP-SRS-19-16
 */
ZTEST_USER(cache_api, test_data_cache_api_user)
{
	int ret;

	ret = sys_cache_data_flush_range(user_buffer, SIZE);
	zassert_true((ret == 0) || (ret == -ENOTSUP));

	ret = sys_cache_data_invd_range(user_buffer, SIZE);
	zassert_true((ret == 0) || (ret == -ENOTSUP));

	ret = sys_cache_data_flush_and_invd_range(user_buffer, SIZE);
	zassert_true((ret == 0) || (ret == -ENOTSUP));
}

static void *cache_api_setup(void)
{
	sys_cache_data_disable();
	sys_cache_data_flush_all();
	sys_cache_data_enable();
	sys_cache_instr_enable();

	return NULL;
}

static void cache_api_teardown(void *unused)
{
	sys_cache_data_disable();
	sys_cache_instr_disable();
}

ZTEST_SUITE(cache_api, NULL, cache_api_setup, NULL, NULL, cache_api_teardown);

/**
 * @}
 */
```

## src/test_dcache_line_align.c
```c
/*
 * SPDX-FileCopyrightText: Copyright The Zephyr Project Contributors
 *
 * SPDX-License-Identifier: Apache-2.0
 */

#if defined(CONFIG_DCACHE_LINE_SIZE)

#include <zephyr/ztest.h>
#include <zephyr/cache.h>
#include <zephyr/linker/sections.h>
#include <zephyr/linker/linker-defs.h>

#define DCACHE_LINE_SIZE CONFIG_DCACHE_LINE_SIZE

/**
 * @brief DCache line alignment attributes tests
 * @defgroup tests_dcache_line DCache line alignment attributes
 * @ingroup all_tests
 * @{
 */

BUILD_ASSERT((DCACHE_LINE_SIZE & (DCACHE_LINE_SIZE - 1)) == 0,
	     "CONFIG_DCACHE_LINE_SIZE must be a power of 2");

static uint8_t var_aligned1 __dcacheline_aligned;
static uint8_t var_aligned2[5] __dcacheline_aligned;
static uint8_t var_control1;

ZTEST(dcache_line_align, test_dcacheline_aligned)
{
	zassert_true(IS_ALIGNED(&var_aligned1, DCACHE_LINE_SIZE));
	zassert_true(IS_ALIGNED(var_aligned2, DCACHE_LINE_SIZE));
	zassert_false(IS_ALIGNED(&var_aligned1 + 1, DCACHE_LINE_SIZE));

	var_aligned1 = 4;
	var_aligned2[0] = 5;
	var_control1 = 6;

	zassert_equal(var_aligned1, 4);
	zassert_equal(var_aligned2[0], 5);
	zassert_equal(var_control1, 6);
}

struct exclusive_obj_desc {
	const void *addr;
	size_t size;
};

static uintptr_t cacheline_start(const void *ptr)
{
	return ROUND_DOWN((uintptr_t)ptr, DCACHE_LINE_SIZE);
}

static uintptr_t cacheline_end(const void *ptr, size_t size)
{
	return ROUND_UP((uintptr_t)ptr + size, DCACHE_LINE_SIZE);
}

static bool ranges_overlap(uintptr_t start_a, uintptr_t end_a,
			   uintptr_t start_b, uintptr_t end_b)
{
	return (start_a < end_b) && (start_b < end_a);
}

static void assert_obj_in_section(const void *ptr, uintptr_t section_start,
				  uintptr_t section_end)
{
	uintptr_t addr = (uintptr_t)ptr;

	zassert_true(addr >= section_start,
		     "object at 0x%lx is below section start 0x%lx",
		     (unsigned long)addr, (unsigned long)section_start);
	zassert_true(addr < section_end,
		     "object at 0x%lx is at/after section end 0x%lx",
		     (unsigned long)addr, (unsigned long)section_end);
}

static void assert_obj_not_in_section(const void *ptr, uintptr_t section_start,
				      uintptr_t section_end)
{
	uintptr_t addr = (uintptr_t)ptr;

	zassert_true((addr < section_start) || (addr >= section_end),
		     "control object at 0x%lx unexpectedly landed in [0x%lx, 0x%lx)",
		     (unsigned long)addr,
		     (unsigned long)section_start,
		     (unsigned long)section_end);
}

static void assert_exclusive_layout(const struct exclusive_obj_desc *objs,
				    size_t count)
{
	for (size_t i = 0; i < count; i++) {
		uintptr_t start_i = cacheline_start(objs[i].addr);
		uintptr_t end_i = cacheline_end(objs[i].addr, objs[i].size);

		zassert_true(IS_ALIGNED(objs[i].addr, DCACHE_LINE_SIZE),
			     "object %d is not cache-line aligned", (int)i);
		zassert_true(end_i > start_i,
			     "object %d has invalid cache-line coverage", (int)i);

		for (size_t j = i + 1; j < count; j++) {
			uintptr_t start_j = cacheline_start(objs[j].addr);
			uintptr_t end_j = cacheline_end(objs[j].addr, objs[j].size);

			zassert_false(ranges_overlap(start_i, end_i, start_j, end_j),
				      "exclusive objects %d and %d share cache-line range",
				      (int)i, (int)j);
		}
	}
}

/*
 * Boundary-sized exclusive noinit objects:
 * - 1 byte
 * - line_size - 1
 * - line_size
 * - line_size + 1
 * - 2 * line_size + 3
 */
static uint8_t var_exclusive_noinit1[1] __dcacheline_exclusive_noinit;
static uint8_t var_exclusive_noinit2[DCACHE_LINE_SIZE - 1] __dcacheline_exclusive_noinit;
static uint8_t var_exclusive_noinit3[DCACHE_LINE_SIZE] __dcacheline_exclusive_noinit;
static uint8_t var_exclusive_noinit4[DCACHE_LINE_SIZE + 1] __dcacheline_exclusive_noinit;
static uint8_t var_exclusive_noinit5[(2 * DCACHE_LINE_SIZE) + 3] __dcacheline_exclusive_noinit;

static uint8_t var_control_noinit;
static uint8_t var_control_data = 11;

ZTEST(dcache_line_align, test_dcacheline_exclusive_noinit)
{
	static const struct exclusive_obj_desc objs[] = {
		{var_exclusive_noinit1, sizeof(var_exclusive_noinit1)},
		{var_exclusive_noinit2, sizeof(var_exclusive_noinit2)},
		{var_exclusive_noinit3, sizeof(var_exclusive_noinit3)},
		{var_exclusive_noinit4, sizeof(var_exclusive_noinit4)},
		{var_exclusive_noinit5, sizeof(var_exclusive_noinit5)},
	};
	uintptr_t sec_start = (uintptr_t)__dcacheline_exclusive_noinit_start;
	uintptr_t sec_end = (uintptr_t)__dcacheline_exclusive_noinit_end;

	zassert_true(IS_ALIGNED(sec_start, DCACHE_LINE_SIZE));
	zassert_true(IS_ALIGNED(sec_end, DCACHE_LINE_SIZE));
	zassert_true(sec_end > sec_start);

	zassert_true(sec_start >= (uintptr_t)__noinit_start);
	zassert_true(sec_end <= (uintptr_t)__noinit_end);

	for (size_t i = 0; i < ARRAY_SIZE(objs); i++) {
		assert_obj_in_section(objs[i].addr, sec_start, sec_end);
	}

	assert_obj_not_in_section(&var_control_noinit, sec_start, sec_end);
	assert_obj_not_in_section(&var_control_data, sec_start, sec_end);

	assert_exclusive_layout(objs, ARRAY_SIZE(objs));

	var_exclusive_noinit1[0] = 1;
	var_exclusive_noinit2[0] = 2;
	var_exclusive_noinit3[DCACHE_LINE_SIZE - 1] = 3;
	var_exclusive_noinit4[DCACHE_LINE_SIZE] = 4;
	var_exclusive_noinit5[(2 * DCACHE_LINE_SIZE) + 2] = 5;
	var_control_noinit = 6;

	zassert_equal(var_exclusive_noinit1[0], 1);
	zassert_equal(var_exclusive_noinit2[0], 2);
	zassert_equal(var_exclusive_noinit3[DCACHE_LINE_SIZE - 1], 3);
	zassert_equal(var_exclusive_noinit4[DCACHE_LINE_SIZE], 4);
	zassert_equal(var_exclusive_noinit5[(2 * DCACHE_LINE_SIZE) + 2], 5);
	zassert_equal(var_control_noinit, 6);
}

/*
 * Boundary-sized exclusive data objects:
 * - 1 byte
 * - line_size - 1
 * - line_size
 * - line_size + 1
 * - 2 * line_size + 3
 */
static uint8_t var_exclusive_data1[1] __dcacheline_exclusive_data = { 9 };
static uint8_t var_exclusive_data2[DCACHE_LINE_SIZE - 1] __dcacheline_exclusive_data = { 4 };
static uint8_t var_exclusive_data3[DCACHE_LINE_SIZE] __dcacheline_exclusive_data = { 7 };
static uint8_t var_exclusive_data4[DCACHE_LINE_SIZE + 1] __dcacheline_exclusive_data = { 1 };
static uint8_t var_exclusive_data5[(2 * DCACHE_LINE_SIZE) + 3] __dcacheline_exclusive_data = { 2 };

ZTEST(dcache_line_align, test_dcacheline_exclusive_data)
{
	static const struct exclusive_obj_desc objs[] = {
		{ var_exclusive_data1, sizeof(var_exclusive_data1) },
		{ var_exclusive_data2, sizeof(var_exclusive_data2) },
		{ var_exclusive_data3, sizeof(var_exclusive_data3) },
		{ var_exclusive_data4, sizeof(var_exclusive_data4) },
		{ var_exclusive_data5, sizeof(var_exclusive_data5) },
	};
	uintptr_t sec_start = (uintptr_t)__dcacheline_exclusive_data_start;
	uintptr_t sec_end = (uintptr_t)__dcacheline_exclusive_data_end;

	zassert_true(IS_ALIGNED(sec_start, DCACHE_LINE_SIZE));
	zassert_true(IS_ALIGNED(sec_end, DCACHE_LINE_SIZE));
	zassert_true(sec_end > sec_start);

#ifdef CONFIG_XIP
	zassert_true(sec_start >= (uintptr_t)__data_region_start);
	zassert_true(sec_end <= (uintptr_t)__data_region_end);
#endif

	for (size_t i = 0; i < ARRAY_SIZE(objs); i++) {
		assert_obj_in_section(objs[i].addr, sec_start, sec_end);
	}

	assert_obj_not_in_section(&var_control_data, sec_start, sec_end);
	assert_obj_not_in_section(&var_control_noinit, sec_start, sec_end);

	assert_exclusive_layout(objs, ARRAY_SIZE(objs));

	zassert_equal(var_exclusive_data1[0], 9);
	zassert_equal(var_exclusive_data2[0], 4);
	zassert_equal(var_exclusive_data3[0], 7);
	zassert_equal(var_exclusive_data4[0], 1);
	zassert_equal(var_exclusive_data5[0], 2);
	zassert_equal(var_control_data, 11);
}

ZTEST_SUITE(dcache_line_align, NULL, NULL, NULL, NULL, NULL);

/**
 * @}
 */

#endif /* CONFIG_DCACHE_LINE_SIZE */
```
