/*
 * Copyright (c) 2022 Nordic Semiconductor ASA
 * SPDX-License-Identifier: Apache-2.0
 */

/ {
	framebuffer {
		compatible = "intel,multiboot-framebuffer";
		width = <640>;
		height = <480>;
	};
};
