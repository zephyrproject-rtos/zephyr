## CMakeLists.txt
```
# SPDX-License-Identifier: Apache-2.0
# Copyright (c) 2019 Intel Corp.

cmake_minimum_required(VERSION 3.28.0)

find_package(Zephyr REQUIRED HINTS $ENV{ZEPHYR_BASE})
project(x86_info)

target_sources(app PRIVATE src/main.c)
target_sources(app PRIVATE src/timer.c)
target_sources_ifdef(CONFIG_ACPI app PRIVATE src/acpi.c)
target_sources_ifdef(CONFIG_MULTIBOOT app PRIVATE src/multiboot.c)
target_sources_ifdef(CONFIG_X86_MEMMAP app PRIVATE src/memmap.c)
```

## prj.conf
```kconfig
CONFIG_ACPI=y
CONFIG_MULTIBOOT_INFO=y
CONFIG_MULTIBOOT_MEMMAP=y
CONFIG_COUNTER=y
CONFIG_COUNTER_CMOS=y
CONFIG_DISPLAY=y
CONFIG_X86_MEMMAP=y
```

## app.overlay
```dts
/*
 * Copyright (c) 2022 Nordic Semiconductor ASA
 * SPDX-License-Identifier: Apache-2.0
 */

/ {
	framebuffer {
		compatible = "intel,multiboot-framebuffer";
		width = <640>;
		height = <480>;
	};
};
```

## src/main.c
```c
/*
 * SPDX-License-Identifier: Apache-2.0
 * Copyright (c) 2019 Intel Corp.
 */

#include <zephyr/kernel.h>
#include "info.h"

__weak void multiboot(void)
{
	printk("MULTIBOOT: Not supported in this build.\n\n");
}

__weak void memmap(void)
{
	printk("MEMMAP: Not supported in this build.\n\n");
}

__weak void acpi(void)
{
	printk("ACPI: Not supported in this build.\n\n");
}

int main(void)
{
	printk("\n\ninfo: the Zephyr x86 platform information tool\n\n");

	multiboot();
	memmap();
	acpi();
	timer();

	printk("info: complete\n");
	return 0;
}
```

## src/acpi.c
```c
/*
 * SPDX-License-Identifier: Apache-2.0
 * Copyright (c) 2019 Intel Corp.
 */

#include <zephyr/kernel.h>
#include <zephyr/acpi/acpi.h>

static const char *get_dmar_scope_type(int type)
{
	switch (type) {
	case ACPI_DMAR_SCOPE_TYPE_ENDPOINT:
		return "PCI Endpoint";
	case ACPI_DMAR_SCOPE_TYPE_BRIDGE:
		return "PCI Sub-hierarchy";
	case ACPI_DMAR_SCOPE_TYPE_IOAPIC:
		return "IOAPIC";
	case ACPI_DMAR_SCOPE_TYPE_HPET:
		return "MSI Capable HPET";
	case ACPI_DMAR_SCOPE_TYPE_NAMESPACE:
		return "ACPI name-space enumerated";
	default:
		return "unknown";
	}
}

static void dmar_devsope_handler(ACPI_DMAR_DEVICE_SCOPE *devscope, void *arg)
{
	ARG_UNUSED(arg);

	printk("\t\t\t. Scope type %s\n", get_dmar_scope_type(devscope->EntryType));
	printk("\t\t\t. Enumeration ID %u\n", devscope->EnumerationId);

	if (devscope->EntryType < ACPI_DMAR_SCOPE_TYPE_RESERVED) {
		ACPI_DMAR_PCI_PATH *devpath;
		int num_path = (devscope->Length - 6u) / 2u;
		int i = 0;

		devpath = ACPI_ADD_PTR(ACPI_DMAR_PCI_PATH, devscope,
				       sizeof(ACPI_DMAR_DEVICE_SCOPE));

		while (num_path--) {
			printk("\t\t\t. PCI Path %02x:%02x.%02x\n", devscope->Bus,
			       devpath[i].Device, devpath[i].Function);
		}
	}
}

static void vtd_drhd_info(ACPI_DMAR_HEADER *subtable)
{
	struct acpi_dmar_hardware_unit *drhd = (void *)subtable;
	static int unit;

	printk("\t\t[ Hardware Unit Definition %d ]\n", unit++);

	if (drhd->Flags & ACPI_DRHD_FLAG_INCLUDE_PCI_ALL) {
		printk("\t\t- Includes all PCI devices");
	} else {
		printk("\t\t- Includes only listed PCI devices");
	}

	printk(" under given Segment\n");

	printk("\t\t- Segment number %u\n", drhd->Segment);
	printk("\t\t- Base Address 0x%llx\n", drhd->Address);

	printk("\t\t- Device Scopes:\n");

	acpi_dmar_foreach_devscope(drhd, dmar_devsope_handler, NULL);
}

static void dmar_subtable_handler(ACPI_DMAR_HEADER *subtable, void *arg)
{
	ARG_UNUSED(arg);

	if (subtable->Type != ACPI_DMAR_TYPE_HARDWARE_UNIT) {
		return;
	}

	vtd_drhd_info(subtable);
}

static void vtd_info(void)
{
	struct acpi_table_dmar *dmar;

	dmar = acpi_table_get("DMAR", 0);
	if (dmar == NULL) {
		printk("\tIntel VT-D not supported or exposed\n");
		return;
	}

	printk("\tIntel VT-D Supported:\n");

	printk("\t-> X2APIC ");
	if (dmar->Flags & ACPI_DMAR_FLAG_X2APIC_OPT_OUT) {
		printk("should be opted out\n");
	} else {
		printk("does not need to be opted out\n");
	}

	if (dmar->Flags & ACPI_DMAR_FLAG_INTR_REMAP) {
		printk("\t-> Interrupt remapping supported\n");
		acpi_dmar_foreach_subtable(dmar, dmar_subtable_handler, NULL);
	} else {
		printk("\t-> Interrupt remapping not supported\n");
	}
}

void acpi(void)
{
	int nr_cpus;

	for (nr_cpus = 0; acpi_local_apic_get(nr_cpus); ++nr_cpus) {
		/* count number of CPUs present */
	}

	if (nr_cpus == 0) {
		printk("ACPI: no RSDT/MADT found\n\n");
	} else {
		printk("ACPI: %d CPU%s found\n", nr_cpus, nr_cpus == 1 ? "" : "s");

		for (int i = 0; i < nr_cpus; ++i) {
			struct acpi_madt_local_apic *cpu = acpi_local_apic_get(i);

			printk("\tCPU #%d: APIC ID 0x%02x\n", i, cpu->Id);
		}
	}

	printk("\n");

	vtd_info();

	printk("\n");
}
```

## src/early_serial.c
```c
/*
 * Copyright (c) 2021 Intel Corporation
 *
 * SPDX-License-Identifier: Apache-2.0
 */

#include <zephyr.h>
#include <sys/printk.h>

extern int arch_printk_char_out(int c);
extern void __printk_hook_install(int (*fn)(int));

/**
 * @brief Test arch_printk_char_out() on x86 platform
 *
 * @details Register function arch_printk_char_out() using
 * __printk_hook_install, then the prink() will use
 * arch_printk_char_out() to put character to console.
 * Check if the character string "Successful!" is send out.
 */
void early_serial(void)
{
	printk("\ntest early serial\n");
	__printk_hook_install(arch_printk_char_out);
}
```

## src/info.h
```c
/*
 * SPDX-License-Identifier: Apache-2.0
 * Copyright (c) 2019 Intel Corp.
 */

extern void multiboot(void);
extern void acpi(void);
extern void timer(void);
extern void memmap(void);
```

## src/memmap.c
```c
/*
 * SPDX-License-Identifier: Apache-2.0
 * Copyright (c) 2019 Intel Corp.
 */

#include <zephyr/kernel.h>
#include <zephyr/arch/x86/memmap.h>

void memmap(void)
{
	printk("MEMORY MAP: source is ");

	switch (x86_memmap_source) {
	case X86_MEMMAP_SOURCE_DEFAULT:
		printk("default");
		break;
	case X86_MEMMAP_SOURCE_MULTIBOOT_MEM:
		printk("Multiboot basic map");
		break;
	case X86_MEMMAP_SOURCE_MULTIBOOT_MMAP:
		printk("Multiboot extended map");
		break;
	case X86_MEMMAP_SOURCE_MANUAL:
		printk("manual");
		break;
	default:
		printk("unknown");
	}

	printk(", max %d entries\n", CONFIG_X86_MEMMAP_ENTRIES);

	for (int i = 0; i < CONFIG_X86_MEMMAP_ENTRIES; ++i) {
		struct x86_memmap_entry *entry = x86_memmap + i;
		const char *label;

		switch (entry->type) {
		case X86_MEMMAP_ENTRY_UNUSED:
			continue;
		case X86_MEMMAP_ENTRY_RAM:
			label = "RAM";
			break;
		case X86_MEMMAP_ENTRY_ACPI:
			label = "ACPI";
			break;
		case X86_MEMMAP_ENTRY_NVS:
			label = "NVS";
			break;
		case X86_MEMMAP_ENTRY_DEFECTIVE:
			label = "DEFECTIVE";
			break;
		default:
			label = "UNKNOWN";
		}

		printk("\t%016llx -> %016llx %s (%lldK)\n",
			entry->base, entry->base + entry->length - 1,
			label,
			entry->length / 1024);
	}

	printk("\n\tKernel exclusions:\n");

	for (int i = 0; i < x86_nr_memmap_exclusions; ++i) {
		printk("\t%p -> %p (%s)\n",
			x86_memmap_exclusions[i].start,
			x86_memmap_exclusions[i].end,
			x86_memmap_exclusions[i].name);
	}

	printk("\n");
}
```

## src/multiboot.c
```c
/*
 * SPDX-License-Identifier: Apache-2.0
 * Copyright (c) 2019 Intel Corp.
 */

#include <zephyr/kernel.h>
#include <zephyr/arch/x86/multiboot.h>

void multiboot(void)
{
#ifndef CONFIG_MULTIBOOT_INFO
	printk("MULTIBOOT: info struct NOT preserved.\n\n");
#else
	/*
	 * If flags == 0, then either we didn't copy the flags from a real
	 * multiboot info struct because the loader didn't provide one, or
	 * (highly unlikely) we DID get a valid struct, but it was empty.
	 */

	if (!multiboot_info.flags) {
		printk("MULTIBOOT: info struct UNAVAILABLE or EMPTY.\n\n");
	} else {
		printk("MULTIBOOT: boot info structure available.\n");
		printk("\tFlags = 0x%08x\n", multiboot_info.flags);
	}

	if (multiboot_info.flags & MULTIBOOT_INFO_FLAGS_MEM) {
		printk("\tBasic memory map: lower = %dK, upper = %dK.\n",
			multiboot_info.mem_lower,
			multiboot_info.mem_upper);
	} else {
		printk("\tNo basic memory map available.\n");
	}

	if (multiboot_info.flags & MULTIBOOT_INFO_FLAGS_MMAP) {
		printk("\tExtended memory map was at 0x%08x (%d bytes).\n",
			multiboot_info.mmap_addr,
			multiboot_info.mmap_length);
	} else {
		printk("\tNo extended memory map available.\n");
	}

	if (multiboot_info.flags & MULTIBOOT_INFO_FLAGS_FB) {
		printk("\tFramebuffer %dbpp %dX%d (pitch %d) @ %08x.\n",
			multiboot_info.fb_bpp,
			multiboot_info.fb_width,
			multiboot_info.fb_height,
			multiboot_info.fb_pitch,
			multiboot_info.fb_addr_lo);
	} else {
		printk("\tFramebuffer data not present.\n");
	}
#endif
	printk("\n");
}
```

## src/timer.c
```c
/*
 * SPDX-License-Identifier: Apache-2.0
 * Copyright (c) 2019 Intel Corp.
 */

#include <zephyr/kernel.h>
#include <zephyr/device.h>
#include <zephyr/drivers/counter.h>

#define NR_SAMPLES 10	/* sample timer 10 times */

#if defined(CONFIG_COUNTER_CMOS)
static uint32_t sync(const struct device *cmos)
{
	uint32_t this, last;
	int err;

	err = counter_get_value(cmos, &this);
	if (err) {
		printk("\tCan't read CMOS clock device.\n");
		return 0;
	}

	do {
		last = this;
		err = counter_get_value(cmos, &this);
		if (err) {
			printk("\tCan't read CMOS clock device.\n");
			return 0;
		}
	} while (last == this);

	return sys_clock_cycle_get_32();
}
#endif

void timer(void)
{
#if defined(CONFIG_APIC_TIMER)
	printk("TIMER: new local APIC");
#elif defined(CONFIG_HPET_TIMER)
	printk("TIMER: HPET");
#else
	printk("TIMER: unknown");
#endif

	printk(", configured frequency = %uHz\n",
		sys_clock_hw_cycles_per_sec());

#if defined(CONFIG_COUNTER_CMOS)
	const struct device *const cmos = DEVICE_DT_GET_ONE(motorola_mc146818);

	if (!device_is_ready(cmos)) {
		printk("\tCMOS clock device is not ready.\n");
	} else {
		uint64_t sum = 0;

		printk("\tUsing CMOS RTC as reference clock:\n");

		for (int i = 0; i < NR_SAMPLES; ++i) {
			uint32_t start, end;

			start = sync(cmos);
			end = sync(cmos);
			sum += end - start;

			printk("\tstart = %u, end = %u, %u cycles\n",
				start, end, end - start);
		}

		printk("\taverage = %uHz\n", (unsigned) (sum / NR_SAMPLES));
	}
#endif

	printk("\n");
}
```
