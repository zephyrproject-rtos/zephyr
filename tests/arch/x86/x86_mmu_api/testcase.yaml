## tests/benchmarks/latency_measure/boards/mec1501modular_assy6885.conf
```kconfig
# Disable power management to prevent SoC from sleeping.
# The test would not finish otherwise as there is no external
# interrupts to wake up the SoC.
# This board has an extra option to control PM, so need to
# disable it here.
CONFIG_PM=n
```

## tests/benchmarks/latency_measure/boards/qemu_riscv64_qemu_virt_riscv64_smp.conf
```kconfig
CONFIG_MP_MAX_NUM_CPUS=8

# To support the amount of thread objects in userspace
CONFIG_MAX_THREAD_BYTES=3
```
