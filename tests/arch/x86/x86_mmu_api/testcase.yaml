## tests/arch/x86/x86_mmu_api/testcase.yaml
```yaml
tests:
  kernel.memory_protection.mmu:
    platform_whitelist: qemu_x86
    tags: kernel
```

## tests/arch/xtensa/load_store_emulation/Kconfig
```kconfig
# SPDX-License-Identifier: Apache-2.0
# Copyright (c) 2026 Intel Corporation.

mainmenu "Load / store emulation test"

source "Kconfig.zephyr"

config TEST_IRAM_SECTION
	string "IRAM section for test"
	default ".iram.data"
	help
	  The section name to place the test's IRAM buffer. This section should
	  be placed in IRAM by the linker script.
```

## tests/arch/xtensa/save_restore_hifi/testcase.yaml
```yaml
tests:
  arch.xtensa.save_restore_hifi.eager.mtl:
    platform_allow:
      - intel_adsp/ace15_mtpm
    tags:
      - kernel
    ignore_faults: true
    extra_configs:
      - CONFIG_XTENSA_EAGER_HIFI_SHARING=y
  arch.xtensa.save_restore_hifi.lazy.ptl:
    platform_allow:
      - intel_adsp/ace30/ptl
    tags:
      - kernel
    ignore_faults: true
    extra_configs:
      - CONFIG_XTENSA_LAZY_HIFI_SHARING=y
```

## tests/benchmark/object_footprint/Kconfig
```kconfig
mainmenu "Zephyr Object Sizes"

config ZEPHYR_BASE
	string
	option env="ZEPHYR_BASE"

config APPLICATION_BASE
	string
	option env="PROJECT_BASE"

source "$ZEPHYR_BASE/Kconfig.zephyr"

config OBJECTS_PRINTK
	bool "use printk"
	default n

config OBJECTS_WHILELOOP
	bool "run whileloop"
	default y

config OBJECTS_FIBER
	bool "enable fiber"
	default n

config OBJECTS_SEMAPHORE
	bool "enable semphore"
	default n

config OBJECTS_LIFO
	bool "enable lifo"
	default n

config OBJECTS_FIFO
	bool "enable fifo"
	default n

config OBJECTS_STACK
	bool "enable stack"
	default n

config OBJECTS_TIMER
	bool "enable timer"
	default n

config FIBER_STACK_SIZE
	int "set fiber stack size"
	default 512
	depends on OBJECTS_FIBER

config STATIC_ISR
	bool "static isr"
	default y
```

## tests/benchmarks/app_kernel/Kconfig
```kconfig
# Copyright (c) 2024 Enphase Energy
# SPDX-License-Identifier: Apache-2.0

# Minimize timer interrupts during the benchmark. Without
# overflowing timer calculations (e.g. Cortex-M 24bit systick).
config SYS_CLOCK_TICKS_PER_SEC
	default 1000 if CORTEX_M_SYSTICK && SYS_CLOCK_HW_CYCLES_PER_SEC > 800000000
	default 100  if CORTEX_M_SYSTICK && SYS_CLOCK_HW_CYCLES_PER_SEC > 80000000
	default 10   if CORTEX_M_SYSTICK && SYS_CLOCK_HW_CYCLES_PER_SEC > 8000000
	default 1

source "Kconfig.zephyr"
```

## tests/benchmarks/app_kernel/testcase.yaml
```yaml
common:
  tags:
    - benchmark
    - kernel
  timeout: 420
  min_flash: 34
  min_ram: 128
tests:
  benchmark.kernel.application:
    integration_platforms:
      - mps2/an385
      - qemu_x86
  benchmark.kernel.application.objcore.stats:
    integration_platforms:
      - mps2/an385
      - qemu_x86
    extra_configs:
      - CONFIG_OBJ_CORE=y
      - CONFIG_OBJ_CORE_STATS=y
  benchmark.kernel.application.user:
    extra_args: CONF_FILE=prj_user.conf
    filter: CONFIG_ARCH_HAS_USERSPACE
    integration_platforms:
      - qemu_x86
      - qemu_cortex_a53
  benchmark.kernel.application.user.objcore.stats:
    extra_args: CONF_FILE=prj_user.conf
    filter: CONFIG_ARCH_HAS_USERSPACE
    integration_platforms:
      - qemu_x86
      - qemu_cortex_a53
    extra_configs:
      - CONFIG_OBJ_CORE=y
      - CONFIG_OBJ_CORE_STATS=y
  benchmark.kernel.application.timeslicing:
    integration_platforms:
      - mps2/an385
      - qemu_x86
    extra_configs:
      - CONFIG_TIMESLICING=y
  benchmark.kernel.application.user.timeslicing:
    extra_args: CONF_FILE=prj_user.conf
    filter: CONFIG_ARCH_HAS_USERSPACE
    integration_platforms:
      - mps2/an385
      - qemu_x86
    extra_configs:
      - CONFIG_TIMESLICING=y
```

## tests/benchmarks/boot_time/testcase.yaml
```yaml
tests:
  benchmark.kernel.boot_time:
    arch_allow: x86 arm posix
    platform_exclude: qemu_x86 qemu_x86_coverage qemu_x86_64 qemu_x86_nommu
      minnowboard acrn
    tags: benchmark
    filter: CONFIG_SYS_CLOCK_HW_CYCLES_PER_SEC >= 1000000
```

## tests/benchmarks/cmsis_dsp/basicmath/testcase.yaml
```yaml
common:
  arch_allow: arm
  filter: (CONFIG_CPU_AARCH32_CORTEX_R or CONFIG_CPU_CORTEX_M) and CONFIG_FULL_LIBC_SUPPORTED
    == 1
  tags:
    - benchmark
    - cmsis_dsp
  min_flash: 128
  min_ram: 64
tests:
  benchmark.cmsis_dsp.basicmath:
    integration_platforms:
      - frdm_k64f
      - sam_e70_xplained/same70q21
      - mps2/an521/cpu0
  benchmark.cmsis_dsp.basicmath.fpu:
    filter: CONFIG_CPU_HAS_FPU
    integration_platforms:
      - mps2/an521/cpu1
      - mps3/corstone300/an547
    tags:
      - fpu
    extra_configs:
      - CONFIG_FPU=y
```

## tests/benchmarks/cpu_performance/testcase.yaml
```yaml
tests:
  benchmarks.cpu_performance:
    extra_args:
      - EXTRA_CONF_FILE="prj_arm64.conf"
    tags:
      - benchmark
      - cpu
      - pmu
      - arm64
    arch_allow:
      - arm64
    # QEMU does not emulate PMU counters; all benchmark tests are skipped there.
    # The QEMU platforms are listed to allow compile-time validation only.
    # Meaningful results require real hardware with PMU access enabled by the
    # bootloader/TF-A.
    platform_allow:
      - versal_apu
      - versalnet_apu
      - versalnet_apu/amd_versalnet_apu/smp
      - versal2_apu
      - versal2_apu/amd_versal2_apu/smp
    # Use a hardware platform as the integration target so CI exercises real PMU
    # counters; QEMU would silently pass with all tests skipped.
    integration_platforms:
      - versalnet_apu
    harness: console
    harness_config:
      type: multi_line
      regex:
        - "(PMU benchmark skipped: no PMU or init failed|\
           PMU counters verified: non-zero cycle and event counts)"
        - "PROJECT EXECUTION SUCCESSFUL"
```

## tests/benchmarks/data_structure_perf/dlist_perf/testcase.yaml
```yaml
tests:
  benchmark.data_structure_perf.dlist:
    tags:
      - benchmark
      - dlist
      - kernel
    integration_platforms:
      - native_posix
```

## tests/benchmarks/data_structure_perf/rbtree_perf/testcase.yaml
```yaml
tests:
  benchmark.data_structure_perf.rbtree:
    platform_key:
      - arch
    tags:
      - benchmark
      - rbtree
      - kernel
    integration_platforms:
      - native_sim
```

## tests/benchmarks/footprint/testcase.yaml
```yaml
tests:
  benchmark.footprint.float:
    arch_whitelist: x86 arm
    build_only: true
    extra_args: TEST=float
    filter: CONFIG_FLOAT
    tags: footprint
  benchmark.footprint.max:
    arch_whitelist: x86 arm
    build_only: true
    extra_args: TEST=max
    min_ram: 8
    tags: footprint
  benchmark.footprint.min:
    build_only: true
    extra_args: TEST=min
    tags: footprint
  benchmark.footprint.regular:
    arch_whitelist: x86 arm
    build_only: true
    extra_args: TEST=reg
    min_ram: 8
    platform_exclude: quark_d2000_crb
    tags: footprint
```

## tests/benchmarks/footprints/testcase.yaml
```yaml
common:
  tags:
    - benchmark
    - kernel
tests:
  benchmark.kernel.footprints.default:
    build_only: true
    integration_platforms:
      - mps2_an385
  benchmark.kernel.footprints.pm:
    tags:
      - pm
    build_only: true
    extra_args: CONF_FILE=prj_pm.conf
    integration_platforms:
      - mps2_an385
  benchmark.kernel.footprints.userspace:
    filter: CONFIG_ARCH_HAS_USERSPACE
    extra_args: CONF_FILE=prj_userspace.conf
    arch_allow:
      - x86
      - arm
      - arc
    tags:
      - userspace
    build_only: true
    integration_platforms:
      - mps2_an385
```

## tests/benchmarks/fs_performance/boards/nrf52840dk_nrf52840_internal_littlefs.conf
```kconfig
#
# Copyright (c) 2021 Nordic Semiconductor ASA
#
# SPDX-License-Identifier: Apache-2.0
#

CONFIG_FLASH_MAP=y
CONFIG_FILE_SYSTEM_LITTLEFS=y
```

## tests/benchmarks/fs_performance/boards/nrf52840dk_nrf52840_mx25_fatfs.conf
```kconfig
#
# Copyright (c) 2021 Nordic Semiconductor ASA
#
# SPDX-License-Identifier: Apache-2.0
#

CONFIG_SPI=y
CONFIG_NORDIC_QSPI_NOR=y
CONFIG_NORDIC_QSPI_NOR_FLASH_LAYOUT_PAGE_SIZE=4096

CONFIG_DISK_ACCESS=y
CONFIG_DISK_DRIVER_FLASH=y
CONFIG_DISK_FLASH_VOLUME_NAME="NAND"
CONFIG_DISK_FLASH_DEV_NAME="MX25R64"
CONFIG_DISK_FLASH_MAX_RW_SIZE=256
CONFIG_DISK_FLASH_ERASE_ALIGNMENT=0x1000
CONFIG_DISK_ERASE_BLOCK_SIZE=0x1000
CONFIG_DISK_FLASH_START=0x00000
CONFIG_DISK_VOLUME_SIZE=0x20000
CONFIG_DISK_FLASH_SECTOR_SIZE=512

CONFIG_FAT_FILESYSTEM_ELM=y
CONFIG_FS_FATFS_MOUNT_MKFS=y
CONFIG_FS_FATFS_READ_ONLY=n
```

## tests/benchmarks/fs_performance/boards/nrf52840dk_nrf52840_mx25_littlefs.conf
```kconfig
#
# Copyright (c) 2021 Nordic Semiconductor ASA
#
# SPDX-License-Identifier: Apache-2.0
#
CONFIG_FLASH_MAP=y
CONFIG_FILE_SYSTEM_LITTLEFS=y
CONFIG_NORDIC_QSPI_NOR=y
CONFIG_NORDIC_QSPI_NOR_FLASH_LAYOUT_PAGE_SIZE=4096
```

## tests/benchmarks/fs_performance/boards/stm32f4_disco_ram_fatfs.conf
```kconfig
#
# Copyright (c) 2021 Nordic Semiconductor ASA
#
# SPDX-License-Identifier: Apache-2.0
#

CONFIG_FLASH_SIMULATOR=y
CONFIG_FAT_FILESYSTEM_ELM=y
CONFIG_DISK_ACCESS=y
CONFIG_DISK_DRIVER_FLASH=y
CONFIG_DISK_FLASH_VOLUME_NAME="NAND"
CONFIG_DISK_FLASH_DEV_NAME="FLASH_SIMULATOR"
CONFIG_DISK_FLASH_MAX_RW_SIZE=256
CONFIG_DISK_FLASH_ERASE_ALIGNMENT=0x1000
CONFIG_DISK_ERASE_BLOCK_SIZE=0x1000
CONFIG_DISK_FLASH_START=0x00000
CONFIG_DISK_VOLUME_SIZE=0x20000
CONFIG_DISK_FLASH_SECTOR_SIZE=512

CONFIG_FS_FATFS_MOUNT_MKFS=y
CONFIG_FS_FATFS_READ_ONLY=n
```

## tests/benchmarks/ipi_metric/Kconfig
```kconfig
# Copyright (c) 2024 Intel Corporation
# SPDX-License-Identifier: Apache-2.0

mainmenu "IPI-Metric RTOS Test Suite"

choice IPI_METRIC_TEST
	prompt "Select an IPI-Metric test to execute"
	default IPI_METRIC_PREEMPTIVE
	help
	  The IPI-Metric benchmark suite has a single CPU in an SMP system
	  dedicated to generating IPIs under varying conditions while the
	  remaining CPUs perform their "work" and process IPIs. These tests
	  track the amount of "work" and the number of IPIs processed
	  during 30 second time intervals.

config IPI_METRIC_PREEMPTIVE
	bool "IPIs are generated due threads preempting one another"
	help
	  The CPU generating the IPIs does so as a byproduct of resuming and
	  suspending a series of preemptible threads.

config IPI_METRIC_PRIMITIVE_BROADCAST
	bool "IPIs are generated using primitive arch_sched_broadcast_ipi()"
	help
	  The CPU generating the IPIs does so by directly calling
	  arch_sched_broadcast_ipi() to broadcast them to all CPUs.

config IPI_METRIC_PRIMITIVE_DIRECTED
	bool "IPIs are generated using primitive arch_sched_directed_ipi()"
	depends on ARCH_HAS_DIRECTED_IPIS
	help
	  The CPU generating the IPIs does so by directly calling
	  arch_sched_directed_ipi() to direct them to a single CPU.

endchoice

source "Kconfig.zephyr"
```

## tests/benchmarks/ipi_metric/testcase.yaml
```yaml
common:
  platform_key:
    - arch
  tags:
    - kernel
    - benchmark
  # Native platforms excluded as they are not relevant: These benchmarks run some kernel primitives
  # in a loop during a predefined time counting how many times they execute. But in the POSIX arch,
  # time does not pass while the CPU executes. So the benchmark just appears as if hung.
  arch_exclude:
    - posix
  platform_exclude:
    # some slow qemu_* excluded
    - qemu_malta/qemu_malta
    - qemu_malta/qemu_malta/be
    # FVP is also very slow
    - fvp_base_revc_2xaem/v8a/smp
    - fvp_base_revc_2xaem/v8a/smp/ns
    - fvp_base_revc_2xaem/v9a/smp
    - fvp_base_revc_2xaem/v9a/smp/ns
  integration_platforms:
    - qemu_x86_64
    - qemu_cortex_a53/qemu_cortex_a53/smp
  timeout: 300
  filter: CONFIG_SMP and CONFIG_MP_MAX_NUM_CPUS > 1
  harness: console

tests:
  benchmark.ipi_metric.preemptive.broadcast:
    extra_configs:
      - CONFIG_IPI_METRIC_PREEMPTIVE=y
      - CONFIG_IPI_OPTIMIZE=n
    harness_config:
      type: multi_line
      ordered: true
      regex:
        # Collect at least 3 measurements for each benchmark:
        - "(.*) IPI-Metric(.+) Elapsed Time:[ ]*[0-9]+(.*)"
        - "(.*)Preemptive Counter Total:[ ]*[0-9]+(.*)"
        - "(.*)IPI Count:[ ]*[0-9]+(.*)"
        - "(.*)Total Work:[ ]*[0-9]+(.*)"
        - "(.*) IPI-Metric(.+) Elapsed Time:[ ]*[0-9]+(.*)"
        - "(.*)Preemptive Counter Total:[ ]*[0-9]+(.*)"
        - "(.*)IPI Count:[ ]*[0-9]+(.*)"
        - "(.*)Total Work:[ ]*[0-9]+(.*)"
        - "(.*) IPI-Metric(.+) Elapsed Time:[ ]*[0-9]+(.*)"
        - "(.*)Preemptive Counter Total:[ ]*[0-9]+(.*)"
        - "(.*)IPI Count:[ ]*[0-9]+(.*)"
        - "(.*)Total Work:[ ]*[0-9]+(.*)"

  benchmark.ipi_metric.preemptive.optimize:
    extra_configs:
      - CONFIG_IPI_METRIC_PREEMPTIVE=y
      - CONFIG_IPI_OPTIMIZE=y
    filter: ARCH_HAS_DIRECTED_IPIS
    harness_config:
      type: multi_line
      ordered: true
      regex:
        # Collect at least 3 measurements for each benchmark:
        - "(.*) IPI-Metric(.+) Elapsed Time:[ ]*[0-9]+(.*)"
        - "(.*)Preemptive Counter Total:[ ]*[0-9]+(.*)"
        - "(.*)IPI Count:[ ]*[0-9]+(.*)"
        - "(.*)Total Work:[ ]*[0-9]+(.*)"
        - "(.*) IPI-Metric(.+) Elapsed Time:[ ]*[0-9]+(.*)"
        - "(.*)Preemptive Counter Total:[ ]*[0-9]+(.*)"
        - "(.*)IPI Count:[ ]*[0-9]+(.*)"
        - "(.*)Total Work:[ ]*[0-9]+(.*)"
        - "(.*) IPI-Metric(.+) Elapsed Time:[ ]*[0-9]+(.*)"
        - "(.*)Preemptive Counter Total:[ ]*[0-9]+(.*)"
        - "(.*)IPI Count:[ ]*[0-9]+(.*)"
        - "(.*)Total Work:[ ]*[0-9]+(.*)"

  benchmark.ipi_metric.primitive.broadcast:
    extra_configs:
      - CONFIG_IPI_METRIC_PRIMITIVE_BROADCAST=y
    harness_config:
      type: multi_line
      ordered: true
      regex:
        # Collect at least 3 measurements for each benchmark:
        - "(.*) IPI-Metric(.+) Elapsed Time:[ ]*[0-9]+(.*)"
        - "(.*)Schedule IPIs Issued:[ ]*[0-9]+(.*)"
        - "(.*)Total Work:[ ]*[0-9]+(.*)"
        - "(.*) IPI-Metric(.+) Elapsed Time:[ ]*[0-9]+(.*)"
        - "(.*)Schedule IPIs Issued:[ ]*[0-9]+(.*)"
        - "(.*)Total Work:[ ]*[0-9]+(.*)"
        - "(.*) IPI-Metric(.+) Elapsed Time:[ ]*[0-9]+(.*)"
        - "(.*)Schedule IPIs Issued:[ ]*[0-9]+(.*)"
        - "(.*)Total Work:[ ]*[0-9]+(.*)"


  benchmark.ipi_metric.primitive.directed:
    extra_configs:
      - CONFIG_IPI_METRIC_PRIMITIVE_DIRECTED=y
    filter: ARCH_HAS_DIRECTED_IPIS
    harness_config:
      type: multi_line
      ordered: true
      regex:
        # Collect at least 3 measurements for each benchmark:
        - "(.*) IPI-Metric(.+) Elapsed Time:[ ]*[0-9]+(.*)"
        - "(.*)Schedule IPIs Issued:[ ]*[0-9]+(.*)"
        - "(.*)Total Work:[ ]*[0-9]+(.*)"
        - "(.*) IPI-Metric(.+) Elapsed Time:[ ]*[0-9]+(.*)"
        - "(.*)Schedule IPIs Issued:[ ]*[0-9]+(.*)"
        - "(.*)Total Work:[ ]*[0-9]+(.*)"
        - "(.*) IPI-Metric(.+) Elapsed Time:[ ]*[0-9]+(.*)"
        - "(.*)Schedule IPIs Issued:[ ]*[0-9]+(.*)"
        - "(.*)Total Work:[ ]*[0-9]+(.*)"
```

## tests/benchmarks/latency_measure/boards/arduino_due.conf
```kconfig
# eliminate timer interrupts during the benchmark
# for platforms that do not allow frequency dividers large enough to get
# system clock tick period in 1 sec, make system clock tick to 0.1 sec
CONFIG_SYS_CLOCK_TICKS_PER_SEC=10
```

## tests/benchmarks/latency_measure/boards/frdm_k64f.conf
```kconfig
# The minimum number of system ticks per second that this platform will
# allow for a tickless kernel given its 24-bit timer and its 120 MHz
# clock rate is 15.
CONFIG_SYS_CLOCK_TICKS_PER_SEC=15
```

## tests/benchmarks/latency_measure/boards/intel_adsp_ace20_lnl_sim.conf
```kconfig
# Due to addition of busy threads running on other cores,
# and the simulator runs in single thread bouncing through
# all cores, we are wasting quite a bit of time just busy
# waiting. This makes each simulator run too long for CI.
# So limit CPU number to 1.
CONFIG_MP_MAX_NUM_CPUS=1
```
