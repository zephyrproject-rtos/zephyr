## CMakeLists.txt
```
# SPDX-License-Identifier: Apache-2.0

cmake_minimum_required(VERSION 3.28.0)
find_package(Zephyr REQUIRED HINTS $ENV{ZEPHYR_BASE})
project(pagetables)

FILE(GLOB app_sources src/*.c)
target_sources(app PRIVATE ${app_sources})

target_include_directories(app PRIVATE
  ${ZEPHYR_BASE}/kernel/include
  ${ZEPHYR_BASE}/arch/${ARCH}/include
  )
```

## prj.conf
```kconfig
CONFIG_ZTEST=y
CONFIG_TEST_HW_STACK_PROTECTION=n
CONFIG_TEST_USERSPACE=y
CONFIG_APPLICATION_DEFINED_SYSCALL=y
```

## src/main.c
```c
/*
 * Copyright (c) 2020 Intel Corporation.
 *
 * SPDX-License-Identifier: Apache-2.0
 */

/**
 * @file
 * x86-specific tests for MMU features and page tables
 */

#include <zephyr/kernel.h>
#include <zephyr/ztest.h>
#include <zephyr/tc_util.h>
#include <zephyr/arch/x86/mmustructs.h>
#include <x86_mmu.h>
#include <zephyr/linker/linker-defs.h>
#include <mmu.h>
#include "main.h"

#ifdef CONFIG_X86_64
#define PT_LEVEL	3
#elif CONFIG_X86_PAE
#define PT_LEVEL	2
#else
#define PT_LEVEL	1
#endif

/* Set of flags whose state we will check. Ignore Accessed/Dirty
 * At leaf level PS bit indicates PAT, but regardless we don't set it
 */
#define FLAGS_MASK	(MMU_P | MMU_RW | MMU_US | MMU_PWT | MMU_PCD | \
			 MMU_G | MMU_PS | MMU_XD)

#define IN_EXTENT(start, limit, virt)                                                              \
	((virt) >= (uint8_t *)(start) &&                                                           \
	 (virt) < ((uint8_t *)(start) + LINKER_SECTION_SIZE(start, limit)))

#ifdef CONFIG_X86_64
extern char _locore_start[];
extern char _lorodata_start[];
extern char _lodata_start[];
extern char _lodata_end[];

#define LOCORE_START	((uint8_t *)&_locore_start)
#define LOCORE_END	((uint8_t *)&_lodata_end)
#endif

#ifdef CONFIG_COVERAGE_GCOV
extern char __gcov_bss_start[];
#endif

#include <zephyr/sys/libc-hooks.h>
#ifdef Z_LIBC_PARTITION_EXISTS
extern char z_data_smem_z_libc_partition_part_start[];
extern char z_data_smem_z_libc_partition_part_end[];
#endif

static pentry_t get_entry(pentry_t *flags, void *addr)
{
	int level;
	pentry_t entry;

	z_x86_pentry_get(&level, &entry, z_x86_page_tables_get(), addr);

	zassert_true((entry & MMU_P) != 0,
		     "non-present RAM entry");
	zassert_equal(level, PT_LEVEL, "bigpage found");
	*flags = entry & FLAGS_MASK;

	return entry;
}

/**
 * Test that MMU flags on RAM virtual address range are set properly
 *
 * @ingroup kernel_memprotect_tests
 */
ZTEST(x86_pagetables, test_ram_perms)
{
	uint8_t *pos;

	pentry_t entry, flags, expected;

	const uint8_t *mem_range_end = K_MEM_KERNEL_VIRT_END;

	for (pos = K_MEM_KERNEL_VIRT_START; pos < mem_range_end;
	     pos += CONFIG_MMU_PAGE_SIZE) {
		if (pos == NULL) {
			/* We have another test specifically for NULL page */
			continue;
		}

#ifdef CONFIG_USERSPACE
		/* Each K_THREAD_STACK_DEFINE object in this region is laid
		 * out as a supervisor-only privilege-stack header followed
		 * by user-accessible pages. The per-page permissions vary
		 * within the object; skip the region rather than enumerate
		 * the layout here.
		 */
		if ((uint8_t *)pos >= (uint8_t *)z_user_stacks_start &&
		    (uint8_t *)pos < (uint8_t *)z_user_stacks_end) {
			continue;
		}
#endif

		entry = get_entry(&flags, pos);

		if (!IS_ENABLED(CONFIG_SRAM_REGION_PERMISSIONS)) {
			expected = MMU_P | MMU_RW;
		} else if (IN_EXTENT(__text_region_start, __text_region_end, pos)) {
			expected = MMU_P | MMU_US;
		} else if (IN_EXTENT(__rodata_region_start, __rodata_region_end, pos)) {
			expected = MMU_P | MMU_US | MMU_XD;
#ifdef CONFIG_COVERAGE_GCOV
		} else if (IN_EXTENT(__gcov_bss_start, __gcov_bss_end, pos)) {
			expected = MMU_P | MMU_RW | MMU_US | MMU_XD;
#endif
#if !defined(CONFIG_X86_KPTI) && defined(CONFIG_USERSPACE)
		} else if (IN_EXTENT(_app_smem_start, _app_smem_end, pos)) {
			/* If KPTI is not enabled, every partition in
			 * _app_smem is accessible from supervisor mode with
			 * its US bit set: with a per-thread page table, the
			 * default memory domain (ztest_partition and any libc
			 * partitions) is programmed before reaching this
			 * test; with a common page table, the same partitions
			 * are programmed statically into the single page
			 * table at boot.
			 */
			expected = MMU_P | MMU_US | MMU_RW | MMU_XD;
#endif /* CONFIG_X86_KPTI */
#ifdef CONFIG_LINKER_USE_BOOT_SECTION
		} else if (IN_EXTENT(lnkr_boot_text_start, lnkr_boot_text_end, pos)) {
			expected = MMU_P | MMU_US;
		} else if (IN_EXTENT(lnkr_boot_rodata_start, lnkr_boot_rodata_end, pos)) {
			expected = MMU_P | MMU_US | MMU_XD;
#endif
#ifdef Z_LIBC_PARTITION_EXISTS
		} else if (IN_EXTENT(z_data_smem_z_libc_partition_part_start,
				     z_data_smem_z_libc_partition_part_end, pos)) {
			expected = MMU_P | MMU_RW | MMU_XD;
#endif
		} else {
			/* We forced CONFIG_HW_STACK_PROTECTION off otherwise
			 * guard pages will have RW cleared. We can relax this
			 * once we start memory-mapping stacks.
			 */
			expected = MMU_P | MMU_RW | MMU_XD;
		}
		zassert_equal(flags, expected,
			      "bad flags " PRI_ENTRY " at %p, expected "
			      PRI_ENTRY, flags, pos, expected);
	}

#ifdef CONFIG_X86_64
	/* Check the locore too */
	for (pos = LOCORE_START; pos < LOCORE_END;
	     pos += CONFIG_MMU_PAGE_SIZE) {
		if (pos == NULL) {
			/* We have another test specifically for NULL page */
			continue;
		}

		entry = get_entry(&flags, pos);

		if (IN_EXTENT(_locore_start, _lorodata_start, pos)) {
			if (IS_ENABLED(CONFIG_X86_KPTI)) {
				expected = MMU_P | MMU_US;
			} else {
				expected = MMU_P;
			}
		} else if (IN_EXTENT(_lorodata_start, _lodata_start, pos)) {
			if (IS_ENABLED(CONFIG_X86_KPTI)) {
				expected = MMU_P | MMU_US | MMU_XD;
			} else {
				expected = MMU_P | MMU_XD;
			}
		} else {
			expected = MMU_P | MMU_RW | MMU_XD;
		}
		zassert_equal(flags, expected,
			      "bad flags " PRI_ENTRY " at %p, expected "
			      PRI_ENTRY, flags, pos, expected);
	}
#endif /* CONFIG_X86_64 */

#ifdef CONFIG_ARCH_MAPS_ALL_RAM
	/* All RAM page frame entries aside from 0x0 must have a mapping.
	 * We currently identity-map on x86, no conversion necessary other than a cast
	 */
	for (pos = (uint8_t *)K_MEM_PHYS_RAM_START;
	     pos < (uint8_t *)K_MEM_PHYS_RAM_END;
	     pos += CONFIG_MMU_PAGE_SIZE) {
		if (pos == NULL) {
			continue;
		}

		entry = get_entry(&flags, pos);
		zassert_true((flags & MMU_P) != 0,
			     "address %p isn't mapped", pos);
	}
#endif
}

/**
 * Test that the NULL virtual page is always non-present
 *
 * @ingroup kernel_memprotect_tests
 */
ZTEST(x86_pagetables, test_null_map)
{
	int level;
	pentry_t entry;

	/* The NULL page must always be non-present */
	z_x86_pentry_get(&level, &entry, z_x86_page_tables_get(), NULL);
	zassert_true((entry & MMU_P) == 0, "present NULL entry");
}

void z_impl_dump_my_ptables(void)
{
	struct k_thread *cur = k_current_get();

	printk("Page tables for thread %p\n", cur);
	z_x86_dump_page_tables(z_x86_thread_page_tables_get(cur));
}

#ifdef CONFIG_USERSPACE
void z_vrfy_dump_my_ptables(void)
{
	z_impl_dump_my_ptables();
}
#include <zephyr/syscalls/dump_my_ptables_mrsh.c>
#endif /* CONFIG_USERSPACE */

#define RAM_SIZE (DT_CHOSEN_SRAM_SIZE / 1024)

void dump_pagetables(void)
{
#if RAM_SIZE > (32 << 10)
	/*
	 * Takes too long to dump page table, so skip dumping
	 * if memory size is larger than 32MB.
	 */
	ztest_test_skip();
#else
	dump_my_ptables();
#endif
}

/**
 * Dump kernel's page tables to console
 *
 * We don't verify any specific output, but this shouldn't crash
 *
 * @ingroup kernel_memprotect_tests
 */
ZTEST_USER(x86_pagetables, test_dump_ptables_user)
{
	dump_pagetables();
}

ZTEST(x86_pagetables, test_dump_ptables)
{
	dump_pagetables();
}

ZTEST_SUITE(x86_pagetables, NULL, NULL, NULL, NULL, NULL);
```

## src/main.h
```c
/*
 * Copyright (c) 2020 Intel Corporation.
 *
 * SPDX-License-Identifier: Apache-2.0
 */
#ifndef MAIN_H
#define MAIN_H

__syscall void dump_my_ptables(void);

#include <zephyr/syscalls/main.h>

#endif
```
