## CMakeLists.txt
```
# SPDX-FileCopyrightText: Copyright The Zephyr Project Contributors
# SPDX-License-Identifier: Apache-2.0

cmake_minimum_required(VERSION 3.28.0)
find_package(Zephyr REQUIRED HINTS $ENV{ZEPHYR_BASE})
project(kernel_latency)

target_sources(app PRIVATE
  src/thread.c
  src/semaphore.c
  src/mutex.c
  src/fifo.c
  src/lifo.c
  src/stack.c
  src/heap.c
  src/condvar.c
  src/yield_queue.c
)

target_sources_ifdef(CONFIG_EVENTS app PRIVATE src/events.c)
```

## Kconfig
```
# SPDX-FileCopyrightText: Copyright The Zephyr Project Contributors
# SPDX-License-Identifier: Apache-2.0

mainmenu "Kernel Latency Benchmark"

config KERNEL_BENCH_NUM_SAMPLES
	int "Number of samples per benchmark"
	default 1000
	help
	  Samples recorded for each benchmark. Percentiles need enough of
	  them to resolve: p99 needs a hundred, p99.9 a thousand. Raise
	  CONFIG_ZTEST_BENCHMARK_MAX_SAMPLES to match.

source "Kconfig.zephyr"
```

## prj.conf
```kconfig
# SPDX-FileCopyrightText: Copyright The Zephyr Project Contributors
# SPDX-License-Identifier: Apache-2.0

CONFIG_ZTEST=y
CONFIG_ZTEST_BENCHMARK=y
CONFIG_ZTEST_BENCHMARK_PERCENTILES=y
CONFIG_ZTEST_BENCHMARK_MAX_SAMPLES=1024

# The framework does not warm up by default. These benchmarks want the
# steady state, and the first execution of one of them costs up to 1.8
# times the rest, so discard a few iterations before sampling. Only the
# measured samples are retained, so this stays inside MAX_SAMPLES above.
CONFIG_ZTEST_BENCHMARK_WARMUP=10

# Formatting the statistics uses more stack than the 1KB some
# platforms default to.
CONFIG_MAIN_STACK_SIZE=4096

# Keep timer interrupts out of the measurements
CONFIG_SYS_CLOCK_TICKS_PER_SEC=100

# The thread benchmarks create and destroy a thread on the same stack
# once per sample. Where stacks are memory mapped, each cycle consumes
# virtual address space that is not handed back, so a few hundred
# iterations exhaust the mapping pool and k_thread_create() asserts.
# Turning the mapping off also keeps thread creation comparable with
# the platforms that have no MMU at all.
CONFIG_THREAD_STACK_MEM_MAPPED=n

# Every benchmark that spans a context switch is closed by a partner
# thread, and the ready queue benchmarks keep filler threads runnable.
# A second CPU would run those concurrently with the measuring thread
# and close the span before the switch being measured happens, so the
# benchmark runs on one CPU, like the other kernel benchmarks.
CONFIG_MP_MAX_NUM_CPUS=1

CONFIG_TIMESLICING=n
CONFIG_PM=n
CONFIG_EVENTS=y
CONFIG_HEAP_MEM_POOL_SIZE=4096
```

## src/bench.h
```c
/*
 * SPDX-FileCopyrightText: Copyright The Zephyr Project Contributors
 * SPDX-License-Identifier: Apache-2.0
 */

#ifndef ZEPHYR_TESTS_BENCHMARKS_KERNEL_LATENCY_SRC_BENCH_H_
#define ZEPHYR_TESTS_BENCHMARKS_KERNEL_LATENCY_SRC_BENCH_H_

#include <zephyr/kernel.h>
#include <zephyr/ztest.h>

/*
 * Shared helpers for the manually sampled benchmarks.
 *
 * Operations that begin and end in the same thread are plain
 * ZTEST_BENCHMARK() bodies, which the framework times itself. The ones
 * here span a context switch, so the body marks the start of the span
 * and the partner thread marks its end, which only
 * ZTEST_BENCHMARK_MANUAL() can express.
 *
 * The framework runs the body once per iteration and handles the warmup
 * either way, so a body performs a single handshake. A partner that
 * blocks and is woken is created by the setup function, does its half,
 * and is joined by the teardown function; the yield partner stays
 * runnable and hands the CPU back instead.
 */

#define BENCH_SAMPLES CONFIG_KERNEL_BENCH_NUM_SAMPLES

#define BENCH_PARTNER_STACK_SIZE (1024 + CONFIG_TEST_EXTRA_STACK_SIZE)

#endif /* ZEPHYR_TESTS_BENCHMARKS_KERNEL_LATENCY_SRC_BENCH_H_ */
```

## src/condvar.c
```c
/*
 * SPDX-FileCopyrightText: Copyright The Zephyr Project Contributors
 * SPDX-License-Identifier: Apache-2.0
 */

/*
 * Condition variable signalling. There is no uncontended variant worth
 * timing: signalling with nobody waiting does almost nothing, so the
 * measurement is the wake of a waiting thread.
 *
 * k_condvar_signal() does not require the mutex, and k_condvar_wait()
 * cannot return without it, so the signaller releases the mutex before
 * opening the span. The woken waiter then takes the free mutex on its
 * way out, and the span holds one wake and one switch, like the other
 * *_wake_switch benchmarks. Signalling with the mutex held would cost
 * three switches instead: the waiter runs, blocks on the mutex and
 * boosts the signaller, which switches back, unlocks and hands over.
 */

#include "bench.h"

ZTEST_BENCHMARK_SUITE(condvar, NULL, NULL);

static K_MUTEX_DEFINE(mutex);
static K_CONDVAR_DEFINE(condvar);
static K_SEM_DEFINE(ready_sem, 0, 1);
static K_SEM_DEFINE(done_sem, 0, 1);
static K_THREAD_STACK_DEFINE(waiter_stack, BENCH_PARTNER_STACK_SIZE);
static struct k_thread waiter_thread;

static void waiter_entry(void *p1, void *p2, void *p3)
{
	ARG_UNUSED(p1);
	ARG_UNUSED(p2);
	ARG_UNUSED(p3);

	(void)k_mutex_lock(&mutex, K_FOREVER);
	k_sem_give(&ready_sem);
	(void)k_condvar_wait(&condvar, &mutex, K_FOREVER);

	ztest_benchmark_end();

	(void)k_mutex_unlock(&mutex);
	k_sem_give(&done_sem);
}

static void waiter_create(void)
{
	int priority = k_thread_priority_get(k_current_get()) - 1;

	k_thread_create(&waiter_thread, waiter_stack, BENCH_PARTNER_STACK_SIZE, waiter_entry,
			NULL, NULL, NULL, priority, 0, K_NO_WAIT);
}

static void waiter_join(void)
{
	(void)k_thread_join(&waiter_thread, K_FOREVER);
}

ZTEST_BENCHMARK_MANUAL(condvar, signal_wake_switch, BENCH_SAMPLES, waiter_create, waiter_join)
{
	/*
	 * The waiter holds the mutex from before it gives ready_sem until
	 * k_condvar_wait() has put it to sleep, so taking the mutex here
	 * guarantees that the signal has somebody to wake. It is released
	 * again before the span opens.
	 */
	(void)k_sem_take(&ready_sem, K_FOREVER);
	(void)k_mutex_lock(&mutex, K_FOREVER);
	(void)k_mutex_unlock(&mutex);

	ztest_benchmark_start();
	(void)k_condvar_signal(&condvar);

	(void)k_sem_take(&done_sem, K_FOREVER);
}
```

## src/events.c
```c
/*
 * SPDX-FileCopyrightText: Copyright The Zephyr Project Contributors
 * SPDX-License-Identifier: Apache-2.0
 */

/* k_event post and wait, and the wake of a thread blocked in wait. */

#include "bench.h"

ZTEST_BENCHMARK_SUITE(events, NULL, NULL);

#define EVENT_BIT BIT(0)

static K_EVENT_DEFINE(event);

static void event_clear(void)
{
	k_event_clear(&event, EVENT_BIT);
}

static void event_set(void)
{
	k_event_post(&event, EVENT_BIT);
}

ZTEST_BENCHMARK(events, post, BENCH_SAMPLES, NULL, event_clear)
{
	k_event_post(&event, EVENT_BIT);
}

ZTEST_BENCHMARK(events, wait_satisfied, BENCH_SAMPLES, event_set, event_clear)
{
	(void)k_event_wait(&event, EVENT_BIT, false, K_NO_WAIT);
}

/*
 * Time from k_event_post() to the higher priority thread blocked in
 * k_event_wait() running.
 */
static K_EVENT_DEFINE(wake_event);
static K_SEM_DEFINE(done_sem, 0, 1);
static K_THREAD_STACK_DEFINE(waiter_stack, BENCH_PARTNER_STACK_SIZE);
static struct k_thread waiter_thread;

static void waiter_entry(void *p1, void *p2, void *p3)
{
	ARG_UNUSED(p1);
	ARG_UNUSED(p2);
	ARG_UNUSED(p3);

	(void)k_event_wait(&wake_event, EVENT_BIT, false, K_FOREVER);
	ztest_benchmark_end();
	k_event_clear(&wake_event, EVENT_BIT);
	k_sem_give(&done_sem);
}

static void waiter_create(void)
{
	int priority = k_thread_priority_get(k_current_get()) - 1;

	k_thread_create(&waiter_thread, waiter_stack, BENCH_PARTNER_STACK_SIZE, waiter_entry,
			NULL, NULL, NULL, priority, 0, K_NO_WAIT);
}

static void waiter_join(void)
{
	(void)k_thread_join(&waiter_thread, K_FOREVER);
}

ZTEST_BENCHMARK_MANUAL(events, post_wake_switch, BENCH_SAMPLES, waiter_create, waiter_join)
{
	ztest_benchmark_start();
	k_event_post(&wake_event, EVENT_BIT);
	(void)k_sem_take(&done_sem, K_FOREVER);
}
```

## src/fifo.c
```c
/*
 * SPDX-FileCopyrightText: Copyright The Zephyr Project Contributors
 * SPDX-License-Identifier: Apache-2.0
 */

/*
 * FIFO operations, including the allocating variants that take memory
 * from the calling thread's resource pool, and the wake of a thread
 * blocked in k_fifo_get().
 */

#include "bench.h"

ZTEST_BENCHMARK_SUITE(fifo, NULL, NULL);

static K_FIFO_DEFINE(fifo);

static struct {
	intptr_t reserved;
	uint32_t payload;
} item;

static void fifo_fill(void)
{
	k_fifo_put(&fifo, &item);
}

static void fifo_drain(void)
{
	(void)k_fifo_get(&fifo, K_NO_WAIT);
}

ZTEST_BENCHMARK(fifo, put, BENCH_SAMPLES, NULL, fifo_drain)
{
	k_fifo_put(&fifo, &item);
}

ZTEST_BENCHMARK(fifo, get, BENCH_SAMPLES, fifo_fill, NULL)
{
	(void)k_fifo_get(&fifo, K_NO_WAIT);
}

static void fifo_alloc_fill(void)
{
	(void)k_fifo_alloc_put(&fifo, &item);
}

ZTEST_BENCHMARK(fifo, alloc_put, BENCH_SAMPLES, NULL, fifo_drain)
{
	(void)k_fifo_alloc_put(&fifo, &item);
}

ZTEST_BENCHMARK(fifo, get_after_alloc_put, BENCH_SAMPLES, fifo_alloc_fill, NULL)
{
	(void)k_fifo_get(&fifo, K_NO_WAIT);
}

/*
 * Time from k_fifo_put() to the higher priority thread blocked in
 * k_fifo_get() running with the item.
 */
static K_FIFO_DEFINE(wake_fifo);
static K_SEM_DEFINE(done_sem, 0, 1);
static K_THREAD_STACK_DEFINE(waiter_stack, BENCH_PARTNER_STACK_SIZE);
static struct k_thread waiter_thread;

static struct {
	intptr_t reserved;
	uint32_t payload;
} wake_item;

static void waiter_entry(void *p1, void *p2, void *p3)
{
	ARG_UNUSED(p1);
	ARG_UNUSED(p2);
	ARG_UNUSED(p3);

	(void)k_fifo_get(&wake_fifo, K_FOREVER);
	ztest_benchmark_end();
	k_sem_give(&done_sem);
}

static void waiter_create(void)
{
	int priority = k_thread_priority_get(k_current_get()) - 1;

	k_thread_create(&waiter_thread, waiter_stack, BENCH_PARTNER_STACK_SIZE, waiter_entry,
			NULL, NULL, NULL, priority, 0, K_NO_WAIT);
}

static void waiter_join(void)
{
	(void)k_thread_join(&waiter_thread, K_FOREVER);
}

ZTEST_BENCHMARK_MANUAL(fifo, put_wake_switch, BENCH_SAMPLES, waiter_create, waiter_join)
{
	ztest_benchmark_start();
	k_fifo_put(&wake_fifo, &wake_item);
	(void)k_sem_take(&done_sem, K_FOREVER);
}
```

## src/heap.c
```c
/*
 * SPDX-FileCopyrightText: Copyright The Zephyr Project Contributors
 * SPDX-License-Identifier: Apache-2.0
 */

/*
 * Kernel heap allocation. Allocating and freeing are separate
 * benchmarks so that the two costs, which differ, do not hide inside
 * one number.
 */

#include "bench.h"

ZTEST_BENCHMARK_SUITE(heap, NULL, NULL);

#define BLOCK_SIZE 64

static void *block;

static void heap_alloc(void)
{
	block = k_malloc(BLOCK_SIZE);
	__ASSERT(block != NULL, "k_malloc failed; raise CONFIG_HEAP_MEM_POOL_SIZE");
}

static void heap_free(void)
{
	k_free(block);
	block = NULL;
}

ZTEST_BENCHMARK(heap, malloc, BENCH_SAMPLES, NULL, heap_free)
{
	block = k_malloc(BLOCK_SIZE);
}

ZTEST_BENCHMARK(heap, free, BENCH_SAMPLES, heap_alloc, NULL)
{
	k_free(block);
}
```

## src/lifo.c
```c
/*
 * SPDX-FileCopyrightText: Copyright The Zephyr Project Contributors
 * SPDX-License-Identifier: Apache-2.0
 */

/* LIFO operations, for comparison against the FIFO of the same shape. */

#include "bench.h"

ZTEST_BENCHMARK_SUITE(lifo, NULL, NULL);

static K_LIFO_DEFINE(lifo);

static struct {
	intptr_t reserved;
	uint32_t payload;
} item;

static void lifo_fill(void)
{
	k_lifo_put(&lifo, &item);
}

static void lifo_drain(void)
{
	(void)k_lifo_get(&lifo, K_NO_WAIT);
}

ZTEST_BENCHMARK(lifo, put, BENCH_SAMPLES, NULL, lifo_drain)
{
	k_lifo_put(&lifo, &item);
}

ZTEST_BENCHMARK(lifo, get, BENCH_SAMPLES, lifo_fill, NULL)
{
	(void)k_lifo_get(&lifo, K_NO_WAIT);
}
```

## src/mutex.c
```c
/*
 * SPDX-FileCopyrightText: Copyright The Zephyr Project Contributors
 * SPDX-License-Identifier: Apache-2.0
 */

/*
 * Uncontended mutex operations. Splitting lock from unlock is what the
 * setup and teardown hooks are for: neither is timed, so each
 * benchmark reports one operation rather than the pair.
 */

#include "bench.h"

ZTEST_BENCHMARK_SUITE(mutex, NULL, NULL);

static K_MUTEX_DEFINE(mutex);

static void mutex_acquire(void)
{
	(void)k_mutex_lock(&mutex, K_FOREVER);
}

static void mutex_release(void)
{
	(void)k_mutex_unlock(&mutex);
}

ZTEST_BENCHMARK(mutex, lock, BENCH_SAMPLES, NULL, mutex_release)
{
	(void)k_mutex_lock(&mutex, K_FOREVER);
}

ZTEST_BENCHMARK(mutex, unlock, BENCH_SAMPLES, mutex_acquire, NULL)
{
	(void)k_mutex_unlock(&mutex);
}
```

## src/semaphore.c
```c
/*
 * SPDX-FileCopyrightText: Copyright The Zephyr Project Contributors
 * SPDX-License-Identifier: Apache-2.0
 */

/*
 * Semaphore operations. The uncontended give and take are timed by the
 * framework; waking a waiting thread is measured manually, because the
 * span ends in that thread.
 */

#include "bench.h"

ZTEST_BENCHMARK_SUITE(semaphore, NULL, NULL);

static K_SEM_DEFINE(sem, 0, 1);

static void sem_drain(void)
{
	(void)k_sem_take(&sem, K_NO_WAIT);
}

static void sem_fill(void)
{
	k_sem_give(&sem);
}

ZTEST_BENCHMARK(semaphore, give, BENCH_SAMPLES, NULL, sem_drain)
{
	k_sem_give(&sem);
}

ZTEST_BENCHMARK(semaphore, take, BENCH_SAMPLES, sem_fill, NULL)
{
	(void)k_sem_take(&sem, K_NO_WAIT);
}

/*
 * Time from k_sem_give() to the higher priority thread that was
 * blocked on the semaphore running again: the wake plus the context
 * switch it forces.
 */
static K_SEM_DEFINE(wake_sem, 0, 1);
static K_SEM_DEFINE(done_sem, 0, 1);
static K_THREAD_STACK_DEFINE(waiter_stack, BENCH_PARTNER_STACK_SIZE);
static struct k_thread waiter_thread;

static void waiter_entry(void *p1, void *p2, void *p3)
{
	ARG_UNUSED(p1);
	ARG_UNUSED(p2);
	ARG_UNUSED(p3);

	(void)k_sem_take(&wake_sem, K_FOREVER);
	ztest_benchmark_end();
	k_sem_give(&done_sem);
}

static void waiter_create(void)
{
	int priority = k_thread_priority_get(k_current_get()) - 1;

	k_thread_create(&waiter_thread, waiter_stack, BENCH_PARTNER_STACK_SIZE, waiter_entry,
			NULL, NULL, NULL, priority, 0, K_NO_WAIT);
}

static void waiter_join(void)
{
	(void)k_thread_join(&waiter_thread, K_FOREVER);
}

ZTEST_BENCHMARK_MANUAL(semaphore, give_wake_switch, BENCH_SAMPLES, waiter_create, waiter_join)
{
	ztest_benchmark_start();
	k_sem_give(&wake_sem);
	(void)k_sem_take(&done_sem, K_FOREVER);
}
```

## src/stack.c
```c
/*
 * SPDX-FileCopyrightText: Copyright The Zephyr Project Contributors
 * SPDX-License-Identifier: Apache-2.0
 */

/* k_stack push and pop, uncontended. */

#include "bench.h"

ZTEST_BENCHMARK_SUITE(stack, NULL, NULL);

#define STACK_DEPTH 4

K_STACK_DEFINE(stack, STACK_DEPTH);

static void stack_fill(void)
{
	(void)k_stack_push(&stack, (stack_data_t)0xbeef);
}

static void stack_drain(void)
{
	stack_data_t value;

	(void)k_stack_pop(&stack, &value, K_NO_WAIT);
}

ZTEST_BENCHMARK(stack, push, BENCH_SAMPLES, NULL, stack_drain)
{
	(void)k_stack_push(&stack, (stack_data_t)0xbeef);
}

ZTEST_BENCHMARK(stack, pop, BENCH_SAMPLES, stack_fill, NULL)
{
	stack_data_t value;

	(void)k_stack_pop(&stack, &value, K_NO_WAIT);
}
```

## src/thread.c
```c
/*
 * SPDX-FileCopyrightText: Copyright The Zephyr Project Contributors
 * SPDX-License-Identifier: Apache-2.0
 */

/*
 * Thread lifecycle operations, and the context switch itself.
 *
 * The lifecycle operations are timed by the framework: each one is the
 * body, and whatever has to happen around it to make the operation
 * legal is the setup or the teardown, which are not timed. The context
 * switch is measured manually, because it ends in a different thread
 * from the one it starts in.
 */

#include "bench.h"

static void yield_partner_create(void);
static void yield_partner_abort(void);

ZTEST_BENCHMARK_SUITE(thread, yield_partner_create, yield_partner_abort);

static K_THREAD_STACK_DEFINE(target_stack, BENCH_PARTNER_STACK_SIZE);
static struct k_thread target_thread;

/* Never runs: created below the benchmark's priority and left parked */
static void target_entry(void *p1, void *p2, void *p3)
{
	ARG_UNUSED(p1);
	ARG_UNUSED(p2);
	ARG_UNUSED(p3);

	k_sleep(K_FOREVER);
}

static int target_priority(void)
{
	return k_thread_priority_get(k_current_get()) + 1;
}

static void target_create(void)
{
	k_thread_create(&target_thread, target_stack, BENCH_PARTNER_STACK_SIZE, target_entry,
			NULL, NULL, NULL, target_priority(), 0, K_FOREVER);
}

static void target_create_and_start(void)
{
	target_create();
	k_thread_start(&target_thread);
}

static void target_create_start_suspend(void)
{
	target_create_and_start();
	k_thread_suspend(&target_thread);
}

/*
 * Abort and then wait for the thread to be reaped. Where thread stacks
 * are memory mapped, the mapping is only released once the terminated
 * thread has been cleaned up, and a thousand create/abort cycles that
 * do not wait exhaust the mapping pool.
 */
static void target_abort(void)
{
	k_thread_abort(&target_thread);
	(void)k_thread_join(&target_thread, K_FOREVER);
}

static void target_join(void)
{
	(void)k_thread_join(&target_thread, K_FOREVER);
}

ZTEST_BENCHMARK(thread, create, BENCH_SAMPLES, NULL, target_abort)
{
	target_create();
}

ZTEST_BENCHMARK(thread, start, BENCH_SAMPLES, target_create, target_abort)
{
	k_thread_start(&target_thread);
}

ZTEST_BENCHMARK(thread, suspend, BENCH_SAMPLES, target_create_and_start, target_abort)
{
	k_thread_suspend(&target_thread);
}

ZTEST_BENCHMARK(thread, resume, BENCH_SAMPLES, target_create_start_suspend, target_abort)
{
	k_thread_resume(&target_thread);
}

ZTEST_BENCHMARK(thread, abort, BENCH_SAMPLES, target_create_and_start, target_join)
{
	k_thread_abort(&target_thread);
}

/*
 * Context switch through k_yield(), measured between two threads of
 * equal priority that hand the CPU back and forth. The partner ends
 * the span, so it covers the switch itself rather than the cost of
 * calling k_yield().
 *
 * The partner lives for the whole suite and loops on ending the span
 * and yielding back, so after the cold run every span ends in a thread
 * returning from k_yield() rather than in one entering for the first
 * time. Ending a span that is not open is ignored, so every pass may
 * try. It is kept suspended except while a yield benchmark iterates, so
 * the lifecycle benchmarks above run against an empty ready queue.
 */
static K_THREAD_STACK_DEFINE(yield_stack, BENCH_PARTNER_STACK_SIZE);
static struct k_thread yield_thread;
static volatile bool yield_stopping;
static int yield_saved_priority;

static void yield_partner(void *p1, void *p2, void *p3)
{
	ARG_UNUSED(p1);
	ARG_UNUSED(p2);
	ARG_UNUSED(p3);

	while (!yield_stopping) {
		ztest_benchmark_end();
		k_yield();
	}
}

static void yield_partner_create(void)
{
	yield_stopping = false;

	k_thread_create(&yield_thread, yield_stack, BENCH_PARTNER_STACK_SIZE, yield_partner,
			NULL, NULL, NULL, k_thread_priority_get(k_current_get()), 0, K_NO_WAIT);
	k_thread_suspend(&yield_thread);
}

static void yield_partner_abort(void)
{
	yield_stopping = true;
	k_thread_resume(&yield_thread);
	(void)k_thread_join(&yield_thread, K_FOREVER);
}

/*
 * The partner runs at the measuring thread's own priority so that
 * k_yield() actually switches. For the cooperative variant both are
 * moved into the cooperative range first, and put back afterwards.
 */
static void yield_resume(bool cooperative)
{
	yield_saved_priority = k_thread_priority_get(k_current_get());

	if (cooperative) {
		k_thread_priority_set(k_current_get(), K_PRIO_COOP(2));
	}

	k_thread_priority_set(&yield_thread, k_thread_priority_get(k_current_get()));
	k_thread_resume(&yield_thread);
}

static void yield_resume_preemptive(void)
{
	yield_resume(false);
}

static void yield_resume_cooperative(void)
{
	yield_resume(true);
}

static void yield_suspend(void)
{
	k_thread_suspend(&yield_thread);
	k_thread_priority_set(k_current_get(), yield_saved_priority);
}

ZTEST_BENCHMARK_MANUAL(thread, yield_preemptive, BENCH_SAMPLES, yield_resume_preemptive,
		       yield_suspend)
{
	ztest_benchmark_start();
	k_yield();
}

ZTEST_BENCHMARK_MANUAL(thread, yield_cooperative, BENCH_SAMPLES, yield_resume_cooperative,
		       yield_suspend)
{
	ztest_benchmark_start();
	k_yield();
}
```

## src/yield_queue.c
```c
/*
 * SPDX-FileCopyrightText: Copyright The Zephyr Project Contributors
 * SPDX-License-Identifier: Apache-2.0
 */

/*
 * Yielding against a loaded ready queue.
 *
 * k_yield() puts the running thread back among the threads of equal
 * priority, which a ready queue may do by walking the queue. What that
 * costs therefore depends on how many threads are runnable at the
 * priority, and a single measurement cannot tell an implementation
 * that walks from one that does not. The same yield is measured here
 * against three queue depths, so the three numbers together show
 * whether the cost grows with the depth.
 *
 * The threads that make up the depth are the measurement's partner as
 * well: whichever of them the yield switches to closes the span, so
 * what is measured is one yield and the one context switch it causes,
 * exactly as in thread.yield_*, and not a trip around the queue.
 */

#include "bench.h"

#define FILLER_COUNT       16
#define FILLER_STACK_SIZE  (512 + CONFIG_TEST_EXTRA_STACK_SIZE)

static void fillers_start(void);
static void fillers_stop(void);

ZTEST_BENCHMARK_SUITE(yield_queue, fillers_start, fillers_stop);

static K_THREAD_STACK_ARRAY_DEFINE(filler_stacks, FILLER_COUNT, FILLER_STACK_SIZE);
static struct k_thread filler_threads[FILLER_COUNT];
static volatile bool fillers_stopping;

/*
 * Runnable for as long as the suite lasts, so that the queue the
 * measuring thread yields into is the depth the benchmark asked for.
 * Ending a span that is not open is ignored, so every pass may try.
 */
static void filler_entry(void *p1, void *p2, void *p3)
{
	ARG_UNUSED(p1);
	ARG_UNUSED(p2);
	ARG_UNUSED(p3);

	while (!fillers_stopping) {
		ztest_benchmark_end();
		k_yield();
	}
}

static void fillers_start(void)
{
	int priority = k_thread_priority_get(k_current_get());

	fillers_stopping = false;

	for (size_t i = 0; i < FILLER_COUNT; i++) {
		k_thread_create(&filler_threads[i], filler_stacks[i], FILLER_STACK_SIZE,
				filler_entry, NULL, NULL, NULL, priority, 0, K_NO_WAIT);
		k_thread_suspend(&filler_threads[i]);
	}
}

static void fillers_stop(void)
{
	fillers_stopping = true;

	for (size_t i = 0; i < FILLER_COUNT; i++) {
		k_thread_resume(&filler_threads[i]);
	}

	for (size_t i = 0; i < FILLER_COUNT; i++) {
		(void)k_thread_join(&filler_threads[i], K_FOREVER);
	}
}

/*
 * Leave exactly depth filler threads runnable. Runs in the untimed
 * setup, so what it costs is not part of any sample.
 */
static void fillers_set_depth(size_t depth)
{
	for (size_t i = 0; i < FILLER_COUNT; i++) {
		if (i < depth) {
			k_thread_resume(&filler_threads[i]);
		} else {
			k_thread_suspend(&filler_threads[i]);
		}
	}
}

static void depth_1_setup(void)
{
	fillers_set_depth(1);
}

static void depth_4_setup(void)
{
	fillers_set_depth(4);
}

static void depth_16_setup(void)
{
	fillers_set_depth(FILLER_COUNT);
}

ZTEST_BENCHMARK_MANUAL(yield_queue, depth_1, BENCH_SAMPLES, depth_1_setup, NULL)
{
	ztest_benchmark_start();
	k_yield();
}

ZTEST_BENCHMARK_MANUAL(yield_queue, depth_4, BENCH_SAMPLES, depth_4_setup, NULL)
{
	ztest_benchmark_start();
	k_yield();
}

ZTEST_BENCHMARK_MANUAL(yield_queue, depth_16, BENCH_SAMPLES, depth_16_setup, NULL)
{
	ztest_benchmark_start();
	k_yield();
}
```
