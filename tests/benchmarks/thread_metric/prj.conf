## CMakeLists.txt
```
# SPDX-License-Identifier: Apache-2.0

cmake_minimum_required(VERSION 3.28.0)
find_package(Zephyr REQUIRED HINTS $ENV{ZEPHYR_BASE})
project(thread_metric)

target_sources_ifdef(CONFIG_TM_POSIX_API app PRIVATE src/tm_porting_layer_posix.c)
target_sources_ifndef(CONFIG_TM_POSIX_API app PRIVATE src/tm_porting_layer_zephyr.c)
target_sources_ifdef(CONFIG_TM_BASIC                 app PRIVATE src/tm_basic_processing_test.c)
target_sources_ifdef(CONFIG_TM_COOPERATIVE           app PRIVATE src/tm_cooperative_scheduling_test.c)
target_sources_ifdef(CONFIG_TM_INTERRUPT             app PRIVATE src/tm_interrupt_processing_test.c)
target_sources_ifdef(CONFIG_TM_INTERRUPT_PREEMPTION  app PRIVATE src/tm_interrupt_preemption_processing_test.c)
target_sources_ifdef(CONFIG_TM_MEMORY_ALLOCATION     app PRIVATE src/tm_memory_allocation_test.c)
target_sources_ifdef(CONFIG_TM_MESSAGE               app PRIVATE src/tm_message_processing_test.c)
target_sources_ifdef(CONFIG_TM_PREEMPTIVE            app PRIVATE src/tm_preemptive_scheduling_test.c)
target_sources_ifdef(CONFIG_TM_SYNCHRONIZATION       app PRIVATE src/tm_synchronization_processing_test.c)
```

## Kconfig
```
# Copyright (c) 2024 Intel Corporation
# SPDX-License-Identifier: Apache-2.0

mainmenu "Eclipse ThreadX Thread-Metric RTOS Test Suite"

choice TM_TEST
	prompt "Select a Thread-Metric test to execute"
	default TM_PREEMPTIVE
	help
	  The Thread-Metric benchmark suite consists of eight RTOS tests.
	  These tests measure the total number of RTOS events that can be
	  processed during a 30 second time interval.

config TM_BASIC
	bool "Baseline basic benchmark"
	help
	  The baseline basic benchmark consists of a single thread that counts
	  the number of times it performs a set of calculations. This number
	  is reported every 30 seconds.

config TM_COOPERATIVE
	bool "Cooperative context switching"
	help
	  The cooperative context switching benchmark spawns five (5) threads
	  of equal priority that yield to each other and increment counters
	  on each context switch. The sum total of the counters is reported
	  every 30 seconds.

config TM_INTERRUPT
	bool "Interrupt processing"
	depends on ARCH_HAS_IRQ_PENDING_OPS && GEN_SW_ISR_TABLE_ARRAY
	select TEST
	select DYNAMIC_INTERRUPTS
	help
	  The interrupt processing benchmark has a single thread that causes
	  an interrupt which results in its ISR incrementing a counter and then
	  posting a semaphore. The thread then increments its own counter and
	  takes that semaphore. The sum total of the counters is reported
	  every 30 seconds.

config TM_INTERRUPT_PREEMPTION
	bool "Interrupt processing preemption"
	depends on ARCH_HAS_IRQ_PENDING_OPS && GEN_SW_ISR_TABLE_ARRAY
	select TEST
	select DYNAMIC_INTERRUPTS
	help
	  The interrupt preemption benchmark counts the number of times that
	  an ISR from a software generated interrupt results in the preemption
	  of a thread. The total number of context switches is reported every
	  30 seconds.

config TM_MEMORY_ALLOCATION
	bool "Memory allocation"
	help
	  The memory allocation benchmark counts the number of times a thread
	  is able to allocate and then release a 128-byte block. This number
	  is reported every 30 seconds.

config TM_MESSAGE
	bool "Message processing"
	help
	  The message processing benchmark counts the number of times that a
	  thread can send and receive a 16-byte message from a message queue.
	  This number is reported every 30 seconds.

config TM_PREEMPTIVE
	bool "Preemptive context switching"
	help
	  The preemptive context switching benchmark creates five (5) threads
	  of different priorities that suspend and resume each other in a
	  cyclical pattern. The total number of context switches is reported
	  every 30 seconds.

config TM_SYNCHRONIZATION
	bool "Synchronization"
	help
	  The synchronization benchmark counts the number of times that a
	  thread can give and take a semaphore without blocking. This number
	  is reported every 30 seconds.

endchoice

source "Kconfig.zephyr"
```

## prj.conf
```kconfig
# Default base configuration file

# The interrupt scenarios select TEST, which in turn enables asserts by default
CONFIG_ASSERT=n

# Use a tickless kernel to minimize the number of timer interrupts
CONFIG_TICKLESS_KERNEL=y
CONFIG_SYS_CLOCK_TICKS_PER_SEC=100

# Optimize for speed
CONFIG_SPEED_OPTIMIZATIONS=y

# Disable time slicing
CONFIG_TIMESLICING=n

# Test is only designed for a single CPU
CONFIG_MP_MAX_NUM_CPUS=1

# Disabling hardware stack protection can greatly
# improve system performance.
CONFIG_HW_STACK_PROTECTION=n

# Disable Thread Local Storage for better context switching times
CONFIG_THREAD_LOCAL_STORAGE=n

# Disable memory slab pointer validation
CONFIG_MEM_SLAB_POINTER_VALIDATE=n

# Turn off MPU explicitly, as some platforms enable it even when
# unused, and it impacts performance paths needlessly (on arm, ARM_MPU
# appears to select MPU, so you need to hit both)
CONFIG_MPU=n
CONFIG_ARM_MPU=n
```

## posix.conf
```kconfig
# SPDX-FileCopyrightText: Copyright The Zephyr Project Contributors
# SPDX-License-Identifier: Apache-2.0

# POSIX porting layer support
CONFIG_POSIX_API=y
CONFIG_POSIX_MESSAGE_PASSING=y
CONFIG_POSIX_PRIORITY_SCHEDULING=y

# Provide pthread objects and stacks without measuring heap allocation during
# pthread creation. Thread-Metric uses at most five threads at a time.
CONFIG_DYNAMIC_THREAD=y
CONFIG_THREAD_STACK_INFO=y
CONFIG_DYNAMIC_THREAD_POOL_SIZE=5
CONFIG_POSIX_THREAD_THREADS_MAX=5

# POSIX message queues and the memory allocation benchmark use the system heap.
CONFIG_HEAP_MEM_POOL_SIZE=4096
```

## src/tm_api.h
```c
/***************************************************************************
 * Copyright (c) 2024 Microsoft Corporation
 *
 * This program and the accompanying materials are made available under the
 * terms of the MIT License which is available at
 * https://opensource.org/licenses/MIT.
 *
 * SPDX-License-Identifier: MIT
 **************************************************************************/

/**************************************************************************/
/**************************************************************************/
/**                                                                       */
/** Thread-Metric Component                                               */
/**                                                                       */
/** Application Interface (API)                                           */
/**                                                                       */
/**************************************************************************/
/**************************************************************************/

/**************************************************************************/
/*                                                                        */
/*  APPLICATION INTERFACE DEFINITION                       RELEASE        */
/*                                                                        */
/*    tm_api.h                                            PORTABLE C      */
/*                                                           6.1.7        */
/*  AUTHOR                                                                */
/*                                                                        */
/*    William E. Lamie, Microsoft Corporation                             */
/*                                                                        */
/*  DESCRIPTION                                                           */
/*                                                                        */
/*    This file defines the basic Application Interface (API)             */
/*    implementation source code for the Thread-Metrics performance       */
/*    test suite. All service prototypes and data structure definitions   */
/*    are defined in this file.                                           */
/*                                                                        */
/*  RELEASE HISTORY                                                       */
/*                                                                        */
/*    DATE              NAME                      DESCRIPTION             */
/*                                                                        */
/*  10-15-2021     William E. Lamie         Initial Version 6.1.7         */
/*                                                                        */
/**************************************************************************/

#ifndef TM_API_H
#define TM_API_H

#include "tm_porting_layer.h"

/*
 * Determine if a C++ compiler is being used.  If so, ensure that standard
 * C is used to process the API information.
 */

#ifdef __cplusplus

/* Yes, C++ compiler is present.  Use standard C.  */
extern "C" {

#endif

/* Define API constants.  */

#define TM_SUCCESS 0
#define TM_ERROR   1

/* Define the time interval in seconds. This can be changed with a -D compiler option.  */

#ifndef TM_TEST_DURATION
#define TM_TEST_DURATION 30
#endif

/*
 * Define RTOS Neutral APIs. RTOS vendors should fill in the guts of the following
 * API. Once this is done the Thread-Metric tests can be successfully run.
 */

void tm_initialize(void (*test_initialization_function)(void));
int tm_thread_create(int thread_id, int priority, void (*entry_function)(void *, void *, void *));
int tm_thread_resume(int thread_id);
int tm_thread_suspend(int thread_id);
void tm_thread_relinquish(void);
void tm_thread_sleep(int seconds);
int tm_queue_create(int queue_id);
int tm_queue_send(int queue_id, unsigned long *message_ptr);
int tm_queue_receive(int queue_id, unsigned long *message_ptr);
int tm_semaphore_create(int semaphore_id);
int tm_semaphore_get(int semaphore_id);
int tm_semaphore_put(int semaphore_id);
int tm_memory_pool_create(int pool_id);
int tm_memory_pool_allocate(int pool_id, unsigned char **memory_ptr);
int tm_memory_pool_deallocate(int pool_id, unsigned char *memory_ptr);

/*
 * Determine if a C++ compiler is being used.  If so, complete the standard
 * C conditional started above.
 */
#ifdef __cplusplus
}
#endif

#endif
```

## src/tm_basic_processing_test.c
```c
/***************************************************************************
 * Copyright (c) 2024 Microsoft Corporation
 *
 * This program and the accompanying materials are made available under the
 * terms of the MIT License which is available at
 * https://opensource.org/licenses/MIT.
 *
 * SPDX-License-Identifier: MIT
 **************************************************************************/

/**************************************************************************/
/**************************************************************************/
/**                                                                       */
/** Thread-Metric Component                                               */
/**                                                                       */
/**   Basic Processing Test                                               */
/**                                                                       */
/**************************************************************************/
/**************************************************************************/

/**************************************************************************/
/*                                                                        */
/*  FUNCTION                                               RELEASE        */
/*                                                                        */
/*    tm_basic_processing_test                            PORTABLE C      */
/*                                                           6.1.7        */
/*  AUTHOR                                                                */
/*                                                                        */
/*    William E. Lamie, Microsoft Corporation                             */
/*                                                                        */
/*  DESCRIPTION                                                           */
/*                                                                        */
/*    This file defines the basic test for determining board processing   */
/*    capabilities                                                        */
/*                                                                        */
/*  RELEASE HISTORY                                                       */
/*                                                                        */
/*    DATE              NAME                      DESCRIPTION             */
/*                                                                        */
/*  10-15-2021     William E. Lamie         Initial Version 6.1.7         */
/*                                                                        */
/**************************************************************************/
#include "tm_api.h"

/* Define the counters used in the demo application...  */

volatile unsigned long tm_basic_processing_counter;

/*
 * Test array.  We will just do a series of calculations on the
 * test array to eat up processing bandwidth. The idea is that
 * all RTOSes should produce the same metric here if everything
 * else is equal, e.g. processor speed, memory speed, etc.
 */

volatile unsigned long tm_basic_processing_array[1024];

/* Define the test thread prototypes.  */

void tm_basic_processing_thread_0_entry(void *p1, void *p2, void *p3);

/* Define the reporting function prototype.  */

void tm_basic_processing_thread_report(void);

/* Define the initialization prototype.  */

void tm_basic_processing_initialize(void);

/* Define main entry point.  */

int main(void)
{
	/* Initialize the test.  */
	tm_initialize(tm_basic_processing_initialize);

	return 0;
}

/* Define the basic processing test initialization.  */

void tm_basic_processing_initialize(void)
{
	/* Create thread 0 at priority 10.  */
	tm_thread_create(0, 10, tm_basic_processing_thread_0_entry);

	/* Resume thread 0.  */
	tm_thread_resume(0);

	tm_basic_processing_thread_report();
}

/* Define the basic processing thread.  */
void tm_basic_processing_thread_0_entry(void *p1, void *p2, void *p3)
{
	int i;

	(void)p1;
	(void)p2;
	(void)p3;

	/* Initialize the test array.   */
	for (i = 0; i < 1024; i++) {

		/* Clear the basic processing array.  */
		tm_basic_processing_array[i] = 0;
	}

	while (1) {

		/*
		 * Loop through the basic processing array, add the previous
		 * contents with the contents of the tm_basic_processing_counter
		 * and xor the result with the previous value...   just to eat
		 * up some time.
		 */

		for (i = 0; i < 1024; i++) {

			/* Update each array entry.  */
			tm_basic_processing_array[i] =
				(tm_basic_processing_array[i] + tm_basic_processing_counter) ^
				tm_basic_processing_array[i];
		}

		/* Increment the basic processing counter.  */
		tm_basic_processing_counter++;
	}
}

/* Define the basic processing reporting function.  */
void tm_basic_processing_thread_report(void)
{

	unsigned long last_counter;
	unsigned long relative_time;

	/* Initialize the last counter.  */
	last_counter = 0;

	/* Initialize the relative time.  */
	relative_time = 0;

	while (1) {

		/* Sleep to allow the test to run.  */
		tm_thread_sleep(TM_TEST_DURATION);

		/* Increment the relative time.  */
		relative_time = relative_time + TM_TEST_DURATION;

		/* Print results to the stdio window.  */
		printf("**** Thread-Metric Basic Single Thread Processing Test **** Relative Time: "
		       "%lu\n",
		       relative_time);

		/* See if there are any errors.  */
		if (tm_basic_processing_counter == last_counter) {

			printf("ERROR: Invalid counter value(s). Basic processing thread died!\n");
		}

		/* Show the time period total.  */
		printf("Time Period Total:  %lu\n\n", tm_basic_processing_counter - last_counter);

		/* Save the last counter.  */
		last_counter = tm_basic_processing_counter;
	}
}
```

## src/tm_cooperative_scheduling_test.c
```c
/***************************************************************************
 * Copyright (c) 2024 Microsoft Corporation
 *
 * This program and the accompanying materials are made available under the
 * terms of the MIT License which is available at
 * https://opensource.org/licenses/MIT.
 *
 * SPDX-License-Identifier: MIT
 **************************************************************************/

/**************************************************************************/
/**************************************************************************/
/**                                                                       */
/** Thread-Metric Component                                               */
/**                                                                       */
/**   Cooperative Scheduling Test                                         */
/**                                                                       */
/**************************************************************************/
/**************************************************************************/

/**************************************************************************/
/*                                                                        */
/*  FUNCTION                                               RELEASE        */
/*                                                                        */
/*    tm_cooperative_scheduling_test                      PORTABLE C      */
/*                                                           6.1.7        */
/*  AUTHOR                                                                */
/*                                                                        */
/*    William E. Lamie, Microsoft Corporation                             */
/*                                                                        */
/*  DESCRIPTION                                                           */
/*                                                                        */
/*    This file defines the cooperative scheduling test.                  */
/*                                                                        */
/*  RELEASE HISTORY                                                       */
/*                                                                        */
/*    DATE              NAME                      DESCRIPTION             */
/*                                                                        */
/*  10-15-2021     William E. Lamie         Initial Version 6.1.7         */
/*                                                                        */
/**************************************************************************/
#include "tm_api.h"

/* Define the counters used in the demo application...  */

unsigned long tm_cooperative_thread_0_counter;
unsigned long tm_cooperative_thread_1_counter;
unsigned long tm_cooperative_thread_2_counter;
unsigned long tm_cooperative_thread_3_counter;
unsigned long tm_cooperative_thread_4_counter;

/* Define the test thread prototypes.  */

void tm_cooperative_thread_0_entry(void *p1, void *p2, void *p3);
void tm_cooperative_thread_1_entry(void *p1, void *p2, void *p3);
void tm_cooperative_thread_2_entry(void *p1, void *p2, void *p3);
void tm_cooperative_thread_3_entry(void *p1, void *p2, void *p3);
void tm_cooperative_thread_4_entry(void *p1, void *p2, void *p3);

/* Define the reporting function prototype.  */

void tm_cooperative_thread_report(void);

/* Define the initialization prototype.  */

void tm_cooperative_scheduling_initialize(void);

/* Define main entry point.  */

int main(void)
{

	/* Initialize the test.  */
	tm_initialize(tm_cooperative_scheduling_initialize);

	return 0;
}

/* Define the cooperative scheduling test initialization.  */

void tm_cooperative_scheduling_initialize(void)
{
	int prio = CONFIG_MAIN_THREAD_PRIORITY;

	/* Create all 5 threads at the same priority as the main thread.  */
	tm_thread_create(0, prio, tm_cooperative_thread_0_entry);
	tm_thread_create(1, prio, tm_cooperative_thread_1_entry);
	tm_thread_create(2, prio, tm_cooperative_thread_2_entry);
	tm_thread_create(3, prio, tm_cooperative_thread_3_entry);
	tm_thread_create(4, prio, tm_cooperative_thread_4_entry);

	/* Resume all 5 threads.  */
	tm_thread_resume(0);
	tm_thread_resume(1);
	tm_thread_resume(2);
	tm_thread_resume(3);
	tm_thread_resume(4);

	tm_cooperative_thread_report();
}

/* Define the first cooperative thread.  */
void tm_cooperative_thread_0_entry(void *p1, void *p2, void *p3)
{
	(void)p1;
	(void)p2;
	(void)p3;

	while (1) {

		/* Relinquish to all other threads at same priority.  */
		tm_thread_relinquish();

		/* Increment this thread's counter.  */
		tm_cooperative_thread_0_counter++;
	}
}

/* Define the second cooperative thread.  */
void tm_cooperative_thread_1_entry(void *p1, void *p2, void *p3)
{
	(void)p1;
	(void)p2;
	(void)p3;

	while (1) {

		/* Relinquish to all other threads at same priority.  */
		tm_thread_relinquish();

		/* Increment this thread's counter.  */
		tm_cooperative_thread_1_counter++;
	}
}

/* Define the third cooperative thread.  */
void tm_cooperative_thread_2_entry(void *p1, void *p2, void *p3)
{
	(void)p1;
	(void)p2;
	(void)p3;

	while (1) {

		/* Relinquish to all other threads at same priority.  */
		tm_thread_relinquish();

		/* Increment this thread's counter.  */
		tm_cooperative_thread_2_counter++;
	}
}

/* Define the fourth cooperative thread.  */
void tm_cooperative_thread_3_entry(void *p1, void *p2, void *p3)
{
	(void)p1;
	(void)p2;
	(void)p3;

	while (1) {

		/* Relinquish to all other threads at same priority.  */
		tm_thread_relinquish();

		/* Increment this thread's counter.  */
		tm_cooperative_thread_3_counter++;
	}
}

/* Define the fifth cooperative thread.  */
void tm_cooperative_thread_4_entry(void *p1, void *p2, void *p3)
{
	(void)p1;
	(void)p2;
	(void)p3;

	while (1) {

		/* Relinquish to all other threads at same priority.  */
		tm_thread_relinquish();

		/* Increment this thread's counter.  */
		tm_cooperative_thread_4_counter++;
	}
}

/* Define the cooperative test reporting function.  */
void tm_cooperative_thread_report(void)
{

	unsigned long total;
	unsigned long relative_time;
	unsigned long last_total;
	unsigned long average;

	/* Initialize the last total.  */
	last_total = 0;

	/* Initialize the relative time.  */
	relative_time = 0;

	while (1) {

		/* Sleep to allow the test to run.  */
		tm_thread_sleep(TM_TEST_DURATION);

		/* Increment the relative time.  */
		relative_time = relative_time + TM_TEST_DURATION;

		/* Print results to the stdio window.  */
		printf("**** Thread-Metric Cooperative Scheduling Test **** Relative Time: %lu\n",
		       relative_time);

		/* Calculate the total of all the counters.  */
		total = tm_cooperative_thread_0_counter + tm_cooperative_thread_1_counter +
			tm_cooperative_thread_2_counter + tm_cooperative_thread_3_counter +
			tm_cooperative_thread_4_counter;

		/* Calculate the average of all the counters.  */
		average = total / 5;

		/* WCC - integrity check */
		printf("tm_cooperative_thread_0_counter: %lu\n", tm_cooperative_thread_0_counter);
		printf("tm_cooperative_thread_1_counter: %lu\n", tm_cooperative_thread_1_counter);
		printf("tm_cooperative_thread_2_counter: %lu\n", tm_cooperative_thread_2_counter);
		printf("tm_cooperative_thread_3_counter: %lu\n", tm_cooperative_thread_3_counter);
		printf("tm_cooperative_thread_4_counter: %lu\n", tm_cooperative_thread_4_counter);

		/* See if there are any errors.  */
		if ((tm_cooperative_thread_0_counter < (average - 1)) ||
		    (tm_cooperative_thread_0_counter > (average + 1)) ||
		    (tm_cooperative_thread_1_counter < (average - 1)) ||
		    (tm_cooperative_thread_1_counter > (average + 1)) ||
		    (tm_cooperative_thread_2_counter < (average - 1)) ||
		    (tm_cooperative_thread_2_counter > (average + 1)) ||
		    (tm_cooperative_thread_3_counter < (average - 1)) ||
		    (tm_cooperative_thread_3_counter > (average + 1)) ||
		    (tm_cooperative_thread_4_counter < (average - 1)) ||
		    (tm_cooperative_thread_4_counter > (average + 1))) {

			printf("ERROR: Invalid counter value(s). Cooperative counters should not "
			       "be more that 1 different than the average!\n");
		}

		/* Show the time period total.  */
		printf("Time Period Total:  %lu\n\n", total - last_total);

		/* Save the last total.  */
		last_total = total;
	}
}
```

## src/tm_interrupt_preemption_processing_test.c
```c
/***************************************************************************
 * Copyright (c) 2024 Microsoft Corporation
 *
 * This program and the accompanying materials are made available under the
 * terms of the MIT License which is available at
 * https://opensource.org/licenses/MIT.
 *
 * SPDX-License-Identifier: MIT
 **************************************************************************/

/**************************************************************************/
/**************************************************************************/
/**                                                                       */
/** Thread-Metric Component                                               */
/**                                                                       */
/**   Interrupt Preemption Processing Test                                */
/**                                                                       */
/**************************************************************************/
/**************************************************************************/

/**************************************************************************/
/*                                                                        */
/*  FUNCTION                                               RELEASE        */
/*                                                                        */
/*    tm_interrupt_preemption_processing_test             PORTABLE C      */
/*                                                           6.1.7        */
/*  AUTHOR                                                                */
/*                                                                        */
/*    William E. Lamie, Microsoft Corporation                             */
/*                                                                        */
/*  DESCRIPTION                                                           */
/*                                                                        */
/*    This file defines the preemptive scheduling test.                   */
/*                                                                        */
/*  RELEASE HISTORY                                                       */
/*                                                                        */
/*    DATE              NAME                      DESCRIPTION             */
/*                                                                        */
/*  10-15-2021     William E. Lamie         Initial Version 6.1.7         */
/*                                                                        */
/**************************************************************************/

#include "tm_api.h"

/* Define the counters used in the demo application...  */

unsigned long tm_interrupt_preemption_thread_0_counter;
unsigned long tm_interrupt_preemption_thread_1_counter;
unsigned long tm_interrupt_preemption_handler_counter;

/* Define the test thread prototypes.  */

void tm_interrupt_preemption_thread_0_entry(void *p1, void *p2, void *p3);
void tm_interrupt_preemption_thread_1_entry(void *p1, void *p2, void *p3);

/* Define the interrupt handler.  This must be called from the RTOS.  */

void tm_interrupt_handler(void);

/* Define the initialization prototype.  */

void tm_interrupt_preemption_processing_initialize(void);

/* Define the reporting function */

void tm_interrupt_preemption_thread_report(void);

/* Define main entry point.  */

int main(void)
{

	/* Initialize the test.  */
	tm_initialize(tm_interrupt_preemption_processing_initialize);

	return 0;
}

/* Define the interrupt processing test initialization.  */

void tm_interrupt_preemption_processing_initialize(void)
{

	/* Create interrupt thread at priority 3.  */
	tm_thread_create(0, 3, tm_interrupt_preemption_thread_0_entry);

	/* Create thread that generates the interrupt at priority 10.  */
	tm_thread_create(1, 10, tm_interrupt_preemption_thread_1_entry);

	/* Resume just thread 1.  */
	tm_thread_resume(1);

	tm_interrupt_preemption_thread_report();
}

/*
 * Define the interrupt thread.  This thread is resumed from the
 * interrupt handler.  It runs and suspends.
 */
void tm_interrupt_preemption_thread_0_entry(void *p1, void *p2, void *p3)
{

	(void)p1;
	(void)p2;
	(void)p3;

	while (1) {

		/* Increment this thread's counter.  */
		tm_interrupt_preemption_thread_0_counter++;

		/*
		 * Suspend. This will allow the thread generating the
		 * interrupt to run again.
		 */
		tm_thread_suspend(0);
	}
}

/* Define the thread that generates the interrupt.  */
void tm_interrupt_preemption_thread_1_entry(void *p1, void *p2, void *p3)
{

	(void)p1;
	(void)p2;
	(void)p3;

	while (1) {

		/*
		 * Force an interrupt. The underlying RTOS must see that the
		 * the interrupt handler is called from the appropriate software
		 * interrupt or trap.
		 */
		TM_CAUSE_INTERRUPT;

		/*
		 * We won't get back here until the interrupt processing is complete,
		 * including the execution of the higher priority thread made ready
		 * by the interrupt.
		 */

		/* Increment this thread's counter.  */
		tm_interrupt_preemption_thread_1_counter++;
	}
}

/*
 * Define the interrupt handler.  This must be called from the RTOS trap handler.
 * To be fair, it must behave just like a processor interrupt, i.e. it must save
 * the full context of the interrupted thread during the preemption processing.
 */
void tm_interrupt_handler(void)
{

	/* Increment the interrupt count.  */
	tm_interrupt_preemption_handler_counter++;

	/* Resume the higher priority thread from the ISR.  */
	tm_thread_resume(0);
}

/* Define the interrupt test reporting function.  */
void tm_interrupt_preemption_thread_report(void)
{

	unsigned long total;
	unsigned long relative_time;
	unsigned long last_total;
	unsigned long average;

	/* Initialize the last total.  */
	last_total = 0;

	/* Initialize the relative time.  */
	relative_time = 0;

	while (1) {

		/* Sleep to allow the test to run.  */
		tm_thread_sleep(TM_TEST_DURATION);

		/* Increment the relative time.  */
		relative_time = relative_time + TM_TEST_DURATION;

		/* Print results to the stdio window.  */
		printf("**** Thread-Metric Interrupt Preemption Processing Test **** Relative "
		       "Time: %lu\n",
		       relative_time);

		/* Calculate the total of all the counters.  */
		total = tm_interrupt_preemption_thread_0_counter +
			tm_interrupt_preemption_thread_1_counter +
			tm_interrupt_preemption_handler_counter;

		/* Calculate the average of all the counters.  */
		average = total / 3;

		/* See if there are any errors.  */
		if ((tm_interrupt_preemption_thread_0_counter < (average - 1)) ||
		    (tm_interrupt_preemption_thread_0_counter > (average + 1)) ||
		    (tm_interrupt_preemption_thread_1_counter < (average - 1)) ||
		    (tm_interrupt_preemption_thread_1_counter > (average + 1)) ||
		    (tm_interrupt_preemption_handler_counter < (average - 1)) ||
		    (tm_interrupt_preemption_handler_counter > (average + 1))) {

			printf("ERROR: Invalid counter value(s). Interrupt processing test has "
			       "failed!\n");
		}

		/* Show the total interrupts for the time period.  */
		printf("Time Period Total:  %lu\n\n",
		       tm_interrupt_preemption_handler_counter - last_total);

		/* Save the last total number of interrupts.  */
		last_total = tm_interrupt_preemption_handler_counter;
	}
}
```

## src/tm_interrupt_processing_test.c
```c
/***************************************************************************
 * Copyright (c) 2024 Microsoft Corporation
 *
 * This program and the accompanying materials are made available under the
 * terms of the MIT License which is available at
 * https://opensource.org/licenses/MIT.
 *
 * SPDX-License-Identifier: MIT
 **************************************************************************/

/**************************************************************************/
/**************************************************************************/
/**                                                                       */
/** Thread-Metric Component                                               */
/**                                                                       */
/**   Interrupt Processing Test                                           */
/**                                                                       */
/**************************************************************************/
/**************************************************************************/

/**************************************************************************/
/*                                                                        */
/*  FUNCTION                                               RELEASE        */
/*                                                                        */
/*    tm_interrupt_processing_test                        PORTABLE C      */
/*                                                           6.1.7        */
/*  AUTHOR                                                                */
/*                                                                        */
/*    William E. Lamie, Microsoft Corporation                             */
/*                                                                        */
/*  DESCRIPTION                                                           */
/*                                                                        */
/*    This file defines the No-preemption interrupt processing test.      */
/*                                                                        */
/*  RELEASE HISTORY                                                       */
/*                                                                        */
/*    DATE              NAME                      DESCRIPTION             */
/*                                                                        */
/*  10-15-2021     William E. Lamie         Initial Version 6.1.7         */
/*                                                                        */
/**************************************************************************/
#include "tm_api.h"

/* Define the counters used in the demo application...  */

unsigned long tm_interrupt_thread_0_counter;
unsigned long tm_interrupt_handler_counter;

/* Define the test thread prototypes.  */

void tm_interrupt_thread_0_entry(void *p1, void *p2, void *p3);

/* Define the reporting function prototype.  */

void tm_interrupt_thread_report(void);

/* Define the interrupt handler.  This must be called from the RTOS.  */

void tm_interrupt_handler(void);

/* Define the initialization prototype.  */

void tm_interrupt_processing_initialize(void);

/* Define main entry point.  */

int main(void)
{

	/* Initialize the test.  */
	tm_initialize(tm_interrupt_processing_initialize);

	return 0;
}

/* Define the interrupt processing test initialization.  */

void tm_interrupt_processing_initialize(void)
{

	/* Create thread that generates the interrupt at priority 10.  */
	tm_thread_create(0, 10, tm_interrupt_thread_0_entry);

	/*
	 * Create a semaphore that will be posted from the interrupt
	 * handler.
	 */
	tm_semaphore_create(0);

	/* Resume just thread 0.  */
	tm_thread_resume(0);

	tm_interrupt_thread_report();
}

/* Define the thread that generates the interrupt.  */
void tm_interrupt_thread_0_entry(void *p1, void *p2, void *p3)
{

	int status;

	/* Pickup the semaphore since it is initialized to 1 by default. */
	status = tm_semaphore_get(0);

	/* Check for good status.  */
	if (status != TM_SUCCESS) {
		return;
	}

	while (1) {

		/*
		 * Force an interrupt. The underlying RTOS must see that the
		 * the interrupt handler is called from the appropriate software
		 * interrupt or trap.
		 */

		TM_CAUSE_INTERRUPT;

		/*
		 * We won't get back here until the interrupt processing is
		 * complete, including the setting of the semaphore from the
		 * interrupt handler.
		 */

		/* Pickup the semaphore set by the interrupt handler. */
		status = tm_semaphore_get(0);

		/* Check for good status.  */
		if (status != TM_SUCCESS) {
			return;
		}

		/* Increment this thread's counter.  */
		tm_interrupt_thread_0_counter++;
	}
}

/*
 * Define the interrupt handler.  This must be called from the RTOS trap handler.
 * To be fair, it must behave just like a processor interrupt, i.e. it must save
 * the full context of the interrupted thread during the preemption processing.
 */
void tm_interrupt_handler(void)
{
	/* Increment the interrupt count.  */
	tm_interrupt_handler_counter++;

	/* Put the semaphore from the interrupt handler.  */
	tm_semaphore_put(0);
}

/* Define the interrupt test reporting function.  */
void tm_interrupt_thread_report(void)
{

	unsigned long total;
	unsigned long last_total;
	unsigned long relative_time;
	unsigned long average;

	/* Initialize the last total.  */
	last_total = 0;

	/* Initialize the relative time.  */
	relative_time = 0;

	while (1) {

		/* Sleep to allow the test to run.  */
		tm_thread_sleep(TM_TEST_DURATION);

		/* Increment the relative time.  */
		relative_time = relative_time + TM_TEST_DURATION;

		/* Print results to the stdio window.  */
		printf("**** Thread-Metric Interrupt Processing Test **** Relative Time: %lu\n",
		       relative_time);

		/* Calculate the total of all the counters.  */
		total = tm_interrupt_thread_0_counter + tm_interrupt_handler_counter;

		/* Calculate the average of all the counters.  */
		average = total / 2;

		/* See if there are any errors.  */
		if ((tm_interrupt_thread_0_counter < (average - 1)) ||
		    (tm_interrupt_thread_0_counter > (average + 1)) ||
		    (tm_interrupt_handler_counter < (average - 1)) ||
		    (tm_interrupt_handler_counter > (average + 1))) {

			printf("ERROR: Invalid counter value(s). Interrupt processing test has "
			       "failed!\n");
		}

		/* Show the total interrupts for the time period.  */
		printf("Time Period Total:  %lu\n\n", tm_interrupt_handler_counter - last_total);

		/* Save the last total number of interrupts.  */
		last_total = tm_interrupt_handler_counter;
	}
}
```

## src/tm_memory_allocation_test.c
```c
/***************************************************************************
 * Copyright (c) 2024 Microsoft Corporation
 *
 * This program and the accompanying materials are made available under the
 * terms of the MIT License which is available at
 * https://opensource.org/licenses/MIT.
 *
 * SPDX-License-Identifier: MIT
 **************************************************************************/

/**************************************************************************/
/**************************************************************************/
/**                                                                       */
/** Thread-Metric Component                                               */
/**                                                                       */
/**   Memory Allocation Test                                              */
/**                                                                       */
/**************************************************************************/
/**************************************************************************/

/**************************************************************************/
/*                                                                        */
/*  FUNCTION                                               RELEASE        */
/*                                                                        */
/*    tm_memory_allocation_test                           PORTABLE C      */
/*                                                           6.1.7        */
/*  AUTHOR                                                                */
/*                                                                        */
/*    William E. Lamie, Microsoft Corporation                             */
/*                                                                        */
/*  DESCRIPTION                                                           */
/*                                                                        */
/*    This file defines the Message exchange processing test.             */
/*                                                                        */
/*  RELEASE HISTORY                                                       */
/*                                                                        */
/*    DATE              NAME                      DESCRIPTION             */
/*                                                                        */
/*  10-15-2021     William E. Lamie         Initial Version 6.1.7         */
/*                                                                        */
/**************************************************************************/
#include "tm_api.h"

/* Define the counters used in the demo application...  */

unsigned long tm_memory_allocation_counter;

/* Define the test thread prototypes.  */

void tm_memory_allocation_thread_0_entry(void *p1, void *p2, void *p3);

/* Define the reporting function prototype.  */

void tm_memory_allocation_thread_report(void);

/* Define the initialization prototype.  */

void tm_memory_allocation_initialize(void);

/* Define main entry point.  */

int main(void)
{

	/* Initialize the test.  */
	tm_initialize(tm_memory_allocation_initialize);

	return 0;
}

/* Define the memory allocation processing test initialization.  */

void tm_memory_allocation_initialize(void)
{
	/* Create a memory pool.  */
	tm_memory_pool_create(0);

	/* Create thread 0 at priority 10.  */
	tm_thread_create(0, 10, tm_memory_allocation_thread_0_entry);

	/* Resume thread 0.  */
	tm_thread_resume(0);

	tm_memory_allocation_thread_report();
}

/* Define the memory allocation processing thread.  */
void tm_memory_allocation_thread_0_entry(void *p1, void *p2, void *p3)
{

	int status;
	unsigned char *memory_ptr;

	while (1) {

		/* Allocate memory from pool.  */
		tm_memory_pool_allocate(0, &memory_ptr);

		/* Release the memory back to the pool.  */
		status = tm_memory_pool_deallocate(0, memory_ptr);

		/* Check for invalid memory allocation/deallocation.  */
		if (status != TM_SUCCESS) {
			break;
		}

		/* Increment the number of memory allocations sent and received.  */
		tm_memory_allocation_counter++;
	}
}

/* Define the memory allocation test reporting function.  */
void tm_memory_allocation_thread_report(void)
{

	unsigned long last_counter;
	unsigned long relative_time;

	/* Initialize the last counter.  */
	last_counter = 0;

	/* Initialize the relative time.  */
	relative_time = 0;

	while (1) {

		/* Sleep to allow the test to run.  */
		tm_thread_sleep(TM_TEST_DURATION);

		/* Increment the relative time.  */
		relative_time = relative_time + TM_TEST_DURATION;

		/* Print results to the stdio window.  */
		printf("**** Thread-Metric Memory Allocation Test **** Relative Time: %lu\n",
		       relative_time);

		/* See if there are any errors.  */
		if (tm_memory_allocation_counter == last_counter) {

			printf("ERROR: Invalid counter value(s). Error allocating/deallocating "
			       "memory!\n");
		}

		/* Show the time period total.  */
		printf("Time Period Total:  %lu\n\n", tm_memory_allocation_counter - last_counter);

		/* Save the last counter.  */
		last_counter = tm_memory_allocation_counter;
	}
}
```

## src/tm_message_processing_test.c
```c
/***************************************************************************
 * Copyright (c) 2024 Microsoft Corporation
 *
 * This program and the accompanying materials are made available under the
 * terms of the MIT License which is available at
 * https://opensource.org/licenses/MIT.
 *
 * SPDX-License-Identifier: MIT
 **************************************************************************/

/**************************************************************************/
/**************************************************************************/
/**                                                                       */
/** Thread-Metric Component                                               */
/**                                                                       */
/**   Message Processing Test                                             */
/**                                                                       */
/**************************************************************************/
/**************************************************************************/

/**************************************************************************/
/*                                                                        */
/*  FUNCTION                                               RELEASE        */
/*                                                                        */
/*    tm_message_processing_test                          PORTABLE C      */
/*                                                           6.1.7        */
/*  AUTHOR                                                                */
/*                                                                        */
/*    William E. Lamie, Microsoft Corporation                             */
/*                                                                        */
/*  DESCRIPTION                                                           */
/*                                                                        */
/*    Basic test for message exchange processing.                         */
/*                                                                        */
/*  RELEASE HISTORY                                                       */
/*                                                                        */
/*    DATE              NAME                      DESCRIPTION             */
/*                                                                        */
/*  10-15-2021     William E. Lamie         Initial Version 6.1.7         */
/*                                                                        */
/**************************************************************************/
#include "tm_api.h"

/* Define the counters used in the demo application...  */

unsigned long tm_message_processing_counter;
unsigned int tm_message_sent[4];
unsigned int tm_message_received[4];

/* Define the test thread prototypes.  */

void tm_message_processing_thread_0_entry(void *p1, void *p2, void *p3);

/* Define the reporting function prototype.  */

void tm_message_processing_thread_report(void);

/* Define the initialization prototype.  */

void tm_message_processing_initialize(void);

/* Define main entry point.  */

int main(void)
{

	/* Initialize the test.  */
	tm_initialize(tm_message_processing_initialize);

	return 0;
}

/* Define the message processing test initialization.  */

void tm_message_processing_initialize(void)
{

	/* Create thread 0 at priority 10.  */
	tm_thread_create(0, 10, tm_message_processing_thread_0_entry);

	/* Resume thread 0.  */
	tm_thread_resume(0);

	/* Create a queue for the message passing.  */
	tm_queue_create(0);

	tm_message_processing_thread_report();
}

/* Define the message processing thread.  */
void tm_message_processing_thread_0_entry(void *p1, void *p2, void *p3)
{
	(void)p1;
	(void)p2;
	(void)p3;

	/* Initialize the source message.   */
	tm_message_sent[0] = 0x11112222;
	tm_message_sent[1] = 0x33334444;
	tm_message_sent[2] = 0x55556666;
	tm_message_sent[3] = 0x77778888;

	while (1) {
		/* Send a message to the queue.  */
		tm_queue_send(0, (unsigned long *)tm_message_sent);

		/* Receive a message from the queue.  */
		tm_queue_receive(0, (unsigned long *)tm_message_received);

		/* Check for invalid message.  */
		if (tm_message_received[3] != tm_message_sent[3]) {
			break;
		}

		/* Increment the last word of the 16-byte message.  */
		tm_message_sent[3]++;

		/* Increment the number of messages sent and received.  */
		tm_message_processing_counter++;
	}
}

/* Define the message test reporting function.  */
void tm_message_processing_thread_report(void)
{

	unsigned long last_counter;
	unsigned long relative_time;

	/* Initialize the last counter.  */
	last_counter = 0;

	/* Initialize the relative time.  */
	relative_time = 0;

	while (1) {

		/* Sleep to allow the test to run.  */
		tm_thread_sleep(TM_TEST_DURATION);

		/* Increment the relative time.  */
		relative_time = relative_time + TM_TEST_DURATION;

		/* Print results to the stdio window.  */
		printf("**** Thread-Metric Message Processing Test **** Relative Time: %lu\n",
		       relative_time);

		/* See if there are any errors.  */
		if (tm_message_processing_counter == last_counter) {

			printf("ERROR: Invalid counter value(s). Error sending/receiving "
			       "messages!\n");
		}

		/* Show the time period total.  */
		printf("Time Period Total:  %lu\n\n", tm_message_processing_counter - last_counter);

		/* Save the last counter.  */
		last_counter = tm_message_processing_counter;
	}
}
```

## src/tm_porting_layer.h
```c
/***************************************************************************
 * Copyright (c) 2024 Microsoft Corporation
 *
 * This program and the accompanying materials are made available under the
 * terms of the MIT License which is available at
 * https://opensource.org/licenses/MIT.
 *
 * SPDX-License-Identifier: MIT
 **************************************************************************/

#ifndef TM_PORTING_LAYER_H
#define TM_PORTING_LAYER_H

#include <stdio.h>

extern void tm_cause_interrupt(void);

#define TM_CAUSE_INTERRUPT tm_cause_interrupt()

#endif
```
