## CMakeLists.txt
```
# SPDX-License-Identifier: Apache-2.0

cmake_minimum_required(VERSION 3.13.1)
find_package(Zephyr REQUIRED HINTS $ENV{ZEPHYR_BASE})
project(timing_info)

FILE(GLOB app_sources src/[^u]*.c)
target_sources(app PRIVATE ${app_sources})
target_sources_ifdef(CONFIG_USERSPACE app PRIVATE src/userspace_bench.c)

target_sources_ifdef(CONFIG_X86 app PRIVATE src/arch/x86/tsc.c)

target_include_directories(app PRIVATE
  ${ZEPHYR_BASE}/kernel/include
  ${ZEPHYR_BASE}/arch/${ARCH}/include
  )
```

## prj.conf
```kconfig
CONFIG_TEST=y
CONFIG_EXECUTION_BENCHMARKING=y
CONFIG_TEST_RANDOM_GENERATOR=y
CONFIG_HEAP_MEM_POOL_SIZE=256
CONFIG_MAIN_STACK_SIZE=2048
CONFIG_FORCE_NO_ASSERT=y
CONFIG_TEST_HW_STACK_PROTECTION=n
CONFIG_MP_NUM_CPUS=1
CONFIG_DYNAMIC_INTERRUPTS=y
```

## prj_userspace.conf
```kconfig
CONFIG_TEST=y
CONFIG_EXECUTION_BENCHMARKING=y
CONFIG_TEST_RANDOM_GENERATOR=y
CONFIG_HEAP_MEM_POOL_SIZE=256
CONFIG_MAIN_STACK_SIZE=2048
CONFIG_FORCE_NO_ASSERT=y
CONFIG_APPLICATION_DEFINED_SYSCALL=y
CONFIG_TEST_USERSPACE=y
CONFIG_MP_NUM_CPUS=1
CONFIG_DYNAMIC_INTERRUPTS=y
```

## src/main_benchmark.c
```c
/*
 * Copyright (c) 2013-2015 Wind River Systems, Inc.
 * Copyright (c) 2016 Intel Corporation.
 *
 * SPDX-License-Identifier: Apache-2.0
 */

/**
 * @file
 * @brief Measure time
 *
 */
#include <kernel.h>
#include <zephyr.h>
#include <tc_util.h>
#include <ksched.h>
#include "timing_info.h"

void __weak calibrate_timer(void)
{
}

void main(void)
{
	uint32_t freq;

	calibrate_timer();

	freq = get_core_freq_MHz();

	/* Configure and start timer */
	benchmark_timer_init();
	benchmark_timer_start();

	TC_START("Time Measurement");
	TC_PRINT("Timing results: Clock frequency: %u MHz\n", freq);

	/*******************************************************************/
	/* System parameters and thread Benchmarking*/
	system_thread_bench();

	/*******************************************************************/
	/* Thread yield*/
	yield_bench();

	/*******************************************************************/
	/* heap Memory benchmarking*/
	heap_malloc_free_bench();

	/*******************************************************************/
	/* Semaphore take and get*/
	semaphore_bench();

	/*******************************************************************/
	/* mutex lock and unlock*/
	mutex_bench();

	/*******************************************************************/
	/* mutex lock and unlock*/
	msg_passing_bench();

	/*******************************************************************/
#ifdef CONFIG_USERSPACE
	/* userspace related benchmarks */
	userspace_bench();
#endif


	TC_PRINT("Time Measurement finished\n");

	/* for sanity regression test utility. */
	TC_END_RESULT(TC_PASS);
	TC_END_REPORT(TC_PASS);
	benchmark_timer_stop();
}
```

## src/msg_passing_bench.c
```c
/*
 * Copyright (c) 2013-2015 Wind River Systems, Inc.
 * Copyright (c) 2016 Intel Corporation.
 *
 * SPDX-License-Identifier: Apache-2.0
 */

#include <kernel.h>
#include <zephyr.h>
#include <tc_util.h>
#include <ksched.h>
#include "timing_info.h"

extern char sline[];

/* mailbox*/
/* K_MBOX_DEFINE(test_msg_queue) */
K_MSGQ_DEFINE(benchmark_q, sizeof(int), 10, 4);
K_MSGQ_DEFINE(benchmark_q_get, sizeof(int), 3, 4);
K_MBOX_DEFINE(benchmark_mbox);

/* Declare a semaphore for the msgq*/
K_SEM_DEFINE(mbox_sem, 1, 1);

/* common location for the swap to write the tsc data*/
extern uint32_t arch_timing_value_swap_end;
extern uint64_t arch_timing_value_swap_common;

/* location of the time stamps*/
uint64_t __msg_q_put_state;
uint64_t __msg_q_get_state;

uint64_t msg_q_put_w_cxt_start_time;
uint64_t msg_q_put_w_cxt_end_time;

uint64_t msg_q_put_wo_cxt_start_time;  /* without context switch */
uint64_t msg_q_put_wo_cxt_end_time;

uint64_t msg_q_get_w_cxt_start_time;
uint64_t msg_q_get_w_cxt_end_time;

uint64_t msg_q_get_wo_cxt_start_time;
uint64_t msg_q_get_wo_cxt_end_time;

uint32_t __mbox_sync_put_state;
uint64_t mbox_sync_put_start_time;
uint64_t mbox_sync_put_end_time;

uint32_t __mbox_sync_get_state;
uint64_t mbox_sync_get_start_time;
uint64_t mbox_sync_get_end_time;

uint64_t mbox_async_put_start_time;
uint64_t mbox_async_put_end_time;

uint64_t mbox_get_w_cxt_start_time;
uint64_t mbox_get_w_cxt_end_time;

/*For benchmarking msg queues*/
k_tid_t producer_w_cxt_switch_tid;
k_tid_t producer_wo_cxt_switch_tid;
k_tid_t producer_get_w_cxt_switch_tid;
k_tid_t consumer_get_w_cxt_switch_tid;
extern k_tid_t consumer_tid;
k_tid_t thread_mbox_sync_put_send_tid;
k_tid_t thread_mbox_sync_put_receive_tid;
k_tid_t thread_mbox_sync_get_send_tid;
k_tid_t thread_mbox_sync_get_receive_tid;
k_tid_t thread_mbox_async_put_send_tid;
k_tid_t thread_mbox_async_put_receive_tid;

/* To time thread creation*/
extern K_THREAD_STACK_DEFINE(my_stack_area, STACK_SIZE);
extern K_THREAD_STACK_DEFINE(my_stack_area_0, STACK_SIZE);
extern struct k_thread my_thread;
extern struct k_thread my_thread_0;

/* thread functions*/
void thread_producer_msgq_w_cxt_switch(void *p1, void *p2, void *p3);
void thread_producer_msgq_wo_cxt_switch(void *p1, void *p2, void *p3);

void thread_producer_get_msgq_w_cxt_switch(void *p1, void *p2, void *p3);
void thread_consumer_get_msgq_w_cxt_switch(void *p1, void *p2, void *p3);

void thread_mbox_sync_put_send(void *p1, void *p2, void *p3);
void thread_mbox_sync_put_receive(void *p1, void *p2, void *p3);

void thread_mbox_sync_get_send(void *p1, void *p2, void *p3);
void thread_mbox_sync_get_receive(void *p1, void *p2, void *p3);

void thread_mbox_async_put_send(void *p1, void *p2, void *p3);
void thread_mbox_async_put_receive(void *p1, void *p2, void *p3);

volatile uint64_t time_check;
int received_data_get;
int received_data_consumer;
int data_to_send;

#define MBOX_CHECK(status) { if (status != 0) { \
		if (status == -ENOMSG) {		      \
			TC_PRINT("Returned -ENOMSG\n");	      \
			return;				      \
		} else {         /* Status will be -EAGAIN */ \
			TC_PRINT("Returned -EAGAIN\n");	      \
			return;				      \
		}					      \
	}						      \
}					      \

void msg_passing_bench(void)
{
	uint32_t total_cycles;

	/*******************************************************************/
	/* Msg queue for put*/
	int received_data = 0;

	producer_w_cxt_switch_tid =
		k_thread_create(&my_thread, my_stack_area, STACK_SIZE,
				thread_producer_msgq_w_cxt_switch, NULL,
				NULL, NULL, 2 /*priority*/, 0, K_MSEC(50));

	uint32_t msg_status =  k_msgq_get(&benchmark_q, &received_data,
				       K_MSEC(300));

	producer_wo_cxt_switch_tid =
		k_thread_create(&my_thread_0, my_stack_area_0, STACK_SIZE,
				thread_producer_msgq_wo_cxt_switch,
				NULL, NULL, NULL, -2 /*priority*/, 0,
				K_NO_WAIT);

	k_thread_abort(producer_w_cxt_switch_tid);
	k_thread_abort(producer_wo_cxt_switch_tid);
	msg_q_put_w_cxt_end_time = (uint32_t)arch_timing_value_swap_common;
	ARG_UNUSED(msg_status);

	/*******************************************************************/

	/* Msg queue for get*/

	producer_get_w_cxt_switch_tid =
		k_thread_create(&my_thread, my_stack_area,
				STACK_SIZE,
				thread_producer_get_msgq_w_cxt_switch, NULL,
				NULL, NULL, 1 /*priority*/, 0, K_MSEC(50));
	consumer_get_w_cxt_switch_tid =
		k_thread_create(&my_thread_0, my_stack_area_0,
				STACK_SIZE,
				thread_consumer_get_msgq_w_cxt_switch,
				NULL, NULL, NULL,
				2 /*priority*/, 0, K_MSEC(50));
	k_sleep(K_MSEC(2000));  /* make the main thread sleep */
	k_thread_abort(producer_get_w_cxt_switch_tid);
	msg_q_get_w_cxt_end_time = (arch_timing_value_swap_common);

	/*******************************************************************/

	/* Msg queue for get*/
	/* from previous step got the msg_q full now just do a simple read*/
	TIMING_INFO_PRE_READ();
	msg_q_get_wo_cxt_start_time = TIMING_INFO_OS_GET_TIME();

	received_data_get =  k_msgq_get(&benchmark_q_get,
					&received_data_consumer,
					K_NO_WAIT);

	TIMING_INFO_PRE_READ();
	msg_q_get_wo_cxt_end_time = TIMING_INFO_OS_GET_TIME();


	/*******************************************************************/

	/* Msg box to benchmark sync put */

	thread_mbox_sync_put_send_tid  =
		k_thread_create(&my_thread, my_stack_area,
				STACK_SIZE,
				thread_mbox_sync_put_send,
				NULL, NULL, NULL,
				2 /*priority*/, 0, K_NO_WAIT);
	thread_mbox_sync_put_receive_tid =
		k_thread_create(&my_thread_0, my_stack_area_0,
				STACK_SIZE,
				thread_mbox_sync_put_receive,
				NULL, NULL, NULL,
				1 /*priority*/, 0, K_NO_WAIT);
	k_sleep(K_MSEC(1000));  /* make the main thread sleep */
	mbox_sync_put_end_time = (arch_timing_value_swap_common);

	/*******************************************************************/

	/* Msg box to benchmark sync get */

	thread_mbox_sync_get_send_tid  =
		k_thread_create(&my_thread, my_stack_area,
				STACK_SIZE,
				thread_mbox_sync_get_send,
				NULL, NULL, NULL,
				1 /*prio*/, 0, K_NO_WAIT);
	thread_mbox_sync_get_receive_tid =
		k_thread_create(&my_thread_0, my_stack_area_0,
				STACK_SIZE,
				thread_mbox_sync_get_receive, NULL,
				NULL, NULL, 2 /*priority*/, 0, K_NO_WAIT);
	k_sleep(K_MSEC(1000)); /* make the main thread sleep */
	mbox_sync_get_end_time = (arch_timing_value_swap_common);

	/*******************************************************************/

	/* Msg box to benchmark async put */

	thread_mbox_async_put_send_tid  =
		k_thread_create(&my_thread, my_stack_area,
				STACK_SIZE,
				thread_mbox_async_put_send,
				NULL, NULL, NULL,
				2 /*prio*/, 0, K_NO_WAIT);
	thread_mbox_async_put_receive_tid =
		k_thread_create(&my_thread_0, my_stack_area_0,
				STACK_SIZE,
				thread_mbox_async_put_receive,
				NULL, NULL, NULL,
				3 /*priority*/, 0, K_NO_WAIT);
	k_sleep(K_MSEC(1000)); /* make the main thread sleep */

	/*******************************************************************/
	int single_element_buffer = 0, status;
	struct k_mbox_msg rx_msg = {
		.size = sizeof(int),
		.rx_source_thread = K_ANY,
		.tx_target_thread = K_ANY
	};
	TIMING_INFO_PRE_READ();
	mbox_get_w_cxt_start_time = TIMING_INFO_OS_GET_TIME();

	status = k_mbox_get(&benchmark_mbox, &rx_msg, &single_element_buffer,
			    K_MSEC(300));
	MBOX_CHECK(status);

	TIMING_INFO_PRE_READ();
	mbox_get_w_cxt_end_time = TIMING_INFO_OS_GET_TIME();

	/*******************************************************************/

	/* Only print lower 32bit of time result */
	total_cycles = CALCULATE_CYCLES(msg_q, put_w_cxt);
	PRINT_STATS("Message queue put with context switch", total_cycles);

	total_cycles = CALCULATE_CYCLES(msg_q, put_wo_cxt);
	PRINT_STATS("Message queue put without context switch", total_cycles);

	total_cycles = CALCULATE_CYCLES(msg_q, get_w_cxt);
	PRINT_STATS("Message queue get with context switch", total_cycles);

	total_cycles = CALCULATE_CYCLES(msg_q, get_wo_cxt);
	PRINT_STATS("Message queue get without context switch", total_cycles);

	total_cycles = CALCULATE_CYCLES(mbox, sync_put);
	PRINT_STATS("Mailbox synchronous put", total_cycles);

	total_cycles = CALCULATE_CYCLES(mbox, sync_get);
	PRINT_STATS("Mailbox synchronous get", total_cycles);

	total_cycles = CALCULATE_CYCLES(mbox, async_put);
	PRINT_STATS("Mailbox asynchronous put", total_cycles);

	total_cycles = CALCULATE_CYCLES(mbox, get_w_cxt);
	PRINT_STATS("Mailbox get without context switch", total_cycles);
}

void thread_producer_msgq_w_cxt_switch(void *p1, void *p2, void *p3)
{
	int data_to_send = 5050;

	arch_timing_value_swap_end = 1U;
	TIMING_INFO_PRE_READ();
	msg_q_put_w_cxt_start_time = (uint32_t)TIMING_INFO_OS_GET_TIME();
	k_msgq_put(&benchmark_q, &data_to_send, K_NO_WAIT);
}


void thread_producer_msgq_wo_cxt_switch(void *p1, void *p2, void *p3)
{
	int data_to_send = 5050;

	TIMING_INFO_PRE_READ();
	msg_q_put_wo_cxt_start_time = TIMING_INFO_OS_GET_TIME();

	k_msgq_put(&benchmark_q, &data_to_send, K_NO_WAIT);

	TIMING_INFO_PRE_READ();
	msg_q_put_wo_cxt_end_time = TIMING_INFO_OS_GET_TIME();
}


void thread_producer_get_msgq_w_cxt_switch(void *p1, void *p2, void *p3)
{
	int status = 0;

	while (1) {
		if (status == 0) {
			data_to_send++;
		}
		status = k_msgq_put(&benchmark_q_get, &data_to_send,
				    K_MSEC(20));
	}
}

void thread_consumer_get_msgq_w_cxt_switch(void *p1, void *p2, void *p3)
{
	producer_get_w_cxt_switch_tid->base.timeout.dticks = _EXPIRED;
	arch_timing_value_swap_end = 1U;
	TIMING_INFO_PRE_READ();
	msg_q_get_w_cxt_start_time = TIMING_INFO_OS_GET_TIME();
	received_data_get =  k_msgq_get(&benchmark_q_get,
					&received_data_consumer,
					K_MSEC(300));
	TIMING_INFO_PRE_READ();
	time_check = TIMING_INFO_OS_GET_TIME();
}


void thread_mbox_sync_put_send(void *p1, void *p2, void *p3)
{
	int single_element_buffer = 1234, status;
	struct k_mbox_msg tx_msg = {
		.size = sizeof(int),
		.info = 5050,
		.tx_data = &single_element_buffer,
		.rx_source_thread = K_ANY,
		.tx_target_thread = K_ANY,
	};

	TIMING_INFO_PRE_READ();
	mbox_sync_put_start_time = TIMING_INFO_OS_GET_TIME();
	arch_timing_value_swap_end = 1U;

	status = k_mbox_put(&benchmark_mbox, &tx_msg, K_MSEC(300));
	MBOX_CHECK(status);

	TIMING_INFO_PRE_READ();
	time_check = TIMING_INFO_OS_GET_TIME();
}

void thread_mbox_sync_put_receive(void *p1, void *p2, void *p3)
{
	int single_element_buffer = 1234, status;
	struct k_mbox_msg rx_msg = {
		.size = sizeof(int),
		.rx_source_thread = K_ANY,
		.tx_target_thread = K_ANY
	};

	status = k_mbox_get(&benchmark_mbox, &rx_msg, &single_element_buffer,
			    K_MSEC(300));
	MBOX_CHECK(status);
}

void thread_mbox_sync_get_send(void *p1, void *p2, void *p3)
{
	int single_element_buffer = 1234, status;
	struct k_mbox_msg tx_msg = {
		.size = sizeof(int),
		.info = 5050,
		.tx_data = &single_element_buffer,
		.rx_source_thread = K_ANY,
		.tx_target_thread = K_ANY,
	};

	status = k_mbox_put(&benchmark_mbox, &tx_msg, K_MSEC(300));
	MBOX_CHECK(status);
}

void thread_mbox_sync_get_receive(void *p1, void *p2, void *p3)
{
	int single_element_buffer, status;
	struct k_mbox_msg rx_msg = {
		.size = sizeof(int),
		.rx_source_thread = K_ANY,
		.tx_target_thread = K_ANY
	};

	arch_timing_value_swap_end = 1U;
	TIMING_INFO_PRE_READ();
	mbox_sync_get_start_time = TIMING_INFO_OS_GET_TIME();

	status = k_mbox_get(&benchmark_mbox, &rx_msg, &single_element_buffer,
			    K_MSEC(300));
	MBOX_CHECK(status);
}

void thread_mbox_async_put_send(void *p1, void *p2, void *p3)
{
	int single_element_buffer = 1234;
	struct k_mbox_msg tx_msg = {
		.size = sizeof(int),
		.info = 5050,
		.tx_data = &single_element_buffer,
		.rx_source_thread = K_ANY,
		.tx_target_thread = K_ANY,
	};

	TIMING_INFO_PRE_READ();
	mbox_async_put_start_time = TIMING_INFO_OS_GET_TIME();
	k_mbox_async_put(&benchmark_mbox, &tx_msg, &mbox_sem);
	TIMING_INFO_PRE_READ();
	mbox_async_put_end_time = TIMING_INFO_OS_GET_TIME();
	k_mbox_async_put(&benchmark_mbox, &tx_msg, &mbox_sem);
}

void thread_mbox_async_put_receive(void *p1, void *p2, void *p3)
{
	int single_element_buffer, status;
	struct k_mbox_msg rx_msg = {
		.size = sizeof(int),
		.rx_source_thread = K_ANY,
		.tx_target_thread = K_ANY
	};

	status = k_mbox_get(&benchmark_mbox, &rx_msg, &single_element_buffer,
			    K_MSEC(300));
	MBOX_CHECK(status);
}
```

## src/semaphore_bench.c
```c
/*
 * Copyright (c) 2017 Intel Corporation.
 *
 * SPDX-License-Identifier: Apache-2.0
 */

#include <kernel.h>
#include <zephyr.h>
#include <tc_util.h>
#include <ksched.h>
#include "timing_info.h"


extern char sline[];

K_SEM_DEFINE(sem_bench, 0, 1);
K_SEM_DEFINE(sem_bench_1, 0, 1);

/* To time thread creation*/
extern K_THREAD_STACK_DEFINE(my_stack_area, STACK_SIZE);
extern K_THREAD_STACK_DEFINE(my_stack_area_0, STACK_SIZE);
extern struct k_thread my_thread;
extern struct k_thread my_thread_0;

/* uint64_t thread_yield_start_time[1000]; */
/* uint64_t thread_yield_end_time[1000]; */
extern uint64_t thread_start_time;
extern uint64_t thread_end_time;
uint64_t sem_take_start_time;
uint64_t sem_take_end_time;
uint64_t sem_give_start_time;
uint64_t sem_give_end_time;

uint32_t swap_called;
uint64_t test_time2;
uint64_t test_time1;

void thread_sem0_test(void *p1, void *p2, void *p3);
void thread_sem1_test(void *p1, void *p2, void *p3);
void thread_sem0_give_test(void *p1, void *p2, void *p3);
void thread_sem1_give_test(void *p1, void *p2, void *p3);

k_tid_t sem0_tid;
k_tid_t sem1_tid;

extern uint64_t arch_timing_value_swap_common;
extern uint32_t arch_timing_value_swap_end;

void semaphore_bench(void)
{
	uint32_t total_cycles;

	/* Thread yield */

	sem0_tid = k_thread_create(&my_thread, my_stack_area,
				   STACK_SIZE, thread_sem0_test,
				   NULL, NULL, NULL,
				   2 /*priority*/, 0, K_NO_WAIT);
	sem1_tid = k_thread_create(&my_thread_0, my_stack_area_0,
				   STACK_SIZE, thread_sem1_test,
				   NULL, NULL, NULL,
				   2 /*priority*/, 0, K_NO_WAIT);

	k_sleep(K_MSEC(1000));

	sem_take_end_time = (arch_timing_value_swap_common);

	sem0_tid = k_thread_create(&my_thread, my_stack_area,
				   STACK_SIZE, thread_sem0_give_test,
				   NULL, NULL, NULL,
				   2 /*priority*/, 0, K_NO_WAIT);
	sem1_tid = k_thread_create(&my_thread_0, my_stack_area_0,
				   STACK_SIZE, thread_sem1_give_test,
				   NULL, NULL, NULL,
				   2 /*priority*/, 0, K_NO_WAIT);

	k_sleep(K_MSEC(1000));

	sem_give_end_time = (arch_timing_value_swap_common);

	/* Semaphore without context switch */
	TIMING_INFO_PRE_READ();
	uint32_t sem_give_wo_cxt_start_time = TIMING_INFO_OS_GET_TIME();

	k_sem_give(&sem_bench);

	TIMING_INFO_PRE_READ();
	uint32_t sem_give_wo_cxt_end_time = TIMING_INFO_OS_GET_TIME();

	TIMING_INFO_PRE_READ();
	uint32_t sem_take_wo_cxt_start_time = TIMING_INFO_OS_GET_TIME();

	k_sem_take(&sem_bench, K_MSEC(10));

	TIMING_INFO_PRE_READ();
	uint32_t sem_take_wo_cxt_end_time = TIMING_INFO_OS_GET_TIME();

	total_cycles = CALCULATE_CYCLES(sem, take);
	PRINT_STATS("Semaphore take with context switch", total_cycles);

	total_cycles = CALCULATE_CYCLES(sem, give);
	PRINT_STATS("Semaphore give with context switch", total_cycles);

	total_cycles = CALCULATE_CYCLES(sem, take_wo_cxt);
	PRINT_STATS("Semaphore take without context switch", total_cycles);

	total_cycles = CALCULATE_CYCLES(sem, give_wo_cxt);
	PRINT_STATS("Semaphore give without context switch", total_cycles);
}

/******************************************************************************/
K_MUTEX_DEFINE(mutex0);
void mutex_bench(void)
{
	uint32_t total_cycles;

	uint64_t mutex_lock_start_time;
	uint64_t mutex_lock_end_time;
	uint64_t mutex_lock_diff = 0U;

	uint64_t mutex_unlock_start_time;
	uint64_t mutex_unlock_end_time;
	uint64_t mutex_unlock_diff = 0U;
	uint32_t count = 0U;

	for (int i = 0; i < 1000; i++) {
		int64_t before = k_uptime_get();

		TIMING_INFO_PRE_READ();
		mutex_lock_start_time = TIMING_INFO_OS_GET_TIME();

		k_mutex_lock(&mutex0, K_MSEC(100));

		TIMING_INFO_PRE_READ();
		mutex_lock_end_time = TIMING_INFO_OS_GET_TIME();

		TIMING_INFO_PRE_READ();
		mutex_unlock_start_time = TIMING_INFO_OS_GET_TIME();

		k_mutex_unlock(&mutex0);

		TIMING_INFO_PRE_READ();
		mutex_unlock_end_time = TIMING_INFO_OS_GET_TIME();

		/* If timer interrupt occurs we need to omit that sample*/
		int64_t after = k_uptime_get();

		if (after - before) {
			continue;
		}

		count++;

		mutex_lock_diff += CALCULATE_CYCLES(mutex, lock);
		mutex_unlock_diff += CALCULATE_CYCLES(mutex, unlock);
	}

	total_cycles = mutex_lock_diff / count;
	PRINT_STATS("Mutex lock", total_cycles);

	total_cycles = mutex_unlock_diff / count;
	PRINT_STATS("Mutex unlock", total_cycles);
}

/******************************************************************************/
void thread_sem1_test(void *p1, void *p2, void *p3)
{

	k_sem_give(&sem_bench); /* sync the 2 threads*/

	arch_timing_value_swap_end = 1U;
	TIMING_INFO_PRE_READ();
	sem_take_start_time =  TIMING_INFO_OS_GET_TIME();
	k_sem_take(&sem_bench, K_MSEC(10));
}

uint32_t sem_count;
void thread_sem0_test(void *p1, void *p2, void *p3)
{
	k_sem_take(&sem_bench, K_MSEC(10));/* To sync threads */

	k_sem_give(&sem_bench);
	sem_count++;
	k_thread_abort(sem0_tid);
}
/******************************************************************************/
void thread_sem1_give_test(void *p1, void *p2, void *p3)
{
	k_sem_give(&sem_bench);         /* sync the 2 threads*/

	k_sem_take(&sem_bench_1, K_MSEC(1000)); /* clear the previous sem_give*/
}

void thread_sem0_give_test(void *p1, void *p2, void *p3)
{
	k_sem_take(&sem_bench, K_MSEC(10));/* To sync threads */

	/* To make sure that the sem give will cause a swap to occur */
	k_thread_priority_set(sem1_tid, 1);

	arch_timing_value_swap_end = 1U;
	TIMING_INFO_PRE_READ();
	sem_give_start_time =  TIMING_INFO_OS_GET_TIME();
	k_sem_give(&sem_bench_1);

}
```

## src/thread_bench.c
```c
/*
 * Copyright (c) 2013-2015 Wind River Systems, Inc.
 * Copyright (c) 2016 Intel Corporation.
 *
 * SPDX-License-Identifier: Apache-2.0
 */

/**
 * @file
 * @brief Measure time
 *
 */
#include <kernel.h>
#include <zephyr.h>
#include <tc_util.h>
#include <ksched.h>
#include "timing_info.h"
char sline[256];
/* FILE *output_file = stdout; */

/* location of the time stamps*/
extern uint32_t arch_timing_value_swap_end;
extern uint64_t arch_timing_value_swap_temp;
extern uint64_t arch_timing_value_swap_common;

volatile uint64_t thread_abort_current_end_time;
volatile uint64_t thread_abort_current_start_time;

/* Thread suspend*/
volatile uint64_t thread_suspend_start_time;
volatile uint64_t thread_suspend_end_time;

/* Thread resume*/
volatile uint64_t thread_resume_start_time;
volatile uint64_t thread_resume_end_time;

/* Thread sleep*/
volatile uint64_t thread_sleep_start_time;
volatile uint64_t thread_sleep_end_time;

/*For benchmarking msg queues*/
k_tid_t producer_tid;
k_tid_t consumer_tid;

/* To time thread creation*/
K_THREAD_STACK_DEFINE(my_stack_area, STACK_SIZE);
K_THREAD_STACK_DEFINE(my_stack_area_0, STACK_SIZE);
struct k_thread my_thread;
struct k_thread my_thread_0;

uint32_t arch_timing_value_swap_end_test = 1U;
uint64_t dummy_time;
uint64_t start_time;
uint64_t test_end_time;

/* Disable the overhead calculations, this is needed to calculate
 * the overhead created by the benchmarking code itself.
 */
#define DISABLE_OVERHEAD_MEASUREMENT

#if defined(CONFIG_X86) && !defined(DISABLE_OVERHEAD_MEASUREMENT)
uint32_t benchmarking_overhead_swap(void)
{

	__asm__ __volatile__ (
		"pushl %eax\n\t"
		"pushl %edx\n\t"
		"rdtsc\n\t"
		"mov %eax,start_time\n\t"
		"mov %edx,start_time+4\n\t"
		"cmp $0x1,arch_timing_value_swap_end_test\n\t"
		"jne time_read_not_needed_test\n\t"
		"movw $0x2,arch_timing_value_swap_end\n\t"
		"pushl %eax\n\t"
		"pushl %edx\n\t"
		"rdtsc\n\t"
		"mov %eax,dummy_time\n\t"
		"mov %edx,dummy_time+4\n\t"
		"pop %edx\n\t"
		"pop %eax\n\t"
		"time_read_not_needed_test:\n\t"
		"rdtsc\n\t"
		"mov %eax,test_end_time\n\t"
		"mov %edx,test_end_time+4\n\t"
		"pop %edx\n\t"
		"pop %eax\n\t");

	return(test_end_time - start_time);
}
#endif


#if defined(CONFIG_CPU_CORTEX_M) && defined(CONFIG_DYNAMIC_INTERRUPTS)
static void dyn_isr_handler(void *args)
{
	ARG_UNUSED(args);
}

int install_dynamic_interrupt_and_get_line(void)
{
	int i;

	for (i = CONFIG_NUM_IRQS - 1; i >= 0; i--) {
		if (NVIC_GetEnableIRQ(i) == 0) {
			/*
			 * Interrupts configured statically with IRQ_CONNECT(.)
			 * are automatically enabled. NVIC_GetEnableIRQ()
			 * returning false, here, implies that the IRQ line is
			 * either not implemented or it is not enabled, thus,
			 * currently not in use by Zephyr.
			 */

			/* Set the NVIC line to pending. */
			NVIC_SetPendingIRQ(i);

			if (NVIC_GetPendingIRQ(i)) {
				/* If the NVIC line is pending, it is
				 * guaranteed that it is implemented; clear the
				 * line.
				 */
				NVIC_ClearPendingIRQ(i);

				if (!NVIC_GetPendingIRQ(i)) {
					/*
					 * If the NVIC line can be successfully
					 * un-pended, it is guaranteed that it
					 * can be used for software interrupt
					 * triggering.
					 */
					break;
				}
			}
		}
	}

	if (i >= 0) {
		/* Install the interrupt */
		NVIC_DisableIRQ(i);
		arch_irq_connect_dynamic(i, 0 /* highest priority */,
			dyn_isr_handler,
			NULL,
			0);
		NVIC_EnableIRQ(i);
	}

	return i;
}
#endif

void test_thread_entry(void *p, void *p1, void *p2)
{
	static int i;

	i++;
}


void thread_swap_test(void *p1, void *p2, void *p3)
{
	arch_timing_value_swap_end = 1U;
	TIMING_INFO_PRE_READ();
	thread_abort_current_start_time = TIMING_INFO_OS_GET_TIME();
	k_thread_abort(_current);
}

void thread_suspend_test(void *p1, void *p2, void *p3);
void yield_bench(void);
void heap_malloc_free_bench(void);
void main_sem_bench(void);
void main_mutex_bench(void);
void main_msg_bench(void);

void system_thread_bench(void)
{
	uint32_t total_cycles;

	/*Thread create*/
	uint64_t thread_create_start_time;
	uint64_t thread_create_end_time;

	/*Thread cancel*/
	uint64_t thread_abort_nonrun_start_time;
	uint64_t thread_abort_nonrun_end_time;

	/* to measure context switch time */
	k_thread_create(&my_thread_0, my_stack_area_0, STACK_SIZE,
			thread_swap_test,
			NULL, NULL, NULL,
			-1 /*priority*/, 0, K_NO_WAIT);

	k_sleep(K_MSEC(1));
	thread_abort_current_end_time = (arch_timing_value_swap_common);
	arch_timing_swap_end = arch_timing_value_swap_common;
#if defined(CONFIG_X86)
	arch_timing_swap_start = arch_timing_value_swap_temp;
	/* In the rest of ARCHes read_timer_start_of_swap() has already
	 * registered the time-stamp of the start of context-switch in
	 * arch_timing_swap_start.
	 */
#endif
	uint32_t total_swap_cycles =
		arch_timing_swap_end -
		arch_timing_swap_start;

	/* Interrupt latency*/
#if defined(CONFIG_CORTEX_M_SYSTICK) && defined(CONFIG_DYNAMIC_INTERRUPTS)
	int irq_line = install_dynamic_interrupt_and_get_line();

	if (irq_line >= 0) {
		NVIC_SetPendingIRQ(irq_line);
		__DSB();
		__ISB();
	} else {
		TC_PRINT("No available IRQ line for ISR latency measuring\n");
	}
#endif
	uint64_t local_end_intr_time = arch_timing_irq_end;
	uint64_t local_start_intr_time = arch_timing_irq_start;

	/*******************************************************************/

	/* thread create */
	TIMING_INFO_PRE_READ();
	thread_create_start_time = TIMING_INFO_OS_GET_TIME();

	k_tid_t my_tid = k_thread_create(&my_thread, my_stack_area,
					 STACK_SIZE,
					 thread_swap_test,
					 NULL, NULL, NULL,
					 5 /*priority*/, 0, K_FOREVER);
	TIMING_INFO_PRE_READ();
	thread_create_end_time = TIMING_INFO_OS_GET_TIME();

	/* aborting a non-running thread */
	TIMING_INFO_PRE_READ();
	thread_abort_nonrun_start_time = TIMING_INFO_OS_GET_TIME();
	k_thread_abort(my_tid);

	TIMING_INFO_PRE_READ();
	thread_abort_nonrun_end_time = TIMING_INFO_OS_GET_TIME();

	/* Thread suspend */
	k_tid_t sus_res_tid = k_thread_create(&my_thread, my_stack_area,
					      STACK_SIZE,
					      thread_suspend_test,
					      NULL, NULL, NULL,
					      -1 /*priority*/, 0, K_NO_WAIT);

	TIMING_INFO_PRE_READ();
	thread_suspend_end_time = TIMING_INFO_OS_GET_TIME();
	/* At this point test for resume*/
	k_thread_resume(sus_res_tid);

	/* calculation for resume */
	thread_resume_start_time = thread_suspend_end_time;

	/*******************************************************************/

	/* Only print lower 32bit of time result */
	PRINT_STATS("Context switch", total_swap_cycles);

	/* Interrupt latency */
	uint32_t intr_latency_cycles = SUBTRACT_CLOCK_CYCLES(local_end_intr_time) -
		SUBTRACT_CLOCK_CYCLES(local_start_intr_time);

	PRINT_STATS("Interrupt latency", intr_latency_cycles);

	/* tick overhead */
	total_cycles =
		SUBTRACT_CLOCK_CYCLES(arch_timing_tick_end) -
		SUBTRACT_CLOCK_CYCLES(arch_timing_tick_start);

	PRINT_STATS("Tick overhead", total_cycles);

	/* thread creation */
	total_cycles = CALCULATE_CYCLES(thread, create);
	PRINT_STATS("Thread creation", total_cycles);

	/* thread cancel */
	total_cycles = CALCULATE_CYCLES(thread, abort_nonrun);
	PRINT_STATS("Thread abort (non-running)", total_cycles);

	/* thread abort */
	total_cycles = CALCULATE_CYCLES(thread, abort_current);
	PRINT_STATS("Thread abort (_current)", total_cycles);

	/* thread suspend */
	total_cycles = CALCULATE_CYCLES(thread, suspend);
	PRINT_STATS("Thread suspend", total_cycles);

	/* thread resume */
	total_cycles = CALCULATE_CYCLES(thread, resume);
	PRINT_STATS("Thread resume", total_cycles);
}

void thread_suspend_test(void *p1, void *p2, void *p3)
{
	TIMING_INFO_PRE_READ();
	thread_suspend_start_time = TIMING_INFO_OS_GET_TIME();
	k_thread_suspend(_current);

	/* comes to this line once its resumed*/
	TIMING_INFO_PRE_READ();
	thread_resume_end_time = TIMING_INFO_OS_GET_TIME();
}

void heap_malloc_free_bench(void)
{
	uint32_t total_cycles;

	/* heap malloc*/
	uint64_t heap_malloc_start_time = 0U;
	uint64_t heap_malloc_end_time = 0U;

	/* heap free*/
	uint64_t heap_free_start_time = 0U;
	uint64_t heap_free_end_time = 0U;

	uint32_t count = 0;
	uint32_t sum_malloc = 0U;
	uint32_t sum_free = 0U;

	k_sleep(K_MSEC(10));
	while (count++ != 100) {
		TIMING_INFO_PRE_READ();
		heap_malloc_start_time = TIMING_INFO_OS_GET_TIME();
		void *allocated_mem = k_malloc(10);

		TIMING_INFO_PRE_READ();
		heap_malloc_end_time = TIMING_INFO_OS_GET_TIME();
		if (allocated_mem == NULL) {
			TC_PRINT("\n Malloc failed at count %d\n", count);
			break;
		}
		TIMING_INFO_PRE_READ();
		heap_free_start_time = TIMING_INFO_OS_GET_TIME();

		k_free(allocated_mem);

		TIMING_INFO_PRE_READ();
		heap_free_end_time = TIMING_INFO_OS_GET_TIME();
		sum_malloc += CALCULATE_CYCLES(heap, malloc);
		sum_free += CALCULATE_CYCLES(heap, free);
	}

	total_cycles = sum_malloc / count;
	PRINT_STATS("Heap malloc", total_cycles);

	total_cycles = sum_free / count;
	PRINT_STATS("Heap free", total_cycles);
}
```

## src/timing_info.h
```c
/*
 * Copyright (c) 2017 Intel Corporation.
 *
 * SPDX-License-Identifier: Apache-2.0
 */
#include <timestamp.h>
#include <kernel_internal.h>

#define CALCULATE_CYCLES(profile, name)					\
	((profile##_##name##_end_time) -				\
	 (profile##_##name##_start_time))

/* Stack size for all the threads created in this benchmark */
#define STACK_SIZE (512 + CONFIG_TEST_EXTRA_STACKSIZE)

/******************************************************************************/
/*
 * Note on: SUBTRACT_CLOCK_CYCLES
 * If we are using x86 based controller we tend to read the tsc value which is
 * always incrementing i.e count up counter.
 * If we are using the ARM based controllers the systick is a
 * count down counter.
 * If we are using nrf SOC, we are using external timer which always increments
 * ie count up counter.
 * Hence to calculate the cycles taken up by the code we need to adjust the
 * values accordingly.
 *
 * NOTE: Needed only when reading value from end of swap operation
 */
#if defined(CONFIG_NRF_RTC_TIMER)

/* To get current count of timer, first 1 need to be written into
 * Capture Register and Current Count will be copied into corresponding
 * current count register.
 */
#define TIMING_INFO_PRE_READ()        (NRF_TIMER2->TASKS_CAPTURE[0] = 1)
#define TIMING_INFO_OS_GET_TIME()     (NRF_TIMER2->CC[0])
#define TIMING_INFO_GET_TIMER_VALUE() (TIMING_INFO_OS_GET_TIME())
#define SUBTRACT_CLOCK_CYCLES(val)    (val)

#elif defined(CONFIG_SOC_SERIES_MEC1501X)
#define TIMING_INFO_PRE_READ()
#define TIMING_INFO_OS_GET_TIME()     (B32TMR1_REGS->CNT)
#define TIMING_INFO_GET_TIMER_VALUE() (TIMING_INFO_OS_GET_TIME())
#define SUBTRACT_CLOCK_CYCLES(val)    (val)

#elif defined(CONFIG_X86)
#define TIMING_INFO_PRE_READ()
#define TIMING_INFO_OS_GET_TIME()      (z_tsc_read())
#define TIMING_INFO_GET_TIMER_VALUE()  (TIMING_INFO_OS_GET_TIME())
#define SUBTRACT_CLOCK_CYCLES(val)     (val)

#elif defined(CONFIG_CPU_CORTEX_M)
#define TIMING_INFO_PRE_READ()
#define TIMING_INFO_OS_GET_TIME()      (k_cycle_get_32())
#define TIMING_INFO_GET_TIMER_VALUE()  (SysTick->VAL)
#define SUBTRACT_CLOCK_CYCLES(val)     (SysTick->LOAD - (uint32_t)val)

#elif defined(CONFIG_ARC)
#define TIMING_INFO_PRE_READ()
#define TIMING_INFO_OS_GET_TIME()     (k_cycle_get_32())
#define TIMING_INFO_GET_TIMER_VALUE() (z_arc_v2_aux_reg_read(_ARC_V2_TMR0_COUNT))
#define SUBTRACT_CLOCK_CYCLES(val)    ((uint32_t)val)

#elif defined(CONFIG_NIOS2)
#include "altera_avalon_timer_regs.h"
#define TIMING_INFO_PRE_READ()         \
	(IOWR_ALTERA_AVALON_TIMER_SNAPL(TIMER_0_BASE, 10))

#define TIMING_INFO_OS_GET_TIME()      (SUBTRACT_CLOCK_CYCLES(\
	((uint32_t)IORD_ALTERA_AVALON_TIMER_SNAPH(TIMER_0_BASE) << 16)\
	| ((uint32_t)IORD_ALTERA_AVALON_TIMER_SNAPL(TIMER_0_BASE))))

#define TIMING_INFO_GET_TIMER_VALUE()  (\
	((uint32_t)IORD_ALTERA_AVALON_TIMER_SNAPH(TIMER_0_BASE) << 16)\
	| ((uint32_t)IORD_ALTERA_AVALON_TIMER_SNAPL(TIMER_0_BASE)))

#define SUBTRACT_CLOCK_CYCLES(val)     \
	((IORD_ALTERA_AVALON_TIMER_PERIODH(TIMER_0_BASE)	\
	  << 16 |						\
	  (IORD_ALTERA_AVALON_TIMER_PERIODL(TIMER_0_BASE)))	\
	 - ((uint32_t)val))

#else
#define TIMING_INFO_PRE_READ()
#define TIMING_INFO_OS_GET_TIME()      (k_cycle_get_32())
#define TIMING_INFO_GET_TIMER_VALUE()  (k_cycle_get_32())
#define SUBTRACT_CLOCK_CYCLES(val)     ((uint32_t)val)
#endif

/******************************************************************************/
/* NRF RTC TIMER runs ar very slow rate (32KHz), So in order to measure
 * Kernel starts a dedicated timer to measure kernel stats.
 */
#if defined(CONFIG_NRF_RTC_TIMER)
#define NANOSECS_PER_SEC (1000000000)
#define CYCLES_PER_SEC   (16000000/(1 << NRF_TIMER2->PRESCALER))

#define CYCLES_TO_NS(x)        ((x) * (NANOSECS_PER_SEC/CYCLES_PER_SEC))
#define PRINT_STATS(x, y) \
	PRINT_F(x, (y * ((SystemCoreClock) / CYCLES_PER_SEC)), \
		CYCLES_TO_NS(y))

/* Configure Timer parameters */
static inline void benchmark_timer_init(void)
{
	NRF_TIMER2->TASKS_CLEAR = 1;	/* Clear Timer */
	NRF_TIMER2->MODE = 0;		/* Timer Mode */
	NRF_TIMER2->PRESCALER = 0;	/* 16M Hz */
	NRF_TIMER2->BITMODE = 3;	/* 32 - bit */
}

/* Stop the timer */
static inline void benchmark_timer_stop(void)
{
	NRF_TIMER2->TASKS_STOP = 1;	/* Stop Timer */
}

/*Start the timer */
static inline void benchmark_timer_start(void)
{
	NRF_TIMER2->TASKS_START = 1;	/* Start Timer */
}

/* Get Core Frequency in MHz */
static inline uint32_t get_core_freq_MHz(void)
{
	return SystemCoreClock/1000000;
}

#elif defined(CONFIG_SOC_SERIES_MEC1501X)

#define NANOSECS_PER_SEC	(1000000000)
#define CYCLES_PER_SEC		(48000000)
#define CYCLES_TO_NS(x)		((x) * (NANOSECS_PER_SEC/CYCLES_PER_SEC))
#define PRINT_STATS(x, y)	PRINT_F(x, y, CYCLES_TO_NS(y))

/* Configure Timer parameters */
static inline void benchmark_timer_init(void)
{
	/* Setup counter */
	B32TMR1_REGS->CTRL =
		MCHP_BTMR_CTRL_ENABLE |
		MCHP_BTMR_CTRL_AUTO_RESTART |
		MCHP_BTMR_CTRL_COUNT_UP;

	B32TMR1_REGS->PRLD = 0;		/* Preload */
	B32TMR1_REGS->CNT = 0;		/* Counter value */

	B32TMR1_REGS->IEN = 0;		/* Disable interrupt */
	B32TMR1_REGS->STS = 1;		/* Clear interrupt */
}

/* Stop the timer */
static inline void benchmark_timer_stop(void)
{
	B32TMR1_REGS->CTRL &= ~MCHP_BTMR_CTRL_START;
}

/* Start the timer */
static inline void benchmark_timer_start(void)
{
	B32TMR1_REGS->CTRL |= MCHP_BTMR_CTRL_START;
}

/* 48MHz counter frequency */
static inline uint32_t get_core_freq_MHz(void)
{
	return CYCLES_PER_SEC;
}

#elif defined(CONFIG_X86)

static inline void benchmark_timer_init(void)  {       }
static inline void benchmark_timer_stop(void)  {       }
static inline void benchmark_timer_start(void) {       }

extern uint32_t x86_cyc_to_ns_floor64(uint64_t cyc);
extern uint32_t x86_get_timer_freq_MHz(void);

#define CYCLES_TO_NS(x) x86_cyc_to_ns_floor64(x)

static inline uint32_t get_core_freq_MHz(void)
{
	return x86_get_timer_freq_MHz();
}

#define PRINT_STATS(x, y)	PRINT_F(x, y, CYCLES_TO_NS(y))

#else  /* All other architectures */
/* Done because weak attribute doesn't work on static inline. */
static inline void benchmark_timer_init(void)  {       }
static inline void benchmark_timer_stop(void)  {       }
static inline void benchmark_timer_start(void) {       }

#define CYCLES_TO_NS(x) (uint32_t)k_cyc_to_ns_floor64(x)

/* Get Core Frequency in MHz */
static inline uint32_t get_core_freq_MHz(void)
{
	return  (sys_clock_hw_cycles_per_sec() / 1000000);
}

#define PRINT_STATS(x, y)	PRINT_F(x, y, CYCLES_TO_NS(y))
#endif /* CONFIG_NRF_RTC_TIMER */

/******************************************************************************/
/* PRINT_F
 * Macro to print a formatted output string. fprintf is used when
 * Assumed that sline character array of SLINE_LEN + 1 characters
 * is defined in the main file
 */

/* #define CSV_FORMAT_OUTPUT */
/* printf format defines. */
#ifdef CSV_FORMAT_OUTPUT
#define FORMAT "%-45s,%4u,%5u\n"
#else
#define FORMAT "%-45s:%4u cycles , %5u ns\n"
#endif
#include <stdio.h>

#define GET_2ND_ARG(first, second, ...) (second)
#define GET_3ND_ARG(first, second, third, ...) (third)

/* Enable this macro to print all the measurements.
 * Note: Some measurements in few architectures are not valid
 */
#define PRINT_ALL_MEASUREMENTS
#ifndef PRINT_ALL_MEASUREMENTS
/*If the measured cycles is greater than 10000 then one of the following is
 * possible.
 * 1. the selected measurement is not supported in the architecture
 * 2. The measurement went wrong somewhere.(less likely to happen)
 */
#define PRINT_F(...)						     \
	{							     \
		if ((GET_2ND_ARG(__VA_ARGS__) <= 20000) &&	     \
		    (GET_2ND_ARG(__VA_ARGS__) != 0)) {		     \
			snprintf(sline, 254, FORMAT, ##__VA_ARGS__); \
			TC_PRINT("%s", sline);			     \
		}						     \
	}
#else
/* Prints all outputs*/
#define PRINT_F(...)						     \
	{							     \
		snprintf(sline, 254, FORMAT, ##__VA_ARGS__); \
		TC_PRINT("%s", sline);			     \
	}

#endif

/******************************************************************************/
/* Function prototypes */
void system_thread_bench(void);
void yield_bench(void);
void heap_malloc_free_bench(void);
void semaphore_bench(void);
void mutex_bench(void);
void msg_passing_bench(void);
void userspace_bench(void);

#ifdef CONFIG_USERSPACE
#include <syscall_handler.h>
__syscall int k_dummy_syscall(void);
__syscall uint32_t userspace_read_timer_value(void);
__syscall int validation_overhead_syscall(void);
#include <syscalls/timing_info.h>
#endif	/* CONFIG_USERSPACE */
```

## src/userspace_bench.c
```c
/*
 * Copyright (c) 2016 Intel Corporation.
 *
 * SPDX-License-Identifier: Apache-2.0
 */

/**
 * @file
 * @brief Measure time
 *
 */
#include <kernel.h>
#include <zephyr.h>
#include <tc_util.h>
#include <ksched.h>
#include "timing_info.h"
#include <app_memory/app_memdomain.h>

K_APPMEM_PARTITION_DEFINE(bench_ptn);
struct k_mem_domain bench_domain;

extern char sline[256];
extern uint64_t arch_timing_enter_user_mode_end;

uint64_t drop_to_user_mode_start_time;

struct k_thread my_thread_user;
K_THREAD_STACK_EXTERN(my_stack_area);
K_THREAD_STACK_EXTERN(my_stack_area_0);


/******************************************************************************/
/* syscall needed to read timer value when in user space */
uint32_t z_impl_userspace_read_timer_value(void)
{
	TIMING_INFO_PRE_READ();
	return TIMING_INFO_GET_TIMER_VALUE();
}

static inline uint32_t z_vrfy_userspace_read_timer_value(void)
{
	TIMING_INFO_PRE_READ();
	return TIMING_INFO_GET_TIMER_VALUE();
}
#include <syscalls/userspace_read_timer_value_mrsh.c>

/******************************************************************************/

void drop_to_user_mode(void);
void user_thread_creation(void);
void syscall_overhead(void);
void validation_overhead(void);

void userspace_bench(void)
{
	struct k_mem_partition *parts[] = {
		&bench_ptn
	};

	k_mem_domain_init(&bench_domain, ARRAY_SIZE(parts), parts);
	k_mem_domain_add_thread(&bench_domain, k_current_get());

	drop_to_user_mode();

	user_thread_creation();

	syscall_overhead();

	validation_overhead();
}
/******************************************************************************/

void test_drop_to_user_mode_1(void *p1, void *p2, void *p3)
{
	volatile uint32_t dummy = 100U;

	dummy++;
}

void drop_to_user_mode_thread(void *p1, void *p2, void *p3)
{
	TIMING_INFO_PRE_READ();
	drop_to_user_mode_start_time = TIMING_INFO_GET_TIMER_VALUE();
	k_thread_user_mode_enter(test_drop_to_user_mode_1, NULL, NULL, NULL);
}


void drop_to_user_mode(void)
{
#ifdef SysTick
	/* Reset the counter so that a interrupt doesn't happen between
	 * the benchmark test
	 */
	SysTick->VAL = 0;
#endif

	/* Test time to drop to usermode from SU */

	k_thread_create(&my_thread_user, my_stack_area_0, STACK_SIZE,
			drop_to_user_mode_thread,
			NULL, NULL, NULL,
			-1 /*priority*/, K_INHERIT_PERMS, K_NO_WAIT);

	k_yield();

	uint32_t total_cycles =
		SUBTRACT_CLOCK_CYCLES(arch_timing_enter_user_mode_end) -
		SUBTRACT_CLOCK_CYCLES(drop_to_user_mode_start_time);

	PRINT_STATS("Drop to user mode", total_cycles);
}

/******************************************************************************/
void user_thread_creation(void)
{
	uint64_t user_thread_creation_end_time, user_thread_creation_start_time;

	TIMING_INFO_PRE_READ();
	user_thread_creation_start_time = TIMING_INFO_GET_TIMER_VALUE();

	k_thread_create(&my_thread_user, my_stack_area, STACK_SIZE,
			test_drop_to_user_mode_1,
			NULL, NULL, NULL,
			0 /*priority*/, K_INHERIT_PERMS | K_USER, K_FOREVER);

	TIMING_INFO_PRE_READ();
	user_thread_creation_end_time = TIMING_INFO_GET_TIMER_VALUE();
	k_thread_abort(&my_thread_user);

	uint32_t total_cycles =
		SUBTRACT_CLOCK_CYCLES(user_thread_creation_end_time) -
		SUBTRACT_CLOCK_CYCLES(user_thread_creation_start_time);

	PRINT_STATS("User thread creation", total_cycles);
}

/******************************************************************************/
/* dummy syscalls creation */
K_APP_BMEM(bench_ptn) uint64_t syscall_overhead_start_time,
	syscall_overhead_end_time;

int z_impl_k_dummy_syscall(void)
{
	return 0;
}

static inline int z_vrfy_k_dummy_syscall(void)
{
	TIMING_INFO_PRE_READ();
	syscall_overhead_end_time = TIMING_INFO_GET_TIMER_VALUE();
	return 0;
}
#include <syscalls/k_dummy_syscall_mrsh.c>


void syscall_overhead_user_thread(void *p1, void *p2, void *p3)
{
	syscall_overhead_start_time = userspace_read_timer_value();
	int val = k_dummy_syscall();

	val |= 0xFF;
}


void syscall_overhead(void)
{
	k_thread_create(&my_thread_user, my_stack_area_0, STACK_SIZE,
			syscall_overhead_user_thread,
			NULL, NULL, NULL,
			-1 /*priority*/, K_INHERIT_PERMS | K_USER, K_NO_WAIT);

	uint32_t total_cycles =
		SUBTRACT_CLOCK_CYCLES(syscall_overhead_end_time) -
		SUBTRACT_CLOCK_CYCLES(syscall_overhead_start_time);

	PRINT_STATS("Syscall overhead", total_cycles);
}

/******************************************************************************/
K_SEM_DEFINE(test_sema, 1, 10);
uint32_t validation_overhead_obj_init_start_time;
uint32_t validation_overhead_obj_init_end_time;
uint32_t validation_overhead_obj_start_time;
uint32_t validation_overhead_obj_end_time;

int z_impl_validation_overhead_syscall(void)
{
	return 0;
}

static inline int z_vrfy_validation_overhead_syscall(void)
{
	TIMING_INFO_PRE_READ();
	validation_overhead_obj_init_start_time = TIMING_INFO_GET_TIMER_VALUE();

	bool status_0 = Z_SYSCALL_OBJ_INIT(&test_sema, K_OBJ_SEM);

	TIMING_INFO_PRE_READ();
	validation_overhead_obj_init_end_time = TIMING_INFO_GET_TIMER_VALUE();


	TIMING_INFO_PRE_READ();
	validation_overhead_obj_start_time = TIMING_INFO_GET_TIMER_VALUE();

	bool status_1 = Z_SYSCALL_OBJ(&test_sema, K_OBJ_SEM);

	TIMING_INFO_PRE_READ();
	validation_overhead_obj_end_time = TIMING_INFO_GET_TIMER_VALUE();
	return status_0 || status_1;
}
#include <syscalls/validation_overhead_syscall_mrsh.c>

void validation_overhead_user_thread(void *p1, void *p2, void *p3)
{
	/* get validation numbers */
	validation_overhead_syscall();
}

void validation_overhead(void)
{
	k_thread_access_grant(k_current_get(), &test_sema);

	k_thread_create(&my_thread_user, my_stack_area, STACK_SIZE,
			validation_overhead_user_thread,
			NULL, NULL, NULL,
			-1 /*priority*/, K_INHERIT_PERMS | K_USER, K_NO_WAIT);


	uint32_t total_cycles_obj_init =
		SUBTRACT_CLOCK_CYCLES(validation_overhead_obj_init_end_time) -
		SUBTRACT_CLOCK_CYCLES(validation_overhead_obj_init_start_time);

	uint32_t total_cycles_obj =
		SUBTRACT_CLOCK_CYCLES(validation_overhead_obj_end_time) -
		SUBTRACT_CLOCK_CYCLES(validation_overhead_obj_start_time);

	PRINT_STATS("Validation overhead k_object init",
		    total_cycles_obj_init);

	PRINT_STATS("Validation overhead k_object permission",
		    total_cycles_obj);
}
```

## src/yield_bench.c
```c
/*
 * Copyright (c) 2017 Intel Corporation.
 *
 * SPDX-License-Identifier: Apache-2.0
 */

#include <kernel.h>
#include <zephyr.h>
#include <tc_util.h>
#include <ksched.h>
#include "timing_info.h"

K_SEM_DEFINE(yield_sem, 0, 1);

/* To time thread creation*/
extern K_THREAD_STACK_DEFINE(my_stack_area, STACK_SIZE);
extern K_THREAD_STACK_DEFINE(my_stack_area_0, STACK_SIZE);
extern struct k_thread my_thread;
extern struct k_thread my_thread_0;

extern char sline[];

extern uint64_t thread_sleep_start_time;
extern uint64_t thread_sleep_end_time;
uint64_t thread_yield_start_time;
uint64_t thread_yield_end_time;
static uint32_t count;

void thread_yield0_test(void *p1, void *p2, void *p3);
void thread_yield1_test(void *p1, void *p2, void *p3);

k_tid_t yield0_tid;
k_tid_t yield1_tid;
void yield_bench(void)
{
	/* Thread yield */
	k_sleep(K_MSEC(10));

	yield0_tid = k_thread_create(&my_thread, my_stack_area,
				     STACK_SIZE,
				     thread_yield0_test,
				     NULL, NULL, NULL,
				     0 /*priority*/, 0, K_NO_WAIT);

	yield1_tid = k_thread_create(&my_thread_0, my_stack_area_0,
				     STACK_SIZE,
				     thread_yield1_test,
				     NULL, NULL, NULL,
				     0 /*priority*/, 0, K_NO_WAIT);

	/* read the time of start of the sleep till the swap happens */
	arch_timing_value_swap_end = 1U;

	TIMING_INFO_PRE_READ();
	thread_sleep_start_time = TIMING_INFO_OS_GET_TIME();

	k_sleep(K_MSEC(1000));

	thread_sleep_end_time = arch_timing_value_swap_common;

	uint32_t yield_cycles = CALCULATE_CYCLES(thread, yield) / 2000U;
	uint32_t sleep_cycles = CALCULATE_CYCLES(thread, sleep);

	PRINT_STATS("Thread yield", yield_cycles);

	PRINT_STATS("Thread sleep", sleep_cycles);
}


void thread_yield0_test(void *p1, void *p2, void *p3)
{
	k_sem_take(&yield_sem, K_MSEC(10));
	TIMING_INFO_PRE_READ();
	thread_yield_start_time = TIMING_INFO_OS_GET_TIME();
	while (count != 1000U) {
		count++;
		k_yield();
	}
	TIMING_INFO_PRE_READ();
	thread_yield_end_time = TIMING_INFO_OS_GET_TIME();
	k_thread_abort(yield1_tid);
}

void thread_yield1_test(void *p1, void *p2, void *p3)
{
	k_sem_give(&yield_sem);
	while (1) {
		k_yield();
	}
}
```
