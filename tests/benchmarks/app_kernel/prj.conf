## CMakeLists.txt
```
# SPDX-License-Identifier: Apache-2.0

cmake_minimum_required(VERSION 3.28.0)
find_package(Zephyr REQUIRED HINTS $ENV{ZEPHYR_BASE})
project(app_kernel)

FILE(GLOB app_sources src/*.c)
target_sources(app PRIVATE ${app_sources})
```

## Kconfig
```
# Copyright (c) 2024 Enphase Energy
# SPDX-License-Identifier: Apache-2.0

# Minimize timer interrupts during the benchmark. Without
# overflowing timer calculations (e.g. Cortex-M 24bit systick).
config SYS_CLOCK_TICKS_PER_SEC
	default 1000 if CORTEX_M_SYSTICK && SYS_CLOCK_HW_CYCLES_PER_SEC > 800000000
	default 100  if CORTEX_M_SYSTICK && SYS_CLOCK_HW_CYCLES_PER_SEC > 80000000
	default 10   if CORTEX_M_SYSTICK && SYS_CLOCK_HW_CYCLES_PER_SEC > 8000000
	default 1

source "Kconfig.zephyr"
```

## prj.conf
```kconfig
CONFIG_TEST=y
# all printf, fprintf to stdout go to console
CONFIG_STDOUT_CONSOLE=y

# eliminate timer interrupts during the benchmark
CONFIG_SYS_CLOCK_TICKS_PER_SEC=1

CONFIG_MAIN_THREAD_PRIORITY=6

# Disable HW Stack Protection (see #28664)
CONFIG_TEST_HW_STACK_PROTECTION=n
CONFIG_HW_STACK_PROTECTION=n
CONFIG_CBPRINTF_FP_SUPPORT=y

# Can only run under 1 CPU
CONFIG_MP_MAX_NUM_CPUS=1

CONFIG_APPLICATION_DEFINED_SYSCALL=y
CONFIG_TIMING_FUNCTIONS=y

# Disable time slicing
CONFIG_TIMESLICING=n
CONFIG_ASSERT=n
```

## prj_fp.conf
```kconfig
CONFIG_TEST=y
# all printf, fprintf to stdout go to console
CONFIG_STDOUT_CONSOLE=y
CONFIG_MAIN_THREAD_PRIORITY=6

CONFIG_FPU=y
CONFIG_FPU_SHARING=y

# eliminate timer interrupts during the benchmark
CONFIG_SYS_CLOCK_TICKS_PER_SEC=1
CONFIG_TICKLESS_KERNEL=n

CONFIG_FORCE_NO_ASSERT=y

# Disable HW Stack Protection (see #28664)
CONFIG_TEST_HW_STACK_PROTECTION=n
CONFIG_HW_STACK_PROTECTION=n

CONFIG_MP_MAX_NUM_CPUS=1

# Enable pipes
CONFIG_PIPES=y
```

## prj_no_fp.conf
```kconfig
# all printf, fprintf to stdout go to console
CONFIG_STDOUT_CONSOLE=y

# eliminate timer interrupts during the benchmark
CONFIG_SYS_CLOCK_TICKS_PER_SEC=1
CONFIG_MAIN_THREAD_PRIORITY=6
```

## prj_user.conf
```kconfig
CONFIG_TEST=y
# all printf, fprintf to stdout go to console
CONFIG_STDOUT_CONSOLE=y

# eliminate timer interrupts during the benchmark
CONFIG_SYS_CLOCK_TICKS_PER_SEC=1

CONFIG_MAIN_THREAD_PRIORITY=6

# Disable HW Stack Protection (see #28664)
CONFIG_TEST_HW_STACK_PROTECTION=n
CONFIG_HW_STACK_PROTECTION=n
CONFIG_CBPRINTF_FP_SUPPORT=y

# Can only run under 1 CPU
CONFIG_MP_MAX_NUM_CPUS=1

CONFIG_APPLICATION_DEFINED_SYSCALL=y
CONFIG_TIMING_FUNCTIONS=y
CONFIG_USERSPACE=y
CONFIG_USERSPACE_THREAD_MAY_RAISE_PRIORITY=y
CONFIG_ASSERT=n
```

## boards/nrf52_bsim.conf
```kconfig
CONFIG_SYS_CLOCK_TICKS_PER_SEC=100
```

## src/config.h
```c
/* config.h */

/*
 * Copyright (c) 1997-2010, 2014-2015 Wind River Systems, Inc.
 *
 * SPDX-License-Identifier: Apache-2.0
 */

#ifndef _CONFIG_H
#define _CONFIG_H

/* Max size of a message string */
#define MAX_MSG 256

#endif /* _CONFIG_H */
```

## src/event_b.c
```c
/* event_b.c */

/*
 * Copyright (c) 1997-2014 Wind River Systems, Inc.
 *
 * SPDX-License-Identifier: Apache-2.0
 */

#include "master.h"

#ifdef EVENT_BENCH

/* #define EVENT_CHECK */
#ifdef EVENT_CHECK
static const char event_signal_err[] = "----------- Error signalling event.\n";
static const char event_test_err[] = "----------- Error testing event.\n";
static const char event_handler_err[] = "----------- Error in event handler\n";
#endif

/* global Event value */
volatile int nevent_value;

/*
 * Function prototypes.
 */
int example_handler (struct k_alert *alert);

/*
 * Function declarations.
 */

/**
 *
 * @brief Event signal speed test
 *
 * @return N/A
 */
void event_test(void)
{
	int nreturn = 0;
	int ncounter;
	u32_t et; /* elapsed time */

	PRINT_STRING(dashline, output_file);
	et = BENCH_START();
	for (ncounter = 0; ncounter < NR_OF_EVENT_RUNS; ncounter++) {
		k_alert_send(&TEST_EVENT);
#ifdef EVENT_CHECK
		if (nreturn != 0) {
			PRINT_STRING(event_signal_err, output_file);
			return; /* error */
		}
#endif /* EVENT_CHECK */
	}
	et = TIME_STAMP_DELTA_GET(et);
	check_result();

	PRINT_F(output_file, FORMAT, "Signal enabled event",
			SYS_CLOCK_HW_CYCLES_TO_NS_AVG(et, NR_OF_EVENT_RUNS));

	et = BENCH_START();
	for (ncounter = 0; ncounter < NR_OF_EVENT_RUNS; ncounter++) {
		k_alert_send(&TEST_EVENT);
#ifdef EVENT_CHECK
		if (nreturn != 0) {
			PRINT_STRING(event_signal_err, output_file);
			k_sleep(1);
			return; /* error */
		}
#endif /* EVENT_CHECK */
		k_alert_recv(&TEST_EVENT, K_NO_WAIT);
#ifdef EVENT_CHECK
		if (nreturn != 0) {
			PRINT_STRING(event_test_err, output_file);
			k_sleep(1);
			return; /* error */
		}
#endif /* EVENT_CHECK */
	}
	et = TIME_STAMP_DELTA_GET(et);
	check_result();

	PRINT_F(output_file, FORMAT, "Signal event & Test event",
			SYS_CLOCK_HW_CYCLES_TO_NS_AVG(et, NR_OF_EVENT_RUNS));

	et = BENCH_START();
	for (ncounter = 0; ncounter < NR_OF_EVENT_RUNS; ncounter++) {
		k_alert_send(&TEST_EVENT);
#ifdef EVENT_CHECK
		if (nreturn != 0) {
			PRINT_STRING(event_signal_err, output_file);
			return; /* error */
		}
#endif /* EVENT_CHECK */
		k_alert_recv(&TEST_EVENT, K_FOREVER);
#ifdef EVENT_CHECK
		if (nreturn != 0) {
			PRINT_STRING(event_test_err, output_file);
			return; /* error */
		}
#endif /* EVENT_CHECK */
	}
	et = TIME_STAMP_DELTA_GET(et);
	check_result();

	PRINT_F(output_file, FORMAT, "Signal event & TestW event",
			SYS_CLOCK_HW_CYCLES_TO_NS_AVG(et, NR_OF_EVENT_RUNS));

	PRINT_STRING("| Signal event with installed handler"
		 "                                         |\n", output_file);
	TEST_EVENT.handler = example_handler;
	if (nreturn != 0) {
		PRINT_F(output_file,
			"-------- Error installing event handler.\n");
		k_sleep(1);
		return; /* error */
	}

	for (ncounter = 0; ncounter < NR_OF_EVENT_RUNS; ncounter++) {
		k_alert_send(&TEST_EVENT);
#ifdef EVENT_CHECK
		if (nreturn != 0) {
			PRINT_STRING(event_signal_err, output_file);
			k_sleep(1);
			return; /* error */
		}
		if (nevent_value != TEST_EVENT.send_count + 1) {
			PRINT_STRING(event_handler_err, output_file);
			k_sleep(1);
			return; /* error */
		}
#endif /* EVENT_CHECK */
		nevent_value = 0;
	}

	TEST_EVENT.handler = NULL;
	if (nreturn != 0) {
		PRINT_F(output_file, "Error removing event handler.\n");
		k_sleep(1);
		return; /* error */
	}

	PRINT_STRING("|    Handler responds OK"
		 "                                                      |\n",
				 output_file);

	return; /* success */
}


/**
 *
 * @brief Event handler for the tests
 *
 * The event handler for the test. Sets up nEventValue global variable.
 * This variable is used in the main test.
 *
 * @return 1
 */
int example_handler (struct k_alert *alert)
{
	ARG_UNUSED(alert);
	nevent_value = alert->send_count + 1;

	return 1;
}

#endif /* EVENT_BENCH */
```

## src/fifo_b.c
```c
/* fifo_b.c */

/*
 * Copyright (c) 1997-2010, 2013-2014 Wind River Systems, Inc.
 *
 * SPDX-License-Identifier: Apache-2.0
 */

#include "master.h"

/**
 * @brief Queue transfer speed test
 */
void queue_test(void)
{
	uint32_t et; /* elapsed time */
	int i;

	PRINT_STRING(dashline);
	et = BENCH_START();
	for (i = 0; i < NR_OF_FIFO_RUNS; i++) {
		k_msgq_put(&DEMOQX1, data_bench, K_FOREVER);
	}
	et = TIME_STAMP_DELTA_GET(et);

	PRINT_F(FORMAT, "enqueue 1 byte msg in FIFO",
		SYS_CLOCK_HW_CYCLES_TO_NS_AVG(et, NR_OF_FIFO_RUNS));

	et = BENCH_START();
	for (i = 0; i < NR_OF_FIFO_RUNS; i++) {
		k_msgq_get(&DEMOQX1, data_bench, K_FOREVER);
	}
	et = TIME_STAMP_DELTA_GET(et);
	check_result();

	PRINT_F(FORMAT, "dequeue 1 byte msg in FIFO",
		SYS_CLOCK_HW_CYCLES_TO_NS_AVG(et, NR_OF_FIFO_RUNS));

	et = BENCH_START();
	for (i = 0; i < NR_OF_FIFO_RUNS; i++) {
		k_msgq_put(&DEMOQX4, data_bench, K_FOREVER);
	}
	et = TIME_STAMP_DELTA_GET(et);
	check_result();

	PRINT_F(FORMAT, "enqueue 4 bytes msg in FIFO",
		SYS_CLOCK_HW_CYCLES_TO_NS_AVG(et, NR_OF_FIFO_RUNS));

	et = BENCH_START();
	for (i = 0; i < NR_OF_FIFO_RUNS; i++) {
		k_msgq_get(&DEMOQX4, data_bench, K_FOREVER);
	}
	et = TIME_STAMP_DELTA_GET(et);
	check_result();

	PRINT_F(FORMAT, "dequeue 4 bytes msg in FIFO",
		SYS_CLOCK_HW_CYCLES_TO_NS_AVG(et, NR_OF_FIFO_RUNS));

	k_sem_give(&STARTRCV);

	et = BENCH_START();
	for (i = 0; i < NR_OF_FIFO_RUNS; i++) {
		k_msgq_put(&DEMOQX1, data_bench, K_FOREVER);
	}
	et = TIME_STAMP_DELTA_GET(et);
	check_result();

	PRINT_F(FORMAT,
		"enqueue 1 byte msg in FIFO to a waiting higher priority task",
		SYS_CLOCK_HW_CYCLES_TO_NS_AVG(et, NR_OF_FIFO_RUNS));

	et = BENCH_START();
	for (i = 0; i < NR_OF_FIFO_RUNS; i++) {
		k_msgq_put(&DEMOQX4, data_bench, K_FOREVER);
	}
	et = TIME_STAMP_DELTA_GET(et);
	check_result();

	PRINT_F(FORMAT,
		"enqueue 4 bytes in FIFO to a waiting higher priority task",
		SYS_CLOCK_HW_CYCLES_TO_NS_AVG(et, NR_OF_FIFO_RUNS));
}
```

## src/fifo_r.c
```c
/* fifo_r.c */

/*
 * Copyright (c) 1997-2010, 2013-2014 Wind River Systems, Inc.
 *
 * SPDX-License-Identifier: Apache-2.0
 */

#include "receiver.h"
#include "master.h"

/* queue transfer speed test */

/**
 * @brief Data receive task
 */
void dequtask(void)
{
	int x, i;

	for (i = 0; i < NR_OF_FIFO_RUNS; i++) {
		k_msgq_get(&DEMOQX1, &x, K_FOREVER);
	}

	for (i = 0; i < NR_OF_FIFO_RUNS; i++) {
		k_msgq_get(&DEMOQX4, &x, K_FOREVER);
	}
}
```

## src/mailbox_b.c
```c
/* mailbox_b.c */

/*
 * Copyright (c) 1997-2010, 2013-2014 Wind River Systems, Inc.
 *
 * SPDX-License-Identifier: Apache-2.0
 */

#include "master.h"

static struct k_mbox_msg message;

#define PRINT_HEADER()                                                       \
	(PRINT_STRING                                                        \
	   ("|   size(B) |       time/packet (nsec)       |          KB/sec" \
	    "                |\n"))

#define PRINT_ONE_RESULT()                                                   \
	PRINT_F("|%11u|%32u|%32u|\n", putsize, puttime,	                     \
		(uint32_t)                                                   \
		(((uint64_t)putsize * 1000000U) / SAFE_DIVISOR(puttime)))

#define PRINT_OVERHEAD()                                                     \
	PRINT_F("| message overhead:  %10u     nsec/packet                 " \
	     "              |\n", empty_msg_put_time)

#define PRINT_XFER_RATE()                                                    \
	PRINT_F("| raw transfer rate:     %10u KB/sec (without"              \
		" overhead)                 |\n",                            \
		(uint32_t)((uint64_t)(putsize >> 1) * 1000000U /             \
			   SAFE_DIVISOR(puttime - empty_msg_put_time)))

/*
 * Function prototypes.
 */
void mailbox_put(uint32_t size, int count, uint32_t *time);

/*
 * Function declarations.
 */

/**
 * @brief Mailbox transfer speed test
 */
void mailbox_test(void)
{
	uint32_t putsize;
	uint32_t puttime;
	int putcount;
	unsigned int empty_msg_put_time;
	struct getinfo getinfo;

	PRINT_STRING(dashline);
	PRINT_STRING("|                "
		     "M A I L B O X   M E A S U R E M E N T S"
		     "                      |\n");
	PRINT_STRING(dashline);
	PRINT_STRING("| Send mailbox message to waiting high "
		     "priority task and wait                 |\n");
	PRINT_F("| repeat for %4d times and take the "
		"average                                  |\n",
		NR_OF_MBOX_RUNS);
	PRINT_STRING(dashline);
	PRINT_HEADER();
	PRINT_STRING(dashline);
	k_sem_reset(&SEM0);
	k_sem_give(&STARTRCV);

	putcount = NR_OF_MBOX_RUNS;

	putsize = 0U;
	mailbox_put(putsize, putcount, &puttime);
	/* waiting for ack */
	k_msgq_get(&MB_COMM, &getinfo, K_FOREVER);
	PRINT_ONE_RESULT();
	empty_msg_put_time = puttime;
	for (putsize = 8U; putsize <= MESSAGE_SIZE; putsize <<= 1) {
		mailbox_put(putsize, putcount, &puttime);
		/* waiting for ack */
		k_msgq_get(&MB_COMM, &getinfo, K_FOREVER);
		PRINT_ONE_RESULT();
	}
	PRINT_STRING(dashline);
	PRINT_OVERHEAD();
	PRINT_XFER_RATE();
}


/**
 * @brief Write the number of data chunks into the mailbox
 *
 * @param size    The size of the data chunk.
 * @param count   Number of data chunks.
 * @param time    The total time.
 */
void mailbox_put(uint32_t size, int count, uint32_t *time)
{
	int i;
	uint64_t  t;
	timing_t  start;
	timing_t  end;

	message.rx_source_thread = K_ANY;
	message.tx_target_thread = K_ANY;

	/* first sync with the receiver */
	k_sem_give(&SEM0);
	start = timing_timestamp_get();
	for (i = 0; i < count; i++) {
		k_mbox_put(&MAILB1, &message, K_FOREVER);
	}
	end = timing_timestamp_get();
	t = timing_cycles_get(&start, &end);
	*time = test_timing_cycles_to_ns_avg(t, count);
}
```

## src/mailbox_r.c
```c
/* mailbox_r.c */

/*
 * Copyright (c) 1997-2010, 2013-2014 Wind River Systems, Inc.
 *
 * SPDX-License-Identifier: Apache-2.0
 */

#include "receiver.h"
#include "master.h"

/*
 * Function prototypes.
 */
void mailbox_get(struct k_mbox *mailbox,
		int size,
		int count,
		unsigned int *time);

/*
 * Function declarations.
 */

/* mailbox transfer speed test */

/**
 * @brief Receive task
 */
void mailrecvtask(void)
{
	int getsize;
	unsigned int gettime;
	int getcount;
	struct getinfo getinfo;

	getcount = NR_OF_MBOX_RUNS;

	getsize = 0;
	mailbox_get(&MAILB1, getsize, getcount, &gettime);
	getinfo.time = gettime;
	getinfo.size = getsize;
	getinfo.count = getcount;
	/* acknowledge to master */
	k_msgq_put(&MB_COMM, &getinfo, K_FOREVER);

	for (getsize = 8; getsize <= MESSAGE_SIZE; getsize <<= 1) {
		mailbox_get(&MAILB1, getsize, getcount, &gettime);
		getinfo.time = gettime;
		getinfo.size = getsize;
		getinfo.count = getcount;
		/* acknowledge to master */
		k_msgq_put(&MB_COMM, &getinfo, K_FOREVER);
	}
}


/**
 * @brief Receive data portions from the specified mailbox
 *
 * @return 0
 *
 * @param mailbox   The mailbox to read data from.
 * @param size      Size of each data portion.
 * @param count     Number of data portions.
 * @param time      Resulting time.
 */
void mailbox_get(struct k_mbox *mailbox,
		 int size,
		 int count,
		 unsigned int *time)
{
	int i;
	timing_t  start;
	timing_t  end;
	int32_t return_value = 0;
	struct k_mbox_msg Message;

	Message.rx_source_thread = K_ANY;
	Message.size = size;

	/* sync with the sender */
	k_sem_take(&SEM0, K_FOREVER);
	start = timing_timestamp_get();
	for (i = 0; i < count; i++) {
		return_value |= k_mbox_get(mailbox,
					  &Message,
					  &data_recv,
					  K_FOREVER);
	}
	end = timing_timestamp_get();
	*time = timing_cycles_get(&start, &end);

	if (return_value != 0) {
		k_panic();
	}
}
```

## src/master.c
```c
/* master.c */

/*
 * Copyright (c) 1997-2010,2013-2015 Wind River Systems, Inc.
 *
 * SPDX-License-Identifier: Apache-2.0
 */

/*
 * File Naming information.
 * ------------------------
 *	Files that end with:
 *		_B : Is a file that contains a benchmark function
 *		_R : Is a file that contains the receiver task
 *			 of a benchmark function
 */
#include <zephyr/tc_util.h>
#include "master.h"

#define RECV_STACK_SIZE  (1024 + CONFIG_TEST_EXTRA_STACK_SIZE)
#define TEST_STACK_SIZE  (1024 + CONFIG_TEST_EXTRA_STACK_SIZE)

BENCH_BMEM char msg[MAX_MSG];
BENCH_BMEM char data_bench[MESSAGE_SIZE];

BENCH_DMEM struct k_pipe *test_pipes[] = {&PIPE_NOBUFF, &PIPE_SMALLBUFF, &PIPE_BIGBUFF};
BENCH_BMEM char sline[SLINE_LEN + 1];

/*
 * Time in timer cycles necessary to read time.
 * Used for correction in time measurements.
 */
uint32_t tm_off;

static BENCH_DMEM char *test_type_str[] = {
	"|                  K E R N E L - - > K E R N E L                   |          |\n",
	"|                  K E R N E L - - >   U S E R                     |          |\n",
	"|                    U S E R   - - > K E R N E L                   |          |\n",
	"|                    U S E R   - - >   U S E R                     |          |\n"
};

/********************************************************************/
/* static allocation  */

static struct k_thread test_thread;
static struct k_thread recv_thread;
K_THREAD_STACK_DEFINE(test_stack, TEST_STACK_SIZE);
K_THREAD_STACK_DEFINE(recv_stack, RECV_STACK_SIZE);

#ifdef CONFIG_USERSPACE
K_APPMEM_PARTITION_DEFINE(bench_mem_partition);
#endif

K_MSGQ_DEFINE(DEMOQX1, 1, 500, 4);
K_MSGQ_DEFINE(DEMOQX4, 4, 500, 4);
K_MSGQ_DEFINE(DEMOQX192, 192, 500, 4);
K_MSGQ_DEFINE(MB_COMM, 12, 1, 4);
K_MSGQ_DEFINE(CH_COMM, 12, 1, 4);

K_MEM_SLAB_DEFINE(MAP1, 16, 2, 4);

K_SEM_DEFINE(SEM0, 0, 1);
K_SEM_DEFINE(SEM1, 0, 1);
K_SEM_DEFINE(SEM2, 0, 1);
K_SEM_DEFINE(SEM3, 0, 1);
K_SEM_DEFINE(SEM4, 0, 1);
K_SEM_DEFINE(STARTRCV, 0, 1);

K_MBOX_DEFINE(MAILB1);

K_MUTEX_DEFINE(DEMO_MUTEX);

K_PIPE_DEFINE(PIPE_NOBUFF, 0, 4);
K_PIPE_DEFINE(PIPE_SMALLBUFF, 256, 4);
K_PIPE_DEFINE(PIPE_BIGBUFF, 4096, 4);

/*
 * Custom syscalls
 */

/**
 * @brief Obtain a timestamp
 *
 * Architecture timestamp routines often require MMIO that is not mapped to
 * the user threads. Use a custom system call to get the timestamp.
 */
timing_t z_impl_timing_timestamp_get(void)
{
	return timing_counter_get();
}

#ifdef CONFIG_USERSPACE
static timing_t z_vrfy_timing_timestamp_get(void)
{
	return z_impl_timing_timestamp_get();
}

#include <zephyr/syscalls/timing_timestamp_get_mrsh.c>
#endif

/*
 * Main test
 */

/**
 * @brief Entry point for test thread
 */
static void test_thread_entry(void *p1, void *p2, void *p3)
{
	bool skip_mem_and_mbox = (bool)(uintptr_t)(p2);

	ARG_UNUSED(p3);

	PRINT_STRING("\n");
	PRINT_STRING(dashline);
	PRINT_STRING("|          S I M P L E   S E R V I C E    "
		     "M E A S U R E M E N T S  |  nsec    |\n");
#ifdef CONFIG_USERSPACE
	PRINT_STRING((const char *)p1);
#endif
	PRINT_STRING(dashline);

	message_queue_test();
	sema_test();
	mutex_test();

	if (!skip_mem_and_mbox) {
		memorymap_test();
		mailbox_test();
	}

	pipe_test();
}

/**
 * @brief Perform all benchmarks
 */
int main(void)
{
	int  priority;

	priority = k_thread_priority_get(k_current_get());

#ifdef CONFIG_USERSPACE
	k_mem_domain_add_partition(&k_mem_domain_default,
				   &bench_mem_partition);
#endif

	bench_test_init();

	timing_init();

	timing_start();

	/* ********* All threads are kernel threads ********** */

	k_thread_create(&test_thread, test_stack,
			K_THREAD_STACK_SIZEOF(test_stack),
			test_thread_entry,
			test_type_str[0], (void *)(uintptr_t)false, NULL,
			priority, 0, K_FOREVER);

	k_thread_create(&recv_thread, recv_stack,
			K_THREAD_STACK_SIZEOF(recv_stack),
			recvtask, (void *)(uintptr_t)false, NULL, NULL,
			5, 0, K_FOREVER);

	k_thread_start(&recv_thread);
	k_thread_start(&test_thread);

	k_thread_join(&test_thread, K_FOREVER);
	k_thread_abort(&recv_thread);

#ifdef CONFIG_USERSPACE
	/* ****** Main thread is kernel, receiver is user thread ******* */

	k_thread_create(&test_thread, test_stack,
			K_THREAD_STACK_SIZEOF(test_stack),
			test_thread_entry,
			test_type_str[1], (void *)(uintptr_t)true, NULL,
			priority, 0, K_FOREVER);

	k_thread_create(&recv_thread, recv_stack,
			K_THREAD_STACK_SIZEOF(recv_stack),
			recvtask, (void *)(uintptr_t)true, NULL, NULL,
			5, K_USER, K_FOREVER);

	k_thread_access_grant(&recv_thread, &DEMOQX1, &DEMOQX4, &DEMOQX192,
			      &MB_COMM, &CH_COMM, &SEM0, &SEM1, &SEM2, &SEM3,
			      &SEM4, &STARTRCV, &DEMO_MUTEX,
			      &PIPE_NOBUFF, &PIPE_SMALLBUFF, &PIPE_BIGBUFF);

	k_thread_start(&recv_thread);
	k_thread_start(&test_thread);

	k_thread_join(&test_thread, K_FOREVER);
	k_thread_abort(&recv_thread);

	/* ****** Main thread is user, receiver is kernel thread ******* */

	k_thread_create(&test_thread, test_stack,
			K_THREAD_STACK_SIZEOF(test_stack),
			test_thread_entry,
			test_type_str[2], (void *)(uintptr_t)true, NULL,
			priority, K_USER, K_FOREVER);

	k_thread_create(&recv_thread, recv_stack,
			K_THREAD_STACK_SIZEOF(recv_stack),
			recvtask, (void *)(uintptr_t)true, NULL, NULL,
			5, 0, K_FOREVER);

	k_thread_access_grant(&test_thread, &DEMOQX1, &DEMOQX4, &DEMOQX192,
			      &MB_COMM, &CH_COMM, &SEM0, &SEM1, &SEM2, &SEM3,
			      &SEM4, &STARTRCV, &DEMO_MUTEX,
			      &PIPE_NOBUFF, &PIPE_SMALLBUFF, &PIPE_BIGBUFF);

	k_thread_start(&recv_thread);
	k_thread_start(&test_thread);

	k_thread_join(&test_thread, K_FOREVER);
	k_thread_abort(&recv_thread);

	/* ********* All threads are user threads ********** */

	k_thread_create(&test_thread, test_stack,
			K_THREAD_STACK_SIZEOF(test_stack),
			test_thread_entry,
			test_type_str[3], (void *)(uintptr_t)true, NULL,
			priority, K_USER, K_FOREVER);

	k_thread_create(&recv_thread, recv_stack,
			K_THREAD_STACK_SIZEOF(recv_stack),
			recvtask, (void *)(uintptr_t)true, NULL, NULL,
			5, K_USER, K_FOREVER);

	k_thread_access_grant(&test_thread, &DEMOQX1, &DEMOQX4, &DEMOQX192,
			      &MB_COMM, &CH_COMM, &SEM0, &SEM1, &SEM2, &SEM3,
			      &SEM4, &STARTRCV, &DEMO_MUTEX,
			      &PIPE_NOBUFF, &PIPE_SMALLBUFF, &PIPE_BIGBUFF);
	k_thread_access_grant(&recv_thread, &DEMOQX1, &DEMOQX4, &DEMOQX192,
			      &MB_COMM, &CH_COMM, &SEM0, &SEM1, &SEM2, &SEM3,
			      &SEM4, &STARTRCV, &DEMO_MUTEX,
			      &PIPE_NOBUFF, &PIPE_SMALLBUFF, &PIPE_BIGBUFF);

	k_thread_start(&recv_thread);
	k_thread_start(&test_thread);

	k_thread_join(&test_thread, K_FOREVER);
	k_thread_abort(&recv_thread);
#endif /* CONFIG_USERSPACE */

	timing_stop();

	PRINT_STRING("|         END OF TESTS                     "
		     "                                   |\n");
	PRINT_STRING(dashline);
	PRINT_STRING("PROJECT EXECUTION SUCCESSFUL\n");
	TC_PRINT_RUNID;

	return 0;
}
```

## src/master.h
```c
/* master.h */

/*
 * Copyright (c) 1997-2010, 2014-2015 Wind River Systems, Inc.
 *
 * SPDX-License-Identifier: Apache-2.0
 */

#ifndef _MASTER_H
#define _MASTER_H

#include <zephyr/kernel.h>
#include <zephyr/syscall.h>
#include <zephyr/internal/syscall_handler.h>

#include <inttypes.h>
#include <stdio.h>

#include "receiver.h"

#include <zephyr/timestamp.h>

#include <string.h>

#include <zephyr/sys/util.h>

#include <zephyr/app_memory/app_memdomain.h>
#include <zephyr/timing/timing.h>

/* printf format defines. */
#define FORMAT "| %-65s|%10"PRIu64"|\n"

/* length of the output line */
#define SLINE_LEN 256

#define NR_OF_MSGQ_RUNS 500
#define NR_OF_SEMA_RUNS 500
#define NR_OF_MUTEX_RUNS 1000
#define NR_OF_MAP_RUNS 1000
#define NR_OF_MBOX_RUNS 128
#define NR_OF_PIPE_RUNS 256
#define SEMA_WAIT_TIME (5000)

#ifdef CONFIG_USERSPACE
#define BENCH_BMEM  K_APP_BMEM(bench_mem_partition)
#define BENCH_DMEM  K_APP_DMEM(bench_mem_partition)
#else
#define BENCH_BMEM
#define BENCH_DMEM
#endif

/* global data */

extern char msg[MAX_MSG];
extern char data_bench[MESSAGE_SIZE];
extern struct k_pipe *test_pipes[];
extern char sline[];

#define dashline \
	"|--------------------------------------" \
	"---------------------------------------|\n"

/*
 * To avoid divisions by 0 faults, wrap the divisor with this macro
 */
#define SAFE_DIVISOR(a) (((a) != 0) ? (a) : 1)


/* pipe amount of content to receive (0+, 1+, all) */
enum pipe_options {
	_0_TO_N = 0x0,
	_1_TO_N = 0x1,
	_ALL_N  = 0x2,
};

/* other external functions */

extern void recvtask(void *p1, void *p2, void *p3);

extern void mailbox_test(void);
extern void sema_test(void);
extern void message_queue_test(void);
extern void mutex_test(void);
extern void memorymap_test(void);
extern void pipe_test(void);

/* kernel objects needed for benchmarking */
extern struct k_mutex DEMO_MUTEX;

extern struct k_sem SEM0;
extern struct k_sem SEM1;
extern struct k_sem SEM2;
extern struct k_sem SEM3;
extern struct k_sem SEM4;
extern struct k_sem STARTRCV;

extern struct k_msgq DEMOQX1;
extern struct k_msgq DEMOQX4;
extern struct k_msgq DEMOQX192;
extern struct k_msgq MB_COMM;
extern struct k_msgq CH_COMM;

extern struct k_mbox MAILB1;

extern struct k_pipe PIPE_NOBUFF;
extern struct k_pipe PIPE_SMALLBUFF;
extern struct k_pipe PIPE_BIGBUFF;


extern struct k_mem_slab MAP1;

/* PRINT_STRING
 * Macro to print an ASCII NULL terminated string.
 */
#define PRINT_STRING(string)  printk("%s", string)

/* PRINT_F
 * Macro to print a formatted output string.
 * Assumed that sline character array of SLINE_LEN + 1 characters
 * is defined in the main file
 */

#define PRINT_F(fmt, ...)					        \
{									\
	snprintf(sline, SLINE_LEN, fmt, ##__VA_ARGS__);                 \
	PRINT_STRING(sline);					        \
}

__syscall void test_thread_priority_set(k_tid_t thread, int prio);
__syscall timing_t timing_timestamp_get(void);
__syscall uint64_t test_timing_cycles_to_ns_avg(uint64_t cycles, uint32_t count);

#include <zephyr/syscalls/master.h>

#endif /* _MASTER_H */
```

## src/memcfg.h
```c
/* memcfg.h */

/*
 * Copyright (c) 1997-2010, 2014 Wind River Systems, Inc.
 *
 * SPDX-License-Identifier: Apache-2.0
 */

#ifndef MESSAGE_H
#define MESSAGE_H

#define MESSAGE_SIZE        4096
#define MESSAGE_SIZE_PIPE   2048	/* must be smaller than MESSAGE_SIZE */

#endif
```

## src/memmap_b.c
```c
/* memmap_b.c */

/*
 * Copyright (c) 1997-2010, 2013-2014 Wind River Systems, Inc.
 *
 * SPDX-License-Identifier: Apache-2.0
 */

#include "master.h"
#include <zephyr/kernel.h>

/**
 * @brief Memory map get/free test
 */
void memorymap_test(void)
{
	uint64_t et; /* elapsed time */
	timing_t  start;
	timing_t  end;
	int i;
	void *p;
	int alloc_status;

	PRINT_STRING(dashline);
	start = timing_timestamp_get();
	for (i = 0; i < NR_OF_MAP_RUNS; i++) {
		alloc_status = k_mem_slab_alloc(&MAP1, &p, K_FOREVER);
		if (alloc_status != 0) {
			PRINT_F(FORMAT,
				"Error: Slab allocation failed.", (uint64_t)alloc_status);
			break;
		}
		k_mem_slab_free(&MAP1, p);
	}
	end = timing_timestamp_get();
	et = timing_cycles_get(&start, &end);

	PRINT_F(FORMAT, "average alloc and dealloc memory page",
		test_timing_cycles_to_ns_avg(et, (2 * NR_OF_MAP_RUNS)));
}
```

## src/mempool_b.c
```c
/* mempool_b.c */

/*
 * Copyright (c) 1997-2010, 2013-2014 Wind River Systems, Inc.
 *
 * SPDX-License-Identifier: Apache-2.0
 */

#include "master.h"

#ifdef MEMPOOL_BENCH

/**
 *
 * @brief Memory pool get/free test
 *
 * @return N/A
 */
void mempool_test(void)
{
	uint32_t et; /* elapsed time */
	int i;
	int32_t return_value = 0;
	struct k_mem_block block;

	PRINT_STRING(dashline, output_file);
	et = BENCH_START();
	for (i = 0; i < NR_OF_POOL_RUNS; i++) {
		return_value |= z_mem_pool_alloc(&DEMOPOOL,
						&block,
						16,
						K_FOREVER);
		z_mem_pool_free(&block);
	}
	et = TIME_STAMP_DELTA_GET(et);
	check_result();

	if (return_value != 0) {
		k_panic();
	}
	PRINT_F(output_file, FORMAT,
		"average alloc and dealloc memory pool block",
		SYS_CLOCK_HW_CYCLES_TO_NS_AVG(et, (2 * NR_OF_POOL_RUNS)));
}

#endif /* MEMPOOL_BENCH */
```

## src/msgq_b.c
```c
/* msgq_b.c */

/*
 * Copyright (c) 1997-2010, 2013-2014 Wind River Systems, Inc.
 *
 * SPDX-License-Identifier: Apache-2.0
 */

#include "master.h"

/**
 * @brief Message queue transfer speed test
 */
void message_queue_test(void)
{
	uint64_t et; /* elapsed time */
	int i;
	timing_t  start;
	timing_t  end;

	PRINT_STRING(dashline);
	start = timing_timestamp_get();
	for (i = 0; i < NR_OF_MSGQ_RUNS; i++) {
		k_msgq_put(&DEMOQX1, data_bench, K_FOREVER);
	}
	end = timing_timestamp_get();
	et = timing_cycles_get(&start, &end);
	PRINT_F(FORMAT, "enqueue 1 byte msg in MSGQ",
		test_timing_cycles_to_ns_avg(et, NR_OF_MSGQ_RUNS));

	start = timing_timestamp_get();
	for (i = 0; i < NR_OF_MSGQ_RUNS; i++) {
		k_msgq_get(&DEMOQX1, data_bench, K_FOREVER);
	}
	end = timing_timestamp_get();
	et = timing_cycles_get(&start, &end);

	PRINT_F(FORMAT, "dequeue 1 byte msg from MSGQ",
		test_timing_cycles_to_ns_avg(et, NR_OF_MSGQ_RUNS));

	start = timing_timestamp_get();
	for (i = 0; i < NR_OF_MSGQ_RUNS; i++) {
		k_msgq_put(&DEMOQX4, data_bench, K_FOREVER);
	}
	end = timing_timestamp_get();
	et = timing_cycles_get(&start, &end);

	PRINT_F(FORMAT, "enqueue 4 bytes msg in MSGQ",
		test_timing_cycles_to_ns_avg(et, NR_OF_MSGQ_RUNS));

	start = timing_timestamp_get();
	for (i = 0; i < NR_OF_MSGQ_RUNS; i++) {
		k_msgq_get(&DEMOQX4, data_bench, K_FOREVER);
	}
	end = timing_timestamp_get();
	et = timing_cycles_get(&start, &end);

	PRINT_F(FORMAT, "dequeue 4 bytes msg in MSGQ",
		test_timing_cycles_to_ns_avg(et, NR_OF_MSGQ_RUNS));

	start = timing_timestamp_get();
	for (i = 0; i < NR_OF_MSGQ_RUNS; i++) {
		k_msgq_put(&DEMOQX192, data_bench, K_FOREVER);
	}
	end = timing_timestamp_get();
	et = timing_cycles_get(&start, &end);

	PRINT_F(FORMAT, "enqueue 192 bytes msg in MSGQ",
		test_timing_cycles_to_ns_avg(et, NR_OF_MSGQ_RUNS));

	start = timing_timestamp_get();
	for (i = 0; i < NR_OF_MSGQ_RUNS; i++) {
		k_msgq_get(&DEMOQX192, data_bench, K_FOREVER);
	}
	end = timing_timestamp_get();
	et = timing_cycles_get(&start, &end);

	PRINT_F(FORMAT, "dequeue 192 bytes msg in MSGQ",
		test_timing_cycles_to_ns_avg(et, NR_OF_MSGQ_RUNS));

	k_sem_give(&STARTRCV);

	start = timing_timestamp_get();
	for (i = 0; i < NR_OF_MSGQ_RUNS; i++) {
		k_msgq_put(&DEMOQX1, data_bench, K_FOREVER);
	}
	end = timing_timestamp_get();
	et = timing_cycles_get(&start, &end);

	PRINT_F(FORMAT,
		"enqueue 1 byte msg in MSGQ to a waiting higher priority task",
		test_timing_cycles_to_ns_avg(et, NR_OF_MSGQ_RUNS));

	start = timing_timestamp_get();
	for (i = 0; i < NR_OF_MSGQ_RUNS; i++) {
		k_msgq_put(&DEMOQX4, data_bench, K_FOREVER);
	}
	end = timing_timestamp_get();
	et = timing_cycles_get(&start, &end);

	PRINT_F(FORMAT,
		"enqueue 4 bytes in MSGQ to a waiting higher priority task",
		test_timing_cycles_to_ns_avg(et, NR_OF_MSGQ_RUNS));

	start = timing_timestamp_get();
	for (i = 0; i < NR_OF_MSGQ_RUNS; i++) {
		k_msgq_put(&DEMOQX192, data_bench, K_FOREVER);
	}
	end = timing_timestamp_get();
	et = timing_cycles_get(&start, &end);

	PRINT_F(FORMAT,
		"enqueue 192 bytes in MSGQ to a waiting higher priority task",
		test_timing_cycles_to_ns_avg(et, NR_OF_MSGQ_RUNS));
}
```
