## CMakeLists.txt
```
# SPDX-FileCopyrightText: Copyright The Zephyr Project Contributors
# SPDX-License-Identifier: Apache-2.0

cmake_minimum_required(VERSION 3.28.0)
find_package(Zephyr REQUIRED HINTS $ENV{ZEPHYR_BASE})
project(interrupt_latency)

target_sources(app PRIVATE
  src/benchmarks.c
)

target_sources_ifdef(CONFIG_INT_BENCH_TRIGGER_SW_IRQ app PRIVATE src/trigger_sw_irq.c)
target_sources_ifdef(CONFIG_INT_BENCH_TRIGGER_OFFLOAD app PRIVATE src/trigger_offload.c)
```

## Kconfig
```
# SPDX-FileCopyrightText: Copyright The Zephyr Project Contributors
# SPDX-License-Identifier: Apache-2.0

mainmenu "Interrupt Handling Benchmark"

menu "Interrupt benchmark options"

config INT_BENCH_NUM_ITERATIONS
	int "Number of iterations per scenario"
	default 1000
	help
	  Number of samples collected for each measured scenario. Larger
	  values give more stable statistics at the cost of runtime.

choice INT_BENCH_TRIGGER
	prompt "Interrupt trigger backend"
	default INT_BENCH_TRIGGER_SW_IRQ if CPU_CORTEX_M || GIC || ARC || X86 || \
		(RISCV && !SMP && !RISCV_S_MODE)
	default INT_BENCH_TRIGGER_OFFLOAD

config INT_BENCH_TRIGGER_SW_IRQ
	bool "Software-triggered hardware interrupt"
	depends on CPU_CORTEX_M || GIC || ARC || X86 || \
		(RISCV && !SMP && !RISCV_S_MODE)
	help
	  Raise a real asynchronous interrupt through the platform
	  interrupt controller (NVIC STIR/ISPR on Cortex-M, a GIC SGI on
	  Arm GIC platforms, IRQ_HINT on ARC, a local APIC self IPI on
	  x86, and a CLIC pending bit or a CLINT machine software
	  interrupt on RISC-V). This exercises the full hardware
	  interrupt entry path and is required for the entry latency,
	  critical section and throughput scenarios.

	  Not available in RISC-V supervisor mode: both the CLINT and
	  mhartid are machine mode only.

config INT_BENCH_TRIGGER_OFFLOAD
	bool "irq_offload() software trap"
	depends on IRQ_OFFLOAD
	help
	  Run the benchmark ISRs synchronously via irq_offload(). This
	  works on every architecture but does not go through the
	  interrupt controller: only the interrupt *exit* paths are
	  measured. Entry latency numbers are not available with this
	  backend.

endchoice

config INT_BENCH_IRQ_LINE
	int "IRQ line used by the benchmark (-1 = auto-select)"
	depends on INT_BENCH_TRIGGER_SW_IRQ
	default -1
	help
	  IRQ line the benchmark connects its ISR to and then triggers
	  from software. The default of -1 selects a platform-appropriate
	  line automatically: an SGI on GIC platforms, the machine
	  software interrupt on RISC-V platforms without a CLIC, a line
	  known to be free on selected QEMU boards and on x86, and the
	  last available line (CONFIG_NUM_IRQS - 1) otherwise. Override
	  this on SoCs where the automatic choice is not an implemented
	  or free line.

config INT_BENCH_IRQ_LINE_ALT
	int "Second IRQ line used by the benchmark (-1 = auto-select)"
	depends on INT_BENCH_TRIGGER_SW_IRQ
	default -1
	help
	  Scenarios that compare how an interrupt is connected need a
	  second line, because the connection method is fixed at build
	  time. Selected the same way as CONFIG_INT_BENCH_IRQ_LINE, one
	  line below it where that is derived from CONFIG_NUM_IRQS.

config INT_BENCH_IRQ_PRIO
	int "Priority of the benchmark IRQ"
	depends on INT_BENCH_TRIGGER_SW_IRQ
	# On Arm GIC the priority is a raw eight bit value of which only
	# the upper bits select the preemption group, so a line at
	# priority 1 cannot be preempted by one at priority 0: they share
	# a group. Use the platform default, which is both representative
	# and far enough from the top for the second line to outrank it.
	default 160 if GIC
	default 1
	help
	  Interrupt priority for the benchmark IRQ line, using the same
	  convention as the priority argument of IRQ_CONNECT() on the
	  target architecture.

config INT_BENCH_IRQ_PRIO_ALT
	int "Priority of the second benchmark IRQ"
	depends on INT_BENCH_TRIGGER_SW_IRQ
	# Zero-latency interrupts have to sit within the levels reserved
	# for them, and the nested scenario needs to outrank the first
	# line. Everything else wants the two lines at equal priority, so
	# that comparing them measures only how they are connected.
	default 0 if INT_BENCH_SCENARIO_ZLI
	default 0 if INT_BENCH_SCENARIO_NESTED
	default INT_BENCH_IRQ_PRIO
	help
	  Interrupt priority for the second benchmark IRQ line, in the
	  same convention as CONFIG_INT_BENCH_IRQ_PRIO.

	  The default matches the first line, so that the entry latency
	  of the two can be compared without the priority differing as
	  well. The nested and zero-latency scenarios override it because
	  they are about the second line outranking the first.

config INT_BENCH_LOCK_HOLD_US
	int "Critical section hold time (microseconds)"
	depends on INT_BENCH_SCENARIO_LOCKED
	default 10
	help
	  How long the critical section scenario keeps interrupts locked
	  with the benchmark interrupt pending before unlocking and
	  measuring the unlock-to-ISR-entry latency.

menuconfig INT_BENCH_LOAD
	bool "Run the scenarios under background system load"
	help
	  Interrupt latency measured on an otherwise idle system is a
	  best case: caches hold the benchmark's own working set, no
	  other interrupt is in service and nothing else competes for the
	  memory system. Enable background load so that the reported
	  maximum and standard deviation describe something closer to
	  what an application will see. The individual load sources are
	  selected below.

if INT_BENCH_LOAD

config INT_BENCH_LOAD_CACHE
	bool "Evict caches between samples"
	default y
	help
	  Walk a working set larger than the benchmark's own between
	  samples, outside the measured span, so that each measured
	  interrupt is served with cold caches and TLBs. Runs in the
	  benchmark thread and therefore affects every scenario on every
	  platform.

config INT_BENCH_LOAD_CACHE_KB
	int "Working set size (KB)"
	depends on INT_BENCH_LOAD_CACHE
	default 8
	help
	  Size of the buffer walked between samples. To be effective this
	  should exceed the size of the last level cache; to be usable it
	  has to fit in RAM alongside the benchmark.

config INT_BENCH_LOAD_TIMER
	bool "Competing periodic timer interrupts"
	default y
	help
	  Run a periodic timer whose handler executes in the system clock
	  ISR, so that it competes with the benchmark interrupt for the
	  interrupt controller and for the interrupt-disabled windows of
	  the kernel timeout code. Affects every platform.

config INT_BENCH_LOAD_TIMER_PERIOD_US
	int "Timer load period (microseconds)"
	depends on INT_BENCH_LOAD_TIMER
	default 1000
	help
	  Period of the competing timer. Values below the tick period of
	  the system clock are rounded up, so raise
	  CONFIG_SYS_CLOCK_TICKS_PER_SEC accordingly.

config INT_BENCH_LOAD_KERNEL
	bool "Kernel activity from interrupt context"
	depends on INT_BENCH_LOAD_TIMER
	default y
	help
	  Have the load timer handler exercise kernel primitives from
	  interrupt context, so that the benchmark interrupt competes
	  with the interrupt-disabled windows the kernel takes around its
	  own data structures rather than only with an empty handler.

	  Runs in the system clock ISR, so unlike a thread it takes
	  effect regardless of priorities and on uniprocessors too.

config INT_BENCH_LOAD_SCHED
	bool "Scheduler churn between samples"
	default y
	help
	  Wake a higher priority thread and let it block again before
	  each sample, so that every measurement is taken on a system
	  that has just context switched rather than one that has been
	  spinning in the same thread.

	  The churn happens between samples rather than during them on
	  purpose. A thread that could preempt the benchmark while it is
	  measuring would add its own scheduling delay to the result and
	  be indistinguishable from interrupt latency.

config INT_BENCH_LOAD_THREADS
	bool "Background CPU and memory load threads"
	default y
	help
	  Run threads of lower priority than the benchmark that
	  continuously write to memory. On SMP these run on the other
	  CPUs and contend for the memory system throughout. On a
	  uniprocessor they only run while the benchmark blocks, so their
	  effect is limited to the rescheduling scenario.

config INT_BENCH_LOAD_NUM_THREADS
	int "Number of background load threads"
	depends on INT_BENCH_LOAD_THREADS
	default 2
	help
	  On SMP this should be at least the number of CPUs other than
	  the one running the benchmark.

endif # INT_BENCH_LOAD

config INT_BENCH_ISR_IN_RAM
	bool "Place the benchmark ISR in RAM"
	depends on ARCH_HAS_RAMFUNC_SUPPORT
	depends on XIP
	help
	  Relocate the benchmark's interrupt handlers to RAM with
	  __ramfunc, so that comparing a run against one built without
	  this option shows what fetching the handler from flash costs.

	  Only the benchmark's own handlers move. The vector table and
	  the architecture's interrupt entry code stay where the build
	  put them, so the difference is a lower bound on what fully
	  relocating the interrupt path would save.

config INT_BENCH_OUTLIER_TRACE
	bool "Report what coincided with outlying samples"
	help
	  Print a line for each sample far above the smallest one seen,
	  naming what else the system did while it was being taken: how
	  many clock ticks were announced and how many times the load
	  timer ran. An outlier that coincides with neither was caused by
	  something the benchmark cannot see, such as the memory system
	  or a debug probe.

	  The witnesses are read once per sample, outside the measured
	  span, so this changes the steady state slightly and is meant
	  for diagnosis rather than for the numbers to be quoted.

config INT_BENCH_OUTLIER_FACTOR
	int "How far above the minimum counts as an outlier"
	depends on INT_BENCH_OUTLIER_TRACE
	default 4
	help
	  A sample is reported when it exceeds this many times the
	  smallest sample seen so far in the same benchmark.

config INT_BENCH_OUTLIER_LIMIT
	int "Maximum outliers reported per benchmark"
	depends on INT_BENCH_OUTLIER_TRACE
	default 8
	help
	  Printing perturbs the samples that follow, so stop after this
	  many. The count of the rest is still reported.

comment "Scenarios"

config INT_BENCH_SCENARIO_ENTRY
	bool "Interrupt entry latency"
	depends on INT_BENCH_TRIGGER_SW_IRQ
	default y
	help
	  Measure the time from the software trigger of a hardware
	  interrupt to the first instruction of its ISR.

config INT_BENCH_SCENARIO_EXIT
	bool "Interrupt exit latency"
	default y
	help
	  Measure the time from the end of the ISR body back to the
	  interrupted thread, and the time from the end of an ISR that
	  wakes a higher priority thread to that thread running.

config INT_BENCH_SCENARIO_END_TO_END
	bool "Interrupt to awakened thread latency"
	depends on INT_BENCH_TRIGGER_SW_IRQ
	default y
	help
	  Measure the whole path an application waits on, from raising
	  the interrupt to the high priority thread it wakes running.

	  The entry and exit scenarios measure the pieces of this span,
	  but they cannot be added together: they are measured in
	  separate runs and neither covers the ISR body or the handoff
	  between them.

config INT_BENCH_SCENARIO_LOCKED
	bool "Entry latency after a critical section"
	depends on INT_BENCH_TRIGGER_SW_IRQ
	# ARC raises a software interrupt by writing the line number to
	# the single IRQ_HINT register, and the system timer writes that
	# same register from sys_clock_cycle_get_32() whenever it finds
	# the timer already expired. The hold below busy waits on that
	# function with interrupts locked, so the timer takes the
	# register over from the benchmark and the two then fight for it
	# for as long as the timer stays behind.
	depends on !ARC
	default y
	help
	  Trigger the benchmark interrupt while interrupts are locked,
	  hold the lock for a configurable window, then measure the time
	  from irq_unlock() to ISR entry. This approximates the latency
	  an interrupt experiences when it arrives during a kernel or
	  application critical section.

	  Not available on ARC, where the benchmark trigger and the
	  system timer share one hardware register.

config INT_BENCH_SCENARIO_DYNAMIC
	bool "Dynamic interrupt connect cost"
	depends on INT_BENCH_TRIGGER_SW_IRQ
	depends on DYNAMIC_INTERRUPTS
	depends on !SHARED_INTERRUPTS
	# On x86, arch_irq_connect_dynamic() is a one shot allocation
	# rather than a rebindable install: it allocates a new IDT vector
	# and consumes an entry from a fixed pool of interrupt stubs on
	# every call, and asserts that the line is not already
	# configured. Repeatedly connecting the same line to gather
	# samples exhausts that pool.
	depends on !X86
	default y
	help
	  Measure the cost of installing an ISR at runtime with
	  irq_connect_dynamic(), by repeatedly reinstalling the handler
	  on the benchmark IRQ line. This requires the architecture to
	  support rebinding a line that is already connected.

config INT_BENCH_SCENARIO_MASKING
	bool "Delay inflicted on a periodic interrupt"
	# Two samples are taken per tick, so the tick has to be frequent
	# enough both to sample the windows of interest and to finish in
	# reasonable time. The base configuration runs far slower than
	# that; the load overlay raises it to 1000.
	depends on SYS_CLOCK_TICKS_PER_SEC >= 1000
	default y
	help
	  Run a periodic timer at the tick rate while exercising kernel
	  primitives, and measure how much later than its period each
	  timer interrupt is actually served. This is the delay an
	  application sees when the kernel or a driver masks interrupts.

	  This is a sampling technique and cannot attribute the delay: a
	  masked window that does not overlap a tick is never seen, and
	  the measured delay also contains time spent in interrupts
	  served earlier. The maximum is a sampled lower bound on the
	  longest interrupt-disabled window, not proof of one.

config INT_BENCH_MASK_INJECT_US
	int "Inject a known interrupt-disabled window (microseconds)"
	depends on INT_BENCH_SCENARIO_MASKING
	default 0
	help
	  Mask interrupts for this long inside the scenario's work loop,
	  to check on a new platform that the measurement responds to a
	  known window. Keep the value well below the tick period: a
	  window comparable to it masks nearly continuously, and the
	  timer then re-anchors to when it was last serviced, so the
	  measured delay falls short of the injected one. Zero measures
	  only the windows the kernel creates by itself.

choice INT_BENCH_ALT_LINE_USE
	prompt "Use of the second benchmark IRQ line"
	depends on INT_BENCH_TRIGGER_SW_IRQ
	default INT_BENCH_SCENARIO_DIRECT if CPU_CORTEX_M || ARC || (X86 && !X86_64)
	default INT_BENCH_SCENARIO_NESTED if GIC
	default INT_BENCH_ALT_LINE_NONE
	help
	  How an interrupt is connected and what priority it runs at are
	  both fixed at build time, so the scenarios that need a second
	  line cannot share one. Pick the one to build.

config INT_BENCH_SCENARIO_DIRECT
	bool "Direct ISR entry latency"
	# Needs both a second triggerable line and IRQ_DIRECT_CONNECT().
	# There is no capability symbol for the latter, so the
	# architectures that implement ARCH_ISR_DIRECT_DECLARE() are
	# listed explicitly: Arm64 has no direct interrupts, x86 has them
	# only on IA32, and RISC-V without a CLIC has only the one
	# interrupt a hart can raise on itself.
	depends on CPU_CORTEX_M || ARC || (X86 && !X86_64)
	help
	  Measure entry latency for an interrupt connected with
	  IRQ_DIRECT_CONNECT(), which is dispatched straight from the
	  vector table instead of through the software ISR table. The
	  line runs at the same priority as the first one, so comparing
	  the two measures only the dispatch.

config INT_BENCH_SCENARIO_ZLI
	bool "Zero-latency interrupt"
	depends on ZERO_LATENCY_IRQS
	help
	  Connect the second line as a zero-latency interrupt and measure
	  it both with interrupts enabled and from inside a critical
	  section. A zero-latency interrupt is not masked by irq_lock(),
	  so it is served during the critical section rather than after
	  it, which the regular critical section scenario can be compared
	  against.

	  The priority difference is inherent here: a zero-latency
	  interrupt is one that runs above the level the kernel masks.

config INT_BENCH_SCENARIO_NESTED
	bool "Nested interrupt preemption latency"
	# Same set of platforms whose nesting behaviour
	# tests/arch/common/interrupt exercises.
	depends on CPU_CORTEX_M || ARC || GIC
	help
	  Raise the second, higher priority interrupt from inside the
	  first one's ISR and measure how long it takes to preempt it.
	  This is the latency a high priority interrupt suffers when a
	  lower priority one is already being serviced, which for an
	  interrupt-heavy application is often the dominant term.

config INT_BENCH_ALT_LINE_NONE
	bool "Unused"
	help
	  Leave the second line alone. This is the only option on
	  platforms that have no second line to trigger.

endchoice

config INT_BENCH_SCENARIO_THROUGHPUT
	bool "Sustained interrupt round-trip cost"
	depends on INT_BENCH_TRIGGER_SW_IRQ
	default y
	help
	  Re-trigger the benchmark interrupt from within its own ISR so
	  interrupts are serviced back to back, and report the average
	  cost of one full entry + ISR + exit round trip. The inverse of
	  this number is the maximum sustainable interrupt rate.

endmenu

config SYS_CLOCK_TICKS_PER_SEC
	int "Number of ticks per second"
	default 20 if SOC_FAMILY_STM32
	default 100
	help
	  A low tick rate keeps timer interrupts out of the measurements,
	  but it cannot be lowered without limit: a tick has to be
	  expressible in the timer's counter. A Cortex-M SysTick counter
	  is 24 bits, so a tick longer than 16777215 cycles cannot be
	  programmed, and the driver then falls back to its minimum delay
	  of ten microseconds and interrupts continuously.

	  The default of 100 is representable on any core up to 1.6GHz.
	  Combined with a tickless kernel it is also quiet: with nothing
	  scheduled the driver programs as far ahead as the counter
	  allows, which on a 150MHz part is 110ms.

source "Kconfig.zephyr"
```

## prj.conf
```kconfig
# SPDX-FileCopyrightText: Copyright The Zephyr Project Contributors
# SPDX-License-Identifier: Apache-2.0

CONFIG_ZTEST=y
CONFIG_ZTEST_BENCHMARK=y
CONFIG_ZTEST_BENCHMARK_OUTPUT_CSV=y
CONFIG_ASSERT=n

# Fallback trigger backend for architectures without a sw-irq trigger
CONFIG_IRQ_OFFLOAD=y

# Every scenario measures one core: the trigger raises the interrupt on
# whichever CPU the benchmark thread is running on, and each measured
# span starts and ends there. Left multi-core, the thread migrates and
# the interrupt is raised on a CPU that never enabled the line, since
# enabling an SGI or a software interrupt is per-CPU, so the trigger is
# simply lost.
CONFIG_MP_MAX_NUM_CPUS=1

# Reduce measurement noise
CONFIG_FORCE_NO_ASSERT=y
CONFIG_TEST_HW_STACK_PROTECTION=n
CONFIG_HW_STACK_PROTECTION=n
CONFIG_COVERAGE=n
CONFIG_PM=n
CONFIG_TIMESLICING=n
CONFIG_BT=n
```

## prj.load.conf
```kconfig
# SPDX-FileCopyrightText: Copyright The Zephyr Project Contributors
# SPDX-License-Identifier: Apache-2.0
#
# Run the benchmark scenarios under background system load. Use with
# EXTRA_CONF_FILE="prj.load.conf".

CONFIG_INT_BENCH_LOAD=y
CONFIG_ASSERT=n

# The base configuration keeps the tick rate low to keep timer
# interrupts out of the measurements. Under load the
# competing timer is part of the point, so give the system clock a
# resolution the load period can actually use. Kept moderate so that
# the benchmark stays practical on slow emulated targets.
CONFIG_SYS_CLOCK_TICKS_PER_SEC=1000
```

## prj.nested.conf
```kconfig
# SPDX-FileCopyrightText: Copyright The Zephyr Project Contributors
# SPDX-License-Identifier: Apache-2.0
#
# Use the second IRQ line for the nested preemption scenario instead of
# the direct ISR comparison; the two need the line at different
# priorities, so only one can be built at a time. Use with
# EXTRA_CONF_FILE="prj.nested.conf".

CONFIG_INT_BENCH_SCENARIO_NESTED=y
```

## prj.ramfunc.conf
```kconfig
# SPDX-FileCopyrightText: Copyright The Zephyr Project Contributors
# SPDX-License-Identifier: Apache-2.0
#
# Relocate the benchmark's interrupt handlers to RAM, so that the run
# can be compared against one built without this overlay to see what
# fetching them from flash costs. Use with
# EXTRA_CONF_FILE="prj.ramfunc.conf".

CONFIG_INT_BENCH_ISR_IN_RAM=y
```

## prj.zli.conf
```kconfig
# SPDX-FileCopyrightText: Copyright The Zephyr Project Contributors
# SPDX-License-Identifier: Apache-2.0
#
# Measure a zero-latency interrupt instead of a directly connected one;
# the two scenarios share the second IRQ line. Cortex-M only. Use with
# EXTRA_CONF_FILE="prj.zli.conf".

CONFIG_ZERO_LATENCY_IRQS=y
CONFIG_INT_BENCH_SCENARIO_ZLI=y
```

## src/benchmarks.c
```c
/*
 * SPDX-FileCopyrightText: Copyright The Zephyr Project Contributors
 * SPDX-License-Identifier: Apache-2.0
 */

/*
 * Interrupt handling benchmarks, built on the ztest benchmark
 * framework. All scenarios are manually sampled benchmarks
 * (ZTEST_BENCHMARK_MANUAL) because their measured spans have endpoints
 * captured in different execution contexts (thread vs ISR), which
 * framework-timed benchmarks cannot express.
 *
 * The suite and all benchmarks live in one translation unit because
 * ZTEST_BENCHMARK_SUITE() defines the suite object static; individual
 * scenarios are selected with the CONFIG_INT_BENCH_SCENARIO_* options.
 */

#include <zephyr/kernel.h>
#include <zephyr/ztest.h>
#include <zephyr/irq.h>
#include <zephyr/timing/timing.h>

#include "load.h"
#include "trigger.h"

#define NUM_ITERATIONS CONFIG_INT_BENCH_NUM_ITERATIONS

#if defined(CONFIG_INT_BENCH_SCENARIO_DIRECT) || defined(CONFIG_INT_BENCH_SCENARIO_ZLI) || \
	defined(CONFIG_INT_BENCH_SCENARIO_NESTED)
#define BENCH_ALT_LINE_USED 1
static volatile bool alt_fired;
#endif

#if defined(CONFIG_INT_BENCH_SCENARIO_DIRECT) || defined(CONFIG_INT_BENCH_SCENARIO_ZLI)
#define BENCH_ALT_LINE_DIRECT 1

/*
 * Dispatched straight from the vector table: no software ISR table
 * lookup and none of the common entry code that wraps a regular ISR.
 * Returning zero tells the architecture layer that no reschedule is
 * needed, which keeps the exit path out of the measurement.
 */
ISR_DIRECT_DECLARE(bench_alt_isr)
{
	ztest_benchmark_end();
	alt_fired = true;

	return 0;
}
#elif defined(BENCH_ALT_LINE_USED)
static void bench_alt_regular_isr(const void *arg)
{
	ARG_UNUSED(arg);

	ztest_benchmark_end();
	alt_fired = true;
}
#endif

static void suite_setup(void)
{
#ifdef CONFIG_INT_BENCH_TRIGGER_SW_IRQ
	printk("Interrupt benchmark: trigger=sw-irq (line %u), %u iterations\n",
	       bench_trigger_irq_line(), NUM_ITERATIONS);
#else
	printk("Interrupt benchmark: trigger=irq_offload, %u iterations\n"
	       "No sw-irq trigger for this architecture: only the exit path\n"
	       "scenarios run (entry latency, critical section, throughput\n"
	       "and dynamic connect need a real asynchronous interrupt)\n",
	       NUM_ITERATIONS);
#endif

	(void)bench_trigger_init();

#ifdef CONFIG_INT_BENCH_SCENARIO_DIRECT
	IRQ_DIRECT_CONNECT(BENCH_IRQ_LINE_ALT, CONFIG_INT_BENCH_IRQ_PRIO_ALT, bench_alt_isr, 0);
	irq_enable(BENCH_IRQ_LINE_ALT);
#endif
#if defined(BENCH_ALT_LINE_USED) && !defined(BENCH_ALT_LINE_DIRECT)
	/*
	 * Nothing claimed the line as a direct or zero-latency
	 * interrupt, so connect it the ordinary way. This is the only
	 * option on platforms without direct interrupts.
	 */
	IRQ_CONNECT(BENCH_IRQ_LINE_ALT, CONFIG_INT_BENCH_IRQ_PRIO_ALT, bench_alt_regular_isr,
		    NULL, 0);
	irq_enable(BENCH_IRQ_LINE_ALT);
#endif
#ifdef CONFIG_INT_BENCH_SCENARIO_ZLI
	/*
	 * Zero-latency interrupts have to be registered with
	 * IRQ_DIRECT_CONNECT(), and at a priority within the levels
	 * reserved for them.
	 */
	IRQ_DIRECT_CONNECT(BENCH_IRQ_LINE_ALT, 0, bench_alt_isr, IRQ_ZERO_LATENCY);
	irq_enable(BENCH_IRQ_LINE_ALT);
#endif

	printk("Background load: %s\n", bench_load_description());
	bench_load_start();
}

static void suite_teardown(void)
{
	bench_load_stop();
}

ZTEST_BENCHMARK_SUITE(interrupt, suite_setup, suite_teardown);

#if defined(CONFIG_INT_BENCH_SCENARIO_ENTRY) || defined(CONFIG_INT_BENCH_SCENARIO_EXIT) || \
	defined(CONFIG_INT_BENCH_SCENARIO_LOCKED)
static volatile bool fired;
#endif

#if defined(CONFIG_INT_BENCH_SCENARIO_ENTRY) || defined(CONFIG_INT_BENCH_SCENARIO_LOCKED)
/* Timestamp as early as possible in the ISR: measures the entry path */
static void entry_handler(void)
{
	ztest_benchmark_end();
	fired = true;
}
#endif

#ifdef CONFIG_INT_BENCH_SCENARIO_ENTRY
/*
 * Interrupt entry latency: time from the software write that raises
 * the interrupt to the first timestamp taken inside the ISR. Requires
 * the sw-irq trigger backend (a real asynchronous interrupt).
 */
static void entry_setup(void)
{
	bench_trigger_set_handler(entry_handler);
}

static void entry_teardown(void)
{
	bench_trigger_set_handler(NULL);
}

ZTEST_BENCHMARK_MANUAL(interrupt, entry_trigger_to_isr, NUM_ITERATIONS, entry_setup,
		       entry_teardown)
{
	fired = false;
	bench_load_churn();
	bench_load_pollute();

	ztest_benchmark_start();
	bench_trigger();

	while (!fired) {
	}
}
#endif /* CONFIG_INT_BENCH_SCENARIO_ENTRY */

#if defined(CONFIG_INT_BENCH_SCENARIO_EXIT) || defined(CONFIG_INT_BENCH_SCENARIO_END_TO_END)
#define WAITER_STACK_SIZE (1024 + CONFIG_TEST_EXTRA_STACK_SIZE)

static K_SEM_DEFINE(wake_sem, 0, 1);
static K_SEM_DEFINE(sync_sem, 0, 1);
static K_THREAD_STACK_DEFINE(waiter_stack, WAITER_STACK_SIZE);
static struct k_thread waiter_thread;
#endif

#ifdef CONFIG_INT_BENCH_SCENARIO_EXIT
/* Timestamp as the last operation in the ISR: measures the exit path */
static void exit_handler(void)
{
	fired = true;
	ztest_benchmark_start();
}

/*
 * Interrupt exit latency: time from the last instruction of the ISR
 * body back to the interrupted thread. Works with both trigger
 * backends; with irq_offload() it measures the offload trap exit path.
 */
static void exit_setup(void)
{
	bench_trigger_set_handler(exit_handler);
}

static void exit_teardown(void)
{
	bench_trigger_set_handler(NULL);
}

ZTEST_BENCHMARK_MANUAL(interrupt, exit_resume_interrupted, NUM_ITERATIONS, exit_setup,
		       exit_teardown)
{
	fired = false;
	bench_load_churn();
	bench_load_pollute();

	bench_trigger();

	while (!fired) {
	}

	ztest_benchmark_end();
}

static void resched_handler(void)
{
	k_sem_give(&wake_sem);
	ztest_benchmark_start();
}


static void waiter_entry(void *p1, void *p2, void *p3)
{
	ARG_UNUSED(p1);
	ARG_UNUSED(p2);
	ARG_UNUSED(p3);

	k_sem_take(&wake_sem, K_FOREVER);
	ztest_benchmark_end();
	k_sem_give(&sync_sem);
}

/*
 * Interrupt exit with rescheduling: time from the last instruction of
 * an ISR that wakes a higher priority thread to that thread running
 * (interrupt exit plus context switch).
 */
static void resched_setup(void)
{
	int priority = k_thread_priority_get(k_current_get());

	bench_trigger_set_handler(resched_handler);

	k_thread_create(&waiter_thread, waiter_stack, K_THREAD_STACK_SIZEOF(waiter_stack),
			waiter_entry, NULL, NULL, NULL, priority - 1, 0, K_NO_WAIT);
}

static void resched_teardown(void)
{
	(void)k_thread_join(&waiter_thread, K_FOREVER);
	bench_trigger_set_handler(NULL);
}

ZTEST_BENCHMARK_MANUAL(interrupt, exit_reschedule, NUM_ITERATIONS, resched_setup,
		       resched_teardown)
{
	bench_load_churn();
	bench_load_pollute();

	bench_trigger();
	k_sem_take(&sync_sem, K_FOREVER);


}
#endif /* CONFIG_INT_BENCH_SCENARIO_EXIT */

#ifdef CONFIG_INT_BENCH_SCENARIO_LOCKED
/*
 * Entry latency after a critical section: the interrupt is raised
 * while interrupts are locked, kept pending for
 * CONFIG_INT_BENCH_LOCK_HOLD_US, then the time from irq_unlock() to
 * ISR entry is measured. Requires the sw-irq trigger backend.
 */
static void locked_setup(void)
{
	bench_trigger_set_handler(entry_handler);
}

static void locked_teardown(void)
{
	bench_trigger_set_handler(NULL);
}

ZTEST_BENCHMARK_MANUAL(interrupt, locked_unlock_to_isr, NUM_ITERATIONS, locked_setup,
		       locked_teardown)
{
	unsigned int key;

	fired = false;
	bench_load_churn();

	key = irq_lock();

	bench_trigger();
	k_busy_wait(CONFIG_INT_BENCH_LOCK_HOLD_US);

	/*
	 * Pollute from inside the critical section, so that the
	 * interrupt is unmasked with the caches in the state a critical
	 * section doing real work would leave them in. This lengthens
	 * the hold time beyond the configured value. Only the cache load
	 * runs here: the kernel and scheduler churn make kernel calls,
	 * which is not valid with interrupts locked, so they ran before
	 * the lock was taken.
	 */
	bench_load_pollute();

	ztest_benchmark_start();
	irq_unlock(key);

	while (!fired) {
	}
}
#endif /* CONFIG_INT_BENCH_SCENARIO_LOCKED */

#ifdef CONFIG_INT_BENCH_SCENARIO_THROUGHPUT
static volatile bool done;
static volatile uint32_t isr_count;

/*
 * Re-trigger from the top of the handler, so the next interrupt is
 * already pending while this one is still being serviced, and
 * timestamp the entry of both.
 */
static void throughput_handler(void)
{
	if (isr_count == 0U) {
		ztest_benchmark_start();
		isr_count = 1U;
		bench_trigger();
	} else {
		ztest_benchmark_end();
		done = true;
	}
}

static void throughput_setup(void)
{
	bench_trigger_set_handler(throughput_handler);
}

static void throughput_teardown(void)
{
	bench_trigger_set_handler(NULL);
}

/*
 * Sustained interrupt round-trip cost. The span runs from the entry of
 * one interrupt to the entry of the next, with the next already pending
 * throughout, so it covers the handler body, the exit path and the
 * entry path back to back (tail-chained where the hardware supports
 * it). Its inverse is the maximum sustainable interrupt rate. Requires
 * the sw-irq backend.
 */
ZTEST_BENCHMARK_MANUAL(interrupt, throughput_round_trip, NUM_ITERATIONS, throughput_setup,
		       throughput_teardown)
{
	isr_count = 0U;
	done = false;
	bench_load_churn();
	bench_load_pollute();

	bench_trigger();

	while (!done) {
	}


}
#endif /* CONFIG_INT_BENCH_SCENARIO_THROUGHPUT */

#ifdef CONFIG_INT_BENCH_SCENARIO_DYNAMIC
/*
 * Cost of installing an interrupt handler at runtime with
 * irq_connect_dynamic(). The line is disabled while the handler is
 * (re)installed because z_isr_install() requires the line to be
 * disabled on most architectures.
 */
static void dynamic_setup(void)
{
	irq_disable(bench_trigger_irq_line());
}

static void dynamic_teardown(void)
{
	irq_enable(bench_trigger_irq_line());
}

ZTEST_BENCHMARK_MANUAL(interrupt, dynamic_connect, NUM_ITERATIONS, dynamic_setup,
		       dynamic_teardown)
{
	unsigned int line = bench_trigger_irq_line();

	bench_load_churn();
	bench_load_pollute();

	ztest_benchmark_start();
	(void)irq_connect_dynamic(line, CONFIG_INT_BENCH_IRQ_PRIO, bench_trigger_isr, NULL, 0);
	ztest_benchmark_end();
}
#endif /* CONFIG_INT_BENCH_SCENARIO_DYNAMIC */

#ifdef CONFIG_INT_BENCH_SCENARIO_MASKING
/*
 * How long the system keeps interrupts masked is a property of the
 * kernel and its drivers rather than something the benchmark can
 * trigger, and Zephyr does not instrument irq_lock() windows, so
 * measure it by its effect: arm a one-shot timer for one tick, keep
 * the kernel busy taking spinlocks until it fires, and measure from
 * arming it to the first instruction of its ISR.
 *
 * The span is one nominal tick plus whatever delay the ISR suffered,
 * so the distribution reads directly: the median is the undelayed
 * period, and everything above it is delay that masking inflicted.
 * Reporting the interval rather than a delay computed against an
 * assumed period avoids having to know the counter frequency, which
 * timing_freq_get() does not report correctly on every platform.
 *
 * The number is the worst delay a periodic real-time event was
 * actually made to suffer, not the longest irq_lock() in the tree: a
 * window that does not overlap a tick boundary is never seen, and the
 * delay also contains time spent in interrupts served first.
 * CONFIG_INT_BENCH_MASK_INJECT_US masks for a known time so the
 * measurement can be checked on a new platform.
 */
static K_SEM_DEFINE(mask_sem, 0, 1);
static K_MUTEX_DEFINE(mask_mutex);

static volatile uint32_t mask_seq;

/*
 * The span is the interval between two expiries, so the first one opens
 * it and the second closes it. Both hooks are safe here: they only take
 * a timestamp, and the framework turns the span into a sample once the
 * body has returned to thread context.
 */
static void mask_timer_handler(struct k_timer *timer)
{
	ARG_UNUSED(timer);

	if (mask_seq == 0U) {
		ztest_benchmark_start();
	} else if (mask_seq == 1U) {
		ztest_benchmark_end();
	}

	mask_seq++;
}

static K_TIMER_DEFINE(mask_timer, mask_timer_handler, NULL);

/* Kernel primitives that take spinlocks, and so mask interrupts */
static void mask_kernel_work(void)
{
	k_sem_give(&mask_sem);
	(void)k_sem_take(&mask_sem, K_NO_WAIT);
	(void)k_mutex_lock(&mask_mutex, K_NO_WAIT);
	(void)k_mutex_unlock(&mask_mutex);
	(void)k_uptime_get();
}

static void mask_setup(void)
{
	mask_seq = 0U;
	k_timer_start(&mask_timer, K_TICKS(1), K_TICKS(1));
}

static void mask_teardown(void)
{
	k_timer_stop(&mask_timer);
}

ZTEST_BENCHMARK_MANUAL(interrupt, periodic_isr_interval, NUM_ITERATIONS, mask_setup,
		       mask_teardown)
{
	int64_t deadline;

	/*
	 * Two expiries, so the span runs between consecutive periods of
	 * a running periodic timer rather than from an arbitrary arming
	 * point to the next tick boundary, which would carry up to a
	 * whole tick of phase noise. Each sample therefore costs two
	 * ticks, which is why this scenario needs the tick rate the load
	 * overlay configures rather than the much slower one the base
	 * configuration runs at.
	 *
	 * Give up rather than spin forever where the timer does not
	 * deliver at the tick rate at all, which under emulation can
	 * otherwise cost minutes of wall clock. Recording no sample
	 * leaves the benchmark inconclusive, which is the honest
	 * outcome.
	 */
	deadline = k_uptime_get() + 100;

	while (mask_seq < 2U) {
		if (k_uptime_get() > deadline) {
			return;
		}

		mask_kernel_work();

		if (CONFIG_INT_BENCH_MASK_INJECT_US > 0) {
			unsigned int key = irq_lock();

			k_busy_wait(CONFIG_INT_BENCH_MASK_INJECT_US);
			irq_unlock(key);
		}
	}
}
#endif /* CONFIG_INT_BENCH_SCENARIO_MASKING */

#ifdef BENCH_ALT_LINE_USED
/*
 * Bound on the spin waiting for the second line's ISR. An interrupt
 * that never arrives would otherwise hang the run, and in the
 * zero-latency and nested cases the wait happens with the first
 * interrupt masked or in service, so nothing else could break the
 * deadlock.
 */
#define ALT_SPIN_LIMIT 10000000U

static bool alt_wait(void)
{
	for (uint32_t spin = 0U; spin < ALT_SPIN_LIMIT; spin++) {
		if (alt_fired) {
			return true;
		}
	}

	return false;
}
#endif

#ifdef BENCH_ALT_LINE_DIRECT
/*
 * Entry latency of the second line, measured exactly as
 * entry_trigger_to_isr measures the first. What differs is only how
 * the line is connected, so the two are directly comparable.
 */
static void alt_entry_measure(const char *name)
{
	alt_fired = false;
	bench_load_churn();
	bench_load_pollute();

	ztest_benchmark_start();
	bench_trigger_alt();

	if (!alt_wait()) {
		printk("%s: ISR did not run, skipping\n", name);
		return;
	}
}
#endif /* BENCH_ALT_LINE_DIRECT */

#ifdef CONFIG_INT_BENCH_SCENARIO_DIRECT
/*
 * A directly connected ISR is dispatched from the vector table, so the
 * difference from entry_trigger_to_isr is the software ISR table
 * dispatch and the common entry code a regular ISR goes through.
 */
ZTEST_BENCHMARK_MANUAL(interrupt, entry_direct_isr, NUM_ITERATIONS, NULL, NULL)
{
	alt_entry_measure("entry_direct_isr");
}
#endif /* CONFIG_INT_BENCH_SCENARIO_DIRECT */

#ifdef CONFIG_INT_BENCH_SCENARIO_ZLI
/*
 * Entry latency of a zero-latency interrupt raised while interrupts
 * are locked. A zero-latency interrupt runs above the priority the
 * kernel masks with, so unlike the interrupt in locked_unlock_to_isr
 * it is served inside the critical section rather than after it. The
 * two scenarios together show what a critical section costs an
 * interrupt, and what escaping it buys.
 */
/*
 * Entry latency of a zero-latency interrupt with interrupts enabled.
 * This is the lowest latency Zephyr offers, and being measured the
 * same way as entry_trigger_to_isr and entry_direct_isr it can be
 * compared with them; zli_entry_while_locked below answers the
 * different question of what happens inside a critical section.
 */
ZTEST_BENCHMARK_MANUAL(interrupt, zli_entry_trigger_to_isr, NUM_ITERATIONS, NULL, NULL)
{
	alt_entry_measure("zli_entry_trigger_to_isr");
}

ZTEST_BENCHMARK_MANUAL(interrupt, zli_entry_while_locked, NUM_ITERATIONS, NULL, NULL)
{
	unsigned int key;
	bool served;

	alt_fired = false;
	bench_load_churn();
	bench_load_pollute();

	key = irq_lock();

	ztest_benchmark_start();
	bench_trigger_alt();

	served = alt_wait();

	irq_unlock(key);

	if (!served) {
		printk("zli_entry_while_locked: not served while locked, skipping\n");
		return;
	}
}
#endif /* CONFIG_INT_BENCH_SCENARIO_ZLI */

#ifdef CONFIG_INT_BENCH_SCENARIO_END_TO_END
static void e2e_handler(void)
{
	k_sem_give(&wake_sem);
}

static void e2e_waiter_entry(void *p1, void *p2, void *p3)
{
	ARG_UNUSED(p1);
	ARG_UNUSED(p2);
	ARG_UNUSED(p3);

	k_sem_take(&wake_sem, K_FOREVER);
	ztest_benchmark_end();
	k_sem_give(&sync_sem);
}

/*
 * The whole path an application actually waits on: from raising the
 * interrupt to the high priority thread it wakes being on the CPU.
 *
 * The other scenarios measure the pieces of this span, but the pieces
 * cannot simply be added: entry latency and the rescheduling exit are
 * measured in separate runs and neither includes the ISR body or the
 * handoff between them. This is the figure to quote for how quickly an
 * application can respond to an event.
 */
static void e2e_setup(void)
{
	int priority = k_thread_priority_get(k_current_get());

	bench_trigger_set_handler(e2e_handler);

	k_thread_create(&waiter_thread, waiter_stack, K_THREAD_STACK_SIZEOF(waiter_stack),
			e2e_waiter_entry, NULL, NULL, NULL, priority - 1, 0, K_NO_WAIT);
}

static void e2e_teardown(void)
{
	(void)k_thread_join(&waiter_thread, K_FOREVER);
	bench_trigger_set_handler(NULL);
}

ZTEST_BENCHMARK_MANUAL(interrupt, irq_to_thread, NUM_ITERATIONS, e2e_setup, e2e_teardown)
{
	bench_load_churn();
	bench_load_pollute();

	ztest_benchmark_start();
	bench_trigger();

	k_sem_take(&sync_sem, K_FOREVER);
}
#endif /* CONFIG_INT_BENCH_SCENARIO_END_TO_END */

#ifdef CONFIG_INT_BENCH_SCENARIO_NESTED
static volatile bool nested_done;
static volatile bool nested_preempted;

/*
 * Runs at the lower priority. Raises the higher priority interrupt and
 * waits for it to preempt this ISR, which is what nesting means: the
 * second interrupt is served while the first is still in progress.
 *
 * Both ends of the span are marked from interrupt context, this handler
 * opening it and the preempting one closing it. The framework turns the
 * pair into a sample once the body has returned to thread context.
 */
static void nested_low_handler(void)
{
	alt_fired = false;

	ztest_benchmark_start();
	bench_trigger_alt();

	nested_preempted = alt_wait();

	nested_done = true;
}

/*
 * Latency of a high priority interrupt raised while a lower priority
 * ISR is running. An interrupt-heavy application rarely has the CPU
 * idle when an event arrives, so this is often a better description of
 * what a high priority handler will see than the plain entry latency.
 */
static void nested_setup(void)
{
	bench_trigger_set_handler(nested_low_handler);
}

static void nested_teardown(void)
{
	bench_trigger_set_handler(NULL);
}

ZTEST_BENCHMARK_MANUAL(interrupt, nested_preempt, NUM_ITERATIONS, nested_setup,
		       nested_teardown)
{
	nested_done = false;
	bench_load_churn();
	bench_load_pollute();

	bench_trigger();

	while (!nested_done) {
	}

	if (!nested_preempted) {
		printk("nested_preempt: the higher priority interrupt did not "
		       "preempt the lower one, skipping\n");
		return;
	}

}
#endif /* CONFIG_INT_BENCH_SCENARIO_NESTED */
```

## src/load.c
```c
/*
 * SPDX-FileCopyrightText: Copyright The Zephyr Project Contributors
 * SPDX-License-Identifier: Apache-2.0
 */

/*
 * Background system load sources, see load.h.
 *
 * Which source perturbs which measurement depends on the context the
 * load runs in:
 *
 * - The cache load runs in the benchmark thread itself, between
 *   samples, and affects every scenario on every platform.
 * - The timer load runs in the system clock ISR, so it competes with
 *   the benchmark interrupt for the interrupt controller and for
 *   interrupt-disabled windows in the kernel. It affects every
 *   platform.
 * - The thread load runs in threads of lower priority than the
 *   benchmark. On SMP those threads execute on the other CPUs and
 *   contend for the memory system throughout. On a uniprocessor they
 *   only run while the benchmark blocks, which happens in the
 *   rescheduling scenario, so their effect there is limited.
 */

#include <zephyr/kernel.h>
#include <zephyr/sys/util.h>

#include "load.h"

#ifdef CONFIG_INT_BENCH_LOAD_CACHE
#define WORKING_SET_SIZE (CONFIG_INT_BENCH_LOAD_CACHE_KB * 1024)

/*
 * Stride of one cache line on the widest line size in common use, so
 * that every line of the working set is touched exactly once.
 */
#define WORKING_SET_STRIDE 64

static volatile uint8_t working_set[WORKING_SET_SIZE];
#endif /* CONFIG_INT_BENCH_LOAD_CACHE */

#ifdef CONFIG_INT_BENCH_LOAD_TIMER
static void load_timer_handler(struct k_timer *timer)
{
	ARG_UNUSED(timer);

	/*
	 * Runs in the system clock ISR. Kept short on purpose: the
	 * point is to compete for interrupt service, not to monopolise
	 * the CPU.
	 */
}

static K_TIMER_DEFINE(load_timer, load_timer_handler, NULL);
#endif /* CONFIG_INT_BENCH_LOAD_TIMER */

#ifdef CONFIG_INT_BENCH_LOAD_THREADS
#define LOAD_STACK_SIZE  (512 + CONFIG_TEST_EXTRA_STACK_SIZE)
#define LOAD_BUFFER_SIZE 256

static K_THREAD_STACK_ARRAY_DEFINE(load_stacks, CONFIG_INT_BENCH_LOAD_NUM_THREADS,
				   LOAD_STACK_SIZE);
static struct k_thread load_threads[CONFIG_INT_BENCH_LOAD_NUM_THREADS];
static volatile uint32_t load_buffers[CONFIG_INT_BENCH_LOAD_NUM_THREADS][LOAD_BUFFER_SIZE];
static volatile bool load_running;

static void load_thread_entry(void *p1, void *p2, void *p3)
{
	volatile uint32_t *buffer = p1;
	uint32_t value = 0U;

	ARG_UNUSED(p2);
	ARG_UNUSED(p3);

	while (load_running) {
		for (uint32_t i = 0U; i < LOAD_BUFFER_SIZE; i++) {
			buffer[i] += value;
			value = buffer[i];
		}

		k_yield();
	}
}
#endif /* CONFIG_INT_BENCH_LOAD_THREADS */

void bench_load_start(void)
{
#ifdef CONFIG_INT_BENCH_LOAD_TIMER
	k_timer_start(&load_timer, K_USEC(CONFIG_INT_BENCH_LOAD_TIMER_PERIOD_US),
		      K_USEC(CONFIG_INT_BENCH_LOAD_TIMER_PERIOD_US));
#endif

#ifdef CONFIG_INT_BENCH_LOAD_THREADS
	int priority = k_thread_priority_get(k_current_get());

	load_running = true;

	for (uint32_t i = 0U; i < CONFIG_INT_BENCH_LOAD_NUM_THREADS; i++) {
		k_thread_create(&load_threads[i], load_stacks[i], LOAD_STACK_SIZE,
				load_thread_entry, (void *)load_buffers[i], NULL, NULL,
				priority + 1, 0, K_NO_WAIT);
	}
#endif
}

void bench_load_stop(void)
{
#ifdef CONFIG_INT_BENCH_LOAD_TIMER
	k_timer_stop(&load_timer);
#endif

#ifdef CONFIG_INT_BENCH_LOAD_THREADS
	load_running = false;

	for (uint32_t i = 0U; i < CONFIG_INT_BENCH_LOAD_NUM_THREADS; i++) {
		(void)k_thread_join(&load_threads[i], K_FOREVER);
	}
#endif
}

void bench_load_pollute(void)
{
#ifdef CONFIG_INT_BENCH_LOAD_CACHE
	for (size_t i = 0U; i < WORKING_SET_SIZE; i += WORKING_SET_STRIDE) {
		working_set[i]++;
	}
#endif
}

const char *bench_load_description(void)
{
	return ""
#ifdef CONFIG_INT_BENCH_LOAD_CACHE
		"cache "
#endif
#ifdef CONFIG_INT_BENCH_LOAD_TIMER
		"timer "
#endif
#ifdef CONFIG_INT_BENCH_LOAD_THREADS
		"threads "
#endif
		;
}
```

## src/load.h
```c
/*
 * SPDX-FileCopyrightText: Copyright The Zephyr Project Contributors
 * SPDX-License-Identifier: Apache-2.0
 */

#ifndef ZEPHYR_TESTS_BENCHMARKS_INTERRUPT_LATENCY_SRC_LOAD_H_
#define ZEPHYR_TESTS_BENCHMARKS_INTERRUPT_LATENCY_SRC_LOAD_H_

#include <zephyr/kernel.h>

/*
 * Background system load.
 *
 * Interrupt latency measured on an otherwise idle system is a best
 * case: caches are warm with the benchmark's own working set, no other
 * interrupt is in service and no other code competes for the memory
 * system. These helpers put the system under load so that the reported
 * maximum and standard deviation describe something closer to what an
 * application will see.
 */

#ifdef CONFIG_INT_BENCH_LOAD

/* Start the background load sources. Called once before benchmarking. */
void bench_load_start(void);

/* Stop the background load sources. */
void bench_load_stop(void);

/*
 * Evict the caches and TLBs by walking a working set larger than the
 * benchmark's own. Called between samples, outside the measured span,
 * so that each measured interrupt is served with cold caches.
 */
void bench_load_pollute(void);

/*
 * Exercise the kernel and the scheduler between samples, outside the
 * measured span. Separate from bench_load_pollute() because that one
 * is also called from inside a critical section, where making kernel
 * calls would not be valid.
 */
void bench_load_churn(void);

/* Describe the enabled load sources, for the benchmark banner. */
const char *bench_load_description(void);

#else

static inline void bench_load_start(void)
{
}

static inline void bench_load_stop(void)
{
}

static inline void bench_load_pollute(void)
{
}

static inline void bench_load_churn(void)
{
}

static inline const char *bench_load_description(void)
{
	return "idle";
}

#endif /* CONFIG_INT_BENCH_LOAD */

#endif /* ZEPHYR_TESTS_BENCHMARKS_INTERRUPT_LATENCY_SRC_LOAD_H_ */
```

## src/trigger.h
```c
/*
 * SPDX-FileCopyrightText: Copyright The Zephyr Project Contributors
 * SPDX-License-Identifier: Apache-2.0
 */

#ifndef ZEPHYR_TESTS_BENCHMARKS_INTERRUPT_LATENCY_SRC_TRIGGER_H_
#define ZEPHYR_TESTS_BENCHMARKS_INTERRUPT_LATENCY_SRC_TRIGGER_H_

#include <zephyr/kernel.h>

/*
 * Trigger backend abstraction.
 *
 * A backend provides a way to run a benchmark-controlled handler in
 * interrupt context. The sw-irq backend raises a real asynchronous
 * interrupt through the platform interrupt controller; the offload
 * backend falls back to the synchronous irq_offload() trap. Scenarios
 * install their measurement handler with bench_trigger_set_handler()
 * and fire it with bench_trigger().
 */
/*
 * Placement of the benchmark's interrupt handlers. With
 * CONFIG_INT_BENCH_ISR_IN_RAM they are relocated out of flash, so that
 * two runs can be compared to see what fetching them costs.
 */
#ifdef CONFIG_INT_BENCH_ISR_IN_RAM
#define BENCH_ISR_FUNC __ramfunc
#else
#define BENCH_ISR_FUNC
#endif

typedef void (*bench_trigger_handler_t)(void);

int bench_trigger_init(void);
void bench_trigger_set_handler(bench_trigger_handler_t handler);
void bench_trigger(void);

/* ISR wrapper installed on the benchmark IRQ line */
BENCH_ISR_FUNC void bench_trigger_isr(const void *arg);

#ifdef CONFIG_INT_BENCH_TRIGGER_SW_IRQ
unsigned int bench_trigger_irq_line(void);

/*
 * Second benchmark IRQ line.
 *
 * Scenarios that compare two ways of connecting an interrupt need a
 * line of their own, because the connection method is fixed at build
 * time. The line number has to be visible here rather than staying
 * private to the backend, since IRQ_DIRECT_CONNECT() is expanded where
 * the handler is defined.
 *
 * RISC-V is absent on purpose: without a CLIC the machine software
 * interrupt is the only interrupt a hart can raise on itself, and the
 * first line already uses it.
 */
#if CONFIG_INT_BENCH_IRQ_LINE_ALT >= 0
#define BENCH_IRQ_LINE_ALT CONFIG_INT_BENCH_IRQ_LINE_ALT
#define BENCH_HAS_ALT_LINE 1
#elif defined(CONFIG_GIC)
/* SGI 0-2 are Zephyr's SMP IPIs and 8-15 may be Secure only */
#define BENCH_IRQ_LINE_ALT 7
#define BENCH_HAS_ALT_LINE 1
#elif defined(CONFIG_BOARD_QEMU_CORTEX_M3)
#define BENCH_IRQ_LINE_ALT 41
#define BENCH_HAS_ALT_LINE 1
#elif defined(CONFIG_X86)
#define BENCH_IRQ_LINE_ALT 28
#define BENCH_HAS_ALT_LINE 1
#elif defined(CONFIG_CPU_CORTEX_M) || defined(CONFIG_ARC)
#define BENCH_IRQ_LINE_ALT (CONFIG_NUM_IRQS - 2)
#define BENCH_HAS_ALT_LINE 1
#endif

#ifdef BENCH_HAS_ALT_LINE
/* Raise the interrupt on the second line */
void bench_trigger_alt(void);
#endif
#endif /* CONFIG_INT_BENCH_TRIGGER_SW_IRQ */

#endif /* ZEPHYR_TESTS_BENCHMARKS_INTERRUPT_LATENCY_SRC_TRIGGER_H_ */
```

## src/trigger_offload.c
```c
/*
 * SPDX-FileCopyrightText: Copyright The Zephyr Project Contributors
 * SPDX-License-Identifier: Apache-2.0
 */

/*
 * Fallback trigger backend based on irq_offload(). Portable to every
 * architecture, but the handler runs from a synchronous software trap
 * rather than an asynchronous interrupt: only the interrupt exit paths
 * are meaningfully measured with this backend.
 */

#include <zephyr/kernel.h>
#include <zephyr/irq_offload.h>

#include "trigger.h"

static bench_trigger_handler_t trigger_handler;

BENCH_ISR_FUNC void bench_trigger_isr(const void *arg)
{
	ARG_UNUSED(arg);

	if (trigger_handler != NULL) {
		trigger_handler();
	}
}

void bench_trigger_set_handler(bench_trigger_handler_t handler)
{
	trigger_handler = handler;
}

int bench_trigger_init(void)
{
	return 0;
}

void bench_trigger(void)
{
	irq_offload(bench_trigger_isr, NULL);
}
```
