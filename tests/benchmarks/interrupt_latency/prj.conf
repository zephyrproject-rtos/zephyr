## CMakeLists.txt
```
# SPDX-FileCopyrightText: Copyright The Zephyr Project Contributors
# SPDX-License-Identifier: Apache-2.0

cmake_minimum_required(VERSION 3.28.0)
find_package(Zephyr REQUIRED HINTS $ENV{ZEPHYR_BASE})
project(interrupt_latency)

target_sources(app PRIVATE
  src/benchmarks.c
)

target_sources_ifdef(CONFIG_INT_BENCH_TRIGGER_SW_IRQ app PRIVATE src/trigger_sw_irq.c)
target_sources_ifdef(CONFIG_INT_BENCH_TRIGGER_OFFLOAD app PRIVATE src/trigger_offload.c)
```

## Kconfig
```
# SPDX-FileCopyrightText: Copyright The Zephyr Project Contributors
# SPDX-License-Identifier: Apache-2.0

mainmenu "Interrupt Handling Benchmark"

menu "Interrupt benchmark options"

config INT_BENCH_NUM_ITERATIONS
	int "Number of iterations per scenario"
	default 1000
	help
	  Number of samples collected for each measured scenario. Larger
	  values give more stable statistics at the cost of runtime.

config INT_BENCH_RISCV_SW_IRQ
	bool
	depends on RISCV && !SMP && !RISCV_S_MODE
	default y if CLIC || NRFX_CLIC
	default $(dt_nodelabel_enabled,clint)
	help
	  The RISC-V sw-irq trigger needs an interrupt a hart can raise on
	  itself: a CLIC pending bit, or the machine software interrupt of
	  a CLINT. Cores with neither, such as the single core LiteX
	  VexRiscv, have none: their external pending bits mirror the
	  interrupt wires and the mip bits are read only.

choice INT_BENCH_TRIGGER
	prompt "Interrupt trigger backend"
	default INT_BENCH_TRIGGER_SW_IRQ if CPU_CORTEX_M || GIC || ARC || X86 || \
		INTC_ESP32 || INT_BENCH_RISCV_SW_IRQ
	default INT_BENCH_TRIGGER_OFFLOAD

config INT_BENCH_TRIGGER_SW_IRQ
	bool "Software-triggered hardware interrupt"
	depends on CPU_CORTEX_M || GIC || ARC || X86 || INTC_ESP32 || \
		INT_BENCH_RISCV_SW_IRQ
	help
	  Raise a real asynchronous interrupt through the platform
	  interrupt controller (NVIC STIR/ISPR on Cortex-M, a GIC SGI on
	  Arm GIC platforms, IRQ_HINT on ARC, a local APIC self IPI on
	  x86, a CLIC pending bit or a CLINT machine software interrupt
	  on RISC-V, and a software-raised interrupt matrix source on
	  Espressif SoCs). This exercises the full hardware interrupt
	  entry path and is required for the entry latency, critical
	  section and throughput scenarios.

	  Not available on RISC-V in supervisor mode, where both the CLINT
	  and mhartid are machine mode only, on SMP builds, where the
	  machine software interrupt carries the scheduler IPIs, or on
	  cores with neither a CLIC nor a CLINT, which have no interrupt a
	  hart can raise on itself.

config INT_BENCH_TRIGGER_OFFLOAD
	bool "irq_offload() software trap"
	depends on IRQ_OFFLOAD
	help
	  Run the benchmark ISRs synchronously via irq_offload(). This
	  works on every architecture but does not go through the
	  interrupt controller: only the interrupt *exit* paths are
	  measured. Entry latency numbers are not available with this
	  backend.

endchoice

config INT_BENCH_IRQ_LINE
	int "IRQ line used by the benchmark (-1 = auto-select)"
	depends on INT_BENCH_TRIGGER_SW_IRQ
	default -1
	help
	  IRQ line the benchmark connects its ISR to and then triggers
	  from software. The default of -1 selects a platform-appropriate
	  line automatically: an SGI on GIC platforms, the machine
	  software interrupt on RISC-V platforms without a CLIC, a line
	  known to be free on selected QEMU boards and on x86, and the
	  last available line (CONFIG_NUM_IRQS - 1) otherwise. Override
	  this on SoCs where the automatic choice is not an implemented
	  or free line.

config INT_BENCH_IRQ_LINE_ALT
	int "Second IRQ line used by the benchmark (-1 = auto-select)"
	depends on INT_BENCH_TRIGGER_SW_IRQ
	default -1
	help
	  Scenarios that compare how an interrupt is connected need a
	  second line, because the connection method is fixed at build
	  time. Selected the same way as CONFIG_INT_BENCH_IRQ_LINE, one
	  line below it where that is derived from CONFIG_NUM_IRQS.

config INT_BENCH_IRQ_PRIO
	int "Priority of the benchmark IRQ"
	depends on INT_BENCH_TRIGGER_SW_IRQ
	# On Arm GIC the priority is a raw eight bit value of which only
	# the upper bits select the preemption group, so a line at
	# priority 1 cannot be preempted by one at priority 0: they share
	# a group. Use the platform default, which is both representative
	# and far enough from the top for the second line to outrank it.
	default 160 if GIC
	default 1
	help
	  Interrupt priority for the benchmark IRQ line, using the same
	  convention as the priority argument of IRQ_CONNECT() on the
	  target architecture.

config INT_BENCH_IRQ_PRIO_ALT
	int "Priority of the second benchmark IRQ"
	depends on INT_BENCH_TRIGGER_SW_IRQ
	# Zero-latency interrupts have to sit within the levels reserved
	# for them, and the nested scenario needs to outrank the first
	# line. Everything else wants the two lines at equal priority, so
	# that comparing them measures only how they are connected.
	default 0 if INT_BENCH_SCENARIO_ZLI
	default 0 if INT_BENCH_SCENARIO_NESTED
	default INT_BENCH_IRQ_PRIO
	help
	  Interrupt priority for the second benchmark IRQ line, in the
	  same convention as CONFIG_INT_BENCH_IRQ_PRIO.

	  The default matches the first line, so that the entry latency
	  of the two can be compared without the priority differing as
	  well. The nested and zero-latency scenarios override it because
	  they are about the second line outranking the first.

config INT_BENCH_LOCK_HOLD_US
	int "Critical section hold time (microseconds)"
	depends on INT_BENCH_SCENARIO_LOCKED
	default 10
	help
	  How long the critical section scenario keeps interrupts locked
	  with the benchmark interrupt pending before unlocking and
	  measuring the unlock-to-ISR-entry latency.

menuconfig INT_BENCH_LOAD
	bool "Run the scenarios under background system load"
	help
	  Interrupt latency measured on an otherwise idle system is a
	  best case: caches hold the benchmark's own working set, no
	  other interrupt is in service and nothing else competes for the
	  memory system. Enable background load so that the reported
	  maximum and standard deviation describe something closer to
	  what an application will see. The individual load sources are
	  selected below.

if INT_BENCH_LOAD

config INT_BENCH_LOAD_CACHE
	bool "Evict caches between samples"
	default y
	help
	  Walk a working set larger than the benchmark's own between
	  samples, outside the measured span, so that each measured
	  interrupt is served with cold caches and TLBs. Runs in the
	  benchmark thread and therefore affects every scenario on every
	  platform.

config INT_BENCH_LOAD_CACHE_KB
	int "Working set size (KB)"
	depends on INT_BENCH_LOAD_CACHE
	default 8
	help
	  Size of the buffer walked between samples. To be effective this
	  should exceed the size of the last level cache; to be usable it
	  has to fit in RAM alongside the benchmark.

config INT_BENCH_LOAD_TIMER
	bool "Competing periodic timer interrupts"
	default y
	help
	  Run a periodic timer whose handler executes in the system clock
	  ISR, so that it competes with the benchmark interrupt for the
	  interrupt controller and for the interrupt-disabled windows of
	  the kernel timeout code. Affects every platform.

config INT_BENCH_LOAD_TIMER_PERIOD_US
	int "Timer load period (microseconds)"
	depends on INT_BENCH_LOAD_TIMER
	default 1000
	help
	  Period of the competing timer. Values below the tick period of
	  the system clock are rounded up, so raise
	  CONFIG_SYS_CLOCK_TICKS_PER_SEC accordingly.

config INT_BENCH_LOAD_KERNEL
	bool "Kernel activity from interrupt context"
	depends on INT_BENCH_LOAD_TIMER
	default y
	help
	  Have the load timer handler exercise kernel primitives from
	  interrupt context, so that the benchmark interrupt competes
	  with the interrupt-disabled windows the kernel takes around its
	  own data structures rather than only with an empty handler.

	  Runs in the system clock ISR, so unlike a thread it takes
	  effect regardless of priorities and on uniprocessors too.

config INT_BENCH_LOAD_SCHED
	bool "Scheduler churn between samples"
	default y
	help
	  Wake a higher priority thread and let it block again before
	  each sample, so that every measurement is taken on a system
	  that has just context switched rather than one that has been
	  spinning in the same thread.

	  The churn happens between samples rather than during them on
	  purpose. A thread that could preempt the benchmark while it is
	  measuring would add its own scheduling delay to the result and
	  be indistinguishable from interrupt latency.

config INT_BENCH_LOAD_THREADS
	bool "Background CPU and memory load threads"
	default y
	help
	  Run threads of lower priority than the benchmark that
	  continuously write to memory. On SMP these run on the other
	  CPUs and contend for the memory system throughout. On a
	  uniprocessor they only run while the benchmark blocks, so their
	  effect is limited to the rescheduling scenario.

config INT_BENCH_LOAD_NUM_THREADS
	int "Number of background load threads"
	depends on INT_BENCH_LOAD_THREADS
	default 2
	help
	  On SMP this should be at least the number of CPUs other than
	  the one running the benchmark.

endif # INT_BENCH_LOAD

config INT_BENCH_ISR_IN_RAM
	bool "Place the benchmark ISR in RAM"
	depends on ARCH_HAS_RAMFUNC_SUPPORT
	depends on XIP
	help
	  Relocate the benchmark's interrupt handlers to RAM with
	  __ramfunc, so that comparing a run against one built without
	  this option shows what fetching the handler from flash costs.

	  Only the benchmark's own handlers move. The vector table and
	  the architecture's interrupt entry code stay where the build
	  put them, so the difference is a lower bound on what fully
	  relocating the interrupt path would save.

config INT_BENCH_OUTLIER_TRACE
	bool "Report what coincided with outlying samples"
	help
	  Print a line for each sample far above the smallest one seen,
	  naming what else the system did while it was being taken: how
	  many clock ticks were announced and how many times the load
	  timer ran. An outlier that coincides with neither was caused by
	  something the benchmark cannot see, such as the memory system
	  or a debug probe.

	  The witnesses are read once per sample, outside the measured
	  span, so this changes the steady state slightly and is meant
	  for diagnosis rather than for the numbers to be quoted.

config INT_BENCH_OUTLIER_FACTOR
	int "How far above the minimum counts as an outlier"
	depends on INT_BENCH_OUTLIER_TRACE
	default 4
	help
	  A sample is reported when it exceeds this many times the
	  smallest sample seen so far in the same benchmark.

config INT_BENCH_OUTLIER_LIMIT
	int "Maximum outliers reported per benchmark"
	depends on INT_BENCH_OUTLIER_TRACE
	default 8
	help
	  Printing perturbs the samples that follow, so stop after this
	  many. The count of the rest is still reported.

comment "Scenarios"

config INT_BENCH_SCENARIO_ENTRY
	bool "Interrupt entry latency"
	depends on INT_BENCH_TRIGGER_SW_IRQ
	default y
	help
	  Measure the time from the software trigger of a hardware
	  interrupt to the first instruction of its ISR.

config INT_BENCH_SCENARIO_EXIT
	bool "Interrupt exit latency"
	default y
	help
	  Measure the time from the end of the ISR body back to the
	  interrupted thread, and the time from the end of an ISR that
	  wakes a higher priority thread to that thread running.

config INT_BENCH_SCENARIO_END_TO_END
	bool "Interrupt to awakened thread latency"
	depends on INT_BENCH_TRIGGER_SW_IRQ
	default y
	help
	  Measure the whole path an application waits on, from raising
	  the interrupt to the high priority thread it wakes running.

	  The entry and exit scenarios measure the pieces of this span,
	  but they cannot be added together: they are measured in
	  separate runs and neither covers the ISR body or the handoff
	  between them.

config INT_BENCH_SCENARIO_LOCKED
	bool "Entry latency after a critical section"
	depends on INT_BENCH_TRIGGER_SW_IRQ
	# ARC raises a software interrupt by writing the line number to
	# the single IRQ_HINT register, and the system timer writes that
	# same register from sys_clock_cycle_get_32() whenever it finds
	# the timer already expired. The hold below busy waits on that
	# function with interrupts locked, so the timer takes the
	# register over from the benchmark and the two then fight for it
	# for as long as the timer stays behind.
	depends on !ARC
	default y
	help
	  Trigger the benchmark interrupt while interrupts are locked,
	  hold the lock for a configurable window, then measure the time
	  from irq_unlock() to ISR entry. This approximates the latency
	  an interrupt experiences when it arrives during a kernel or
	  application critical section.

	  Not available on ARC, where the benchmark trigger and the
	  system timer share one hardware register.

config INT_BENCH_SCENARIO_DYNAMIC
	bool "Dynamic interrupt connect cost"
	depends on INT_BENCH_TRIGGER_SW_IRQ
	depends on DYNAMIC_INTERRUPTS
	depends on !SHARED_INTERRUPTS
	# On x86, arch_irq_connect_dynamic() is a one shot allocation
	# rather than a rebindable install: it allocates a new IDT vector
	# and consumes an entry from a fixed pool of interrupt stubs on
	# every call, and asserts that the line is not already
	# configured. Repeatedly connecting the same line to gather
	# samples exhausts that pool.
	depends on !X86
	default y
	help
	  Measure the cost of installing an ISR at runtime with
	  irq_connect_dynamic(), by repeatedly reinstalling the handler
	  on the benchmark IRQ line. This requires the architecture to
	  support rebinding a line that is already connected.

config INT_BENCH_SCENARIO_MASKING
	bool "Delay inflicted on a periodic interrupt"
	# Two samples are taken per tick, so the tick has to be frequent
	# enough both to sample the windows of interest and to finish in
	# reasonable time. The base configuration runs far slower than
	# that; the load overlay raises it to 1000.
	depends on SYS_CLOCK_TICKS_PER_SEC >= 1000
	default y
	help
	  Run a periodic timer at the tick rate while exercising kernel
	  primitives, and measure how much later than its period each
	  timer interrupt is actually served. This is the delay an
	  application sees when the kernel or a driver masks interrupts.

	  This is a sampling technique and cannot attribute the delay: a
	  masked window that does not overlap a tick is never seen, and
	  the measured delay also contains time spent in interrupts
	  served earlier. The maximum is a sampled lower bound on the
	  longest interrupt-disabled window, not proof of one.

config INT_BENCH_MASK_INJECT_US
	int "Inject a known interrupt-disabled window (microseconds)"
	depends on INT_BENCH_SCENARIO_MASKING
	default 0
	help
	  Mask interrupts for this long inside the scenario's work loop,
	  to check on a new platform that the measurement responds to a
	  known window. Keep the value well below the tick period: a
	  window comparable to it masks nearly continuously, and the
	  timer then re-anchors to when it was last serviced, so the
	  measured delay falls short of the injected one. Zero measures
	  only the windows the kernel creates by itself.

choice INT_BENCH_ALT_LINE_USE
	prompt "Use of the second benchmark IRQ line"
	depends on INT_BENCH_TRIGGER_SW_IRQ
	default INT_BENCH_SCENARIO_DIRECT if CPU_CORTEX_M || ARC || (X86 && !X86_64)
	default INT_BENCH_SCENARIO_NESTED if GIC
	default INT_BENCH_ALT_LINE_NONE
	help
	  How an interrupt is connected and what priority it runs at are
	  both fixed at build time, so the scenarios that need a second
	  line cannot share one. Pick the one to build.

config INT_BENCH_SCENARIO_DIRECT
	bool "Direct ISR entry latency"
	# Needs both a second triggerable line and IRQ_DIRECT_CONNECT().
	# There is no capability symbol for the latter, so the
	# architectures that implement ARCH_ISR_DIRECT_DECLARE() are
	# listed explicitly: Arm64 has no direct interrupts, x86 has them
	# only on IA32, and RISC-V without a CLIC has only the one
	# interrupt a hart can raise on itself.
	depends on CPU_CORTEX_M || ARC || (X86 && !X86_64)
	help
	  Measure entry latency for an interrupt connected with
	  IRQ_DIRECT_CONNECT(), which is dispatched straight from the
	  vector table instead of through the software ISR table. The
	  line runs at the same priority as the first one, so comparing
	  the two measures only the dispatch.

config INT_BENCH_SCENARIO_ZLI
	bool "Zero-latency interrupt"
	depends on ZERO_LATENCY_IRQS
	help
	  Connect the second line as a zero-latency interrupt and measure
	  it both with interrupts enabled and from inside a critical
	  section. A zero-latency interrupt is not masked by irq_lock(),
	  so it is served during the critical section rather than after
	  it, which the regular critical section scenario can be compared
	  against.

	  The priority difference is inherent here: a zero-latency
	  interrupt is one that runs above the level the kernel masks.

config INT_BENCH_SCENARIO_NESTED
	bool "Nested interrupt preemption latency"
	# Same set of platforms whose nesting behaviour
	# tests/arch/common/interrupt exercises.
	depends on CPU_CORTEX_M || ARC || GIC
	help
	  Raise the second, higher priority interrupt from inside the
	  first one's ISR and measure how long it takes to preempt it.
	  This is the latency a high priority interrupt suffers when a
	  lower priority one is already being serviced, which for an
	  interrupt-heavy application is often the dominant term.

config INT_BENCH_ALT_LINE_NONE
	bool "Unused"
	help
	  Leave the second line alone. This is the only option on
	  platforms that have no second line to trigger.

endchoice

config INT_BENCH_SCENARIO_THROUGHPUT
	bool "Sustained interrupt round-trip cost"
	depends on INT_BENCH_TRIGGER_SW_IRQ
	default y
	help
	  Re-trigger the benchmark interrupt from within its own ISR so
	  interrupts are serviced back to back, and report the average
	  cost of one full entry + ISR + exit round trip. The inverse of
	  this number is the maximum sustainable interrupt rate.

endmenu

config SYS_CLOCK_TICKS_PER_SEC
	int "Number of ticks per second"
	default 20 if SOC_FAMILY_STM32
	default 100
	help
	  A low tick rate keeps timer interrupts out of the measurements,
	  but it cannot be lowered without limit: a tick has to be
	  expressible in the timer's counter. A Cortex-M SysTick counter
	  is 24 bits, so a tick longer than 16777215 cycles cannot be
	  programmed, and the driver then falls back to its minimum delay
	  of ten microseconds and interrupts continuously.

	  The default of 100 is representable on any core up to 1.6GHz.
	  Combined with a tickless kernel it is also quiet: with nothing
	  scheduled the driver programs as far ahead as the counter
	  allows, which on a 150MHz part is 110ms.

source "Kconfig.zephyr"
```

## prj.conf
```kconfig
# SPDX-FileCopyrightText: Copyright The Zephyr Project Contributors
# SPDX-License-Identifier: Apache-2.0

CONFIG_ZTEST=y
CONFIG_ZTEST_BENCHMARK=y
CONFIG_ASSERT=n
#CONFIG_ZTEST_BENCHMARK_OUTPUT_CSV=y

# What matters for a real-time system is how bad an individual
# interrupt can be, which lives in the tail of the distribution rather
# than in the mean. Retain every sample so the tail can be reported.
CONFIG_ZTEST_BENCHMARK_PERCENTILES=y
CONFIG_ZTEST_BENCHMARK_MAX_SAMPLES=1024

# The benchmark framework reports its statistics as doubles from the
# thread running the benchmarks. Formatting them needs more stack than
# the 1KB default of some platforms provides.
CONFIG_MAIN_STACK_SIZE=4096

# Fallback trigger backend for architectures without a sw-irq trigger
CONFIG_IRQ_OFFLOAD=y

# Every scenario measures one core: the trigger raises the interrupt on
# whichever CPU the benchmark thread is running on, and each measured
# span starts and ends there. Left multi-core, the thread migrates and
# the interrupt is raised on a CPU that never enabled the line, since
# enabling an SGI or a software interrupt is per-CPU, so the trigger is
# simply lost.
CONFIG_MP_MAX_NUM_CPUS=1

# Reduce measurement noise
CONFIG_TEST_HW_STACK_PROTECTION=n
CONFIG_HW_STACK_PROTECTION=n
CONFIG_COVERAGE=n
CONFIG_PM=n
CONFIG_TIMESLICING=n
CONFIG_BT=n
```

## prj.load.conf
```kconfig
# SPDX-FileCopyrightText: Copyright The Zephyr Project Contributors
# SPDX-License-Identifier: Apache-2.0
#
# Run the benchmark scenarios under background system load. Use with
# EXTRA_CONF_FILE="prj.load.conf".

CONFIG_INT_BENCH_LOAD=y
CONFIG_ASSERT=n

# The base configuration keeps the tick rate low to keep timer
# interrupts out of the measurements. Under load the
# competing timer is part of the point, so give the system clock a
# resolution the load period can actually use. Kept moderate so that
# the benchmark stays practical on slow emulated targets.
CONFIG_SYS_CLOCK_TICKS_PER_SEC=1000
```

## prj.nested.conf
```kconfig
# SPDX-FileCopyrightText: Copyright The Zephyr Project Contributors
# SPDX-License-Identifier: Apache-2.0
#
# Use the second IRQ line for the nested preemption scenario instead of
# the direct ISR comparison; the two need the line at different
# priorities, so only one can be built at a time. Use with
# EXTRA_CONF_FILE="prj.nested.conf".

CONFIG_INT_BENCH_SCENARIO_NESTED=y
```

## prj.ramfunc.conf
```kconfig
# SPDX-FileCopyrightText: Copyright The Zephyr Project Contributors
# SPDX-License-Identifier: Apache-2.0
#
# Relocate the benchmark's interrupt handlers to RAM, so that the run
# can be compared against one built without this overlay to see what
# fetching them from flash costs. Use with
# EXTRA_CONF_FILE="prj.ramfunc.conf".

CONFIG_INT_BENCH_ISR_IN_RAM=y
```

## prj.zli.conf
```kconfig
# SPDX-FileCopyrightText: Copyright The Zephyr Project Contributors
# SPDX-License-Identifier: Apache-2.0
#
# Measure a zero-latency interrupt instead of a directly connected one;
# the two scenarios share the second IRQ line. Cortex-M only. Use with
# EXTRA_CONF_FILE="prj.zli.conf".

CONFIG_ZERO_LATENCY_IRQS=y
CONFIG_INT_BENCH_SCENARIO_ZLI=y
```

## src/load.c
```c
/*
 * SPDX-FileCopyrightText: Copyright The Zephyr Project Contributors
 * SPDX-License-Identifier: Apache-2.0
 */

/*
 * Background system load sources, see load.h.
 *
 * Which source perturbs which measurement depends on the context the
 * load runs in:
 *
 * - The cache load runs in the benchmark thread itself, between
 *   samples, and affects every scenario on every platform.
 * - The timer load runs in the system clock ISR, so it competes with
 *   the benchmark interrupt for the interrupt controller and for
 *   interrupt-disabled windows in the kernel. It affects every
 *   platform.
 * - The thread load runs in threads of lower priority than the
 *   benchmark. On SMP those threads execute on the other CPUs and
 *   contend for the memory system throughout. On a uniprocessor they
 *   only run while the benchmark blocks, which happens in the
 *   rescheduling scenario, so their effect there is limited.
 */

#include <zephyr/kernel.h>
#include <zephyr/sys/util.h>

#include "load.h"

#ifdef CONFIG_INT_BENCH_LOAD_CACHE
#define WORKING_SET_SIZE (CONFIG_INT_BENCH_LOAD_CACHE_KB * 1024)

/*
 * Stride of one cache line on the widest line size in common use, so
 * that every line of the working set is touched exactly once.
 */
#define WORKING_SET_STRIDE 64

static volatile uint8_t working_set[WORKING_SET_SIZE];
#endif /* CONFIG_INT_BENCH_LOAD_CACHE */

#ifdef CONFIG_INT_BENCH_LOAD_KERNEL
static K_SEM_DEFINE(kernel_load_sem, 0, 1);
#endif

#ifdef CONFIG_INT_BENCH_LOAD_TIMER
static volatile uint32_t load_timer_runs;

static void load_timer_handler(struct k_timer *timer)
{
	ARG_UNUSED(timer);

	load_timer_runs++;

	/*
	 * Runs in the system clock ISR. Kept short on purpose: the
	 * point is to compete for interrupt service, not to monopolise
	 * the CPU.
	 */
#ifdef CONFIG_INT_BENCH_LOAD_KERNEL
	/*
	 * Kernel calls that take a spinlock, so that the benchmark
	 * interrupt competes with the windows the kernel masks
	 * interrupts for rather than with an empty handler.
	 */
	k_sem_give(&kernel_load_sem);
	(void)k_sem_take(&kernel_load_sem, K_NO_WAIT);
	(void)k_uptime_get();
#endif
}

static K_TIMER_DEFINE(load_timer, load_timer_handler, NULL);
#endif /* CONFIG_INT_BENCH_LOAD_TIMER */

#ifdef CONFIG_INT_BENCH_LOAD_SCHED
#define CHURN_STACK_SIZE (512 + CONFIG_TEST_EXTRA_STACK_SIZE)

static K_SEM_DEFINE(churn_sem, 0, 1);
static K_SEM_DEFINE(churn_done_sem, 0, 1);
static K_THREAD_STACK_DEFINE(churn_stack, CHURN_STACK_SIZE);
static struct k_thread churn_thread;
static volatile bool churn_running;

/*
 * Runs at a higher priority than the benchmark, so waking it forces a
 * context switch away and back. It only ever runs between samples,
 * because that is the only point at which the benchmark gives it the
 * semaphore; a thread that could preempt a measurement in progress
 * would add its scheduling delay to the result.
 */
static void churn_thread_entry(void *p1, void *p2, void *p3)
{
	ARG_UNUSED(p1);
	ARG_UNUSED(p2);
	ARG_UNUSED(p3);

	while (churn_running) {
		k_sem_take(&churn_sem, K_FOREVER);
		k_sem_give(&churn_done_sem);
	}
}
#endif /* CONFIG_INT_BENCH_LOAD_SCHED */

#ifdef CONFIG_INT_BENCH_LOAD_THREADS
#define LOAD_STACK_SIZE  (512 + CONFIG_TEST_EXTRA_STACK_SIZE)
#define LOAD_BUFFER_SIZE 256

static K_THREAD_STACK_ARRAY_DEFINE(load_stacks, CONFIG_INT_BENCH_LOAD_NUM_THREADS, LOAD_STACK_SIZE);
static struct k_thread load_threads[CONFIG_INT_BENCH_LOAD_NUM_THREADS];
static volatile uint32_t load_buffers[CONFIG_INT_BENCH_LOAD_NUM_THREADS][LOAD_BUFFER_SIZE];
static volatile bool load_running;

static void load_thread_entry(void *p1, void *p2, void *p3)
{
	volatile uint32_t *buffer = p1;
	uint32_t value = 0U;

	ARG_UNUSED(p2);
	ARG_UNUSED(p3);

	while (load_running) {
		for (uint32_t i = 0U; i < LOAD_BUFFER_SIZE; i++) {
			buffer[i] += value;
			value = buffer[i];
		}

		k_yield();
	}
}
#endif /* CONFIG_INT_BENCH_LOAD_THREADS */

void bench_load_churn(void)
{
#ifdef CONFIG_INT_BENCH_LOAD_SCHED
	k_sem_give(&churn_sem);
	(void)k_sem_take(&churn_done_sem, K_FOREVER);
#endif
}

void bench_load_start(void)
{
#ifdef CONFIG_INT_BENCH_LOAD_SCHED
	int churn_priority = k_thread_priority_get(k_current_get()) - 1;

	churn_running = true;
	k_thread_create(&churn_thread, churn_stack, CHURN_STACK_SIZE, churn_thread_entry, NULL,
			NULL, NULL, churn_priority, 0, K_NO_WAIT);
#endif

#ifdef CONFIG_INT_BENCH_LOAD_TIMER
	k_timer_start(&load_timer, K_USEC(CONFIG_INT_BENCH_LOAD_TIMER_PERIOD_US),
		      K_USEC(CONFIG_INT_BENCH_LOAD_TIMER_PERIOD_US));
#endif

#ifdef CONFIG_INT_BENCH_LOAD_THREADS
	int priority = k_thread_priority_get(k_current_get());

	load_running = true;

	for (uint32_t i = 0U; i < CONFIG_INT_BENCH_LOAD_NUM_THREADS; i++) {
		k_thread_create(&load_threads[i], load_stacks[i], LOAD_STACK_SIZE,
				load_thread_entry, (void *)load_buffers[i], NULL, NULL,
				priority + 1, 0, K_NO_WAIT);
	}
#endif
}

void bench_load_stop(void)
{
#ifdef CONFIG_INT_BENCH_LOAD_SCHED
	churn_running = false;
	k_sem_give(&churn_sem);
	(void)k_sem_take(&churn_done_sem, K_FOREVER);
	(void)k_thread_join(&churn_thread, K_FOREVER);
#endif

#ifdef CONFIG_INT_BENCH_LOAD_TIMER
	k_timer_stop(&load_timer);
#endif

#ifdef CONFIG_INT_BENCH_LOAD_THREADS
	load_running = false;

	for (uint32_t i = 0U; i < CONFIG_INT_BENCH_LOAD_NUM_THREADS; i++) {
		(void)k_thread_join(&load_threads[i], K_FOREVER);
	}
#endif
}

void bench_load_pollute(void)
{
#ifdef CONFIG_INT_BENCH_LOAD_CACHE
	for (size_t i = 0U; i < WORKING_SET_SIZE; i += WORKING_SET_STRIDE) {
		working_set[i]++;
	}
#endif
}

uint32_t bench_load_timer_runs(void)
{
#ifdef CONFIG_INT_BENCH_LOAD_TIMER
	return load_timer_runs;
#else
	return 0;
#endif
}

const char *bench_load_description(void)
{
	return ""
#ifdef CONFIG_INT_BENCH_LOAD_CACHE
	       "cache "
#endif
#ifdef CONFIG_INT_BENCH_LOAD_TIMER
	       "timer "
#endif
#ifdef CONFIG_INT_BENCH_LOAD_KERNEL
	       "kernel "
#endif
#ifdef CONFIG_INT_BENCH_LOAD_SCHED
	       "sched "
#endif
#ifdef CONFIG_INT_BENCH_LOAD_THREADS
	       "threads "
#endif
		;
}
```

## src/load.h
```c
/*
 * SPDX-FileCopyrightText: Copyright The Zephyr Project Contributors
 * SPDX-License-Identifier: Apache-2.0
 */

#ifndef ZEPHYR_TESTS_BENCHMARKS_INTERRUPT_LATENCY_SRC_LOAD_H_
#define ZEPHYR_TESTS_BENCHMARKS_INTERRUPT_LATENCY_SRC_LOAD_H_

#include <zephyr/kernel.h>

/*
 * Background system load.
 *
 * Interrupt latency measured on an otherwise idle system is a best
 * case: caches are warm with the benchmark's own working set, no other
 * interrupt is in service and no other code competes for the memory
 * system. These helpers put the system under load so that the reported
 * maximum and standard deviation describe something closer to what an
 * application will see.
 */

#ifdef CONFIG_INT_BENCH_LOAD

/* Start the background load sources. Called once before benchmarking. */
void bench_load_start(void);

/* Stop the background load sources. */
void bench_load_stop(void);

/*
 * Evict the caches and TLBs by walking a working set larger than the
 * benchmark's own. Called between samples, outside the measured span,
 * so that each measured interrupt is served with cold caches.
 */
void bench_load_pollute(void);

/*
 * Exercise the kernel and the scheduler between samples, outside the
 * measured span. Separate from bench_load_pollute() because that one
 * is also called from inside a critical section, where making kernel
 * calls would not be valid.
 */
void bench_load_churn(void);

/* Describe the enabled load sources, for the benchmark banner. */
const char *bench_load_description(void);

#else

static inline void bench_load_start(void)
{
}

static inline void bench_load_stop(void)
{
}

static inline void bench_load_pollute(void)
{
}

static inline void bench_load_churn(void)
{
}

static inline const char *bench_load_description(void)
{
	return "idle";
}

#endif /* CONFIG_INT_BENCH_LOAD */

#endif /* ZEPHYR_TESTS_BENCHMARKS_INTERRUPT_LATENCY_SRC_LOAD_H_ */
```

## src/trigger.h
```c
/*
 * SPDX-FileCopyrightText: Copyright The Zephyr Project Contributors
 * SPDX-License-Identifier: Apache-2.0
 */

#ifndef ZEPHYR_TESTS_BENCHMARKS_INTERRUPT_LATENCY_SRC_TRIGGER_H_
#define ZEPHYR_TESTS_BENCHMARKS_INTERRUPT_LATENCY_SRC_TRIGGER_H_

#include <zephyr/kernel.h>

/*
 * Trigger backend abstraction.
 *
 * A backend provides a way to run a benchmark-controlled handler in
 * interrupt context. The sw-irq backend raises a real asynchronous
 * interrupt through the platform interrupt controller; the offload
 * backend falls back to the synchronous irq_offload() trap. Scenarios
 * install their measurement handler with bench_trigger_set_handler()
 * and fire it with bench_trigger().
 */
/*
 * Placement of the benchmark's interrupt handlers. With
 * CONFIG_INT_BENCH_ISR_IN_RAM they are relocated out of flash, so that
 * two runs can be compared to see what fetching them costs.
 */
#ifdef CONFIG_INT_BENCH_ISR_IN_RAM
#define BENCH_ISR_FUNC __ramfunc
#else
#define BENCH_ISR_FUNC
#endif

typedef void (*bench_trigger_handler_t)(void);

int bench_trigger_init(void);
void bench_trigger_set_handler(bench_trigger_handler_t handler);
void bench_trigger(void);

/* ISR wrapper installed on the benchmark IRQ line */
BENCH_ISR_FUNC void bench_trigger_isr(const void *arg);

#ifdef CONFIG_INT_BENCH_TRIGGER_SW_IRQ
unsigned int bench_trigger_irq_line(void);

/*
 * Second benchmark IRQ line.
 *
 * Scenarios that compare two ways of connecting an interrupt need a
 * line of their own, because the connection method is fixed at build
 * time. The line number has to be visible here rather than staying
 * private to the backend, since IRQ_DIRECT_CONNECT() is expanded where
 * the handler is defined.
 *
 * RISC-V is absent on purpose: without a CLIC the machine software
 * interrupt is the only interrupt a hart can raise on itself, and the
 * first line already uses it.
 */
#if CONFIG_INT_BENCH_IRQ_LINE_ALT >= 0
#define BENCH_IRQ_LINE_ALT CONFIG_INT_BENCH_IRQ_LINE_ALT
#define BENCH_HAS_ALT_LINE 1
#elif defined(CONFIG_GIC)
/* SGI 0-2 are Zephyr's SMP IPIs and 8-15 may be Secure only */
#define BENCH_IRQ_LINE_ALT 7
#define BENCH_HAS_ALT_LINE 1
#elif defined(CONFIG_BOARD_QEMU_CORTEX_M3)
#define BENCH_IRQ_LINE_ALT 41
#define BENCH_HAS_ALT_LINE 1
#elif defined(CONFIG_X86)
#define BENCH_IRQ_LINE_ALT 28
#define BENCH_HAS_ALT_LINE 1
#elif defined(CONFIG_CPU_CORTEX_M) || defined(CONFIG_ARC)
#define BENCH_IRQ_LINE_ALT (CONFIG_NUM_IRQS - 2)
#define BENCH_HAS_ALT_LINE 1
#endif

#ifdef BENCH_HAS_ALT_LINE
/* Raise the interrupt on the second line */
void bench_trigger_alt(void);
#endif
#endif /* CONFIG_INT_BENCH_TRIGGER_SW_IRQ */

#endif /* ZEPHYR_TESTS_BENCHMARKS_INTERRUPT_LATENCY_SRC_TRIGGER_H_ */
```

## src/trigger_offload.c
```c
/*
 * SPDX-FileCopyrightText: Copyright The Zephyr Project Contributors
 * SPDX-License-Identifier: Apache-2.0
 */

/*
 * Fallback trigger backend based on irq_offload(). Portable to every
 * architecture, but the handler runs from a synchronous software trap
 * rather than an asynchronous interrupt: only the interrupt exit paths
 * are meaningfully measured with this backend.
 */

#include <zephyr/kernel.h>
#include <zephyr/irq_offload.h>

#include "trigger.h"

static bench_trigger_handler_t trigger_handler;

BENCH_ISR_FUNC void bench_trigger_isr(const void *arg)
{
	ARG_UNUSED(arg);

	if (trigger_handler != NULL) {
		trigger_handler();
	}
}

void bench_trigger_set_handler(bench_trigger_handler_t handler)
{
	trigger_handler = handler;
}

int bench_trigger_init(void)
{
	return 0;
}

void bench_trigger(void)
{
	irq_offload(bench_trigger_isr, NULL);
}
```

## src/trigger_sw_irq.c
```c
/*
 * SPDX-FileCopyrightText: Copyright The Zephyr Project Contributors
 * SPDX-License-Identifier: Apache-2.0
 */

/*
 * Trigger backend raising a real asynchronous interrupt through the
 * platform interrupt controller. The per-architecture trigger methods
 * are adapted from subsys/testsuite/include/zephyr/interrupt_util.h,
 * which is the mechanism proven by tests/arch/common/interrupt.
 */

#include <zephyr/kernel.h>
#include <zephyr/irq.h>

#include "trigger.h"

/*
 * Benchmark IRQ line selection. CONFIG_INT_BENCH_IRQ_LINE overrides;
 * otherwise pick a platform-appropriate default.
 */
#if CONFIG_INT_BENCH_IRQ_LINE >= 0
#define BENCH_IRQ_LINE CONFIG_INT_BENCH_IRQ_LINE
#elif defined(CONFIG_GIC)
/*
 * Use an SGI (software generated interrupt) line. SGI 0-2 are used by
 * Zephyr for SMP IPIs and SGI 8-15 may be inaccessible from the
 * Non-Secure state, so use SGI 6.
 */
#define BENCH_IRQ_LINE 6
#elif defined(CONFIG_BOARD_QEMU_CORTEX_M3)
/*
 * QEMU's NVIC model for this board does not implement all
 * CONFIG_NUM_IRQS lines; line 42 is implemented and unused (same line
 * used by tests/arch/common/interrupt).
 */
#define BENCH_IRQ_LINE 42
#elif defined(CONFIG_X86)
/*
 * x86 has no CONFIG_NUM_IRQS; IRQ lines are mapped to IDT vectors at
 * build time. Use the same line as tests/arch/common/interrupt, which
 * is known not to collide with the platform's own IRQ assignments.
 */
#define BENCH_IRQ_LINE 27
#elif defined(CONFIG_RISCV) && !defined(CONFIG_CLIC) && !defined(CONFIG_NRFX_CLIC)
/*
 * Without a CLIC, the only interrupt a RISC-V hart can raise on itself
 * is the machine software interrupt, asserted through the CLINT.
 */
#define BENCH_IRQ_LINE RISCV_IRQ_MSOFT
#else
#define BENCH_IRQ_LINE (CONFIG_NUM_IRQS - 1)
#endif

/*
 * Deassert a level triggered benchmark interrupt. Called at the very
 * start of the ISR, before the measurement handler, so that the
 * throughput scenario can reassert the interrupt from within its own
 * handler.
 */
static inline void bench_trigger_ack(void);

static bench_trigger_handler_t trigger_handler;

BENCH_ISR_FUNC void bench_trigger_isr(const void *arg)
{
	ARG_UNUSED(arg);

	bench_trigger_ack();

	if (trigger_handler != NULL) {
		trigger_handler();
	}
}

void bench_trigger_set_handler(bench_trigger_handler_t handler)
{
	trigger_handler = handler;
}

unsigned int bench_trigger_irq_line(void)
{
	return BENCH_IRQ_LINE;
}

#if defined(CONFIG_CPU_CORTEX_M)
#include <cmsis_core.h>

void bench_trigger(void)
{
#if defined(CONFIG_SOC_TI_LM3S6965_QEMU) || defined(CONFIG_CPU_CORTEX_M0) ||                       \
	defined(CONFIG_CPU_CORTEX_M0PLUS) || defined(CONFIG_CPU_CORTEX_M1) ||                      \
	defined(CONFIG_ARMV6_M_ARMV8_M_BASELINE)
	/* QEMU does not simulate the STIR register: this is a workaround */
	NVIC_SetPendingIRQ(BENCH_IRQ_LINE);
#else
	NVIC->STIR = BENCH_IRQ_LINE;
#endif
}

#ifdef BENCH_HAS_ALT_LINE
void bench_trigger_alt(void)
{
#if defined(CONFIG_SOC_TI_LM3S6965_QEMU) || defined(CONFIG_CPU_CORTEX_M0) ||                       \
	defined(CONFIG_CPU_CORTEX_M0PLUS) || defined(CONFIG_CPU_CORTEX_M1) ||                      \
	defined(CONFIG_ARMV6_M_ARMV8_M_BASELINE)
	NVIC_SetPendingIRQ(BENCH_IRQ_LINE_ALT);
#else
	NVIC->STIR = BENCH_IRQ_LINE_ALT;
#endif
}
#endif

#elif defined(CONFIG_GIC)
#include <zephyr/drivers/interrupt_controller/gic.h>
#include <zephyr/dt-bindings/interrupt-controller/arm-gic.h>

void bench_trigger(void)
{
#if CONFIG_GIC_VER <= 2
	sys_write32(GICD_SGIR_TGTFILT_REQONLY | GICD_SGIR_SGIINTID(BENCH_IRQ_LINE), GICD_SGIR);
#else
	uint64_t mpidr = GET_MPIDR();
	uint8_t aff0 = MPIDR_AFFLVL(mpidr, 0);

	gic_raise_sgi(BENCH_IRQ_LINE, mpidr, BIT(aff0));
#endif
}

#ifdef BENCH_HAS_ALT_LINE
void bench_trigger_alt(void)
{
#if CONFIG_GIC_VER <= 2
	sys_write32(GICD_SGIR_TGTFILT_REQONLY | GICD_SGIR_SGIINTID(BENCH_IRQ_LINE_ALT), GICD_SGIR);
#else
	uint64_t mpidr = GET_MPIDR();
	uint8_t aff0 = MPIDR_AFFLVL(mpidr, 0);

	gic_raise_sgi(BENCH_IRQ_LINE_ALT, mpidr, BIT(aff0));
#endif
}
#endif

#elif defined(CONFIG_ARC)

void bench_trigger(void)
{
	z_arc_v2_aux_reg_write(_ARC_V2_AUX_IRQ_HINT, BENCH_IRQ_LINE);
}

#ifdef BENCH_HAS_ALT_LINE
void bench_trigger_alt(void)
{
	z_arc_v2_aux_reg_write(_ARC_V2_AUX_IRQ_HINT, BENCH_IRQ_LINE_ALT);
}
#endif

#elif defined(CONFIG_X86)
#ifdef CONFIG_X2APIC
#include <zephyr/drivers/interrupt_controller/loapic.h>
#define VECTOR_MASK 0xFFU
#else
#include <zephyr/arch/arch_interface.h>
/*
 * LOAPIC ICR value for a self directed IPI: fixed delivery mode,
 * physical destination mode, level assert, edge triggered, no
 * destination shorthand.
 */
#define LOAPIC_ICR_IPI_TEST 0x00004000U
#endif

/*
 * The interrupt is emulated by sending an IPI from the local APIC to
 * the core itself. Note that unlike trigger_irq() in
 * <zephyr/interrupt_util.h>, no delay loop is added after the write:
 * the delay would be counted as interrupt entry latency. Callers spin
 * on a flag set by the ISR instead.
 */
static uint8_t bench_vector;
#ifdef BENCH_HAS_ALT_LINE
static uint8_t bench_vector_alt;
#endif

static inline void bench_send_self_ipi(uint8_t vector)
{
#ifdef CONFIG_X2APIC
	x86_write_x2apic(LOAPIC_SELF_IPI, vector & VECTOR_MASK);
#else
#ifdef CONFIG_SMP
	int cpu_id = arch_curr_cpu()->id;
#else
	int cpu_id = 0;
#endif
	z_loapic_ipi(cpu_id, LOAPIC_ICR_IPI_TEST, vector);
#endif /* CONFIG_X2APIC */
}

void bench_trigger(void)
{
	bench_send_self_ipi(bench_vector);
}

#ifdef BENCH_HAS_ALT_LINE
void bench_trigger_alt(void)
{
	bench_send_self_ipi(bench_vector_alt);
}
#endif

#elif defined(CONFIG_RISCV)
#if defined(CONFIG_CLIC) || defined(CONFIG_NRFX_CLIC)
void riscv_clic_irq_set_pending(uint32_t irq);

void bench_trigger(void)
{
	riscv_clic_irq_set_pending(BENCH_IRQ_LINE);
}

#else
#include <zephyr/arch/riscv/csr.h>

/*
 * Without a CLIC, a hart cannot make one of its own external
 * interrupts pending: PLIC pending bits are driven by the interrupt
 * gateways, and the machine software, timer and external pending bits
 * of the mip CSR are read only. The machine software interrupt is
 * therefore asserted the same way the SMP IPI code does it, by writing
 * this hart's MSIP register in the CLINT.
 *
 * MSIP is level triggered, so the ISR has to deassert it; see
 * bench_trigger_ack() below.
 *
 * Both the CLINT and mhartid are machine mode only, which is why
 * CONFIG_INT_BENCH_TRIGGER_SW_IRQ excludes CONFIG_RISCV_S_MODE.
 */
#define CLINT_NODE DT_NODELABEL(clint)
#if !DT_NODE_EXISTS(CLINT_NODE)
#error "No CLIC and no 'clint' devicetree node: cannot trigger an interrupt"
#endif

#define MSIP_BASE    DT_REG_ADDR_RAW(CLINT_NODE)
#define MSIP(hartid) ((volatile uint32_t *)MSIP_BASE)[hartid]

#define BENCH_TRIGGER_LEVEL_ACK 1

void bench_trigger(void)
{
	MSIP(csr_read(mhartid)) = 1U;
}

static inline void bench_trigger_ack(void)
{
	MSIP(csr_read(mhartid)) = 0U;
}
#endif /* CONFIG_CLIC || CONFIG_NRFX_CLIC */

#else
#error "No software interrupt trigger available for this architecture"
#endif

#ifndef BENCH_TRIGGER_LEVEL_ACK
static inline void bench_trigger_ack(void)
{
	/* Edge triggered: nothing to deassert */
}
#endif

int bench_trigger_init(void)
{
	IRQ_CONNECT(BENCH_IRQ_LINE, CONFIG_INT_BENCH_IRQ_PRIO, bench_trigger_isr, NULL, 0);

#ifdef CONFIG_X86
	/*
	 * The local APIC is addressed by IDT vector rather than by IRQ
	 * line. Resolve the vector assigned to the benchmark line once,
	 * so that triggering costs no more than the APIC write itself.
	 */
	bench_vector = (uint8_t)Z_IRQ_TO_INTERRUPT_VECTOR(BENCH_IRQ_LINE);
#ifdef BENCH_HAS_ALT_LINE
	bench_vector_alt = (uint8_t)Z_IRQ_TO_INTERRUPT_VECTOR(BENCH_IRQ_LINE_ALT);
#endif
#endif

	irq_enable(BENCH_IRQ_LINE);

	return 0;
}
```
