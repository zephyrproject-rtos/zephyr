## tests/benchmarks/latency_measure/testcase.yaml
```yaml
common:
  platform_key:
    - arch
  tags:
    - kernel
    - benchmark
tests:
  benchmark.kernel.latency:
    # FIXME: no DWT and no RTC_TIMER for qemu_cortex_m0
    platform_exclude:
      - qemu_cortex_m0
      - m2gl025_miv
    filter: CONFIG_PRINTK and not CONFIG_SOC_FAMILY_STM32
    harness: console
    integration_platforms:
      - qemu_x86
      - qemu_arc/qemu_arc_em
      - qemu_riscv64/qemu_virt_riscv64/smp
    harness_config:
      type: one_line
      record:
        regex:
          - "(?P<metric>.*) - (?P<description>.*):(?P<cycles>.*) cycles ,(?P<nanoseconds>.*) ns"
      regex:
        - "PROJECT EXECUTION SUCCESSFUL"

  # Cortex-M has 24bit systick, so default 1 TICK per seconds
  # is achievable only if frequency is below 0x00FFFFFF (around 16MHz)
  # 20 Ticks per secondes allows a frequency up to 335544300Hz (335MHz)
  benchmark.kernel.latency.stm32:
    arch_allow: arm
    filter: CONFIG_PRINTK and CONFIG_SOC_FAMILY_STM32
    extra_configs:
      - CONFIG_SYS_CLOCK_TICKS_PER_SEC=20
    harness: console
    harness_config:
      type: one_line
      record:
        regex:
          - "(?P<metric>.*) - (?P<description>.*):(?P<cycles>.*) cycles ,(?P<nanoseconds>.*) ns"
      regex:
        - "PROJECT EXECUTION SUCCESSFUL"

  # Obtain the benchmark results for various user thread / kernel thread
  # configurations on platforms that support user space.
  benchmark.kernel.latency.userspace:
    filter: CONFIG_ARCH_HAS_USERSPACE
    timeout: 300
    extra_configs:
      - CONFIG_USERSPACE=y
    harness: console
    integration_platforms:
      - qemu_x86
      - qemu_cortex_a53
    harness_config:
      type: one_line
      record:
        regex:
          - "(?P<metric>.*) - (?P<description>.*):(?P<cycles>.*) cycles ,(?P<nanoseconds>.*) ns"
      regex:
        - "PROJECT EXECUTION SUCCESSFUL"

  benchmark.kernel.latency.objcore:
    # FIXME: no DWT and no RTC_TIMER for qemu_cortex_m0
    platform_exclude:
      - qemu_cortex_m0
      - m2gl025_miv
    filter: CONFIG_PRINTK and not CONFIG_SOC_FAMILY_STM32
    timeout: 300
    extra_configs:
      - CONFIG_OBJ_CORE=y
      - CONFIG_OBJ_CORE_STATS=y
    harness: console
    integration_platforms:
      - qemu_x86
      - qemu_arc/qemu_arc_em
      - qemu_riscv64/qemu_virt_riscv64/smp
    harness_config:
      type: one_line
      record:
        regex:
          - "(?P<metric>.*) - (?P<description>.*):(?P<cycles>.*) cycles ,(?P<nanoseconds>.*) ns"
      regex:
        - "PROJECT EXECUTION SUCCESSFUL"
```

## tests/benchmarks/mbedtls/testcase.yaml
```yaml
common:
  harness: console
  harness_config:
    type: one_line
    regex:
      - "Benchmark completed"
  timeout: 10
  tags: crypto
  arch_exclude:
    - posix
tests:
  benchmark.crypto.mbedtls:
    filter: CONFIG_TEST_RANDOM_GENERATOR
    integration_platforms:
      - qemu_x86
    platform_exclude:
      - imx95_var_dart/mimx9596/m7
      - imx95_var_dart/mimx9596/a55
```

## tests/benchmarks/memory_allocators/testcase.yaml
```yaml
# Copyright (c) 2026 Måns Ansgariusson <mansgariusson@gmail.com>
# SPDX-License-Identifier: Apache-2.0

tests:
  benchmark.memory_allocators:
    tags:
      - benchmark
    min_ram: 32
    timeout: 120
    integration_platforms:
      - qemu_x86
    arch_exclude:
      - posix
```

## tests/benchmarks/object_footprint/Kconfig
```kconfig
mainmenu "Zephyr Object Sizes"

source "$(ZEPHYR_BASE)/Kconfig.zephyr"

config OBJECTS_PRINTK
	bool "use printk"

config OBJECTS_WHILELOOP
	bool "run whileloop"
	default y

config OBJECTS_THREAD
	bool "enable thread"

config OBJECTS_SEMAPHORE
	bool "enable semaphore"

config OBJECTS_LIFO
	bool "enable lifo"

config OBJECTS_FIFO
	bool "enable fifo"

config OBJECTS_STACK
	bool "enable stack"

config OBJECTS_TIMER
	bool "enable timer"

config THREAD_STACK_SIZE
	int "set thread stack size"
	default 512
	depends on OBJECTS_THREAD

config STATIC_ISR
	bool "static isr"
	default y
```

## tests/benchmarks/object_footprint/testcase.yaml
```yaml
tests:
  benchmark.footprint.001:
    build_only: true
    extra_args: CONF_FILE=prj01.conf
    platform_whitelist: qemu_x86
    tags: footprint
  benchmark.footprint.002:
    build_only: true
    extra_args: CONF_FILE=prj02.conf
    platform_whitelist: qemu_x86
    tags: footprint
  benchmark.footprint.003:
    build_only: true
    extra_args: CONF_FILE=prj03.conf
    platform_whitelist: qemu_x86
    tags: footprint
  benchmark.footprint.004:
    build_only: true
    extra_args: CONF_FILE=prj04.conf
    platform_whitelist: qemu_x86
    tags: footprint
  benchmark.footprint.005:
    build_only: true
    extra_args: CONF_FILE=prj05.conf
    platform_whitelist: qemu_x86
    tags: footprint
  benchmark.footprint.006:
    build_only: true
    extra_args: CONF_FILE=prj06.conf
    platform_whitelist: qemu_x86
    tags: footprint
  benchmark.footprint.007:
    build_only: true
    extra_args: CONF_FILE=prj07.conf
    platform_whitelist: qemu_x86
    tags: footprint
  benchmark.footprint.008:
    build_only: true
    extra_args: CONF_FILE=prj08.conf
    platform_whitelist: qemu_x86
    tags: footprint
  benchmark.footprint.009:
    build_only: true
    extra_args: CONF_FILE=prj09.conf
    platform_whitelist: qemu_x86
    tags: footprint
  benchmark.footprint.010:
    build_only: true
    extra_args: CONF_FILE=prj10.conf
    platform_whitelist: qemu_x86
    tags: footprint
  benchmark.footprint.011:
    build_only: true
    extra_args: CONF_FILE=prj11.conf
    platform_whitelist: qemu_x86
    tags: footprint
```

## tests/benchmarks/pmu/boards/versalnet_apu_amd_versalnet_apu_smp.conf
```kconfig
# Copyright (c) 2026 Advanced Micro Devices, Inc.
# SPDX-License-Identifier: Apache-2.0

# SMP builds require CONFIG_SCHED_CPU_MASK for CPU pinning.
# PMU registers are per-CPU; without pinning, thread migration
# between CPUs would produce invalid measurements.
CONFIG_SCHED_SIMPLE=y
CONFIG_SCHED_CPU_MASK=y
```

## tests/benchmarks/pmu_benchmarks/testcase.yaml
```yaml
tests:
  benchmarks.pmu_benchmarks:
    extra_args:
      - EXTRA_CONF_FILE="prj_arm64.conf"
    tags:
      - benchmark
      - kernel
      - pmu
      - arm64
    arch_allow:
      - arm64
    # QEMU does not emulate PMU counters; all benchmark tests are skipped there.
    # The QEMU platforms are listed to allow compile-time validation only.
    # Meaningful results require real hardware with PMU access enabled by the
    # bootloader/TF-A.
    platform_allow:
      - versal_apu
      - versalnet_apu
      - versalnet_apu/amd_versalnet_apu/smp
      - versal2_apu
      - versal2_apu/amd_versal2_apu/smp
    integration_platforms:
      - versalnet_apu
    harness: console
    harness_config:
      type: multi_line
      regex:
        - "(PMU benchmark skipped: no PMU or init failed|\
           PMU counters verified: non-zero cycle and event counts)"
        - "PROJECT EXECUTION SUCCESSFUL"
```

## tests/benchmarks/posix/threads/testcase.yaml
```yaml
common:
  tags:
    - posix
    - benchmark
  min_ram: 64
  arch_exclude:
    - posix
  integration_platforms:
    - qemu_cortex_a53/qemu_cortex_a53/smp
    - qemu_riscv/qemu_virt_riscv/rv64/smp
    - qemu_riscv/qemu_virt_riscv/rv32/smp
    - qemu_x86_64
  harness: console
  harness_config:
    type: one_line
    record:
      regex:
        - "(?P<api>.*), ALL, (?P<time>.*), (?P<threads>.*), (?P<cores>.*), (?P<rate>.*)"
    regex:
      - "PROJECT EXECUTION SUCCESSFUL"
tests:
  benchmark.posix.threads: {}
```

## tests/benchmarks/power_management/testcase.yaml
```yaml
tests:
  benchmark.kernel.power_management:
    filter: CONFIG_SYS_PM_MIN_RESIDENCY_SLEEP_1 and CONFIG_SYS_PM_MIN_RESIDENCY_DEEP_SLEEP_1
    tags: benchmark 
```

## tests/benchmarks/psa_crypto/testcase.yaml
```yaml
common:
  timeout: 30
  tags:
    - benchmark
    - crypto
  arch_exclude:
    - posix
tests:
  benchmark.crypto.psa:
    filter: CONFIG_TEST_RANDOM_GENERATOR
    integration_platforms:
      - qemu_x86
```

## tests/benchmarks/sched/testcase.yaml
```yaml
tests:
  benchmark.kernel.scheduler:
    tags:
      - benchmark
      - kernel
    integration_platforms:
      - mps2/an385
      - qemu_x86
    slow: true
    harness: console
    harness_config:
      type: multi_line
      regex:
        - "unpend\\s+\\d* ready\\s+\\d* switch\\s+\\d* pend\\s+\\d* tot\\s+\\d* \\(avg\\s+\\d*\\)"
        - "fin"
```

## tests/benchmarks/sched_queues/Kconfig
```kconfig
# Copyright (c) 2024 Intel Corporation
# SPDX-License-Identifier: Apache-2.0

mainmenu "Scheduler Queue Benchmark"

source "Kconfig.zephyr"

config BENCHMARK_NUM_ITERATIONS
	int "Number of iterations to gather data"
	default 1000
	help
	  This option specifies the number of times each test will be executed
	  before calculating the average times for reporting.

config BENCHMARK_NUM_THREADS
	int "Number of threads"
	default 100
	help
	  This option specifies the maximum number of threads that the test
	  will add to the ready queue. Increasing this value will places greater
	  stress on the ready queue and better highlight the performance
	  differences as the number of threads in the ready queue changes.

config BENCHMARK_RECORDING
	bool "Log statistics as records"
	default n
	help
	  Log summary statistics as records to pass results
	  to the Twister JSON report and recording.csv file(s).

config BENCHMARK_VERBOSE
	bool "Display detailed results"
	default n
	help
	  This option displays the average time of all the iterations done for
	  each thread in the tests. This generates large amounts of output. To
	  analyze it, it is recommended to redirect the output to a file.
```

## tests/benchmarks/sched_queues/testcase.yaml
```yaml
common:
  platform_key:
    - arch
  min_ram: 32
  timeout: 120
  tags:
    - kernel
    - benchmark
  integration_platforms:
    - qemu_x86
    - qemu_cortex_a53
  harness: console
  harness_config:
    type: one_line
    regex:
      - "PROJECT EXECUTION SUCCESSFUL"
    record:
      regex:
        - "REC: (?P<metric>.*) - (?P<description>.*):(?P<cycles>.*) cycles ,(?P<nanoseconds>.*) ns"
  extra_configs:
    - CONFIG_BENCHMARK_RECORDING=y

tests:
  benchmark.sched_queues.dumb:
    extra_configs:
      - CONFIG_SCHED_DUMB=y

  benchmark.sched_queues.scalable:
    extra_configs:
      - CONFIG_SCHED_SCALABLE=y

  benchmark.sched_queues.multiq:
    extra_configs:
      - CONFIG_SCHED_MULTIQ=y
```

## tests/benchmarks/sched_userspace/testcase.yaml
```yaml
tests:
  benchmark.kernel.scheduler_userspace:
    arch_allow: arm64
    tags:
      - kernel
      - benchmark
      - userspace
    filter: CONFIG_ARCH_HAS_USERSPACE
    slow: true
    arch_exclude:
      - posix
    timeout: 300
    harness: console
    harness_config:
      type: one_line
      regex:
        - "SUCCESS"
```

## tests/benchmarks/sys_kernel/testcase.yaml
```yaml
tests:
  benchmark.kernel.core:
    platform_key:
      - arch
    tags:
      - kernel
      - benchmark
    arch_exclude:
      - xtensa
    min_ram: 32
    timeout: 120
```

## tests/benchmarks/thread_metric/Kconfig
```kconfig
# Copyright (c) 2024 Intel Corporation
# SPDX-License-Identifier: Apache-2.0

mainmenu "Eclipse ThreadX Thread-Metric RTOS Test Suite"

source "Kconfig.zephyr"

choice TM_TEST
	prompt "Select a Thread-Metric test to execute"
	default TM_PREEMPTIVE
	help
	  The Thread-Metric benchmark suite consists of eight RTOS tests.
	  These tests measure the total number of RTOS events that can be
	  processed during a 30 second time interval.

config TM_BASIC
	bool "Baseline basic benchmark"
	help
	  The baseline basic benchmark consists of a single thread that counts
	  the number of times it performs a set of calculations. This number
	  is reported every 30 seconds.

config TM_COOPERATIVE
	bool "Cooperative context switching"
	help
	  The cooperative context switching benchmark spawns five (5) threads
	  of equal priority that yield to each other and increment counters
	  on each context switch. The sum total of the counters is reported
	  every 30 seconds.

config TM_INTERRUPT
	bool "Interrupt processing"
	select TEST
	select IRQ_OFFLOAD
	select IRQ_OFFLOAD_NESTED
	help
	  The interrupt processing benchmark has a single thread that causes
	  an interrupt which results in its ISR incrementing a counter and then
	  posting a semaphore. The thread then increments its own counter and
	  takes that semaphore. The sum total of the counters is reported
	  every 30 seconds.

config TM_INTERRUPT_PREEMPTION
	bool "Interrupt processing preemption"
	select TEST
	select IRQ_OFFLOAD
	select IRQ_OFFLOAD_NESTED
	help
	  The interrupt preemption benchmark counts the number of times that
	  an ISR from a software generated interrupt results in the preemption
	  of a thread. The total number of context switches is reported every
	  30 seconds.

config TM_MEMORY_ALLOCATION
	bool "Memory allocation"
	help
	  The memory allocation benchmark counts the number of times a thread
	  is able to allocate and then release a 128-byte block. This number
	  is reported every 30 seconds.

config TM_MESSAGE
	bool "Message processing"
	help
	  The message processing benchmark counts the number of times that a
	  thread can send and receive a 16-byte message from a message queue.
	  This number is reported every 30 seconds.

config TM_PREEMPTIVE
	bool "Preemptive context switching"
	help
	  The preemptive context switching benchmark creates five (5) threads
	  of different priorities that suspend and resume each other in a
	  cyclical pattern. The total number of context switches is reported
	  every 30 seconds.

config TM_SYNCHRONIZATION
	bool "Synchronization"
	help
	  The synchronization benchmark counts the number of times that a
	  thread can give and take a semaphore without blocking. This number
	  is reported every 30 seconds.

endchoice
```

## tests/benchmarks/thread_metric/testcase.yaml
```yaml
common:
  tags:
    - kernel
    - benchmark
  # Native platforms excluded as they are not relevant: These benchmarks run some kernel primitives
  # in a loop during a predefined time counting how many times they execute. But in the POSIX arch,
  # time does not pass while the CPU executes. So the benchmark just appears as if hung.
  arch_exclude:
    - posix
  # qemu_nios2 excluded as it is slow
  platform_exclude:
    - qemu_nios2
  integration_platforms:
    - qemu_x86
    - qemu_cortex_a53
  timeout: 300
  harness: console
  harness_config:
    type: one_line
    regex:
      - "(.*) Relative Time: (.*)"

tests:
  benchmark.thread_metric.basic:
    extra_configs:
      - CONFIG_TM_BASIC=y

  benchmark.thread_metric.cooperative:
    extra_configs:
      - CONFIG_TM_COOPERATIVE=y

  benchmark.thread_metric.interrupt:
    extra_configs:
      - CONFIG_TM_INTERRUPT=y

  benchmark.thread_metric.interrupt_preemption:
    extra_configs:
      - CONFIG_TM_INTERRUPT_PREEMPTION=y

  benchmark.thread_metric.memory_allocation:
    extra_configs:
      - CONFIG_TM_MEMORY_ALLOCATION=y

  benchmark.thread_metric.message:
    extra_configs:
      - CONFIG_TM_MESSAGE=y

  benchmark.thread_metric.preemptive:
    extra_configs:
      - CONFIG_TM_PREEMPTIVE=y

  benchmark.thread_metric.synchronization:
    extra_configs:
      - CONFIG_TM_SYNCHRONIZATION=y
```
