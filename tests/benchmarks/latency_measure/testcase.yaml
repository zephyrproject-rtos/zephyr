## tests/benchmarks/timeout_mgmt/Kconfig
```kconfig
# Copyright (c) 2026 Intel Corporation
# SPDX-License-Identifier: Apache-2.0

mainmenu "Timeout Management Benchmark"

source "Kconfig.zephyr"

config BENCHMARK_NUM_ITERATIONS
	int "Number of iterations to gather data"
	default 1000
	help
	  This option specifies the number of times each test will be executed
	  before calculating the average times for reporting.

config BENCHMARK_NUM_TIMEOUTS
	int "Number of timeouts"
	default 100
	help
	  This option specifies the maximum number of timeouts that the test
	  will create. Increasing this value will place greater stress on
	  the timeout management system.

config BENCHMARK_TIMEOUT_BIAS
	int "Timeout bias (ticks) to apply to the timeouts"
	default 0
	help
	  This option specifies the number of ticks to add to each of the
	  timeouts created by the test. This bias can be used to ensure that
	  timeouts do not expire mid-test which could skew the results.


config BENCHMARK_VERBOSE
	bool "Display detailed results"
	default n
	help
	  This option displays the average time of all the iterations done for
	  each timeout in the tests. This generates large amounts of output. To
	  analyze it, it is recommended to redirect the output to a file.
```

## tests/benchmarks/timeout_mgmt/testcase.yaml
```yaml
common:
  platform_key:
    - arch
  min_ram: 32
  timeout: 120
  tags:
    - kernel
    - benchmark
  integration_platforms:
    - qemu_x86
    - qemu_cortex_a53
  harness: console

tests:
  benchmark.timeout_mgmt.simple:
    extra_configs:
      - CONFIG_TIMEOUT_MANAGEMENT_DELTAQ=y
    harness_config:
      type: one_line
      regex:
        - "PROJECT EXECUTION SUCCESSFUL"
  benchmark.timeout_mgmt.wheel:
    extra_configs:
      - CONFIG_TIMEOUT_MANAGEMENT_WHEEL=y
    harness_config:
      type: one_line
      regex:
        - "PROJECT EXECUTION SUCCESSFUL"
```

## tests/benchmarks/timeslicing/testcase.yaml
```yaml
common:
  platform_key:
    - arch
  tags:
    - kernel
    - benchmark
  # Native platforms excluded as they are not relevant: These benchmarks run some kernel primitives
  # in a loop during a predefined time counting how many times they execute. But in the POSIX arch,
  # time does not pass while the CPU executes. So the benchmark just appears as if hung.
  arch_exclude:
    - posix
  # some slow qemu_* excluded
  platform_exclude:
    - qemu_malta/qemu_malta
    - qemu_malta/qemu_malta/be
    - qemu_nios2
  integration_platforms:
    - qemu_x86
    - qemu_cortex_a53
  timeout: 300
  harness: console
  harness_config:
    type: multi_line
    ordered: true
    regex:
      # Collect at least 3 measurements for each benchmark:
      - "(.*) Time Interval ending (.*)"
      - "(.*) Total number of ctx switches: (.*)"
      - "(.*) Time Interval ending (.*)"
      - "(.*) Total number of ctx switches: (.*)"
      - "(.*) Time Interval ending (.*)"
      - "(.*) Total number of ctx switches: (.*)"

tests:
  benchmark.timeslicing.auto_reset:
    extra_configs:
      - CONFIG_TIMESLICING=y
      - CONFIG_TIMESLICE_AUTO_RESET=y

  benchmark.timeslicing.no_auto_reset:
    extra_configs:
      - CONFIG_TIMESLICING=y
      - CONFIG_TIMESLICE_AUTO_RESET=n

  benchmark.no_timeslicing:
    extra_configs:
      - CONFIG_TIMESLICING=n
```

## tests/benchmarks/timing_info/testcase.yaml
```yaml
tests:
  benchmark.kernel.timing.default:
    arch_exclude: posix
    tags: benchmark
    harness: console
    harness_config:
      type: one_line
      record:
        regex: "(?P<metric>.*):(?P<cycles>.*) cycles ,(?P<nanoseconds>.*) ns"
      regex:
        - "PROJECT EXECUTION SUCCESSFUL"
  benchmark.kernel.timing.userspace:
    filter: CONFIG_ARCH_HAS_USERSPACE
    extra_args: CONF_FILE=prj_userspace.conf
    arch_whitelist: x86 arm arc
    tags: benchmark userspace
    harness: console
    harness_config:
      type: one_line
      record:
        regex: "(?P<metric>.*):(?P<cycles>.*) cycles ,(?P<nanoseconds>.*) ns"
      regex:
        - "PROJECT EXECUTION SUCCESSFUL"
```

## tests/benchmarks/wait_queues/Kconfig
```kconfig
# Copyright (c) 2024 Intel Corporation
# SPDX-License-Identifier: Apache-2.0

mainmenu "Wait Queue Benchmark"

source "Kconfig.zephyr"

config BENCHMARK_NUM_ITERATIONS
	int "Number of iterations to gather data"
	default 1000
	help
	  This option specifies the number of times each test will be executed
	  before calculating the average times for reporting.

config BENCHMARK_NUM_THREADS
	int "Number of threads"
	default 100
	help
	  This option specifies the maximum number of threads that the test
	  will add to a wait queue. Increasing this value will places greater
	  stress on the wait queues and better highlight the performance
	  differences as the number of threads in the wait queue changes.

config BENCHMARK_VERBOSE
	bool "Display detailed results"
	default y
	help
	  This option displays the average time of all the iterations done for
	  each thread in the tests. This generates large amounts of output. To
	  analyze it, it is recommended redirect or copy the data to a file.
```

## tests/benchmarks/wait_queues/testcase.yaml
```yaml
common:
  platform_key:
    - arch
  tags:
    - kernel
    - benchmark
  integration_platforms:
    - qemu_x86
    - qemu_cortex_a53
  timeout: 120
  harness: console
  harness_config:
    type: one_line
    regex:
      - "PROJECT EXECUTION SUCCESSFUL"
    record:
      regex:
        - "REC: (?P<metric>.*) - (?P<description>.*):(?P<cycles>.*) cycles ,(?P<nanoseconds>.*) ns"
  extra_configs:
    - CONFIG_BENCHMARK_RECORDING=y

tests:
  benchmark.wait_queues.simple:
    extra_configs:
      - CONFIG_WAITQ_SIMPLE=y

  benchmark.wait_queues.scalable:
    extra_configs:
      - CONFIG_WAITQ_SCALABLE=y
```

## tests/bluetooth/addr/testcase.yaml
```yaml
tests:
  bluetooth.addr:
    extra_args:
      - EXTRA_DTC_OVERLAY_FILE="test.overlay"
    platform_allow:
      - native_sim
      - native_sim/native/64
      - qemu_x86
      - qemu_cortex_m3
    tags:
      - bluetooth
      - addr
    integration_platforms:
      - native_sim
```

## tests/bluetooth/adv/testcase.yaml
```yaml
tests:
  bluetooth.adv:
    platform_allow:
      - nrf52_bsim/nrf52833
      - nrf51dk/nrf51822
      - nrf52840dk/nrf52840
    tags: bluetooth
    slow: true
    timeout: 360
    integration_platforms:
      - nrf51dk/nrf51822
```
