## CMakeLists.txt
```
cmake_minimum_required(VERSION 3.20.0)
find_package(Zephyr REQUIRED HINTS $ENV{ZEPHYR_BASE})
project(system_test)

FILE(GLOB app_sources src/*.c)
include_directories(include)
target_sources(app PRIVATE ${app_sources})
```

## prj.conf
```kconfig
CONFIG_TIMER=y
# Enable heap memory allocation support
CONFIG_HEAP_MEM_POOL_SIZE=4096
# CONFIG_MAIN_STACK_SIZE=4096
CONFIG_RING_BUFFER=y
CONFIG_TEST_RANDOM_GENERATOR=y
```

## src/main.c
```c
/*
 * Copyright (c) 2024 Intel Corporation
 *
 * SPDX-License-Identifier: Apache-2.0
 */

#include <stdio.h>
#include <zephyr/kernel.h>

#include "timer_management.h"
#include "log_management.h"
#include "data_management.h"
#include "thread_management.h"

/* Main application function */
int main(void)
{
	log_init_output();
	log_printDescription();
	fprintf(output_file, "TEST: Start.");
	fprintf(output_file, "\n-> Preparing random data...");
	prepare_data();
	fprintf(output_file, "\n-> Creating threads...");
	thr_create();
	fprintf(output_file, "\n-> Creating timers...");
	tmr_create();
	fprintf(output_file, "\n-> Pushing data to Fifo...");
	fifo_push();
	fprintf(output_file, "\n-> Pushing data to Lifo...");
	lifo_push();
	fprintf(output_file, "\n-> Pushing data to Stack...");
	stack_push();
	fprintf(output_file, "\n-> Pushing data to Ring Buffer...");
	ring_buf_push();
	fprintf(output_file, "\n-> Popping data from Fifo...");
	fifo_pop();
	fprintf(output_file, "\n-> Popping data from Lifo...");
	lifo_pop();
	fprintf(output_file, "\n-> Popping data from Stack...");
	stack_pop();
	fprintf(output_file, "\n-> Popping data from Ring Buffer...");
	ring_buf_pop();
	fprintf(output_file, "\n-> Waiting for join all threads...");
	thr_join_all();
	fprintf(output_file, "\nTEST: End.");

	tmr_summary();
	thr_summary();
	data_summary();

	return 0;
}
```

## include/data_management.h
```c
/*
 * Copyright (c) 2024 Intel Corporation
 *
 * SPDX-License-Identifier: Apache-2.0
 */

#ifndef __DATA_MANAGEMENT_H
#define __DATA_MANAGEMENT_H

#include <zephyr/kernel.h>
#include <zephyr/random/random.h>
#include <zephyr/sys/ring_buffer.h>
#include <stdio.h>

#define DATA_LEN 20

struct fifo_item_t {
	void *fifo_reserved;
	int data;
};

struct lifo_item_t {
	void *lifo_reserved;
	int data;
};

extern uint8_t fifo_pushed_data[DATA_LEN];
extern uint8_t fifo_popped_data[DATA_LEN];
extern uint8_t lifo_pushed_data[DATA_LEN];
extern uint8_t lifo_popped_data[DATA_LEN];
extern uint8_t stack_pushed_data[DATA_LEN];
extern uint8_t stack_popped_data[DATA_LEN];
extern uint8_t ring_buffer_pushed_data[DATA_LEN];
extern uint8_t ring_buffer_popped_data[DATA_LEN];

extern void prepare_data(void);
extern void fifo_push(void);
extern void fifo_pop(void);
extern void lifo_push(void);
extern void lifo_pop(void);
extern void stack_push(void);
extern void stack_pop(void);
extern void ring_buf_push(void);
extern void ring_buf_pop(void);
extern void data_summary(void);
extern bool compare_arrays(uint8_t *arr1, uint8_t *arr2, int size, bool rev);

#endif
```

## include/log_management.h
```c
/*
 * Copyright (c) 2024 Intel Corporation
 *
 * SPDX-License-Identifier: Apache-2.0
 */

#ifndef __LOG_MANAGEMENT_H
#define __LOG_MANAGEMENT_H

#include <zephyr/logging/log.h>
#include <zephyr/logging/log_ctrl.h>
#include <stdio.h>

extern FILE *output_file;

/* ANSI escape codes for colors */
#define RED(x)   "\x1b[31m" x "\x1b[0m"
#define GREEN(x) "\x1b[32m" x "\x1b[0m"

extern void log_init_output(void);
extern void log_print_data(char *title, uint8_t *data, uint8_t size);
extern void log_printDescription(void);

#endif
```

## include/thread_management.h
```c
/*
 * Copyright (c) 2024 Intel Corporation
 *
 * SPDX-License-Identifier: Apache-2.0
 */

#ifndef __THREAD_MANAGEMENT_H
#define __THREAD_MANAGEMENT_H

#include <zephyr/kernel.h>

#define THR_COUNT    50
#define THR_DATA_LEN 200
#define THR_PRIORITY 5

struct thr_dynamic {
	struct k_thread thread;
	int id;
	int delay;
	int wasCreated;
	int wasHandled;
};

extern void thr_entry_point(void *arg1, void *arg2, void *arg3);
extern void thr_create(void);
extern void thr_join_all(void);
extern void thr_summary(void);

#endif
```

## include/timer_management.h
```c
/*
 * Copyright (c) 2024 Intel Corporation
 *
 * SPDX-License-Identifier: Apache-2.0
 */

#ifndef __TIMER_MANAGEMENT_H_
#define __TIMER_MANAGEMENT_H_

#include <zephyr/kernel.h>

#define TMR_COUNT 50

struct tmr_dynamic {
	struct k_timer timer;
	int id;
	int period;
	bool wasCreated;
	bool wasExpired;
};

void tmr_expiry_function(struct k_timer *timer_id);
void tmr_create(void);
void tmr_summary(void);

#endif
```

## src/data_management.c
```c
/*
 * Copyright (c) 2024 Intel Corporation
 *
 * SPDX-License-Identifier: Apache-2.0
 */

#include "data_management.h"
#include "log_management.h"

K_MUTEX_DEFINE(data_mutex);

K_FIFO_DEFINE(fifo);
static struct fifo_item_t fifo_data[DATA_LEN];

K_LIFO_DEFINE(lifo);
static struct lifo_item_t lifo_data[DATA_LEN];

K_STACK_DEFINE(stack, DATA_LEN);

RING_BUF_DECLARE(ring_buf, DATA_LEN);

uint8_t fifo_pushed_data[DATA_LEN];
uint8_t fifo_popped_data[DATA_LEN];
uint8_t lifo_popped_data[DATA_LEN];
uint8_t lifo_pushed_data[DATA_LEN];
uint8_t stack_popped_data[DATA_LEN];
uint8_t stack_pushed_data[DATA_LEN];
uint8_t ring_buffer_pushed_data[DATA_LEN];
uint8_t ring_buffer_popped_data[DATA_LEN];

void prepare_data(void)
{
	for (uint8_t i = 0; i < DATA_LEN; i++) {
		fifo_pushed_data[i] = sys_rand8_get();
		lifo_pushed_data[i] = sys_rand8_get();
		stack_pushed_data[i] = sys_rand8_get();
		ring_buffer_pushed_data[i] = sys_rand8_get();
	}
}

void fifo_push(void)
{
	for (int i = 0; i < DATA_LEN; i++) {
		k_mutex_lock(&data_mutex, K_FOREVER);
		fifo_data[i].data = fifo_pushed_data[i];
		k_fifo_put(&fifo, &fifo_data[i]);
		k_mutex_unlock(&data_mutex);
	}
}

void fifo_pop(void)
{
	for (int i = 0; i < DATA_LEN; i++) {
		struct fifo_item_t *data = k_fifo_get(&fifo, K_NO_WAIT);

		if (data) {
			k_mutex_lock(&data_mutex, K_FOREVER);
			fifo_popped_data[i] = data->data;
			k_mutex_unlock(&data_mutex);
		}
	}
}

void lifo_push(void)
{
	for (int i = 0; i < DATA_LEN; i++) {
		k_mutex_lock(&data_mutex, K_FOREVER);
		lifo_data[i].data = lifo_pushed_data[i];
		k_lifo_put(&lifo, &lifo_data[i]);
		k_mutex_unlock(&data_mutex);
	}
}

void lifo_pop(void)
{
	for (int i = 0; i < DATA_LEN; i++) {
		struct lifo_item_t *data = k_lifo_get(&lifo, K_NO_WAIT);

		if (data) {
			k_mutex_lock(&data_mutex, K_FOREVER);
			lifo_popped_data[i] = data->data;
			k_mutex_unlock(&data_mutex);
		}
	}
}

void stack_push(void)
{
	for (int i = 0; i < DATA_LEN; i++) {
		k_mutex_lock(&data_mutex, K_FOREVER);
		k_stack_push(&stack, stack_pushed_data[i]);
		k_mutex_unlock(&data_mutex);
	}
}

void stack_pop(void)
{
	stack_data_t data;

	for (int i = 0; i < DATA_LEN; i++) {
		k_mutex_lock(&data_mutex, K_FOREVER);
		k_stack_pop(&stack, &data, K_NO_WAIT);
		stack_popped_data[i] = (uint8_t)data;
		k_mutex_unlock(&data_mutex);
	}
}

void ring_buf_push(void)
{
	for (int i = 0; i < DATA_LEN; i++) {
		k_mutex_lock(&data_mutex, K_FOREVER);
		const uint8_t data = ring_buffer_pushed_data[i];

		ring_buf_put(&ring_buf, &data, 1);
		k_mutex_unlock(&data_mutex);
	}
}

void ring_buf_pop(void)
{
	for (int i = 0; i < DATA_LEN; i++) {
		uint8_t data;

		ring_buf_get(&ring_buf, &data, 1);
		k_mutex_lock(&data_mutex, K_FOREVER);
		ring_buffer_popped_data[i] = data;
		k_mutex_unlock(&data_mutex);
	}
}

bool compare_arrays(uint8_t *arr1, uint8_t *arr2, int size, bool rev)
{
	if (rev) {
		for (int i = 0; i < size; i++) {
			if (arr1[i] != arr2[size - 1 - i]) {
				fprintf(output_file, "\nFAILED (%d not equal %d at index %d)\n",
					arr1[i], arr2[size - 1 - i], i);
				return false;
			}
		}
	} else {
		for (int i = 0; i < size; i++) {
			if (arr1[i] != arr2[i]) {
				fprintf(output_file, "\nFAILED (%d not equal %d at index %d)\n",
					arr1[i], arr2[i], i);
				return false;
			}
		}
	}
	return true;
}

void data_summary(void)
{
	fprintf(output_file, "\n==================================================================="
			     "=============");
	fprintf(output_file, "\nTEST: DATA SUMMARY");
	fprintf(output_file, "\n==================================================================="
			     "=============");
	fprintf(output_file, "\nTEST: Fifo");
	fprintf(output_file, "\n-------------------------------------------------------------------"
			     "-------------");
	log_print_data("\nPushed data to Fifo:\n", fifo_pushed_data, DATA_LEN);
	log_print_data("\nPopped data from Fifo:\n", fifo_popped_data, DATA_LEN);
	fprintf(output_file, "\n-------------------------------------------------------------------"
			     "-------------");
	bool is_test_passed = compare_arrays(fifo_pushed_data, fifo_popped_data, DATA_LEN, false);
	const char *test_result_message =
		is_test_passed ? "\nFifo: " GREEN("PASSED") : "\nFifo: " RED("FAILED");

	fprintf(output_file, "%s", test_result_message);
	fprintf(output_file, "\n-------------------------------------------------------------------"
			     "-------------");
	fprintf(output_file, "\nTEST: Lifo");
	fprintf(output_file, "\n-------------------------------------------------------------------"
			     "-------------");
	log_print_data("\nPushed data to Lifo:\n", lifo_pushed_data, DATA_LEN);
	log_print_data("\nPopped data from Lifo.\n", lifo_popped_data, DATA_LEN);
	fprintf(output_file, "\n-------------------------------------------------------------------"
			     "-------------");
	is_test_passed = compare_arrays(lifo_pushed_data, lifo_popped_data, DATA_LEN, true);
	test_result_message =
		is_test_passed ? "\nLifo: " GREEN("PASSED") : "\nLifo: " RED("FAILED");
	fprintf(output_file, "%s", test_result_message);
	fprintf(output_file, "\n-------------------------------------------------------------------"
			     "-------------");
	fprintf(output_file, "\nTEST: Stack");
	fprintf(output_file, "\n-------------------------------------------------------------------"
			     "-------------");
	log_print_data("\nPushed data to Stack:\n", stack_pushed_data, DATA_LEN);
	log_print_data("\nPopped data from Stack:\n", stack_popped_data, DATA_LEN);
	fprintf(output_file, "\n-------------------------------------------------------------------"
			     "-------------");
	is_test_passed = compare_arrays(stack_pushed_data, stack_popped_data, DATA_LEN, true);
	test_result_message =
		is_test_passed ? "\nStack: " GREEN("PASSED") : "\nStack: " RED("FAILED");
	fprintf(output_file, "%s", test_result_message);
	fprintf(output_file, "\n-------------------------------------------------------------------"
			     "-------------");
	fprintf(output_file, "\nTEST: Ring Buffer");
	fprintf(output_file, "\n-------------------------------------------------------------------"
			     "-------------");
	log_print_data("\nPushed data to Ring Buffer:\n", ring_buffer_pushed_data, DATA_LEN);
	log_print_data("\nPopped data from Ring Buffer:\n", ring_buffer_popped_data, DATA_LEN);
	fprintf(output_file, "\n-------------------------------------------------------------------"
			     "-------------");
	is_test_passed =
		compare_arrays(ring_buffer_pushed_data, ring_buffer_popped_data, DATA_LEN, false);
	test_result_message = is_test_passed ? "\nRing Buffer: " GREEN("PASSED")
					     : "\nRing Buffer: " RED("FAILED");
	fprintf(output_file, "%s", test_result_message);
	fprintf(output_file, "\n-------------------------------------------------------------------"
			     "-------------");
}
```

## src/log_management.c
```c
/*
 * Copyright (c) 2024 Intel Corporation
 *
 * SPDX-License-Identifier: Apache-2.0
 */

#include "log_management.h"
#include "timer_management.h"
#include "thread_management.h"
#include "data_management.h"

FILE *output_file;

void log_print_data(char *title, uint8_t *data, uint8_t size)
{
	fprintf(output_file, "%s", title);
	fprintf(output_file, "-> ");
	for (uint8_t i = 0; i < size; i++) {
		fprintf(output_file, "%d", data[i]);
		if (i < size - 1) {
			fprintf(output_file, ",");
		}
	}
}

void log_printDescription(void)
{
	fprintf(output_file, "\n============================== Kernel System Test "
			     "==============================");
	fprintf(output_file, "\nTEST : System_Test");
	fprintf(output_file, "\n Tested Component   | Covered API");
	fprintf(output_file, "\n-------------------------------------------------------------------"
			     "-------------");
	fprintf(output_file, "\n - Fifo:            | k_fifo_put(), k_fifo_get()");
	fprintf(output_file, "\n - Lifo:            | k_lifo_put, k_lifo_get");
	fprintf(output_file, "\n - Stack:           | k_stck_push(), k_stack_pop()");
	fprintf(output_file, "\n - Ring Buffer:     | ring_buf_put(), ring_buf_get()");
	fprintf(output_file,
		"\n - Timer:           | k_timer_init(), k_timer_start(), k_timer_expiry_t");
	fprintf(output_file,
		"\n - Thread:          | k_thread_create(), k_thread_join(), k_thread_entry_t");
	fprintf(output_file,
		"\n - Mutex:           | k_mutex_lock(), k_mutex_unlock(), K_MUTEX_DEFINE");
	fprintf(output_file, "\n - Random Generator:| sys_rand8_get()");
	fprintf(output_file, "\n==================================================================="
			     "=============\n");
}

void log_init_output(void)
{
	output_file = stdout;
}
```

## src/timer_management.c
```c
/*
 * Copyright (c) 2024 Intel Corporation
 *
 * SPDX-License-Identifier: Apache-2.0
 */

#include "timer_management.h"
#include "data_management.h"
#include "log_management.h"


static struct tmr_dynamic timers[TMR_COUNT];

void tmr_create(void)
{
	for (int i = 0; i < TMR_COUNT; i++) {
		timers[i].id = i;
		timers[i].period = ((i + 1) * 10);
		timers[i].wasCreated = true;
		k_timer_init(&timers[i].timer, tmr_expiry_function, NULL);
		k_timer_start(&timers[i].timer, K_MSEC(timers[i].period), K_NO_WAIT);
	}
}

void tmr_expiry_function(struct k_timer *timer_id)
{
	struct tmr_dynamic *t = CONTAINER_OF(timer_id, struct tmr_dynamic, timer);

	t->wasExpired = true;
}

void tmr_summary(void)
{
	fprintf(output_file, "\n==================================================================="
			     "=============");
	fprintf(output_file, "\nTEST: Timer");
	fprintf(output_file, "\n==================================================================="
			     "=============");
	int created_timers = 0;
	int expired_timers = 0;

	for (int i = 0; i < TMR_COUNT; i++) {
		if (timers[i].wasCreated) {
			created_timers += 1;
		}
		if (timers[i].wasExpired) {
			expired_timers += 1;
		}
	}

	fprintf(output_file, "\n-> Tested %d timers.", TMR_COUNT);
	fprintf(output_file, "\n-> Created %d timers.", created_timers);
	fprintf(output_file, "\n-> Expired %d timers.", expired_timers);
	fprintf(output_file, "\n-------------------------------------------------------------------"
			     "-------------");
	const char *test_result_message =
		(TMR_COUNT == created_timers && expired_timers == TMR_COUNT)
			? "\nTimer: " GREEN("PASSED")
			: "\nTimer: " RED("FAILED");
	fprintf(output_file, "%s", test_result_message);
}
```
