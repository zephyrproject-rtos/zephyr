## prj.conf
```kconfig
CONFIG_LOCATION=y
CONFIG_ZTEST=y
CONFIG_USERSPACE=y
CONFIG_LOCATION_PROVIDERS_MAX=2
CONFIG_LOCATION_EVENT_HANDLERS_MAX=2
```

## src/main.c
```c
/*
 * Copyright (c) 2016 Intel Corporation
 *
 * SPDX-License-Identifier: Apache-2.0
 */

#include <zephyr/zephyr.h>
#include <ztest.h>

extern void test_location_api_register(void);
extern void test_location_api_location_providers_get(void);
extern void test_location_api_position_get(void);
extern void test_location_api_bearing_get(void);
extern void test_location_api_speed_get(void);
extern void test_location_api_altitude_get(void);

extern void test_location_api_location_providers_get_user(void);
extern void test_location_api_position_get_user(void);
extern void test_location_api_bearing_get_user(void);
extern void test_location_api_speed_get_user(void);
extern void test_location_api_altitude_get_user(void);

extern void test_location_api_event_handler_register(void);
extern void test_location_api_raise_event(void);

void test_main(void)
{
	ztest_test_suite(location_test_supervisor,
			 ztest_unit_test(test_location_api_register),
			 ztest_unit_test(test_location_api_location_providers_get),
			 ztest_unit_test(test_location_api_position_get),
			 ztest_unit_test(test_location_api_bearing_get),
			 ztest_unit_test(test_location_api_speed_get),
			 ztest_unit_test(test_location_api_altitude_get));

	ztest_test_suite(location_test_user,
			 ztest_user_unit_test(test_location_api_location_providers_get_user),
			 ztest_user_unit_test(test_location_api_position_get_user),
			 ztest_user_unit_test(test_location_api_bearing_get_user),
			 ztest_user_unit_test(test_location_api_speed_get_user),
			 ztest_user_unit_test(test_location_api_altitude_get_user));

	ztest_test_suite(location_test_supervisor_event,
			 ztest_unit_test(test_location_api_event_handler_register),
			 ztest_unit_test(test_location_api_raise_event));

	ztest_run_test_suite(location_test_supervisor);
	ztest_run_test_suite(location_test_user);
	ztest_run_test_suite(location_test_supervisor_event);
}
```

## src/test_api.c
```c
/*
 * Copyright (c) 2022, Bjarki Arge Andreasen
 *
 * SPDX-License-Identifier: Apache-2.0
 */

#include <zephyr/location.h>
#include <ztest.h>
#include <string.h>

/***********************************************************************
 *                    Driver instance data structure
 **********************************************************************/
struct test_driver_data {
	struct location_position position;
	struct location_bearing bearing;
	struct location_speed speed;
	struct location_altitude altitude;
};

/***********************************************************************
 *             Driver location provider api implementation
 **********************************************************************/
static int test_position_get(const struct device *dev,
			     struct location_position *position)
{
	struct test_driver_data *data = (struct test_driver_data *)dev->data;

	*position = data->position;
	return 0;
}

static int test_bearing_get(const struct device *dev,
			    struct location_bearing *bearing)
{
	struct test_driver_data *data = (struct test_driver_data *)dev->data;

	*bearing = data->bearing;
	return 0;
}

static int test_speed_get(const struct device *dev,
			  struct location_speed *speed)
{
	struct test_driver_data *data = (struct test_driver_data *)dev->data;

	*speed = data->speed;
	return 0;
}

static int test_altitude_get(const struct device *dev,
			     struct location_altitude *altitude)
{
	struct test_driver_data *data = (struct test_driver_data *)dev->data;

	*altitude = data->altitude;
	return 0;
}

static struct location_provider_api test_location_provider_api = {
	.position_get = test_position_get,
	.bearing_get = test_bearing_get,
	.speed_get = test_speed_get,
	.altitude_get = test_altitude_get,
};

/***********************************************************************
 *                       Driver instance data
 **********************************************************************/
static struct test_driver_data test_driver_data1 = {
	.position = {
		.latitude = 100,
		.longitude = -100,
		.accuracy = 100,
		.uptime_ticks = 10,
	},
	.bearing = {
		.bearing = 200,
		.accuracy = 10,
		.uptime_ticks = 10,
	},
	.speed = {
		.speed = 1000,
		.accuracy = 10,
		.uptime_ticks = 10,
	},
	.altitude = {
		.altitude = 5000,
		.accuracy = 200,
		.uptime_ticks = 20,
	},
};

static struct test_driver_data test_driver_data2 = {
	.position = {
		.latitude = 200,
		.longitude = -200,
		.accuracy = 200,
		.uptime_ticks = 20,
	},
	.bearing = {
		.bearing = 400,
		.accuracy = 20,
		.uptime_ticks = 20,
	},
	.speed = {
		.speed = 1400,
		.accuracy = 20,
		.uptime_ticks = 20,
	},
	.altitude = {
		.altitude = 4000,
		.accuracy = 1000,
		.uptime_ticks = 200,
	},
};

/***********************************************************************
 *                          Driver instances
 **********************************************************************/
const struct device test_driver1 = {
	.name = "TEST1",
	.api = NULL,
	.data = &test_driver_data1,
};

const struct device test_driver2 = {
	.name = "TEST2",
	.api = NULL,
	.data = &test_driver_data2,
};

/***********************************************************************
 *                        Supervisor mode tests
 **********************************************************************/
void test_location_api_register(void)
{
	zassert_true(location_provider_register(&test_driver1,
		&test_location_provider_api) == 0, "Could not register test driver 1");
	zassert_true(location_provider_register(&test_driver2,
		&test_location_provider_api) == 0, "Could not register test driver 2");
	zassert_true(location_provider_register(&test_driver2,
		&test_location_provider_api) == -ENOMEM,
		"Could register a third provider with a max of 2 allowed");
}

void test_location_api_location_providers_get(void)
{
	/* Get providers */
	const struct location_provider *providers;

	zassert_true(location_providers_get(&providers) == 2,
		"Incorrect number of providers returned");

	/* Verify providers */
	zassert_true((void *)providers[0].dev == (void *)&test_driver1,
		"Returned provider 1 dev does not match registered provider 1 dev");
	zassert_true((void *)providers[1].dev == (void *)&test_driver2,
		"Returned provider 2 dev does not match registered provider 2 dev");
	zassert_true((void *)providers[0].api == (void *)&test_location_provider_api,
		"Returned provider 1 api does not match registered provider 1 api");
	zassert_true((void *)providers[1].api == (void *)&test_location_provider_api,
		"Returned provider 2 api does not match registered provider 2 api");
}

/* Try to get and verify position from the two registered location providers */
void test_location_api_position_get(void)
{
	/* Get providers */
	const struct location_provider *providers;

	location_providers_get(&providers);

	/* Get position from provider 1 */
	struct location_position position1;
	struct location_position position2;

	zassert_true(location_position_get(&providers[0], &position1) == 0,
		"Could not get position from provider 1");
	zassert_true(location_position_get(&providers[1], &position2) == 0,
		"Could not get position from provider 2");

	/* Verify positions */
	zassert_true(memcmp(&position1, &test_driver_data1.position,
		sizeof(struct location_position)) == 0,
		"Returned position 1 does not match real position 1");
	zassert_true(memcmp(&position2, &test_driver_data2.position,
		sizeof(struct location_position)) == 0,
		"Returned position 2 does not match real position 2");
}

/* Try to get and verify bearing from the two registered location providers */
void test_location_api_bearing_get(void)
{
	/* Get providers */
	const struct location_provider *providers;

	location_providers_get(&providers);

	/* Get bearing from provider 1 */
	struct location_bearing bearing1;
	struct location_bearing bearing2;

	zassert_true(location_bearing_get(&providers[0], &bearing1) == 0,
		"Could not get bearing from provider 1");
	zassert_true(location_bearing_get(&providers[1], &bearing2) == 0,
		"Could not get bearing from provider 2");

	/* Verify bearings */
	zassert_true(memcmp(&bearing1, &test_driver_data1.bearing,
		sizeof(struct location_bearing)) == 0,
		"Returned bearing 1 does not match real bearing 1");
	zassert_true(memcmp(&bearing2, &test_driver_data2.bearing,
		sizeof(struct location_bearing)) == 0,
		"Returned bearing 2 does not match real bearing 2");
}

/* Try to get and verify speed from the two registered location providers */
void test_location_api_speed_get(void)
{
	/* Get providers */
	const struct location_provider *providers;

	location_providers_get(&providers);
	/* Get speed from provider 1 */
	struct location_speed speed1;
	struct location_speed speed2;

	zassert_true(location_speed_get(&providers[0], &speed1) == 0,
		"Could not get speed from provider 1");
	zassert_true(location_speed_get(&providers[1], &speed2) == 0,
		"Could not get speed from provider 2");

	/* Verify speeds */
	zassert_true(memcmp(&speed1, &test_driver_data1.speed, sizeof(struct location_speed)) == 0,
		"Returned speed 1 does not match real speed 1");
	zassert_true(memcmp(&speed2, &test_driver_data2.speed, sizeof(struct location_speed)) == 0,
		"Returned speed 2 does not match real speed 2");
}

/* Try to get and verify altitude from the two registered location providers */
void test_location_api_altitude_get(void)
{
	/* Get providers */
	const struct location_provider *providers;

	location_providers_get(&providers);

	/* Get altitude from provider 1 */
	struct location_altitude altitude1;
	struct location_altitude altitude2;

	zassert_true(location_altitude_get(&providers[0], &altitude1) == 0,
		"Could not get altitude from provider 1");
	zassert_true(location_altitude_get(&providers[1], &altitude2) == 0,
		"Could not get altitude from provider 2");

	/* Verify altitudes */
	zassert_true(memcmp(&altitude1, &test_driver_data1.altitude,
		sizeof(struct location_altitude)) == 0,
		"Returned altitude 1 does not match real altitude 1");
	zassert_true(memcmp(&altitude2, &test_driver_data2.altitude,
		sizeof(struct location_altitude)) == 0,
		"Returned altitude 2 does not match real altitude 2");
}

/***********************************************************************
 *                           Usermode tests
 **********************************************************************/
void test_location_api_location_providers_get_user(void)
{
	/* Get providers */
	const struct location_provider *providers;

	zassert_true(location_providers_get(&providers) == 2,
		"Incorrect number of providers returned");
}

void test_location_api_position_get_user(void)
{
	/* Get providers */
	const struct location_provider *providers;

	location_providers_get(&providers);

	/* Get position from provider 1 */
	struct location_position position1;
	struct location_position position2;

	zassert_true(location_position_get(&providers[0], &position1) == 0,
		"Could not get position from provider 1");
	zassert_true(location_position_get(&providers[1], &position2) == 0,
		"Could not get position from provider 2");

	/* Verify positions */
	zassert_true(memcmp(&position1, &test_driver_data1.position,
		sizeof(struct location_position)) == 0,
		"Returned position 1 does not match real position 1");
	zassert_true(memcmp(&position2, &test_driver_data2.position,
		sizeof(struct location_position)) == 0,
		"Returned position 2 does not match real position 2");
}

void test_location_api_bearing_get_user(void)
{
	/* Get providers */
	const struct location_provider *providers;

	location_providers_get(&providers);

	/* Get bearing from provider 1 */
	struct location_bearing bearing1;
	struct location_bearing bearing2;

	zassert_true(location_bearing_get(&providers[0], &bearing1) == 0,
		"Could not get bearing from provider 1");
	zassert_true(location_bearing_get(&providers[1], &bearing2) == 0,
		"Could not get bearing from provider 2");

	/* Verify bearings */
	zassert_true(memcmp(&bearing1, &test_driver_data1.bearing,
		sizeof(struct location_bearing)) == 0,
		"Returned bearing 1 does not match real bearing 1");
	zassert_true(memcmp(&bearing2, &test_driver_data2.bearing,
		sizeof(struct location_bearing)) == 0,
		"Returned bearing 2 does not match real bearing 2");
}

void test_location_api_speed_get_user(void)
{
	/* Get providers */
	const struct location_provider *providers;

	location_providers_get(&providers);

	/* Get speed from provider 1 */
	struct location_speed speed1;
	struct location_speed speed2;

	zassert_true(location_speed_get(&providers[0], &speed1) == 0,
		"Could not get speed from provider 1");
	zassert_true(location_speed_get(&providers[1], &speed2) == 0,
		"Could not get speed from provider 2");

	/* Verify speeds */
	zassert_true(memcmp(&speed1, &test_driver_data1.speed,
		sizeof(struct location_speed)) == 0,
		"Returned speed 1 does not match real speed 1");
	zassert_true(memcmp(&speed2, &test_driver_data2.speed,
		sizeof(struct location_speed)) == 0,
		"Returned speed 2 does not match real speed 2");
}

void test_location_api_altitude_get_user(void)
{
	/* Get providers */
	const struct location_provider *providers;

	location_providers_get(&providers);

	/* Get altitude from provider 1 */
	struct location_altitude altitude1;
	struct location_altitude altitude2;

	zassert_true(location_altitude_get(&providers[0], &altitude1) == 0,
		"Could not get altitude from provider 1");
	zassert_true(location_altitude_get(&providers[1], &altitude2) == 0,
		"Could not get altitude from provider 2");

	/* Verify altitudes */
	zassert_true(memcmp(&altitude1, &test_driver_data1.altitude,
		sizeof(struct location_altitude)) == 0,
		"Returned altitude 1 does not match real altitude 1");
	zassert_true(memcmp(&altitude2, &test_driver_data2.altitude,
		sizeof(struct location_altitude)) == 0,
		"Returned altitude 2 does not match real altitude 2");
}
```

## src/test_events.c
```c
/*
 * Copyright (c) 2022, Bjarki Arge Andreasen
 *
 * SPDX-License-Identifier: Apache-2.0
 */

#include <zephyr/location.h>
#include <ztest.h>
#include <string.h>

/***********************************************************************
 *                          Driver instances
 **********************************************************************/
extern const struct device test_driver1;
extern const struct device test_driver2;

/***********************************************************************
 *                        Handlers data
 **********************************************************************/
static union location_event event_filter1 = {
	.position   = 0,
	.bearing    = 0,
	.speed      = 1,
	.altitude   = 1,
};

static union location_event event_filter2 = {
	.position   = 1,
	.bearing    = 1,
	.speed      = 0,
	.altitude   = 0,
};

static uint8_t event_handler1_invoked_cnt;
static uint8_t event_handler2_invoked_cnt;

/***********************************************************************
 *                          Handlers
 **********************************************************************/
static void test_location_api_event_handler1(const struct location_provider *provider,
							union location_event event)
{
	/* Verify any raised event was enabled */
	zassert_true(event_filter1.value & event.value, "Handler 1 invoked mistakenly");

	/* Verify correct provider supplied */
	zassert_true(provider->dev == &test_driver1, "Incorrect location provider supplied");

	/* Increment count */
	event_handler1_invoked_cnt++;
}

static void test_location_api_event_handler2(const struct location_provider *provider,
							union location_event event)
{
	/* Verify any raised event was enabled */
	zassert_true(event_filter2.value & event.value, "Handler 2 invoked mistakenly");

	/* Verify correct provider supplied */
	zassert_true(provider->dev == &test_driver2, "Incorrect location provider supplied");

	/* Increment count */
	event_handler2_invoked_cnt++;
}

/***********************************************************************
 *                        Supervisor mode tests
 **********************************************************************/
void test_location_api_event_handler_register(void)
{
	/* Try to register event handlers 1 and 2 */
	zassert_true(location_event_handler_register(test_location_api_event_handler1,
		event_filter1) == 0, "Failed to register location event handler 1");
	zassert_true(location_event_handler_register(test_location_api_event_handler2,
		event_filter2) == 0, "Failed to register location event handler 1");

	/* Try to register event handler 2 despite only having allocated two event handlers max */
	zassert_true(location_event_handler_register(test_location_api_event_handler2,
		event_filter2) == -ENOMEM, "Memory overflow while registering event handler");
}

void test_location_api_raise_event(void)
{
	union location_event event11 = {
		.position   = 0,
		.bearing    = 0,
		.speed      = 0,
		.altitude   = 1,
	};

	union location_event event12 = {
		.position   = 0,
		.bearing    = 0,
		.speed      = 1,
		.altitude   = 0,
	};

	union location_event event13 = {
		.position   = 0,
		.bearing    = 0,
		.speed      = 1,
		.altitude   = 1,
	};

	union location_event event21 = {
		.position   = 1,
		.bearing    = 0,
		.speed      = 0,
		.altitude   = 0,
	};

	union location_event event22 = {
		.position   = 0,
		.bearing    = 1,
		.speed      = 0,
		.altitude   = 0,
	};

	union location_event event23 = {
		.position   = 1,
		.bearing    = 1,
		.speed      = 0,
		.altitude   = 0,
	};

	union location_event event24 = {
		.position   = 1,
		.bearing    = 1,
		.speed      = 0,
		.altitude   = 0,
	};

	/* Send event from driver1 */
	zassert_true(location_provider_raise_event(&test_driver1, event11) == 0,
		"Failed to raise event 11");
	zassert_true(location_provider_raise_event(&test_driver1, event12) == 0,
		"Failed to raise event 12");
	zassert_true(location_provider_raise_event(&test_driver1, event13) == 0,
		"Failed to raise event 13");

	/* Send event from driver2 */
	zassert_true(location_provider_raise_event(&test_driver2, event21) == 0,
		"Failed to raise event 21");
	zassert_true(location_provider_raise_event(&test_driver2, event22) == 0,
		"Failed to raise event 22");
	zassert_true(location_provider_raise_event(&test_driver2, event23) == 0,
		"Failed to raise event 23");
	zassert_true(location_provider_raise_event(&test_driver2, event24) == 0,
		"Failed to raise event 24");

	/* Ensure correct number of event received */
	zassert_true(event_handler1_invoked_cnt == 3,
		"Incorrect number of invocations if handler1");
	zassert_true(event_handler2_invoked_cnt == 4,
		"Incorrect number of invocations if handler2");
}
```
