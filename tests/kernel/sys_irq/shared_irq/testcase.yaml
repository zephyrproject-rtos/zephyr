## tests/kernel/sys_irq/shared_irq/testcase.yaml
```yaml
tests:
  kernel.sys_irq.shared_irq:
    platform_allow:
      - nrf5340dk/nrf5340/cpuapp
  kernel.sys_irq.shared_irq.lto:
    extra_configs:
      - CONFIG_LTO=y
    platform_allow:
      - nrf5340dk/nrf5340/cpuapp
```

## tests/kernel/system_test/testcase.yaml
```yaml
tests:
  kernel.system_test:
    timeout: 120
    extra_configs:
      - platform:native_sim:CONFIG_SYS_CLOCK_TICKS_PER_SEC=10000
    harness: console
    harness_config:
      type: multi_line
      regex:
        - ".*Timer: .*PASSED.*"
        - ".*Thread: .*PASSED.*"
        - ".*Fifo: .*PASSED.*"
        - ".*Lifo: .*PASSED.*"
        - ".*Stack: .*PASSED.*"
        - ".*Ring Buffer: .*PASSED.*"
```

## tests/kernel/test_build/testcase.yaml
```yaml
tests:
  test_debug:
    build_only: true
    extra_args: CONF_FILE=debug.conf
    tags: apps
  test_newlib:
    build_only: true
    extra_args: CONF_FILE=newlib.conf
    tags: apps
  test_runtime_nmi:
    arch_whitelist: arm
    build_only: true
    extra_args: CONF_FILE=runtime_nmi.conf
    tags: apps
```

## tests/kernel/thread_safety/testcase.yaml
```yaml
tests:
  kernel.thread_safety:
    tags:
      - kernel
    platform_allow:
      - mps2/an385
      - qemu_riscv32e
    integration_toolchains:
      - zephyr/llvm
      - zephyr/gnu
```

## tests/kernel/threads/dynamic_thread/testcase.yaml
```yaml
tests:
  kernel.threads.dynamic:
    tags:
      - kernel
      - threads
      - userspace
    ignore_faults: true
    filter: CONFIG_ARCH_HAS_USERSPACE
    arch_exclude:
      - posix
    integration_platforms:
      - qemu_x86
```

## tests/kernel/threads/dynamic_thread_stack/testcase.yaml
```yaml
common:
  tags: kernel security
  min_ram: 32
  integration_platforms:
    - qemu_x86
    - qemu_x86_nommu
    - qemu_x86_64
    - qemu_cortex_a53
    - qemu_cortex_a53_smp
    - qemu_cortex_m3
    - qemu_riscv32
    - qemu_riscv32e
    - qemu_riscv64
    - qemu_riscv64_smp

# Permutations of (pool | alloc | user)
tests:
  kernel.threads.dynamic_thread.stack.no_pool.no_alloc.no_user:
    extra_configs:
      # 000
      - CONFIG_DYNAMIC_THREAD_POOL_SIZE=0
      - CONFIG_DYNAMIC_THREAD_ALLOC=n
      - CONFIG_USERSPACE=n
  kernel.threads.dynamic_thread.stack.no_pool.no_alloc.user:
    tags: userspace
    extra_configs:
      # 001
      - CONFIG_DYNAMIC_THREAD_POOL_SIZE=0
      - CONFIG_DYNAMIC_THREAD_ALLOC=n
      - CONFIG_USERSPACE=y
  kernel.threads.dynamic_thread.stack.no_pool.alloc.no_user:
    extra_configs:
      # 010
      - CONFIG_DYNAMIC_THREAD_POOL_SIZE=0
      - CONFIG_DYNAMIC_THREAD_ALLOC=y
      - CONFIG_DYNAMIC_THREAD_PREFER_ALLOC=y
      - CONFIG_USERSPACE=n
  kernel.threads.dynamic_thread.stack.no_pool.alloc.user:
    tags: userspace
    extra_configs:
      # 011
      - CONFIG_DYNAMIC_THREAD_POOL_SIZE=0
      - CONFIG_DYNAMIC_THREAD_ALLOC=y
      - CONFIG_DYNAMIC_THREAD_PREFER_ALLOC=y
      - CONFIG_USERSPACE=y
  kernel.threads.dynamic_thread.stack.pool.no_alloc.no_user:
    extra_configs:
      # 100
      - CONFIG_DYNAMIC_THREAD_POOL_SIZE=2
      - CONFIG_DYNAMIC_THREAD_ALLOC=n
      - CONFIG_USERSPACE=n
  kernel.threads.dynamic_thread.stack.pool.no_alloc.user:
    tags: userspace
    extra_configs:
      # 101
      - CONFIG_DYNAMIC_THREAD_POOL_SIZE=2
      - CONFIG_DYNAMIC_THREAD_ALLOC=n
      - CONFIG_USERSPACE=y
  kernel.threads.dynamic_thread.stack.pool.alloc.no_user:
    extra_configs:
      # 110
      - CONFIG_DYNAMIC_THREAD_PREFER_ALLOC=y
      - CONFIG_DYNAMIC_THREAD_POOL_SIZE=2
      - CONFIG_DYNAMIC_THREAD_ALLOC=y
      - CONFIG_USERSPACE=n
  kernel.threads.dynamic_thread.stack.pool.alloc.user:
    tags: userspace
    extra_configs:
      # 111
      - CONFIG_DYNAMIC_THREAD_PREFER_ALLOC=y
      - CONFIG_DYNAMIC_THREAD_POOL_SIZE=2
      - CONFIG_DYNAMIC_THREAD_ALLOC=y
      - CONFIG_USERSPACE=y
```

## tests/kernel/threads/lifecycle/lifecycle_api/testcase.yaml
```yaml
tests:
  kernel.threads:
    arch_exclude: nios2
    tags: kernel threads userspace
```

## tests/kernel/threads/no-multithreading/testcase.yaml
```yaml
tests:
  kernel.threads.no-multithreading:
    tags: kernel
    filter: not CONFIG_SMP
    platform_allow:
      - qemu_cortex_m0
      - qemu_cortex_m3
      - mps2/an385
      - mps2/an521/cpu0
      - nrf52840dk/nrf52840
      - nrf9160dk/nrf9160
      - nrf51dk/nrf51822
      - xg29_rb4412a
      - nsim/nsim_em
      - nsim/nsim_em7d_v22
      - nsim/nsim_hs
      - nsim/nsim_hs/mpuv6
      - nsim/nsim_hs5x
      - nsim/nsim_hs6x
      - qemu_arc/qemu_arc_em
      - qemu_arc/qemu_arc_hs
      - qemu_arc/qemu_arc_hs6x
      - qemu_riscv/qemu_virt_riscv/rv32
      - qemu_riscv/qemu_virt_riscv/rv32e
      - qemu_riscv/qemu_virt_riscv/rv64
      - qemu_leon3
    integration_platforms:
      - qemu_cortex_m0
```

## tests/kernel/threads/reuse_tid/testcase.yaml
```yaml
tests:
  kernel.threads.reuse_tid:
    tags:
      - kernel
      - threads
    ignore_faults: true
    integration_platforms:
      - qemu_cortex_a53
      - qemu_riscv32
```

## tests/kernel/threads/runtime_stack_safety/testcase.yaml
```yaml
common:
  tags:
    - kernel
    - threads
tests:
  kernel.threads.runtime_stack_safety: {}
  kernel.threads.runtime_stack_safety.userspace:
    filter: CONFIG_ARCH_HAS_USERSPACE
    tags:
      - userspace
    extra_configs:
      - CONFIG_USERSPACE=y
```

## tests/kernel/threads/scheduling/schedule_api/testcase.yaml
```yaml
tests:
  kernel.threads.scheduling:
    min_ram: 20
    tags: kernel threads sched
```

## tests/kernel/threads/thread_apis/Kconfig
```kconfig
# Copyright (c) 2024 Intel Corporation
# SPDX-License-Identifier: Apache-2.0

mainmenu "Thread APIs test"

source "Kconfig.zephyr"

config THREAD_API_UNMAPPED_ADDRESS
	hex "Unmapped address from which to read"
	default 0xFFFFFFF0
	help
	  This is the unmapped address that test_thread_name_user_get_set()
	  will attempt to use if CONFIG_TRUSTED_EXECUTION_NONSECURE is not
	  enabled. For most platforms, this address can be expected to be
	  near the end of addressable memory; however it is not guaranteed
	  for all platforms.
```

## tests/kernel/threads/thread_apis/testcase.yaml
```yaml
common:
  ignore_faults: true
  tags:
    - kernel
    - threads
    - userspace
tests:
  kernel.threads.apis:
    min_flash: 34
  kernel.threads.apis.pinonly:
    min_flash: 34
    depends_on:
      - smp
    extra_configs:
      - CONFIG_SCHED_CPU_MASK=n
      - CONFIG_SCHED_CPU_MASK_PIN_ONLY=y
  kernel.threads.apis.pinonly.scalable:
    min_flash: 34
    depends_on:
      - smp
    extra_configs:
      - CONFIG_SCHED_CPU_MASK_PIN_ONLY=y
      - CONFIG_SCHED_SCALABLE=y
  kernel.threads.apis.pinonly.multiq:
    min_flash: 34
    depends_on:
      - smp
    extra_configs:
      - CONFIG_SCHED_CPU_MASK_PIN_ONLY=y
      - CONFIG_SCHED_MULTIQ=y
```

## tests/kernel/threads/thread_error_case/boards/qemu_xtensa_dc233c_mmu.conf
```kconfig
# For some weird reasons, enabling ICOUNT would crash QEMU
# on this test. So disable it.
CONFIG_QEMU_ICOUNT=n
```

## tests/kernel/threads/thread_error_case/testcase.yaml
```yaml
tests:
  kernel.threads.error.case:
    tags:
      - kernel
      - threads
      - userspace
    filter: CONFIG_USERSPACE
    ignore_faults: true
    integration_platforms:
      - qemu_x86
```

## tests/kernel/threads/thread_stack/testcase.yaml
```yaml
tests:
  kernel.threads.thread_stack:
    tags:
      - kernel
      - security
      - userspace
    ignore_faults: true
    min_ram: 16
    integration_platforms:
      - mps2/an521/cpu0
      - qemu_x86
  kernel.threads.armv8m_mpu_stack_guard:
    min_ram: 16
    extra_args: CONF_FILE=prj_armv8m_mpu_stack_guard.conf
    filter: CONFIG_ARM_MPU and CONFIG_ARMV8_M_MAINLINE
    arch_allow: arm
    tags:
      - kernel
      - security
      - userspace
    ignore_faults: true
    integration_platforms:
      - mps2/an521/cpu0
```

## tests/kernel/threads/thread_stack_validate/testcase.yaml
```yaml
tests:
  kernel.threads.thread_stack_validate:
    tags:
      - kernel
      - security
      - userspace
    ignore_faults: true
```

## tests/kernel/threads/tls/testcase.yaml
```yaml
common:
  integration_platforms:
    - qemu_x86
tests:
  kernel.threads.tls:
    tags:
      - kernel
      - threads
    filter: CONFIG_ARCH_HAS_THREAD_LOCAL_STORAGE and CONFIG_TOOLCHAIN_SUPPORTS_THREAD_LOCAL_STORAGE
  kernel.threads.tls.userspace:
    tags:
      - kernel
      - threads
      - userspace
    filter: CONFIG_ARCH_HAS_THREAD_LOCAL_STORAGE and CONFIG_ARCH_HAS_USERSPACE and
      CONFIG_TOOLCHAIN_SUPPORTS_THREAD_LOCAL_STORAGE
    arch_exclude:
      - posix
    platform_exclude:
      - ucans32k1sic
    # ARCMWDT can't handle THREAD_LOCAL_STORAGE with USERSPACE, see #52570 for details
    toolchain_exclude: arcmwdt
    extra_configs:
      - CONFIG_TEST_USERSPACE=y
```

## tests/kernel/tickless/tickless/testcase.yaml
```yaml
tests:
  kernel.tickless:
    arch_exclude: nios2 riscv32
    filter: CONFIG_X86 or (CONFIG_ARM and (CONFIG_SOC_MK64F12
      or CONFIG_SOC_SERIES_SAM3X)) or (CONFIG_ARC and
      CONFIG_SOC_QUARK_SE_C1000_SS) or CONFIG_ARCH_POSIX
    tags: tickless kernel
```

## tests/kernel/tickless/tickless_concept/boards/mimxrt595_evk_cm33.conf
```kconfig
#
# Copyright 2022, NXP
#
# SPDX-License-Identifier: Apache-2.0
#

# Turn on Device Level Power Management as we wish
# to reconfigure the FlexSPI pins for power savings
# when transitioning the SoC to Deep Low Power modes.
CONFIG_PM_DEVICE=y
```
