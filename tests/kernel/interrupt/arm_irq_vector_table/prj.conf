## Kconfig
```
config NUM_IRQS
	int "Number of IRQs for this test, made overridable in the .conf file"
	default 3
source "$ZEPHYR_BASE/Kconfig.zephyr"
```

## prj.conf
```kconfig
CONFIG_ZTEST=y
CONFIG_ZTEST_STACKSIZE=512
CONFIG_MAIN_STACK_SIZE=512
CONFIG_GEN_ISR_TABLES=n
CONFIG_NUM_IRQS=3
# Force Bluetooth disable (required by platforms that enable Bluetooth by default)
CONFIG_BT=n
```

## src/main.c
```c
/*
 * Copyright (c) 2017 Intel Corporation
 *
 * SPDX-License-Identifier: Apache-2.0
 */

#if !defined(CONFIG_CPU_CORTEX_M)
  #error project can only run on Cortex-M
#endif

#include <ztest.h>

extern void test_arm_irq_vector_table(void);

void test_main(void)
{
	ztest_test_suite(vector_table,
		ztest_unit_test(test_arm_irq_vector_table));
	ztest_run_test_suite(vector_table);
}
```
