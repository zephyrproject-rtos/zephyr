## CMakeLists.txt
```
# SPDX-License-Identifier: Apache-2.0

cmake_minimum_required(VERSION 3.28.0)
find_package(Zephyr REQUIRED HINTS $ENV{ZEPHYR_BASE})
project(spinlock_api)

target_sources(app PRIVATE src/main.c)
target_sources(app PRIVATE src/spinlock_error_case.c)
target_sources(app PRIVATE src/spinlock_fairness.c)
```

## prj.conf
```kconfig
CONFIG_ZTEST=y
CONFIG_SPIN_VALIDATE=y
CONFIG_SPIN_LOCK_TIME_LIMIT=10000000
CONFIG_ASSERT_TEST=y
```

## src/main.c
```c
/*
 * Copyright (c) 2018,2022 Intel Corporation.
 *
 * SPDX-License-Identifier: Apache-2.0
 */
#include <zephyr/tc_util.h>
#include <zephyr/ztest.h>
#include <zephyr/kernel.h>
#include <zephyr/spinlock.h>

BUILD_ASSERT(CONFIG_MP_MAX_NUM_CPUS > 1);

#define CPU1_STACK_SIZE 1024

K_THREAD_STACK_DEFINE(cpu1_stack, CPU1_STACK_SIZE);
struct k_thread cpu1_thread;

static struct k_spinlock bounce_lock;

volatile int bounce_owner, bounce_done;
volatile int trylock_failures;
volatile int trylock_successes;

/**
 * @brief Tests for spinlock
 *
 * @defgroup kernel_spinlock_tests Spinlock Tests
 *
 * @ingroup all_tests
 *
 * @{
 * @}
 */

/**
 * @brief Test basic spinlock
 *
 * @ingroup kernel_spinlock_tests
 *
 * @see k_spin_lock(), k_spin_unlock()
 * @verifies ZEP-SRS-34-3
 */
ZTEST(spinlock, test_spinlock_basic)
{
	k_spinlock_key_t key;
	static struct k_spinlock l;

	zassert_true(!z_spin_is_locked(&l), "Spinlock initialized to locked");

	key = k_spin_lock(&l);

	zassert_true(z_spin_is_locked(&l), "Spinlock failed to lock");

	k_spin_unlock(&l, key);

	zassert_true(!z_spin_is_locked(&l), "Spinlock failed to unlock");
}

static void bounce_once(int id, bool trylock)
{
	int ret;
	int i, locked;
	k_spinlock_key_t key;

	/* Take the lock, check last owner and release if it was us.
	 * Wait for us to get the lock "after" another CPU
	 */
	locked = 0;
	for (i = 0; i < 10000; i++) {
		/*
		 * The peer CPU may finish its run and set bounce_done at any
		 * point. Once it stops bouncing the lock we can no longer see
		 * a cross-CPU handoff, so give up gracefully instead of
		 * spinning out the full retry budget and asserting.
		 */
		if (bounce_done) {
			return;
		}

		if (trylock) {
			ret = k_spin_trylock(&bounce_lock, &key);
			if (ret == -EBUSY) {
				trylock_failures++;
				continue;
			}
			trylock_successes++;
		} else {
			key = k_spin_lock(&bounce_lock);
		}

		if (bounce_owner != id) {
			locked = 1;
			break;
		}

		k_spin_unlock(&bounce_lock, key);
		if (trylock) {
			k_yield();
		}
		k_busy_wait(1);
	}

	/*
	 * With trylock the two CPUs contend without queuing, so under
	 * adverse scheduling one side can legitimately fail to observe a
	 * cross-CPU handoff within the retry budget. That is not a lock
	 * defect, so skip this round instead of asserting; the mutual
	 * exclusion check below is thus best-effort under trylock. The
	 * blocking lock path queues fairly and must always hand off, so
	 * keep asserting there (unless the peer already finished its run).
	 */
	if (!locked && (trylock || bounce_done)) {
		return;
	}

	zassert_true(locked, "Other cpu did not get lock in 10000 tries");

	/* Mark us as the owner, spin for a while validating that we
	 * never see another owner write to the protected data.
	 */
	bounce_owner = id;

	for (i = 0; i < 5; i++) {
		zassert_true(bounce_owner == id, "Locked data changed");
		k_busy_wait(5);
	}

	/* Release the lock */
	k_spin_unlock(&bounce_lock, key);
}

static void cpu1_fn(void *p1, void *p2, void *p3)
{
	ARG_UNUSED(p1);
	ARG_UNUSED(p2);
	ARG_UNUSED(p3);

	while (!bounce_done) {
		bounce_once(4321, false);
	}
}

/**
 * @brief Test spinlock with bounce
 *
 * @ingroup kernel_spinlock_tests
 *
 * @see arch_cpu_start()
 */
ZTEST(spinlock, test_spinlock_bounce)
{
	int i;

	k_thread_create(&cpu1_thread, cpu1_stack, CPU1_STACK_SIZE,
			cpu1_fn, NULL, NULL, NULL,
			0, 0, K_NO_WAIT);

	k_busy_wait(10);

	for (i = 0; i < 10000; i++) {
		bounce_once(1234, false);
	}

	bounce_done = 1;

	k_thread_join(&cpu1_thread, K_FOREVER);
}

/**
 * @brief Test basic mutual exclusion using interrupt masking
 *
 * @details
 * - Spinlocks can be initialized at run-time.
 * - Spinlocks in uniprocessor context should achieve mutual exclusion using
 *   interrupt masking.
 *
 * @ingroup kernel_spinlock_tests
 *
 * @see k_spin_lock(), k_spin_unlock()
 */
ZTEST(spinlock, test_spinlock_mutual_exclusion)
{
	k_spinlock_key_t key;
	static struct k_spinlock lock_runtime;
	unsigned int irq_key;

	(void)memset(&lock_runtime, 0, sizeof(lock_runtime));

	key = k_spin_lock(&lock_runtime);

	zassert_true(z_spin_is_locked(&lock_runtime), "Spinlock failed to lock");

	/* check irq has not locked */
	zassert_true(arch_irq_unlocked(key.key),
			"irq should be first locked!");

	/*
	 * We make irq locked nested to check if interrupt
	 * disable happened or not.
	 */
	irq_key = arch_irq_lock();

	/* check irq has already locked */
	zassert_false(arch_irq_unlocked(irq_key),
			"irq should be already locked!");

	arch_irq_unlock(irq_key);

	k_spin_unlock(&lock_runtime, key);

	zassert_true(!z_spin_is_locked(&lock_runtime), "Spinlock failed to unlock");
}

static void trylock_fn(void *p1, void *p2, void *p3)
{
	ARG_UNUSED(p1);
	ARG_UNUSED(p2);
	ARG_UNUSED(p3);

	while (!bounce_done) {
		bounce_once(4321, true);
	}
}

/**
 * @brief Test k_spin_trylock()
 *
 * @ingroup kernel_spinlock_tests
 *
 * @see k_spin_trylock()
 */
ZTEST(spinlock, test_trylock)
{
	int i;

	k_thread_create(&cpu1_thread, cpu1_stack, CPU1_STACK_SIZE,
			trylock_fn, NULL, NULL, NULL,
			0, 0, K_NO_WAIT);

	k_busy_wait(10);

	for (i = 0; i < 10000; i++) {
		bounce_once(1234, true);
	}

	bounce_done = 1;

	k_thread_join(&cpu1_thread, K_FOREVER);

	zassert_true(trylock_failures > 0);
	zassert_true(trylock_successes > 0);
}

static void before(void *ctx)
{
	ARG_UNUSED(ctx);

	bounce_done = 0;
	bounce_owner = 0;
	trylock_failures = 0;
	trylock_successes = 0;
}

ZTEST_SUITE(spinlock, NULL, NULL, before, NULL, NULL);
```

## src/spinlock_error_case.c
```c
/*
 * Copyright (c) 2018,2022 Intel Corporation.
 *
 * SPDX-License-Identifier: Apache-2.0
 */
#include <zephyr/ztest_test.h>
#include <zephyr/kernel.h>
#include <zephyr/ztest.h>
#include <zephyr/spinlock.h>

BUILD_ASSERT(CONFIG_MP_MAX_NUM_CPUS > 1);

static struct k_spinlock lock;
static struct k_spinlock mylock;
static k_spinlock_key_t key;

/* Like all spin locks in Zephyr (and things that directly hold them), this must
 * be placed globally in code paths that intel_adsp runs to be valid. Even if
 * only used in a local function context as is the case here when SPIN_VALIDATE
 * and KERNEL_COHERENCE are enabled.
 *
 * When both are enabled a check to verify that a spin lock is placed
 * in coherent (uncached) memory is done and asserted on. Spin locks placed
 * on a stack will fail on platforms where KERNEL_COHERENCE is needed such
 * as intel_adsp.
 *
 * See kernel/Kconfig KERNEL_COHERENCE and subsys/debug/Kconfig SPIN_VALIDATE
 * for more details.
 */
#ifdef CONFIG_SPIN_LOCK_TIME_LIMIT
	static struct k_spinlock timeout_lock;
#endif


static ZTEST_DMEM volatile bool valid_assert;
static ZTEST_DMEM volatile bool unlock_after_assert;


static inline void set_assert_valid(bool valid, bool unlock)
{
	valid_assert = valid;
	unlock_after_assert = unlock;
}

static void action_after_assert_fail(void)
{
	if (unlock_after_assert) {
		k_spin_unlock(&lock, key);
	}

	ztest_test_pass();
}

void zassert_post_action(const char *file, unsigned int line)
{
	ARG_UNUSED(file);
	ARG_UNUSED(line);

	printk("Caught an assert.\n");

	if (valid_assert) {
		valid_assert = false; /* reset back to normal */
		printk("Assert error expected as part of test case.\n");

		/* do some action after fatal error happened */
		action_after_assert_fail();
	} else {
		printk("Assert failed was unexpected, aborting...\n");
#ifdef CONFIG_USERSPACE
	/* User threads aren't allowed to induce kernel panics; generate
	 * an oops instead.
	 */
		if (k_is_user_context()) {
			k_oops();
		}
#endif
		k_panic();
	}
}


/**
 * @brief Test spinlock cannot be recursive
 *
 * @details Validate using spinlock recursive will trigger assertion.
 *
 * @ingroup kernel_spinlock_tests
 *
 * @see k_spin_lock()
 */
ZTEST(spinlock, test_spinlock_no_recursive)
{
	k_spinlock_key_t re;

	key = k_spin_lock(&lock);

	set_assert_valid(true, true);
	re = k_spin_lock(&lock);

	ztest_test_fail();
}

/**
 * @brief Test unlocking incorrect spinlock
 *
 * @details Validate unlocking incorrect spinlock will trigger assertion.
 *
 * @ingroup kernel_spinlock_tests
 *
 * @see k_spin_unlock()
 */
ZTEST(spinlock, test_spinlock_unlock_error)
{
	key = k_spin_lock(&lock);

	set_assert_valid(true, true);
	k_spin_unlock(&mylock, key);

	ztest_test_fail();
}

/**
 * @brief Test unlocking incorrect spinlock
 *
 * @details Validate unlocking incorrect spinlock will trigger assertion.
 *
 * @ingroup kernel_spinlock_tests
 *
 * @see k_spin_release()
 */
ZTEST(spinlock, test_spinlock_release_error)
{
	key = k_spin_lock(&lock);

	set_assert_valid(true, true);
	k_spin_release(&mylock);

	ztest_test_fail();
}


/**
 * @brief Test unlocking spinlock held over the time limit
 *
 * @details Validate unlocking spinlock held past the time limit will trigger
 * assertion.
 *
 * @ingroup kernel_spinlock_tests
 *
 * @see k_spin_unlock()
 */
ZTEST(spinlock, test_spinlock_lock_time_limit)
{
#ifndef CONFIG_SPIN_LOCK_TIME_LIMIT
	ztest_test_skip();
	return;
#else
	if (CONFIG_SPIN_LOCK_TIME_LIMIT == 0) {
		ztest_test_skip();
		return;
	}

	TC_PRINT("testing lock time limit, limit is %d!\n", CONFIG_SPIN_LOCK_TIME_LIMIT);

	key = k_spin_lock(&timeout_lock);

	/* Backdate only this lock so the timeout check does not depend on CPU
	 * speed or require holding interrupts off for the configured limit.
	 */
	timeout_lock.lock_time -= CONFIG_SPIN_LOCK_TIME_LIMIT;

	set_assert_valid(true, false);
	k_spin_unlock(&timeout_lock, key);

	ztest_test_fail();
#endif
}
```

## src/spinlock_fairness.c
```c
/*
 * Copyright (c) 2023 Syntacore. All rights reserved.
 *
 * SPDX-License-Identifier: Apache-2.0
 */

#include <zephyr/ztest_test.h>
#include <zephyr/kernel.h>
#include <zephyr/ztest.h>
#include <zephyr/spinlock.h>

#ifdef CONFIG_SCHED_CPU_MASK

#define STACK_SIZE	(8 * 1024)
#define CORES_NUM	CONFIG_MP_MAX_NUM_CPUS
#define FAIRNESS_TEST_CYCLES_PER_CORE 1000

BUILD_ASSERT(CONFIG_MP_MAX_NUM_CPUS > 1);

static K_THREAD_STACK_ARRAY_DEFINE(tstack, CORES_NUM, STACK_SIZE);
static struct k_thread tthread[CORES_NUM];
static uint32_t spinlock_grabbed[CORES_NUM];
static atomic_t fairness_test_cycles;
static struct k_spinlock lock;
static atomic_t start_sync;

static inline struct k_thread *get_thread(uint8_t core_id)
{
	return &tthread[core_id];
}

/**
 * @brief Execution thread which runs concurrently on each CPU in the system
 *
 * @param [in] arg1 - thread argument 1
 * @param [in] arg2 - thread argument 2
 * @param [in] arg3 - thread argument 3
 */
static void test_thread(void *arg1, void *arg2, void *arg3)
{
	int core_id = (uintptr_t)arg1;

	/* Synchronize all the cores as much as possible */
	int key = arch_irq_lock();

	atomic_dec(&start_sync);
	while (atomic_get(&start_sync) != 0)
		;

	/*
	 * Run the test: let the cores contend for the spinlock and
	 * collect the spinlock acquisition statistics
	 */
	do {
		k_spinlock_key_t spinlock_key = k_spin_lock(&lock);

		if (atomic_get(&fairness_test_cycles) == 0) {
			k_spin_unlock(&lock, spinlock_key);
			arch_irq_unlock(key);
			return;
		}

		spinlock_grabbed[core_id]++;

		/* Imitate some work which takes time */
		volatile uint32_t countdown = 10000;

		while (countdown--)
			;

		atomic_dec(&fairness_test_cycles);

		k_spin_unlock(&lock, spinlock_key);
	} while (atomic_get(&fairness_test_cycles) != 0);

	arch_irq_unlock(key);
}

static void test_init(void)
{
	memset(tthread, 0x00, sizeof(tthread));
	memset(tstack, 0x00, sizeof(tstack));
	atomic_set(&start_sync, CORES_NUM);
	atomic_set(&fairness_test_cycles, FAIRNESS_TEST_CYCLES_PER_CORE * CORES_NUM);

	for (uintptr_t core_id = 0; core_id < CORES_NUM; core_id++) {
		struct k_thread *thread = get_thread(core_id);

		k_thread_create(thread, tstack[core_id], STACK_SIZE,
		   (k_thread_entry_t)test_thread,
		   (void *)core_id, NULL, NULL,
		   K_PRIO_COOP(10), 0, K_FOREVER);

		/*
		 * Pin each thread to a particular CPU core.
		 * The larger the core's memory access latency in comparison to the
		 * other cores - the less chances to win a contention for the spinlock
		 * this core will have in case the spinlock implementation doesn't
		 * provide acquisition fairness.
		 */
		k_thread_cpu_pin(thread, core_id);
	}
}

/**
 * @brief Test spinlock acquisition fairness
 *
 * @details This test verifies a spinlock acquisition fairness in relation
 *		to the cores contending for the spinlock. Memory access latency may
 *		vary between the CPU cores, so that some CPUs reach the spinlock faster
 *		than the others and depending on spinlock implementation may get
 *		higher chance to win the contention for the spinlock than the other
 *		cores, making them to starve.
 *		This effect may become critical for some real-life platforms
 *		(e.g. NUMA) resulting in performance loss or even a live-lock,
 *		when a single CPU is continuously winning the contention.
 *		This test ensures that the probability to win the contention for a
 *		spinlock is evenly distributed between all of the contending cores.
 *
 * @ingroup kernel_spinlock_tests
 *
 * @see k_spin_lock(), k_spin_unlock()
 */
ZTEST(spinlock, test_spinlock_fairness)
{
	test_init();

	/* Launching all the threads */
	for (uint8_t core_id = 0; core_id < CORES_NUM; core_id++) {
		struct k_thread *thread = get_thread(core_id);

		k_thread_start(thread);
	}
	/* Waiting for all the threads to complete */
	for (uint8_t core_id = 0; core_id < CORES_NUM; core_id++) {
		struct k_thread *thread = get_thread(core_id);

		k_thread_join(thread, K_FOREVER);
	}

	/* Print statistics */
	for (uint8_t core_id = 0; core_id < CORES_NUM; core_id++) {
		printk("CPU%u acquired spinlock %u times, expected %u\n",
			core_id, spinlock_grabbed[core_id], FAIRNESS_TEST_CYCLES_PER_CORE);
	}

	/*
	 * Verify spinlock acquisition fairness.
	 *
	 * With CONFIG_TICKET_SPINLOCKS the lock is FIFO-fair by
	 * construction, so on real hardware the acquisition count is
	 * exactly even and the strict check is a cheap regression guard.
	 *
	 * On an emulated target the vCPUs are time-sliced unevenly by the
	 * host scheduler (twister oversubscribes the host), so the count
	 * reflects host scheduling rather than the lock. The emulator
	 * cannot measure fairness, so report the split as informational
	 * there instead of asserting on it.
	 */
	for (uint8_t core_id = 0; core_id < CORES_NUM; core_id++) {
		if (IS_ENABLED(CONFIG_QEMU_TARGET)) {
			if (spinlock_grabbed[core_id] < FAIRNESS_TEST_CYCLES_PER_CORE) {
				printk("CPU%u acquired the spinlock %u times, expected %u "
					"(not asserted on an emulated target)\n",
					core_id, spinlock_grabbed[core_id],
					FAIRNESS_TEST_CYCLES_PER_CORE);
			}
		} else {
			zassert_false(spinlock_grabbed[core_id] < FAIRNESS_TEST_CYCLES_PER_CORE,
				"CPU%d starved on a spinlock: acquired %u times, expected %u\n",
				core_id, spinlock_grabbed[core_id], FAIRNESS_TEST_CYCLES_PER_CORE);
		}
	}
}

#endif /* CONFIG_SCHED_CPU_MASK */
```

## src/spinlock_pool.c
```c
/*
 * Copyright (c) 2026 Måns Ansgariusson <mansgariusson@gmail.com>
 *
 * SPDX-License-Identifier: Apache-2.0
 */

#include <zephyr/spinlock.h>
#include <zephyr/ztest.h>

#define NUMBER_OF_SPINLOCKS 8

SPINLOCK_POOL_DEFINE(lonely_lock, 1);
SPINLOCK_POOL_DEFINE(test_pool, NUMBER_OF_SPINLOCKS);

ZTEST(spinlock_pool, test_spinlock_single)
{
	for (size_t i = 0; i < 128; i++) {
		zassert_equal_ptr(spinlock_find(lonely_lock, i), &lonely_lock[0]);
	}

	zassert_equal_ptr(spinlock_find(lonely_lock, UINTPTR_MAX), &lonely_lock[0]);
}

ZTEST(spinlock_pool, test_spinlock_lookup)
{
	uintptr_t object = 0x1234U;
	struct k_spinlock *lock = spinlock_find(test_pool, object);

	zassume(sizeof(struct k_spinlock) != 0, "pool elements are zero-sized");

	zassert_true(lock >= &test_pool[0]);
	zassert_true(lock < &test_pool[NUMBER_OF_SPINLOCKS]);

	zassert_equal_ptr(spinlock_find(test_pool, object), lock);
}

ZTEST(spinlock_pool, test_spinlock_distribution)
{
	bool seen[NUMBER_OF_SPINLOCKS] = { false };

	zassume(sizeof(struct k_spinlock) != 0, "pool elements are zero-sized");

	for (size_t i = 0; i < NUMBER_OF_SPINLOCKS; i++) {
		struct k_spinlock *lock = spinlock_find(test_pool, i * 4U);
		size_t index = z_spinlock_index(i * 4U, NUMBER_OF_SPINLOCKS);

		zassert_equal_ptr(lock, &test_pool[index], "lock does not match computed slot");
		zassert_false(seen[index], "pool %zu selected more than once", index);
		seen[index] = true;
	}

	for (size_t i = 0; i < NUMBER_OF_SPINLOCKS; i++) {
		zassert_true(seen[i], "pool %zu was not selected", i);
	}
}

ZTEST(spinlock_pool, test_spinlock_lock)
{
	struct k_spinlock *lock = spinlock_find(test_pool, 4U);
	k_spinlock_key_t key = k_spin_lock(lock);

	zassert_true(z_spin_is_locked(lock));
	k_spin_unlock(lock, key);
	zassert_false(z_spin_is_locked(lock));
}


ZTEST(spinlock_pool, test_spinlock_dual_access)
{
	struct k_spinlock *lock1 = spinlock_find(test_pool, 4U);
	struct k_spinlock *lock2 = spinlock_find(test_pool, 8U);

	k_spinlock_key_t key1 = k_spin_lock(lock1);
	k_spinlock_key_t key2 = k_spin_lock(lock2);

	zassert_true(z_spin_is_locked(lock1));
	zassert_true(z_spin_is_locked(lock2));

	k_spin_unlock(lock2, key2);
	k_spin_unlock(lock1, key1);

	zassert_false(z_spin_is_locked(lock1));
	zassert_false(z_spin_is_locked(lock2));
}

ZTEST_SUITE(spinlock_pool, NULL, NULL, NULL, NULL, NULL);
```
