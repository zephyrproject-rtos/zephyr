## prj.conf
```kconfig
CONFIG_STDOUT_CONSOLE=y
CONFIG_ZTEST=y
```

## src/main.c
```c
/*
 * Copyright (c) 2017 Intel Corporation
 *
 * SPDX-License-Identifier: Apache-2.0
 */

#include <ztest.h>
extern void test_multilib(void);

/**test case main entry*/
void test_main(void)
{
	ztest_test_suite(test_multilib_fn,
		ztest_unit_test(test_multilib));
	ztest_run_test_suite(test_multilib_fn);
}
```

## src/multilib.c
```c
/*
 * Copyright (c) 2016 Linaro Ltd.
 *
 * SPDX-License-Identifier: Apache-2.0
 */

#include <zephyr.h>
#include <errno.h>
#include <tc_util.h>
#include <ztest.h>

void test_multilib(void)
{
	volatile long long a = 100;
	volatile long long b = 3;
	volatile long long c = a / b;

	TC_START("test_multilib");

	/**TESTPOINT: Check if the correct multilib is selected*/
	zassert_equal(c, 33, "smoke-test failed: wrong multilib selected");
}
```

## src/test_multilib.c
```c
/*
 * Copyright (c) 2016 Linaro Ltd.
 *
 * SPDX-License-Identifier: Apache-2.0
 */

#include <zephyr.h>
#include <errno.h>
#include <tc_util.h>

void main(void)
{
	volatile long long a = 100;
	volatile long long b = 3;
	volatile long long c = a / b;
	int rv = TC_PASS;

	TC_START("test_multilib");
	if (c != 33) {
		rv = TC_FAIL;
	}

	TC_END_RESULT(rv);
	TC_END_REPORT(rv);
}
```
