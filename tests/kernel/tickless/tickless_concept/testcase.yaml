## tests/kernel/tickless/tickless_concept/testcase.yaml
```yaml
tests:
  kernel.tickless.concept:
    platform_exclude:
      - litex_vexriscv
      - rv32m1_vega/openisa_rv32m1/zero_riscy
      - rv32m1_vega/openisa_rv32m1/ri5cy
      - nrf5340dk/nrf5340/cpunet
      - nucleo_l073rz
    tags:
      - kernel
      - pm
```

## tests/kernel/timer/cycle64/testcase.yaml
```yaml
# Note: Re: slow vs fast
#
# Some platforms such as native_sim, qemu_riscv32, qemu_riscv64
# complete these tests almost instantaneously because of qemu timer
# quirks ("time warp") even though the test reports that it completes
# in e.g. 14 s. We can take advantage of that for fast tests on each PR
# but we also want to exercise this code path during daily builds or
# otherwise when users specify "twister --enable-slow".
#
# As other platforms are added with varying timer frequencies, increase
# timeout as necessary.
tests:
  kernel.timer.cycle64:
    tags:
      - kernel
      - timer
    filter: CONFIG_TIMER_HAS_64BIT_CYCLE_COUNTER and not CONFIG_NRF_GRTC_TIMER
    arch_exclude: posix
    timeout: 140
    slow: true
  kernel.timer.cycle64.fast:
    tags:
      - kernel
      - timer
    filter: CONFIG_TIMER_HAS_64BIT_CYCLE_COUNTER and not CONFIG_NRF_GRTC_TIMER
    arch_allow: posix
  kernel.timer.cycle64.grtc:
    tags:
      - kernel
      - timer
    filter: CONFIG_TIMER_HAS_64BIT_CYCLE_COUNTER and CONFIG_NRF_GRTC_TIMER
    arch_exclude: posix
    timeout: 8600
    slow: true
```

## tests/kernel/timer/deferrable_timeout/testcase.yaml
```yaml
tests:
  kernel.timer.deferrable_timeout:
    tags:
      - kernel
      - timer
```

## tests/kernel/timer/starve/testcase.yaml
```yaml
tests:
  kernel.timer.starve:
    slow: true
    timeout: 3700
    tags: kernel timer
```

## tests/kernel/timer/timeout/testcase.yaml
```yaml
tests:
  kernel.timer.timeout:
    tags:
      - kernel
      - timer
  kernel.timer.timeout.min_heap:
    tags:
      - kernel
      - timer
    extra_conf_files:
      - prj_heap.conf
    integration_platforms:
      - cy8cproto_041tp
      - esp32c3_devkitm
```

## tests/kernel/timer/timepoints/testcase.yaml
```yaml
tests:
  kernel.timer.timepoints:
    tags:
      - kernel
      - timer
  kernel.timer.timepoints.min_heap:
    tags:
      - kernel
      - timer
    extra_conf_files:
      - prj_heap.conf
    integration_platforms:
      - cy8cproto_041tp
      - esp32c3_devkitm
```

## tests/kernel/timer/timer_api/testcase.yaml
```yaml
tests:
  kernel.timer:
    tags:
      - kernel
      - timer
      - userspace
  kernel.timer.no_multitheading:
    tags:
      - kernel
      - timer
    platform_allow:
      - qemu_cortex_m3
      - nsim/nsim_em
      - nsim/nsim_em7d_v22
      - nsim/nsim_hs
      - nsim/nsim_hs/mpuv6
      - nsim/nsim_hs5x
      - nsim/nsim_hs6x
      - qemu_arc/qemu_arc_em
      - qemu_arc/qemu_arc_hs
      - qemu_arc/qemu_arc_hs6x
      - qemu_leon3
    integration_platforms:
      - qemu_cortex_m3
      - nsim/nsim_em
    extra_configs:
      - CONFIG_MULTITHREADING=n
      - CONFIG_TEST_USERSPACE=n
      - CONFIG_SPIN_VALIDATE=n
```

## tests/kernel/timer/timer_behavior/Kconfig
```kconfig
# SPDX-License-Identifier: Apache-2.0
# Copyright (c) 2022 Intel Corporation

mainmenu "Timer Behavior Test"

config SYS_CLOCK_TICKS_PER_SEC
	default 8192 if NRF_RTC_TIMER && TICKLESS_KERNEL

source "Kconfig.zephyr"

config TIMER_TEST_SAMPLES
	int "The number of timer samples to gather for statistics"
	default 1000 if (SRAM_SIZE < 24)
	default 2000 if (SRAM_SIZE < 32)
	default 3000 if (SRAM_SIZE < 48)
	default 5000 if (SRAM_SIZE < 64)
	default 7000 if (SRAM_SIZE < 96)
	default 10000

config TIMER_TEST_PERIOD
	int "The number of microseconds to for the timer period"
	default 1000

config TIMER_TEST_MAX_STDDEV
	int "Maximum standard deviation in microseconds allowed"
	default 10

config TIMER_TEST_MAX_DRIFT
	int "Maximum drift in microseconds allowed (should be about 1 period allowance)"
	default 1000

config TIMER_TEST_PERIOD_MAX_DRIFT_PERCENT
	int "Maximum drift percentage for the timer period"
	default 10
	help
	  A value of 10 means 10%.
```

## tests/kernel/timer/timer_behavior/boards/imx95_evk_mimx9596_m7.conf
```kconfig
CONFIG_MCUX_LPTMR_TIMER=y
CONFIG_TICKLESS_KERNEL=y
CONFIG_SYS_CLOCK_TICKS_PER_SEC=1024
```

## tests/kernel/timer/timer_behavior/dts/bindings/timer-behavior-external.yaml
```yaml
# Copyright (c) 2023 Intel Corporation
#
# SPDX-License-Identifier: Apache-2.0

description: |
  Binding providing resources required to build and run the
  tests/kernel/timer/timer_behavior/kernel.timer.timer_behavior_external
  test in Zephyr.

compatible: "test-kernel-timer-behavior-external"

properties:
  timerout-gpios:
    type: phandle-array
    required: true
    description:
      GPIO pin that will toggle on each cycle of the test, to be
      connected to an external tool (such as a logic analyzer)
      that will collect timing information.
```

## tests/kernel/timer/timer_behavior/testcase.yaml
```yaml
tests:
  kernel.timer.timer:
    tags:
      - kernel
      - timer
    min_ram: 16
    platform_type:
      - mcu
    simulation_exclude:
      - renode
  kernel.timer.timer_behavior_external:
    filter: dt_compat_enabled("test-kernel-timer-behavior-external")
    harness: pytest
    harness_config:
      pytest_args: ['--tool', 'saleae_logic2', '--tool-options',
                    'address=127.0.0.1,port=10430,channel=1,sample-rate=6_250_000,threshold-volts=3.3']
      fixture: gpio_timerout
    extra_configs:
      - CONFIG_TIMER_EXTERNAL_TEST=y
      - CONFIG_BOOT_DELAY=5000
```

## tests/kernel/timer/timer_error_case/testcase.yaml
```yaml
tests:
  kernel.timer.error_case:
    tags:
      - kernel
      - timer
      - userspace
      - pearl_gecko
    ignore_faults: true
```

## tests/kernel/timer/timer_monotonic/testcase.yaml
```yaml
tests:
  kernel.timer.monotonic:
    tags:
      - kernel
      - timer
  kernel.timer.monotonic.apic.tsc:
    tags:
      - kernel
      - timer
      - apic_tsc
    platform_allow: intel_ehl_crb
    extra_configs:
      - CONFIG_APIC_TSC_DEADLINE_TIMER=y
      - CONFIG_HPET_TIMER=n
  kernel.timer.monotonic.icount_off:
    # Extra test for GH-48608
    tags:
      - kernel
      - timer
    platform_allow: mps2/an385
    extra_configs:
      - CONFIG_QEMU_ICOUNT=n
```

## tests/kernel/timer/timer_schedule/testcase.yaml
```yaml
tests:
  kernel.timer:
    tags: kernel
    arch_exclude: riscv32 nios2 posix
  kernel.timer.tickless:
    build_only: true
    extra_args: CONF_FILE="prj_tickless.conf"
    arch_exclude: riscv32 nios2 posix
    tags: kernel
```

## tests/kernel/timer/timer_starve/Kconfig
```kconfig
# SPDX-License-Identifier: Apache-2.0
# Copyright (c) 2019 Nordic Semiconductor ASA

mainmenu "Timer Starvation Test"

source "Kconfig.zephyr"

config APP_STOP_S
	int "The number of seconds to run without error before pass"
	default 3600
```

## tests/kernel/timer/timer_starve/testcase.yaml
```yaml
tests:
  kernel.timer.starve:
    slow: true
    timeout: 3700
    tags:
      - kernel
      - timer
    integration_platforms:
      - qemu_x86
```

## tests/kernel/timer/timer_stress/testcase.yaml
```yaml
tests:
  kernel.timer.stress:
    tags:
      - kernel
      - timer
    integration_platforms:
      - qemu_cortex_m3
      - native_sim
```

## tests/kernel/usage/thread_runtime_stats/testcase.yaml
```yaml
tests:
  kernel.usage:
    tags: kernel
# The following architectures are excluded as they have boards that
# exhibit precision timing anomalies related to emulation.
#     posix, riscv32, sparc
# The following architectures are exluded as the necessary
# thread runtime statistic hooks do not yet exist.
#     mips
    arch_exclude: posix sparc mips
# SMP is excluded as the test was only written for UP
    filter: not CONFIG_SMP
```

## tests/kernel/userbufer_validate/testcase.yaml
```yaml
tests:
     - test:
        tags: kernel userspace
        filter: CONFIG_ARCH_HAS_USERSPACE
```

## tests/kernel/usleep/testcase.yaml
```yaml
tests:
  kernel.usleep:
    tags: sleep
    arch_whitelist: x86
    platform_exclude: quark_d2000_crb quark_se_c1000_devboard tinytile acrn arduino_101
```

## tests/kernel/version_header/testcase.yaml
```yaml
tests:
  kernel.version:
    arch_exclude: posix
    platform_exclude: qemu_x86 qemu_cortex_m3 qemu_xtensa
                      qemu_nios2 x86_jailhouse qemu_riscv32
                      xt-sim mps2_an385
    tags: version header
```

## tests/kernel/workq/critical/Kconfig
```kconfig
# Copyright (c) 2024 Intel Corporation
# SPDX-License-Identifier: Apache-2.0
source "Kconfig.zephyr"

if WDT_SAM
config WDT_DISABLE_AT_BOOT
	bool "Disable at boot"
	default y
endif
```
