## CMakeLists.txt
```
# SPDX-License-Identifier: Apache-2.0

cmake_minimum_required(VERSION 3.28.0)
find_package(Zephyr REQUIRED HINTS $ENV{ZEPHYR_BASE})
project(tickless_concept)

FILE(GLOB app_sources src/*.c)
target_sources(app PRIVATE ${app_sources})
```

## Kconfig
```
# Copyright (c) 2025 Nordic Semiconductor ASA
# SPDX-License-Identifier: Apache-2.0

config SYS_CLOCK_TICKS_PER_SEC
	default 128 if NRF_RTC_TIMER
	default 1000 if RENESAS_RX_TIMER_CMT
	default 100

source "Kconfig.zephyr"
```

## prj.conf
```kconfig
CONFIG_ZTEST=y
CONFIG_SYS_CLOCK_TICKS_PER_SEC=100
CONFIG_MP_MAX_NUM_CPUS=1
```

## boards/mimxrt595_evk_cm33.conf
```kconfig
#
# Copyright 2022, NXP
#
# SPDX-License-Identifier: Apache-2.0
#

# Turn on Device Level Power Management as we wish
# to reconfigure the FlexSPI pins for power savings
# when transitioning the SoC to Deep Low Power modes.
CONFIG_PM_DEVICE=y
```

## boards/mimxrt595_evk_cm33.overlay
```dts
/*
 * Copyright 2022, NXP
 *
 * SPDX-License-Identifier: Apache-2.0
 */

&os_timer {
	status = "okay";
	wakeup-source;
};
```

## boards/rza3ul_smarc.overlay
```dts
/*
 * Copyright (c) 2025 Renesas Electronics Corporation
 *
 * SPDX-License-Identifier: Apache-2.0
 */

&gtm0 {
	os_timer {
		status = "okay";
	};
};
```

## boards/rzg3s_smarc_r9a08g045s33gbg_cm33.overlay
```dts
/*
 * Copyright (c) 2024 Renesas Electronics Corporation
 *
 * SPDX-License-Identifier: Apache-2.0
 */

&gtm0 {
	os_timer {
		status = "okay";
	};
};

&systick {
	status = "disabled";
};
```

## boards/rzv2l_smarc_r9a07g054l23gbg_cm33.overlay
```dts
/*
 * Copyright (c) 2025 Renesas Electronics Corporation
 *
 * SPDX-License-Identifier: Apache-2.0
 */

&gtm0 {
	os_timer {
		status = "okay";
	};
};

&systick {
	status = "disabled";
};
```

## src/main.c
```c
/*
 * Copyright (c) 2017 Intel Corporation
 *
 * SPDX-License-Identifier: Apache-2.0
 */

#include <zephyr/ztest.h>
#include <zephyr/pm/pm.h>

#define STACK_SIZE (512 + CONFIG_TEST_EXTRA_STACK_SIZE)
#define NUM_THREAD 4
static K_THREAD_STACK_ARRAY_DEFINE(tstack, NUM_THREAD, STACK_SIZE);
static struct k_thread tdata[NUM_THREAD];

/* Sleep duration for the tickless / tickful cases, in milliseconds (the
 * unit kernel sleep APIs accept).
 */
#define SLEEP_TICKLESS_MS  k_ticks_to_ms_floor64(k_ms_to_ticks_floor64(200))
#define SLEEP_TICKFUL_MS   k_ticks_to_ms_floor64(k_ms_to_ticks_floor64(200) - 1)

/* Slice is half of the sleep duration.  Defined in ms (kernel slicing
 * API takes ms) and ticks (measurements compare in ticks).
 */
#define SLICE_SIZE_MS      (SLEEP_TICKLESS_MS / 2)
#define SLICE_TICKS        k_ms_to_ticks_ceil32(SLICE_SIZE_MS)

/* Timeout interrupt and thread dispatch latency can span multiple ticks when
 * the tick period is shorter than one millisecond. At lower tick rates this
 * still evaluates to a one-tick tolerance.
 */
#define SLICE_TOLERANCE_TICKS k_ms_to_ticks_ceil32(1)

/*align to millisecond boundary*/
#define ALIGN_MS_BOUNDARY()		       \
	do {				       \
		uint32_t t = k_uptime_get_32();   \
		while (t == k_uptime_get_32()) \
			Z_SPIN_DELAY(50);       \
	} while (0)

K_SEM_DEFINE(sema, 0, NUM_THREAD);
/* Reference timestamp (in ticks) for measuring slice durations */
static uint64_t elapsed_slice;
static uint32_t elapsed_slices[NUM_THREAD];

static uint32_t ticks_delta(uint64_t *reftime)
{
	uint64_t now = k_uptime_ticks();
	uint32_t delta = now - *reftime;

	*reftime = now;
	return delta;
}

static void thread_tslice(void *p1, void *p2, void *p3)
{
	uint32_t idx = POINTER_TO_UINT(p1);

	elapsed_slices[idx] = ticks_delta(&elapsed_slice);

	/*keep the current thread busy for more than one slice*/
	k_busy_wait(1000 * SLEEP_TICKLESS_MS);
	k_sem_give(&sema);
}
/**
 * @defgroup  kernel_tickless_tests Tickless
 * @ingroup all_tests
 * @{
 */


/**
 * @brief Verify system clock with and without tickless idle
 *
 * @details Check if system clock recovers and works as expected
 * when tickless idle is enabled and disabled.
 */
ZTEST(tickless_concept, test_tickless_sysclock)
{
	volatile uint32_t t0, t1;

	ALIGN_MS_BOUNDARY();
	t0 = k_uptime_get_32();
	k_msleep(SLEEP_TICKLESS_MS);
	t1 = k_uptime_get_32();
	TC_PRINT("time %d, %d\n", t0, t1);
	/**TESTPOINT: verify system clock recovery after exiting tickless idle*/
	zassert_true((t1 - t0) >= SLEEP_TICKLESS_MS);

	ALIGN_MS_BOUNDARY();
	t0 = k_uptime_get_32();
	k_sem_take(&sema, K_MSEC(SLEEP_TICKFUL_MS));
	t1 = k_uptime_get_32();
	TC_PRINT("time %d, %d\n", t0, t1);
	/**TESTPOINT: verify system clock recovery after exiting tickful idle*/
	zassert_true((t1 - t0) >= SLEEP_TICKFUL_MS);
}

/**
 * @brief Verify tickless functionality with time slice
 *
 * @details Create threads of equal priority and enable time
 * slice. Check if the threads execute more than a tick.
 */
ZTEST(tickless_concept, test_tickless_slice)
{
	k_tid_t tid[NUM_THREAD];

	k_sem_reset(&sema);
	/*enable time slice*/
	k_sched_time_slice_set(SLICE_SIZE_MS, K_PRIO_PREEMPT(0));

	/*create delayed threads with equal preemptive priority*/
	for (int i = 0; i < NUM_THREAD; i++) {
		tid[i] = k_thread_create(&tdata[i], tstack[i], STACK_SIZE,
					 thread_tslice, UINT_TO_POINTER(i), NULL, NULL,
					 K_PRIO_PREEMPT(0), 0,
					 K_MSEC(SLICE_SIZE_MS));
	}
	ticks_delta(&elapsed_slice);
	/*relinquish CPU and wait for each thread to complete*/
	for (int i = 0; i < NUM_THREAD; i++) {
		k_sem_take(&sema, K_FOREVER);
	}

	/*test case teardown*/
	for (int i = 0; i < NUM_THREAD; i++) {
		k_thread_abort(tid[i]);
	}
	/*disable time slice*/
	k_sched_time_slice_set(0, K_PRIO_PREEMPT(0));

	for (int i = 0; i < NUM_THREAD; i++) {
		uint32_t tick_delta = elapsed_slices[i];

		TC_PRINT("elapsed slice %u ticks, expected ~%u\n",
			 tick_delta, (uint32_t)SLICE_TICKS);

		zexpect_between_inclusive(tick_delta,
					  SLICE_TICKS - SLICE_TOLERANCE_TICKS,
					  SLICE_TICKS + SLICE_TOLERANCE_TICKS,
					  "elapsed %u ticks, expected ~%u",
					  tick_delta, (uint32_t)SLICE_TICKS);
	}
}

/**
 * @}
 */

ZTEST_SUITE(tickless_concept, NULL, NULL,
		ztest_simple_1cpu_before, ztest_simple_1cpu_after, NULL);
```

## src/test_tickless_sysclock.c
```c
/*
 * Copyright (c) 2017 Intel Corporation
 *
 * SPDX-License-Identifier: Apache-2.0
 */

/**
 * @addtogroup t_tickless
 * @{
 * @defgroup t_tickless_concept test_tickless_concept
 * @brief TestPurpose: verify tickless idle concepts
 * @details
https://www.zephyrproject.org/doc/subsystems/power_management.html#tickless-idle
 * @}
 */

#include <ztest.h>
#include <power.h>

#define STACK_SIZE 512
#define NUM_THREAD 4
static K_THREAD_STACK_ARRAY_DEFINE(tstack, NUM_THREAD, STACK_SIZE);
static struct k_thread tdata[NUM_THREAD];
/*for those not supporting tickless idle*/
#ifndef CONFIG_TICKLESS_IDLE
#define CONFIG_TICKLESS_IDLE_THRESH 20
#endif
/*millisecond per tick*/
#define MSEC_PER_TICK (sys_clock_us_per_tick / USEC_PER_MSEC)
/*sleep duration tickless*/
#define SLEEP_TICKLESS (CONFIG_TICKLESS_IDLE_THRESH * MSEC_PER_TICK)
/*sleep duration with tick*/
#define SLEEP_TICKFUL ((CONFIG_TICKLESS_IDLE_THRESH-1) * MSEC_PER_TICK)
/*slice size is set as half of the sleep duration*/
#define SLICE_SIZE ((CONFIG_TICKLESS_IDLE_THRESH >> 1) * MSEC_PER_TICK)
/*align to millisecond boundary*/
#if defined(CONFIG_ARCH_POSIX)
#define ALIGN_MS_BOUNDARY() \
	do {				       \
		u32_t t = k_uptime_get_32();   \
		while (t == k_uptime_get_32()) \
			posix_halt_cpu();\
	} while (0)
#else
#define ALIGN_MS_BOUNDARY() \
	do {\
		u32_t t = k_uptime_get_32();\
		while (t == k_uptime_get_32())\
			;\
	} while (0)
#endif
K_SEM_DEFINE(sema, 0, NUM_THREAD);
static s64_t elapsed_slice;

static void thread_tslice(void *p1, void *p2, void *p3)
{
	s64_t t = k_uptime_delta(&elapsed_slice);

	TC_PRINT("elapsed slice %lld\n", t);
	/**TESTPOINT: verify slicing scheduler behaves as expected*/
	zassert_true(t >= SLICE_SIZE, NULL);
	/*less than one tick delay*/
	zassert_true(t <= (SLICE_SIZE + MSEC_PER_TICK), NULL);

	u32_t t32 = k_uptime_get_32();

	/*keep the current thread busy for more than one slice*/
	while (k_uptime_get_32() - t32 < SLEEP_TICKLESS)
#if defined(CONFIG_ARCH_POSIX)
		posix_halt_cpu();
#else
		;
#endif
	k_sem_give(&sema);
}

/*test cases*/
void test_tickless_sysclock(void)
{
	volatile u32_t t0, t1;

	ALIGN_MS_BOUNDARY();
	t0 = k_uptime_get_32();
	k_sleep(SLEEP_TICKLESS);
	t1 = k_uptime_get_32();
	TC_PRINT("time %d, %d\n", t0, t1);
	/**TESTPOINT: verify system clock recovery after exiting tickless idle*/
	zassert_true((t1 - t0) >= SLEEP_TICKLESS, NULL);

	ALIGN_MS_BOUNDARY();
	t0 = k_uptime_get_32();
	k_sem_take(&sema, SLEEP_TICKFUL);
	t1 = k_uptime_get_32();
	TC_PRINT("time %d, %d\n", t0, t1);
	/**TESTPOINT: verify system clock recovery after exiting tickful idle*/
	zassert_true((t1 - t0) >= SLEEP_TICKFUL, NULL);
}

void test_tickless_slice(void)
{
	k_tid_t tid[NUM_THREAD];

	k_sem_reset(&sema);
	/*enable time slice*/
	k_sched_time_slice_set(SLICE_SIZE, K_PRIO_PREEMPT(0));

	/*create delayed threads with equal preemptive priority*/
	for (int i = 0; i < NUM_THREAD; i++) {
		tid[i] = k_thread_create(&tdata[i], tstack[i], STACK_SIZE,
			thread_tslice, NULL, NULL, NULL,
			K_PRIO_PREEMPT(0), 0, SLICE_SIZE);
	}
	k_uptime_delta(&elapsed_slice);
	/*relinquish CPU and wait for each thread to complete*/
	for (int i = 0; i < NUM_THREAD; i++) {
		k_sem_take(&sema, K_FOREVER);
	}

	/*test case teardown*/
	for (int i = 0; i < NUM_THREAD; i++) {
		k_thread_abort(tid[i]);
	}
	/*disable time slice*/
	k_sched_time_slice_set(0, K_PRIO_PREEMPT(0));
}
```
