## CMakeLists.txt
```
# SPDX-License-Identifier: Apache-2.0

cmake_minimum_required(VERSION 3.15.7)
find_package(Zephyr REQUIRED HINTS $ENV{ZEPHYR_BASE})
project(tickless)

target_sources(app PRIVATE src/main.c)
target_sources_ifdef(CONFIG_ARM app PRIVATE src/timestamps.c)
```

## prj.conf
```kconfig
CONFIG_PM=y
CONFIG_ZTEST=y

# The code is written to assume a slow tick rate
CONFIG_SYS_CLOCK_TICKS_PER_SEC=100
```

## src/main.c
```c
/* test_tickless.c - tickless idle tests */

/*
 * Copyright (c) 2011, 2013-2014 Wind River Systems, Inc.
 *
 * SPDX-License-Identifier: Apache-2.0
 */

/* DESCRIPTION Unit test for tickless idle feature. */

#include <zephyr.h>
#include <ztest.h>

#include <sys/printk.h>
#include <arch/cpu.h>
#include <tc_util.h>
#if defined(CONFIG_ARCH_POSIX)
#include "posix_board_if.h"
#endif

#define STACKSIZE 4096
#define PRIORITY 6

#define SLEEP_TICKS 10

static struct k_thread thread_tickless;
static K_THREAD_STACK_DEFINE(thread_tickless_stack, STACKSIZE);

#ifdef CONFIG_TICKLESS_IDLE
/* This used to poke an internal kernel variable, which doesn't exit
 * any more.  It was never documented as an API, and the test never
 * failed when it was removed.  So just leave it here as a vestigial
 * thing until the test gets reworked
 */
int32_t _sys_idle_threshold_ticks;
#endif

#define TICKS_TO_MS  (MSEC_PER_SEC / CONFIG_SYS_CLOCK_TICKS_PER_SEC)


/* NOTE: Clock speed may change between platforms */

#define CAL_REPS 16    /* # of loops in timestamp calibration */

/*
 * Arch-specific timer resolution/size types, definitions and
 * timestamp routines.
 */

#if defined(CONFIG_X86) || defined(CONFIG_ARC) || defined(CONFIG_ARCH_POSIX)
typedef uint64_t _timer_res_t;
#define _TIMER_ZERO  0ULL

/* timestamp routines */
#define _TIMESTAMP_OPEN()
#if defined(CONFIG_ARCH_POSIX)
#define _TIMESTAMP_READ()       (posix_get_hw_cycle())
#else
#define _TIMESTAMP_READ()       (z_tsc_read())
#endif
#define _TIMESTAMP_CLOSE()

#elif defined(CONFIG_ARM)

#  if defined(CONFIG_SOC_TI_LM3S6965_QEMU)
/* A bug in the QEMU ARMv7-M sysTick timer prevents tickless idle support */
#error "This QEMU target does not support tickless idle!"
#  endif

typedef uint32_t _timer_res_t;
#define _TIMER_ZERO  0

/* timestamp routines, from timestamps.c */
extern void _timestamp_open(void);
extern uint32_t _timestamp_read(void);
extern void _timestamp_close(void);

#define _TIMESTAMP_OPEN()       (_timestamp_open())
#define _TIMESTAMP_READ()       (_timestamp_read())
#define _TIMESTAMP_CLOSE()      (_timestamp_close())

#else
#error "Unknown target"
#endif

void ticklessTestThread(void)
{
	int32_t start_time;
	int32_t end_time;
	int32_t diff_time;
	int32_t diff_ticks;
	_timer_res_t start_tsc;
	_timer_res_t end_tsc;
	_timer_res_t cal_tsc = _TIMER_ZERO;
	_timer_res_t diff_tsc = _TIMER_ZERO;
	_timer_res_t diff_per;

#ifdef CONFIG_TICKLESS_IDLE
	int32_t oldThreshold;
#endif
	int i;

	printk("Tickless Idle Test\n");
#ifndef CONFIG_TICKLESS_IDLE
	printk("WARNING! Tickless idle support has not been enabled!\n");
#endif

	printk("Calibrating TSC...\n");
#ifdef CONFIG_TICKLESS_IDLE
	oldThreshold = _sys_idle_threshold_ticks;
	/* make sure we do not enter tickless idle mode */
	_sys_idle_threshold_ticks = 0x7FFFFFFF;
#endif

	/* initialize the timer, if necessary */
	_TIMESTAMP_OPEN();

	for (i = 0; i < CAL_REPS; i++) {
		/*
		 * Do a single tick sleep to get us as close to a tick boundary
		 * as we can.
		 */
		k_msleep(TICKS_TO_MS);
		start_time = k_uptime_get_32();
		start_tsc = _TIMESTAMP_READ();
		/* FIXME: one tick less to account for
		 * one  extra tick for _TICK_ALIGN in k_sleep
		 */
		k_msleep((SLEEP_TICKS - 1) * TICKS_TO_MS);
		end_tsc = _TIMESTAMP_READ();
		end_time = k_uptime_get_32();
		cal_tsc += end_tsc - start_tsc;
	}
	cal_tsc /= CAL_REPS;

#if defined(CONFIG_X86) || defined(CONFIG_ARC)
	printk("Calibrated time stamp period = 0x%x%x\n",
	       (uint32_t)(cal_tsc >> 32), (uint32_t)(cal_tsc & 0xFFFFFFFFLL));
#elif defined(CONFIG_ARCH_POSIX)
	printk("Calibrated time stamp period = %" PRIu64 "\n", cal_tsc);
#elif defined(CONFIG_ARM)
	printk("Calibrated time stamp period = 0x%x\n", cal_tsc);
#endif

	printk("Do the real test with tickless enabled\n");

#ifdef CONFIG_TICKLESS_IDLE
	_sys_idle_threshold_ticks = oldThreshold;
#endif

	printk("Going idle for %d ticks...\n", SLEEP_TICKS);

	for (i = 0; i < CAL_REPS; i++) {
		/*
		 * Do a single tick sleep to get us as close to a tick boundary
		 * as we can.
		 */
		k_msleep(TICKS_TO_MS);
		start_time = k_uptime_get_32();
		start_tsc = _TIMESTAMP_READ();
		/* FIXME: one tick less to account for
		 * one  extra tick for _TICK_ALIGN in k_sleep
		 */
		k_msleep((SLEEP_TICKS - 1) * TICKS_TO_MS);
		end_tsc = _TIMESTAMP_READ();
		end_time = k_uptime_get_32();
		diff_tsc += end_tsc - start_tsc;
	}

	diff_tsc /= CAL_REPS;

	diff_time = (end_time - start_time);
	/* Convert ms to ticks*/
	diff_ticks = (diff_time / TICKS_TO_MS);

	printk("start time     : %d\n", start_time);
	printk("end   time     : %d\n", end_time);
	printk("diff  time     : %d\n", diff_time);
	printk("diff  ticks    : %d\n", diff_ticks);

#if defined(CONFIG_X86) || defined(CONFIG_ARC)
	printk("diff  time stamp: 0x%x%x\n",
	       (uint32_t)(diff_tsc >> 32), (uint32_t)(diff_tsc & 0xFFFFFFFFULL));
	printk("Cal   time stamp: 0x%x%x\n",
	       (uint32_t)(cal_tsc >> 32), (uint32_t)(cal_tsc & 0xFFFFFFFFLL));
#elif defined(CONFIG_ARCH_POSIX)
	printk("diff  time stamp: %" PRIu64 "\n", diff_tsc);
	printk("Cal   time stamp: %" PRIu64 "\n", cal_tsc);
#elif defined(CONFIG_ARM)
	printk("diff  time stamp: 0x%x\n", diff_tsc);
	printk("Cal   time stamp: 0x%x\n", cal_tsc);
#endif

	/*
	 * Calculate percentage difference between
	 * calibrated TSC diff and measured result
	 */
	if (diff_tsc > cal_tsc) {
		diff_per = ((diff_tsc - cal_tsc) * 100U) / cal_tsc;
	} else {
		diff_per = ((cal_tsc - diff_tsc) * 100U) / cal_tsc;
	}

	printk("variance in time stamp diff: %d percent\n", (int32_t)diff_per);

#ifndef CONFIG_NONDETERMINISTIC_TIMING
	zassert_equal(diff_ticks, SLEEP_TICKS,
		      "* TEST FAILED. TICK COUNT INCORRECT *");
#endif

	/* release the timer, if necessary */
	_TIMESTAMP_CLOSE();

}
/**
 * @brief Tests to verify tickless feature
 *
 * @defgroup kernel_tickless_tests Tickless
 * @ingroup all_tests
 * @{
 */

/**
 * @brief Test to verify tickless functionality
 *
 * @details Test verifies tickless_idle and tickless
 * functionality
 */
void test_tickless(void)
{
	k_thread_create(&thread_tickless, thread_tickless_stack,
			STACKSIZE,
			(k_thread_entry_t) ticklessTestThread,
			NULL, NULL, NULL,
			PRIORITY, 0, K_NO_WAIT);
	k_sleep(K_MSEC(4000));
}

/**
 * @}
 */
void test_main(void)
{
	ztest_test_suite(tickless,
			 ztest_unit_test(test_tickless));
	ztest_run_test_suite(tickless);
}
```

## src/test_tickless.c
```c
/* test_tickless.c - tickless idle tests */

/*
 * Copyright (c) 2011, 2013-2014 Wind River Systems, Inc.
 *
 * SPDX-License-Identifier: Apache-2.0
 */

/* DESCRIPTION Unit test for tickless idle feature. */

#include <zephyr.h>
#include <ztest.h>

#include <misc/printk.h>
#include <arch/cpu.h>
#include <tc_util.h>
#if defined(CONFIG_ARCH_POSIX)
#include "posix_board_if.h"
#endif

#define STACKSIZE 4096
#define PRIORITY 6

#define SLEEP_TICKS 10

static struct k_thread thread_tickless;
static K_THREAD_STACK_DEFINE(thread_tickless_stack, STACKSIZE);

#ifdef CONFIG_TICKLESS_IDLE
extern s32_t _sys_idle_threshold_ticks;
#endif

#define TICKS_TO_MS  (MSEC_PER_SEC / CONFIG_SYS_CLOCK_TICKS_PER_SEC)


/* NOTE: Clock speed may change between platforms */

#define CAL_REPS 16    /* # of loops in timestamp calibration */

/*
 * Arch-specific timer resolution/size types, definitions and
 * timestamp routines.
 */

#if defined(CONFIG_X86) || defined(CONFIG_ARC) || defined(CONFIG_ARCH_POSIX)
typedef u64_t _timer_res_t;
#define _TIMER_ZERO  0ULL

/* timestamp routines */
#define _TIMESTAMP_OPEN()
#if defined(CONFIG_ARCH_POSIX)
#define _TIMESTAMP_READ()	(posix_get_hw_cycle())
#else
#define _TIMESTAMP_READ()	(_tsc_read())
#endif
#define _TIMESTAMP_CLOSE()

#elif defined(CONFIG_ARM)

#  if defined(CONFIG_SOC_TI_LM3S6965_QEMU)
/* A bug in the QEMU ARMv7-M sysTick timer prevents tickless idle support */
#error "This QEMU target does not support tickless idle!"
#  endif

typedef u32_t _timer_res_t;
#define _TIMER_ZERO  0

/* timestamp routines, from timestamps.c */
extern void _timestamp_open(void);
extern u32_t _timestamp_read(void);
extern void _timestamp_close(void);

#define _TIMESTAMP_OPEN()	(_timestamp_open())
#define _TIMESTAMP_READ()	(_timestamp_read())
#define _TIMESTAMP_CLOSE()	(_timestamp_close())

#else
#error "Unknown target"
#endif

void ticklessTestThread(void)
{
	s32_t start_time;
	s32_t end_time;
	s32_t diff_time;
	s32_t diff_ticks;
	_timer_res_t start_tsc;
	_timer_res_t end_tsc;
	_timer_res_t cal_tsc = _TIMER_ZERO;
	_timer_res_t diff_tsc = _TIMER_ZERO;
	_timer_res_t diff_per;

#ifdef CONFIG_TICKLESS_IDLE
	s32_t oldThreshold;
#endif
	int i;

	printk("Tickless Idle Test\n");
#ifndef CONFIG_TICKLESS_IDLE
	printk("WARNING! Tickless idle support has not been enabled!\n");
#endif

	printk("Calibrating TSC...\n");
#ifdef CONFIG_TICKLESS_IDLE
	oldThreshold = _sys_idle_threshold_ticks;
	/* make sure we do not enter tickless idle mode */
	_sys_idle_threshold_ticks = 0x7FFFFFFF;
#endif

	/* initialize the timer, if necessary */
	_TIMESTAMP_OPEN();

	for (i = 0; i < CAL_REPS; i++) {
		/*
		 * Do a single tick sleep to get us as close to a tick boundary
		 * as we can.
		 */
		k_sleep(TICKS_TO_MS);
		start_time = k_uptime_get_32();
		start_tsc = _TIMESTAMP_READ();
		/* FIXME: one tick less to account for
		 * one  extra tick for _TICK_ALIGN in k_sleep
		 */
		k_sleep((SLEEP_TICKS - 1) * TICKS_TO_MS);
		end_tsc = _TIMESTAMP_READ();
		end_time = k_uptime_get_32();
		cal_tsc += end_tsc - start_tsc;
	}
	cal_tsc /= CAL_REPS;

#if defined(CONFIG_X86) || defined(CONFIG_ARC)
	printk("Calibrated time stamp period = 0x%x%x\n",
		   (u32_t)(cal_tsc >> 32), (u32_t)(cal_tsc & 0xFFFFFFFFLL));
#elif defined(CONFIG_ARCH_POSIX)
	printk("Calibrated time stamp period = %llu\n", cal_tsc);
#elif defined(CONFIG_ARM)
	printk("Calibrated time stamp period = 0x%x\n", cal_tsc);
#endif

	printk("Do the real test with tickless enabled\n");

#ifdef CONFIG_TICKLESS_IDLE
	_sys_idle_threshold_ticks = oldThreshold;
#endif

	printk("Going idle for %d ticks...\n", SLEEP_TICKS);

	for (i = 0; i < CAL_REPS; i++) {
		/*
		 * Do a single tick sleep to get us as close to a tick boundary
		 * as we can.
		 */
		k_sleep(TICKS_TO_MS);
		start_time = k_uptime_get_32();
		start_tsc = _TIMESTAMP_READ();
		/* FIXME: one tick less to account for
		 * one  extra tick for _TICK_ALIGN in k_sleep
		 */
		k_sleep((SLEEP_TICKS - 1) * TICKS_TO_MS);
		end_tsc = _TIMESTAMP_READ();
		end_time = k_uptime_get_32();
		diff_tsc += end_tsc - start_tsc;
	}

	diff_tsc /= CAL_REPS;

	diff_time = (end_time - start_time);
	/* Convert ms to ticks*/
	diff_ticks = (diff_time / TICKS_TO_MS);

	printk("start time     : %d\n", start_time);
	printk("end   time     : %d\n", end_time);
	printk("diff  time     : %d\n", diff_time);
	printk("diff  ticks    : %d\n", diff_ticks);

#if defined(CONFIG_X86) || defined(CONFIG_ARC)
	printk("diff  time stamp: 0x%x%x\n",
		   (u32_t)(diff_tsc >> 32), (u32_t)(diff_tsc & 0xFFFFFFFFULL));
	printk("Cal   time stamp: 0x%x%x\n",
		   (u32_t)(cal_tsc >> 32), (u32_t)(cal_tsc & 0xFFFFFFFFLL));
#elif defined(CONFIG_ARCH_POSIX)
	printk("diff  time stamp: %llu\n", diff_tsc);
	printk("Cal   time stamp: %llu\n", cal_tsc);
#elif defined(CONFIG_ARM) || defined(CONFIG_SOC_QUARK_SE_C1000_SS)
	printk("diff  time stamp: 0x%x\n", diff_tsc);
	printk("Cal   time stamp: 0x%x\n", cal_tsc);
#endif

	/*
	 * Calculate percentage difference between
	 * calibrated TSC diff and measured result
	 */
	if (diff_tsc > cal_tsc) {
		diff_per = (100 * (diff_tsc - cal_tsc)) / cal_tsc;
	} else {
		diff_per = (100 * (cal_tsc - diff_tsc)) / cal_tsc;
	}

	printk("variance in time stamp diff: %d percent\n", (s32_t)diff_per);

	zassert_equal(diff_ticks, SLEEP_TICKS,
			"* TEST FAILED. TICK COUNT INCORRECT *");

	/* release the timer, if necessary */
	_TIMESTAMP_CLOSE();

}

void test_tickless(void)
{
	k_thread_create(&thread_tickless, thread_tickless_stack,
			STACKSIZE,
			(k_thread_entry_t) ticklessTestThread,
			NULL, NULL, NULL,
			PRIORITY, 0, K_NO_WAIT);
	k_sleep(4000);
}

void test_main(void)
{
	ztest_test_suite(test_tick_less,
			ztest_unit_test(test_tickless));
	ztest_run_test_suite(test_tick_less);
}
```

## src/timestamps.c
```c
/*
 * Copyright (c) 2014 Wind River Systems, Inc.
 *
 * SPDX-License-Identifier: Apache-2.0
 */

/**
 * @file
 *
 * Timestamp support for tickless idle testing
 *
 * Platform-specific timestamp support for the tickless idle test.
 */

#include <tc_util.h>
#include <stddef.h>
#include <sys/__assert.h>

#if defined(CONFIG_SOC_TI_LM3S6965_QEMU)
/*
 * @brief Use a General Purpose Timer in
 * 32-bit periodic timer mode (down-counter)
 * (RTC mode's resolution of 1 second is insufficient.)
 */

#define _TIMESTAMP_NUM 0  /* set to timer # for use by timestamp (0-3) */

#define _CLKGATECTRL (*((volatile uint32_t *)0x400FE104))
#define _CLKGATECTRL_TIMESTAMP_EN (1 << (16 + _TIMESTAMP_NUM))

#define _TIMESTAMP_BASE 0x40030000
#define _TIMESTAMP_OFFSET (0x1000 * _TIMESTAMP_NUM)
#define _TIMESTAMP_ADDR (_TIMESTAMP_BASE + _TIMESTAMP_OFFSET)

#define _TIMESTAMP_CFG (*((volatile uint32_t *)(_TIMESTAMP_ADDR + 0)))
#define _TIMESTAMP_CTRL (*((volatile uint32_t *)(_TIMESTAMP_ADDR + 0xC)))
#define _TIMESTAMP_MODE (*((volatile uint32_t *)(_TIMESTAMP_ADDR + 0x4)))
#define _TIMESTAMP_LOAD (*((volatile uint32_t *)(_TIMESTAMP_ADDR + 0x28)))
#define _TIMESTAMP_IMASK (*((volatile uint32_t *)(_TIMESTAMP_ADDR + 0x18)))
#define _TIMESTAMP_ISTATUS (*((volatile uint32_t *)(_TIMESTAMP_ADDR + 0x1C)))
#define _TIMESTAMP_ICLEAR (*((volatile uint32_t *)(_TIMESTAMP_ADDR + 0x24)))
#define _TIMESTAMP_VAL (*((volatile uint32_t *)(_TIMESTAMP_ADDR + 0x48)))

/*
 * Set the rollover value such that it leaves the most significant bit of
 * the returned timestamp value unused.  This allows room for extended values
 * when handling rollovers when converting to an up-counter value.
 */
#define _TIMESTAMP_MAX ((uint32_t)0x7FFFFFFF)
#define _TIMESTAMP_EXT ((uint32_t)0x80000000)

/**
 *
 * @brief Timestamp initialization
 *
 * This routine initializes the timestamp timer.
 *
 * @return N/A
 */
void _timestamp_open(void)
{
	/* QEMU does not currently support the 32-bit timer modes of the GPTM */
	printk("WARNING! Timestamp is not supported for this target!\n");

	/* enable timer access */
	_CLKGATECTRL |= _CLKGATECTRL_TIMESTAMP_EN;

	/* minimum 3 clk delay is required before timer register access */
	k_sleep(K_TICKS(3));

	_TIMESTAMP_CTRL = 0x0;                  /* disable/reset timer */
	_TIMESTAMP_CFG = 0x0;                   /* 32-bit timer */
	_TIMESTAMP_MODE = 0x2;                  /* periodic mode */

	/* maximum interval to reduce rollovers */
	_TIMESTAMP_LOAD = _TIMESTAMP_MAX;
	_TIMESTAMP_IMASK = 0x70F;               /* mask all timer interrupts */
	_TIMESTAMP_ICLEAR = 0x70F;              /* clear all interrupt status */

	_TIMESTAMP_CTRL = 0x1;                  /* enable timer */
}

/**
 *
 * @brief Timestamp timer read
 *
 * This routine returns the timestamp value.
 *
 * @return timestamp value
 */
uint32_t _timestamp_read(void)
{
	static uint32_t last_timer_val;
	static uint32_t cnt;
	uint32_t timer_val = _TIMESTAMP_VAL;

	/* handle rollover for every other read (end of sleep) */

	if ((cnt % 2) && (timer_val > last_timer_val)) {
		last_timer_val = timer_val;

		/* convert to extended up-counter value */
		timer_val = _TIMESTAMP_EXT + (_TIMESTAMP_MAX - timer_val);
	} else {
		last_timer_val = timer_val;

		/* convert to up-counter value */
		timer_val = _TIMESTAMP_MAX - timer_val;
	}

	cnt++;

	return timer_val;
}

/**
 *
 * @brief Timestamp release
 *
 * This routine releases the timestamp timer.
 *
 * @return N/A
 */
void _timestamp_close(void)
{

	/* disable/reset timer */
	_TIMESTAMP_CTRL = 0x0;
	_TIMESTAMP_CFG = 0x0;

	/* disable timer access */
	_CLKGATECTRL &= ~_CLKGATECTRL_TIMESTAMP_EN;
}

#elif defined(CONFIG_SOC_MK64F12)
/* Freescale FRDM-K64F target - use RTC (prescale value) */

#define _COUNTDOWN_TIMER false

#define _CLKGATECTRL (*((volatile uint32_t *)0x4004803C))
#define _CLKGATECTRL_TIMESTAMP_EN (1 << 29)

#define _SYSOPTCTRL2 (*((volatile uint32_t *)0x40048004))
#define _SYSOPTCTRL2_32KHZRTCCLK (1 << 4)

#define _TIMESTAMP_ADDR (0x4003D000)

#define _TIMESTAMP_ICLEAR (*((volatile uint32_t *)(_TIMESTAMP_ADDR + 0x24)))

#define _TIMESTAMP_VAL (*((volatile uint32_t *)(_TIMESTAMP_ADDR + 0)))
#define _TIMESTAMP_PRESCALE (*((volatile uint32_t *)(_TIMESTAMP_ADDR + 0x4)))
#define _TIMESTAMP_COMP (*((volatile uint32_t *)(_TIMESTAMP_ADDR + 0xC)))
#define _TIMESTAMP_CTRL (*((volatile uint32_t *)(_TIMESTAMP_ADDR + 0x10)))
#define _TIMESTAMP_STATUS (*((volatile uint32_t *)(_TIMESTAMP_ADDR + 0x14)))
#define _TIMESTAMP_LOCK (*((volatile uint32_t *)(_TIMESTAMP_ADDR + 0x18)))
#define _TIMESTAMP_IMASK (*((volatile uint32_t *)(_TIMESTAMP_ADDR + 0x1C)))
#define _TIMESTAMP_RACCESS (*((volatile uint32_t *)(_TIMESTAMP_ADDR + 0x800)))
#define _TIMESTAMP_WACCESS (*((volatile uint32_t *)(_TIMESTAMP_ADDR + 0x804)))

/**
 *
 * @brief Timestamp initialization
 *
 * This routine initializes the timestamp timer.
 *
 * @return N/A
 */
void _timestamp_open(void)
{
	/* enable timer access */
	_CLKGATECTRL |= _CLKGATECTRL_TIMESTAMP_EN;

	/* set 32 KHz RTC clk */
	_SYSOPTCTRL2 |= _SYSOPTCTRL2_32KHZRTCCLK;

	_TIMESTAMP_STATUS = 0x0;        /* disable counter */
	_TIMESTAMP_CTRL = 0x100;        /* enable oscillator */

	_TIMESTAMP_LOCK = 0xFF;         /* unlock registers */
	_TIMESTAMP_PRESCALE = 0x0;      /* reset prescale value */
	_TIMESTAMP_COMP = 0x0;          /* reset compensation values */
	_TIMESTAMP_RACCESS = 0xFF;      /* allow register read access */
	_TIMESTAMP_WACCESS = 0xFF;      /* allow register write access */
	_TIMESTAMP_IMASK = 0x0;         /* mask all timer interrupts */

	/* minimum 0.3 sec delay required for oscillator stabilization */
	k_msleep(0.3 * MSEC_PER_SEC);

	/* clear invalid time flag in status register */
	_TIMESTAMP_VAL = 0x0;

	_TIMESTAMP_STATUS = 0x10;       /* enable counter */
}

/**
 *
 * @brief Timestamp timer read
 *
 * This routine returns the timestamp value.
 *
 * @return timestamp value
 */
uint32_t _timestamp_read(void)
{
	static uint32_t last_prescale;
	static uint32_t cnt;
	uint32_t prescale1 = _TIMESTAMP_PRESCALE;
	uint32_t prescale2 = _TIMESTAMP_PRESCALE;

	/* ensure a valid reading */

	while (prescale1 != prescale2) {
		prescale1 = _TIMESTAMP_PRESCALE;
		prescale2 = _TIMESTAMP_PRESCALE;
	}

	/* handle prescale rollover @ 0x8000
	 * for every other read (end of sleep)
	 */

	if ((cnt % 2) && (prescale1 < last_prescale)) {
		prescale1 += 0x8000;
	}

	last_prescale = prescale2;
	cnt++;

	return prescale1;
}

/**
 *
 * @brief Timestamp release
 *
 * This routine releases the timestamp timer.
 *
 * @return N/A
 */
void _timestamp_close(void)
{
	_TIMESTAMP_STATUS = 0x0;        /* disable counter */
	_TIMESTAMP_CTRL = 0x0;          /* disable oscillator */
}

#elif defined(CONFIG_SOC_FAMILY_SAM)
/* Atmel SAM family processor - use RTT (Real-time Timer) */

#include <soc.h>

/**
 *
 * @brief Timestamp initialization
 *
 * This routine initializes the timestamp timer.
 *
 * @return N/A
 */
void _timestamp_open(void)
{
	/* enable RTT clock from PMC */
	soc_pmc_peripheral_enable(ID_RTT);

	/* Reset RTT and set prescaler to 3, minimum required by SAM E70 SoC */
	RTT->RTT_MR = RTT_MR_RTTRST | RTT_MR_RTPRES(3);
}

/**
 *
 * @brief Timestamp timer read
 *
 * This routine returns the timestamp value.
 *
 * @return timestamp value
 */
uint32_t _timestamp_read(void)
{
	uint32_t timer_val_0;
	uint32_t timer_val_1;

	/* As RTT_VR can be updated asynchronously with the Master Clock, it
	 * must be read twice at the same value to ensure the read value is
	 * correct.
	 */
	do {
		timer_val_0 = RTT->RTT_VR;
		timer_val_1 = RTT->RTT_VR;
	} while (timer_val_0 != timer_val_1);

	return timer_val_0;
}

/**
 *
 * @brief Timestamp release
 *
 * This routine releases the timestamp timer.
 *
 * @return N/A
 */
void _timestamp_close(void)
{
	/* disable RTT clock from PMC */
	soc_pmc_peripheral_disable(ID_RTT);
}

#else
#error "Unknown platform"
#endif /* CONFIG_SOC_xxx */
```
