## tests/kernel/common/Kconfig
```kconfig
# Copyright (c) The Zephyr Project Contributors
# SPDX-License-Identifier: Apache-2.0

configdefault MAX_THREAD_BYTES
	default 5 if MP_MAX_NUM_CPUS > 4
	default 3

source "Kconfig.zephyr"
```

## tests/kernel/condvar/sys_condvar/testcase.yaml
```yaml
common:
  tags:
    - kernel
    - condvar
  min_ram: 32
tests:
  kernel.condvar.sys_condvar:
    filter: CONFIG_ARCH_HAS_USERSPACE
    tags: userspace
  kernel.condvar.sys_condvar.nouser:
    extra_configs:
      - CONFIG_TEST_USERSPACE=n
```

## tests/kernel/critical_section_hooks/Kconfig
```kconfig
# Copyright (c) Qualcomm Technologies, Inc. and/or its subsidiaries.
# SPDX-License-Identifier: Apache-2.0

config TEST_CRITICAL_SECTION_HOOKS
	def_bool y
	select CRITICAL_SECTION_HOOKS
	select NONZERO_SPINLOCK_SIZE

source "Kconfig.zephyr"
```

## tests/kernel/mem_protect/demand_paging/mem_map_rollback/testcase.yaml
```yaml
tests:
  kernel.demand_paging.mem_map_rollback:
    tags:
      - kernel
      - mmu
      - demand_paging
    platform_allow:
      - qemu_x86_tiny
```

## tests/kernel/mem_protect/demand_paging/user_domain/boards/qemu_cortex_a53_smp.conf
```kconfig
CONFIG_BACKING_STORE_RAM=y
CONFIG_BACKING_STORE_RAM_PAGES=24
CONFIG_DEMAND_PAGING_ALLOW_IRQ=y
```

## tests/kernel/mem_protect/mem_write_fault/Kconfig
```kconfig
# SPDX-FileCopyrightText: Copyright The Zephyr Project Contributors
# SPDX-License-Identifier: Apache-2.0

mainmenu "Write fault hook test"

source "Kconfig.zephyr"

config TEST_MEM_WRITE_FAULT_HOOK
	bool
	default y
	depends on ARCH_HAS_MEM_WRITE_FAULT && MMU
	select MEM_WRITE_FAULT_HOOK
	help
	  The test provides z_mem_write_fault() itself.
```

## tests/kernel/mem_protect/mem_write_fault/testcase.yaml
```yaml
common:
  ignore_faults: true
  tags:
    - kernel
    - mmu
    - userspace
  filter: CONFIG_ARCH_HAS_MEM_WRITE_FAULT and CONFIG_MMU
  platform_key:
    - arch
    - simulation
tests:
  kernel.memory_protection.mem_write_fault: {}
  kernel.memory_protection.mem_write_fault.userspace:
    filter: CONFIG_ARCH_HAS_USERSPACE
    extra_configs:
      - CONFIG_TEST_USERSPACE=y
      - CONFIG_USERSPACE=y
```

## tests/kernel/mem_protect/syscalls/Kconfig
```kconfig
# Copyright (c) The Zephyr Project Contributors
# SPDX-License-Identifier: Apache-2.0

configdefault MAX_THREAD_BYTES
	default 7 if MP_MAX_NUM_CPUS > 4
	default 5

source "Kconfig.zephyr"
```

## tests/kernel/mem_protect/userspace/boards/intel_adsp_ace30_ptl.conf
```kconfig
CONFIG_MAX_THREAD_BYTES=3
CONFIG_USERSPACE_SWITCHING_TESTS=y
CONFIG_XTENSA_MMU_NUM_L1_TABLES=6
```

## tests/kernel/multiprocessing/ipi_optimize/Kconfig
```kconfig
# SPDX-FileCopyrightText: Copyright The Zephyr Project Contributors
# SPDX-License-Identifier: Apache-2.0

config TEST_IPI_PM_HOOKS
	bool "PM hooks provided by the test"
	depends on ARM64 || RISCV
	select HAS_PM
	# depends on PM would be recursive: PM depends on HAS_PM, selected here
	select PM
	help
	  The test provides pm_state_set() and pm_state_exit_post_ops(): every
	  power state waits for an interrupt with interrupts locked, as SoC
	  hooks do. The wait is a WFI instruction.

source "Kconfig.zephyr"
```

## tests/kernel/mutex/mutex_api/Kconfig
```kconfig
# SPDX-License-Identifier: Apache-2.0
# Copyright (c) 2022 Meta

config TEST_MUTEX_API_THREAD_CREATE_TICKS
	int "Wait time (in ticks) after thread creation"
	default 42

config MAX_THREAD_BYTES
	default 5 if USERSPACE

source "Kconfig"
```

## tests/kernel/process/user_mode_enter/testcase.yaml
```yaml
common:
  tags:
    - kernel
    - process
    - userspace
  filter: CONFIG_ARCH_HAS_USERSPACE
  harness: console
  harness_config:
    type: one_line
    regex:
      - "user_mode_enter: child ok"
tests:
  kernel.process.user_mode_enter:
    integration_platforms:
      - qemu_x86
      - qemu_riscv32
```
