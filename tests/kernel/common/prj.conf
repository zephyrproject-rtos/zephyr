## CMakeLists.txt
```
# SPDX-License-Identifier: Apache-2.0

cmake_minimum_required(VERSION 3.28.0)
find_package(Zephyr REQUIRED HINTS $ENV{ZEPHYR_BASE})
project(kernel_common)

target_sources(app PRIVATE
  src/atomic.c
  src/bitarray.c
  src/byteorder.c
  src/clock.c
  src/main.c
  src/timeout_order.c
  src/multilib.c
  src/errno.c
  src/boot_delay.c
  src/pow2.c
)

target_sources_ifdef(
  CONFIG_STATIC_INIT_GNU
  app PRIVATE
  src/constructor.c
)

target_sources_ifdef(
  CONFIG_IRQ_OFFLOAD
  app PRIVATE
  src/irq_offload.c
)
```

## Kconfig
```
# Copyright (c) The Zephyr Project Contributors
# SPDX-License-Identifier: Apache-2.0

configdefault MAX_THREAD_BYTES
	default 5 if MP_MAX_NUM_CPUS > 4
	default 3

source "Kconfig.zephyr"
```

## prj.conf
```kconfig
CONFIG_ZTEST=y
CONFIG_PRINTK=y
CONFIG_LOG=y
CONFIG_POLL=y
CONFIG_BOOT_DELAY=500
CONFIG_IRQ_OFFLOAD=y
CONFIG_TEST_USERSPACE=y
CONFIG_BOUNDS_CHECK_BYPASS_MITIGATION=y
CONFIG_MAX_THREAD_BYTES=3
```

## prj_hw_random_xoroshiro.conf
```kconfig
CONFIG_ZTEST=y
CONFIG_RING_BUFFER=y
CONFIG_RNG=y
CONFIG_SYS_LOG=y
CONFIG_ENTROPY_GENERATOR=y
CONFIG_XOROSHIRO_RANDOM_GENERATOR=y
CONFIG_POLL=y
```

## prj_sw_random_systimer.conf
```kconfig
CONFIG_ZTEST=y
CONFIG_RING_BUFFER=y
CONFIG_RNG=y
CONFIG_SYS_LOG=y
CONFIG_ENTROPY_GENERATOR=y
CONFIG_TEST_RANDOM_GENERATOR=y
CONFIG_TIMER_RANDOM_GENERATOR=y
CONFIG_POLL=y
```

## boards/kit_psc3m5_evk.overlay
```dts
/*
 *==================================================================================================
 * Copyright (c) 2025 Cypress Semiconductor Corporation (an Infineon company) or
 * an affiliate of Cypress Semiconductor Corporation
 *
 * SPDX-License-Identifier: Apache-2.0
 *==================================================================================================
 */

/ {
	chosen {
		zephyr,code-partition = &slot0_partition;
	};
};

&slot0_partition {
	label = "image-0";
	reg = <0x12000000 DT_SIZE_K(150)>; /* 150k for secure test application */
};

&slot0_ns_partition {
	label = "image-1";
	reg = <0x2025800 DT_SIZE_K(106)>; /* 106k for nonsecure test application */
};
```

## src/main.c
```c
/*
 * Copyright (c) 2016 Intel Corporation
 *
 * SPDX-License-Identifier: Apache-2.0
 */


#include <zephyr/ztest.h>
#include <zephyr/kernel_version.h>
#include <zephyr/sys/speculation.h>
#include <zephyr/version.h>

/**
 * @defgroup kernel_common_tests Common Tests
 * @ingroup all_tests
 * @{
 * @}
 *
 */

#ifndef CONFIG_PRINTK
/**
 * @brief Skipped stub of the printk test used when CONFIG_PRINTK is disabled.
 *
 * @ingroup kernel_printk_tests
 */
ZTEST(printk, test_printk)
{
	ztest_test_skip();
}
#endif

/**
 * @brief Verify sys_kernel_version_get() reports the build-time kernel version.
 *
 * @ingroup kernel_common_tests
 *
 * @details
 * Passing proves that the runtime kernel version returned by
 * sys_kernel_version_get() matches the version constants the image was built
 * with, so version reporting stays consistent with the source tree.
 *
 * Test steps:
 * - Retrieve the packed kernel version via sys_kernel_version_get().
 * - Extract the major, minor, and patchlevel fields with the SYS_KERNEL_VER_*
 *   accessor macros.
 *
 * Expected result:
 * - Each extracted field equals its corresponding KERNEL_VERSION_* /
 *   KERNEL_PATCHLEVEL build-time constant.
 *
 * @see sys_kernel_version_get()
 * @verifies ZEP-SRS-39-1
 * @verifies ZEP-SRS-39-2
 * @verifies ZEP-SRS-39-3
 * @verifies ZEP-SRS-39-4
 * @verifies ZEP-SRS-39-5
 */
ZTEST(common, test_version)
{
	uint32_t version = sys_kernel_version_get();

	zassert_true(SYS_KERNEL_VER_MAJOR(version) == KERNEL_VERSION_MAJOR,
		     "major version mismatch");
	zassert_true(SYS_KERNEL_VER_MINOR(version) == KERNEL_VERSION_MINOR,
		     "minor version mismatch");
	zassert_true(SYS_KERNEL_VER_PATCHLEVEL(version) == KERNEL_PATCHLEVEL,
		     "patchlevel version match");

}

/**
 * @brief Verify k_array_index_sanitize() clamps out-of-bounds indices.
 *
 * @ingroup kernel_common_tests
 *
 * @details
 * Passing proves that the speculation-mitigation helper returns an in-bounds
 * index unchanged and, under userspace, sanitizes an out-of-bounds index to a
 * safe value (0) so that speculative out-of-bounds array accesses cannot leak
 * data.
 *
 * Test steps:
 * - Sanitize an in-bounds index (17 against bound 24) and check it is unchanged.
 * - Under CONFIG_USERSPACE, sanitize an out-of-bounds index (17 against bound 5)
 *   and check the result.
 *
 * Expected result:
 * - The in-bounds index is returned as-is (17); the out-of-bounds index is
 *   clamped to 0 when userspace is enabled.
 *
 * @see k_array_index_sanitize()
 */
ZTEST(common, test_bounds_check_mitigation)
{
	/* Very hard to test against speculation attacks, but we can
	 * at least assert that logically this function does
	 * what it says it does.
	 */

	int index = 17;

	index = k_array_index_sanitize(index, 24);
	zassert_equal(index, 17, "bad index");

#ifdef CONFIG_USERSPACE
	index = k_array_index_sanitize(index, 5);
	zassert_equal(index, 0, "bad index");
#endif
}

extern struct k_stack eno_stack;
extern struct k_thread eno_thread;

void *common_setup(void)
{
#if CONFIG_USERSPACE
	k_thread_access_grant(k_current_get(), &eno_thread, &eno_stack);
#endif

	return NULL;
}

ZTEST_SUITE(common, NULL, common_setup, NULL, NULL, NULL);
```

## src/atomic.c
```c
/*
 * Copyright (c) 2015 Intel Corporation
 *
 * SPDX-License-Identifier: Apache-2.0
 */

#include <zephyr/ztest.h>
#include <zephyr/sys/atomic.h>

/* convenience macro - return either 64-bit or 32-bit value */
#define ATOMIC_WORD(val_if_64, val_if_32)                                                          \
	((atomic_t)((sizeof(void *) == sizeof(uint64_t)) ? (val_if_64) : (val_if_32)))

/* an example of the number of atomic bit in an array */
#define NUM_FLAG_BITS 100

/* set test_cycle 1000us * 20 = 20ms */
#define TEST_CYCLE 20

#define THREADS_NUM 2

#define STACK_SIZE (512 + CONFIG_TEST_EXTRA_STACK_SIZE)

static K_THREAD_STACK_ARRAY_DEFINE(stack, THREADS_NUM, STACK_SIZE);

static struct k_thread thread[THREADS_NUM];

atomic_t total_atomic;

/**
 * @defgroup kernel_atomic_ops_tests Atomic Operations
 * @ingroup all_tests
 * @{
 * @}
 *
 * @addtogroup kernel_atomic_ops_tests
 * @{
 */

/**
 * @brief Verify each atomic operation API mutates and returns the expected value.
 *
 * @ingroup kernel_atomic_ops_tests
 *
 * @details
 * Passing proves that every atomic primitive (compare-and-set, arithmetic,
 * load/store, bitwise, and single-bit operations on both scalar and pointer
 * targets, plus the ATOMIC_DEFINE bit-array) performs the documented
 * read-modify-write semantics: each call returns the prior value of the
 * target and leaves the target updated to the expected result, including for
 * negative operands and per-bit operations across the full atomic word width.
 *
 * Test steps:
 * - Invoke each atomic API in turn against a known target value.
 * - For arithmetic operations, exercise both positive and negative operands.
 * - For bit operations, iterate over every bit position of the atomic word.
 * - For ATOMIC_DEFINE, set and clear each bit of a multi-word bit array.
 *
 * Expected result:
 * - Each call returns the target's previous value and the target holds the
 *   expected post-operation value.
 *
 * @see atomic_cas(), atomic_add(), atomic_sub(),
 * atomic_inc(), atomic_dec(), atomic_get(), atomic_set(),
 * atomic_clear(), atomic_or(), atomic_and(), atomic_xor(),
 * atomic_nand(), atomic_test_bit(), atomic_test_and_clear_bit(),
 * atomic_test_and_set_bit(), atomic_clear_bit(), atomic_set_bit(),
 * ATOMIC_DEFINE
 *
 * @verifies ZEP-SRS-19-1
 * @verifies ZEP-SRS-26-9
 * @verifies ZEP-SRS-26-10
 * @verifies ZEP-SRS-26-11
 * @verifies ZEP-SRS-26-12
 * @verifies ZEP-SRS-26-13
 * @verifies ZEP-SRS-26-14
 * @verifies ZEP-SRS-26-15
 * @verifies ZEP-SRS-26-16
 * @verifies ZEP-SRS-26-17
 * @verifies ZEP-SRS-26-18
 * @verifies ZEP-SRS-26-19
 * @verifies ZEP-SRS-26-20
 * @verifies ZEP-SRS-26-21
 * @verifies ZEP-SRS-26-22
 * @verifies ZEP-SRS-26-23
 * @verifies ZEP-SRS-26-24
 * @verifies ZEP-SRS-26-25
 * @verifies ZEP-SRS-26-26
 * @verifies ZEP-SRS-26-27
 * @verifies ZEP-SRS-26-28
 * @verifies ZEP-SRS-26-29
 * @verifies ZEP-SRS-26-30
 * @verifies ZEP-SRS-26-31
 * @verifies ZEP-SRS-26-32
 * @verifies ZEP-SRS-26-33
 * @verifies ZEP-SRS-26-34
 * @verifies ZEP-SRS-26-35
 * @verifies ZEP-SRS-26-36
 * @verifies ZEP-SRS-26-37
 * @verifies ZEP-SRS-26-38
 * @verifies ZEP-SRS-26-39
 */
ZTEST_USER(atomic, test_atomic)
{
	int i;

	atomic_t target, orig;
	atomic_ptr_t ptr_target;
	atomic_val_t value;
	atomic_val_t oldvalue;
	void *ptr_value, *old_ptr_value;

	ATOMIC_DEFINE(flag_bits, NUM_FLAG_BITS) = {0};

	zassert_equal(sizeof(atomic_t), ATOMIC_WORD(sizeof(uint64_t), sizeof(uint32_t)),
		      "sizeof(atomic_t)");

	target = 4;
	value = 5;
	oldvalue = 6;

	/* atomic_cas() */
	zassert_false(atomic_cas(&target, oldvalue, value), "atomic_cas");
	target = 6;
	zassert_true(atomic_cas(&target, oldvalue, value), "atomic_cas");
	zassert_true((target == value), "atomic_cas");

	/* atomic_ptr_cas() */
	ptr_target = ATOMIC_PTR_INIT((void *)4);
	ptr_value = (atomic_ptr_val_t)5;
	old_ptr_value = (atomic_ptr_val_t)6;
	zassert_false(atomic_ptr_cas(&ptr_target, old_ptr_value, ptr_value),
		      "atomic_ptr_cas");
	ptr_target = (atomic_ptr_val_t)6;
	zassert_true(atomic_ptr_cas(&ptr_target, old_ptr_value, ptr_value),
		     "atomic_ptr_cas");
	zassert_true((ptr_target == ptr_value), "atomic_ptr_cas");

	/* atomic_add() */
	target = 1;
	value = 2;
	zassert_true((atomic_add(&target, value) == 1), "atomic_add");
	zassert_true((target == 3), "atomic_add");
	/* Test the atomic_add() function parameters can be negative */
	target = 2;
	value = -4;
	zassert_true((atomic_add(&target, value) == 2), "atomic_add");
	zassert_true((target == -2), "atomic_add");

	/* atomic_sub() */
	target = 10;
	value = 2;
	zassert_true((atomic_sub(&target, value) == 10), "atomic_sub");
	zassert_true((target == 8), "atomic_sub");
	/* Test the atomic_sub() function parameters can be negative */
	target = 5;
	value = -4;
	zassert_true((atomic_sub(&target, value) == 5), "atomic_sub");
	zassert_true((target == 9), "atomic_sub");

	/* atomic_inc() */
	target = 5;
	zassert_true((atomic_inc(&target) == 5), "atomic_inc");
	zassert_true((target == 6), "atomic_inc");

	/* atomic_dec() */
	target = 2;
	zassert_true((atomic_dec(&target) == 2), "atomic_dec");
	zassert_true((target == 1), "atomic_dec");

	/* atomic_get() */
	target = 50;
	zassert_true((atomic_get(&target) == 50), "atomic_get");

	/* atomic_ptr_get() */
	ptr_target = ATOMIC_PTR_INIT((void *)50);
	zassert_true((atomic_ptr_get(&ptr_target) == (atomic_ptr_val_t)50),
		     "atomic_ptr_get");

	/* atomic_set() */
	target = 42;
	value = 77;
	zassert_true((atomic_set(&target, value) == 42), "atomic_set");
	zassert_true((target == value), "atomic_set");

	/* atomic_ptr_set() */
	ptr_target = ATOMIC_PTR_INIT((void *)42);
	ptr_value = (atomic_ptr_val_t)77;
	zassert_true((atomic_ptr_set(&ptr_target, ptr_value) == (atomic_ptr_val_t)42),
		     "atomic_ptr_set");
	zassert_true((ptr_target == ptr_value), "atomic_ptr_set");

	/* atomic_clear() */
	target = 100;
	zassert_true((atomic_clear(&target) == 100), "atomic_clear");
	zassert_true((target == 0), "atomic_clear");

	/* atomic_ptr_clear() */
	ptr_target = ATOMIC_PTR_INIT((void *)100);
	zassert_true((atomic_ptr_clear(&ptr_target) == (atomic_ptr_val_t)100),
		     "atomic_ptr_clear");
	zassert_true((ptr_target == NULL), "atomic_ptr_clear");

	/* atomic_or() */
	target = 0xFF00;
	value  = 0x0F0F;
	zassert_true((atomic_or(&target, value) == 0xFF00), "atomic_or");
	zassert_true((target == 0xFF0F), "atomic_or");

	/* atomic_xor() */
	target = 0xFF00;
	value  = 0x0F0F;
	zassert_true((atomic_xor(&target, value) == 0xFF00), "atomic_xor");
	zassert_true((target == 0xF00F), "atomic_xor");

	/* atomic_and() */
	target = 0xFF00;
	value  = 0x0F0F;
	zassert_true((atomic_and(&target, value) == 0xFF00), "atomic_and");
	zassert_true((target == 0x0F00), "atomic_and");


	/* atomic_nand() */
	target = 0xFF00;
	value  = 0x0F0F;
	zassert_true((atomic_nand(&target, value) == 0xFF00), "atomic_nand");
	zassert_true((target == ATOMIC_WORD(0xFFFFFFFFFFFFF0FF, 0xFFFFF0FF)), "atomic_nand");

	/* atomic_test_bit() */
	for (i = 0; i < ATOMIC_BITS; i++) {
		target = ATOMIC_WORD(0x0F0F0F0F0F0F0F0F, 0x0F0F0F0F);
		zassert_true(!!(atomic_test_bit(&target, i) == !!(target & BIT(i))),
			     "atomic_test_bit");
	}

	/* atomic_test_and_clear_bit() */
	for (i = 0; i < ATOMIC_BITS; i++) {
		orig = ATOMIC_WORD(0x0F0F0F0F0F0F0F0F, 0x0F0F0F0F);
		target = orig;
		zassert_true(!!(atomic_test_and_clear_bit(&target, i)) == !!(orig & BIT(i)),
			     "atomic_test_and_clear_bit");
		zassert_true(target == (orig & ~BIT(i)), "atomic_test_and_clear_bit");
	}

	/* atomic_test_and_set_bit() */
	for (i = 0; i < ATOMIC_BITS; i++) {
		orig = ATOMIC_WORD(0x0F0F0F0F0F0F0F0F, 0x0F0F0F0F);
		target = orig;
		zassert_true(!!(atomic_test_and_set_bit(&target, i)) == !!(orig & BIT(i)),
			     "atomic_test_and_set_bit");
		zassert_true(target == (orig | BIT(i)), "atomic_test_and_set_bit");
	}

	for (i = 0; i < ATOMIC_BITS; i++) {
		orig = ATOMIC_WORD(0x0F0F0F0F0F0F0F0F, 0x0F0F0F0F);
		target = orig;
		zassert_true(atomic_test_and_set_bit_to(&target, i, false) ==
				     (IS_BIT_SET(orig, i) != IS_BIT_SET(target, i)),
			     "atomic_test_and_set_bit_to");
		zassert_true(target == (orig & ~BIT(i)), "atomic_test_and_set_bit_to");
	}

	for (i = 0; i < ATOMIC_BITS; i++) {
		orig = ATOMIC_WORD(0x0F0F0F0F0F0F0F0F, 0x0F0F0F0F);
		target = orig;
		zassert_true(atomic_test_and_set_bit_to(&target, i, true) ==
				     (IS_BIT_SET(orig, i) != IS_BIT_SET(target, i)),
			     "atomic_test_and_set_bit_to");
		zassert_true(target == (orig | BIT(i)), "atomic_test_and_set_bit_to");
	}

	/* atomic_clear_bit() */
	for (i = 0; i < ATOMIC_BITS; i++) {
		orig = ATOMIC_WORD(0x0F0F0F0F0F0F0F0F, 0x0F0F0F0F);
		target = orig;
		atomic_clear_bit(&target, i);
		zassert_true(target == (orig & ~BIT(i)), "atomic_clear_bit");
	}

	/* atomic_set_bit() */
	for (i = 0; i < ATOMIC_BITS; i++) {
		orig = ATOMIC_WORD(0x0F0F0F0F0F0F0F0F, 0x0F0F0F0F);
		target = orig;
		atomic_set_bit(&target, i);
		zassert_true(target == (orig | BIT(i)), "atomic_set_bit");
	}

	/* atomic_set_bit_to(&target, i, false) */
	for (i = 0; i < ATOMIC_BITS; i++) {
		orig = ATOMIC_WORD(0x0F0F0F0F0F0F0F0F, 0x0F0F0F0F);
		target = orig;
		atomic_set_bit_to(&target, i, false);
		zassert_true(target == (orig & ~BIT(i)), "atomic_set_bit_to");
	}

	/* atomic_set_bit_to(&target, i, true) */
	for (i = 0; i < ATOMIC_BITS; i++) {
		orig = ATOMIC_WORD(0x0F0F0F0F0F0F0F0F, 0x0F0F0F0F);
		target = orig;
		atomic_set_bit_to(&target, i, true);
		zassert_true(target == (orig | BIT(i)), "atomic_set_bit_to");
	}

	/* ATOMIC_DEFINE */
	for (i = 0; i < NUM_FLAG_BITS; i++) {
		atomic_set_bit(flag_bits, i);
		zassert_true(!!atomic_test_bit(flag_bits, i) == !!(1),
			"Failed to set a single bit in an array of atomic variables");
		atomic_clear_bit(flag_bits, i);
		zassert_true(!!atomic_test_bit(flag_bits, i) == !!(0),
			"Failed to clear a single bit in an array of atomic variables");
	}
}

/* This helper function will run more the one slice */
void atomic_handler(void *p1, void *p2, void *p3)
{
	ARG_UNUSED(p1);
	ARG_UNUSED(p2);
	ARG_UNUSED(p3);

	for (int i = 0; i < TEST_CYCLE; i++) {
		atomic_inc(&total_atomic);
		/* Do 1000us busywait to longer the handler execute time */
		k_busy_wait(1000);
	}
}

/**
 * @brief Verify atomic increments from concurrent threads are not lost.
 *
 * @ingroup kernel_atomic_ops_tests
 *
 * @details
 * Passing proves that atomic_inc() is safe under preemptive concurrency: when
 * multiple equal-priority preemptible threads increment a shared atomic_t while
 * being time-sliced in and out, no increment is lost to a torn read-modify-write,
 * so the final value equals the exact total number of increments performed.
 *
 * Test steps:
 * - Enable time slicing so equal-priority preemptible threads are scheduled fairly.
 * - Start THREADS_NUM threads, each incrementing the shared atomic TEST_CYCLE times
 *   with a busy-wait between increments to force interleaving across slices.
 * - Join all threads and disable time slicing.
 *
 * Expected result:
 * - The shared atomic equals TEST_CYCLE * THREADS_NUM.
 *
 * @see atomic_inc()
 * @verifies ZEP-SRS-19-1
 * @verifies ZEP-SRS-26-3
 * @verifies ZEP-SRS-26-4
 * @verifies ZEP-SRS-26-5
 */
ZTEST(atomic, test_threads_access_atomic)
{
	k_tid_t tid[THREADS_NUM];

	/* enable time slice 1ms at priority 10 */
	k_sched_time_slice_set(1, K_PRIO_PREEMPT(10));

	for (int i = 0; i < THREADS_NUM; i++) {
		tid[i] = k_thread_create(&thread[i], stack[i], STACK_SIZE,
				atomic_handler, NULL, NULL, NULL,
				K_PRIO_PREEMPT(10), 0, K_NO_WAIT);
	}

	for (int i = 0; i < THREADS_NUM; i++) {
		k_thread_join(tid[i], K_FOREVER);
	}

	/* disable time slice */
	k_sched_time_slice_set(0, K_PRIO_PREEMPT(10));

	zassert_true(total_atomic == (TEST_CYCLE * THREADS_NUM),
		"atomic counting failure");
}

/**
 * @brief Verify atomic increment overflow wraps identically to plain increment.
 *
 * @ingroup kernel_atomic_ops_tests
 *
 * @details
 * The C standard leaves signed overflow undefined, but Zephyr's atomic_t must
 * behave deterministically. Passing proves that incrementing an atomic_t past
 * its maximum value produces the same wrapped result as an ordinary increment of
 * an equivalently-typed scalar, both at the signed maximum and at the all-ones
 * (unsigned wrap to zero) boundary. This guarantees an atomic variable can be
 * reasoned about with plain arithmetic where it is logically safe to do so.
 *
 * Test steps:
 * - Seed an atomic_t and a matching scalar at the maximum signed value, increment
 *   both, and compare.
 * - Seed both at the all-ones value (-1), increment both, and compare.
 *
 * Expected result:
 * - After each increment the atomic value matches the plain-increment result and
 *   the expected wrapped boundary value.
 *
 * @see atomic_inc()
 * @verifies ZEP-SRS-19-1
 * @verifies ZEP-SRS-26-1
 * @verifies ZEP-SRS-26-2
 * @verifies ZEP-SRS-26-19
 * @verifies ZEP-SRS-26-20
 */
ZTEST(atomic, test_atomic_overflow)
{
	/* Check overflow over max signed value */
	uint64_t overflowed_value = (uint64_t)1 << (ATOMIC_BITS - 1);
	atomic_val_t atomic_value = overflowed_value - 1;
	atomic_t atomic_var = ATOMIC_INIT(atomic_value);

	atomic_value++;
	atomic_inc(&atomic_var);

	zassert_true(atomic_value == atomic_get(&atomic_var),
		"max signed overflow mismatch: %lx/%lx",
		atomic_value, atomic_get(&atomic_var));
	zassert_true(atomic_value == (atomic_val_t)overflowed_value,
		"unexpected value after overflow: %lx, expected: %lx",
		atomic_value, (atomic_val_t)overflowed_value);

	/* Check overflow over max unsigned value */
	atomic_value = -1;
	atomic_var = ATOMIC_INIT(atomic_value);

	atomic_value++;
	atomic_inc(&atomic_var);

	zassert_true(atomic_value == atomic_get(&atomic_var),
		"max unsigned overflow mismatch: %lx/%lx",
		atomic_value, atomic_get(&atomic_var));
	zassert_true(atomic_value == 0,
		"unexpected value after overflow: %lx, expected: 0",
		atomic_value);
}

/**
 * @}
 */
extern void *common_setup(void);
ZTEST_SUITE(atomic, NULL, common_setup, NULL, NULL, NULL);
```

## src/barrier.c
```c
/*
 * Copyright (c) 2022 Alexandre Mergnat <amergnat@baylibre.com>
 *
 * SPDX-License-Identifier: Apache-2.0
 */

#include <zephyr.h>
#include <ztest.h>
#include <kernel.h>

/**
 * @brief Test to verify API functions
 *
 * @ingroup kernel_mem_barrier_tests
 *
 * @details
 * Test Objective:
 * - To verify if all memory barrier API are defined
 *   to catch build regression.
 *
 * Testing techniques:
 * - Call all memory barrier API functions.
 *
 */
ZTEST(mb_api, test_mb_api)
{
	z_full_mb();
	z_read_mb();
	z_write_mb();
}
```

## src/bitfield.c
```c
/*
 * Copyright (c) 2016 Intel Corporation
 *
 * SPDX-License-Identifier: Apache-2.0
 */

#include <zephyr/kernel.h>
#include <zephyr/ztest.h>
#include <zephyr/arch/cpu.h>

#include <zephyr/tc_util.h>

#ifdef CONFIG_BIG_ENDIAN
#define BIT_INDEX(bit)  ((3 - ((bit >> 3) & 0x3)) + 4*(bit >> 5))
#else
#define BIT_INDEX(bit)  (bit >> 3)
#endif
#define BIT_VAL(bit)    (1 << (bit & 0x7))
#define BITFIELD_SIZE   512

/**
 * @defgroup kernel_bitfield_tests Bit Fields
 * @ingroup all_tests
 * @{
 * @}
 *
 * @addtogroup kernel_bitfield_tests
 * @{
 */

/**
 * @brief Verify single-bit and bitfield set/clear/test primitives operate on the correct bit.
 *
 * @ingroup kernel_bitfield_tests
 *
 * @details
 * Exercises the memory-mapped bit manipulation helpers across every bit of a word
 * and of a large multi-byte bitfield. Passing proves each primitive sets, clears,
 * tests and atomically test-and-set/clears only the addressed bit, returns the
 * prior bit state, and leaves neighbouring bits untouched on both endiannesses.
 *
 * Test steps:
 * - For each bit 0..31 of a 32-bit word: set, test, clear and re-test the bit, then
 *   exercise sys_test_and_set_bit() and sys_test_and_clear_bit() checking returned
 *   prior state and resulting value.
 * - For each bit of a BITFIELD_SIZE-bit array: repeat the same sequence using the
 *   sys_bitfield_* helpers, validating the affected byte via BIT_INDEX/BIT_VAL.
 *
 * Expected result:
 * - Every set/clear/test reflects the expected bit value and every test-and-modify
 *   call reports the correct previous state.
 *
 * @see sys_set_bit()
 */
ZTEST(bitfield, test_bitfield)
{
#ifdef CONFIG_ARM
	ztest_test_skip();
#else
	uint32_t b1 = 0U;
	unsigned char b2[BITFIELD_SIZE >> 3] = { 0 };
	unsigned int bit;
	int ret;

	TC_PRINT("twiddling bits....\n");

	for (bit = 0U; bit < 32; ++bit) {
		sys_set_bit((mem_addr_t)&b1, bit);

		zassert_equal(b1, (1 << bit),
			      "sys_set_bit failed on bit %d\n", bit);

		zassert_true(sys_test_bit((mem_addr_t)&b1, bit),
			     "sys_test_bit did not detect bit %d\n", bit);

		sys_clear_bit((mem_addr_t)&b1, bit);
		zassert_equal(b1, 0, "sys_clear_bit failed for bit %d\n", bit);

		zassert_false(sys_test_bit((mem_addr_t)&b1, bit),
			      "sys_test_bit erroneously detected bit %d\n",
			      bit);

		zassert_false(sys_test_and_set_bit((mem_addr_t)&b1, bit),
			      "sys_test_and_set_bit erroneously"
			      " detected bit %d\n", bit);
		zassert_equal(b1, (1 << bit),
			      "sys_test_and_set_bit did not set bit %d\n",
			      bit);
		zassert_true(sys_test_and_set_bit((mem_addr_t)&b1, bit),
			     "sys_test_and_set_bit did not detect bit %d\n",
			     bit);
		zassert_equal(b1, (1 << bit),
			      "sys_test_and_set_bit cleared bit %d\n", bit);

		zassert_true(sys_test_and_clear_bit((mem_addr_t)&b1, bit),
			     "sys_test_and_clear_bit did not detect bit %d\n",
			     bit);
		zassert_equal(b1, 0, "sys_test_and_clear_bit did not clear"
			      " bit %d\n", bit);
		zassert_false(sys_test_and_clear_bit((mem_addr_t)&b1, bit),
			      "sys_test_and_clear_bit erroneously detected"
			      " bit %d\n", bit);
		zassert_equal(b1, 0, "sys_test_and_clear_bit set bit %d\n",
			      bit);
	}

	for (bit = 0U; bit < BITFIELD_SIZE; ++bit) {
		sys_bitfield_set_bit((mem_addr_t)b2, bit);
		zassert_equal(b2[BIT_INDEX(bit)], BIT_VAL(bit),
			      "sys_bitfield_set_bit failed for bit %d\n",
			      bit);
		zassert_true(sys_bitfield_test_bit((mem_addr_t)b2, bit),
			     "sys_bitfield_test_bit did not detect bit %d\n",
			     bit);

		sys_bitfield_clear_bit((mem_addr_t)b2, bit);
		zassert_equal(b2[BIT_INDEX(bit)], 0,
			      "sys_bitfield_clear_bit failed for bit %d\n",
			      bit);
		zassert_false(sys_bitfield_test_bit((mem_addr_t)b2, bit),
			      "sys_bitfield_test_bit erroneously detected"
			      " bit %d\n", bit);

		ret = sys_bitfield_test_and_set_bit((mem_addr_t)b2, bit);
		zassert_false(ret, "sys_bitfield_test_and_set_bit erroneously"
			      " detected bit %d\n", bit);

		zassert_equal(b2[BIT_INDEX(bit)], BIT_VAL(bit),
			      "sys_bitfield_test_and_set_bit did not set"
			      " bit %d\n", bit);
		zassert_true(sys_bitfield_test_and_set_bit((mem_addr_t)b2, bit),
			     "sys_bitfield_test_and_set_bit did not detect bit"
			     " %d\n", bit);
		zassert_equal(b2[BIT_INDEX(bit)], BIT_VAL(bit),
			      "sys_bitfield_test_and_set_bit cleared bit %d\n",
			      bit);

		zassert_true(sys_bitfield_test_and_clear_bit((mem_addr_t)b2,
							     bit), "sys_bitfield_test_and_clear_bit did not"
			     " detect bit %d\n", bit);
		zassert_equal(b2[BIT_INDEX(bit)], 0,
			      "sys_bitfield_test_and_clear_bit did not"
			      " clear bit %d\n", bit);
		zassert_false(sys_bitfield_test_and_clear_bit((mem_addr_t)b2,
							      bit), "sys_bitfield_test_and_clear_bit"
			      " erroneously detected bit %d\n", bit);
		zassert_equal(b2[BIT_INDEX(bit)], 0,
			      "sys_bitfield_test_and_clear_bit set bit %d\n",
			      bit);
	}
#endif

}

/**
 * @}
 */

extern void *common_setup(void);

ZTEST_SUITE(bitfield, NULL, common_setup, NULL, NULL, NULL);
```

## src/bitpool.c
```c
/*
 * Copyright (c) 2025 Nordic Semiconductor ASA
 *
 * SPDX-License-Identifier: Apache-2.0
 */

#include <zephyr/ztest.h>
#include <zephyr/sys/bitpool.h>

/**
 * @addtogroup kernel_common_tests
 * @{
 */

#define BITPOOL_TEST_BITCNT (30)
#define BITPOOL_TEST_LONG_BITCNT (510)

#define zassert_bitpool_bit_true(_v, _b) \
	zassert_true(bitpool_get_bit(_v, _b), "Wrong bit (%u) state, expected true", (_b))

#define zassert_bitpool_bit_false(_v, _b) \
	zassert_false(bitpool_get_bit(_v, _b), "Wrong bit (%u) state, expected false", (_b))

#define bitpool_in_range(bit, low, high) ((bit) >= (low) && (bit) <= (high))

#define __bitpool_in_any_range_fn(bit, ...) bitpool_in_range(bit, __VA_ARGS__)
#define _bitpool_in_any_range_fn(range, bit) __bitpool_in_any_range_fn(bit, __DEBRACKET range)
#define bitpool_in_any_range(bit, ...) \
	(FOR_EACH_FIXED_ARG(_bitpool_in_any_range_fn, (|), bit, __VA_ARGS__))

#define bitpool_check_ranges(var, bitcnt, ...) do {         \
	for (size_t n = 0; n < (bitcnt); ++n) {             \
		if (bitpool_in_any_range(n, __VA_ARGS__)) { \
			zassert_bitpool_bit_true(var, n);   \
		} else {                                    \
			zassert_bitpool_bit_false(var, n);  \
		}                                           \
	} } while (0)

ZTEST_USER(bitpool, test_bitpool_find_and_set)
{
	/* Test in a range of first element */
	int ret;
	static const size_t calc_bitcnt = BITPOOL_TEST_BITCNT;
	ATOMIC_VAL_DEFINE(calc_atomic, BITPOOL_TEST_BITCNT) = {0};

	/* Try to find a pool of 1 where every bit is cleared */
	ret = bitpool_find_first_block(calc_atomic, true, 10, calc_bitcnt);
	zassert_equal(-ENOSPC, ret, "Bit pool set found: %d", ret);

	/* Find space of 10 bits - should be present at the begin */
	ret = bitpool_find_first_block(calc_atomic, false, 10, calc_bitcnt);
	zassert_equal(0, ret, "Bit pool clear found: %d", ret);
	bitpool_set_block_to(calc_atomic, ret, 10, true);

	bitpool_check_ranges(calc_atomic, calc_bitcnt, (0, 9));

	/* Trying to find 11 ones where there are only 10 available */
	ret = bitpool_find_first_block(calc_atomic, true, 11, calc_bitcnt);
	zassert_equal(-ENOSPC, ret, "Bit pool set found: %d", ret);

	/* Find 3 bits of ones and clear them */
	ret = bitpool_find_first_block(calc_atomic, true, 3, calc_bitcnt);
	zassert_equal(0, ret, "Bit pool clear found: %d", ret);
	bitpool_set_block_to(calc_atomic, ret, 3, false);

	bitpool_check_ranges(calc_atomic, calc_bitcnt, (3, 9));

	/* Now try to reserve 5 bits */
	ret = bitpool_find_first_block(calc_atomic, false, 5, calc_bitcnt);
	zassert_equal(10, ret, "Bit pool clear found: %d", ret);
	bitpool_set_block_to(calc_atomic, ret, 5, true);

	bitpool_check_ranges(calc_atomic, calc_bitcnt, (3, 14));

	/* Free 2 in the middle and try to find it */
	bitpool_set_block_to(calc_atomic, 8, 2, false);

	bitpool_check_ranges(calc_atomic, calc_bitcnt, (3, 7), (10, 14));

	ret = bitpool_find_first_block(calc_atomic, false, 2, calc_bitcnt);
	zassert_equal(0, ret, "Bit pool clear found: %d", ret);
	bitpool_set_block_to(calc_atomic, ret, 2, true);

	ret = bitpool_find_first_block(calc_atomic, false, 2, calc_bitcnt);
	zassert_equal(8, ret, "Bit pool clear found: %d", ret);
	bitpool_set_block_to(calc_atomic, ret, 2, true);

	bitpool_check_ranges(calc_atomic, calc_bitcnt, (0, 1), (3, 14));
}

ZTEST_USER(bitpool, test_bitpool_find_and_set_long)
{
	/* Test bit finding and setting mainly at the connection point between array elements */
	int ret;
	static const size_t calc_bitcnt = BITPOOL_TEST_LONG_BITCNT;
	ATOMIC_VAL_DEFINE(calc_atomic, BITPOOL_TEST_LONG_BITCNT) = {0};

	/* Try to find a pool of 1 where every bit is cleared */
	ret = bitpool_find_first_block(calc_atomic, true, 1, calc_bitcnt);
	zassert_equal(-ENOSPC, ret, "Bit pool set found: %d", ret);

	/* Find a pool of 60 1 where every bit is cleared */
	ret = bitpool_find_first_block(calc_atomic, false, 60, calc_bitcnt);
	zassert_equal(0, ret, "Bit pool clear found: %d", ret);
	bitpool_set_block_to(calc_atomic, ret, 60, true);

	bitpool_check_ranges(calc_atomic, calc_bitcnt, (0, 59));

	/* Find a pool of 10 1 where every bit is cleared */
	ret = bitpool_find_first_block(calc_atomic, false, 10, calc_bitcnt);
	zassert_equal(60, ret, "Bit pool clear found: %d", ret);
	bitpool_set_block_to(calc_atomic, ret, 10, true);

	bitpool_check_ranges(calc_atomic, calc_bitcnt, (0, 69));

	/* Find another big pool of zeros */
	ret = bitpool_find_first_block(calc_atomic, false, 250, calc_bitcnt);
	zassert_equal(70, ret, "Bit pool clear found: %d", ret);
	bitpool_set_block_to(calc_atomic, ret, 250, true);

	bitpool_check_ranges(calc_atomic, calc_bitcnt, (0, 319));

	/* Release 10 bits in the middle */
	bitpool_set_block_to(calc_atomic, 60, 10, false);

	bitpool_check_ranges(calc_atomic, calc_bitcnt, (0, 59), (70, 319));

	/* Reserve 11 bits that should not fit into released block in the middle */
	ret = bitpool_find_first_block(calc_atomic, false, 11, calc_bitcnt);
	zassert_equal(320, ret, "Bit pool clear found: %d", ret);
	bitpool_set_block_to(calc_atomic, ret, 11, true);

	bitpool_check_ranges(calc_atomic, calc_bitcnt, (0, 59), (70, 330));

	/* Reserve 9 bits block that should fit the block released ealier */
	ret = bitpool_find_first_block(calc_atomic, false, 9, calc_bitcnt);
	zassert_equal(60, ret, "Bit pool clear found: %d", ret);
	bitpool_set_block_to(calc_atomic, ret, 9, true);

	bitpool_check_ranges(calc_atomic, calc_bitcnt, (0, 68), (70, 330));

	/* Reserve 1 additional bit to fill the remaining space */
	ret = bitpool_find_first_block(calc_atomic, false, 1, calc_bitcnt);
	zassert_equal(69, ret, "Bit pool clear found: %d", ret);
	bitpool_set_block_to(calc_atomic, ret, 1, true);

	bitpool_check_ranges(calc_atomic, calc_bitcnt, (0, 330));

	/* Fill to full capacity */
	ret = bitpool_find_first_block(calc_atomic, false, (calc_bitcnt - 331), calc_bitcnt);
	zassert_equal(331, ret, "Bit pool clear found: %d", ret);
	bitpool_set_block_to(calc_atomic, ret, (calc_bitcnt - 331), true);

	bitpool_check_ranges(calc_atomic, calc_bitcnt, (0, calc_bitcnt));

	/* Trying to reserve any more bits */
	ret = bitpool_find_first_block(calc_atomic, false, 1, calc_bitcnt);
	zassert_equal(-ENOSPC, ret, "Bit pool clear found: %d", ret);
}

ZTEST_USER(bitpool, test_bitpool_find_any_size)
{
	int ret;
	size_t size;
	static const size_t calc_bitcnt = BITPOOL_TEST_BITCNT;
	ATOMIC_VAL_DEFINE(calc_atomic, BITPOOL_TEST_BITCNT) = {0};

	/* Try to find a pool of 1 where every bit is cleared */
	ret = bitpool_find_first_block_any_size(calc_atomic, true, &size, calc_bitcnt);
	zassert_equal(-ENOSPC, ret, "Bit pool set found: %d", ret);

	/* Expect to find full size of zeros */
	ret = bitpool_find_first_block_any_size(calc_atomic, false, &size, calc_bitcnt);
	zassert_equal(0, ret, "Bit pool clear found: %d", ret);
	zassert_equal(calc_bitcnt, size, "Bit pool size: %u", size);

	/* Find pools in partially taken area */
	bitpool_set_block_to(calc_atomic, 11, 3, true);
	bitpool_set_block_to(calc_atomic, 16, 2, true);
	bitpool_set_block_to(calc_atomic, 26, calc_bitcnt - 26, true);

	ret = bitpool_find_first_block_any_size(calc_atomic, false, &size, calc_bitcnt);
	zassert_equal(0, ret, "Bit pool clear found: %d", ret);
	zassert_equal(11, size, "Bit pool size: %u", size);
	bitpool_set_block_to(calc_atomic, ret, size, true);

	ret = bitpool_find_first_block_any_size(calc_atomic, false, &size, calc_bitcnt);
	zassert_equal(14, ret, "Bit pool clear found: %d", ret);
	zassert_equal(2, size, "Bit pool size: %u", size);
	bitpool_set_block_to(calc_atomic, ret, size, true);

	ret = bitpool_find_first_block_any_size(calc_atomic, false, &size, calc_bitcnt);
	zassert_equal(18, ret, "Bit pool clear found: %d", ret);
	zassert_equal(8, size, "Bit pool size: %u", size);
	bitpool_set_block_to(calc_atomic, ret, size, true);

	ret = bitpool_find_first_block_any_size(calc_atomic, false, &size, calc_bitcnt);
	zassert_equal(-ENOSPC, ret, "Bit pool clear found: %d", ret);
}

ZTEST_USER(bitpool, test_bitpool_find_any_size_long)
{
	int ret;
	size_t size;
	static const size_t calc_bitcnt = BITPOOL_TEST_LONG_BITCNT;
	ATOMIC_VAL_DEFINE(calc_atomic, BITPOOL_TEST_LONG_BITCNT) = {0};

	/* Try to find a pool of 1 where every bit is cleared */
	ret = bitpool_find_first_block_any_size(calc_atomic, true, &size, calc_bitcnt);
	zassert_equal(-ENOSPC, ret, "Bit pool set found: %d", ret);

	/* Expect to find full size of zeros */
	ret = bitpool_find_first_block_any_size(calc_atomic, false, &size, calc_bitcnt);
	zassert_equal(0, ret, "Bit pool clear found: %d", ret);
	zassert_equal(calc_bitcnt, size, "Bit pool size: %u", size);

	/* Find pools in partially taken area */
	bitpool_set_block_to(calc_atomic, 0, 32, true);
	bitpool_set_block_to(calc_atomic, 64, 10, true);
	bitpool_set_block_to(calc_atomic, 100, 100, true);


	ret = bitpool_find_first_block_any_size(calc_atomic, false, &size, calc_bitcnt);
	zassert_equal(32, ret, "Bit pool clear found: %d", ret);
	zassert_equal(32, size, "Bit pool size: %u", size);
	bitpool_set_block_to(calc_atomic, ret, size, true);

	ret = bitpool_find_first_block_any_size(calc_atomic, false, &size, calc_bitcnt);
	zassert_equal(74, ret, "Bit pool clear found: %d", ret);
	zassert_equal(26, size, "Bit pool size: %u", size);
	bitpool_set_block_to(calc_atomic, ret, size, true);

	ret = bitpool_find_first_block_any_size(calc_atomic, false, &size, calc_bitcnt);
	zassert_equal(200, ret, "Bit pool clear found: %d", ret);
	zassert_equal(calc_bitcnt - 200, size, "Bit pool size: %u", size);
	bitpool_set_block_to(calc_atomic, ret, size, true);

	ret = bitpool_find_first_block_any_size(calc_atomic, false, &size, calc_bitcnt);
	zassert_equal(-ENOSPC, ret, "Bit pool clear found: %d", ret);
}

ZTEST_USER(bitpool, test_bitpool_atomic_cas)
{
	bool res;
	static const size_t calc_bitcnt = BITPOOL_TEST_LONG_BITCNT;
	ATOMIC_DEFINE(tested_atomic, BITPOOL_TEST_LONG_BITCNT) = {0};
	ATOMIC_VAL_DEFINE(old_atomic, BITPOOL_TEST_LONG_BITCNT);
	ATOMIC_VAL_DEFINE(calc_atomic, BITPOOL_TEST_LONG_BITCNT);

	bitpool_copy(tested_atomic, old_atomic, calc_bitcnt);
	memcpy(calc_atomic, old_atomic, sizeof(calc_atomic));

	bitpool_set_block_to(calc_atomic, 10, calc_bitcnt - 20, true);

	/* CAS */
	res = bitpool_atomic_cas(tested_atomic, old_atomic, calc_atomic, calc_bitcnt);
	zassert_true(res, "CAS error");

	bitpool_check_ranges(tested_atomic, calc_bitcnt, (10, calc_bitcnt - 11));

	/* CAS second time with wrong old value - should fail */
	bitpool_set_block_to(calc_atomic, 15, 5, false);

	res = bitpool_atomic_cas(tested_atomic, old_atomic, calc_atomic, calc_bitcnt);
	zassert_false(res, "CAS should fail");

	bitpool_check_ranges(tested_atomic, calc_bitcnt, (10, calc_bitcnt - 11));
}

ZTEST_USER(bitpool, test_bitpool_atomic_op)
{
	ATOMIC_DEFINE(tested_atomic, BITPOOL_TEST_BITCNT) = {0};
	size_t cnt;

	/* Test if the operation works at all */
	BITPOOL_ATOMIC_OP(tested_atomic, old, new, BITPOOL_TEST_BITCNT)
	{
		bitpool_copy(old, new, BITPOOL_TEST_BITCNT);
		bitpool_set_block_to(new, 10, 10, true);
	}
	bitpool_check_ranges(tested_atomic, BITPOOL_TEST_BITCNT, (10, 19));

	/* Test interruption in atomic operation */
	cnt = 0;
	BITPOOL_ATOMIC_OP(tested_atomic, old, new, BITPOOL_TEST_BITCNT)
	{
		bitpool_copy(old, new, BITPOOL_TEST_BITCNT);
		if (cnt < 3) {
			BITPOOL_ATOMIC_OP(tested_atomic, iold, inew, BITPOOL_TEST_BITCNT)
			{
				bitpool_copy(iold, inew, BITPOOL_TEST_BITCNT);
				bitpool_set_bit(inew, cnt);
			}
			bitpool_check_ranges(tested_atomic, BITPOOL_TEST_BITCNT,
					     (0, cnt), (10, 19));
		}
		bitpool_set_bit(new, 15);
		++cnt;
	}
	zassert_equal(4, cnt, "Unexpected number of iterations: %u", cnt);
	bitpool_check_ranges(tested_atomic, BITPOOL_TEST_BITCNT, (0, 2), (10, 19), (15, 15));
}

ZTEST_USER(bitpool, test_bitpool_atomic_op_break)
{
	ATOMIC_DEFINE(tested_atomic, BITPOOL_TEST_BITCNT) = {0};

	BITPOOL_ATOMIC_OP(tested_atomic, old, new, BITPOOL_TEST_BITCNT)
	{
		bitpool_copy(old, new, BITPOOL_TEST_BITCNT);
		bitpool_set_bit(new, 0);
	}
	bitpool_check_ranges(tested_atomic, BITPOOL_TEST_BITCNT, (0, 0));

	BITPOOL_ATOMIC_OP(tested_atomic, old, new, BITPOOL_TEST_BITCNT)
	{
		bitpool_copy(old, new, BITPOOL_TEST_BITCNT);
		bitpool_set_bit(new, 1);
		BITPOOL_ATOMIC_OP_break;
	}
	bitpool_check_ranges(tested_atomic, BITPOOL_TEST_BITCNT, (0, 0));
}

extern void *common_setup(void);
ZTEST_SUITE(bitpool, NULL, common_setup, NULL, NULL, NULL);
/**
 * @}
 */
```

## src/boot_delay.c
```c
/*
 * Copyright (c) 2018 Intel Corporation
 *
 * SPDX-License-Identifier: Apache-2.0
 */

#include <zephyr/ztest.h>


/**
 * @defgroup kernel_init_tests Kernel Initialization
 * @ingroup all_tests
 * @{
 * @}
 *
 * @addtogroup kernel_init_tests
 * @{
 */

/**
 * @brief Verify that the configured boot delay elapses before the kernel runs.
 *
 * @ingroup kernel_init_tests
 *
 * @details
 * Passing proves that the kernel honors CONFIG_BOOT_DELAY by busy-waiting the
 * configured number of milliseconds during early boot, so that by the time the
 * test runs at least that much time has elapsed on the hardware cycle counter.
 *
 * Test steps:
 * - Skip the test on platforms with GHz-scale counters that can roll over a
 *   32-bit cycle count during firmware startup.
 * - Sample the current cycle count via k_cycle_get_32().
 * - Convert the elapsed cycles to nanoseconds and compare against
 *   CONFIG_BOOT_DELAY expressed in nanoseconds.
 *
 * Expected result:
 * - The elapsed time is greater than or equal to the configured boot delay.
 *
 * @see k_cycle_get_32()
 */
ZTEST(boot_delay, test_bootdelay)
{
	if (CONFIG_SYS_CLOCK_HW_CYCLES_PER_SEC > 1000000000) {
		/* Systems with very fast counters (like the x86 TSC)
		 * and long firmware startup (often 10+ seconds on a
		 * EFI PC!)  can easily roll this over during startup,
		 * and there's no way to detect that case with a 32
		 * bit OS API.  Just skip it if we have a GHz-scale
		 * counter.
		 */
		ztest_test_skip();
	}

	uint32_t current_cycles = k_cycle_get_32();

	/* compare this with the boot delay specified */
	zassert_true(k_cyc_to_ns_floor64(current_cycles) >=
			(NSEC_PER_MSEC * CONFIG_BOOT_DELAY),
			"boot delay not executed: %d < %d",
			(uint32_t)k_cyc_to_ns_floor64(current_cycles),
			(NSEC_PER_MSEC * CONFIG_BOOT_DELAY));
}

/**
 * @}
 */

extern void *common_setup(void);
ZTEST_SUITE(boot_delay, NULL, common_setup, NULL, NULL, NULL);
```

## src/clock.c
```c
/*
 * Copyright (c) 2017 Intel Corporation
 *
 * SPDX-License-Identifier: Apache-2.0
 */

#include <zephyr/ztest.h>

#define ALIGN_MS_BOUNDARY		       \
	do {				       \
		uint32_t t = k_uptime_get_32();   \
		while (t == k_uptime_get_32()) \
			Z_SPIN_DELAY(50);      \
	} while (0)

/** @cond INTERNAL_HIDDEN */
struct timer_data {
	/* Updated from ISR context; volatile keeps LTO from caching the reads. */
	volatile int duration_count;
	volatile int stop_count;
};
static void duration_expire(struct k_timer *timer);
static void stop_expire(struct k_timer *timer);

/* TESTPOINT: init timer via K_TIMER_DEFINE */
K_TIMER_DEFINE(ktimer, duration_expire, stop_expire);

/*
 * tdata is written by the timer expiry/stop callbacks (duration_expire(),
 * stop_expire()) that run asynchronously from the test thread, and polled by
 * the test after a k_busy_wait(). Mark it volatile so the compiler reloads it
 * on every access instead of caching it across the busy-wait: under LTO the
 * whole-program optimizer otherwise proves nothing visible in k_busy_wait()
 * writes tdata, caches duration_count, and constant-folds the comparisons
 * (observed as "duration 0 not 1").
 */
static ZTEST_BMEM volatile struct timer_data tdata;

/** @endcond */

#define DURATION 100
#define LESS_DURATION 70

/**
 * @defgroup kernel_clock_tests Clock Operations
 * @ingroup all_tests
 * @{
 * @}
 *
 * @addtogroup kernel_clock_tests
 * @{
 */

/**
 * @brief Verify the uptime clock advances monotonically and reports deltas.
 *
 * @ingroup kernel_clock_tests
 *
 * @details
 * Passing proves the system uptime clock is a forward-progressing time source
 * usable from user mode: both the 64-bit and lower-32-bit millisecond uptime
 * readings increase as wall time elapses and the 32-bit reading observes a
 * millisecond boundary crossing.
 *
 * Test steps:
 * - Spin until k_uptime_get() advances by at least 5 ms.
 * - Spin until k_uptime_get_32() advances by at least 5 ms.
 * - Sample the 32-bit uptime, align to a millisecond boundary, and confirm it grew.
 *
 * Expected result:
 * - The millisecond uptime readings increase over time.
 *
 * @see k_uptime_get(), k_uptime_get_32()
 * @verifies ZEP-SRS-28-1
 */
ZTEST_USER(clock, test_clock_uptime)
{
	uint64_t t64, t32;

	/**TESTPOINT: uptime elapse*/
	t64 = k_uptime_get();
	while (k_uptime_get() < (t64 + 5)) {
		Z_SPIN_DELAY(50);
	}

	/**TESTPOINT: uptime elapse lower 32-bit*/
	t32 = k_uptime_get_32();
	while (k_uptime_get_32() < (t32 + 5)) {
		Z_SPIN_DELAY(50);
	}

	/**TESTPOINT: uptime straddled ms boundary*/
	t32 = k_uptime_get_32();
	ALIGN_MS_BOUNDARY;
	zassert_true(k_uptime_get_32() > t32);
}

/**
 * @brief Verify the system uptime is reported in system ticks.
 *
 * @ingroup kernel_clock_tests
 *
 * @details
 * Passing proves k_uptime_ticks() is a forward-progressing reading of the
 * system uptime in ticks, usable from user mode.
 *
 * Test steps:
 * - Sample k_uptime_ticks() and spin until it advances.
 *
 * Expected result:
 * - The tick reading increases as wall time elapses.
 *
 * @see k_uptime_ticks()
 * @verifies ZEP-SRS-28-2
 */
ZTEST_USER(clock, test_clock_uptime_ticks)
{
	int64_t ticks = k_uptime_ticks();

	/**TESTPOINT: uptime in system ticks advances*/
	while (k_uptime_ticks() <= ticks) {
		Z_SPIN_DELAY(50);
	}
}

/**
 * @brief Verify the system uptime is reported in whole seconds.
 *
 * @ingroup kernel_clock_tests
 *
 * @details
 * Passing proves k_uptime_seconds() reports the uptime in seconds
 * consistently with the millisecond uptime clock: the value equals the
 * floor of the millisecond reading converted to seconds.
 *
 * Test steps:
 * - Sample k_uptime_seconds() between two k_uptime_get() readings.
 * - Check the seconds value against the floor of both millisecond readings.
 *
 * Expected result:
 * - The seconds reading is bounded by the floors of the surrounding
 *   millisecond readings.
 *
 * @see k_uptime_seconds()
 * @verifies ZEP-SRS-28-3
 */
ZTEST_USER(clock, test_clock_uptime_seconds)
{
	/**TESTPOINT: uptime in seconds is consistent with the millisecond reading*/
	uint64_t ms_before = k_uptime_get();
	uint32_t secs = k_uptime_seconds();
	uint64_t ms_after = k_uptime_get();

	zassert_true(secs >= (ms_before / MSEC_PER_SEC),
		     "uptime seconds %u below floor of %llu ms", secs, ms_before);
	zassert_true(secs <= (ms_after / MSEC_PER_SEC),
		     "uptime seconds %u above floor of %llu ms", secs, ms_after);
}

/**
 * @brief Verify elapsed time reporting relative to a reference.
 *
 * @ingroup kernel_clock_tests
 *
 * @details
 * Passing proves k_uptime_delta() measures the time elapsed since a
 * caller-held reference time and updates the reference for the next
 * measurement.
 *
 * Test steps:
 * - Seed a delta reference, then spin until k_uptime_delta() returns a
 *   non-zero elapsed time.
 *
 * Expected result:
 * - k_uptime_delta() reports a non-zero interval once time has elapsed.
 *
 * @see k_uptime_delta()
 * @verifies ZEP-SRS-28-4
 */
ZTEST_USER(clock, test_clock_uptime_delta)
{
	int64_t d64 = 0;

	/**TESTPOINT: uptime delta*/
	d64 = k_uptime_delta(&d64);
	while (k_uptime_delta(&d64) == 0) {
		Z_SPIN_DELAY(50);
	}
}

/**
 * @brief Verify the 32-bit cycle counter advances consistently with uptime.
 *
 * @ingroup kernel_clock_tests
 *
 * @details
 * Passing proves that the architecture's 32-bit hardware cycle counter
 * (k_cycle_get_32()) is a monotonically increasing time source whose rate is
 * consistent with the tick-derived uptime clock (k_uptime_get_32()): the number
 * of cycles elapsed over one observed millisecond of uptime corresponds to at
 * least one millisecond worth of cycles and at least one millisecond when
 * converted to nanoseconds, cross-validating the cycle counter against uptime.
 *
 * Test steps:
 * - Align to a millisecond boundary and spin until the cycle counter advances,
 *   guarding against counter wrap-around.
 * - Sample the cycle counter, align to a millisecond boundary, and spin until
 *   the 32-bit uptime advances by one millisecond.
 * - Compute the cycle delta over that interval (skipping if the counter wrapped).
 *
 * Expected result:
 * - The cycle delta exceeds one millisecond of cycles and, converted via
 *   k_cyc_to_ns_floor64(), exceeds one millisecond in nanoseconds.
 *
 * @see k_cycle_get_32(), k_uptime_get_32()
 * @verifies ZEP-SRS-28-5
 * @verifies ZEP-SRS-28-7
 */

ZTEST(clock, test_clock_cycle_32)
{
	uint32_t c32, c0, c1, t32;

	/**TESTPOINT: cycle elapse*/
	ALIGN_MS_BOUNDARY;
	c32 = k_cycle_get_32();
	/*break if cycle counter wrap around*/
	while (k_cycle_get_32() > c32 &&
	       k_cycle_get_32() < (c32 + k_ticks_to_cyc_floor32(1))) {
		Z_SPIN_DELAY(50);
	}

	/**TESTPOINT: cycle/uptime cross check*/
	c0 = k_cycle_get_32();
	ALIGN_MS_BOUNDARY;
	t32 = k_uptime_get_32();
	while (t32 == k_uptime_get_32()) {
		Z_SPIN_DELAY(50);
	}

	c1 = k_uptime_get_32();
	/*avoid cycle counter wrap around*/
	if (c1 > c0) {
		/* delta cycle should be greater than 1 milli-second*/
		zassert_true((c1 - c0) > (sys_clock_hw_cycles_per_sec() / MSEC_PER_SEC));
		/* delta NS should be greater than 1 milli-second */
		zassert_true((uint32_t)k_cyc_to_ns_floor64(c1 - c0) >
			     (NSEC_PER_SEC / MSEC_PER_SEC));
	}
}

/**
 * @brief Verify the 64-bit cycle counter tracks the 32-bit counter over an interval.
 *
 * @ingroup kernel_clock_tests
 *
 * @details
 * Passing proves that, on platforms providing a 64-bit cycle counter, the
 * 64-bit and 32-bit cycle counters measure the same elapsed time over a short
 * sleep: the 64-bit delta is at least as large as the 32-bit delta (it does not
 * lose resolution) yet remains below twice the 32-bit delta (it does not run at
 * a different rate). The test skips on platforms without a 64-bit cycle counter.
 *
 * Test steps:
 * - Skip unless CONFIG_TIMER_HAS_64BIT_CYCLE_COUNTER is enabled.
 * - Sample both the 64-bit and 32-bit cycle counters, sleep 1 ms, then sample again.
 * - Compute the 32-bit and 64-bit deltas across the sleep.
 *
 * Expected result:
 * - The 64-bit delta is >= the 32-bit delta and < twice the 32-bit delta.
 *
 * @see k_cycle_get_64()
 * @verifies ZEP-SRS-28-6
 */
ZTEST(clock, test_clock_cycle_64)
{
	uint32_t d32;
	uint64_t d64;
	uint32_t t32[2];
	uint64_t t64[2];

	if (!IS_ENABLED(CONFIG_TIMER_HAS_64BIT_CYCLE_COUNTER)) {
		ztest_test_skip();
	}

	t64[0] = k_cycle_get_64();
	t32[0] = k_cycle_get_32();

	k_msleep(1);

	t32[1] = k_cycle_get_32();
	t64[1] = k_cycle_get_64();

	d32 = MIN(t32[1] - t32[0], t32[0] - t32[1]);
	d64 = MIN(t64[1] - t64[0], t64[1] - t64[0]);

	zassert_true(d64 >= d32,
		"k_cycle_get() (64-bit): d64: %" PRIu64 " < d32: %u", d64, d32);

	zassert_true(d64 < (d32 << 1),
		"k_cycle_get() (64-bit): d64: %" PRIu64 " >= 2 * d32: %u",
		d64, (d32 << 1));
}

/*
 *help function
 */
static void duration_expire(struct k_timer *timer)
{
	tdata.duration_count++;
}

static void stop_expire(struct k_timer *timer)
{
	tdata.stop_count++;
}

static void init_data_count(void)
{
	tdata.duration_count = 0;
	tdata.stop_count = 0;
}

/**
 * @brief Verify a kernel timer expires only after its millisecond duration elapses.
 *
 * @ingroup kernel_clock_tests
 *
 * @details
 * Passing proves that k_timer_start() honors a millisecond expiry duration with
 * correct timing semantics: the timer's expiry callback does not fire while less
 * than the configured duration has elapsed, and fires exactly once once the full
 * duration is exceeded, while the stop callback is not invoked on normal expiry.
 *
 * Test steps:
 * - Start the timer for DURATION ms one-shot and busy-wait LESS_DURATION ms;
 *   confirm neither the expiry nor stop counter has incremented.
 * - Restart the timer, align to a tick, busy-wait just over DURATION ms, and
 *   confirm the expiry counter is exactly 1 and the stop counter is 0.
 * - Stop the timer to clean up.
 *
 * Expected result:
 * - No expiry before the duration elapses; exactly one expiry afterward and no
 *   stop-callback invocation.
 *
 * @see k_timer_start(), k_timer_stop(), k_busy_wait()
 *
 * @verifies ZEP-SRS-28-13
 */

ZTEST(clock, test_ms_time_duration)
{
	init_data_count();
	k_timer_start(&ktimer, K_MSEC(DURATION), K_NO_WAIT);

	/** TESTPOINT: waiting time less than duration and check the count*/
	k_busy_wait(LESS_DURATION * 1000);
	zassert_true(tdata.duration_count == 0);
	zassert_true(tdata.stop_count == 0);

	/** TESTPOINT: proving duration in millisecond */
	init_data_count();
	k_timer_start(&ktimer, K_MSEC(100), K_MSEC(50));

	/** TESTPOINT: waiting time more than duration and check the count */
	k_usleep(1);		/* align to tick */
	k_busy_wait((DURATION + 1) * 1000);
	zassert_true(tdata.duration_count == 1, "duration %u not 1",
		     tdata.duration_count);
	zassert_true(tdata.stop_count == 0,
		     "stop %u not 0", tdata.stop_count);

	/** cleanup environment */
	k_timer_stop(&ktimer);
}

/**
 * @}
 */

extern void *common_setup(void);
ZTEST_SUITE(clock, NULL, common_setup, NULL, NULL, NULL);
```
