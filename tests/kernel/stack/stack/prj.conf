## CMakeLists.txt
```
# SPDX-License-Identifier: Apache-2.0

cmake_minimum_required(VERSION 3.28.0)
find_package(Zephyr REQUIRED HINTS $ENV{ZEPHYR_BASE})
project(stack_usage)

FILE(GLOB app_sources src/*.c)
target_sources(app PRIVATE ${app_sources})
```

## prj.conf
```kconfig
CONFIG_ZTEST=y
CONFIG_IRQ_OFFLOAD=y
CONFIG_TEST_USERSPACE=y
CONFIG_MP_MAX_NUM_CPUS=1
CONFIG_ZTEST_FATAL_HOOK=y
```

## src/main.c
```c
/*
 * Copyright (c) 2018 Intel Corporation
 *
 * SPDX-License-Identifier: Apache-2.0
 */

/*
 * @file
 * @brief Use stack API's in different scenarios
 *
 * This module tests following three basic scenarios:
 *
 * Scenario #1
 * Test thread enters items into a stack, starts the Child thread and
 * waits for a semaphore. Child thread extracts all items from the stack
 * and enters some items back into the stack. Child thread gives the
 * semaphore for Test thread to continue. Once the control is returned
 * back to Test thread, it extracts all items from the stack.
 *
 * Scenario #2
 * Test thread enters an item into stack2, starts a Child thread and
 * extract an item from stack1 once the item is there. The child thread
 * will extract an item from stack2 once the item is there and enter
 * an item to stack1. The flow of control goes from Test thread to Child
 * thread and so forth.
 *
 * Scenario #3
 * Tests the ISR interfaces. Test thread pushes items into stack2 and gives
 * control to the Child thread. Child thread pops items from stack2 and then
 * pushes items into stack1. Child thread gives back control to the Test thread
 * and Test thread pops the items from stack1.
 * All the Push and Pop operations happen in ISR Context.
 */


/**
 * @brief Tests for Kernel stack objects
 * @defgroup kernel_stack_tests Stacks
 * @ingroup all_tests
 * @{
 * @}
 */

#include <zephyr/ztest.h>
#include <zephyr/irq_offload.h>

#define TSTACK_SIZE     (512 + CONFIG_TEST_EXTRA_STACK_SIZE)
#define STACK_LEN       4

/* stack objects used in this test */
K_STACK_DEFINE(stack1, STACK_LEN);
K_STACK_DEFINE(stack2, STACK_LEN);

/* thread info * */
K_THREAD_STACK_DEFINE(threadstack, TSTACK_SIZE);
struct k_thread thread_data;

/* Data pushed to stack */
static ZTEST_DMEM stack_data_t data1[STACK_LEN] = { 0xAAAA, 0xBBBB, 0xCCCC, 0xDDDD };
static ZTEST_DMEM stack_data_t data2[STACK_LEN] = { 0x1111, 0x2222, 0x3333, 0x4444 };
static ZTEST_DMEM stack_data_t data_isr[STACK_LEN] = { 0xABCD, 0xABCD, 0xABCD,
						       0xABCD };

/* semaphore to sync threads */
static struct k_sem end_sema;



K_HEAP_DEFINE(test_pool, 128 * 3);

extern struct k_stack kstack;
extern struct k_stack stack;
extern struct k_sem end_sema;

/* entry of contexts */
static void tIsr_entry_push(const void *p)
{
	uint32_t i;

	/* Push items to stack */
	for (i = 0U; i < STACK_LEN; i++) {
		k_stack_push((struct k_stack *)p, data_isr[i]);
	}
}

static void tIsr_entry_pop(const void *p)
{
	uint32_t i;

	/* Pop items from stack */
	for (i = 0U; i < STACK_LEN; i++) {
		if (p == &stack1) {
			k_stack_pop((struct k_stack *)p, &data1[i], K_NO_WAIT);
		} else {
			k_stack_pop((struct k_stack *)p, &data2[i], K_NO_WAIT);
		}
	}
}

static void thread_entry_fn_single(void *p1, void *p2, void *p3)
{
	stack_data_t tmp[STACK_LEN];
	uint32_t i;

	/* Pop items from stack */
	for (i = STACK_LEN; i; i--) {
		k_stack_pop((struct k_stack *)p1, &tmp[i - 1], K_NO_WAIT);
	}
	zassert_false(memcmp(tmp, data1, sizeof(tmp)),
		      "Push & Pop items does not match");

	/* Push items from stack */
	for (i = 0U; i < STACK_LEN; i++) {
		k_stack_push((struct k_stack *)p1, data2[i]);
	}

	/* Give control back to Test thread */
	k_sem_give(&end_sema);
}

static void thread_entry_fn_dual(void *p1, void *p2, void *p3)
{
	stack_data_t tmp[STACK_LEN];
	uint32_t i;

	for (i = 0U; i < STACK_LEN; i++) {
		/* Pop items from stack2 */
		k_stack_pop(p2, &tmp[i], K_FOREVER);

		/* Push items to stack1 */
		k_stack_push(p1, data1[i]);

	}
	zassert_false(memcmp(tmp, data2, sizeof(tmp)),
		      "Push & Pop items does not match");
}

static void thread_entry_fn_isr(void *p1, void *p2, void *p3)
{
	/* Pop items from stack2 */
	irq_offload(tIsr_entry_pop, (const void *)p2);
	zassert_false(memcmp(data_isr, data2, sizeof(data_isr)),
		      "Push & Pop items does not match");

	/* Push items to stack1 */
	irq_offload(tIsr_entry_push, (const void *)p1);

	/* Give control back to Test thread */
	k_sem_give(&end_sema);
}

/**
 * @addtogroup kernel_stack_tests
 * @{
 */

/**
 * @brief Verify data passing between threads using single stack
 * @see k_stack_push(), #K_STACK_DEFINE(x), k_stack_pop()
 * @verifies ZEP-SRS-30-5
 * @verifies ZEP-SRS-30-6
 */
ZTEST_USER(stack_usage, test_single_stack_play)
{
	stack_data_t tmp[STACK_LEN];
	uint32_t i;

	/* Init kernel objects */
	k_sem_init(&end_sema, 0, 1);

	/* Push items to stack */
	for (i = 0U; i < STACK_LEN; i++) {
		k_stack_push(&stack1, data1[i]);
	}

	k_tid_t tid = k_thread_create(&thread_data, threadstack, TSTACK_SIZE,
				      thread_entry_fn_single, &stack1, NULL,
				      NULL, K_PRIO_PREEMPT(0), K_USER |
				      K_INHERIT_PERMS, K_NO_WAIT);

	/* Let the child thread run */
	k_sem_take(&end_sema, K_FOREVER);

	/* Pop items from stack */
	for (i = STACK_LEN; i; i--) {
		k_stack_pop(&stack1, &tmp[i - 1], K_NO_WAIT);
	}

	zassert_false(memcmp(tmp, data2, sizeof(tmp)),
		      "Push & Pop items does not match");

	/* Clear the spawn thread to avoid side effect */
	k_thread_abort(tid);
}

/**
 * @brief Verify data passing between threads using dual stack
 * @see k_stack_push(), #K_STACK_DEFINE(x), k_stack_pop()
 * @verifies ZEP-SRS-30-5
 * @verifies ZEP-SRS-30-6
 */
ZTEST_USER(stack_usage_1cpu, test_dual_stack_play)
{
	stack_data_t tmp[STACK_LEN];
	uint32_t i;

	k_tid_t tid = k_thread_create(&thread_data, threadstack, TSTACK_SIZE,
				      thread_entry_fn_dual, &stack1, &stack2,
				      NULL, K_PRIO_PREEMPT(0), K_USER |
				      K_INHERIT_PERMS, K_NO_WAIT);

	for (i = 0U; i < STACK_LEN; i++) {
		/* Push items to stack2 */
		k_stack_push(&stack2, data2[i]);

		/* Pop items from stack1 */
		k_stack_pop(&stack1, &tmp[i], K_FOREVER);
	}

	zassert_false(memcmp(tmp, data1, sizeof(tmp)),
		      "Push & Pop items does not match");

	/* Clear the spawn thread to avoid side effect */
	k_thread_abort(tid);
}

/**
 * @brief Verify data passing between thread and ISR
 * @see k_stack_push(), #K_STACK_DEFINE(x), k_stack_pop()
 * @verifies ZEP-SRS-30-5
 * @verifies ZEP-SRS-30-6
 */
ZTEST(stack_usage_1cpu, test_isr_stack_play)
{
	/* Init kernel objects */
	k_sem_init(&end_sema, 0, 1);

	k_tid_t tid = k_thread_create(&thread_data, threadstack, TSTACK_SIZE,
				      thread_entry_fn_isr, &stack1, &stack2,
				      NULL, K_PRIO_PREEMPT(0),
				      K_INHERIT_PERMS, K_NO_WAIT);


	/* Push items to stack2 */
	irq_offload(tIsr_entry_push, (const void *)&stack2);

	/* Let the child thread run */
	k_sem_take(&end_sema, K_FOREVER);

	/* Pop items from stack1 */
	irq_offload(tIsr_entry_pop, (const void *)&stack1);

	zassert_false(memcmp(data_isr, data1, sizeof(data_isr)),
		      "Push & Pop items does not match");

	/* Clear the spawn thread to avoid side effect */
	k_thread_abort(tid);
}

/* the thread entry */
void thread_entry_wait(void *p1, void *p2, void *p3)
{
	stack_data_t *txdata = p3;

	k_stack_push(p1, *(txdata + 2));
	k_stack_push(p1, *(txdata + 3));
}

/**
 * @brief Test that the stack pop can be waited
 * if no item available
 *
 * @details Create and initialize a new stack
 * Set two timeout parameters to indicate
 * the maximum amount of time the thread will wait.
 *
 * @ingroup kernel_stack_tests
 *
 * @see k_stack_push(), #K_STACK_DEFINE(x), k_stack_pop()
 * @verifies ZEP-SRS-30-9
 */
ZTEST(stack_usage, test_stack_pop_can_wait)
{
	struct k_stack stack3;
	stack_data_t tx_data[STACK_LEN] = { 0xaa, 0xbb, 0xcc, 0xdd };
	stack_data_t rx_data[STACK_LEN] = { 0 };

	k_stack_alloc_init(&stack3, 2);
	k_tid_t tid = k_thread_create(&thread_data, threadstack,
			TSTACK_SIZE, thread_entry_wait, &stack3,
			NULL, tx_data, K_PRIO_PREEMPT(0), 0,
			K_NO_WAIT);

	for (int i = 0; i < 2; i++) {
		k_stack_push(&stack3, tx_data[i]);
	}

	for (int i = 0; i < 3; i++) {
		k_stack_pop(&stack3, &rx_data[i], K_FOREVER);
	}

	zassert_true(rx_data[2] == tx_data[2], "wait forever and pop failed\n");
	k_stack_pop(&stack3, &rx_data[3], K_MSEC(50));
	zassert_true(rx_data[3] == tx_data[3], "Wait maximum time pop failed\n");
	/* Clear the spawn thread to avoid side effect */
	k_thread_abort(tid);
	/*free the buffer allocated*/
	k_stack_cleanup(&stack3);
}

/**
 * @}
 */

extern struct k_stack threadstack1;
extern struct k_thread thread_data1;
extern struct k_sem end_sema1;

static void *stack_setup(void)
{
	k_thread_access_grant(k_current_get(), &stack1, &stack2, &thread_data,
			      &end_sema, &threadstack, &kstack, &stack, &thread_data1,
			      &end_sema1, &threadstack1);

	k_thread_heap_assign(k_current_get(), &test_pool);

	return NULL;
}

ZTEST_SUITE(stack_usage, NULL, stack_setup, NULL, NULL, NULL);

ZTEST_SUITE(stack_contexts, NULL, stack_setup, NULL, NULL, NULL);

ZTEST_SUITE(stack_fail, NULL, stack_setup, NULL, NULL, NULL);

ZTEST_SUITE(stack_usage_1cpu, NULL, stack_setup,
		ztest_simple_1cpu_before, ztest_simple_1cpu_after, NULL);
```

## src/test_stack_contexts.c
```c
/*
 * Copyright (c) 2016 Intel Corporation
 *
 * SPDX-License-Identifier: Apache-2.0
 */

#include <zephyr/ztest.h>
#include <zephyr/irq_offload.h>
#define STACK_SIZE (512 + CONFIG_TEST_EXTRA_STACK_SIZE)
#define STACK_LEN 4
#define HIGH_T1			0xaaa
#define HIGH_T2			0xbbb
#define LOW_PRIO			0xccc

/**TESTPOINT: init via K_STACK_DEFINE*/
K_STACK_DEFINE(kstack, STACK_LEN);
K_STACK_DEFINE(kstack_test_alloc, STACK_LEN);
struct k_stack stack;

K_THREAD_STACK_DEFINE(threadstack1, STACK_SIZE);
struct k_thread thread_data1;
K_THREAD_STACK_DEFINE(threadstack_t1, STACK_SIZE);
static struct k_thread high_pro_thread_t1;
K_THREAD_STACK_DEFINE(threadstack_t2, STACK_SIZE);
static struct k_thread high_pro_thread_t2;
static ZTEST_DMEM stack_data_t data[STACK_LEN] = { 0xABCD, 0x1234 };
struct k_sem end_sema1;

static void tstack_push(struct k_stack *pstack)
{
	for (int i = 0; i < STACK_LEN; i++) {
		/**TESTPOINT: stack push*/
		k_stack_push(pstack, data[i]);
	}
}

static void tstack_pop(struct k_stack *pstack)
{
	stack_data_t rx_data;

	for (int i = STACK_LEN - 1; i >= 0; i--) {
		/**TESTPOINT: stack pop*/
		zassert_false(k_stack_pop(pstack, &rx_data, K_NO_WAIT));
		zassert_equal(rx_data, data[i]);
	}
}

/*entry of contexts*/
static void tIsr_entry_push(const void *p)
{
	tstack_push((struct k_stack *)p);
}

static void tIsr_entry_pop(const void *p)
{
	tstack_pop((struct k_stack *)p);
}

static void tThread_entry(void *p1, void *p2, void *p3)
{
	tstack_pop((struct k_stack *)p1);
	k_sem_give(&end_sema1);
	tstack_push((struct k_stack *)p1);
	k_sem_give(&end_sema1);
}

static void tstack_thread_thread(struct k_stack *pstack)
{
	k_sem_init(&end_sema1, 0, 1);
	/**TESTPOINT: thread-thread data passing via stack*/
	k_tid_t tid = k_thread_create(&thread_data1, threadstack1, STACK_SIZE,
				      tThread_entry, pstack, NULL, NULL,
				      K_PRIO_PREEMPT(0), K_USER |
				      K_INHERIT_PERMS, K_NO_WAIT);
	tstack_push(pstack);
	k_sem_take(&end_sema1, K_FOREVER);

	k_sem_take(&end_sema1, K_FOREVER);
	tstack_pop(pstack);

	/* clear the spawn thread to avoid side effect */
	k_thread_abort(tid);
}

static void tstack_thread_isr(struct k_stack *pstack)
{
	k_sem_init(&end_sema1, 0, 1);
	/**TESTPOINT: thread-isr data passing via stack*/
	irq_offload(tIsr_entry_push, (const void *)pstack);
	tstack_pop(pstack);

	tstack_push(pstack);
	irq_offload(tIsr_entry_pop, (const void *)pstack);
}

/**
 * @addtogroup kernel_stack_tests
 * @{
 */

/**
 * @brief Test to verify data passing between threads via stack
 *
 * @details Static define and Dynamic define stacks,
 * Then initialize them.
 * Current thread push or pop data item into the stack.
 * Create a new thread pop or push data item into the stack.
 * Controlled by semaphore.
 * Verify data passing between threads via stack
 * And verify stack can be define at compile time.
 *
 * @ingroup kernel_stack_tests
 *
 * @see k_stack_init(), k_stack_push(), #K_STACK_DEFINE(x), k_stack_pop()
 * @verifies ZEP-SRS-30-5
 * @verifies ZEP-SRS-30-6
 */
ZTEST(stack_contexts, test_stack_thread2thread)
{
	/**TESTPOINT: test k_stack_init stack*/
	k_stack_init(&stack, data, STACK_LEN);
	tstack_thread_thread(&stack);

	/**TESTPOINT: test K_STACK_DEFINE stack*/
	tstack_thread_thread(&kstack);
}

/**
 * @brief Verify a stack defined at compile time is ready for use.
 *
 * @details A stack created with K_STACK_DEFINE() must be fully initialized
 * at boot: empty and immediately usable without any run-time
 * initialization call. Push an item onto the statically defined stack and
 * pop it back, verifying the value round-trips.
 *
 * @ingroup kernel_stack_tests
 *
 * @see #K_STACK_DEFINE(x), k_stack_push(), k_stack_pop()
 * @verifies ZEP-SRS-30-1
 */
ZTEST(stack_contexts, test_stack_define)
{
	stack_data_t rx_data;

	/* empty at boot: a non-blocking pop fails */
	zassert_equal(k_stack_pop(&kstack, &rx_data, K_NO_WAIT), -EBUSY);

	/* usable at boot without any run-time initialization */
	zassert_ok(k_stack_push(&kstack, data[0]));
	zassert_ok(k_stack_pop(&kstack, &rx_data, K_NO_WAIT));
	zassert_equal(rx_data, data[0]);
}

/**
 * @brief Verify run-time initialization of a stack over a caller buffer.
 *
 * @details k_stack_init() must set up a stack over a caller-provided memory
 * area with the given capacity: the stack starts empty (a non-blocking pop
 * fails) and accepts and returns items.
 *
 * @ingroup kernel_stack_tests
 *
 * @see k_stack_init(), k_stack_push(), k_stack_pop()
 * @verifies ZEP-SRS-30-2
 */
ZTEST(stack_contexts, test_stack_init)
{
	static stack_data_t init_buf[STACK_LEN];
	stack_data_t rx_data;

	k_stack_init(&stack, init_buf, STACK_LEN);

	/* starts out empty */
	zassert_equal(k_stack_pop(&stack, &rx_data, K_NO_WAIT), -EBUSY);

	zassert_ok(k_stack_push(&stack, data[0]));
	zassert_ok(k_stack_pop(&stack, &rx_data, K_NO_WAIT));
	zassert_equal(rx_data, data[0]);
}

/**
 * @brief Verify items pop in reverse push order (LIFO).
 *
 * @details Popping a stack must return the most recently pushed item that
 * has not yet been popped. Push two distinct items and verify they pop in
 * reverse order.
 *
 * @ingroup kernel_stack_tests
 *
 * @see k_stack_push(), k_stack_pop()
 * @verifies ZEP-SRS-30-6
 */
ZTEST(stack_contexts, test_stack_pop_order)
{
	static stack_data_t order_buf[STACK_LEN];
	stack_data_t rx_data;

	k_stack_init(&stack, order_buf, STACK_LEN);

	zassert_ok(k_stack_push(&stack, data[0]));
	zassert_ok(k_stack_push(&stack, data[1]));

	/* the most recently pushed item comes out first */
	zassert_ok(k_stack_pop(&stack, &rx_data, K_NO_WAIT));
	zassert_equal(rx_data, data[1]);
	zassert_ok(k_stack_pop(&stack, &rx_data, K_NO_WAIT));
	zassert_equal(rx_data, data[0]);
}

#ifdef CONFIG_USERSPACE
/**
 * @brief Verifies data passing between user threads via stack
 * @see k_stack_init(), k_stack_push(), #K_STACK_DEFINE(x), k_stack_pop()
 * @verifies ZEP-SRS-30-5
 * @verifies ZEP-SRS-30-6
 */
ZTEST_USER(stack_contexts, test_stack_user_thread2thread)
{
	struct k_stack *th_stack = k_object_alloc(K_OBJ_STACK);

	zassert_not_null(th_stack, "couldn't allocate stack object");
	zassert_false(k_stack_alloc_init(th_stack, STACK_LEN),
		      "stack init failed");

	tstack_thread_thread(th_stack);
}
#endif

/**
 * @brief Verifies data passing between thread and ISR via stack
 * @see k_stack_init(), k_stack_push(), #K_STACK_DEFINE(x), k_stack_pop()
 * @verifies ZEP-SRS-30-5
 * @verifies ZEP-SRS-30-6
 */
ZTEST(stack_contexts, test_stack_thread2isr)
{
	/**TESTPOINT: test k_stack_init stack*/
	k_stack_init(&stack, data, STACK_LEN);
	tstack_thread_isr(&stack);

	/**TESTPOINT: test K_STACK_DEFINE stack*/
	tstack_thread_isr(&kstack);
}

/**
 * @see k_stack_alloc_init(), k_stack_push(), #K_STACK_DEFINE(x), k_stack_pop(),
 * k_stack_cleanup()
 * @verifies ZEP-SRS-30-3
 * @verifies ZEP-SRS-30-4
 */
ZTEST(stack_contexts, test_stack_alloc_thread2thread)
{
	int ret;

	k_stack_alloc_init(&kstack_test_alloc, STACK_LEN);

	k_sem_init(&end_sema1, 0, 1);
	/**TESTPOINT: thread-thread data passing via stack*/
	k_tid_t tid = k_thread_create(&thread_data1, threadstack1, STACK_SIZE,
					tThread_entry, &kstack_test_alloc,
					NULL, NULL, K_PRIO_PREEMPT(0), 0,
					K_NO_WAIT);
	tstack_push(&kstack_test_alloc);
	k_sem_take(&end_sema1, K_FOREVER);

	k_sem_take(&end_sema1, K_FOREVER);
	tstack_pop(&kstack_test_alloc);

	/* clear the spawn thread to avoid side effect */
	k_thread_abort(tid);
	k_stack_cleanup(&kstack_test_alloc);

	/** Requested buffer allocation from the test pool.*/
	ret = k_stack_alloc_init(&kstack_test_alloc, (STACK_SIZE/2)+1);
	zassert_true(ret == -ENOMEM,
			"requested buffer is smaller than resource pool");
}

static void low_prio_wait_for_stack(void *p1, void *p2, void *p3)
{
	struct k_stack *pstack = p1;
	stack_data_t output;

	k_stack_pop(pstack, &output, K_FOREVER);
	zassert_true(output == LOW_PRIO,
	    "The low priority thread get the stack data failed lastly");
}

static void high_prio_t1_wait_for_stack(void *p1, void *p2, void *p3)
{
	struct k_stack *pstack = p1;
	stack_data_t output;

	k_stack_pop(pstack, &output, K_FOREVER);
	zassert_true(output == HIGH_T1,
	    "The highest priority and waited longest get the stack data failed firstly");
}

static void high_prio_t2_wait_for_stack(void *p1, void *p2, void *p3)
{
	struct k_stack *pstack = p1;
	stack_data_t output;

	k_stack_pop(pstack, &output, K_FOREVER);
	zassert_true(output == HIGH_T2,
	   "The higher priority and waited longer get the stack data failed secondly");
}

/**
 * @brief Test multi-threads to get data from stack.
 *
 * @details Define three threads, and set a higher priority for two of them,
 * and set a lower priority for the last one. Then Add a delay between
 * creating the two high priority threads.
 * Test point:
 * 1. Any number of threads may wait(K_FOREVER set) on an empty stack
 * simultaneously.
 * 2. When data is pushed, it is given to the highest priority
 * thread that has waited longest.
 *
 * @ingroup kernel_stack_tests
 * @verifies ZEP-SRS-30-6
 */
ZTEST(stack_contexts, test_stack_multithread_competition)
{
	k_stack_init(&stack, data, STACK_LEN);

	int old_prio = k_thread_priority_get(k_current_get());
	int prio = 10;
	stack_data_t test_data[3];

	memset(test_data, 0, sizeof(test_data));
	k_thread_priority_set(k_current_get(), prio);

	/* Set up some values */
	test_data[0] = HIGH_T1;
	test_data[1] = HIGH_T2;
	test_data[2] = LOW_PRIO;

	k_thread_create(&thread_data1, threadstack1, STACK_SIZE,
			low_prio_wait_for_stack,
			&stack, NULL, NULL,
			prio + 4, 0, K_NO_WAIT);

	k_thread_create(&high_pro_thread_t1, threadstack_t1, STACK_SIZE,
			high_prio_t1_wait_for_stack,
			&stack, NULL, NULL,
			prio + 2, 0, K_NO_WAIT);

	/* Make thread thread_data1 and high_pro_thread_t1 wait more time */
	k_sleep(K_MSEC(10));

	k_thread_create(&high_pro_thread_t2, threadstack_t2, STACK_SIZE,
			high_prio_t2_wait_for_stack,
			&stack, NULL, NULL,
			prio + 2, 0, K_NO_WAIT);

	/* Initialize them and block */
	k_sleep(K_MSEC(50));

	/* Insert some data to wake up thread */
	k_stack_push(&stack, test_data[0]);
	k_stack_push(&stack, test_data[1]);
	k_stack_push(&stack, test_data[2]);

	/* Wait for thread exiting */
	k_thread_join(&thread_data1, K_FOREVER);
	k_thread_join(&high_pro_thread_t1, K_FOREVER);
	k_thread_join(&high_pro_thread_t2, K_FOREVER);

	/* Revert priority of the main thread */
	k_thread_priority_set(k_current_get(), old_prio);
}

/**
 * @brief Test case of requesting a buffer larger than resource pool.
 *
 * @details Try to request a buffer larger than resource pool for stack,
 * then see if returns an expected value.
 *
 * @ingroup kernel_stack_tests
 * @verifies ZEP-SRS-30-3
 */
ZTEST(stack_contexts, test_stack_alloc_null)
{
	int ret;

	/* Requested buffer allocation from the test pool. */
	ret = k_stack_alloc_init(&kstack_test_alloc, (STACK_SIZE/2)+1);
	zassert_true(ret == -ENOMEM,
			"requested buffer is smaller than resource pool");
}

/**
 * @brief Reject stack entry counts that overflow the allocation size.
 */
ZTEST(stack_contexts, test_stack_alloc_size_overflow)
{
	struct k_stack overflow_stack;
	uint32_t num_entries;
	int ret;

	if (sizeof(size_t) > sizeof(uint32_t)) {
		ztest_test_skip();
	}

	num_entries = (UINT32_MAX / sizeof(stack_data_t)) + 1U;
	ret = k_stack_alloc_init(&overflow_stack, num_entries);
	zassert_equal(ret, -ENOMEM,
		      "overflowing stack allocation must be rejected");
}

/**
 * @}
 */
```

## src/test_stack_fail.c
```c
/*
 * Copyright (c) 2016 Intel Corporation
 *
 * SPDX-License-Identifier: Apache-2.0
 */

#include <zephyr/ztest.h>
#include <zephyr/irq_offload.h>
#include <zephyr/ztest_error_hook.h>

#define TIMEOUT K_MSEC(100)
#define STACK_SIZE (512 + CONFIG_TEST_EXTRA_STACK_SIZE)
#define STACK_LEN 2

static ZTEST_BMEM stack_data_t data[STACK_LEN];
extern struct k_stack stack;
K_THREAD_STACK_DEFINE(threadstack2, STACK_SIZE);
struct k_thread thread_data2;

static void stack_pop_fail(struct k_stack *rx_data_stack)
{
	stack_data_t rx_data;

	/**TESTPOINT: stack pop returns -EBUSY*/
	zassert_equal(k_stack_pop(rx_data_stack, &rx_data, K_NO_WAIT), -EBUSY);
	/**TESTPOINT: stack pop returns -EAGAIN*/
	zassert_equal(k_stack_pop(rx_data_stack, &rx_data, TIMEOUT), -EAGAIN);
}

/**
 * @addtogroup kernel_stack_tests
 * @{
 */

/* Sub-thread entry */
void tStack_pop_entry(void *p1, void *p2, void *p3)
{
	zassert_true(k_stack_pop(p1, p2, K_FOREVER), "stack pop failed\n");
}

/**
 * @brief Verifies stack pop functionality
 * @see k_stack_init(), k_stack_pop()
 * @verifies ZEP-SRS-30-11
 */
ZTEST(stack_fail, test_stack_pop_fail)
{
	k_stack_init(&stack, data, STACK_LEN);

	stack_pop_fail(&stack);
}

/**
 * @brief Verifies cleanup a stack that still be needed by another
 * thread.
 * @see k_stack_cleanup()
 * @verifies ZEP-SRS-30-4
 */
ZTEST(stack_fail, test_stack_cleanup_error)
{
	stack_data_t rx_data[STACK_LEN - 1];

	k_stack_init(&stack, data, STACK_LEN);
	/* Creat a new thread */
	k_tid_t tid = k_thread_create(&thread_data2, threadstack2, STACK_SIZE,
					tStack_pop_entry, &stack,
					rx_data, NULL, K_PRIO_PREEMPT(0), 0,
					K_NO_WAIT);
	/* Delay for finishing some actions of the new thread */
	k_sleep(K_MSEC(500));
	/* Try to clean up the stack, that still be waited by the thread */
	zassert_true(k_stack_cleanup(&stack) == -EAGAIN, "The stack is cleanuped successful");
	/* clear the spawn thread to avoid side effect */
	k_thread_abort(tid);
}

/**
 * @brief Verifies push a data in the full stack.
 * @see k_stack_push()
 * @verifies ZEP-SRS-30-7
 */
ZTEST(stack_fail, test_stack_push_full)
{
	stack_data_t tx_data[STACK_LEN] = {0};
	stack_data_t data_tmp = 0;

	k_stack_init(&stack, data, STACK_LEN);
	for (int i = 0; i < STACK_LEN; i++) {
		zassert_true(k_stack_push(&stack, tx_data[i]) == 0, "push data into stack failed");
	}
	/* Verify that push a data in the full stack, a negative value will be met */
	zassert_true(k_stack_push(&stack, data_tmp) == -ENOMEM, "push data successful");
}

/**
 * @brief k_stack_init() must drop a leftover ALLOC flag
 *
 * @details k_stack_alloc_init() sets K_STACK_FLAG_ALLOC. Re-initializing
 * over a caller buffer without cleanup() first must clear that flag,
 * otherwise cleanup() would k_free() the static buffer.
 *
 * @see k_stack_alloc_init(), k_stack_init(), k_stack_cleanup()
 */
ZTEST(stack_fail, test_stack_init_clears_alloc)
{
	stack_data_t static_buf[STACK_LEN];
	stack_data_t *allocated;

	zassert_ok(k_stack_alloc_init(&stack, STACK_LEN));
	allocated = stack.base;
	zassert_not_null(allocated);

	k_stack_init(&stack, static_buf, STACK_LEN);
	zassert_equal(stack.flags & K_STACK_FLAG_ALLOC, 0);
	zassert_ok(k_stack_cleanup(&stack));

	k_free(allocated);
}

#ifdef CONFIG_USERSPACE
/**
 * @brief Verifies stack pop from a user thread
 * @see k_stack_init(), k_stack_pop()
 * @verifies ZEP-SRS-30-11
 */
ZTEST_USER(stack_fail, test_stack_user_pop_fail)
{
	struct k_stack *alloc_stack = k_object_alloc(K_OBJ_STACK);

	zassert_not_null(alloc_stack, "couldn't allocate stack object");
	zassert_false(k_stack_alloc_init(alloc_stack, STACK_LEN),
		      "stack init failed");

	stack_pop_fail(alloc_stack);
}

/**
 * @brief Verifies stack alloc and initialize a null pointer.
 * @see k_stack_alloc_init()
 * @verifies ZEP-SRS-30-3
 */
ZTEST_USER(stack_fail, test_stack_user_init_null)
{
	ztest_set_fault_valid(true);
	k_stack_alloc_init(NULL, STACK_LEN);
}

/**
 * @brief Verify that alloc and initialize a stack with
 * 0 memory.
 * @see k_stack_alloc_init()
 * @verifies ZEP-SRS-30-3
 */
ZTEST_USER(stack_fail, test_stack_user_init_invalid_value)
{
	ztest_set_fault_valid(true);
	struct k_stack *alloc_stack = k_object_alloc(K_OBJ_STACK);

	zassert_not_null(alloc_stack, "couldn't allocate stack object");
	k_stack_alloc_init(alloc_stack, 0);
}

/**
 * @brief Verify that push some data into a NULL
 * pointer.
 * @see k_stack_push()
 * @verifies ZEP-SRS-30-5
 */
ZTEST_USER(stack_fail, test_stack_user_push_null)
{
	ztest_set_fault_valid(true);
	k_stack_push(NULL, 0);
}

/**
 * @brief Verifies pop data from a NULL pointer.
 * @see k_stack_pop()
 * @verifies ZEP-SRS-30-6
 */
ZTEST_USER(stack_fail, test_stack_user_pop_null)
{
	ztest_set_fault_valid(true);
	k_stack_pop(NULL, 0, K_NO_WAIT);
}

/**
 * @brief Verifies cleanup a stack that its data still be waited by
 * another thread.
 * @see k_stack_pop()
 * @verifies ZEP-SRS-30-11
 */
ZTEST_USER(stack_fail, test_stack_user_pop_permission)
{
	ztest_set_fault_valid(true);
	struct k_stack *alloc_stack = k_object_alloc(K_OBJ_STACK);

	zassert_not_null(alloc_stack, "couldn't allocate stack object");
	zassert_false(k_stack_alloc_init(alloc_stack, STACK_LEN),
		      "stack init failed");
	/* Try to access and to write data at invalid address */
	k_stack_pop(alloc_stack, (stack_data_t *)alloc_stack, K_NO_WAIT);
}
#endif
/**
 * @}
 */
```
