## tests/kernel/service/Kconfig
```kconfig
# Copyright (c) 2026 Intel Corporation
# SPDX-License-Identifier: Apache-2.0

config TEST_OPTIONAL_SERVICE
	bool "Pretend an optional service is part of the build"
	help
	  Left disabled by the test: it stands in for a Kconfig-gated service
	  that another service declares a conditional dependency on.

source "Kconfig.zephyr"
```

## tests/kernel/signal/testcase.yaml
```yaml
common:
  tags:
    - kernel
  platform_exclude:
    # undefined reference to `bootutil_key_cnt'
    - mps2/an521/cpu0/ns

tests:
  kernel.signal: {}
  kernel.signal.userspace:
    filter: CONFIG_ARCH_SUPPORTS_USERSPACE_SIGNALS
    tags: userspace
    extra_configs:
      - CONFIG_TEST_USERSPACE=y
      - CONFIG_USERSPACE=y
```

## tests/kernel/threads/tls/Kconfig
```kconfig
# SPDX-FileCopyrightText: Copyright The Zephyr Project Contributors
# SPDX-License-Identifier: Apache-2.0

mainmenu "Thread-local storage tests"

config TEST_TLS_ALIGNMENT
	int "Alignment of initialized thread-local data"
	default 1
	range 1 64
	help
	  Increase the alignment to verify that runtime TLS initialization
	  preserves the ELF layout and compiler-generated variable offsets.

config TEST_TLS_BSS_ALIGNMENT
	int "Alignment of zero-initialized thread-local data"
	default 1
	range 1 64
	help
	  Increase the alignment independently of initialized data to verify
	  padding before and within the zero-initialized TLS area.

source "Kconfig.zephyr"
```

## tests/kernel/tickless/tickless_concept/Kconfig
```kconfig
# Copyright (c) 2025 Nordic Semiconductor ASA
# SPDX-License-Identifier: Apache-2.0

config SYS_CLOCK_TICKS_PER_SEC
	default 32768 if NRF_RTC_TIMER
	default 1000 if RENESAS_RX_TIMER_CMT
	default 100

source "Kconfig.zephyr"
```

## tests/kernel/timer/timeout_long/Kconfig
```kconfig
# SPDX-FileCopyrightText: Copyright 2026 NXP
# SPDX-License-Identifier: Apache-2.0

source "Kconfig.zephyr"

config TEST_TIMEOUT_LONG_CLOCK
	bool
	default y
	depends on BOARD_MPS2_AN385
	select TICKLESS_CAPABLE
	select TIMER_HAS_64BIT_CYCLE_COUNTER

config TEST_TIMEOUT_LONG_RELOAD
	bool "Use a relative reload for the controlled system clock"
	default n

config TEST_TIMEOUT_LONG_64BIT_COMPARE
	bool "Use a 64-bit compare clock for announce-budget tests"
	depends on !TEST_TIMEOUT_LONG_RELOAD
	default n
	help
	  Use a wide counter and comparator so the kernel announce budget,
	  rather than the counter span, limits each wait.
```

## tests/kernel/timer/timer_api/Kconfig
```kconfig
# SPDX-License-Identifier: Apache-2.0
# Copyright (c) 2023 Nordic Semiconductor ASA

config SYS_CLOCK_TICKS_PER_SEC
	default 16384 if NRF_RTC_TIMER && TICKLESS_KERNEL

config TEST_PROVIDE_PM_HOOKS
	bool "Provide the PM hooks this test needs"
	select HAS_PM
	select PM_STATE_SET_IRQ_UNLOCKED
	help
	  CONFIG_PM needs HAS_PM, which only SoCs implementing low-power states
	  select. src/pm_hooks.c supplies the two required hooks so the PM idle
	  path can be exercised anywhere.

source "Kconfig.zephyr"
```

## tests/kernel/timer/timer_clock/testcase.yaml
```yaml
common:
  ignore_faults: true
  tags:
    - kernel
    - timer
tests:
  kernel.timer.timer_clock:
    integration_platforms:
      - native_sim
      - qemu_x86
      - qemu_cortex_m3
  kernel.timer.timer_clock.tickless:
    integration_platforms:
      - native_sim
      - qemu_x86
      - qemu_cortex_m3
    extra_configs:
      - CONFIG_TICKLESS_KERNEL=y
  kernel.timer.timer_clock.smp:
    platform_allow:
      - qemu_x86_64
    integration_platforms:
      - qemu_x86_64
    extra_configs:
      - CONFIG_MP_MAX_NUM_CPUS=2
      - CONFIG_SPIN_VALIDATE=y
  kernel.timer.timer_clock.userspace:
    filter: CONFIG_ARCH_HAS_USERSPACE
    integration_platforms:
      - qemu_x86
      - qemu_cortex_m3
    extra_configs:
      - CONFIG_TEST_USERSPACE=y
      - CONFIG_ZTEST_FATAL_HOOK=y
```

## tests/kernel/timer/timer_signal/testcase.yaml
```yaml
common:
  ignore_faults: true
  tags:
    - kernel
    - timer
tests:
  kernel.timer.timer_signal:
    integration_platforms:
      - native_sim
      - qemu_x86
      - qemu_cortex_m3
  kernel.timer.timer_signal.tickless:
    integration_platforms:
      - native_sim
      - qemu_x86
    extra_configs:
      - CONFIG_TICKLESS_KERNEL=y
  kernel.timer.timer_signal.userspace:
    filter: CONFIG_ARCH_SUPPORTS_USERSPACE_SIGNALS
    integration_platforms:
      - qemu_x86
      - qemu_cortex_m3
    extra_configs:
      - CONFIG_TEST_USERSPACE=y
      - CONFIG_ZTEST_FATAL_HOOK=y
```

## tests/lib/cbprintf_package/Kconfig
```kconfig
# Copyright The Zephyr Project Contributors
# SPDX-License-Identifier: Apache-2.0

config TEST_EXTRA_STACK_SIZE
	default 16384 if COVERAGE_GCOV
	default 1024

source "Kconfig.zephyr"
```

## tests/lib/devicetree/api/Kconfig
```kconfig
# SPDX-FileCopyrightText: Copyright (c) 2026 Silicon Laboratories Inc.
# SPDX-License-Identifier: Apache-2.0

config TEST_DT_CLASS_ENABLED
	def_bool $(dt_class_enabled,vnd-class-a)

config TEST_DT_CLASS_ENABLED_MISSING
	def_bool $(dt_class_enabled,vnd-no-such-class)

source "Kconfig.zephyr"
```

## tests/lib/elastipool/Kconfig
```kconfig
# Copyright (c) 2025, Friedt Professional Engineering Services, Inc.
#
# SPDX-License-Identifier: Apache-2.0

config TEST_ELASTIC_POOL_MAX_ELEMS
	int "Maximum number of elements for elastic pool testing"
	default 1024
	help
	  The maximum number of elements for elastic pool testing.

	  This number should be non-trivial. If runtime were not a constraint,
	  then it would ideally be -1, i.e. no limit.

source "Kconfig.zephyr"
```

## tests/lib/sys_timer/Kconfig
```kconfig
# SPDX-FileCopyrightText: Copyright The Zephyr Project Contributors
# SPDX-License-Identifier: Apache-2.0

config SYS_TIMER_MIN_ADD_TEST
	int "Guaranteed system timers contributed by this test"
	default 2
	help
	  Contribution of this test to the accumulated minimum (guaranteed,
	  statically allocated) size of the system timer pool.

source "Kconfig.zephyr"
```

## tests/lib/sys_timer/testcase.yaml
```yaml
common:
  ignore_faults: true
  tags:
    - os
    - timer
tests:
  libraries.sys_timer:
    integration_platforms:
      - native_sim
      - qemu_x86
      - qemu_cortex_m3
  libraries.sys_timer.static_only:
    integration_platforms:
      - native_sim
      - qemu_x86
    extra_configs:
      - CONFIG_SYS_TIMER_MAX=2
  libraries.sys_timer.userspace:
    filter: CONFIG_ARCH_HAS_USERSPACE
    integration_platforms:
      - qemu_x86
      - qemu_cortex_m3
    extra_configs:
      - CONFIG_TEST_USERSPACE=y
      - CONFIG_ZTEST_FATAL_HOOK=y
```
