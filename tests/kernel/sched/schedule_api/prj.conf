## CMakeLists.txt
```
# SPDX-License-Identifier: Apache-2.0

cmake_minimum_required(VERSION 3.28.0)
find_package(Zephyr REQUIRED HINTS $ENV{ZEPHYR_BASE})
project(schedule_api)

FILE(GLOB app_sources src/*.c)
target_sources(app PRIVATE ${app_sources})

target_include_directories(app PRIVATE
  ${ZEPHYR_BASE}/kernel/include
  ${ZEPHYR_BASE}/arch/${ARCH}/include
  )
```

## Kconfig
```
# Copyright (c) 2026 MIPS Holding, Inc.
# SPDX-License-Identifier: Apache-2.0

# The time-slice tests need a tick period longer than a thread handoff, so ask
# for 1 ms instead of a much finer native tick.
#
# A default, not a prj*.conf assignment, so that boards pinning a slower tick
# in their _defconfig keep it. Slower is always safe; 1 ms is not, for example
# on the 1 MHz ARC nsim SMP boards where a tick is only 1000 cycles.
config SYS_CLOCK_TICKS_PER_SEC
	default 1000

source "Kconfig.zephyr"
```

## prj.conf
```kconfig
CONFIG_ZTEST=y
CONFIG_IRQ_OFFLOAD=y
CONFIG_NUM_PREEMPT_PRIORITIES=30
CONFIG_NUM_COOP_PRIORITIES=30
#CONFIG_SCHED_SCALABLE=y
CONFIG_MAX_THREAD_BYTES=6
CONFIG_TEST_USERSPACE=y
CONFIG_MP_MAX_NUM_CPUS=1
CONFIG_ZTEST_FATAL_HOOK=y
CONFIG_SYS_CLOCK_TICKS_PER_SEC=1000
CONFIG_THREAD_MONITOR=y
CONFIG_THREAD_STACK_INFO=y
```

## prj_dumb.conf
```kconfig
CONFIG_ZTEST=y
CONFIG_IRQ_OFFLOAD=y
CONFIG_TEST_USERSPACE=y
CONFIG_SCHED_DUMB=y
CONFIG_MAX_THREAD_BYTES=6
CONFIG_MP_MAX_NUM_CPUS=1
CONFIG_ZTEST_FATAL_HOOK=y
```

## prj_multiq.conf
```kconfig
CONFIG_ZTEST=y
CONFIG_IRQ_OFFLOAD=y
CONFIG_TEST_USERSPACE=y
CONFIG_SCHED_MULTIQ=y
CONFIG_MAX_THREAD_BYTES=6
CONFIG_MP_MAX_NUM_CPUS=1
CONFIG_ZTEST_FATAL_HOOK=y
CONFIG_NUM_COOP_PRIORITIES=30
CONFIG_NUM_PREEMPT_PRIORITIES=40
CONFIG_SYS_CLOCK_TICKS_PER_SEC=1000
CONFIG_THREAD_MONITOR=y
CONFIG_THREAD_STACK_INFO=y
```

## prj_native_posix.conf
```kconfig
CONFIG_ZTEST=y
CONFIG_IRQ_OFFLOAD=y
CONFIG_SCHED_MULTIQ=y
```

## prj_simple.conf
```kconfig
CONFIG_ZTEST=y
CONFIG_IRQ_OFFLOAD=y
CONFIG_TEST_USERSPACE=y
CONFIG_SCHED_SIMPLE=y
CONFIG_MAX_THREAD_BYTES=6
CONFIG_MP_MAX_NUM_CPUS=1
CONFIG_ZTEST_FATAL_HOOK=y
CONFIG_SYS_CLOCK_TICKS_PER_SEC=1000
CONFIG_THREAD_MONITOR=y
CONFIG_THREAD_STACK_INFO=y
```

## boards/nsim_nsim_hs6x_smp.conf
```kconfig
# 1 MHz timer: a 1 ms tick is too short for the SMP boards
CONFIG_SYS_CLOCK_TICKS_PER_SEC=100
```

## boards/qemu_cortex_a53_qemu_cortex_a53_smp.conf
```kconfig
# SPDX-FileCopyrightText: Copyright 2026 Arm Limited and/or its affiliates <open-source-office@arm.com>
# SPDX-License-Identifier: Apache-2.0

# These tests use one CPU even with SMP enabled. Icount provides deterministic
# timing for the time-slice assertions while retaining the SMP kernel code paths.
CONFIG_QEMU_ICOUNT=y
```

## boards/da14695_dk_usb.overlay
```dts
/*
 * Copyright (c) 2025 Renesas Electronics Corporation
 *
 * SPDX-License-Identifier: Apache-2.0
 */

/*
 * Clock control for Smartbond schedules delayed work
 * that interferes with slice scheduling test.
 * Slice scheduling test does not expect any additional
 * thread to be scheduled during test.
 * This simply sets xtal32k settle time to fire way
 * before slice test is started.
 * RCX and RC32K calibration intervals are set to 0
 * to disable calibration for tests.
 */

&xtal32k {
	settle-time = <500>;
};

&rcx {
	calibration-interval = <0>;
};

&rc32k {
	calibration-interval = <0>;
};
```

## src/main.c
```c
/*
 * Copyright (c) 2016 Intel Corporation
 *
 * SPDX-License-Identifier: Apache-2.0
 */

#include "test_sched.h"

/* Shared threads */
K_THREAD_STACK_DEFINE(tstack, STACK_SIZE);
K_THREAD_STACK_ARRAY_DEFINE(tstacks, MAX_NUM_THREAD, STACK_SIZE);

/* Not in header file intentionally, see #16760 */
K_THREAD_STACK_DECLARE(ustack, STACK_SIZE);

void spin_for_ms(int ms)
{
	uint32_t t32 = k_uptime_get_32();

	while (k_uptime_get_32() - t32 < ms) {
		/* In the posix arch, a busy loop takes no time, so
		 * let's make it take some
		 */
		Z_SPIN_DELAY(50);
	}
}

static void *threads_scheduling_tests_setup(void)
{
#ifdef CONFIG_USERSPACE
	k_thread_access_grant(k_current_get(), &user_thread, &user_sem,
			      &ustack);
#endif /* CONFIG_USERSPACE */

	return NULL;
}

static bool in_stack(uintptr_t addr, const void *stack, size_t size)
{
	return addr >= (uintptr_t)stack && addr < (uintptr_t)stack + size;
}

struct leftovers {
	k_tid_t tid[MAX_NUM_THREAD + 2];
	size_t count;
};

static void find_leftover(const struct k_thread *thread, void *data)
{
	struct leftovers *left = data;
	uintptr_t start = thread->stack_info.start;

	if ((in_stack(start, tstacks, sizeof(tstacks)) ||
	     in_stack(start, tstack, sizeof(tstack)) ||
	     in_stack(start, ustack, sizeof(ustack))) &&
	    left->count < ARRAY_SIZE(left->tid)) {
		left->tid[left->count++] = (k_tid_t)thread;
	}
}

/* A failed assertion ends the test before it aborts its threads. Abort
 * them here: the next test reuses their stacks and thread objects.
 */
static void threads_scheduling_after(void *data)
{
	struct leftovers left = { .count = 0 };

	ARG_UNUSED(data);

	k_thread_foreach(find_leftover, &left);
	for (size_t i = 0; i < left.count; i++) {
		k_thread_abort(left.tid[i]);
	}
}

static void threads_scheduling_1cpu_after(void *data)
{
	threads_scheduling_after(data);
	ztest_simple_1cpu_after(data);
}

/**
 * @brief Test scheduling
 *
 * @defgroup tests_kernel_sched Scheduling tests
 *
 * @ingroup all_tests
 *
 * @{
 * @}
 */
ZTEST_SUITE(threads_scheduling, NULL, threads_scheduling_tests_setup, NULL,
	    threads_scheduling_after, NULL);
ZTEST_SUITE(threads_scheduling_1cpu, NULL, threads_scheduling_tests_setup,
			ztest_simple_1cpu_before, threads_scheduling_1cpu_after, NULL);
```

## src/test_priority_scheduling.c
```c
/*
 * Copyright (c) 2017 Intel Corporation
 *
 * SPDX-License-Identifier: Apache-2.0
 */

#include <zephyr/ztest.h>
#include "test_sched.h"

#define RAM_SIZE (DT_CHOSEN_SRAM_SIZE / 1024)

/* nrf 51 has lower ram, so creating less number of threads */
#if RAM_SIZE <= 24
	#define NUM_THREAD 2
#elif (RAM_SIZE <= 32) \
	|| defined(CONFIG_SOC_EMSK_EM7D)
	#define NUM_THREAD 3
#else
	#define NUM_THREAD 10
#endif
#define ITERATION_COUNT 5
#define BASE_PRIORITY 1

BUILD_ASSERT(NUM_THREAD <= MAX_NUM_THREAD);

/* Semaphore on which Ztest thread wait */
static K_SEM_DEFINE(sema2, 0, NUM_THREAD);

/* Semaphore on which application threads wait */
static K_SEM_DEFINE(sema3, 0, NUM_THREAD);

static int thread_idx;
static struct k_thread t[NUM_THREAD];

/* Application thread */
static void thread_tslice(void *p1, void *p2, void *p3)
{
	int idx = POINTER_TO_INT(p1);

	/* Print New line for last thread */
	int thread_parameter = (idx == (NUM_THREAD - 1)) ? '\n' :
			       (idx + 'A');

	while (1) {
		/* Printing alphabet corresponding to thread */
		TC_PRINT("%c", thread_parameter);
		/* Testing if threads are executed as per priority */
		zassert_true((idx == thread_idx));
		thread_idx = (thread_idx + 1) % (NUM_THREAD);

		/* Release CPU and give chance to Ztest thread to run */
		k_sem_give(&sema2);
		/* Wait for release of semaphore from Ztest thread */
		k_sem_take(&sema3, K_FOREVER);
	}

}

/* test cases */

/**
 * @brief Check the behavior of preemptive threads with different priorities
 *
 * @details Create multiple threads of different priorities - all are preemptive,
 * current thread is also made preemptive. Check how the threads get chance to
 * execute based on their priorities
 *
 * @ingroup tests_kernel_sched
 * @verifies ZEP-SRS-2-8
 * @verifies ZEP-SRS-2-9
 * @verifies ZEP-SRS-2-12
 */
ZTEST(threads_scheduling, test_priority_scheduling)
{
	k_tid_t tid[NUM_THREAD];
	int old_prio = k_thread_priority_get(k_current_get());
	int count = 0;

	/* update priority for current thread */
	k_thread_priority_set(k_current_get(),
			      K_PRIO_PREEMPT(BASE_PRIORITY - 1));

	/* Create Threads with different Priority */
	for (int i = 0; i < NUM_THREAD; i++) {
		tid[i] = k_thread_create(&t[i], tstacks[i], STACK_SIZE,
					 thread_tslice, INT_TO_POINTER(i), NULL, NULL,
					 K_PRIO_PREEMPT(BASE_PRIORITY + i), 0,
					 K_NO_WAIT);
	}

	while (count < ITERATION_COUNT) {

		/* Wait for each thread to complete */
		for (int i = 0; i < NUM_THREAD; i++) {
			k_sem_take(&sema2, K_FOREVER);
		}
		/* Delay to give chance to last thread to run */
		k_sleep(K_MSEC(1));

		/* Giving Chance to other threads to run */
		for (int i = 0; i < NUM_THREAD; i++) {
			k_sem_give(&sema3);
		}
		count++;
	}


	/* test case teardown */
	for (int i = 0; i < NUM_THREAD; i++) {
		k_thread_abort(tid[i]);
	}
	/* Set priority of Main thread to its old value */
	k_thread_priority_set(k_current_get(), old_prio);
}
```

## src/test_sched.h
```c
/*
 * Copyright (c) 2016 Intel Corporation
 *
 * SPDX-License-Identifier: Apache-2.0
 */

#ifndef __TEST_SCHED_H__
#define __TEST_SCHED_H__

#include <zephyr/kernel.h>
#include <zephyr/ztest.h>

#define MAX_NUM_THREAD 10
#define STACK_SIZE (640 + CONFIG_TEST_EXTRA_STACK_SIZE)

K_THREAD_STACK_DECLARE(tstack, STACK_SIZE);
K_THREAD_STACK_ARRAY_DECLARE(tstacks, MAX_NUM_THREAD, STACK_SIZE);
extern struct k_thread user_thread;
extern struct k_sem user_sem;

struct thread_data {
	k_tid_t tid;
	int priority;
	int executed;
};

void spin_for_ms(int ticks);

void test_priority_cooperative(void);
void test_priority_preemptible(void);
void test_priority_preemptible_wait_prio(void);
void test_bad_priorities(void);
void test_yield_cooperative(void);
void test_sleep_cooperative(void);
void test_busy_wait_cooperative(void);
void test_sleep_wakeup_preemptible(void);
void test_pending_thread_wakeup(void);
void test_time_slicing_preemptible(void);
void test_time_slicing_disable_preemptible(void);
void test_lock_preemptible(void);
void test_unlock_preemptible(void);
void test_unlock_nested_sched_lock(void);
void test_sched_is_preempt_thread(void);
void test_slice_reset(void);
void test_slice_scheduling(void);
void test_priority_scheduling(void);
void test_wakeup_expired_timer_thread(void);
void test_user_k_wakeup(void);
void test_user_k_is_preempt(void);
void test_k_thread_suspend_init_null(void);
void test_k_thread_resume_init_null(void);
void test_k_thread_priority_get_init_null(void);
void test_k_thread_priority_set_init_null(void);
void test_k_thread_priority_set_overmax(void);
void test_k_thread_priority_set_upgrade(void);
void test_k_wakeup_init_null(void);
void test_slice_perthread(void);

/* Tick-domain uptime delta: returns ticks since *reftime, updates
 * *reftime. Delta fits in uint32_t for slice-scale measurements.
 */
static inline uint32_t ticks_delta(uint64_t *reftime)
{
	uint64_t now = k_uptime_ticks();
	uint32_t delta = now - *reftime;

	*reftime = now;
	return delta;
}

#endif /* __TEST_SCHED_H__ */
```

## src/test_sched_api_error.c
```c
/*
 * Copyright (c) 2021 Intel Corporation
 *
 * SPDX-License-Identifier: Apache-2.0
 */

#include <ztest.h>
#include "test_sched.h"

#define THREAD_TEST_PRIORITY 0
static bool after_test;
static struct k_thread tdata;

static void thread_resume_unsuspend(void *p1, void *p2, void *p3)
{
	k_thread_resume(k_current_get());
	after_test = true;
}

/**
 * @brief Test k_thread_resume() API
 *
 * @details resume a thread which is not suspended will directly return
 *
 * @ingroup kernel_sched_tests
 *
 * @see k_thread_resume()
 */
void test_k_thread_resume_unsuspend(void)
{
	after_test = false;

	k_tid_t tid = k_thread_create(&tdata, tstack, STACK_SIZE,
			(k_thread_entry_t)thread_resume_unsuspend,
			NULL, NULL, NULL,
			K_PRIO_PREEMPT(THREAD_TEST_PRIORITY),
			0, K_NO_WAIT);

	zassert_false(after_test, "child thread didn't return");

	k_thread_join(tid, K_FOREVER);
}
```

## src/test_sched_is_preempt_thread.c
```c
/*
 * Copyright (c) 2017 Intel Corporation
 *
 * SPDX-License-Identifier: Apache-2.0
 */

#include <zephyr/ztest.h>
#include <zephyr/irq_offload.h>
#include "test_sched.h"

/* local variables */
static struct k_thread tdata;
static struct k_sem end_sema;

static void tIsr(const void *data)
{
	/** TESTPOINT: The code is running at ISR. */
	zassert_false(k_is_preempt_thread());
}

static void tpreempt_ctx(void *p1, void *p2, void *p3)
{
	/** TESTPOINT: The thread's priority is in the preemptible range. */
	zassert_true(k_is_preempt_thread());
	k_sched_lock();
	/** TESTPOINT: The thread has locked the scheduler. */
	zassert_false(k_is_preempt_thread());
	k_sched_unlock();
	/** TESTPOINT: The thread has not locked the scheduler. */
	zassert_true(k_is_preempt_thread());
	k_thread_priority_set(k_current_get(), K_PRIO_COOP(1));
	/** TESTPOINT: The thread's priority is in the cooperative range. */
	zassert_false(k_is_preempt_thread());
	k_sem_give(&end_sema);
}

static void tcoop_ctx(void *p1, void *p2, void *p3)
{
	/** TESTPOINT: The thread's priority is in the cooperative range. */
	zassert_false(k_is_preempt_thread());
	k_thread_priority_set(k_current_get(), K_PRIO_PREEMPT(1));
	/** TESTPOINT: The thread's priority is in the preemptible range. */
	zassert_true(k_is_preempt_thread());
	k_sched_lock();
	/** TESTPOINT: The thread has locked the scheduler. */
	zassert_false(k_is_preempt_thread());
	k_sched_unlock();
	/** TESTPOINT: The thread has not locked the scheduler. */
	zassert_true(k_is_preempt_thread());
	k_sem_give(&end_sema);
}

/* test cases */

/**
 * @brief Validate the correctness of k_is_preempt_thread()
 *
 * @details Create a preemptive thread, lock the scheduler
 * and call k_is_preempt_thread(). Unlock the scheduler and
 * call k_is_preempt_thread() again. Create a cooperative
 * thread and lock the scheduler k_is_preempt_thread() and
 * unlock the scheduler and call k_is_preempt_thread().
 *
 * @see k_is_preempt_thread()
 *
 * @ingroup tests_kernel_sched
 */
ZTEST(threads_scheduling, test_sched_is_preempt_thread)
{
	k_sem_init(&end_sema, 0, 1);

	/* create preempt thread */
	k_tid_t tid = k_thread_create(&tdata, tstack, STACK_SIZE,
				      tpreempt_ctx, NULL, NULL, NULL,
				      K_PRIO_PREEMPT(1), 0, K_NO_WAIT);
	k_sem_take(&end_sema, K_FOREVER);
	k_thread_abort(tid);

	/* create coop thread */
	tid = k_thread_create(&tdata, tstack, STACK_SIZE,
			      tcoop_ctx, NULL, NULL, NULL,
			      K_PRIO_COOP(1), 0, K_NO_WAIT);
	k_sem_take(&end_sema, K_FOREVER);
	k_thread_abort(tid);

	/* invoke isr */
	irq_offload(tIsr, NULL);
}
```

## src/test_sched_pending.c
```c
/*
 * Copyright (c) 2021 Intel Corporation
 *
 * SPDX-License-Identifier: Apache-2.0
 */
#include <ksched.h>
#include <spinlock.h>
#include <wait_q.h>
#include <ztest.h>

struct sched_pending {
	_wait_q_t waitq;
	struct k_spinlock lock;
} pending;

#define STACK_SIZE	(1024 + CONFIG_TEST_EXTRA_STACKSIZE)

K_THREAD_STACK_DEFINE(test_stack, STACK_SIZE);

static struct k_thread tdata;

static atomic_t num;
static k_tid_t tid;

static void thread_handler1(void *p1, void *p2, void *p3)
{
	z_waitq_init(&pending.waitq);
	k_spinlock_key_t key = k_spin_lock(&pending.lock);

	z_pend_thread(_current, &pending.waitq, K_FOREVER);
	z_reschedule(&pending.lock, key);
}

static void thread_handler2(void *p1, void *p2, void *p3)
{
	z_waitq_init(&pending.waitq);

	unsigned int key = irq_lock();

	z_pend_curr_irqlock(key, &pending.waitq, K_FOREVER);
}

static void thread_handler3(void *p1, void *p2, void *p3)
{
	atomic_inc(&num);
}

/**
 * @brief Test kernel api z_pend_thread()  z_unpend_thread()
 * z_unpend_all() z_pend_curr_irqlock()
 *
 * @details Part1: Creat a child thread and when it's running,
 * use z_pend_thread() api to set it to pending state.
 * Verfiy the child thread state in main thread, it should be in pending.
 * Use z_unpend_thread() api to unpend the child thread and verify in
 * main thread. It should be in unpending state.
 * Part2: Creat a child thread and make it in pending state.
 * Use z_unpend_all() to unpend it then verify the state.
 * Part3: Test z_pend_curr_irqlock() and verify it's pending state.
 *
 * @ingroup kernel_sched_tests
 *
 * @see z_pend_thread() z_unpend_thread() z_unpend_all()
 * z_pend_curr_irqlock()
 */
void test_kernel_api_pend_unpend(void)
{
	/* Part1: test kernel api z_pend_thread() z_unpend_thread() */
	tid = k_thread_create(&tdata, test_stack, STACK_SIZE,
					thread_handler1, NULL, NULL, NULL,
					K_PRIO_PREEMPT(0), 0, K_NO_WAIT);
	/* relinquish CPU for above thread to start */
	k_msleep(1);
	zassert_true(z_is_thread_pending(&tdata), NULL);
	z_unpend_thread(tid);
	z_ready_thread(tid);
	zassert_false(z_is_thread_pending(&tdata), NULL);
	k_thread_abort(tid);

	/* Part2: test kernel api z_pend_thread() z_unpend_all() */
	tid = k_thread_create(&tdata, test_stack, STACK_SIZE,
					thread_handler1, NULL, NULL, NULL,
					K_PRIO_PREEMPT(0), 0, K_NO_WAIT);
	k_msleep(1);
	zassert_true(z_is_thread_pending(&tdata), NULL);
	z_unpend_all(&pending.waitq);
	zassert_false(z_is_thread_pending(&tdata), NULL);
	k_thread_abort(tid);

	/* Part3: test kernel api z_pend_curr_irqlock() */
	tid = k_thread_create(&tdata, test_stack, STACK_SIZE,
				thread_handler2, NULL, NULL, NULL,
				K_PRIO_PREEMPT(0), 0, K_NO_WAIT);
	k_msleep(1);
	zassert_true(z_is_thread_pending(&tdata), NULL);
	k_thread_abort(tid);
}

/**
 * @brief Test kernel api z_move_thread_to_end_of_prio_q()
 * z_remove_thread_from_ready_q()
 *
 * @details Firstly, creat a child thread and use
 * z_move_thread_to_end_of_prio_q()  api to append it to prio_q,
 * then verify then thread's callback has been executed.
 * Secondly, call z_remove_thread_from_ready_q() to remove a thread
 * that has been add to prio_q. The callback should not be executed.
 *
 * @ingroup kernel_sched_tests
 *
 * @see z_move_thread_to_end_of_prio_q() z_remove_thread_from_ready_q()
 */
void test_kernel_api_append_remove_queue(void)
{
	tid = k_thread_create(&tdata, test_stack, STACK_SIZE,
					thread_handler3, NULL, NULL, NULL,
					K_PRIO_PREEMPT(0), 0, K_NO_WAIT);
	/* test child thread will be implemented when append into prio_q */
	zassert_true(num == 0, NULL);
	z_move_thread_to_end_of_prio_q(&tdata);
	k_msleep(1);
	zassert_true(num == 1, NULL);

	/* test the child thread is not implemented */
	z_move_thread_to_end_of_prio_q(&tdata);
	z_remove_thread_from_ready_q(&tdata);
	zassert_true(num == 1, NULL);

	k_thread_abort(tid);
}
```

## src/test_sched_priority.c
```c
/*
 * Copyright (c) 2016 Intel Corporation
 *
 * SPDX-License-Identifier: Apache-2.0
 */

#include "test_sched.h"
#include <ksched.h>

#define THREAD_NUM 4

static struct k_thread tdata_prio[THREAD_NUM];
static struct k_thread tdata;
static int last_prio;
static uint8_t tid_num[4];
static struct k_sem sync_sema;


static void thread_entry(void *p1, void *p2, void *p3)
{
	last_prio = k_thread_priority_get(k_current_get());
}

static void thread_entry_prio(void *p1, void *p2, void *p3)
{
	static int i;

	k_sem_take(&sync_sema, K_MSEC(100));

	tid_num[i++] = POINTER_TO_INT(p1);
}


/* test cases */

/**
 * @brief Validate that the cooperative thread will
 * not be preempted
 *
 * @details Create a cooperative thread with priority higher
 * than the current cooperative thread. Make sure that the higher
 * priority thread will not preempt the lower priority cooperative
 * thread.
 *
 * @ingroup tests_kernel_sched
 */
ZTEST(threads_scheduling, test_priority_cooperative)
{
	int old_prio = k_thread_priority_get(k_current_get());

	/* set current thread to a negative priority */
	last_prio = -1;
	k_thread_priority_set(k_current_get(), last_prio);

	/* spawn thread with higher priority */
	int spawn_prio = last_prio - 1;

	k_tid_t tid = k_thread_create(&tdata, tstack, STACK_SIZE,
				      thread_entry, NULL, NULL, NULL,
				      spawn_prio, 0, K_NO_WAIT);
	/* checkpoint: current thread shouldn't preempted by higher thread */
	zassert_true(last_prio == k_thread_priority_get(k_current_get()));
	k_sleep(K_MSEC(100));
	/* checkpoint: spawned thread get executed */
	zassert_true(last_prio == spawn_prio);
	k_thread_abort(tid);

	/* restore environment */
	k_thread_priority_set(k_current_get(), old_prio);
}

/**
 * @brief Validate preemptiveness of preemptive thread
 *
 * @details Create a preemptive thread which is of priority
 * lower than current thread. Current thread is made has preemptive.
 * Make sure newly created thread is not preempted. Now create a
 * preemptive thread which is of priority higher than current
 * thread. Make sure newly created thread is preempted
 *
 * @ingroup tests_kernel_sched
 */
ZTEST(threads_scheduling, test_priority_preemptible)
{
	int old_prio = k_thread_priority_get(k_current_get());

	/* set current thread to a non-negative priority */
	last_prio = 2;
	k_thread_priority_set(k_current_get(), last_prio);

	int spawn_prio = last_prio - 1;

	k_tid_t tid = k_thread_create(&tdata, tstack, STACK_SIZE,
				      thread_entry, NULL, NULL, NULL,
				      spawn_prio, 0, K_NO_WAIT);
	/* checkpoint: thread is preempted by higher thread */
	zassert_true(last_prio == spawn_prio);

	k_sleep(K_MSEC(100));
	k_thread_abort(tid);

	spawn_prio = last_prio + 1;
	tid = k_thread_create(&tdata, tstack, STACK_SIZE,
			      thread_entry, NULL, NULL, NULL,
			      spawn_prio, 0, K_NO_WAIT);
	/* checkpoint: thread is not preempted by lower thread */
	zassert_false(last_prio == spawn_prio);
	k_thread_abort(tid);

	/* restore environment */
	k_thread_priority_set(k_current_get(), old_prio);
}

/**
 * @brief Validate scheduling sequence of preemptive threads with start delay
 *
 * @details Create four preemptive threads which are of priority
 * higher than current thread. Make sure that the highest priority
 * and longest waiting thread is scheduled first.
 *
 * @ingroup tests_kernel_sched
 */
ZTEST(threads_scheduling_1cpu, test_priority_preemptible_wait_prio)
{
	int old_prio = k_thread_priority_get(k_current_get());
	k_tid_t tid[THREAD_NUM];
	uint8_t tid_chk[4] =  { 0, 1, 2, 3 };

	k_sem_init(&sync_sema, 0, THREAD_NUM);

	/* Ensure that this code starts running at the start of a system tick */
	k_usleep(1);

	/* set current thread to a non-negative priority */
	last_prio = K_PRIO_PREEMPT(2);
	k_thread_priority_set(k_current_get(), last_prio);

	/* the highest-priority thread that has waited the longest */
	tid[0] = k_thread_create(&tdata_prio[0], tstacks[0], STACK_SIZE,
			thread_entry_prio, INT_TO_POINTER(0), NULL, NULL,
			K_PRIO_PREEMPT(0), 0, K_MSEC(10));
	/* the highest-priority thread that has waited the shorter */
	tid[1] = k_thread_create(&tdata_prio[1], tstacks[1], STACK_SIZE,
			thread_entry_prio, INT_TO_POINTER(1), NULL, NULL,
			K_PRIO_PREEMPT(0), 0, K_MSEC(20));
	/* the lowest-priority thread that has waited longest */
	tid[2] = k_thread_create(&tdata_prio[2], tstacks[2], STACK_SIZE,
			thread_entry_prio, INT_TO_POINTER(2), NULL, NULL,
			K_PRIO_PREEMPT(1), 0, K_MSEC(10));
	/* the lowest-priority thread that has waited shorter */
	tid[3] = k_thread_create(&tdata_prio[3], tstacks[3], STACK_SIZE,
			thread_entry_prio, INT_TO_POINTER(3), NULL, NULL,
			K_PRIO_PREEMPT(1), 0, K_MSEC(20));

	/* relinquish CPU for above threads to start */
	k_sleep(K_MSEC(30));

	for (int i = 0; i < THREAD_NUM; i++) {
		k_sem_give(&sync_sema);
	}

	zassert_true((memcmp(tid_num, tid_chk, 4) == 0),
		     "scheduling priority failed");

	/* test case tear down */
	for (int i = 0; i < THREAD_NUM; i++) {
		k_thread_abort(tid[i]);
	}

	/* restore environment */
	k_thread_priority_set(k_current_get(), old_prio);
}

extern void idle(void *p1, void *p2, void *p3);

/**
 * @brief Verify thread priority validation accepts/rejects the right values.
 *
 * @details
 * The kernel's priority-validity check must accept legal application priorities
 * (and the idle priority only for the idle entry) and reject out-of-range
 * values. The test runs a table of priority/entry combinations through both
 * validity checks and confirms each expected accept/reject result.
 *
 * Test steps:
 * - Iterate a table of {priority, entry, expected-valid} cases.
 * - For each, check the internal validity predicate and the Z_VALID_PRIO macro.
 *
 * Expected result:
 * - Every case returns its expected validity verdict.
 *
 * @ingroup tests_kernel_sched
 */
ZTEST(threads_scheduling, test_bad_priorities)
{
	struct prio_test {
		int prio;
		void *entry;
		bool result;
	} testcases[] = {
		{ K_IDLE_PRIO, idle, true },
		{ K_IDLE_PRIO, NULL, false },
		{ K_HIGHEST_APPLICATION_THREAD_PRIO - 1, NULL, false },
		{ K_LOWEST_APPLICATION_THREAD_PRIO + 1, NULL, false },
		{ K_HIGHEST_APPLICATION_THREAD_PRIO, NULL, true },
		{ K_LOWEST_APPLICATION_THREAD_PRIO, NULL, true },
		{ CONFIG_MAIN_THREAD_PRIORITY, NULL, true }
	};

	for (int i = 0; i < ARRAY_SIZE(testcases); i++) {
		zassert_equal(_is_valid_prio(testcases[i].prio,
					     testcases[i].entry),
			      testcases[i].result, "failed check %d", i);
		/* XXX why are these even separate APIs? */
		zassert_equal(Z_VALID_PRIO(testcases[i].prio,
					   testcases[i].entry),
			      testcases[i].result, "failed check %d", i);
	}
}
```

## src/test_sched_timeslice_and_lock.c
```c
/*
 * Copyright (c) 2016 Intel Corporation
 *
 * SPDX-License-Identifier: Apache-2.0
 */

#include "test_sched.h"
#define THREADS_NUM     3
#define DURATION	K_MSEC(1)

BUILD_ASSERT(THREADS_NUM <= MAX_NUM_THREAD);

static struct thread_data tdata[THREADS_NUM];
static struct k_thread tthread[THREADS_NUM];
static int old_prio, init_prio;

struct k_thread t;

K_SEM_DEFINE(pend_sema, 0, 1);
K_SEM_DEFINE(timer_sema, 0, 1);
struct k_timer th_wakeup_timer;

static void thread_entry(void *p1, void *p2, void *p3)
{
	int sleep_ms = POINTER_TO_INT(p2);

	if (sleep_ms > 0) {
		k_msleep(sleep_ms);
	}

	int tnum = POINTER_TO_INT(p1);

	tdata[tnum].executed = 1;
}

static void setup_threads(void)
{
	old_prio = k_thread_priority_get(k_current_get());
	for (int i = 0; i < THREADS_NUM; i++) {
		if (i == 0) {
			/* spawn thread with higher priority */
			tdata[i].priority = init_prio - 1;
		} else if (i == 1) {
			/* spawn thread with same priority */
			tdata[i].priority = init_prio;
		} else {
			/* spawn thread with lower priority */
			tdata[i].priority = init_prio + 1;
		}
		tdata[i].executed = 0;
	}
	k_thread_priority_set(k_current_get(), init_prio);
}

static void spawn_threads(int sleep_msec)
{
	for (int i = 0; i < THREADS_NUM; i++) {
		tdata[i].tid = k_thread_create(&tthread[i], tstacks[i],
					       STACK_SIZE, thread_entry,
					       INT_TO_POINTER(i),
					       INT_TO_POINTER(sleep_msec),
					       NULL, tdata[i].priority, 0,
					       K_NO_WAIT);
	}
}

static void teardown_threads(void)
{
	for (int i = 0; i < THREADS_NUM; i++) {
		k_thread_abort(tdata[i].tid);
	}
	k_thread_priority_set(k_current_get(), old_prio);
}

static void timer_handler(struct k_timer *timer)
{
	ARG_UNUSED(timer);
	k_sem_give(&timer_sema);
}

static void thread_handler(void *p1, void *p2, void *p3)
{
	k_timer_init(&th_wakeup_timer, timer_handler, NULL);
	k_timer_start(&th_wakeup_timer, DURATION, K_NO_WAIT);
}

/* test cases */

/**
 * @brief Validate the behavior of cooperative thread
 * when it yields
 *
 * @ingroup tests_kernel_sched
 *
 * @details Create 3 threads of priority -2, -1 and 0.
 * Yield the main thread which is cooperative. Check
 * if all the threads gets executed.
 * @verifies ZEP-SRS-2-14
 * @verifies ZEP-SRS-2-15
 * @verifies ZEP-SRS-19-2
 */
ZTEST(threads_scheduling, test_yield_cooperative)
{

	/* set current thread to a cooperative priority */
	init_prio = -1;
	setup_threads();

	spawn_threads(0);
	/* checkpoint: only higher priority thread get executed when yield */
	k_yield();
	zassert_true(tdata[0].executed == 1);
	zassert_true(tdata[1].executed == 1);
	for (int i = 2; i < THREADS_NUM; i++) {
		zassert_true(tdata[i].executed == 0);
	}
	/* restore environment */
	teardown_threads();
}
/**
 * @brief Validate the behavior of cooperative thread when it sleeps
 *
 * @details Create 3 threads of priority -2, -1 and 0. Put the main
 * thread in timeout queue by calling k_sleep() which is cooperative.
 * Check if all the threads gets executed.
 *
 * @ingroup tests_kernel_sched
 * @verifies ZEP-SRS-2-14
 */
ZTEST(threads_scheduling, test_sleep_cooperative)
{
	/* set current thread to a cooperative priority */
	init_prio = -1;
	setup_threads();

	spawn_threads(0);
	/* checkpoint: all ready threads get executed when k_sleep */
	k_sleep(K_MSEC(100));
	for (int i = 0; i < THREADS_NUM; i++) {
		zassert_true(tdata[i].executed == 1);
	}

	/* restore environment */
	teardown_threads();
}

/**
 * @brief Verify k_busy_wait() in a cooperative thread blocks other threads.
 *
 * @details
 * k_busy_wait() spins without yielding the CPU. From a cooperative thread (which
 * is never preempted), no other ready thread may run for the whole busy-wait
 * duration, unlike k_sleep() which would let them execute.
 *
 * Test steps:
 * - Set the current thread to a cooperative priority and spawn worker threads.
 * - Call k_busy_wait() for 100 ms.
 * - Verify none of the workers executed during the busy-wait.
 *
 * Expected result:
 * - No other thread runs while the cooperative thread busy-waits.
 *
 * @ingroup tests_kernel_sched
 *
 * @see k_busy_wait()
 * @verifies ZEP-SRS-2-14
 * @verifies ZEP-SRS-28-13
 */
ZTEST(threads_scheduling, test_busy_wait_cooperative)
{
	/* set current thread to a cooperative priority */
	init_prio = -1;
	setup_threads();

	spawn_threads(0);
	k_busy_wait(100000); /* 100 ms */
	/* checkpoint: No other threads get executed */
	for (int i = 0; i < THREADS_NUM; i++) {
		zassert_true(tdata[i].executed == 0);
	}
	/* restore environment */
	teardown_threads();
}

/**
 * @brief Validate k_wakeup()
 *
 * @details Create 3 threads with main thread with priority 0
 * and other threads with -1, 0 ,+1 priority. Now -1 priority
 * thread gets executed and it is made to sleep for 10 sec.
 * Now, wake up the -1 priority thread and check if it starts
 * executing.
 *
 * @see k_wakeup()
 *
 * @ingroup tests_kernel_sched
 * @verifies ZEP-SRS-28-11
 */
ZTEST(threads_scheduling, test_sleep_wakeup_preemptible)
{
	/* set current thread to a preemptible priority */
	init_prio = 0;
	setup_threads();

	spawn_threads(10 * 1000); /* 10 second */
	/* checkpoint: lower threads not executed, high threads are in sleep */
	for (int i = 0; i < THREADS_NUM; i++) {
		zassert_true(tdata[i].executed == 0);
	}
	k_wakeup(tdata[0].tid);
	zassert_true(tdata[0].executed == 1);
	/* restore environment */
	teardown_threads();
}

static int executed;
static void coop_thread(void *p1, void *p2, void *p3)
{
	ARG_UNUSED(p1);
	ARG_UNUSED(p2);
	ARG_UNUSED(p3);

	k_sem_take(&pend_sema, K_MSEC(100));
	executed = 1;
}

/**
 * @brief Verify k_wakeup() behavior on pending thread
 *
 * @details The test creates a cooperative thread and let
 * it wait for semaphore. Then calls k_wakeup(). The k_wakeup()
 * call should return gracefully without waking up the thread
 *
 * @see k_wakeup()
 *
 * @ingroup tests_kernel_sched
 * @verifies ZEP-SRS-28-11
 */
ZTEST(threads_scheduling, test_pending_thread_wakeup)
{
	/* Make current thread preemptible */
	k_thread_priority_set(k_current_get(), K_PRIO_PREEMPT(1));

	/* Create a thread which waits for semaphore */
	k_tid_t tid = k_thread_create(&t, tstack, STACK_SIZE,
				      coop_thread,
				      NULL, NULL, NULL,
				      K_PRIO_COOP(1), 0, K_NO_WAIT);

	zassert_false(executed == 1, "The thread didn't wait"
		      " for semaphore acquisition");

	/* Call wakeup on pending thread */
	k_wakeup(tid);

	/* TESTPOINT: k_wakeup() shouldn't resume
	 * execution of pending thread
	 */
	zassert_true(executed != 1, "k_wakeup woke up a"
		     " pending thread!");

	k_thread_abort(tid);
}

/**
 * @brief Validate preemptive thread behavior with time slice
 *
 * @details Create 3 threads with -1, 0, and 1 as priority, setup
 * time slice for threads with priority 0. Make sure the threads
 * with equal priorities are executed in time slice.
 *
 * @ingroup tests_kernel_sched
 * @verifies ZEP-SRS-2-11
 */
ZTEST(threads_scheduling, test_time_slicing_preemptible)
{
#ifdef CONFIG_TIMESLICING
	/* set current thread to a preemptible priority */
	init_prio = 0;
	setup_threads();

	k_sched_time_slice_set(200, 0); /* 200 ms */
	spawn_threads(0);
	/* checkpoint: higher priority threads get executed immediately */
	zassert_true(tdata[0].executed == 1);
	k_busy_wait(500000); /* 500 ms */
	/* checkpoint: equal priority threads get executed every time slice */
	zassert_true(tdata[1].executed == 1);
	for (int i = 2; i < THREADS_NUM; i++) {
		zassert_true(tdata[i].executed == 0);
	}

	/* restore environment */
	k_sched_time_slice_set(0, 0); /* disable time slice */
	teardown_threads();
#else /* CONFIG_TIMESLICING */
	ztest_test_skip();
#endif /* CONFIG_TIMESLICING */
}

/**
 * @brief Check the behavior of preemptive thread with k_busy_wait()
 *
 * @details Create 3 threads with -1, 0, and 1 as priority,
 * setup time slice for threads with priority 0. Make sure the
 * threads with equal priorities are executed in time slice.
 * Also run k_busy_wait() for 5 secs and check if other threads
 * are not executed at that time.
 *
 * @see k_busy_wait()
 *
 * @ingroup tests_kernel_sched
 * @verifies ZEP-SRS-2-11
 */
ZTEST(threads_scheduling, test_time_slicing_disable_preemptible)
{
#ifdef CONFIG_TIMESLICING
	/* set current thread to a preemptible priority */
	init_prio = 0;
	setup_threads();

	spawn_threads(0);
	/* checkpoint: higher priority threads get executed immediately */
	zassert_true(tdata[0].executed == 1);
	k_busy_wait(500000); /* 500 ms */
	/* checkpoint: equal priority threads get executed every time slice */
	zassert_true(tdata[1].executed == 0);
	for (int i = 2; i < THREADS_NUM; i++) {
		zassert_true(tdata[i].executed == 0);
	}
	/* restore environment */
	teardown_threads();
#else /* CONFIG_TIMESLICING */
	ztest_test_skip();
#endif /* CONFIG_TIMESLICING */
}

/**
 * @brief Lock the scheduler when preemptive threads are running
 *
 * @details Create 3 threads and lock the scheduler. Make sure that the
 * threads are not executed. Call k_sleep() and check if the threads
 * have executed.
 *
 * @ingroup tests_kernel_sched
 * @verifies ZEP-SRS-2-16
 */
ZTEST(threads_scheduling, test_lock_preemptible)
{
	/* set current thread to a preemptible priority */
	init_prio = 0;
	setup_threads();

	k_sched_lock();
	spawn_threads(0);
	/* do critical thing */
	k_busy_wait(100000);
	/* checkpoint: all other threads not been executed */
	for (int i = 0; i < THREADS_NUM; i++) {
		zassert_true(tdata[i].executed == 0);
	}
	/* make current thread unready */
	k_sleep(K_MSEC(100));
	/* checkpoint: all other threads get executed */
	for (int i = 0; i < THREADS_NUM; i++) {
		zassert_true(tdata[i].executed == 1);
	}
	/* restore environment */
	teardown_threads();
}

/**
 * @brief Validate k_sched_lock() and k_sched_unlock()
 *
 * @details  Lock the scheduler and create 3 threads. Check
 * that the threads are not executed. Call k_sched_unlock()
 * and check if the threads have executed.
 *
 * @see k_sched_lock(), k_sched_unlock()
 *
 * @ingroup tests_kernel_sched
 * @verifies ZEP-SRS-2-16
 */
ZTEST(threads_scheduling, test_unlock_preemptible)
{
	/* set current thread to a preemptible priority */
	init_prio = 0;
	setup_threads();

	k_sched_lock();
	spawn_threads(0);
	/* do critical thing */
	k_busy_wait(100000);

	k_sched_unlock();

	/* ensure threads of equal priority can run */
	k_yield();

	/* checkpoint: higher and equal threads get executed */
	zassert_true(tdata[0].executed == 1);
	zassert_true(tdata[1].executed == 1);
	zassert_true(tdata[2].executed == 0);

	/* restore environment */
	teardown_threads();
}

/**
 * @brief Validate nested k_sched_lock() and k_sched_unlock()
 *
 * @details In a preemptive thread, lock the scheduler twice and
 * create a cooperative thread.  Call k_sched_unlock() and check the
 * cooperative thread haven't executed.  Unlock it again to see the
 * thread have executed this time.
 *
 * @see k_sched_lock(), k_sched_unlock()
 *
 * @ingroup tests_kernel_sched
 * @verifies ZEP-SRS-2-16
 */
ZTEST(threads_scheduling, test_unlock_nested_sched_lock)
{
	/* set current thread to a preemptible priority */
	init_prio = 0;
	setup_threads();

	/* take the scheduler lock twice */
	k_sched_lock();
	k_sched_lock();

	/* spawn threads without wait */
	spawn_threads(0);

	/* do critical thing */
	k_busy_wait(100000);

	/* unlock once; this shouldn't let other threads to run */
	k_sched_unlock();

	/* checkpoint: no threads get executed */
	for (int i = 0; i < THREADS_NUM; i++) {
		zassert_true(tdata[i].executed == 0);
	}

	/* unlock another; this let the higher thread to run */
	k_sched_unlock();

	/* Ensure threads of equal priority run */
	k_yield();

	/* checkpoint: higher threads NOT get executed */
	zassert_true(tdata[0].executed == 1);
	zassert_true(tdata[1].executed == 1);
	zassert_true(tdata[2].executed == 0);

	/* restore environment */
	teardown_threads();
}

/**
 * @brief validate k_wakeup() in some corner scenario
 * @details trigger a timer and after expiration of timer
 * call k_wakeup(), even the thread is not in sleep state neither
 * in pending state
 *
 * @see k_wakeup()
 *
 * @ingroup tests_kernel_sched
 * @verifies ZEP-SRS-28-11
 */
ZTEST(threads_scheduling, test_wakeup_expired_timer_thread)
{
	k_tid_t tid = k_thread_create(&tthread[0], tstack, STACK_SIZE,
					thread_handler, NULL, NULL, NULL,
					K_PRIO_PREEMPT(0), 0, K_NO_WAIT);
	k_sem_take(&timer_sema, K_FOREVER);
	/* wakeup a thread if the timer is expired */
	k_wakeup(tid);
	k_thread_abort(tid);
}
```

## src/test_sched_timeslice_reset.c
```c
/*
 * Copyright (c) 2017 Intel Corporation
 *
 * SPDX-License-Identifier: Apache-2.0
 */

#include <zephyr/ztest.h>
#include "test_sched.h"

/*
 * Build the real test body for the documentation build (__DOXYGEN__) as
 * well as when CONFIG_TIMESLICING is set, so the documented case is not
 * hidden by the #else skip-stub below.
 */
#if defined(CONFIG_TIMESLICING) || defined(__DOXYGEN__)

#define NUM_THREAD 3

BUILD_ASSERT(NUM_THREAD <= MAX_NUM_THREAD);

/* slice size in milliseconds (kernel slicing API takes ms) */
#define SLICE_SIZE_MS 200
/* busy-wait duration: more than one slice so the slicer fires */
#define BUSY_MS (SLICE_SIZE_MS + 20)

/* All measurement bounds are expressed in ticks: that's the granularity
 * at which preemptive scheduling happens. Each measured slice lands on
 * exactly one of two tick values -- the configured slice or one tick
 * later, due to z_add_timeout()'s "+1" round-up that guarantees an
 * at-least-N tick delay.
 */
#define SLICE_TICKS k_ms_to_ticks_ceil32(SLICE_SIZE_MS)
#define HALF_SLICE_TICKS (SLICE_TICKS / 2)

K_SEM_DEFINE(sema, 0, NUM_THREAD);
/* Reference timestamp (in ticks) for each measurement */
static uint64_t elapsed_slice;
static int thread_idx;
static struct k_thread t[NUM_THREAD];

static void thread_time_slice(void *p1, void *p2, void *p3)
{
	__maybe_unused uint32_t tick_delta = ticks_delta(&elapsed_slice);
	/*
	 * Thread 0 picks up CPU when the main test thread voluntarily
	 * yields halfway through its slice, so its elapsed measurement
	 * spans the busy-wait of half a slice. The remaining threads see
	 * the previous thread's full slice between successive wakeups.
	 */
	__maybe_unused uint32_t expected = (thread_idx == 0) ? HALF_SLICE_TICKS : SLICE_TICKS;

#ifdef CONFIG_DEBUG
	TC_PRINT("thread[%d] elapsed: %u ticks, expected ~%u\n",
		 thread_idx, tick_delta, expected);
#endif

	/* Update before the assert so a failure log doesn't suggest the
	 * same thread ran more than once.
	 */
	thread_idx = (thread_idx + 1) % NUM_THREAD;

#ifndef CONFIG_COVERAGE_GCOV
	/* TESTPOINT: a measured slice falls on either the configured tick
	 * boundary or the next one (kernel "+1" round-up).
	 */
	zassert_between_inclusive(tick_delta, expected, expected + 1,
				  "elapsed %u ticks, expected ~%u",
				  tick_delta, expected);
#endif /* CONFIG_COVERAGE_GCOV */

	/* Keep this thread busy past one slice so the slicer fires and
	 * hands the CPU to the next thread.
	 */
	spin_for_ms(BUSY_MS);
	k_sem_give(&sema);
}

#endif /* CONFIG_TIMESLICING */

/* test cases */
/**
 * @brief Check the behavior of preemptive threads when the
 * time slice is disabled and enabled
 *
 * @details Create multiple preemptive threads with few different
 * priorities and few with same priorities and enable the time slice.
 * Ensure that each thread is given the time slice period to execute.
 *
 * Skipped when CONFIG_TIMESLICING is disabled.
 *
 * @see k_sched_time_slice_set(), k_sem_reset(), k_cycle_get_32(),
 *      k_uptime_get_32()
 *
 * @ingroup tests_kernel_sched
 * @verifies ZEP-SRS-2-11
 */
ZTEST(threads_scheduling, test_slice_reset)
{
#ifdef CONFIG_TIMESLICING
	uint32_t t32;
	k_tid_t tid[NUM_THREAD];
	int old_prio = k_thread_priority_get(k_current_get());

	thread_idx = 0;
	/* disable timeslice */
	k_sched_time_slice_set(0, K_PRIO_PREEMPT(0));

	/* Size the busy-wait as a whole number of ticks using the driver's
	 * real cycles per tick, floor(HW/ticks). Converting the half-slice
	 * with the fractional ratio (k_ticks_to_cyc_ceil32()) would skew the
	 * measured ticks where a tick isn't a whole number of cycles.
	 */
	uint32_t cyc_per_tick = k_ticks_to_cyc_floor32(1);
	uint32_t half_slice_cyc = HALF_SLICE_TICKS * cyc_per_tick;

	for (int j = 0; j < 2; j++) {
		k_sem_reset(&sema);

		/* update priority for current thread */
		k_thread_priority_set(k_current_get(), K_PRIO_PREEMPT(j));

		/* synchronize to tick boundary */
		k_usleep(1);

		/* create delayed threads with equal preemptive priority */
		for (int i = 0; i < NUM_THREAD; i++) {
			tid[i] = k_thread_create(&t[i], tstacks[i], STACK_SIZE,
						 thread_time_slice, NULL, NULL,
						 NULL, K_PRIO_PREEMPT(j), 0,
						 K_NO_WAIT);
		}

		/* enable time slice (and reset the counter!) */
		k_sched_time_slice_set(SLICE_SIZE_MS, K_PRIO_PREEMPT(0));

		/* initialize reference timestamp */
		ticks_delta(&elapsed_slice);

		/* consume half a timeslice, timed on the free-running cycle
		 * counter (independent of the tick interrupt)
		 */
		t32 = k_cycle_get_32();
		while (k_cycle_get_32() - t32 < half_slice_cyc) {
			Z_SPIN_DELAY(50);
		}

		/* relinquish CPU and wait for each thread to complete */
		k_sleep(K_TICKS(SLICE_TICKS * (NUM_THREAD + 1)));
		for (int i = 0; i < NUM_THREAD; i++) {
			k_sem_take(&sema, K_FOREVER);
		}

		/* test case teardown */
		for (int i = 0; i < NUM_THREAD; i++) {
			k_thread_abort(tid[i]);
		}
		/* disable time slice */
		k_sched_time_slice_set(0, K_PRIO_PREEMPT(0));
	}
	k_thread_priority_set(k_current_get(), old_prio);
#else
	ztest_test_skip();
#endif /* CONFIG_TIMESLICING */
}
```

## src/test_slice_scheduling.c
```c
/*
 * Copyright (c) 2022 Intel Corporation
 *
 * SPDX-License-Identifier: Apache-2.0
 */

#include <zephyr/ztest.h>
#include "test_sched.h"

/*
 * Build the real test bodies for the documentation build (__DOXYGEN__) as
 * well as when CONFIG_TIMESLICING is set, so the documented cases are not
 * hidden by the #else skip-stubs below.
 */
#if defined(CONFIG_TIMESLICING) || defined(__DOXYGEN__)

/* nrf 51 has lower ram, so creating less number of threads */
#if (DT_CHOSEN_SRAM_SIZE / 1024) <= 24
	#define NUM_THREAD 2
#elif ((DT_CHOSEN_SRAM_SIZE / 1024) <= 32) \
	|| defined(CONFIG_SOC_EMSK_EM7D)
	#define NUM_THREAD 3
#else
	#define NUM_THREAD 10
#endif
#define BASE_PRIORITY 0
#define ITERATION_COUNT 5

BUILD_ASSERT(NUM_THREAD <= MAX_NUM_THREAD);
/* slice size in milliseconds (kernel slicing API takes ms) */
#define SLICE_SIZE_MS 200
/* busy-wait duration: more than one slice so the slicer fires */
#define BUSY_MS (SLICE_SIZE_MS + 20)

/* Measurement bound is in ticks: slicer-driven preemption lands on
 * either the configured tick boundary or one tick later (kernel "+1"
 * round-up in z_add_timeout()).
 */
#define SLICE_TICKS k_ms_to_ticks_ceil32(SLICE_SIZE_MS)

#define PERTHREAD_SLICE_TICKS 64

static struct k_thread t[NUM_THREAD];

static K_SEM_DEFINE(sema1, 0, NUM_THREAD);
/* Reference timestamp (in ticks) for measuring slice durations */
static uint64_t elapsed_slice;

static int thread_idx;

static void thread_tslice(void *p1, void *p2, void *p3)
{
	int idx = POINTER_TO_INT(p1);

	/* Print New line for last thread */
	int thread_parameter = (idx == (NUM_THREAD - 1)) ? '\n' :
			       (idx + 'A');

	while (1) {
		uint32_t tick_delta = ticks_delta(&elapsed_slice);

		TC_PRINT("%c", thread_parameter);
#ifndef CONFIG_COVERAGE_GCOV
		/* TESTPOINT: threads run in round-robin order, and each
		 * measured slice falls on either the configured tick boundary
		 * or the next one (kernel "+1" round-up). Skipped under
		 * coverage, where gcov instrumentation perturbs the slice
		 * timing enough to reorder wakeups.
		 */
		zassert_equal(idx, thread_idx,
			      "out of order: idx=%d thread_idx=%d",
			      idx, thread_idx);
		zassert_between_inclusive(tick_delta, SLICE_TICKS,
					  SLICE_TICKS + 1,
					  "tick_delta=%u expected ~%u",
					  tick_delta, SLICE_TICKS);
#else
		(void)tick_delta;
#endif /* CONFIG_COVERAGE_GCOV */
		thread_idx = (thread_idx + 1) % (NUM_THREAD);

		k_sem_give(&sema1);

		/* Keep the current thread busy for more than one slice,
		 * even though, when timeslice used up the next thread
		 * should be scheduled in.
		 */
		spin_for_ms(BUSY_MS);
	}
}

static volatile int32_t perthread_count;
static volatile uint32_t last_cyc;
static volatile bool perthread_running;
static K_SEM_DEFINE(perthread_sem, 0, 1);

static void slice_expired(struct k_thread *thread, void *data)
{
	zassert_equal(thread, data, "wrong callback data pointer");

	/* Convert with the driver's real cycles per tick, floor(HW/ticks), not
	 * the fractional ratio k_cyc_to_ticks_near32() uses (which skews where a
	 * tick isn't a whole number of cycles). Round, don't truncate, to absorb
	 * the sub-tick offset between the reference and this reading.
	 */
	uint32_t now = k_cycle_get_32();
	uint32_t dt = DIV_ROUND_CLOSEST(now - last_cyc, k_ticks_to_cyc_floor32(1));

	zassert_true(perthread_running, "thread didn't start");
	/* Slice fire lands on either the configured tick boundary or
	 * the next one due to z_add_timeout()'s "+1" round-up.
	 */
	zassert_between_inclusive(dt, PERTHREAD_SLICE_TICKS,
				  PERTHREAD_SLICE_TICKS + 1,
				  "slice expired at dt=%u, expected ~%u",
				  dt, PERTHREAD_SLICE_TICKS);

	last_cyc = now;

	/* First time through, just let the slice expire and keep
	 * running.  Second time, abort the thread and wake up the
	 * main test function.
	 */
	if (perthread_count++ != 0) {
		k_thread_abort(thread);
		perthread_running = false;
		k_sem_give(&perthread_sem);
	}
}

static void slice_perthread_fn(void *a, void *b, void *c)
{
	ARG_UNUSED(a); ARG_UNUSED(b); ARG_UNUSED(c);
	while (true) {
		perthread_running = true;
		k_busy_wait(10);
	}
}

#endif /* CONFIG_TIMESLICING */

/* test cases */

/**
 * @brief Check the behavior of preemptive threads when the
 * time slice is disabled and enabled
 *
 * @details Create multiple preemptive threads with same priorities
 * and few with same priorities and enable the time slice.
 * Ensure that each thread is given the time slice period to execute.
 *
 * Skipped when CONFIG_TIMESLICING is disabled.
 *
 * @ingroup tests_kernel_sched
 *
 * @see k_sched_time_slice_set()
 */
ZTEST(threads_scheduling, test_slice_scheduling)
{
#ifdef CONFIG_TIMESLICING
	k_tid_t tid[NUM_THREAD];
	int old_prio = k_thread_priority_get(k_current_get());
	int count = 0;

	thread_idx = 0;

	/* disable timeslice */
	k_sched_time_slice_set(0, K_PRIO_PREEMPT(0));

	/* update priority for current thread */
	k_thread_priority_set(k_current_get(), K_PRIO_PREEMPT(BASE_PRIORITY));

	/* align to tick edge */
	k_usleep(1);

	/* create threads with equal preemptive priority */
	for (int i = 0; i < NUM_THREAD; i++) {
		tid[i] = k_thread_create(&t[i], tstacks[i], STACK_SIZE,
					 thread_tslice,
					 INT_TO_POINTER(i), NULL, NULL,
					 K_PRIO_PREEMPT(BASE_PRIORITY), 0,
					 K_NO_WAIT);
	}

	/* enable time slice */
	k_sched_time_slice_set(SLICE_SIZE_MS, K_PRIO_PREEMPT(BASE_PRIORITY));
	ticks_delta(&elapsed_slice);

	while (count < ITERATION_COUNT) {
		/* Keep the current thread busy for more than one slice,
		 * even though, when timeslice used up the next thread
		 * should be scheduled in.
		 */
		spin_for_ms(BUSY_MS);

		/* all threads should have run by now */
		ticks_delta(&elapsed_slice);
		for (int i = 0; i < NUM_THREAD; i++) {
			zassert_equal(k_sem_take(&sema1, K_NO_WAIT), 0,
				      "not all threads gave their sem");
		}
		count++;
	}


	/* test case teardown */
	for (int i = 0; i < NUM_THREAD; i++) {
		k_thread_abort(tid[i]);
	}

	/* disable time slice */
	k_sched_time_slice_set(0, K_PRIO_PREEMPT(0));

	k_thread_priority_set(k_current_get(), old_prio);
#else
	ztest_test_skip();
#endif /* CONFIG_TIMESLICING */
}

/**
 * @brief Verify a per-thread time slice expires and invokes its callback.
 *
 * @details
 * With CONFIG_TIMESLICE_PER_THREAD, a thread's individual time slice
 * (k_thread_time_slice_set()) must expire after the configured number of ticks
 * and invoke the registered expiry callback, which here suspends the thread.
 * Requires CONFIG_TIMESLICING and CONFIG_TIMESLICE_PER_THREAD; otherwise the
 * test skips.
 *
 * Test steps:
 * - Create a busy-looping thread and set a per-thread slice with a callback.
 * - Tick-align and start the thread.
 * - Wait for the callback (which suspends the thread) and confirm it stopped.
 *
 * Expected result:
 * - The per-thread slice expires, the callback runs, and the thread is suspended.
 *
 * @ingroup tests_kernel_sched
 *
 * @see k_thread_time_slice_set()
 */
ZTEST(threads_scheduling, test_slice_perthread)
{
#ifdef CONFIG_TIMESLICING
	if (!IS_ENABLED(CONFIG_TIMESLICE_PER_THREAD)) {
		ztest_test_skip();
		return;
	}

	/* Create the thread but don't start it */
	k_thread_create(&t[0], tstacks[0], STACK_SIZE,
			slice_perthread_fn, NULL, NULL, NULL,
			1, 0, K_FOREVER);
	k_thread_time_slice_set(&t[0], PERTHREAD_SLICE_TICKS, slice_expired, &t[0]);

	/* Tick align, set up, then start */
	k_usleep(1);
	last_cyc = k_cycle_get_32();
	k_thread_start(&t[0]);

	k_sem_take(&perthread_sem, K_FOREVER);
	zassert_false(perthread_running, "thread failed to suspend");
#else
	ztest_test_skip();
#endif /* CONFIG_TIMESLICING */
}
```
