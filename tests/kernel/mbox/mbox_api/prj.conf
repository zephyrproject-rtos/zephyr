## CMakeLists.txt
```
# SPDX-License-Identifier: Apache-2.0

cmake_minimum_required(VERSION 3.28.0)
find_package(Zephyr REQUIRED HINTS $ENV{ZEPHYR_BASE})
project(mbox_api)

FILE(GLOB app_sources src/*.c)
target_sources(app PRIVATE ${app_sources})
```

## prj.conf
```kconfig
CONFIG_ZTEST=y
CONFIG_NUM_MBOX_ASYNC_MSGS=5

CONFIG_MP_MAX_NUM_CPUS=1
```

## boards/qemu_rx_r5f562n8.conf
```kconfig
# Copyright (c) 2024 Tibor Kiss
# SPDX-License-Identifier: Apache-2.0

CONFIG_TEST_EXTRA_STACK_SIZE=128
```

## boards/qemu_x86_lakemont.conf
```kconfig
# Copyright (c) 2022 Intel Corporation
# SPDX-License-Identifier: Apache-2.0

# Need a little bit more stack space
# after moving to new ztest API
CONFIG_TEST_EXTRA_STACK_SIZE=64
```

## boards/qemu_x86_tiny.conf
```kconfig
# Copyright (c) 2021 Intel Corporation
# SPDX-License-Identifier: Apache-2.0

# Need a little bit more stack space
CONFIG_TEST_EXTRA_STACK_SIZE=256
```

## boards/qemu_x86_tiny_ia32_768.conf
```kconfig
# Copyright (c) 2022 Intel Corporation
# SPDX-License-Identifier: Apache-2.0

# Need quite some space for coverage.
CONFIG_TEST_EXTRA_STACK_SIZE=1024
```

## src/main.c
```c
/*
 * Copyright (c) 2016 Intel Corporation
 *
 * SPDX-License-Identifier: Apache-2.0
 */

#include <zephyr/ztest.h>
extern void test_mbox_kinit(void);
extern void test_mbox_kdefine(void);
extern void test_enhance_capability(void);
extern void test_define_multi_mbox(void);
extern void test_mbox_put_get_null(void);
extern void test_mbox_put_get_buffer(void);
extern void test_mbox_async_put_get_buffer(void);
extern void test_mbox_async_put_get_block(void);
extern void test_mbox_target_source_thread_buffer(void);
extern void test_mbox_target_source_thread_block(void);
extern void test_mbox_incorrect_receiver_tid(void);
extern void test_mbox_incorrect_transmit_tid(void);
extern void test_mbox_timed_out_mbox_get(void);
extern void test_mbox_block_get_invalid_pool(void);
extern void test_mbox_msg_tid_mismatch(void);
extern void test_mbox_block_get_buff_to_pool(void);
extern void test_mbox_block_get_buff_to_smaller_pool(void);
extern void test_mbox_dispose_size_0_msg(void);
extern void test_mbox_clean_up_tx_pool(void);
extern void test_mbox_async_put_to_waiting_get(void);
extern void test_mbox_get_waiting_put_incorrect_tid(void);
extern void test_mbox_async_multiple_put(void);
extern void test_mbox_multiple_waiting_get(void);
extern void test_mbox_data_get_null(void);
extern void test_mbox_get_put_block_data(void);

/*test case main entry*/
void test_main(void)
{
	ztest_test_suite(mbox_api,
			 ztest_unit_test(test_mbox_kinit),/*keep init first!*/
			 ztest_unit_test(test_mbox_kdefine),
			 ztest_unit_test(test_enhance_capability),
			 ztest_unit_test(test_define_multi_mbox),
			 ztest_unit_test(test_mbox_put_get_null),
			 ztest_unit_test(test_mbox_put_get_buffer),
			 ztest_unit_test(test_mbox_async_put_get_buffer),
			 ztest_unit_test(test_mbox_target_source_thread_buffer),
			 ztest_unit_test(test_mbox_incorrect_receiver_tid),
			 ztest_unit_test(test_mbox_incorrect_transmit_tid),
			 ztest_unit_test(test_mbox_timed_out_mbox_get),
			 ztest_unit_test(test_mbox_msg_tid_mismatch),
			 ztest_unit_test(test_mbox_dispose_size_0_msg),
			 ztest_unit_test(test_mbox_async_put_to_waiting_get),
			 ztest_unit_test(
				test_mbox_get_waiting_put_incorrect_tid),
			 ztest_unit_test(test_mbox_async_multiple_put),
			 ztest_unit_test(test_mbox_data_get_null),
			 ztest_unit_test(test_mbox_get_put_block_data),
			 ztest_unit_test(test_mbox_multiple_waiting_get)
);
	ztest_run_test_suite(mbox_api);
}
```
