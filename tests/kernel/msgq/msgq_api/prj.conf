## CMakeLists.txt
```
# SPDX-License-Identifier: Apache-2.0

cmake_minimum_required(VERSION 3.28.0)
find_package(Zephyr REQUIRED HINTS $ENV{ZEPHYR_BASE})
project(msgq_api)

FILE(GLOB app_sources src/*.c)
target_sources(app PRIVATE ${app_sources})
```

## Kconfig
```
# Copyright (c) 2024
# SPDX-License-Identifier: Apache-2.0

config TEST_MSGQ_PUT_FRONT
	bool "Test message queue put front feature"

# Include Zephyr's Kconfig.
source "Kconfig"
```

## prj.conf
```kconfig
CONFIG_ZTEST=y
CONFIG_ZTEST_NEW_API=y
CONFIG_IRQ_OFFLOAD=y
CONFIG_TEST_USERSPACE=y
```

## src/main.c
```c
/*
 * Copyright (c) 2016 Intel Corporation
 *
 * SPDX-License-Identifier: Apache-2.0
 */

/**
 * @brief Message queue tests
 * @defgroup tests_kernel_msgq Message queue tests
 * @ingroup all_tests
 * @{
 * @}
 */

#include <zephyr/ztest.h>

#include "test_msgq.h"

#ifdef CONFIG_64BIT
#define MAX_SZ	256
#else
#define MAX_SZ	128
#endif

K_HEAP_DEFINE(test_pool, MAX_SZ * 2);

extern struct k_msgq kmsgq;
extern struct k_msgq msgq;
extern struct k_sem end_sema;
extern struct k_thread tdata;
extern k_tid_t tids[2];
K_THREAD_STACK_DECLARE(tstack, STACK_SIZE);

void *msgq_api_setup(void)
{
	k_thread_access_grant(k_current_get(), &kmsgq, &msgq, &end_sema,
			      &tdata, &tstack);
	k_thread_heap_assign(k_current_get(), &test_pool);
	return NULL;
}

static void test_end_threads_join(void)
{
	for (int i = 0; i < ARRAY_SIZE(tids); i++) {
		if (tids[i] != NULL) {
			k_thread_join(tids[i], K_FOREVER);
			tids[i] = NULL;
		}
	}
}

static void msgq_api_test_after(void *data)
{
	test_end_threads_join();
}

static void msgq_api_test_1cpu_after(void *data)
{
	test_end_threads_join();

	ztest_simple_1cpu_after(data);
}

ZTEST_SUITE(msgq_api, NULL, msgq_api_setup, NULL, msgq_api_test_after, NULL);
ZTEST_SUITE(msgq_api_1cpu, NULL, msgq_api_setup,
	    ztest_simple_1cpu_before, msgq_api_test_1cpu_after, NULL);
```

## src/test_msgq.h
```c
/*
 * Copyright (c) 2015-2016 Intel Corporation.
 *
 * SPDX-License-Identifier: Apache-2.0
 */

#ifndef __TEST_MSGQ_H__
#define __TEST_MSGQ_H__

#include <zephyr/kernel.h>
#include <zephyr/irq_offload.h>
#include <zephyr/ztest.h>
#include <limits.h>

#define TIMEOUT_MS 100
#define TIMEOUT K_MSEC(TIMEOUT_MS)
#define STACK_SIZE (512 + CONFIG_TEST_EXTRA_STACK_SIZE)
#define MSG_SIZE 4
#define MSGQ_LEN 2
#define MSG0 0xABCD
#define MSG1 0x1234
#define OVERFLOW_SIZE_MSG SIZE_MAX
#endif /* __TEST_MSGQ_H__ */
```

## src/test_msgq_attrs.c
```c
/*
 * Copyright (c) 2018 Intel Corporation
 *
 * SPDX-License-Identifier: Apache-2.0
 */

#include "test_msgq.h"
extern struct k_msgq msgq;
static ZTEST_BMEM char __aligned(4) tbuffer[MSG_SIZE * MSGQ_LEN];
static ZTEST_DMEM uint32_t send_buf[MSGQ_LEN] = { MSG0, MSG1 };
static ZTEST_DMEM uint32_t rec_buf[MSGQ_LEN] = { MSG0, MSG1 };

static void attrs_get(struct k_msgq *q)
{
	int ret;
	struct k_msgq_attrs attrs;

	k_msgq_get_attrs(q, &attrs);
	zassert_equal(attrs.used_msgs, 0);

	/*fill the queue to full*/
	for (int i = 0; i < MSGQ_LEN; i++) {
		ret = k_msgq_put(q, (void *)&send_buf[i], K_NO_WAIT);
		zassert_equal(ret, 0);
	}

	k_msgq_get_attrs(q, &attrs);
	zassert_equal(attrs.used_msgs, MSGQ_LEN);

	for (int i = 0; i < MSGQ_LEN; i++) {
		ret = k_msgq_get(q, (void *)&rec_buf[i], K_NO_WAIT);
		zassert_equal(ret, 0);
	}

	k_msgq_get_attrs(q, &attrs);
	zassert_equal(attrs.used_msgs, 0);
}

/**
 * @addtogroup tests_kernel_msgq
 * @{
 */

/**
 * @brief Verify k_msgq_get_attrs() reports the used-message count.
 *
 * @details
 * k_msgq_get_attrs() must reflect the live occupancy of the queue. The test
 * reads the attributes when empty, after filling the queue to capacity, and
 * again after draining it, confirming used_msgs tracks each transition.
 *
 * Test steps:
 * - Get attributes of an empty queue and verify used_msgs is 0.
 * - Fill the queue and verify used_msgs equals the queue length.
 * - Drain the queue and verify used_msgs is 0 again.
 *
 * Expected result:
 * - used_msgs reports 0, full, then 0 as messages are added and removed.
 *
 * @see k_msgq_get_attrs()
 * @verifies ZEP-SRS-31-15
 * @verifies ZEP-SRS-31-16
 * @verifies ZEP-SRS-31-21
 */
ZTEST(msgq_api, test_msgq_attrs_get)
{
	k_msgq_init(&msgq, tbuffer, MSG_SIZE, MSGQ_LEN);
	attrs_get(&msgq);
}

#ifdef CONFIG_USERSPACE

/**
 * @brief Verify k_msgq_get_attrs() from user mode on an allocated queue.
 *
 * @details
 * Same used-message accounting as test_msgq_attrs_get(), but exercised from a
 * user-mode thread on a queue created with k_msgq_alloc_init(), confirming the
 * attribute query works under userspace with a dynamically allocated queue.
 *
 * Test steps:
 * - Allocate and alloc-init a message queue as a user thread.
 * - Verify used_msgs is 0, then full, then 0 across fill/drain.
 *
 * Expected result:
 * - used_msgs is reported correctly from user mode.
 *
 * @see k_msgq_get_attrs()
 * @see k_msgq_alloc_init()
 * @verifies ZEP-SRS-31-15
 * @verifies ZEP-SRS-31-16
 * @verifies ZEP-SRS-31-21
 */
ZTEST_USER(msgq_api, test_msgq_user_attrs_get)
{
	struct k_msgq *q;

	q = k_object_alloc(K_OBJ_MSGQ);
	zassert_not_null(q, "couldn't alloc message queue");
	zassert_false(k_msgq_alloc_init(q, MSG_SIZE, MSGQ_LEN));
	attrs_get(q);
}
#endif

/**
 * @}
 */
```

## src/test_msgq_define.c
```c
/*
 * Copyright (c) 2026 Cesar Vandevelde
 *
 * SPDX-License-Identifier: Apache-2.0
 */

#include <zephyr/kernel.h>

#include "test_msgq.h"

struct typed_msgq_msg {
	uint8_t num1;
	uint64_t num2;
};

K_MSGQ_DEFINE(kmsgq_public, MSG_SIZE, MSGQ_LEN, 4);
K_MSGQ_DEFINE_STATIC(kmsgq_static, MSG_SIZE, MSGQ_LEN, 4);
K_MSGQ_DEFINE_TYPE(kmsgq_type, struct typed_msgq_msg, MSGQ_LEN);
K_MSGQ_DEFINE_STATIC_TYPE(kmsgq_static_type, struct typed_msgq_msg, MSGQ_LEN);

/**
 * @brief Test public-scope message queue defined at compile time
 *
 * @details
 * - Verify that the free count is equal to the queue length.
 * - Verify that the used count equals 0.
 * - Verify that the message size is correct.
 *
 * @see K_MSGQ_DEFINE()
 */
ZTEST(msgq_api, test_define_public)
{
	zassert_equal(k_msgq_num_free_get(&kmsgq_public), MSGQ_LEN);
	zassert_equal(k_msgq_num_used_get(&kmsgq_public), 0);
	zassert_equal(kmsgq_public.msg_size, MSG_SIZE);
}

/**
 * @brief Test static-scope message queue defined at compile time
 *
 * @details
 * - Verify that the free count is equal to the queue length.
 * - Verify that the used count equals 0.
 * - Verify that the message size is correct.
 *
 * @see K_MSGQ_DEFINE_STATIC()
 */
ZTEST(msgq_api, test_define_static)
{
	zassert_equal(k_msgq_num_free_get(&kmsgq_static), MSGQ_LEN);
	zassert_equal(k_msgq_num_used_get(&kmsgq_static), 0);
	zassert_equal(kmsgq_static.msg_size, MSG_SIZE);
}

/**
 * @brief Test public-scope, typed message queue defined at compile time
 *
 * @details
 * - Verify that the free count is equal to the queue length.
 * - Verify that the used count equals 0.
 * - Verify that the message size is correct.
 *
 * @see K_MSGQ_DEFINE_TYPE()
 */
ZTEST(msgq_api, test_define_type)
{
	zassert_equal(k_msgq_num_free_get(&kmsgq_type), MSGQ_LEN);
	zassert_equal(k_msgq_num_used_get(&kmsgq_type), 0);
	zassert_equal(kmsgq_type.msg_size, sizeof(struct typed_msgq_msg));
}

/**
 * @brief Test static-scope, typed message queue defined at compile time
 *
 * @details
 * - Verify that the free count is equal to the queue length.
 * - Verify that the used count equals 0.
 * - Verify that the message size is correct.
 *
 * @see K_MSGQ_DEFINE_STATIC_TYPE()
 */
ZTEST(msgq_api, test_define_static_type)
{
	zassert_equal(k_msgq_num_free_get(&kmsgq_static_type), MSGQ_LEN);
	zassert_equal(k_msgq_num_used_get(&kmsgq_static_type), 0);
	zassert_equal(kmsgq_static_type.msg_size, sizeof(struct typed_msgq_msg));
}
```

## src/test_msgq_fail.c
```c
/*
 * Copyright (c) 2016 Intel Corporation
 *
 * SPDX-License-Identifier: Apache-2.0
 */
#include "test_msgq.h"

static ZTEST_BMEM char __aligned(4) tbuffer[MSG_SIZE * MSGQ_LEN];
static ZTEST_DMEM uint32_t data[MSGQ_LEN] = { MSG0, MSG1 };
extern struct k_msgq msgq;

static void put_fail(struct k_msgq *q)
{
	int ret = k_msgq_put(q, (void *)&data[0], K_NO_WAIT);

	zassert_false(ret);
	ret = k_msgq_put(q, (void *)&data[0], K_NO_WAIT);
	zassert_false(ret);
	/**TESTPOINT: msgq put returns -ENOMSG*/
	ret = k_msgq_put(q, (void *)&data[1], K_NO_WAIT);
	zassert_equal(ret, -ENOMSG);
	/**TESTPOINT: msgq put returns -EAGAIN*/
	ret = k_msgq_put(q, (void *)&data[0], TIMEOUT);
	zassert_equal(ret, -EAGAIN);

	k_msgq_purge(q);
}

static void get_fail(struct k_msgq *q)
{
	uint32_t rx_data;

	/**TESTPOINT: msgq get returns -ENOMSG*/
	int ret = k_msgq_get(q, &rx_data, K_NO_WAIT);

	zassert_equal(ret, -ENOMSG);
	/**TESTPOINT: msgq get returns -EAGAIN*/
	ret = k_msgq_get(q, &rx_data, TIMEOUT);
	zassert_equal(ret, -EAGAIN);
}

/**
 * @addtogroup tests_kernel_msgq
 * @{
 */

/**
 * @brief Verify k_msgq_put() error codes when the queue is full.
 *
 * @details
 * Once a queue is full, a non-blocking put must return -ENOMSG and a put with a
 * finite timeout must return -EAGAIN after the timeout elapses.
 *
 * Test steps:
 * - Fill the queue, then put with K_NO_WAIT and expect -ENOMSG.
 * - Put with a finite timeout and expect -EAGAIN.
 *
 * Expected result:
 * - k_msgq_put() returns -ENOMSG (no wait) and -EAGAIN (timeout) when full.
 *
 * @see k_msgq_put()
 * @verifies ZEP-SRS-31-7
 */
ZTEST(msgq_api_1cpu, test_msgq_put_fail)
{
	k_msgq_init(&msgq, tbuffer, MSG_SIZE, MSGQ_LEN);
	put_fail(&msgq);
}

#ifdef CONFIG_USERSPACE
/**
 * @brief Verify k_msgq_put() full-queue error codes from user mode.
 *
 * @details
 * User-mode counterpart of test_msgq_put_fail() on a queue created with
 * k_msgq_alloc_init(): a full-queue put must return -ENOMSG (no wait) and
 * -EAGAIN (timeout).
 *
 * Test steps:
 * - Allocate and alloc-init a queue as a user thread and fill it.
 * - Put with K_NO_WAIT (-ENOMSG) and with a finite timeout (-EAGAIN).
 *
 * Expected result:
 * - The error codes match the supervisor case from user mode.
 *
 * @see k_msgq_put()
 * @see k_msgq_alloc_init()
 * @verifies ZEP-SRS-31-7
 */
ZTEST_USER(msgq_api, test_msgq_user_put_fail)
{
	struct k_msgq *q;

	q = k_object_alloc(K_OBJ_MSGQ);
	zassert_not_null(q, "couldn't alloc message queue");
	zassert_false(k_msgq_alloc_init(q, MSG_SIZE, MSGQ_LEN));
	put_fail(q);
}
#endif /* CONFIG_USERSPACE */

/**
 * @brief Verify k_msgq_get() error codes when the queue is empty.
 *
 * @details
 * On an empty queue, a non-blocking get must return -ENOMSG and a get with a
 * finite timeout must return -EAGAIN after the timeout elapses.
 *
 * Test steps:
 * - On an empty queue, get with K_NO_WAIT and expect -ENOMSG.
 * - Get with a finite timeout and expect -EAGAIN.
 *
 * Expected result:
 * - k_msgq_get() returns -ENOMSG (no wait) and -EAGAIN (timeout) when empty.
 *
 * @see k_msgq_get()
 * @verifies ZEP-SRS-31-11
 */
ZTEST(msgq_api_1cpu, test_msgq_get_fail)
{
	k_msgq_init(&msgq, tbuffer, MSG_SIZE, MSGQ_LEN);
	get_fail(&msgq);
}

#ifdef CONFIG_USERSPACE
/**
 * @brief Verify k_msgq_get() empty-queue error codes from user mode.
 *
 * @details
 * User-mode counterpart of test_msgq_get_fail() on a queue created with
 * k_msgq_alloc_init(): an empty-queue get must return -ENOMSG (no wait) and
 * -EAGAIN (timeout).
 *
 * Test steps:
 * - Allocate and alloc-init a queue as a user thread.
 * - Get with K_NO_WAIT (-ENOMSG) and with a finite timeout (-EAGAIN).
 *
 * Expected result:
 * - The error codes match the supervisor case from user mode.
 *
 * @see k_msgq_get()
 * @see k_msgq_alloc_init()
 * @verifies ZEP-SRS-31-11
 */
ZTEST_USER(msgq_api, test_msgq_user_get_fail)
{
	struct k_msgq *q;

	q = k_object_alloc(K_OBJ_MSGQ);
	zassert_not_null(q, "couldn't alloc message queue");
	zassert_false(k_msgq_alloc_init(q, MSG_SIZE, MSGQ_LEN));
	get_fail(q);
}
#endif /* CONFIG_USERSPACE */

/**
 * @}
 */
```

## src/test_msgq_purge.c
```c
/*
 * Copyright (c) 2016 Intel Corporation
 *
 * SPDX-License-Identifier: Apache-2.0
 */

#include "test_msgq.h"

K_THREAD_STACK_DECLARE(tstack, STACK_SIZE);
extern struct k_thread tdata;
extern k_tid_t tids[2];
extern struct k_msgq msgq;
static ZTEST_BMEM char __aligned(4) tbuffer[MSG_SIZE * MSGQ_LEN];
static ZTEST_DMEM uint32_t data[MSGQ_LEN] = { MSG0, MSG1 };

static void tThread_entry(void *p1, void *p2, void *p3)
{
	int ret = k_msgq_put((struct k_msgq *)p1, (void *)&data[0], TIMEOUT);

	zassert_equal(ret, -ENOMSG);
}

static void purge_when_put(struct k_msgq *q)
{
	int ret;

	/*fill the queue to full*/
	for (int i = 0; i < MSGQ_LEN; i++) {
		ret = k_msgq_put(q, (void *)&data[i], K_NO_WAIT);
		zassert_equal(ret, 0);
	}
	/*create another thread waiting to put msg*/
	tids[0] = k_thread_create(&tdata, tstack, STACK_SIZE,
				  tThread_entry, q, NULL, NULL,
				  K_PRIO_PREEMPT(0), K_USER | K_INHERIT_PERMS,
				  K_NO_WAIT);
	k_msleep(TIMEOUT_MS >> 1);
	/**TESTPOINT: msgq purge while another thread waiting to put msg*/
	k_msgq_purge(q);

	/*verify msg put after purge*/
	for (int i = 0; i < MSGQ_LEN; i++) {
		ret = k_msgq_put(q, (void *)&data[i], K_NO_WAIT);
		zassert_equal(ret, 0);
	}

	k_thread_abort(tids[0]);
}

/**
 * @addtogroup tests_kernel_msgq
 * @{
 */

/**
 * @brief Verify k_msgq_purge() drops messages and wakes a pending writer.
 *
 * @details
 * Purging a full queue must discard all queued messages and unblock any thread
 * waiting to put, returning -ENOMSG to that writer. After the purge the queue
 * must be usable again for new puts.
 *
 * Test steps:
 * - Fill the queue, then start a writer that blocks on a put with a timeout.
 * - Purge the queue while the writer is pending.
 * - Verify the writer's put returns -ENOMSG and the queue accepts new messages.
 *
 * Expected result:
 * - Purge empties the queue, the pending writer gets -ENOMSG, and the queue is
 *   usable afterwards.
 *
 * @see k_msgq_purge()
 * @see k_msgq_put()
 * @verifies ZEP-SRS-31-14
 * @verifies ZEP-SRS-31-19
 */
ZTEST(msgq_api_1cpu, test_msgq_purge_when_put)
{
	k_msgq_init(&msgq, tbuffer, MSG_SIZE, MSGQ_LEN);

	purge_when_put(&msgq);
}

#ifdef CONFIG_USERSPACE
/**
 * @brief Verify k_msgq_purge() with a pending writer from user mode.
 *
 * @details
 * User-mode counterpart of test_msgq_purge_when_put() on a queue created with
 * k_msgq_alloc_init(): purging while a writer pends must discard messages, wake
 * the writer with -ENOMSG, and leave the queue usable.
 *
 * Test steps:
 * - Allocate and alloc-init a queue as a user thread and fill it.
 * - Start a pending writer, purge, and verify recovery.
 *
 * Expected result:
 * - Behavior matches the supervisor case from user mode.
 *
 * @see k_msgq_purge()
 * @see k_msgq_alloc_init()
 * @verifies ZEP-SRS-31-14
 * @verifies ZEP-SRS-31-19
 */
ZTEST_USER(msgq_api, test_msgq_user_purge_when_put)
{
	struct k_msgq *q;

	q = k_object_alloc(K_OBJ_MSGQ);
	zassert_not_null(q, "couldn't alloc message queue");
	zassert_false(k_msgq_alloc_init(q, MSG_SIZE, MSGQ_LEN));

	purge_when_put(q);
}
#endif

/**
 * @}
 */
```
