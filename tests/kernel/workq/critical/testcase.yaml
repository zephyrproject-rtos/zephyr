## tests/kernel/workq/critical/testcase.yaml
```yaml
common:
  tags:
    - kernel
    - workqueue
tests:
  kernel.workqueue.critical:
    integration_platforms:
      - qemu_x86
```

## tests/kernel/workq/user_work/testcase.yaml
```yaml
tests:
  kernel.workqueue.user:
    min_flash: 34
    filter: CONFIG_ARCH_HAS_USERSPACE
    tags:
      - kernel
      - userspace
      - workqueue
```

## tests/kernel/workq/work/testcase.yaml
```yaml
tests:
  kernel.workqueue.api:
    min_flash: 34
    tags: kernel
    # hifive1 platform fails to run due to #40376, all
    # the related CI checks got blocked, so exclude it.
    # qemu_rx platform fails to run due to #92213, exclude this
    # for now until the issue is resolved.
    platform_exclude:
      - hifive1
      - qemu_rx
    timeout: 80
```

## tests/kernel/workq/work_queue/Kconfig
```kconfig
# Copyright (c) 2023 Intel Corporation
# SPDX-License-Identifier: Apache-2.0

source "Kconfig.zephyr"

config TEST_WORK_ITEM_WAIT_MS
	int "Test item working time, msec."
	default 100

config TEST_SUBMIT_WAIT_MS
	int "Test item submission interval, msec."
	default 50
```

## tests/kernel/workq/work_queue/testcase.yaml
```yaml
tests:
  kernel.workqueue:
    min_flash: 34
    tags:
      - kernel
      - workqueue
  kernel.workqueue.work_timeout:
    min_flash: 34
    tags:
      - kernel
      - workqueue
    extra_configs:
      - CONFIG_WORKQUEUE_WORK_TIMEOUT=y
```

## tests/kernel/workq/work_queue_api/testcase.yaml
```yaml
tests:
  kernel.workqueue.api:
    filter: CONFIG_KERNEL_WORK1
    min_flash: 34
    tags: kernel userspace
```

## tests/kernel/workq/work_timeout/testcase.yaml
```yaml
tests:
  kernel.workqueue.work_timeout:
    tags: kernel
    min_flash: 64
    min_ram: 32
    extra_args: CONFIG_WORKQUEUE_WORK_TIMEOUT=y
  kernel.workqueue.work_timeout.disabled:
    tags: kernel
    min_flash: 64
    min_ram: 32
```

## tests/kernel/workq/workq2/Kconfig
```kconfig
# Copyright (c) 2025 Måns Ansgariusson <mansgariusson@gmail.com>
# SPDX-License-Identifier: Apache-2.0

source "Kconfig.zephyr"

config WORKQ_TEST_ITEM_WORK_TIME
	int "Test item working time, msec."
	default 50
```

## tests/kernel/xip/testcase.yaml
```yaml
tests:
  arch.common.xip:
    filter: CONFIG_XIP
    tags:
      - kernel
      - xip
    integration_platforms:
      - qemu_arc_em
      - qemu_x86_xip
    platform_exclude:
      - qemu_riscv32_xip # See issue #62975
  arch.common.xip.minimallibc:
    filter: CONFIG_XIP and CONFIG_MINIMAL_LIBC_SUPPORTED
    tags:
      - kernel
      - xip
    integration_platforms:
      - qemu_arc_em
      - qemu_x86_xip
    platform_exclude:
      - qemu_riscv32_xip # See issue #62975
    extra_configs:
      - CONFIG_MINIMAL_LIBC=y
```

## tests/kernel/zync/testcase.yaml
```yaml
common:
    tags: kernel userspace
tests:
  kernel.zync:
    tags: kernel userspace
  kernel.zync.max_val:
    extra_configs:
      - CONFIG_ZYNC_MAX_VAL=y
  kernel.zync.recursive:
    extra_configs:
      - CONFIG_ZYNC_RECURSIVE=y
  kernel.zync.prio_boost:
    extra_configs:
      - CONFIG_ZYNC_PRIO_BOOST=y
  kernel.zync.nouser:
    extra_configs:
      - CONFIG_TEST_USERSPACE=n
      - CONFIG_ZYNC_RECURSIVE=y
      - CONFIG_ZYNC_PRIO_BOOST=y
      - CONFIG_ZYNC_MAX_VAL=y
```

## tests/lib/acpi/integration/testcase.yaml
```yaml
tests:
  acpi.basic:
    tags:
      - acpi
      - acpica
    integration_platforms:
      - qemu_x86_64/atom
    depends_on: acpi
```

## tests/lib/async/testcase.yaml
```yaml
tests:
  libraries.async:
    tags: async
    integration_platforms:
      - native_posix
```

## tests/lib/authentication/testcase.yaml
```yaml
tests:
  authentication.auth:
    tags: authentication
    filter: CONFIG_ENTROPY_HAS_DRIVER
    platform_allow: nrf52840dk_nrf52840
```

## tests/lib/c_lib/Kconfig
```kconfig
# SPDX-License-Identifier: Apache-2.0
# Copyright (c) 2022 Meta

mainmenu "Strerror test parameters"

source "Kconfig.zephyr"

config MINIMAL_LIBC_DISABLE_STRING_ERROR_TABLE
	depends on MINIMAL_LIBC
	bool
	default y if !MINIMAL_LIBC_STRING_ERROR_TABLE
	default n if MINIMAL_LIBC_STRING_ERROR_TABLE
	help
	  This option is only here to simplify conditional expressions
	  in test_strerror.c rather than inverting logic for the
	  global MINIMAL_LIBC_STRING_ERROR_TABLE option.

config TEST_LIBC_CLOCK_MAX_ERROR_PCT
	int "Maximum tolerance (%) for CLOCKS_PER_SEC"
	default 1

config TEST_LIBC_CLOCK_MAX_ERROR_PPM
	int "Maximum tolerance (parts-per-million) for CLOCKS_PER_SEC"
	default 20000
```

## tests/lib/c_lib/common/testcase.yaml
```yaml
common:
  tags:
    - clib
  ignore_faults: true
  integration_platforms:
    - mps2/an385
tests:
  libraries.libc.common: {}
  libraries.libc.common.minimal:
    filter: CONFIG_MINIMAL_LIBC_SUPPORTED
    tags: minimal_libc
    extra_configs:
      - CONFIG_MINIMAL_LIBC=y
      - CONFIG_MINIMAL_LIBC_NON_REENTRANT_FUNCTIONS=y
      - CONFIG_MINIMAL_LIBC_RAND=y
  libraries.libc.common.newlib:
    filter: CONFIG_NEWLIB_LIBC_SUPPORTED
    min_ram: 32
    tags: newlib
    extra_configs:
      - CONFIG_NEWLIB_LIBC=y
  libraries.libc.common.newlib_nano:
    filter: CONFIG_NEWLIB_LIBC_SUPPORTED and CONFIG_HAS_NEWLIB_LIBC_NANO
    tags: newlib
    extra_configs:
      - CONFIG_NEWLIB_LIBC=y
      - CONFIG_NEWLIB_LIBC_NANO=y
  libraries.libc.common.picolibc:
    filter: CONFIG_PICOLIBC_SUPPORTED
    tags: picolibc
    extra_configs:
      - CONFIG_PICOLIBC=y
  libraries.libc.common.picolibc.module:
    filter: CONFIG_ZEPHYR_PICOLIBC_MODULE
    tags: picolibc
    extra_configs:
      - CONFIG_PICOLIBC=y
      - CONFIG_PICOLIBC_USE_MODULE=y
  libraries.libc.common.picolibc.notls:
    filter: CONFIG_ZEPHYR_PICOLIBC_MODULE
    tags: picolibc
    extra_configs:
      - CONFIG_PICOLIBC=y
      - CONFIG_PICOLIBC_USE_MODULE=y
      - CONFIG_THREAD_LOCAL_STORAGE=n
```

## tests/lib/c_lib/mallinfo/testcase.yaml
```yaml
common:
  tags:
    - clib
  integration_platforms:
    - qemu_riscv64
tests:
  libraries.libc.mallinfo.minimal:
    filter: CONFIG_MINIMAL_LIBC_SUPPORTED
    tags: minimal_libc
    extra_configs:
      - CONFIG_MINIMAL_LIBC=y
  libraries.libc.mallinfo.picolibc:
    filter: CONFIG_PICOLIBC_SUPPORTED
    tags: picolibc
    ignore_faults: true
    extra_configs:
      - CONFIG_PICOLIBC=y
  libraries.libc.mallinfo.picolibc.module:
    filter: CONFIG_ZEPHYR_PICOLIBC_MODULE
    tags: picolibc
    ignore_faults: true
    extra_configs:
      - CONFIG_PICOLIBC=y
      - CONFIG_PICOLIBC_USE_MODULE=y
  libraries.libc.mallinfo.picolibc.notls:
    filter: CONFIG_ZEPHYR_PICOLIBC_MODULE
    tags: picolibc
    ignore_faults: true
    extra_configs:
      - CONFIG_PICOLIBC=y
      - CONFIG_PICOLIBC_USE_MODULE=y
      - CONFIG_THREAD_LOCAL_STORAGE=n

# CONFIG_NEWLIB_LIBC not supported at this time
```

## tests/lib/c_lib/stdio/testcase.yaml
```yaml
common:
  tags:
    - clib
  min_ram: 128
  filter: not CONFIG_NATIVE_LIBC
tests:
  libraries.libc.common.stdio.minimal:
    tags: minimal_libc
    filter: CONFIG_MINIMAL_LIBC_SUPPORTED
    extra_configs:
      - CONFIG_MINIMAL_LIBC=y
  libraries.libc.common.stdio.picolibc:
    tags: picolibc
    filter: CONFIG_PICOLIBC_SUPPORTED
    extra_configs:
      - CONFIG_PICOLIBC=y
  libraries.libc.common.stdio.newlib:
    tags: newlib
    filter: TOOLCHAIN_HAS_NEWLIB == 1
    extra_configs:
      - CONFIG_NEWLIB_LIBC=y
```

## tests/lib/c_lib/strerror/testcase.yaml
```yaml
common:
  tags:
    - clib
  integration_platforms:
    - qemu_x86
tests:
  libraries.libc.strerror.minimal.strerror_table:
    filter: CONFIG_MINIMAL_LIBC_SUPPORTED
    tags: minimal_libc
    extra_configs:
      - CONFIG_MINIMAL_LIBC=y
      - CONFIG_MINIMAL_LIBC_STRING_ERROR_TABLE=y
      - CONFIG_MINIMAL_LIBC_NON_REENTRANT_FUNCTIONS=y
  libraries.libc.strerror.minimal.no_strerror_table:
    filter: CONFIG_MINIMAL_LIBC_SUPPORTED
    tags: minimal_libc
    extra_configs:
      - CONFIG_MINIMAL_LIBC=y
      - CONFIG_MINIMAL_LIBC_STRING_ERROR_TABLE=n
      - CONFIG_MINIMAL_LIBC_NON_REENTRANT_FUNCTIONS=y
  libraries.libc.strerror.newlib:
    filter: CONFIG_NEWLIB_LIBC_SUPPORTED
    min_ram: 32
    tags: newlib
    ignore_faults: true
    extra_configs:
      - CONFIG_NEWLIB_LIBC=y
  libraries.libc.strerror.newlib_nano:
    filter: CONFIG_NEWLIB_LIBC_SUPPORTED and CONFIG_HAS_NEWLIB_LIBC_NANO
    tags: newlib
    ignore_faults: true
    extra_configs:
      - CONFIG_NEWLIB_LIBC=y
      - CONFIG_NEWLIB_LIBC_NANO=y
  libraries.libc.strerror.picolibc:
    filter: CONFIG_PICOLIBC_SUPPORTED
    tags: picolibc
    ignore_faults: true
    extra_configs:
      - CONFIG_PICOLIBC=y
  libraries.libc.strerror.picolibc.module:
    filter: CONFIG_ZEPHYR_PICOLIBC_MODULE
    tags: picolibc
    ignore_faults: true
    extra_configs:
      - CONFIG_PICOLIBC=y
      - CONFIG_PICOLIBC_USE_MODULE=y
  libraries.libc.strerror.picolibc.notls:
    filter: CONFIG_ZEPHYR_PICOLIBC_MODULE
    tags: picolibc
    ignore_faults: true
    extra_configs:
      - CONFIG_PICOLIBC=y
      - CONFIG_PICOLIBC_USE_MODULE=y
      - CONFIG_THREAD_LOCAL_STORAGE=n
```

## tests/lib/c_lib/strtoll/testcase.yaml
```yaml
common:
  tags:
  - clib
  - strtoll
tests:
  libraries.libc.strtoll:
    filter: CONFIG_LIBC_STRTO_SUPPORTED
    tags: libc_strto
    extra_configs:
      - CONFIG_LIBC_STRTO=y
```

## tests/lib/c_lib/testcase.yaml
```yaml
common:
  tags:
    - clib
  filter: not CONFIG_NATIVE_APPLICATION
  integration_platforms:
    - mps2_an385
tests:
  libraries.libc:
    ignore_faults: true
    filter: not (CONFIG_ARCH_POSIX and CONFIG_EXTERNAL_LIBC)
  libraries.libc.picolibc:
    filter: CONFIG_PICOLIBC_SUPPORTED
    tags: picolibc
    ignore_faults: true
    extra_configs:
      - CONFIG_PICOLIBC=y
  libraries.libc.newlib:
    filter: CONFIG_NEWLIB_LIBC_SUPPORTED
    min_ram: 32
    tags: newlib
    ignore_faults: true
    extra_configs:
      - CONFIG_NEWLIB_LIBC=y
  libraries.libc.newlib_nano:
    filter: CONFIG_NEWLIB_LIBC_SUPPORTED and CONFIG_HAS_NEWLIB_LIBC_NANO
    tags: newlib
    ignore_faults: true
    extra_configs:
      - CONFIG_NEWLIB_LIBC=y
      - CONFIG_NEWLIB_LIBC_NANO=y
  libraries.libc.minimal.strerror_table:
    tags: minimal_libc
    extra_configs:
      - CONFIG_MINIMAL_LIBC=y
      - CONFIG_MINIMAL_LIBC_STRING_ERROR_TABLE=y
  libraries.libc.minimal.no_strerror_table:
    tags: minimal_libc
    extra_configs:
      - CONFIG_MINIMAL_LIBC=y
      - CONFIG_MINIMAL_LIBC_STRING_ERROR_TABLE=n
```

## tests/lib/c_lib/thrd/testcase.yaml
```yaml
common:
  tags:
    - clib
    - c11
    - threads
    # For now, the implementation of C11 threads uses POSIX under the hood.
    - posix
  # 1 tier0 platform per supported architecture
  platform_key:
    - arch
    - simulation
  filter: not CONFIG_NATIVE_APPLICATION
tests:
  libraries.libc.c11_threads.minimal:
    tags: minimal_libc
    filter: CONFIG_MINIMAL_LIBC_SUPPORTED
    extra_configs:
      - CONFIG_MINIMAL_LIBC=y
      - CONFIG_MINIMAL_LIBC_NON_REENTRANT_FUNCTIONS=y
      - CONFIG_MINIMAL_LIBC_RAND=y
  libraries.libc.c11_threads.picolibc:
    filter: CONFIG_PICOLIBC_SUPPORTED
    tags: picolibc
    extra_configs:
      - CONFIG_PICOLIBC=y
  libraries.libc.c11_threads.picolibc.module:
    filter: CONFIG_ZEPHYR_PICOLIBC_MODULE
    tags: picolibc
    extra_configs:
      - CONFIG_PICOLIBC=y
      - CONFIG_PICOLIBC_USE_MODULE=y
      - CONFIG_THREAD_LOCAL_STORAGE=y
  libraries.libc.c11_threads.picolibc.notls:
    filter: CONFIG_ZEPHYR_PICOLIBC_MODULE
    tags: picolibc
    extra_configs:
      - CONFIG_PICOLIBC=y
      - CONFIG_PICOLIBC_USE_MODULE=y
      - CONFIG_THREAD_LOCAL_STORAGE=n
  libraries.libc.c11_threads.newlib:
    filter: CONFIG_NEWLIB_LIBC_SUPPORTED
    arch_exclude:
      - posix
    min_ram: 32
    tags: newlib
    extra_configs:
      - CONFIG_NEWLIB_LIBC=y
  libraries.libc.c11_threads.newlib_nano:
    filter: CONFIG_NEWLIB_LIBC_SUPPORTED and CONFIG_HAS_NEWLIB_LIBC_NANO
    tags: newlib
    extra_configs:
      - CONFIG_NEWLIB_LIBC=y
      - CONFIG_NEWLIB_LIBC_NANO=y
```
