## tests/kernel/workq/sysworkq_stack_aggregation/Kconfig
```kconfig
# Copyright (c) 2026 Priyanshu Singh <singhpriyanshu9838@gmail.com>
# SPDX-License-Identifier: Apache-2.0

mainmenu "System Workqueue Stack Size Aggregation Test"

source "Kconfig.zephyr"

config TEST_SYSWORKQ_MIN_2048
	bool "Enable dummy 2048-byte subsystem requirement"
	default y

config SYSTEM_WORKQUEUE_MIN_STACK_SIZE_TEST_A
	int
	default 2048 if TEST_SYSWORKQ_MIN_2048

config TEST_ENABLE_SUBSYS_B
	bool "Enable dummy 3072-byte subsystem requirement"
	default n

config SYSTEM_WORKQUEUE_MIN_STACK_SIZE_TEST_B
	int
	default 3072 if TEST_ENABLE_SUBSYS_B

config TEST_EXPECT_USER_CONFIGURED
	bool "Expect user-configured workqueue stack size detection"

config TEST_EXPECTED_STACK_SIZE
	int "Expected compiled system workqueue stack size"
	default 2048
```

## tests/net/lib/tailscale/client/dns/Kconfig
```kconfig
# SPDX-FileCopyrightText: FoBE Studio
# SPDX-License-Identifier: Apache-2.0

source "Kconfig.zephyr"

config TEST_TAILSCALE_CLIENT_DNS
	def_bool y
	select TAILSCALE_DNS_RESOLVER
```

## tests/net/lib/tailscale/client/ingress/Kconfig
```kconfig
# SPDX-FileCopyrightText: FoBE Studio
# SPDX-License-Identifier: Apache-2.0

source "Kconfig.zephyr"

config TEST_TAILSCALE_CLIENT_INGRESS
	def_bool y
	select TAILSCALE_CLIENT_INGRESS
```

## tests/subsys/fs/path_resolve/testcase.yaml
```yaml
tests:
  filesystem.path_resolve:
    tags: filesystem
    integration_platforms:
      - native_sim
```

## tests/subsys/ipc/ipc_service_api/boards/ek_ra8p1_r7ka8p1kflcac_cm85_static_vrings.conf
```kconfig
CONFIG_SOC_RA_ENABLE_START_SECOND_CORE=y
CONFIG_HEAP_MEM_POOL_SIZE=4096
CONFIG_OPENAMP=y
CONFIG_OPENAMP_SLAVE=n
CONFIG_IPC_SERVICE_BACKEND_RPMSG_SHMEM_RESET=y
```

## tests/subsys/llext/Kconfig
```kconfig
# SPDX-License-Identifier: Apache-2.0
# Copyright (c) 2025 Intel Corporation.

mainmenu "LLEXT tests"

config MP_MAX_NUM_CPUS
	default 1 if LLEXT_READONLY_1CPU

source "Kconfig.zephyr"

config LLEXT_INC_IN_TEXT
	bool "Put extension .inc array in .text instead of .data"
	help
	  Put the llext extension .inc arrays from the LLEXT subsys tests
	  in .text instead of .data by default. This is useful for when the
	  memory region the linker places .data in by default is not suitable
	  for execution.

config LLEXT_READONLY_1CPU
	bool
	default y if !LLEXT_STORAGE_WRITABLE && \
		     (SOC_SERIES_INTEL_ADSP_ACE20 || \
		      SOC_SERIES_INTEL_ADSP_ACE30 || \
		      SOC_SERIES_INTEL_ADSP_ACE40)
	select LLEXT_CUSTOM_HEAP_PLACEMENT
	help
	  Automatically enabled on Intel ADSP ACE when the ELF storage is not
	  writable, i.e. for the readonly and readonly_mpu tests. In that case
	  the extension code is copied to the LLEXT heap and executed from
	  there. Windowed call return addresses only keep the low 30 bits, so
	  the heap must be placed in the cached region, in the same 1GB region
	  as .text. That region is not coherent across cores, so these tests
	  are restricted to a single CPU.
```
