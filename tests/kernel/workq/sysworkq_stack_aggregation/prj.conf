## CMakeLists.txt
```
# Copyright (c) 2026 Priyanshu Singh <singhpriyanshu9838@gmail.com>
# SPDX-License-Identifier: Apache-2.0

cmake_minimum_required(VERSION 3.20.0)

find_package(Zephyr REQUIRED HINTS $ENV{ZEPHYR_BASE})
project(sysworkq_stack_aggregation)

if(DEFINED EXPECT_USER_VALUE_RAISED)
  get_property(is_user_val_raised GLOBAL PROPERTY SYSTEM_WORKQUEUE_STACK_SIZE_USER_VALUE_RAISED)
  if(EXPECT_USER_VALUE_RAISED AND NOT is_user_val_raised)
    message(FATAL_ERROR "Expected SYSTEM_WORKQUEUE_STACK_SIZE_USER_VALUE_RAISED to be TRUE, but was FALSE")
  elseif(NOT EXPECT_USER_VALUE_RAISED AND is_user_val_raised)
    message(FATAL_ERROR "Expected SYSTEM_WORKQUEUE_STACK_SIZE_USER_VALUE_RAISED to be FALSE, but was TRUE")
  endif()
endif()

target_sources(app PRIVATE src/main.c)
```

## Kconfig
```
# Copyright (c) 2026 Priyanshu Singh <singhpriyanshu9838@gmail.com>
# SPDX-License-Identifier: Apache-2.0

mainmenu "System Workqueue Stack Size Aggregation Test"

source "Kconfig.zephyr"

config TEST_SYSWORKQ_MIN_2048
	bool "Enable dummy 2048-byte subsystem requirement"
	default y

config SYSTEM_WORKQUEUE_MIN_STACK_SIZE_TEST_A
	int
	default 2048 if TEST_SYSWORKQ_MIN_2048

config TEST_ENABLE_SUBSYS_B
	bool "Enable dummy 3072-byte subsystem requirement"
	default n

config SYSTEM_WORKQUEUE_MIN_STACK_SIZE_TEST_B
	int
	default 3072 if TEST_ENABLE_SUBSYS_B

config TEST_EXPECTED_STACK_SIZE
	int "Expected compiled system workqueue stack size"
	default 2048
```

## prj.conf
```kconfig
CONFIG_ZTEST=y
CONFIG_TEST_SYSWORKQ_MIN_2048=y
CONFIG_THREAD_STACK_INFO=y

# Commented-out settings must not trigger user-configured stack warning:
# CONFIG_SYSTEM_WORKQUEUE_STACK_SIZE=1024
# CONFIG_SYSTEM_WORKQUEUE_STACK_SIZE is not set
```

## src/main.c
```c
/*
 * Copyright (c) 2026 Priyanshu Singh <singhpriyanshu9838@gmail.com>
 *
 * SPDX-License-Identifier: Apache-2.0
 */

#include <zephyr/ztest.h>
#include <zephyr/kernel.h>

static struct k_work test_work;
static K_SEM_DEFINE(work_done_sem, 0, 1);

static void test_work_handler(struct k_work *work)
{
	ARG_UNUSED(work);
	k_sem_give(&work_done_sem);
}

ZTEST(sysworkq_stack_aggregation, test_stack_size)
{
	k_tid_t tid = k_work_queue_thread_get(&k_sys_work_q);

	zassert_not_null(tid, "System workqueue thread ID must not be NULL");

#if defined(CONFIG_THREAD_STACK_INFO)
	size_t stack_size = tid->stack_info.size;

#if defined(CONFIG_TEST_EXPECTED_STACK_SIZE)
	TC_PRINT("Runtime sysworkq thread stack size: %zu bytes (expected: %d)\n", stack_size,
		 CONFIG_TEST_EXPECTED_STACK_SIZE);

	zexpect_true(stack_size >= (size_t)CONFIG_TEST_EXPECTED_STACK_SIZE,
		     "Runtime thread stack size %zu is smaller than expected %d", stack_size,
		     CONFIG_TEST_EXPECTED_STACK_SIZE);
	zexpect_true(stack_size < (size_t)CONFIG_TEST_EXPECTED_STACK_SIZE + 512U,
		     "Runtime thread stack size %zu is unexpectedly larger than expected %d",
		     stack_size, CONFIG_TEST_EXPECTED_STACK_SIZE);
#else
	TC_PRINT("Runtime sysworkq thread stack size: %zu bytes\n", stack_size);
#endif
#endif
}

ZTEST(sysworkq_stack_aggregation, test_execution)
{
	int ret;

	k_work_init(&test_work, test_work_handler);
	ret = k_work_submit_to_queue(&k_sys_work_q, &test_work);
	zassert_true(ret >= 0, "k_work_submit_to_queue failed: %d", ret);

	ret = k_sem_take(&work_done_sem, K_MSEC(1000));
	zassert_equal(ret, 0, "Timed out waiting for work item execution on sysworkq");
}

ZTEST_SUITE(sysworkq_stack_aggregation, NULL, NULL, NULL, NULL, NULL);
```
