## CMakeLists.txt
```
# SPDX-License-Identifier: Apache-2.0

cmake_minimum_required(VERSION 3.20.0)
find_package(Zephyr REQUIRED HINTS $ENV{ZEPHYR_BASE})
project(xip)

FILE(GLOB app_sources src/*.c)
target_sources(app PRIVATE ${app_sources})
```

## prj.conf
```kconfig
CONFIG_ZTEST=y
CONFIG_ZTEST_NEW_API=y
CONFIG_LOG_MODE_IMMEDIATE=y # See issue #62975
```

## src/main.c
```c
/*
 * Copyright (c) 2017 Intel Corporation
 *
 * SPDX-License-Identifier: Apache-2.0
 */

/**
 * @brief Test to verify XIP
 *
 * @defgroup kernel_xip_tests XIP Tests
 *
 * @ingroup all_tests
 *
 * @details This module tests that XIP performs as expected. If the first
 * task is even activated that is a good indication that XIP is
 * working. However, the test does do some some testing on
 * global variables for completeness sake.
 *
 * @{
 * @}
 */

#include <ztest.h>

/* This test relies on these values being one larger than the one before */
#define TEST_VAL_1  0x1
#define TEST_VAL_2  0x2
#define TEST_VAL_3  0x3
#define TEST_VAL_4  0x4

#define XIP_TEST_ARRAY_SZ 4

extern uint32_t xip_array[XIP_TEST_ARRAY_SZ];

/*
 * This array is deliberately defined outside of the scope of the main test
 * module to avoid optimization issues.
 */
uint32_t xip_array[XIP_TEST_ARRAY_SZ] = {
	TEST_VAL_1, TEST_VAL_2, TEST_VAL_3, TEST_VAL_4};

/**
 * @brief Test XIP
 *
 * @ingroup kernel_xip_tests
 */
ZTEST(xip, test_globals)
{
	int  i;

	/* Array should be filled with monotonically incrementing values */
	for (i = 0; i < XIP_TEST_ARRAY_SZ; i++) {

		/**TESTPOINT: Check if the array value is correct*/
		zassert_equal(xip_array[i], (i+1), "Array value is incorrect");
	}
}

/**test case main entry*/
ZTEST_SUITE(xip, NULL, NULL, NULL, NULL, NULL);
```

## src/test.h
```c
/*
 * Copyright (c) 2014 Wind River Systems, Inc.
 *
 * SPDX-License-Identifier: Apache-2.0
 */

/**
 * This header contains defines, externs etc. for the XIP
 * regression test.
 */


/* This test relies on these values being one larger than the one before */

#define TEST_VAL_1  0x1
#define TEST_VAL_2  0x2
#define TEST_VAL_3  0x3
#define TEST_VAL_4  0x4

#define XIP_TEST_ARRAY_SZ 4

extern u32_t xip_array[XIP_TEST_ARRAY_SZ];
```

## src/test_xip.c
```c
/* test_xip.c - test XIP */

/*
 * Copyright (c) 2014 Wind River Systems, Inc.
 *
 * SPDX-License-Identifier: Apache-2.0
 */

/*
DESCRIPTION
This module tests that XIP performs as expected. If the first
task is even activated that is a good indication that XIP is
working. However, the test does do some some testing on
global variables for completeness sake.
 */

#include <zephyr.h>
#include <tc_util.h>
#include "test.h"


/**
 *
 * @brief Regression test's entry point
 *
 * @return N/A
 */

void main(void)
{
	int  tcRC = TC_PASS;
	int  i;

	TC_START("kernel_xip");
	PRINT_DATA("Starting XIP tests\n");
	PRINT_LINE;

	/* Test globals are correct */

	TC_PRINT("Test globals\n");

	/* Array should be filled with monotomically incrementing values */
	for (i = 0; i < XIP_TEST_ARRAY_SZ; i++) {
		if (xip_array[i] != (i+1)) {
			TC_PRINT("xip_array[%d] != %d\n", i, i+1);
			tcRC = TC_FAIL;
			goto exitRtn;
		}
	}

exitRtn:
	TC_END_RESULT(tcRC);
	TC_END_REPORT(tcRC);
}
```

## src/test_xip_helper.c
```c
/*
 * Copyright (c) 2014 Wind River Systems, Inc.
 *
 * SPDX-License-Identifier: Apache-2.0
 */

/*
 * @file XIP helper module
 *
 * This module contains support code for the XIP regression
 * test.
 */

#include <zephyr.h>
#include "test.h"

/*
 * This array is deliberately defined outside of the scope of the main test
 * module to avoid optimization issues.
 */
u32_t xip_array[XIP_TEST_ARRAY_SZ] = {
	TEST_VAL_1, TEST_VAL_2, TEST_VAL_3, TEST_VAL_4};
```

## src/xip.c
```c
/*
 * Copyright (c) 2014 Wind River Systems, Inc.
 *
 * SPDX-License-Identifier: Apache-2.0
 */

/*
 * DESCRIPTION
 * This module tests that XIP performs as expected. If the first
 * task is even activated that is a good indication that XIP is
 * working. However, the test does do some some testing on
 * global variables for completeness sake.
 */

#include <zephyr.h>
#include <tc_util.h>
#include "test.h"
#include <ztest.h>

/**
 *
 * @brief Regression test's entry point
 *
 * @return N/A
 */

void test_globals(void)
{
	int  i;

	/* Array should be filled with monotomically incrementing values */
	for (i = 0; i < XIP_TEST_ARRAY_SZ; i++) {

		/**TESTPOINT: Check if the array value is correct*/
		zassert_equal(xip_array[i], (i+1), "Array value is incorrect");
	}
}
```
