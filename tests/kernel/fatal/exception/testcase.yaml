## tests/kernel/fatal/exception/testcase.yaml
```yaml
common:
  ignore_faults: true
tests:
  kernel.common.stack_protection:
    extra_args: CONF_FILE=prj.conf
    platform_exclude:
      - twr_ke18f
      - ucans32k1sic
    filter: CONFIG_ARCH_HAS_STACK_PROTECTION
    arch_exclude:
      - posix
    tags:
      - kernel
      - userspace
  kernel.common.stack_protection_no_userspace:
    extra_args: CONF_FILE=protection_no_userspace.conf
    filter: CONFIG_ARCH_HAS_STACK_PROTECTION
    arch_allow: arm
    tags:
      - kernel
      - memory_protection
  kernel.common.stack_protection_arm_fpu_sharing:
    extra_args: CONF_FILE=prj_arm_fpu_sharing.conf
    platform_exclude:
      - twr_ke18f
      - ucans32k1sic
    arch_allow: arm
    filter: CONFIG_ARCH_HAS_STACK_PROTECTION and CONFIG_ARMV7_M_ARMV8_M_FP
    tags:
      - fpu
      - kernel
      - userspace
    integration_platforms:
      - mps2/an385
  kernel.common.stack_protection_armv8m_mpu_stack_guard:
    extra_args: CONF_FILE=prj_armv8m_mpu_stack_guard.conf
    filter: CONFIG_ARM_MPU and CONFIG_ARMV8_M_MAINLINE
    arch_allow: arm
    tags:
      - kernel
      - userspace
    integration_platforms:
      - mps2/an385
  kernel.common.stack_sentinel:
    extra_args: CONF_FILE=sentinel.conf
    platform_exclude:
      - qemu_cortex_a9 # FIXME: See issue #39948
    tags: kernel
    integration_platforms:
      - qemu_x86
```

## tests/kernel/fatal/message_capture/testcase.yaml
```yaml
tests:
  kernel.logging.message_capture:
    tags:
      - kernel
      - pearl_gecko
    harness: console
    harness_config:
      type: multi_line
      ordered: false
      regex:
        - "Current thread: (.*)"
        - "Caught system error -- reason (.*)"
```

## tests/kernel/fatal/no-multithreading/testcase.yaml
```yaml
common:
  platform_allow:
    - qemu_cortex_m3
    - qemu_arc/qemu_arc_em
    - qemu_arc/qemu_arc_hs
    - qemu_arc/qemu_arc_hs6x
    - qemu_riscv32
    - qemu_riscv32e
    - qemu_riscv64
    - nsim/nsim_em
    - nsim/nsim_em7d_v22
    - nsim/nsim_hs
    - nsim/nsim_hs/mpuv6
    - nsim/nsim_hs5x
    - nsim/nsim_hs6x
  integration_platforms:
    - qemu_cortex_m3
    - nsim/nsim_em
  tags:
    - kernel
    - scheduler
  ignore_faults: true
tests:
  kernel.no-mt.cpu_exception:
    extra_args: EXTRA_CPPFLAGS=-DVIA_TWISTER=0
  kernel.no-mt.oops:
    extra_args: EXTRA_CPPFLAGS=-DVIA_TWISTER=1
  kernel.no-mt.panic:
    extra_args: EXTRA_CPPFLAGS=-DVIA_TWISTER=2
  kernel.no-mt.zephyr_assert:
    extra_args: EXTRA_CPPFLAGS=-DVIA_TWISTER=3
  kernel.no-mt.arbitrary_reason:
    extra_args: EXTRA_CPPFLAGS=-DVIA_TWISTER=4
  kernel.no-mt.arbitrary_reason_negative:
    extra_args: EXTRA_CPPFLAGS=-DVIA_TWISTER=5
```

## tests/kernel/fatal/testcase.yaml
```yaml
tests:
  kernel.common.stack_protection:
    extra_args: CONF_FILE=prj.conf
    filter: CONFIG_ARCH_HAS_STACK_PROTECTION
    tags: kernel ignore_faults userspace
  kernel.common.stack_protection_no_userspace:
    extra_args: CONF_FILE=protection_no_userspace.conf
    filter: CONFIG_ARCH_HAS_STACK_PROTECTION
    arch_whitelist: arm
    tags: kernel ignore_faults memory_protection
  kernel.common.stack_protection_arm_fp_sharing:
    extra_args: CONF_FILE=prj_arm_fp_sharing.conf
    filter: CONFIG_ARCH_HAS_STACK_PROTECTION and CONFIG_ARMV7_M_ARMV8_M_FP
    tags: kernel ignore_faults userspace
  kernel.common.stack_sentinel:
    extra_args: CONF_FILE=sentinel.conf
    tags: kernel ignore_faults
```

## tests/kernel/fifo/fifo_api/testcase.yaml
```yaml
tests:
  kernel.fifo:
    tags: kernel
  kernel.fifo.linker_generator:
    platform_allow: qemu_cortex_m3
    tags: linker_generator
    extra_configs:
      - CONFIG_CMAKE_LINKER_GENERATOR=y
```

## tests/kernel/fp_sharing/float_disable/testcase.yaml
```yaml
tests:
  kernel.fp_sharing.float_disable.arm:
    arch_whitelist: arm
    filter: CONFIG_ARMV7_M_ARMV8_M_FP
    extra_configs:
      - CONFIG_DYNAMIC_INTERRUPTS=y
    tags: kernel userspace
  kernel.fp_sharing.float_disable.x86:
    extra_args: CONF_FILE=prj_x86.conf
    platform_whitelist: qemu_x86
    tags: kernel userspace
```

## tests/kernel/fp_sharing/testcase.yaml
```yaml
tests:
  kernel.fp_sharing:
    extra_args: PI_NUM_ITERATIONS=70000
    filter: CONFIG_ARMV7_M_ARMV8_M_FP
    slow: true
    tags: core
    timeout: 600
    min_ram: 16
  kernel.fp_sharing.x86:
    extra_args: CONF_FILE=prj_x86.conf
    platform_whitelist: qemu_x86
    slow: true
    tags: core
    timeout: 600
```

## tests/kernel/fpu_sharing/float_disable/testcase.yaml
```yaml
common:
  tags:
    - fpu
    - kernel
    - userspace
tests:
  kernel.fpu_sharing.float_disable:
    arch_allow:
      - arm
      - sparc
    filter: CONFIG_ARMV7_M_ARMV8_M_FP or CONFIG_ARMV7_R_FP or CONFIG_CPU_HAS_FPU
    extra_configs:
      - arch:arm:CONFIG_DYNAMIC_INTERRUPTS=y
  kernel.fpu_sharing.float_disable.x86.fpu:
    extra_args: CONF_FILE=prj_x86.conf
    extra_configs:
      - CONFIG_X86_SSE_FP_MATH=n
      - CONFIG_X86_SSE=n
    platform_allow:
      - qemu_x86/atom
      - qemu_x86_lakemont/lakemont
      - intel_ehl_crb/elkhart_lake
      - acrn_ehl_crb/elkhart_lake
    integration_platforms:
      - qemu_x86/atom
  kernel.fpu_sharing.float_disable.x86.fpu.sse:
    extra_args: CONF_FILE=prj_x86.conf
    extra_configs:
      - CONFIG_X86_SSE_FP_MATH=n
    platform_allow:
      - qemu_x86/atom
      - qemu_x86_lakemont/lakemont
      - intel_ehl_crb/elkhart_lake
      - acrn_ehl_crb/elkhart_lake
    integration_platforms:
      - qemu_x86/atom
    toolchain_exclude:
      - llvm
      - oneApi
  kernel.fpu_sharing.float_disable.x86.sse:
    extra_args: CONF_FILE=prj_x86.conf
    extra_configs:
      - CONFIG_X86_SSE_FP_MATH=y
    platform_allow:
      - qemu_x86/atom
      - qemu_x86_lakemont/lakemont
      - intel_ehl_crb/elkhart_lake
      - acrn_ehl_crb/elkhart_lake
    integration_platforms:
      - qemu_x86/atom
```

## tests/kernel/fpu_sharing/generic/boards/rpi_zero_2w.conf
```kconfig
CONFIG_BOOT_DELAY=200

# prj.conf pins MP_MAX_NUM_CPUS=1 so the two FP threads thrash one
# cpu's lazy save/restore deterministically. Override to 4 here: with
# the threads free to land on any of the four cores, every migration
# of a live FPU context exercises flush_owned_fpu() ->
# arch_flush_fpu_ipi() -> the BCM2836 mailbox-0 FPU-flush IPI. That
# cross-cpu path is exactly what this board overlay exists to test.
CONFIG_MP_MAX_NUM_CPUS=4
CONFIG_SMP=y
CONFIG_PM_CPU_OPS=y
CONFIG_PM_CPU_OPS_SPINTABLE=y

# arch_cpu_start uses sys_cache_data_flush_range to publish
# arm64_cpu_boot_params to the parked secondary core; without
# CACHE_MANAGEMENT the flush is a no-op and cpu 0 hangs in wfe
# waiting for the secondary's mpid handshake.
CONFIG_CACHE_MANAGEMENT=y
```

## tests/kernel/fpu_sharing/generic/testcase.yaml
```yaml
tests:
  kernel.fpu_sharing.generic.arc:
    extra_args: PI_NUM_ITERATIONS=500
    arch_allow: arc
    filter: CONFIG_ISA_ARCV2 and CONFIG_CPU_HAS_FPU
    slow: true
    tags:
      - fpu
      - kernel
    timeout: 600
    min_ram: 16
  kernel.fpu_sharing.generic.arm:
    extra_args: PI_NUM_ITERATIONS=70000
    filter: CONFIG_ARMV7_M_ARMV8_M_FP or CONFIG_ARMV7_R_FP or CONFIG_CPU_HAS_VFP
    slow: true
    arch_allow: arm
    tags:
      - fpu
      - kernel
    timeout: 600
    min_ram: 16
  kernel.fpu_sharing.generic.arm64:
    extra_args: PI_NUM_ITERATIONS=70000
    arch_allow: arm64
    filter: CONFIG_CPU_CORTEX_A
    slow: true
    tags:
      - fpu
      - kernel
    timeout: 600
  kernel.fpu_sharing.generic.riscv32:
    extra_args: PI_NUM_ITERATIONS=500
    filter: CONFIG_CPU_HAS_FPU and not CONFIG_64BIT
    arch_allow: riscv
    tags:
      - fpu
      - kernel
    timeout: 600
    min_ram: 16
  kernel.fpu_sharing.generic.riscv64:
    extra_args: PI_NUM_ITERATIONS=500
    extra_configs:
      - CONFIG_MAIN_STACK_SIZE=2048
    filter: CONFIG_CPU_HAS_FPU and CONFIG_64BIT
    arch_allow: riscv
    tags:
      - fpu
      - kernel
    timeout: 600
    min_ram: 16
  kernel.fpu_sharing.generic.sparc:
    extra_args: PI_NUM_ITERATIONS=70000
    filter: CONFIG_CPU_HAS_FPU
    arch_allow: sparc
    tags:
      - fpu
      - kernel
    timeout: 600
  kernel.fpu_sharing.generic.x86.fpu:
    extra_args: CONF_FILE=prj_x86.conf
    extra_configs:
      - CONFIG_X86_SSE_FP_MATH=n
      - CONFIG_X86_SSE=n
    platform_allow:
      - qemu_x86
      - qemu_x86_lakemont
    integration_platforms:
      - qemu_x86
    slow: true
    tags:
      - fpu
      - kernel
    timeout: 600
  kernel.fpu_sharing.generic.x86.fpu.sse:
    extra_args: CONF_FILE=prj_x86.conf
    extra_configs:
      - CONFIG_X86_SSE_FP_MATH=n
    platform_allow:
      - qemu_x86
      - qemu_x86_lakemont
    integration_platforms:
      - qemu_x86
    slow: true
    tags:
      - fpu
      - kernel
    timeout: 600
    toolchain_exclude:
      - llvm
      - oneApi
  kernel.fpu_sharing.generic.x86.sse:
    extra_args: CONF_FILE=prj_x86.conf
    extra_configs:
      - CONFIG_X86_SSE_FP_MATH=y
    platform_allow:
      - qemu_x86
      - qemu_x86_lakemont
    slow: true
    tags:
      - fpu
      - kernel
    timeout: 600
  kernel.fpu_sharing.generic.xtensa:
    filter: CONFIG_CPU_HAS_FPU
    arch_allow: xtensa
    tags:
      - fpu
      - kernel
    timeout: 600
```

## tests/kernel/gen_isr_table/testcase.yaml
```yaml
common:
  tags:
    - kernel
    - interrupt
    - isr_table
tests:
  arch.interrupt.gen_isr_table.arm_baseline:
    platform_allow: qemu_cortex_m3
    filter: CONFIG_GEN_ISR_TABLES and CONFIG_ARMV6_M_ARMV8_M_BASELINE
    extra_configs:
      - CONFIG_NULL_POINTER_EXCEPTION_DETECTION_NONE=y
  arch.interrupt.gen_isr_table.arm_baseline.linker_generator:
    platform_allow: qemu_cortex_m3
    filter: CONFIG_GEN_ISR_TABLES and CONFIG_ARMV6_M_ARMV8_M_BASELINE
    tags:
      - linker_generator
    extra_configs:
      - CONFIG_NULL_POINTER_EXCEPTION_DETECTION_NONE=y
      - CONFIG_CMAKE_LINKER_GENERATOR=y
  arch.interrupt.gen_isr_table.arm_mainline:
    platform_allow: qemu_cortex_m3
    platform_exclude:
      - stmf103_mini
      - nucleo_f103rb
      - olimexino_stm32
      - stm32_min_dev_black
      - stm32_min_dev_blue
      - usb_kw24d512
      - v2m_beetle
      - cc1352r1_launchxl
      - cc26x2r1_launchxl
      - olimex_stm32_h103
      - cc1352r_sensortag
    filter: CONFIG_GEN_ISR_TABLES and CONFIG_ARMV7_M_ARMV8_M_MAINLINE
    extra_configs:
      - CONFIG_NULL_POINTER_EXCEPTION_DETECTION_NONE=y
  arch.interrupt.gen_isr_table.disabled:
    platform_allow: qemu_cortex_m3
    extra_configs:
      - CONFIG_GEN_ISR_TABLES=n
      - CONFIG_NULL_POINTER_EXCEPTION_DETECTION_NONE=y
    build_only: true
  arch.interrupt.gen_isr_table.arc:
    arch_allow: arc
    filter: CONFIG_RGF_NUM_BANKS > 1
    extra_configs:
      - CONFIG_ARC_FIRQ_STACK=y
      - CONFIG_TEST_HW_STACK_PROTECTION=n
  arch.interrupt.gen_isr_table.riscv_direct:
    arch_allow:
      - riscv32
      - riscv64
    platform_exclude:
      - m2gl025_miv
      - adp_xc7k_ae350
    filter: CONFIG_SOC_FAMILY_RISCV_PRIVILEGED
    extra_configs:
      - CONFIG_GEN_IRQ_VECTOR_TABLE=y
  arch.interrupt.gen_isr_table.riscv_no_direct:
    platform_exclude: m2gl025_miv
    arch_allow:
      - riscv32
      - riscv64
    filter: CONFIG_SOC_FAMILY_RISCV_PRIVILEGED
    extra_configs:
      - CONFIG_GEN_IRQ_VECTOR_TABLE=n
  arch.interrupt.gen_isr_table.bit_shift_2nd_level:
    platform_allow: qemu_riscv32
    filter: CONFIG_SOC_FAMILY_RISCV_PRIVILEGED
    extra_configs:
      - CONFIG_1ST_LEVEL_INTERRUPT_BITS=10
      - CONFIG_2ND_LEVEL_INTERRUPT_BITS=10
  arch.interrupt.gen_isr_table.bit_shift_3rd_level:
    platform_allow: qemu_riscv32
    filter: CONFIG_SOC_FAMILY_RISCV_PRIVILEGED
    extra_configs:
      - CONFIG_MULTI_LEVEL_INTERRUPTS=y
      - CONFIG_2ND_LEVEL_INTERRUPTS=y
      - CONFIG_3RD_LEVEL_INTERRUPTS=y
      - CONFIG_1ST_LEVEL_INTERRUPT_BITS=10
      - CONFIG_2ND_LEVEL_INTERRUPT_BITS=10
      - CONFIG_3RD_LEVEL_INTERRUPT_BITS=9
```

## tests/kernel/interrupt/gen_isr_table/testcase.yaml
```yaml
tests:
  arch.interrupt:
    filter: CONFIG_GEN_ISR_TABLES and CONFIG_ARMV7_M_ARMV8_M_MAINLINE
    tags: interrupt isr_table
```

## tests/kernel/interrupt/irq_lock/testcase.yaml
```yaml
tests:
  arch.interrupt:
    arch_exclude: x86 posix riscv32
    tags: interrupt irq_lock
```

## tests/kernel/interrupt/static_idt/testcase.yaml
```yaml
tests:
  arch.interrupt:
    arch_whitelist: x86
    tags: ignore_faults interrupt idt
```

## tests/kernel/interrupt/testcase.yaml
```yaml
tests:
  arch.interrupt:
    # nios2 excluded, see #22956
    arch_exclude: nios2
    platform_exclude: qemu_cortex_m0
    tags:
      - kernel
      - interrupt
    filter: not CONFIG_TRUSTED_EXECUTION_NONSECURE
  arch.interrupt.qemu_cortex_m0:
    platform_allow: qemu_cortex_m0
    tags:
      - kernel
      - interrupt
    filter: not CONFIG_TRUSTED_EXECUTION_NONSECURE
    extra_configs:
      - CONFIG_QEMU_ICOUNT=y
  arch.interrupt.minimallibc:
    filter: not CONFIG_TRUSTED_EXECUTION_NONSECURE and CONFIG_MINIMAL_LIBC_SUPPORTED
    # nios2 excluded, see #22956
    arch_exclude: nios2
    platform_exclude: qemu_cortex_m0
    tags:
      - kernel
      - interrupt
      - libc
    extra_configs:
      - CONFIG_MINIMAL_LIBC=y
  arch.interrupt.qemu_cortex_m0.minimallibc:
    filter: not CONFIG_TRUSTED_EXECUTION_NONSECURE and CONFIG_MINIMAL_LIBC_SUPPORTED
    platform_allow: qemu_cortex_m0
    tags:
      - kernel
      - interrupt
      - libc
    extra_configs:
      - CONFIG_QEMU_ICOUNT=y
      - CONFIG_MINIMAL_LIBC=y
  arch.shared_interrupt:
    platform_exclude:
      # excluded because of failures during test_prevent_interruption
      - qemu_cortex_m0
      # On it8xxx2_evb, current trigger_irq implementation of RISC-V architecture
      # does not trigger interrupts
      - it8xxx2_evb
    arch_exclude:
      # same as for qemu_cortex_m0, #22956
      - nios2
      # test needs 2 working interrupt lines
      - xtensa
      # TODO: make test work on this arch
      - mips
    tags:
      - kernel
      - interrupt
    extra_configs:
      - CONFIG_SHARED_INTERRUPTS=y
    filter: not CONFIG_TRUSTED_EXECUTION_NONSECURE
  arch.interrupt.multilevel:
    filter: CONFIG_MULTI_LEVEL_INTERRUPTS
    extra_args:
      - EXTRA_DTC_OVERLAY_FILE="multilevel_irq.overlay"
    extra_configs:
      - CONFIG_TEST_MULTILEVEL_IRQ=y
  arch.interrupt.multilevel_l3:
    filter: CONFIG_MULTI_LEVEL_INTERRUPTS
    extra_args:
      - EXTRA_DTC_OVERLAY_FILE="multilevel_irq.overlay"
    extra_configs:
      - CONFIG_TEST_MULTILEVEL_IRQ=y
      - CONFIG_3RD_LEVEL_INTERRUPTS=y
      - CONFIG_3RD_LEVEL_INTERRUPT_BITS=11
```

## tests/kernel/ipi_cascade/testcase.yaml
```yaml
tests:
  kernel.ipi_cascade.smp:
    tags:
      - kernel
      - smp
    filter: (CONFIG_MP_MAX_NUM_CPUS == 2)
```

## tests/kernel/ipi_optimize/testcase.yaml
```yaml
tests:
  kernel.ipi_optimize.smp:
    tags:
      - kernel
      - smp
    filter: (CONFIG_MP_MAX_NUM_CPUS > 1)
```

## tests/kernel/ipi_work/testcase.yaml
```yaml
tests:
  kernel.ipi_work:
    tags:
      - kernel
      - smp
    filter: (CONFIG_MP_MAX_NUM_CPUS > 1) and CONFIG_SCHED_IPI_SUPPORTED
```

## tests/kernel/lifo/lifo_api/testcase.yaml
```yaml
tests:
  kernel.lifo:
    tags: kernel
  kernel.lifo.linker_generator:
    platform_allow: qemu_cortex_m3
    tags: linker_generator
    extra_configs:
      - CONFIG_CMAKE_LINKER_GENERATOR=y
```
