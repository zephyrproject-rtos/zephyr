## tests/kernel/pending/testcase.yaml
```yaml
tests:
  kernel.pending:
    tags: kernel
  kernel.pending.minimallibc:
    filter: CONFIG_MINIMAL_LIBC_SUPPORTED
    tags:
      - kernel
      - libc
    extra_configs:
      - CONFIG_MINIMAL_LIBC=y
```

## tests/kernel/pipe/deprecated/pipe/testcase.yaml
```yaml
tests:
  kernel.deprecated.pipe:
    tags:
      - kernel
      - userspace
    ignore_faults: true
```

## tests/kernel/pipe/pipe/testcase.yaml
```yaml
tests:
  kernel.pipe:
    tags:
      - kernel
      - userspace
      - pearl_gecko
    ignore_faults: true
```

## tests/kernel/pipe/pipe_api/testcase.yaml
```yaml
tests:
  kernel.pipe.api:
    tags:
      - kernel
      - userspace
  kernel.pipe.api.benchmark:
    platform_allow:
      - qemu_x86
    integration_platforms:
      - qemu_x86
    extra_configs:
      - CONFIG_ZTEST_BENCHMARK=y
    tags:
      - kernel
      - benchmark
```

## tests/kernel/poll/testcase.yaml
```yaml
tests:
  kernel.poll:
    ignore_faults: true
    tags:
      - kernel
      - userspace
    platform_exclude:
      - nrf52dk/nrf52810
  kernel.poll.minimallibc:
    filter: CONFIG_MINIMAL_LIBC_SUPPORTED
    ignore_faults: true
    tags:
      - kernel
      - userspace
      - libc
    platform_exclude:
      - nrf52dk/nrf52810
    extra_configs:
      - CONFIG_MINIMAL_LIBC=y
```

## tests/kernel/profiling/profiling_api/Kconfig
```kconfig
# SPDX-License-Identifier: Apache-2.0

config KERNEL_PROFILING_API_TEST
	bool
	default y
	select HAS_POWER_STATE_SLEEP_1
	help
	  Hidden option enabling LPS_0 power state regardless of hardware
	  support. This ensures that power management hooks used in this
	  test to profile idle thread will be executed.

# Include Zephyr's Kconfig.
source "Kconfig"
```

## tests/kernel/profiling/profiling_api/testcase.yaml
```yaml
tests:
  kernel.common.profiling:
    arch_exclude: nios2
    platform_exclude:
      - em_starterkit/emsk_em7d
      - em_starterkit/emsk_em9d
      - em_starterkit/emsk_em11d
      - litex_vexriscv
      - rv32m1_vega/openisa_rv32m1/zero_riscy
      - rv32m1_vega/openisa_rv32m1/ri5cy
      - nrf5340dk/nrf5340/cpunet
    tags:
      - kernel
      - pm
```

## tests/kernel/sched/deadline/testcase.yaml
```yaml
tests:
  kernel.scheduler.deadline:
    tags: kernel
  kernel.scheduler.deadline.scalable:
    tags: kernel
    extra_configs:
      - CONFIG_SCHED_SCALABLE=y
```

## tests/kernel/sched/metairq/testcase.yaml
```yaml
tests:
  kernel.scheduler.metairq:
    tags: kernel
    platform_exclude: nrf52dk_nrf52810
```

## tests/kernel/sched/preempt/testcase.yaml
```yaml
tests:
  kernel.scheduler.preempt:
    tags: kernel
    platform_exclude: nrf52dk/nrf52810
```

## tests/kernel/sched/schedule_api/testcase.yaml
```yaml
common:
  timeout: 180
  min_ram: 34
  tags:
    - kernel
    - threads
    - scheduler
    - userspace
  ignore_faults: true
tests:
  kernel.scheduler:
    filter: not CONFIG_SCHED_MULTIQ
    extra_configs:
      - CONFIG_TIMESLICING=y
  kernel.scheduler.no_timeslicing:
    filter: not CONFIG_SCHED_MULTIQ
    extra_configs:
      - CONFIG_TIMESLICING=n
  kernel.scheduler.slice_perthread:
    filter: not CONFIG_SCHED_MULTIQ
    extra_configs:
      - CONFIG_TIMESLICING=y
      - CONFIG_TIMESLICE_PER_THREAD=y
  kernel.scheduler.multiq:
    extra_args: CONF_FILE=prj_multiq.conf
    extra_configs:
      - CONFIG_TIMESLICING=y
  kernel.scheduler.multiq_no_timeslicing:
    extra_args: CONF_FILE=prj_multiq.conf
    extra_configs:
      - CONFIG_TIMESLICING=n
  kernel.scheduler.simple_timeslicing:
    extra_args: CONF_FILE=prj_simple.conf
    extra_configs:
      - CONFIG_TIMESLICING=y
  kernel.scheduler.simple_no_timeslicing:
    extra_args: CONF_FILE=prj_simple.conf
    extra_configs:
      - CONFIG_TIMESLICING=n
```

## tests/kernel/sched/timeslicing/testcase.yaml
```yaml
common:
  # platforms with a lacking timer driver are likely to fail
  platform_exclude: qemu_nios2
tests:
  kernel.scheduler.timeslicing:
    tags: kernel
    extra_configs:
      - CONFIG_SMP=n
      - CONFIG_MP_MAX_NUM_CPUS=1
  kernel.scheduler.timeslicing.smp.1cpu:
    tags: kernel smp
    filter: CONFIG_SMP
    extra_configs:
      - CONFIG_MP_MAX_NUM_CPUS=1
  kernel.scheduler.timeslicing.smp.full:
    tags: kernel smp
    filter: CONFIG_SMP and (CONFIG_MP_MAX_NUM_CPUS > 1)
```

## tests/kernel/semaphore/sem_error_case/testcase.yaml
```yaml
tests:
  kernel.semaphore.error:
    filter: CONFIG_ARCH_HAS_USERSPACE
    tags: kernel userspace ignore_faults
```
