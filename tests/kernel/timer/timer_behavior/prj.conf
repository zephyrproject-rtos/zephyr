## CMakeLists.txt
```
# SPDX-License-Identifier: Apache-2.0

cmake_minimum_required(VERSION 3.28.0)
find_package(Zephyr REQUIRED HINTS $ENV{ZEPHYR_BASE})
project(timer_behavior)

FILE(GLOB app_sources src/*.c)
target_sources(app PRIVATE ${app_sources})
```

## Kconfig
```
# SPDX-License-Identifier: Apache-2.0
# Copyright (c) 2022 Intel Corporation

mainmenu "Timer Behavior Test"

config SYS_CLOCK_TICKS_PER_SEC
	default 8192 if NRF_RTC_TIMER && TICKLESS_KERNEL

source "Kconfig.zephyr"

DT_CHOSEN_Z_SRAM = zephyr,sram

config TIMER_TEST_SAMPLES
	int "The number of timer samples to gather for statistics"
	default 1000 if (SRAM_DEPRECATED_KCONFIG_SET && SRAM_SIZE <= 24) || \
		(!SRAM_DEPRECATED_KCONFIG_SET && $(dt_chosen_reg_size_int,$(DT_CHOSEN_Z_SRAM),0,K) <= 24)
	default 2000 if (SRAM_DEPRECATED_KCONFIG_SET && SRAM_SIZE <= 32) || \
		(!SRAM_DEPRECATED_KCONFIG_SET && $(dt_chosen_reg_size_int,$(DT_CHOSEN_Z_SRAM),0,K) <= 32)
	default 3000 if (SRAM_DEPRECATED_KCONFIG_SET && SRAM_SIZE <= 48) || \
		(!SRAM_DEPRECATED_KCONFIG_SET && $(dt_chosen_reg_size_int,$(DT_CHOSEN_Z_SRAM),0,K) <= 48)
	default 5000 if (SRAM_DEPRECATED_KCONFIG_SET && SRAM_SIZE <= 64) || \
		(!SRAM_DEPRECATED_KCONFIG_SET && $(dt_chosen_reg_size_int,$(DT_CHOSEN_Z_SRAM),0,K) <= 64)
	default 7000 if (SRAM_DEPRECATED_KCONFIG_SET && SRAM_SIZE <= 96) || \
		(!SRAM_DEPRECATED_KCONFIG_SET && $(dt_chosen_reg_size_int,$(DT_CHOSEN_Z_SRAM),0,K) <= 96)
	default 10000

config TIMER_TEST_PERIOD
	int "The number of microseconds to for the timer period"
	default 1000

config TIMER_EXTERNAL_TEST
	bool "Perform test using an external tool"
	help
	  Toggles a GPIO pin, on every period, that can be used by an external
	  tool (such as a logic analyzer) to gather timing data. A pytest harness
	  is used to get the data collected by the tool and evaluate it.

if TIMER_EXTERNAL_TEST

config TIMER_EXTERNAL_TEST_MAX_DRIFT_PPM
	int "Maximum drift in PPM for tests using external tool"
	default 4500
	help
	  Parts Per Million of allowed drift when using an external tool
	  connected to a GPIO pin is used to measure time behaviour.

config TIMER_EXTERNAL_TEST_PERIOD_MAX_DRIFT_PPM
	int "Maximum timer period drift in PPM for tests using external tool"
	default 100000
	help
	  Parts Per Million of allowed period drift when using an external tool
	  connected to a GPIO pin is used to measure time behaviour.

config TIMER_EXTERNAL_TEST_SYNC_DELAY
	int "Delay, in seconds, between tests, so that external tool can be ready"
	default 3

endif # TIMER_EXTERNAL_TEST
```

## prj.conf
```kconfig
CONFIG_ZTEST=y
CONFIG_CBPRINTF_FP_SUPPORT=y

# Make sure this is off. Otherwise a single 60-character line at
# 115200 bauds would grab the printk lock and disable IRQs for more
# than 5 ms screwing up timer latency statistics.
CONFIG_PRINTK_SYNC=n
CONFIG_GPIO=y

# Disable timeslicing. On platforms with a coarse SysTick (e.g. 32 kHz),
# the timeslice yield triggers an extra sys_clock_set_timeout() that
# accumulates unannounced cycles until dticks=2 is announced in a single
# ISR, firing two callbacks back-to-back and producing a spurious 1-cycle
# period in the results.
CONFIG_TIMESLICING=n
```

## boards/ek_ra8d1.conf
```kconfig
# Copyright (c) 2025 Renesas Electronics Corporation
# SPDX-License-Identifier: Apache-2.0

CONFIG_USE_RENESAS_RA_ULPT_TIMER=y
```

## boards/frdm_mcxe31b.conf
```kconfig
CONFIG_MCUX_STM_TIMER=y
```

## boards/imx95_evk_mimx9596_m7.conf
```kconfig
CONFIG_MCUX_LPTMR_TIMER=y
CONFIG_TICKLESS_KERNEL=y
CONFIG_SYS_CLOCK_TICKS_PER_SEC=1024
```

## boards/nrf54h20dk_nrf54h20_cpuppr_xip.conf
```kconfig
CONFIG_SYS_CLOCK_TICKS_PER_SEC=3906
```

## boards/nrf54l09pdk_nrf54l09_cpuapp.conf
```kconfig
CONFIG_SYS_CLOCK_TICKS_PER_SEC=10000
```

## boards/esp32s3_devkitm.overlay
```dts
/*
 * Copyright (c) 2023 Intel Corporation
 *
 * SPDX-License-Identifier: Apache-2.0
 */

/ {
    resources {
        compatible = "test-kernel-timer-behavior-external";

        timerout-gpios = <&gpio0 4 GPIO_ACTIVE_LOW>;
    };
};
```

## boards/frdm_k64f.overlay
```dts
/*
 * Copyright (c) 2023 Intel Corporation
 *
 * SPDX-License-Identifier: Apache-2.0
 */

/ {
	resources {
		compatible = "test-kernel-timer-behavior-external";

		timerout-gpios = <&gpioc 3 GPIO_ACTIVE_LOW>;	/* Arduino D7 */
	};
};
```

## boards/frdm_mcxe31b.overlay
```dts
/*
 * Copyright (c) 2026 NXP
 *
 * SPDX-License-Identifier: Apache-2.0
 */

/ {
	chosen {
		zephyr,system-timer = &stm_0;
	};
};
```

## boards/mec15xxevb_assy6853.overlay
```dts
/*
 * Copyright (c) 2023 Intel Corporation
 *
 * SPDX-License-Identifier: Apache-2.0
 */

/ {
	resources {
		compatible = "test-kernel-timer-behavior-external";

		timerout-gpios = <&gpio_140_176 14 GPIO_ACTIVE_LOW>;
	};
};
```

## dts/bindings/timer-behavior-external.yaml
```yaml
# Copyright (c) 2023 Intel Corporation
#
# SPDX-License-Identifier: Apache-2.0

description: |
  Binding providing resources required to build and run the
  tests/kernel/timer/timer_behavior/kernel.timer.timer_behavior_external
  test in Zephyr.

compatible: "test-kernel-timer-behavior-external"

properties:
  timerout-gpios:
    type: phandle-array
    required: true
    description:
      GPIO pin that will toggle on each cycle of the test, to be
      connected to an external tool (such as a logic analyzer)
      that will collect timing information.
```

## src/main.c
```c
/*
 * Copyright (c) 2022 Intel Corporation
 *
 * SPDX-License-Identifier: Apache-2.0
 */

#include <zephyr/ztest.h>

void test_main(void)
{
	ztest_run_test_suite(timer_jitter_drift, false, 1, 1, NULL);
#ifndef CONFIG_TIMER_EXTERNAL_TEST
	ztest_run_test_suite(timer_tick_train, false, 1, 1, NULL);
#endif
	ztest_run_test_suite(timer_ramp, false, 1, 1, NULL);
}
```

## src/jitter_drift.c
```c
/*
 * Copyright (c) 2022 Intel Corporation
 *
 * SPDX-License-Identifier: Apache-2.0
 */

#include <limits.h>
#include <math.h>
#include <stdlib.h>

#include <zephyr/kernel.h>
#include <zephyr/drivers/gpio.h>

#include <zephyr/tc_util.h>
#include <zephyr/ztest.h>

#ifdef CONFIG_TIMER_EXTERNAL_TEST
#define TIMER_OUT_NODE DT_INST(0, test_kernel_timer_behavior_external)
static const struct gpio_dt_spec timer_out = GPIO_DT_SPEC_GET(TIMER_OUT_NODE,
		timerout_gpios);
#endif

static uint32_t periodic_idx;
static uint64_t periodic_data[CONFIG_TIMER_TEST_SAMPLES + 1];
static uint64_t periodic_start, periodic_end;
static struct k_timer periodic_timer;
static struct k_sem periodic_sem;

/*
 * The following code collects periodic time samples using the timer's
 * auto-restart feature based on its period argument.
 */

static void timer_period_fn(struct k_timer *t)
{
	uint64_t curr_cycle;

#ifdef CONFIG_TIMER_EXTERNAL_TEST
	gpio_pin_toggle_dt(&timer_out);
#endif

#ifdef CONFIG_TIMER_HAS_64BIT_CYCLE_COUNTER
	curr_cycle = k_cycle_get_64();
#else
	curr_cycle = k_cycle_get_32();
#endif
	periodic_data[periodic_idx] = curr_cycle;

	if (periodic_idx == 0) {
		periodic_start = curr_cycle;
	}
	++periodic_idx;
	if (periodic_idx >= ARRAY_SIZE(periodic_data)) {
		periodic_end = curr_cycle;
		k_timer_stop(t);
		k_sem_give(&periodic_sem);
	}
}

static void collect_timer_period_time_samples(void)
{
	k_timer_init(&periodic_timer, timer_period_fn, NULL);
	k_timer_start(&periodic_timer, K_NO_WAIT, K_USEC(CONFIG_TIMER_TEST_PERIOD));
}

/*
 * The following code collects periodic time samples by explicitly restarting
 * the timer and relying solely on the timer's start delay argument to
 * create periodicity.
 */

static void timer_startdelay_fn(struct k_timer *t)
{
	uint64_t curr_cycle;

#ifdef CONFIG_TIMER_EXTERNAL_TEST
	gpio_pin_toggle_dt(&timer_out);
#endif

#ifdef CONFIG_TIMER_HAS_64BIT_CYCLE_COUNTER
	curr_cycle = k_cycle_get_64();
#else
	curr_cycle = k_cycle_get_32();
#endif
	periodic_data[periodic_idx] = curr_cycle;

	if (periodic_idx == 0) {
		periodic_start = curr_cycle;
	}
	++periodic_idx;
	if (periodic_idx < ARRAY_SIZE(periodic_data)) {
		k_timer_start(t, K_USEC(CONFIG_TIMER_TEST_PERIOD), K_FOREVER);
	} else {
		periodic_end = curr_cycle;
		k_sem_give(&periodic_sem);
	}
}

static void collect_timer_startdelay_time_samples(void)
{
	k_timer_init(&periodic_timer, timer_startdelay_fn, NULL);
	k_timer_start(&periodic_timer, K_NO_WAIT, K_FOREVER);
}

/* Get a difference in cycles between one timer count and an earlier one
 * accounting for potentially wrapped values.
 *
 * @retval 0 an unhandled wrap of the timer occurred and the value should be ignored
 */
static uint64_t periodic_diff(uint64_t later, uint64_t earlier)
{
	/* Timer wrap around, will be ignored in statistics */
	if (later < earlier) {
		TC_PRINT("WARNING: Caught a timer wrap-around !\n");
		return 0;
	}

	return later - earlier;
}

static double cycles_to_us(uint64_t cycles)
{
	return 1000000.0 * cycles / sys_clock_hw_cycles_per_sec();
}

/**
 * @brief Test a timers jitter and drift over time
 */
static void do_test_using(void (*sample_collection_fn)(void), const char *mechanism)
{
	k_timeout_t actual_timeout = K_USEC(CONFIG_TIMER_TEST_PERIOD);
	uint64_t expected_duration = (uint64_t)actual_timeout.ticks * CONFIG_TIMER_TEST_SAMPLES;

	TC_PRINT("collecting time samples for approx %llu seconds\n",
		 k_ticks_to_ms_ceil64(expected_duration) / MSEC_PER_SEC);

	periodic_idx = 0;
	k_sem_init(&periodic_sem, 0, 1);

	/* Align to tick boundary. Otherwise the first handler execution
	 * might turn out to be significantly late and cause the test to
	 * fail. This can happen if k_timer_start() is called right before
	 * the upcoming tick boundary and in consequence the tick passes
	 * between the moment when the kernel decides what tick to use for
	 * the next timeout and the moment when the system timer actually
	 * sets up that timeout.
	 */
	k_sleep(K_TICKS(1));

	sample_collection_fn();
	k_sem_take(&periodic_sem, K_FOREVER);

	TC_PRINT("periodic timer samples gathered, calculating statistics\n");

	/* calculate variance, and precision */
	uint64_t total_cycles = 0;
	uint32_t periodic_rollovers = 0;

	uint64_t max_cyc = 0;
	uint64_t min_cyc = UINT64_MAX;

	for (int i = 0; i < CONFIG_TIMER_TEST_SAMPLES; i++) {
		uint64_t diff = periodic_diff(periodic_data[i + 1], periodic_data[i]);

		if (diff == 0) {
			periodic_rollovers++;
		} else {
			total_cycles += diff;
			min_cyc = MIN(diff, min_cyc);
			max_cyc = MAX(diff, max_cyc);
		}
	}

#ifndef CONFIG_TIMER_HAS_64BIT_CYCLE_COUNTER
	/*
	 * Account for rollovers if any, and only when k_cycle_get_32()
	 * is used. This should not happen with k_cycle_get_64() and will
	 * be trapped later otherwise.
	 */
	periodic_end += (1ULL << 32) * periodic_rollovers;
#endif

	double min_us = cycles_to_us(min_cyc);
	double max_us = cycles_to_us(max_cyc);

	double mean_cyc =
		(double)total_cycles / (double)(CONFIG_TIMER_TEST_SAMPLES - periodic_rollovers);
	double mean_us = cycles_to_us(total_cycles) /
			 (double)(CONFIG_TIMER_TEST_SAMPLES - periodic_rollovers);
	double variance_us = 0;
	double variance_cyc = 0;

	for (int i = 0; i < CONFIG_TIMER_TEST_SAMPLES; i++) {
		uint64_t diff = periodic_diff(periodic_data[i + 1], periodic_data[i]);

		if (diff != 0) {
			double mean_cyc_diff = (double)diff - mean_cyc;
			double mean_us_diff = cycles_to_us(diff) - mean_us;
			double mean_cyc_diff_sq = mean_cyc_diff * mean_cyc_diff;
			double mean_us_diff_sq = mean_us_diff * mean_us_diff;

			variance_us += mean_us_diff_sq;
			variance_cyc += mean_cyc_diff_sq;
		}
	}

	/* A measure of how wide the distribution is, ideal is 0 */
	variance_us = variance_us / (double)(CONFIG_TIMER_TEST_SAMPLES - periodic_rollovers);
	variance_cyc = variance_cyc / (double)(CONFIG_TIMER_TEST_SAMPLES - periodic_rollovers);

	/* A measure of timer precision, ideal is 0 */
	double stddev_us = sqrt(variance_us);
	double stddev_cyc = sqrt(variance_cyc);

	/* Use double precision math here as integer overflows are possible in doing all the
	 * conversions otherwise
	 */
	double expected_time_us =
		(double)CONFIG_TIMER_TEST_PERIOD * (double)CONFIG_TIMER_TEST_SAMPLES;
	double actual_time_us = cycles_to_us(periodic_end - periodic_start);

	/* While this could be non-integer, the mean should be very close to it over time */
	double expected_period =
		(double)CONFIG_TIMER_TEST_PERIOD * (double)sys_clock_hw_cycles_per_sec()
		/ 1000000.0;
	/*
	 * Expected period drift(us) due to round up/down errors during the
	 * conversion between ticks, cycles and delay.
	 */
	uint32_t cyc_per_tick = sys_clock_hw_cycles_per_sec()
				/ CONFIG_SYS_CLOCK_TICKS_PER_SEC;
	double expected_period_drift = ((double)actual_timeout.ticks * cyc_per_tick
		- expected_period) / sys_clock_hw_cycles_per_sec() * 1000000;
	double expected_time_drift_us = expected_period_drift
		* CONFIG_TIMER_TEST_SAMPLES;
	double time_diff_us = actual_time_us - expected_time_us
		- expected_time_drift_us;
	double time_diff_us_abs = time_diff_us >= 0.0 ? time_diff_us : -time_diff_us;

	/* Allowed jitter is one tick, the scheduling quantum, computed from the
	 * clock rather than a tuning value.
	 */
	uint32_t max_stddev = k_ticks_to_us_ceil32(1);

	TC_PRINT("timer clock rate %u, kernel tick rate %d\n",
		 sys_clock_hw_cycles_per_sec(), CONFIG_SYS_CLOCK_TICKS_PER_SEC);
	if ((USEC_PER_SEC / CONFIG_TIMER_TEST_PERIOD) > CONFIG_SYS_CLOCK_TICKS_PER_SEC) {
		TC_PRINT("test timer period (%u us) is smaller than "
			 "system tick period (%u us)\n",
			 CONFIG_TIMER_TEST_PERIOD, k_ticks_to_us_near32(1));
		zassert_true(expected_period_drift != 0.0);
	}
	if (expected_period_drift != 0.0) {
		TC_PRINT("expected period drift: %.8g us\n", expected_period_drift);
	}
	TC_PRINT("period duration statistics for %d samples (%u rollovers):\n",
		 CONFIG_TIMER_TEST_SAMPLES - periodic_rollovers, periodic_rollovers);
	TC_PRINT("  expected: %d us,       \t%f cycles\n",
		 CONFIG_TIMER_TEST_PERIOD, expected_period);
	TC_PRINT("  min:      %f us, \t%llu cycles\n", min_us, min_cyc);
	TC_PRINT("  max:      %f us, \t%llu cycles\n", max_us, max_cyc);
	TC_PRINT("  mean:     %f us, \t%f cycles\n", mean_us, mean_cyc);
	TC_PRINT("  variance: %f us, \t%f cycles\n", variance_us, variance_cyc);
	TC_PRINT("  stddev:   %f us, \t%f cycles\n", stddev_us, stddev_cyc);
	TC_PRINT("timer start cycle %llu, end cycle %llu,\n"
		 "total time %f us, expected time %f us,\n"
		 "expected time drift %f us, difference %f us\n",
		 periodic_start, periodic_end, actual_time_us, expected_time_us,
		 expected_time_drift_us, time_diff_us);

	/* Record the stats gathered as a JSON object including related CONFIG_* params. */
	TC_PRINT("RECORD: {"
		 "\"testcase\":\"jitter_drift_timer\", \"mechanism\":\"%s\""
		 ", \"stats_count\":%d, \"rollovers\":%d"
		 ", \"mean_us\":%.6f, \"mean_cycles\":%.0f"
		 ", \"stddev_us\":%.6f, \"stddev_cycles\":%.0f"
		 ", \"var_us\":%.6f, \"var_cycles\":%.0f"
		 ", \"min_us\":%.6f, \"min_cycles\":%llu"
		 ", \"max_us\":%.6f, \"max_cycles\":%llu"
		 ", \"timer_start_cycle\": %llu, \"timer_end_cycle\": %llu"
		 ", \"total_time_us\":%.6f"
		 ", \"expected_total_time_us\":%.6f"
		 ", \"expected_total_drift_us\":%.6f"
		 ", \"total_drift_us\":%.6f"
		 ", \"expected_period_cycles\":%.0f"
		 ", \"expected_period_drift_us\":%.6f"
		 ", \"sys_clock_hw_cycles_per_sec\":%u"
		 ", \"CONFIG_SYS_CLOCK_HW_CYCLES_PER_SEC\":%u"
		 ", \"CONFIG_SYS_CLOCK_TICKS_PER_SEC\":%d"
		 ", \"CONFIG_TIMER_TEST_PERIOD\":%d"
		 ", \"CONFIG_TIMER_TEST_SAMPLES\":%d"
		 ", \"MAX_STD_DEV\":%d"
		 "}\n",
		 mechanism,
		 CONFIG_TIMER_TEST_SAMPLES - periodic_rollovers, periodic_rollovers,
		 mean_us, mean_cyc,
		 stddev_us, stddev_cyc,
		 variance_us, variance_cyc,
		 min_us, min_cyc,
		 max_us, max_cyc,
		 periodic_start, periodic_end,
		 actual_time_us,
		 expected_time_us,
		 expected_time_drift_us,
		 time_diff_us,
		 expected_period,
		 expected_period_drift,
		 sys_clock_hw_cycles_per_sec(),
		 (uint32_t)CONFIG_SYS_CLOCK_HW_CYCLES_PER_SEC,
		 CONFIG_SYS_CLOCK_TICKS_PER_SEC,
		 CONFIG_TIMER_TEST_PERIOD,
		 CONFIG_TIMER_TEST_SAMPLES,
		 max_stddev
		 );

	/* Validate the maximum/minimum timer period is within the allowed drift.
	 *
	 * The bound is an absolute time, one tick, computed from the clock rather
	 * than a percentage of the period. A periodic timer is rescheduled in
	 * whole ticks, so a single period can land up to one tick from nominal;
	 * one tick also covers the measurement slop at any realistic tick rate.
	 * It scales with the cycle-to-tick ratio, so a coarse clock (e.g. a
	 * 32 kHz SysTick, where a tick is a large fraction of the period) widens
	 * the bound automatically and needs no per-platform value.
	 */
	double test_period = (double)CONFIG_TIMER_TEST_PERIOD;
	double allowed_drift_us = (double)k_ticks_to_us_ceil32(1);
	double nominal_us = test_period + expected_period_drift;

	/* Report the measured drift as a percentage for readability; the
	 * pass/fail decision below is on the absolute allowed_drift_us bound.
	 */
	TC_PRINT("period drift allowed +/-%f us (%.3g%%); measured min %f us (%.3g%%), "
		 "max %f us (%.3g%%)\n",
		 allowed_drift_us, allowed_drift_us / test_period * 100,
		 nominal_us - min_us, (nominal_us - min_us) / test_period * 100,
		 max_us - nominal_us, (max_us - nominal_us) / test_period * 100);

	zassert_true(max_us <= nominal_us + allowed_drift_us,
		"Longest timer period %f us too long: drift %f us (%.3g%%) exceeds allowed %f us",
		max_us, max_us - nominal_us, (max_us - nominal_us) / test_period * 100,
		allowed_drift_us);

	/* The low-side bound (nominal - one tick) only carries information while
	 * the nominal period stays above one tick. A period can never be
	 * negative, so once the period is within a tick of zero, "one tick short"
	 * permits an arbitrarily short period and the assertion can no longer
	 * fail. Skip it there rather than run a check that always passes; at that
	 * resolution the short side is constrained by the jitter (stddev) and
	 * total-drift checks below.
	 */
	if (nominal_us > allowed_drift_us) {
		zassert_true(min_us >= nominal_us - allowed_drift_us,
			"Shortest timer period %f us too short: drift %f us (%.3g%%) exceeds allowed %f us",
			min_us, nominal_us - min_us, (nominal_us - min_us) / test_period * 100,
			allowed_drift_us);
	} else {
		TC_PRINT("nominal period (%f us) is within one tick; short-side bound "
			 "not applicable, see stddev and total drift\n", nominal_us);
	}

	/* Validate the timer deviation (precision/jitter of the timer) is within a configurable
	 * bound
	 */
	zassert_true(stddev_us < (double)max_stddev,
		     "Standard deviation (in microseconds) outside expected bound");

	/* Validate the timer accuracy over time: the total measured time must
	 * not drift from the model by as much as a whole period. That "within
	 * one period" allowance is the test period itself, so no separate tuning
	 * value is needed.
	 */
	zassert_true(time_diff_us_abs < test_period,
		     "Total drift %f us exceeds one period (%f us)",
		     time_diff_us_abs, test_period);
}

/**
 * @brief Measure jitter and drift of a periodic timer
 *
 * @details Collect expiry samples from a periodic timer using its built-in
 * auto-restart and verify the jitter and drift relative to the configured
 * period stay within expected bounds.
 *
 * @ingroup kernel_timer_tests
 * @see k_timer_start()
 * @verifies ZEP-SRS-4-5
 */
ZTEST(timer_jitter_drift, test_jitter_drift_timer_period)
{
	TC_PRINT("periodic timer behavior test using built-in restart mechanism\n");
#ifdef CONFIG_TIMER_EXTERNAL_TEST
	TC_PRINT("===== External Tool Sync Point =====\n");
	TC_PRINT("===== builtin =====\n");
	TC_PRINT("===== Waiting %d seconds =====\n",
		 CONFIG_TIMER_EXTERNAL_TEST_SYNC_DELAY);
	k_sleep(K_SECONDS(CONFIG_TIMER_EXTERNAL_TEST_SYNC_DELAY));
	gpio_pin_configure_dt(&timer_out, GPIO_OUTPUT_LOW);
#endif
	do_test_using(collect_timer_period_time_samples, "builtin");
}

/**
 * @brief Measure jitter and drift of a timer restarted with a delay
 *
 * @details Collect expiry samples by explicitly restarting the timer with a
 * delay each period and verify the jitter and drift relative to the configured
 * period stay within expected bounds.
 *
 * @ingroup kernel_timer_tests
 * @see k_timer_start()
 * @verifies ZEP-SRS-4-5
 */
ZTEST(timer_jitter_drift, test_jitter_drift_timer_startdelay)
{
	TC_PRINT("periodic timer behavior test using explicit start with delay\n");
#ifdef CONFIG_TIMER_EXTERNAL_TEST
	TC_PRINT("===== External Tool Sync Point =====\n");
	TC_PRINT("===== startdelay =====\n");
	TC_PRINT("===== Waiting %d seconds =====\n",
		 CONFIG_TIMER_EXTERNAL_TEST_SYNC_DELAY);
	k_sleep(K_SECONDS(CONFIG_TIMER_EXTERNAL_TEST_SYNC_DELAY));
	gpio_pin_configure_dt(&timer_out, GPIO_OUTPUT_LOW);
#endif
	do_test_using(collect_timer_startdelay_time_samples, "startdelay");
}

ZTEST_SUITE(timer_jitter_drift, NULL, NULL, NULL, NULL, NULL);
```

## src/ramp.c
```c
/*
 * SPDX-FileCopyrightText: Copyright (c) 2026 Infineon Technologies AG,
 * SPDX-FileCopyrightText: or an affiliate of Infineon Technologies AG.
 *
 * SPDX-License-Identifier: Apache-2.0
 */

#include <zephyr/kernel.h>
#include <zephyr/drivers/gpio.h>

#include <zephyr/tc_util.h>
#include <zephyr/ztest.h>


#ifdef CONFIG_TIMER_HAS_64BIT_CYCLE_COUNTER
typedef uint64_t cycle_t;
#define ramp_cycle_get()         k_cycle_get_64()
#define ramp_cyc_to_ticks(c)     k_cyc_to_ticks_floor64(c)
#define CYCLE_FMT                "%llu"
#else
typedef uint32_t cycle_t;
#define ramp_cycle_get()         k_cycle_get_32()
#define ramp_cyc_to_ticks(c)     k_cyc_to_ticks_floor32(c)
#define CYCLE_FMT                "%u"
#endif

K_SEM_DEFINE(ramp_sem, 0, 1);
static cycle_t start_cycle;
static cycle_t end_cycle;

static void tm_fn(struct k_timer *tm)
{
	end_cycle = ramp_cycle_get();
	k_sem_give(&ramp_sem);
}

static struct k_timer tm;

/**
 * @brief Test timers can be scheduled in a ramp
 *
 * Schedules timers in a ramp of delays to verify that within a reasonable range of
 * timeouts are schedulable correctly.
 *
 * It could be that some timer drivers might have difficulty in scheduling some
 * time periods but not others due to implementation details. This test should catch those.
 *
 * The ramp is logrithmic up to what amounts to approximately 10 seconds of ticks.
 *
 * @ingroup kernel_timer_tests
 * @see k_timer_start()
 * @verifies ZEP-SRS-4-5
 */
ZTEST(timer_ramp, test_timer_ramp)
{
	bool failed = false;
	uint32_t delay = 1;

	k_timer_init(&tm, tm_fn, NULL);

	while ((delay/CONFIG_SYS_CLOCK_TICKS_PER_SEC) < 10) {
		start_cycle = ramp_cycle_get();
		k_timer_start(&tm, K_TICKS(delay), K_NO_WAIT);
		k_sem_take(&ramp_sem, K_FOREVER);

		cycle_t delta_cycles = end_cycle - start_cycle;
		uint32_t delta_ticks = ramp_cyc_to_ticks(delta_cycles);

		if (delta_ticks > (delay + 1) || delta_ticks < delay) {
			TC_PRINT("failed: delay of %d ticks , actual %d (" CYCLE_FMT " cycles)\n",
				 delay, delta_ticks, delta_cycles);
			failed = true;
		} else {
			TC_PRINT("passed: delay of %d ticks, actual %d (" CYCLE_FMT " cycles)\n",
				 delay, delta_ticks, delta_cycles);
		}
		delay = delay*2;
	}

	zassert(failed != true, "Failed ramp test");
}

ZTEST_SUITE(timer_ramp, NULL, NULL, NULL, NULL, NULL);
```

## src/tick_timer_train.c
```c
/*
 * Copyright (c) 2022 Intel Corporation
 *
 * SPDX-License-Identifier: Apache-2.0
 */

#include <zephyr/kernel.h>
#include <zephyr/sys/time_units.h>
#include <zephyr/tc_util.h>
#include <zephyr/ztest.h>

#define TIMERS_CNT 4
#define TEST_SECONDS 10
#define MAX_CALLBACKS (CONFIG_SYS_CLOCK_TICKS_PER_SEC*TEST_SECONDS)/TIMERS_CNT

struct timer_wrapper {
	int64_t last_scheduled;
	struct k_timer tm;
	uint32_t callbacks;
	uint32_t late_callbacks;
	uint32_t last_isr;
	uint32_t max_delta;
};

K_SEM_DEFINE(timers_sem, 0, K_SEM_MAX_LIMIT);

struct timer_wrapper timers[TIMERS_CNT];

static void tm_fn(struct k_timer *tm)
{
	struct timer_wrapper *tm_wrap =
		CONTAINER_OF(tm, struct timer_wrapper, tm);
	uint32_t now = k_cycle_get_32();

	if (tm_wrap->last_isr != 0) {
		uint32_t delta = now - tm_wrap->last_isr;

		tm_wrap->max_delta = delta > tm_wrap->max_delta ? delta : tm_wrap->max_delta;
		if (delta >= k_ticks_to_cyc_floor32(TIMERS_CNT + 1)) {
			tm_wrap->late_callbacks++;
		}
	}
	tm_wrap->last_isr = now;
	tm_wrap->callbacks++;
	if (tm_wrap->callbacks >= MAX_CALLBACKS) {
		k_timer_stop(tm);
		k_sem_give(&timers_sem);
	} else {
		int64_t next = tm_wrap->last_scheduled + TIMERS_CNT;

		tm_wrap->last_scheduled = next;
		k_timer_start(tm, K_TIMEOUT_ABS_TICKS(next), K_NO_WAIT);
	}
}


/**
 * @brief Test timers can be scheduled 1 tick apart without issues
 *
 * Schedules timers with absolute scheduling with a 1 tick
 * period. Measures the total time elapsed and tries to run
 * some fake busy work while doing so. If the print outs don't show up or
 * the timer train is late to the station, the test fails.
 *
 * @ingroup kernel_timer_tests
 * @see k_timer_start()
 * @see K_TIMEOUT_ABS_TICKS
 * @verifies ZEP-SRS-4-5
 * @verifies ZEP-SRS-28-14
 * @verifies ZEP-SRS-28-18
 */
ZTEST(timer_tick_train, test_one_tick_timer_train)
{
	const uint32_t max_time = TEST_SECONDS*1000 + 1000;

	TC_PRINT("Initializing %u Timers, Tick Rate %uHz, Expecting %u callbacks in %u ms\n",
		 TIMERS_CNT, CONFIG_SYS_CLOCK_TICKS_PER_SEC, MAX_CALLBACKS, max_time);

	for (int i = 0; i < TIMERS_CNT; i++) {
		k_timer_init(&timers[i].tm, tm_fn, NULL);
		timers[i].max_delta = 0;
	}

	TC_PRINT("Starting Timers with Skews\n");
	int64_t tick = k_uptime_ticks();

	for (int i = 0; i < TIMERS_CNT; i++) {
		timers[i].last_scheduled = tick + i;
		k_timer_start(&timers[i].tm, K_TIMEOUT_ABS_TICKS(timers[i].last_scheduled),
			      K_NO_WAIT);
	}

#ifdef CONFIG_TIMER_HAS_64BIT_CYCLE_COUNTER
	uint64_t start_cycle = k_cycle_get_64();
#else
	uint32_t start_time_ms = k_uptime_get();
#endif

	uint32_t remaining_timers = TIMERS_CNT;

	/* Do work in the meantime, proving there's enough time to do other things */
	uint32_t busy_loops = 0;

	while (true) {
		while (k_sem_take(&timers_sem, K_NO_WAIT) == 0) {
			remaining_timers--;

		}
		if (remaining_timers == 0) {
			break;
		}
		TC_PRINT("Faking busy work, remaining timers is %u, timer callbacks %u\n",
			 remaining_timers, timers[0].callbacks);
		busy_loops++;
		k_busy_wait(250000);
	}

#ifdef CONFIG_TIMER_HAS_64BIT_CYCLE_COUNTER
	uint64_t end_cycle = k_cycle_get_64();
#else
	uint64_t end_time_ms = k_uptime_get();
#endif

#ifdef CONFIG_TIMER_HAS_64BIT_CYCLE_COUNTER
	uint64_t delta_cycles = end_cycle - start_cycle;
	uint32_t delta_time = k_cyc_to_ms_floor32(delta_cycles);
#else
	uint32_t delta_time = end_time_ms - start_time_ms;
#endif

	TC_PRINT("One Tick Timer Train Done, took %u ms, busy loop ran %u times\n",
		 delta_time, busy_loops);

	uint32_t max_delta = 0;

	TC_PRINT("    Perfect delta %u cycles or %u us\n",
		 k_ticks_to_cyc_floor32(TIMERS_CNT), k_ticks_to_us_near32(TIMERS_CNT));
	for (int i = 0; i < TIMERS_CNT; i++) {
		TC_PRINT("Timer %d max delta %u cycles or %u us, "
			 "%u late callbacks (%u.%u%%)\n",
			 i, timers[i].max_delta,
			 k_cyc_to_us_near32(timers[i].max_delta),
			 timers[i].late_callbacks,
			 (1000 * timers[i].late_callbacks + MAX_CALLBACKS/2) / MAX_CALLBACKS / 10,
			 (1000 * timers[i].late_callbacks + MAX_CALLBACKS/2) / MAX_CALLBACKS % 10);
		/* Record the stats gathered as a JSON object including related CONFIG_* params. */
		TC_PRINT("RECORD: {"
			 "\"testcase\":\"one_tick_timer_train\""
			 ", \"timer\":%d, \"max_delta_cycles\":%u, \"max_delta_us\":%u"
			 ", \"late_callbacks\":%u"
			 ", \"perfect_delta_cycles\":%u, \"perfect_delta_us\":%u"
			 ", \"train_time_ms\":%u, \"busy_loops\":%u"
			 ", \"timers\":%u, \"expected_callbacks\":%u, \"expected_time_ms\":%u"
			 ", \"CONFIG_SYS_CLOCK_TICKS_PER_SEC\":%u"
			 "}\n",
			 i, timers[i].max_delta, k_cyc_to_us_near32(timers[i].max_delta),
			 timers[i].late_callbacks,
			 k_ticks_to_cyc_floor32(TIMERS_CNT), k_ticks_to_us_near32(TIMERS_CNT),
			 delta_time, busy_loops,
			 TIMERS_CNT, MAX_CALLBACKS, max_time,
			 CONFIG_SYS_CLOCK_TICKS_PER_SEC
			 );
		max_delta = timers[i].max_delta > max_delta ? timers[i].max_delta : max_delta;
		k_timer_stop(&timers[i].tm);
	}

	if (max_delta >= k_ticks_to_cyc_floor32(TIMERS_CNT + 1)) {
		TC_PRINT("!! Some ticks were missed.\n");
		TC_PRINT("!! Consider making CONFIG_SYS_CLOCK_TICKS_PER_SEC smaller.\n");
		/* should this fail the test? */
	}

	const uint32_t maximum_busy_loops = TEST_SECONDS * 4;

	if (busy_loops < (maximum_busy_loops - maximum_busy_loops/10)) {
		TC_PRINT("!! The busy loop didn't run as much as expected.\n");
		TC_PRINT("!! Consider making CONFIG_SYS_CLOCK_TICKS_PER_SEC smaller.\n");
	}

	/* On some platforms, where the tick period is short, like on nRF
	 * platforms where it is ~30 us, execution of the timer handlers
	 * can take significant part of the CPU time, so accept if at least
	 * one-third of possible busy loop iterations is actually performed.
	 */
	const uint32_t acceptable_busy_loops = maximum_busy_loops / 3;

	zassert_true(busy_loops > acceptable_busy_loops,
		     "Expected thread to run while 1 tick timers are firing");

	zassert_true(delta_time < max_time,
		     "Expected timer train to finish in under %u milliseconds, took %u", max_time,
		     delta_time);
}

ZTEST_SUITE(timer_tick_train, NULL, NULL, NULL, NULL, NULL);
```
