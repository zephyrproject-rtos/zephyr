/*
 * Copyright (c) 2023 Intel Corporation
 *
 * SPDX-License-Identifier: Apache-2.0
 */

/ {
    resources {
        compatible = "test-kernel-timer-behavior-external";

        timerout-gpios = <&gpioc 3 GPIO_ACTIVE_LOW>; /* Arduino D7 */
    };
};
