/*
 * Copyright (c) 2023 Intel Corporation
 *
 * SPDX-License-Identifier: Apache-2.0
 */

/ {
	resources {
		compatible = "test-kernel-timer-behavior-external";

		timerout-gpios = <&gpio_140_176 14 GPIO_ACTIVE_LOW>;
	};
};
