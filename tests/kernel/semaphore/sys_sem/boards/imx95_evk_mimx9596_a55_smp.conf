## tests/kernel/semaphore/sys_sem/boards/imx95_evk_mimx9596_a55_smp.conf
```kconfig
#
# Copyright 2024 NXP
#
# SPDX-License-Identifier: Apache-2.0

CONFIG_MAX_THREAD_BYTES=5
```

## tests/kernel/semaphore/sys_sem/testcase.yaml
```yaml
tests:
  kernel.semaphore.usage:
    filter: CONFIG_ARCH_HAS_USERSPACE
    arch_exclude:
      - posix
    tags:
      - kernel
      - userspace
    ignore_faults: true
```

## tests/kernel/sleep/testcase.yaml
```yaml
tests:
  kernel.common.timing:
    tags:
      - kernel
      - sleep
    platform_exclude:
      - npcx4m8f_evb
      - npcx7m6fb_evb
      - npcx9m6f_evb
  kernel.common.timing.minimallibc:
    filter: CONFIG_MINIMAL_LIBC_SUPPORTED
    tags:
      - kernel
      - sleep
      - libc
    extra_configs:
      - CONFIG_MINIMAL_LIBC=y
```

## tests/kernel/smp/Kconfig
```kconfig
# Copyright (c) 2023 Intel Corporation
# SPDX-License-Identifier: Apache-2.0

mainmenu "SMP test"

source "Kconfig.zephyr"

config SMP_TEST_RUN_FACTOR
	int "Run factor for stressing tests, such as 'switch torture', \
		as a percentage"
	default 100

config SMP_IPI_NUM_ITERS
	int "Number of iterations to run the SMP IPI test"
	default 3
	help
	  Number of times to run the SMP IPI broadcast test.

config SMP_IPI_WAIT_MS
	int "Milliseconds to wait for SMP IPI per iteration"
	default 100
	help
	  How long to wait for broadcast IPI to be processed
	  on other processor(s).

config SMP_IPI_WAIT_RETRIES
	int "Retries to wait for SMP IPI per iteration"
	default 3
	help
	  Number of retries waiting for broadcast IPI to be
	  processed on other processor(s). Each retry the wait
	  is for CONFIG_SMP_IPI_WAIT_MS milliseconds.
```

## tests/kernel/smp/boards/intel_adsp_ace40_nvl.conf
```kconfig
# SPDX-License-Identifier: Apache-2.0

CONFIG_SOC_SERIES_INTEL_ADSP_ACE_NUM_SPIN_RELAX_NOPS_ADD_CPU_ID=y
```

## tests/kernel/smp/boards/qemu_cortex_a53_smp.conf
```kconfig
# Copyright (c) 2022 Carlo Caione <ccaione@baylibre.com>
# SPDX-License-Identifier: Apache-2.0

CONFIG_MP_NUM_CPUS=4
```

## tests/kernel/smp/testcase.yaml
```yaml
common:
  timeout: 120
tests:
  kernel.multiprocessing.smp:
    tags:
      - kernel
      - smp
    ignore_faults: true
    filter: (CONFIG_MP_MAX_NUM_CPUS > 1)
  kernel.multiprocessing.smp.minimallibc:
    tags:
      - kernel
      - smp
      - libc
    ignore_faults: true
    filter: (CONFIG_MP_MAX_NUM_CPUS > 1) and CONFIG_MINIMAL_LIBC_SUPPORTED
    extra_configs:
      - CONFIG_MINIMAL_LIBC=y
  kernel.multiprocessing.smp.affinity:
    tags:
      - kernel
      - smp
    ignore_faults: true
    filter: (CONFIG_MP_MAX_NUM_CPUS > 1)
    extra_configs:
      - CONFIG_SCHED_CPU_MASK=y

  kernel.multiprocessing.smp.affinity.custom_rom_offset:
    tags:
      - kernel
      - smp
    ignore_faults: true
    filter: (CONFIG_MP_MAX_NUM_CPUS > 1)
    platform_exclude:
      - qemu_riscv64/qemu_virt_riscv64/smp # qemu_riscv64 doesn't support custom ROM offset
      - qemu_riscv32/qemu_virt_riscv32/smp # qemu_riscv32 doesn't support custom ROM offset
    extra_configs:
      - CONFIG_SCHED_CPU_MASK=y
      - CONFIG_ROM_START_OFFSET=0x80
```

## tests/kernel/smp_abort/testcase.yaml
```yaml
tests:
  kernel.smp_abort:
    arch_exclude: x86  # Buggy irq_offload(), see #71172
    tags:
      - kernel
      - smp
    filter: (CONFIG_MP_MAX_NUM_CPUS > 1)
```

## tests/kernel/smp_boot_delay/boards/qemu_x86_64.conf
```kconfig
# Copyright (c) 2023 Intel Corporation
#
# SPDX-License-Identifier: Apache-2.0

CONFIG_MP_MAX_NUM_CPUS=4
```

## tests/kernel/smp_boot_delay/testcase.yaml
```yaml
tests:
  kernel.multiprocessing.smp_boot_delay:
    tags:
      - kernel
      - smp
    platform_allow: intel_adsp/cavs25 qemu_x86_64
    integration_platforms:
      - qemu_x86_64
  kernel.multiprocessing.smp_boot_delay.minimallibc:
    filter: CONFIG_MINIMAL_LIBC_SUPPORTED
    tags:
      - kernel
      - smp
      - libc
    platform_allow: intel_adsp/cavs25 qemu_x86_64
    integration_platforms:
      - qemu_x86_64
    extra_configs:
      - CONFIG_MINIMAL_LIBC=y
```

## tests/kernel/smp_cache/testcase.yaml
```yaml
tests:
  kernel.smp.cache:
    tags:
      - kernel
      - smp
      - cache
    filter: CONFIG_MP_MAX_NUM_CPUS > 1
    min_ram: 64
    platform_exclude:
      - qemu_x86
    arch_exclude:
      - posix
  kernel.smp.cache.cpu_mask:
    tags:
      - kernel
      - smp
      - cache
    filter: CONFIG_MP_MAX_NUM_CPUS > 1
    min_ram: 64
    platform_exclude:
      - qemu_x86
    arch_exclude:
      - posix
    extra_configs:
      - CONFIG_SCHED_CPU_MASK=y
```

## tests/kernel/smp_metairq/testcase.yaml
```yaml
tests:
  kernel.smp_metairq:
    tags:
      - kernel
      - smp
    filter: (CONFIG_MP_MAX_NUM_CPUS > 1)
```

## tests/kernel/smp_suspend/testcase.yaml
```yaml
tests:
  kernel.smp_suspend:
    tags:
      - kernel
      - smp
    timeout: 600
    filter: (CONFIG_MP_MAX_NUM_CPUS > 1)
```

## tests/kernel/spinlock/Kconfig
```kconfig
# Copyright (c) 2023 Meta
#
# SPDX-License-Identifier: Apache-2.0

source "Kconfig.zephyr"

config TEST_TRYLOCK_RETRIES
	int "Max number of retries to ensure contention"
	default 10
	help
	  The k_spin_trylock() function will return an error code in the case that the lock is owned
	  by another thread and generally speaking, that is a type of resource contention. For this
	  particular test, we actually do want to see trylock fail, because that is of course a code
	  path that needs to be tested.

	  This option will retry the test up to CONFIG_TEST_TRYLOCK_RETRIES times if a failure is
	  not seen in an attempt to elicit the desired code path.
```

## tests/kernel/spinlock/spinlock_held_lock/testcase.yaml
```yaml
tests:
  kernel.spinlock.held_lock:
    tags:
      - kernel
      - spinlock
    filter: CONFIG_SPIN_VALIDATE and not CONFIG_SMP
```

## tests/kernel/spinlock/testcase.yaml
```yaml
tests:
  kernel.multiprocessing.spinlock:
    tags:
      - kernel
      - smp
      - spinlock
    filter: CONFIG_SMP and CONFIG_MP_MAX_NUM_CPUS > 1 and CONFIG_MP_MAX_NUM_CPUS <= 4
    depends_on:
      - smp
  kernel.multiprocessing.spinlock.minimallibc:
    tags:
      - kernel
      - smp
      - spinlock
      - libc
    filter: CONFIG_SMP and CONFIG_MP_MAX_NUM_CPUS > 1 and CONFIG_MP_MAX_NUM_CPUS <= 4 and
      CONFIG_MINIMAL_LIBC_SUPPORTED
    depends_on:
      - smp
    extra_configs:
      - CONFIG_MINIMAL_LIBC=y
  kernel.multiprocessing.spinlock_fairness:
    tags:
      - kernel
      - smp
      - spinlock
    filter: CONFIG_SMP and CONFIG_MP_MAX_NUM_CPUS > 1 and CONFIG_MP_MAX_NUM_CPUS <= 4
    depends_on:
      - smp
    extra_configs:
      - CONFIG_SCHED_CPU_MASK=y
      - CONFIG_TICKET_SPINLOCKS=y
```

## tests/kernel/stack/stack/testcase.yaml
```yaml
tests:
  kernel.stack.usage:
    tags:
      - kernel
      - userspace
      - pearl_gecko
    ignore_faults: true
```

## tests/kernel/static_idt/testcase.yaml
```yaml
tests:
  kernel.interrupt:
    arch_whitelist: x86
    tags: bat_commit core ignore_faults
```

## tests/kernel/sys_irq/direct_irq/testcase.yaml
```yaml
tests:
  kernel.sys_irq.direct_irq:
    platform_allow:
      - nrf5340dk/nrf5340/cpuapp
      - nrf5340dk/nrf5340/cpunet
  kernel.sys_irq.direct_irq.lto:
    extra_configs:
      - CONFIG_LTO=y
    platform_allow:
      - nrf5340dk/nrf5340/cpuapp
      - nrf5340dk/nrf5340/cpunet
```

## tests/kernel/sys_irq/irq/boards/nrf54l15dk_nrf54l15_cpuapp.conf
```kconfig
# Copyright (c) 2025 Nordic Semiconductor
# SPDX-License-Identifier: Apache-2.0

CONFIG_GEN_ISR_TABLES=n
```

## tests/kernel/sys_irq/irq/testcase.yaml
```yaml
tests:
  kernel.sys_irq.irq:
    platform_allow:
      - nrf54l15dk/nrf54l15/cpuapp
      - nrf54l15dk/nrf54l15/cpuflpr
      - nrf5340dk/nrf5340/cpuapp
      - nrf5340dk/nrf5340/cpunet
  kernel.sys_irq.irq.lto:
    extra_configs:
      - CONFIG_LTO=y
    platform_allow:
      - nrf54l15dk/nrf54l15/cpuapp
      - nrf54l15dk/nrf54l15/cpuflpr
      - nrf5340dk/nrf5340/cpuapp
      - nrf5340dk/nrf5340/cpunet
```

## tests/kernel/sys_irq/shared_irq/boards/nrf5340dk_nrf5340_cpuapp.conf
```kconfig
# Copyright (c) 2024 Nordic Semiconductor
# SPDX-License-Identifier: Apache-2.0

CONFIG_GEN_ISR_TABLES=n
CONFIG_GEN_IRQ_VECTOR_TABLE=n
```
