/* Copyright 2022 Carlo Caione <ccaione@baylibre.com>
 * SPDX-License-Identifier: Apache-2.0
 */

/ {
	cpus {
		cpu@2 {
			compatible = "intel,x86_64";
			reg = <2>;
			device_type = "cpu";
		};

		cpu@3 {
			compatible = "intel,x86_64";
			reg = <3>;
			device_type = "cpu";
		};
	};
};
