## CMakeLists.txt
```
# SPDX-License-Identifier: Apache-2.0

cmake_minimum_required(VERSION 3.28.0)
find_package(Zephyr REQUIRED HINTS $ENV{ZEPHYR_BASE})
project(smp)

target_sources(app PRIVATE src/main.c)

target_include_directories(app PRIVATE
  ${ZEPHYR_BASE}/kernel/include
  ${ZEPHYR_BASE}/arch/${ARCH}/include
  )
```

## Kconfig
```
# Copyright (c) 2024 Intel Corporation
# SPDX-License-Identifier: Apache-2.0

mainmenu "SMP suspend test"

source "Kconfig.zephyr"

config SMP_TEST_RELAX
	int "A delay to compensate for spinlock bias induced by arch_spin_relax"
	default 16
```

## prj.conf
```kconfig
CONFIG_ZTEST=y
CONFIG_SMP=y
```

## src/main.c
```c
/*
 * Copyright (c) 2024 Intel Corporation.
 *
 * SPDX-License-Identifier: Apache-2.0
 */

#include <zephyr/tc_util.h>
#include <zephyr/ztest.h>
#include <zephyr/kernel.h>

#if CONFIG_MP_MAX_NUM_CPUS < 2
#error "SMP test requires at least two CPUs!"
#endif

#define STACK_SIZE 1024 + CONFIG_TEST_EXTRA_STACK_SIZE

#define NUM_THREADS 6

K_THREAD_STACK_ARRAY_DEFINE(thread_stack, NUM_THREADS, STACK_SIZE);
struct k_thread thread[NUM_THREADS];

volatile uint64_t thread_counter[NUM_THREADS];

static void thread_entry(void *p1, void *p2, void *p3)
{
	struct k_thread *resume_thread = p1;
	unsigned int self_index = (unsigned int)(uintptr_t)p2;

	while (1) {
		if (resume_thread != NULL) {
			k_thread_resume(resume_thread);
		}

		thread_counter[self_index]++;

		/*
		 * Contentious spinlocks embedded within tight loops (such as
		 * this one) have a CPU bias induced by arch_spin_relax(). We
		 * counteract this by introducing a configurable delay so that
		 * other threads have a chance to acquire the spinlock and
		 * prevent starvation.
		 */

		for (volatile unsigned int i = 0;
		     i < CONFIG_SMP_TEST_RELAX;
		     i++) {
		}

		if (self_index != 0) {
			k_thread_suspend(k_current_get());
		}
	}
}

/**
 * @brief Verify that chained cross-CPU suspend and resume never starves a
 *        thread.
 *
 * @ingroup kernel_smp_tests
 *
 * @details
 * The threads form a chain. Thread 0 never suspends itself: on every
 * iteration it resumes thread 1 and keeps running. Every other thread
 * resumes its successor, if it has one, and then suspends itself until
 * its predecessor resumes it again, so the set of runnable threads is
 * constantly being handed around between CPUs. A lost resume, or
 * a CPU bias in the spinlock relax path, would leave one thread permanently
 * suspended or starved. The test detects that by sampling every thread's
 * iteration counter once a second and requiring all of them to keep
 * advancing.
 *
 * Test steps:
 * - Create NUM_THREADS threads at descending priorities, each suspended before
 *   it is started.
 * - Resume the first thread to start the chain.
 * - Every second, for fifteen iterations, compare each thread's counter
 *   against the value sampled in the previous iteration.
 *
 * Expected result:
 * - Every thread's counter advances in every sampling interval; none of them
 *   is starved.
 *
 * @see k_thread_suspend()
 * @see k_thread_resume()
 *
 * @verifies ZEP-SRS-34-10
 */
ZTEST(smp_suspend_resume, test_smp_thread_suspend_resume_stress)
{
	unsigned int  i;
	uint64_t counter[NUM_THREADS] = {};

	/* Create the threads */

	printk("Starting ...\n");

	for (i = 0; i < NUM_THREADS; i++) {

		k_thread_create(&thread[i], thread_stack[i],
				STACK_SIZE, thread_entry,
				i < (NUM_THREADS - 1) ? &thread[i + 1] : NULL,
				(void *)(uintptr_t)i, NULL,
				10 - i, 0, K_FOREVER);

		k_thread_suspend(&thread[i]);

		k_thread_start(&thread[i]);
	}

	/*
	 * All newly created test threads are currently in the suspend state.
	 * Start the first thread.
	 */

	k_thread_resume(&thread[0]);

	for (unsigned int iteration = 0; iteration < 15; iteration++) {
		k_sleep(K_MSEC(1000));

		for (i = 0; i < NUM_THREADS; i++) {
			zassert_false(counter[i] == thread_counter[i],
				      " -- Thread %u is starving: %llu\n",
				      i, thread_counter[i]);

			counter[i] = thread_counter[i];

		}
	}
}

ZTEST_SUITE(smp_suspend_resume, NULL, NULL, NULL, NULL, NULL);
```
