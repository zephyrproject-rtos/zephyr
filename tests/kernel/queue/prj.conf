## CMakeLists.txt
```
# SPDX-License-Identifier: Apache-2.0

cmake_minimum_required(VERSION 3.28.0)
find_package(Zephyr REQUIRED HINTS $ENV{ZEPHYR_BASE})
project(queue)

FILE(GLOB app_sources src/*.c)
target_sources(app PRIVATE ${app_sources})
```

## prj.conf
```kconfig
CONFIG_ZTEST=y
CONFIG_IRQ_OFFLOAD=y
CONFIG_POLL=y
CONFIG_TEST_USERSPACE=y
CONFIG_ZTEST_FATAL_HOOK=y
CONFIG_MAX_THREAD_BYTES=8
```

## prj_poll.conf
```kconfig
CONFIG_ZTEST=y
CONFIG_IRQ_OFFLOAD=y
CONFIG_POLL=y
CONFIG_TEST_USERSPACE=y
```

## src/main.c
```c
/*
 * Copyright (c) 2017 Intel Corporation
 *
 * SPDX-License-Identifier: Apache-2.0
 */

#include <zephyr/ztest.h>
#include "test_queue.h"

#ifdef CONFIG_64BIT
#define MAX_SZ	128
#else
#define MAX_SZ	96
#endif
K_HEAP_DEFINE(test_pool, MAX_SZ * 4 + 128);

/*test case main entry*/
void *queue_test_setup(void)
{
	k_thread_heap_assign(k_current_get(), &test_pool);

	return NULL;
}

ZTEST_SUITE(queue_api, NULL, queue_test_setup, NULL, NULL, NULL);
ZTEST_SUITE(queue_api_1cpu, NULL, queue_test_setup,
		ztest_simple_1cpu_before, ztest_simple_1cpu_after, NULL);
```

## src/test_queue.h
```c
/*
 * Copyright (c) 2017 Intel Corporation.
 *
 * SPDX-License-Identifier: Apache-2.0
 */

#ifndef __TEST_FIFO_H__
#define __TEST_FIFO_H__

#include <zephyr/ztest.h>
#include <zephyr/irq_offload.h>
#include <zephyr/ztest_error_hook.h>

extern struct k_heap test_pool;

typedef struct qdata {
	sys_snode_t snode;
	uint32_t data;
	bool allocated;
} qdata_t;
#endif
```

## src/test_queue_fail.c
```c
/*
 * Copyright (c) 2017 Intel Corporation
 *
 * SPDX-License-Identifier: Apache-2.0
 */

#include "test_queue.h"

#define TIMEOUT K_MSEC(100)
#define STACK_SIZE (512 + CONFIG_TEST_EXTRA_STACK_SIZE)
#define LIST_LEN 2

static K_THREAD_STACK_DEFINE(tstack, STACK_SIZE);
static struct k_thread tdata;
K_SEM_DEFINE(sem, 0, 1);

/*test cases*/
/**
 * @brief Verify k_queue_get() on an empty queue returns NULL.
 *
 * @details
 * With no data queued, k_queue_get() must return NULL rather than block forever
 * or return stale data. Checked both with K_NO_WAIT (immediate) and with a finite
 * timeout that is allowed to expire.
 *
 * Test steps:
 * - Initialize an empty queue.
 * - Call k_queue_get() with K_NO_WAIT and verify it returns NULL.
 * - Call k_queue_get() with a finite timeout and verify it returns NULL.
 *
 * Expected result:
 * - Both k_queue_get() calls return NULL.
 *
 * @ingroup tests_kernel_queue
 *
 * @see k_queue_get()
 * @verifies ZEP-SRS-20-6
 */
ZTEST(queue_api_1cpu, test_queue_get_fail)
{
	static struct k_queue queue;

	k_queue_init(&queue);
	/**TESTPOINT: queue get returns NULL*/
	zassert_is_null(k_queue_get(&queue, K_NO_WAIT), NULL);
	zassert_is_null(k_queue_get(&queue, TIMEOUT), NULL);
}

/* The sub-thread entry */
static void tThread_entry(void *p1, void *p2, void *p3)
{
	k_sem_give(&sem);

	/* wait the queue for data */
	qdata_t *p = k_queue_get((struct k_queue *)p1, K_FOREVER);

	zassert_equal(p, p2, "Failed to append a unnormal list");
}

/**
 * @brief Test k_queue_append_list() failure scenario
 *
 * @details According to the API k_queue_append_list to
 * design some error condition to verify error branch of
 * the API.
 *	1. Verify that the list's head is empty.
 *	2. Verify that the list's tail is empty.
 *	3. Verify that append list to the queue when a
 * sub-thread is waiting for data.
 *
 * @ingroup tests_kernel_queue
 *
 * @see k_queue_append_list()
 * @verifies ZEP-SRS-20-11
 */
ZTEST(queue_api, test_queue_append_list_error)
{
	static qdata_t data_l[2];
	static struct k_queue queue;
	static qdata_t *head = NULL, *tail = &data_l[1];

	k_queue_init(&queue);
	memset(data_l, 0, sizeof(data_l));

	/* Check if the list of head is equal to null */
	zassert_true(k_queue_append_list(&queue, (uint32_t *)head,
			(uint32_t *)tail) == -EINVAL,
			"failed to CHECKIF head == NULL");
	/* Check if the list of tail is equal to null */
	head = &data_l[0];
	tail = NULL;
	zassert_true(k_queue_append_list(&queue, (uint32_t *)head,
			(uint32_t *)tail) == -EINVAL,
			"failed to CHECKIF tail == NULL");
	/* Initializing the queue for re-using below */
	k_queue_init(&queue);

	/* Append unnormal list(just one node)into the queue for sub-thread */
	head = &data_l[0];
	head->snode.next = NULL;

	k_thread_create(&tdata, tstack, STACK_SIZE, tThread_entry, &queue,
			head, NULL, K_PRIO_PREEMPT(0), 0, K_NO_WAIT);
	/* Delay for thread initializing */
	k_sem_take(&sem, K_FOREVER);

	k_queue_append_list(&queue, (uint32_t *)head, (uint32_t *)head);

	k_thread_join(&tdata, K_FOREVER);
}

/**
 * @brief Test k_queue_merge_slist() failure scenario
 *
 * @details Verify the API k_queue_merge_slist when
 * a slist is empty or a slist's tail is null.
 *
 * @ingroup tests_kernel_queue
 *
 * @see k_queue_merge_slist()
 * @verifies ZEP-SRS-20-12
 */
ZTEST(queue_api, test_queue_merge_list_error)
{
	qdata_t data_sl[2];
	static struct k_queue queue;
	sys_slist_t slist;

	k_queue_init(&queue);
	sys_slist_init(&slist);
	memset(data_sl, 0, sizeof(data_sl));

	/* Check if the slist is empty */
	zassert_true(k_queue_merge_slist(&queue, &slist) == -EINVAL,
			"Failed to CHECKIF slist is empty");
	/* Check if the tail of the slist is null */
	sys_slist_append(&slist, (sys_snode_t *)&(data_sl[0].snode));
	sys_slist_append(&slist, (sys_snode_t *)&(data_sl[1].snode));
	slist.tail = NULL;
	zassert_true(k_queue_merge_slist(&queue, &slist) != 0,
			"Failed to CHECKIF the tail of slist == null");
}

#ifdef CONFIG_USERSPACE
/**
 * @brief Test k_queue_init() failure scenario
 *
 * @details Verify that the parameter of API k_queue_init() is
 * NULL, what will happen.
 *
 * @ingroup tests_kernel_queue
 *
 * @see k_queue_init()
 * @verifies ZEP-SRS-20-2
 */
ZTEST_USER(queue_api, test_queue_init_null)
{
	ztest_set_fault_valid(true);
	k_queue_init(NULL);
}

/**
 * @brief Test k_queue_alloc_append() failure scenario
 *
 * @details Verify that the parameter of the API is
 * NULL, what will happen.
 *
 * @ingroup tests_kernel_queue
 *
 * @see k_queue_alloc_append()
 * @verifies ZEP-SRS-20-14
 */
ZTEST_USER(queue_api, test_queue_alloc_append_null)
{
	qdata_t data;

	memset(&data, 0, sizeof(data));
	ztest_set_fault_valid(true);
	k_queue_alloc_append(NULL, &data);
}

/**
 * @brief Test k_queue_alloc_prepend() failure scenario
 *
 * @details Verify that the parameter of the API is
 * NULL, what will happen.
 *
 * @ingroup tests_kernel_queue
 *
 * @see k_queue_alloc_prepend()
 * @verifies ZEP-SRS-20-14
 */
ZTEST_USER(queue_api, test_queue_alloc_prepend_null)
{
	qdata_t data;

	memset(&data, 0, sizeof(data));
	ztest_set_fault_valid(true);
	k_queue_alloc_prepend(NULL, &data);
}

/**
 * @brief Test k_queue_get() failure scenario
 *
 * @details Verify that the parameter of the API is
 * NULL, what will happen.
 *
 * @ingroup tests_kernel_queue
 *
 * @see k_queue_get()
 * @verifies ZEP-SRS-20-6
 */
ZTEST_USER(queue_api, test_queue_get_null)
{
	ztest_set_fault_valid(true);
	k_queue_get(NULL, K_FOREVER);
}

/**
 * @brief Test k_queue_is_empty() failure scenario
 *
 * @details Verify that the parameter of the API is
 * NULL, what will happen.
 *
 * @ingroup tests_kernel_queue
 *
 * @see k_queue_is_empty()
 * @verifies ZEP-SRS-20-7
 */
ZTEST_USER(queue_api, test_queue_is_empty_null)
{
	ztest_set_fault_valid(true);
	k_queue_is_empty(NULL);
}

/**
 * @brief Test k_queue_peek_head() failure scenario
 *
 * @details Verify that the parameter of the API is
 * NULL, what will happen.
 *
 * @ingroup tests_kernel_queue
 *
 * @see k_queue_peek_head()
 * @verifies ZEP-SRS-20-9
 */
ZTEST_USER(queue_api, test_queue_peek_head_null)
{
	ztest_set_fault_valid(true);
	k_queue_peek_head(NULL);
}

/**
 * @brief Test k_queue_peek_tail() failure scenario
 *
 * @details Verify that the parameter of the API is
 * NULL, what will happen.
 *
 * @ingroup tests_kernel_queue
 *
 * @see k_queue_peek_tail()
 * @verifies ZEP-SRS-20-8
 */
ZTEST_USER(queue_api, test_queue_peek_tail_null)
{
	ztest_set_fault_valid(true);
	k_queue_peek_tail(NULL);
}

/**
 * @brief Test k_queue_cancel_wait() error scenario
 *
 * @details Verify that cancelling the wait on a queue causes a blocked
 * k_queue_get() to return without an item.
 *
 * @ingroup tests_kernel_queue
 *
 * @see k_queue_cancel_wait()
 * @verifies ZEP-SRS-20-15
 */
ZTEST_USER(queue_api, test_queue_cancel_wait_error)
{
	struct k_queue *q;

	q = k_object_alloc(K_OBJ_QUEUE);
	zassert_not_null(q, "no memory for allocated queue object");
	k_queue_init(q);

	/* Check if cancel a qeueu that no thread to wait */
	k_queue_cancel_wait(q);

	/* Check if cancel a null pointer */
	ztest_set_fault_valid(true);
	k_queue_cancel_wait(NULL);
}

#endif /* CONFIG_USERSPACE */
```

## src/test_queue_loop.c
```c
/*
 * Copyright (c) 2017 Intel Corporation
 *
 * SPDX-License-Identifier: Apache-2.0
 */

#include "test_queue.h"

#define STACK_SIZE (512 + CONFIG_TEST_EXTRA_STACK_SIZE)
#define LIST_LEN 4
#define LOOPS 32

static qdata_t data[LIST_LEN];
static qdata_t data_p[LIST_LEN];
static qdata_t data_r[LIST_LEN];
static struct k_queue queue;
static K_THREAD_STACK_DEFINE(tstack, STACK_SIZE);
static struct k_thread tdata;
static struct k_sem end_sema;

static void tqueue_append(struct k_queue *pqueue)
{
	/**TESTPOINT: queue append*/
	for (int i = 0; i < LIST_LEN; i++) {
		k_queue_append(pqueue, (void *)&data[i]);
	}

	/**TESTPOINT: queue prepend*/
	for (int i = LIST_LEN - 1; i >= 0; i--) {
		k_queue_prepend(pqueue, (void *)&data_p[i]);
	}

	/**TESTPOINT: queue find and remove*/
	for (int i = LIST_LEN - 1; i >= 0; i--) {
		k_queue_prepend(pqueue, (void *)&data_r[i]);
	}
}

static void tqueue_get(struct k_queue *pqueue)
{
	void *rx_data;

	/*get queue data from "queue_prepend"*/
	for (int i = 0; i < LIST_LEN; i++) {
		/**TESTPOINT: queue get*/
		rx_data = k_queue_get(pqueue, K_NO_WAIT);
		zassert_equal(rx_data, (void *)&data_p[i]);
	}

	/*get queue data from "queue_append"*/
	for (int i = 0; i < LIST_LEN; i++) {
		/**TESTPOINT: queue get*/
		rx_data = k_queue_get(pqueue, K_NO_WAIT);
		zassert_equal(rx_data, (void *)&data[i]);
	}
}

static void tqueue_find_and_remove(struct k_queue *pqueue)
{
	/*remove queue data from "queue_find_and_remove"*/
	for (int i = 0; i < LIST_LEN; i++) {
		/**TESTPOINT: queue find and remove*/
		zassert_true(k_queue_remove(pqueue, &data_r[i]));
	}
}

/*entry of contexts*/
static void tIsr_entry(const void *p)
{
	tqueue_find_and_remove((struct k_queue *)p);
	tqueue_get((struct k_queue *)p);
	tqueue_append((struct k_queue *)p);
}

static void tThread_entry(void *p1, void *p2, void *p3)
{
	tqueue_find_and_remove((struct k_queue *)p1);
	tqueue_get((struct k_queue *)p1);
	k_sem_give(&end_sema);
	tqueue_append((struct k_queue *)p1);
	k_sem_give(&end_sema);
}

/* queue read write job */
static void tqueue_read_write(struct k_queue *pqueue)
{
	k_sem_init(&end_sema, 0, 1);
	/**TESTPOINT: thread-isr-thread data passing via queue*/
	k_tid_t tid = k_thread_create(&tdata, tstack, STACK_SIZE,
				      tThread_entry, pqueue, NULL, NULL,
				      K_PRIO_PREEMPT(0), 0, K_NO_WAIT);

	tqueue_append(pqueue);
	irq_offload(tIsr_entry, (const void *)pqueue);
	k_sem_take(&end_sema, K_FOREVER);
	k_sem_take(&end_sema, K_FOREVER);

	tqueue_find_and_remove(pqueue);
	tqueue_get(pqueue);
	k_thread_abort(tid);
}

/*test cases*/
/**
 * @brief Verify queue data integrity under repeated cross-context traffic.
 *
 * @details
 * Stresses the queue by cycling append/prepend/get/remove operations through
 * main-thread, ISR and spawned-thread contexts many times. Across every
 * iteration the items must be passed and removed without loss, duplication or
 * reordering.
 *
 * Test steps:
 * - For LOOPS iterations: append/prepend from the main thread, find-and-remove
 *   plus get/append from an ISR and a spawned thread, then drain.
 * - Verify each get returns the expected item and each remove succeeds.
 *
 * Expected result:
 * - Data passes correctly across all contexts on every iteration.
 *
 * @ingroup tests_kernel_queue
 *
 * @see k_queue_append()
 * @see k_queue_get()
 * @see k_queue_remove()
 * @verifies ZEP-SRS-20-3
 * @verifies ZEP-SRS-20-4
 * @verifies ZEP-SRS-20-5
 * @verifies ZEP-SRS-20-6
 */
ZTEST(queue_api_1cpu, test_queue_loop)
{
	k_queue_init(&queue);
	for (int i = 0; i < LOOPS; i++) {
		TC_PRINT("* Pass data by queue in loop %d\n", i);
		tqueue_read_write(&queue);
	}
}
```

## src/test_queue_user.c
```c
/*
 * Copyright (c) 2017 Intel Corporation
 *
 * SPDX-License-Identifier: Apache-2.0
 */

#include "test_queue.h"

#ifdef CONFIG_USERSPACE

#define STACK_SIZE (512 + CONFIG_TEST_EXTRA_STACK_SIZE)
#define LIST_LEN        5

/** @cond INTERNAL_HIDDEN */
static K_THREAD_STACK_DEFINE(child_stack, STACK_SIZE);
static struct k_thread child_thread;
static ZTEST_BMEM struct qdata qdata[LIST_LEN * 2];
/** @endcond */

/**
 * @brief Tests for queue
 * @defgroup tests_kernel_queue Queue tests
 * @ingroup all_tests
 * @{
 * @}
 */

/* Higher priority than the thread putting stuff in the queue */
void child_thread_get(void *p1, void *p2, void *p3)
{
	struct qdata *qd;
	struct k_queue *q = p1;
	struct k_sem *sem = p2;

	zassert_false(k_queue_is_empty(q));
	qd = k_queue_peek_head(q);
	zassert_equal(qd->data, 0);
	qd = k_queue_peek_tail(q);
	zassert_equal(qd->data, (LIST_LEN * 2) - 1,
		      "got %d expected %d", qd->data, (LIST_LEN * 2) - 1);

	for (int i = 0; i < (LIST_LEN * 2); i++) {
		qd = k_queue_get(q, K_FOREVER);

		zassert_equal(qd->data, i);
		if (qd->allocated) {
			/* snode should never have been touched */
			zassert_is_null(qd->snode.next, NULL);
		}
	}


	zassert_true(k_queue_is_empty(q));

	/* This one gets canceled */
	qd = k_queue_get(q, K_FOREVER);
	zassert_is_null(qd, NULL);

	k_sem_give(sem);
}

/**
 * @brief Verify supervisor-queued data reaches a user thread and cancel wait.
 *
 * @details
 * A supervisor thread fills a queue with both plain and alloc-appended elements,
 * which a user-mode child thread must read back in order (with correct head/tail
 * peeks). The child then blocks on an empty queue and must be released by
 * k_queue_cancel_wait() returning NULL.
 *
 * Test steps:
 * - Supervisor appends interleaved plain and alloc-appended items.
 * - Start a user child that peeks head/tail, gets all items in order, then
 *   blocks on an empty get.
 * - Call k_queue_cancel_wait() and verify the child's blocked get returns NULL.
 *
 * Expected result:
 * - The user thread reads every item in order and the cancel releases its wait.
 *
 * @ingroup tests_kernel_queue
 *
 * @see k_queue_alloc_append()
 * @see k_queue_get()
 * @see k_queue_cancel_wait()
 * @verifies ZEP-SRS-20-3
 * @verifies ZEP-SRS-20-6
 * @verifies ZEP-SRS-20-15
 */
ZTEST(queue_api_1cpu, test_queue_supv_to_user)
{
	/* Supervisor mode will add a bunch of data, some with alloc
	 * and some not
	 */

	struct k_queue *q;
	struct k_sem *sem;

	if (!(IS_ENABLED(CONFIG_USERSPACE))) {
		ztest_test_skip();
	}

	q = k_object_alloc(K_OBJ_QUEUE);
	zassert_not_null(q, "no memory for allocated queue object");
	k_queue_init(q);

	sem = k_object_alloc(K_OBJ_SEM);
	zassert_not_null(sem, "no memory for semaphore object");
	k_sem_init(sem, 0, 1);

	for (int i = 0; i < (LIST_LEN * 2); i = i + 2) {
		/* Just for test purposes -- not safe to do this in the
		 * real world as user mode shouldn't have any access to the
		 * snode struct
		 */
		qdata[i].data = i;
		qdata[i].allocated = false;
		qdata[i].snode.next = NULL;
		k_queue_append(q, &qdata[i]);

		qdata[i + 1].data = i + 1;
		qdata[i + 1].allocated = true;
		qdata[i + 1].snode.next = NULL;
		zassert_false(k_queue_alloc_append(q, &qdata[i + 1]));
	}

	k_thread_create(&child_thread, child_stack, STACK_SIZE,
			child_thread_get, q, sem, NULL, K_HIGHEST_THREAD_PRIO,
			K_USER | K_INHERIT_PERMS, K_NO_WAIT);

	k_yield();

	/* child thread runs until blocking on the last k_queue_get() call */
	k_queue_cancel_wait(q);
	k_sem_take(sem, K_FOREVER);
}

/**
 * @brief Verify k_queue_alloc_prepend() yields LIFO order from user mode.
 *
 * @details
 * Prepending items pushes each to the front, so reading the queue back returns
 * them in reverse insertion (LIFO) order. Exercised from a user-mode thread on an
 * allocated queue object.
 *
 * Test steps:
 * - Alloc-prepend a sequence of items 0..N-1 from a user thread.
 * - Get all items and verify they come out in reverse order (N-1..0).
 *
 * Expected result:
 * - Items are returned newest-first (LIFO).
 *
 * @ingroup tests_kernel_queue
 *
 * @see k_queue_alloc_prepend()
 * @see k_queue_get()
 * @verifies ZEP-SRS-20-14
 */
ZTEST_USER(queue_api, test_queue_alloc_prepend_user)
{
	struct k_queue *q;

	q = k_object_alloc(K_OBJ_QUEUE);
	zassert_not_null(q, "no memory for allocated queue object");
	k_queue_init(q);

	for (int i = 0; i < LIST_LEN * 2; i++) {
		qdata[i].data = i;
		zassert_false(k_queue_alloc_prepend(q, &qdata[i]));
	}

	for (int i = (LIST_LEN * 2) - 1; i >= 0; i--) {
		struct qdata *qd;

		qd = k_queue_get(q, K_NO_WAIT);
		zassert_true(qd != NULL);
		zassert_equal(qd->data, i);
	}
}

/**
 * @brief Verify k_queue_alloc_append() yields FIFO order from user mode.
 *
 * @details
 * Appending items adds each to the tail, so reading the queue back returns them
 * in insertion (FIFO) order. Exercised from a user-mode thread on an allocated
 * queue object.
 *
 * Test steps:
 * - Alloc-append a sequence of items 0..N-1 from a user thread.
 * - Get all items and verify they come out in insertion order (0..N-1).
 *
 * Expected result:
 * - Items are returned oldest-first (FIFO).
 *
 * @ingroup tests_kernel_queue
 *
 * @see k_queue_alloc_append()
 * @see k_queue_get()
 * @verifies ZEP-SRS-20-14
 */
ZTEST_USER(queue_api, test_queue_alloc_append_user)
{
	struct k_queue *q;

	q = k_object_alloc(K_OBJ_QUEUE);
	zassert_not_null(q, "no memory for allocated queue object");
	k_queue_init(q);

	for (int i = 0; i < LIST_LEN * 2; i++) {
		qdata[i].data = i;
		zassert_false(k_queue_alloc_append(q, &qdata[i]));
	}

	for (int i = 0; i < LIST_LEN * 2; i++) {
		struct qdata *qd;

		qd = k_queue_get(q, K_NO_WAIT);
		zassert_true(qd != NULL);
		zassert_equal(qd->data, i);
	}
}

/**
 * @brief Verify allocated queue resources are auto-freed back to the pool.
 *
 * @details
 * Elements added with the alloc APIs and the kernel objects allocated by the
 * previous user-mode test must be released automatically (queue elements when
 * dequeued, objects when permitted threads exit). The test confirms the whole
 * pool is available again by reallocating all of it.
 *
 * Test steps:
 * - After the preceding alloc-heavy test, allocate the entire pool in chunks.
 * - Verify every allocation succeeds, then free them.
 *
 * Expected result:
 * - All pool memory is reclaimable, proving prior resources were auto-freed.
 *
 * @ingroup tests_kernel_queue
 *
 * @see k_queue_alloc_append()
 * @verifies ZEP-SRS-20-14
 */
ZTEST(queue_api, test_auto_free)
{
	/* Ensure any resources requested by the previous test were released
	 * by allocating the entire pool. It would have allocated two kernel
	 * objects and five queue elements. The queue elements should be
	 * auto-freed when they are de-queued, and the objects when all
	 * threads with permissions exit.
	 */
	void *b[4];
	int i;

	if (!(IS_ENABLED(CONFIG_USERSPACE))) {
		ztest_test_skip();
	}

	for (i = 0; i < 4; i++) {
		b[i] = k_heap_alloc(&test_pool, 64, K_FOREVER);
		zassert_true(b[i] != NULL, "memory not auto released!");
	}

	for (i = 0; i < 4; i++) {
		k_heap_free(&test_pool, b[i]);
	}
}

#endif /* CONFIG_USERSPACE */
```
