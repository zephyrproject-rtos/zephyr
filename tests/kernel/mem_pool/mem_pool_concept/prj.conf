## CMakeLists.txt
```
# SPDX-License-Identifier: Apache-2.0

cmake_minimum_required(VERSION 3.15.7)
find_package(Zephyr REQUIRED HINTS $ENV{ZEPHYR_BASE})
project(mem_pool_concept)

FILE(GLOB app_sources src/*.c)
target_sources(app PRIVATE ${app_sources})
```

## prj.conf
```kconfig
CONFIG_ZTEST=y
CONFIG_SYS_TIMEOUT_LEGACY_API=n
```

## src/main.c
```c
/*
 * Copyright (c) 2016 Intel Corporation
 *
 * SPDX-License-Identifier: Apache-2.0
 */

#include <ztest.h>
extern void test_mpool_alloc_wait_prio(void);

/*test case main entry*/
void test_main(void)
{
	ztest_test_suite(mpool_concept,
			 ztest_1cpu_unit_test(test_mpool_alloc_wait_prio));
	ztest_run_test_suite(mpool_concept);
}
```

## src/test_mpool.h
```c
/*
 * Copyright (c) 2016 Intel Corporation
 *
 * SPDX-License-Identifier: Apache-2.0
 */

#define TIMEOUT K_MSEC(2000)
#ifdef CONFIG_RISCV
#define STACK_SIZE (1024 + CONFIG_TEST_EXTRA_STACKSIZE)
#else
#define STACK_SIZE (512 + CONFIG_TEST_EXTRA_STACKSIZE)
#endif
#define BLK_SIZE_MIN 16
#define BLK_SIZE_MAX 64
#define BLK_NUM_MIN 8
#define BLK_NUM_MAX 2
#define BLK_ALIGN BLK_SIZE_MIN
```

## src/test_mpool_alloc_size.c
```c
/*
 * Copyright (c) 2016 Intel Corporation
 *
 * SPDX-License-Identifier: Apache-2.0
 */

#include <ztest.h>
#include "test_mpool.h"

#define TEST_SIZE ((BLK_SIZE_MAX >> 2) + 1)

extern struct k_mem_pool mpool1;

/*test cases*/
/**
 * @brief Test alloc and free of different blocks sizes
 *
 * @ingroup kernel_memory_pool_tests
 *
 * @details The test demonstrates how the request is handled
 * to allocate the minimum available size block in memory pool
 * to satisfy the requirement of the application.
 */
void test_mpool_alloc_size_roundup(void)
{
	struct k_mem_block block[BLK_NUM_MAX], block_fail;

	/* This test is written to assume specific heap layout, in
	 * fact the sys_heap backend can routinely see more than "min
	 * blocks" allocated.
	 */
	if (IS_ENABLED(CONFIG_MEM_POOL_HEAP_BACKEND)) {
		ztest_test_skip();
	}

	/**
	 * TESTPOINT: When an application issues a request for a memory block,
	 * the memory pool first determines the size of the smallest block that
	 * will satisfy the request
	 */
	for (int i = 0; i < BLK_NUM_MAX; i++) {
		/*request a size for the mpool to round up to "BLK_SIZE_MAX"*/
		zassert_true(k_mem_pool_alloc(&mpool1, &block[i], TEST_SIZE,
					      K_NO_WAIT) == 0, NULL);
	}
	/*verify consequently no more blocks available*/
	zassert_true(k_mem_pool_alloc(&mpool1, &block_fail, BLK_SIZE_MIN,
				      K_NO_WAIT) == -ENOMEM, NULL);

	/*test case tear down*/
	for (int i = 0; i < BLK_NUM_MAX; i++) {
		k_mem_pool_free(&block[i]);
	}
}
```

## src/test_mpool_alloc_wait.c
```c
/*
 * Copyright (c) 2016 Intel Corporation
 *
 * SPDX-License-Identifier: Apache-2.0
 */

#include <ztest.h>
#include "test_mpool.h"

#define THREAD_NUM 3
K_MEM_POOL_DEFINE(mpool1, BLK_SIZE_MIN, BLK_SIZE_MAX, BLK_NUM_MAX, BLK_ALIGN);

static K_THREAD_STACK_ARRAY_DEFINE(tstack, THREAD_NUM, STACK_SIZE);
static struct k_thread tdata[THREAD_NUM];
static struct k_sem sync_sema;
static struct k_mem_block block_ok;

/*thread entry*/
void tmpool_alloc_wait_timeout(void *p1, void *p2, void *p3)
{
	struct k_mem_block block;

	zassert_true(k_mem_pool_alloc(&mpool1, &block, BLK_SIZE_MIN,
				      TIMEOUT) == -EAGAIN, NULL);
	k_sem_give(&sync_sema);
}

void tmpool_alloc_wait_ok(void *p1, void *p2, void *p3)
{
	zassert_true(k_mem_pool_alloc(&mpool1, &block_ok, BLK_SIZE_MIN,
				      TIMEOUT) == 0, NULL);
	k_sem_give(&sync_sema);
}

/*test cases*/
/**
 * @brief Verify alloc and free with different prio threads
 *
 * @ingroup kernel_memory_pool_tests
 *
 * @details The test case allocates 3 blocks of 64 bytes,
 * and spawns 3 threads with lowest priority T1 and other
 * 2 threads, T2 and T3 of same but higher than T1 with
 * delayed start 10ms and 20ms respectively. Then checks
 * the behavior of allocation.
 *
 * @see k_mem_pool_alloc()
 * @see k_mem_pool_free()
 */
void test_mpool_alloc_wait_prio(void)
{
	struct k_mem_block block[2 * BLK_NUM_MIN];
	k_tid_t tid[THREAD_NUM];
	int nb;

	k_sem_init(&sync_sema, 0, THREAD_NUM);

	/*allocated up all blocks*/
	for (nb = 0; nb < ARRAY_SIZE(block); nb++) {
		if (k_mem_pool_alloc(&mpool1, &block[nb], BLK_SIZE_MIN,
				     K_NO_WAIT) != 0) {
			break;
		}
	}

	zassert_true(nb >= BLK_NUM_MIN, "nb %d want %d", nb, BLK_NUM_MIN);

	/**
	 * TESTPOINT: when a suitable memory block becomes available, it is
	 * given to the highest-priority thread that has waited the longest
	 */
	/**
	 * TESTPOINT: If a block of the desired size is unavailable, a thread
	 * can optionally wait for one to become available
	 */
	/*the low-priority thread*/
	tid[0] = k_thread_create(&tdata[0], tstack[0], STACK_SIZE,
				 tmpool_alloc_wait_timeout, NULL, NULL, NULL,
				 K_PRIO_PREEMPT(1), 0, K_NO_WAIT);
	/*the highest-priority thread that has waited the longest*/
	tid[1] = k_thread_create(&tdata[1], tstack[1], STACK_SIZE,
				 tmpool_alloc_wait_ok, NULL, NULL, NULL,
				 K_PRIO_PREEMPT(0), 0, K_MSEC(10));
	/*the highest-priority thread that has waited shorter*/
	tid[2] = k_thread_create(&tdata[2], tstack[2], STACK_SIZE,
				 tmpool_alloc_wait_timeout, NULL, NULL, NULL,
				 K_PRIO_PREEMPT(0), 0, K_MSEC(20));
	/*relinquish CPU for above threads to start */
	k_sleep(K_MSEC(30));
	/*free one block, expected to unblock thread "tid[1]"*/
	k_mem_pool_free(&block[0]);
	/*wait for all threads exit*/
	for (int i = 0; i < THREAD_NUM; i++) {
		k_sem_take(&sync_sema, K_FOREVER);
	}

	/*test case tear down*/
	for (int i = 0; i < THREAD_NUM; i++) {
		k_thread_abort(tid[i]);
	}
	k_mem_pool_free(&block_ok);
	for (int i = 1; i < nb; i++) {
		k_mem_pool_free(&block[i]);
	}
}
```

## src/test_mpool_merge_fail_diff_parent.c
```c
/*
 * Copyright (c) 2016 Intel Corporation
 *
 * SPDX-License-Identifier: Apache-2.0
 */

#include <ztest.h>
#include "test_mpool.h"

extern struct k_mem_pool mpool1;

/*test cases*/
/**
 * @brief Test to verify merge of blocks of different quad-block
 *
 * @ingroup kernel_memory_pool_tests
 *
 * @details TESTPOINT: The algo cannot merge adjacent free blocks
 * of the same size if they belong to different parent quad-blocks
 * Test steps: 1. allocate block [0~7] in minimum block size
 * 2. free block [2~5], belong to diff parental quad-blocks
 * 3. request a big block
 * verify blocks [2, 3] and blocks [4, 5] can't be merged
 * 4. tear down, free blocks [0, 1, 6, 7]
 */
void test_mpool_alloc_merge_failed_diff_parent(void)
{
	/* The heap backend doesn't use the splitting mechanism tested
	 * here, and in fact is significantly more fragmentation
	 * resistant and succeeds at the "failed" allocation desired
	 * below.
	 */
	if (IS_ENABLED(CONFIG_MEM_POOL_HEAP_BACKEND)) {
		ztest_test_skip();
	}

	struct k_mem_block block[BLK_NUM_MIN], block_fail;

	for (int i = 0; i < BLK_NUM_MIN; i++) {
		/* 1. allocated up all blocks*/
		zassert_true(k_mem_pool_alloc(&mpool1, &block[i], BLK_SIZE_MIN,
					      K_NO_WAIT) == 0, NULL);
	}
	/* 2. free adjacent blocks belong to different parent quad-blocks*/
	for (int i = 2; i < 6; i++) {
		k_mem_pool_free(&block[i]);
	}
	/* 3. request a big block, expected failed to merge*/
	zassert_true(k_mem_pool_alloc(&mpool1, &block_fail, BLK_SIZE_MAX,
				      TIMEOUT) == -EAGAIN, NULL);

	/* 4. test case tear down*/
	k_mem_pool_free(&block[0]);
	k_mem_pool_free(&block[1]);
	k_mem_pool_free(&block[6]);
	k_mem_pool_free(&block[7]);
}
```

## src/test_mpool_merge_fail_diff_size.c
```c
/*
 * Copyright (c) 2016 Intel Corporation
 *
 * SPDX-License-Identifier: Apache-2.0
 */

#include <ztest.h>
#define TIMEOUT K_MSEC(2000)
#define BLK_SIZE_MIN 16
#define BLK_SIZE_MID 32
#define BLK_SIZE_MAX 256
#define BLK_NUM_MIN 32
#define BLK_NUM_MAX 2
#define BLK_ALIGN BLK_SIZE_MIN

K_MEM_POOL_DEFINE(mpool3, BLK_SIZE_MIN, BLK_SIZE_MAX, BLK_NUM_MAX, BLK_ALIGN);

/*test cases*/
/**
 * @brief Verify blocks of different sizes cannot be merged.
 *
 * @ingroup kernel_memory_pool_tests
 *
 * @details The merging algorithm cannot combine adjacent free blocks
 * of different sizes
 * Test steps: 1. allocate 14 blocks in different sizes
 * 2. free block [2~8], in different sizes
 * 3. request a big block verify blocks [2~8] can't be merged
 * 4. tear down, free blocks [0, 1, 9~13]
 */
void test_mpool_alloc_merge_failed_diff_size(void)
{
	/* The heap backend doesn't use the splitting mechanism tested
	 * here, and in fact is significantly more fragmentation
	 * resistant and succeeds at the "failed" allocation desired
	 * below.
	 */
	if (IS_ENABLED(CONFIG_MEM_POOL_HEAP_BACKEND)) {
		ztest_test_skip();
	}

	struct k_mem_block block[BLK_NUM_MIN], block_fail;
	size_t block_size[] = {
		BLK_SIZE_MIN, BLK_SIZE_MIN, BLK_SIZE_MIN, BLK_SIZE_MIN,
		BLK_SIZE_MID, BLK_SIZE_MID, BLK_SIZE_MID,
		BLK_SIZE_MIN, BLK_SIZE_MIN, BLK_SIZE_MIN, BLK_SIZE_MIN,
		BLK_SIZE_MID, BLK_SIZE_MID, BLK_SIZE_MID
	};
	int block_count = ARRAY_SIZE(block_size);


	for (int i = 0; i < block_count; i++) {
		/* 1. allocate blocks in different sizes*/
		zassert_true(k_mem_pool_alloc(&mpool3, &block[i], block_size[i],
					      K_NO_WAIT) == 0, NULL);
	}
	/* 2. free block [2~8], in different sizes*/
	for (int i = 2; i < 9; i++) {
		k_mem_pool_free(&block[i]);
	}
	/* 3. request a big block, expected failed to merge*/
	zassert_true(k_mem_pool_alloc(&mpool3, &block_fail, BLK_SIZE_MAX,
				      TIMEOUT) == -EAGAIN, NULL);

	/* 4. test case tear down*/
	k_mem_pool_free(&block[0]);
	k_mem_pool_free(&block[1]);
	for (int i = 9; i < block_count; i++) {
		k_mem_pool_free(&block[i]);
	}
}
```

## src/test_mpool_spook.c
```c
/*
 * Copyright (c) 2019 BayLibre SAS
 *
 * SPDX-License-Identifier: Apache-2.0
 */

/*
 * This test demonstrates a serious bugs that exist in the mem-pool code
 * when the fix from PR #16966 is not applied.
 *
 * Expected output with the bug present:
 *
 *	allocating boxes
 *	init box 3
 *	show box 3: tic="tic" tac="tac" toe="toe"
 *	init box 4
 *	show box 4: tic="tic" tac="tac" toe="toe"
 *	show box 3: tic="tic" tac="tac" toe="tic"
 *	init box 3
 *	show box 3: tic="tic" tac="tac" toe="toe"
 *	show box 4: tic="toe" tac="tac" toe="toe"
 */

/**
 * @brief Memory Pool Bug Tests
 * @defgroup kernel_memory_pool_tests Memory Pool
 * @ingroup all_tests
 * @{
 * @}
 */

#include <ztest.h>
#include <zephyr.h>
#include <misc/printk.h>

K_MEM_POOL_DEFINE(my_pool, 8, 44, 9, 4);

struct tic_tac_toe { char *tic; char *tac; char *toe; };

static struct tic_tac_toe *boxes[9];

static bool spooked;

static void init_box(int n)
{
	printk("init box %d\n", n);
	boxes[n]->tic = "tic";
	boxes[n]->tac = "tac";
	boxes[n]->toe = "toe";
}

static void show_box(int n)
{
	printk("show box %d: tic=\"%s\" tac=\"%s\" toe=\"%s\"\n",
	       n, boxes[n]->tic, boxes[n]->tac, boxes[n]->toe);

	if (strcmp(boxes[n]->tic, "tic") != 0 ||
	    strcmp(boxes[n]->tac, "tac") != 0 ||
	    strcmp(boxes[n]->toe, "toe") != 0) {
		spooked = true;
	}
}

void test_mempool_spook(void)
{
	struct k_mem_block block[9];
	int i, ret;

	printk("allocating boxes\n");
	for (i = 0; i < 9; i++) {
		ret = k_mem_pool_alloc(&my_pool, &block[i],
				       sizeof(struct tic_tac_toe), 0);
		zassert_false(ret != 0 || block[i].data == NULL,
			      "memory allocation failure\n");
		boxes[i] = block[i].data;
	}

	init_box(3);
	show_box(3);
	init_box(4);
	show_box(4);
	show_box(3); /* ! */
	init_box(3);
	show_box(3);
	show_box(4); /* ! */

	zassert_false(spooked, "");
}
```
