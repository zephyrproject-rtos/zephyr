## CMakeLists.txt
```
# SPDX-License-Identifier: Apache-2.0

cmake_minimum_required(VERSION 3.28.0)
find_package(Zephyr REQUIRED HINTS $ENV{ZEPHYR_BASE})
project(userspace)

FILE(GLOB app_sources src/*.c)
target_sources(app PRIVATE ${app_sources})
```

## Kconfig
```
# Copyright (c) 2025 Intel Corporation
#
# SPDX-License-Identifier: Apache-2.0

mainmenu "Userspace test"

source "Kconfig.zephyr"

config USERSPACE_SWITCHING_TESTS
	bool "Run thread switching tests"
	select SCHED_CPU_MASK if MP_MAX_NUM_CPUS > 1
	help
	  Run userspace_domain_switching tests.

	  Enable this via board overlay.
```

## prj.conf
```kconfig
CONFIG_STACK_CANARIES=n
CONFIG_ZTEST=y
CONFIG_INIT_STACKS=y
CONFIG_APPLICATION_DEFINED_SYSCALL=y
CONFIG_TEST_USERSPACE=y
CONFIG_PIPES=y
```

## boards/frdm_mcxn236.conf
```kconfig
CONFIG_COMMON_LIBC_MALLOC_ARENA_SIZE=0
```

## boards/intel_adsp_ace30_ptl.conf
```kconfig
CONFIG_MAX_THREAD_BYTES=3
CONFIG_USERSPACE_SWITCHING_TESTS=y
CONFIG_XTENSA_MMU_NUM_L1_TABLES=6
```

## boards/kit_pse84_eval_pse846gps2dbzc4a_m55.conf
```kconfig
CONFIG_USERSPACE_SWITCHING_TESTS=y
```

## boards/qemu_cortex_a53.conf
```kconfig
CONFIG_MAX_XLAT_TABLES=24
```

## boards/qemu_cortex_a53_qemu_cortex_a53_smp.conf
```kconfig
CONFIG_MAX_XLAT_TABLES=24
CONFIG_USERSPACE_SWITCHING_TESTS=y
```

## boards/qemu_riscv32_qemu_virt_riscv32_smode.conf
```kconfig
# Copyright (c) 2026 Alexios Lyrakis <alexios.lyrakis@gmail.com>
# Copyright (c) 2026 Jisheng Zhang <jszhang@kernel.org>
# SPDX-License-Identifier: Apache-2.0

# Enable MMU support for RISC-V virtual memory testing.
CONFIG_RISCV_MMU=y
CONFIG_MAX_XLAT_TABLES=128
# QEMU icount mode: jump to next timer deadline on wfi (needed for k_sleep)
CONFIG_QEMU_ICOUNT_SLEEP=y
CONFIG_USERSPACE_SWITCHING_TESTS=y
```

## boards/frdm_mcxn236.overlay
```dts
/*
 * Copyright 2024 NXP
 *
 * SPDX-License-Identifier: Apache-2.0
 */

&sramx {
	status = "disabled";
};
```

## boards/mimxrt595_evk_mimxrt595s_cm33.overlay
```dts
/*
 * Copyright 2023 NXP
 *
 * SPDX-License-Identifier: Apache-2.0
 */

/*
 * Disable USB SRAM node because this test does not
 * need USB but needs an extra MPU region which
 * otherwise would be taken up for the SRAM1 USB region.
 */
&sram1 {
	status = "disabled";
};
```

## boards/nucleo_f746zg.overlay
```dts
/*
 * Copyright 2023 STMicroelectronics
 *
 * SPDX-License-Identifier: Apache-2.0
 */

/*
 * Disable quadspi MPU region for testing
 * on this stm32f7 target
 * else one region is missing among 8 MPU regions
 */

/delete-node/ &quadspi_memory;
```

## src/mem_domain_remove.c
```c
/*
 * Copyright (c) 2026 Process Mission
 *
 * SPDX-License-Identifier: Apache-2.0
 */

#include <zephyr/kernel.h>
#include <zephyr/ztest.h>
#include <zephyr/app_memory/app_memdomain.h>
/* for z_libc_partition */
#include <zephyr/sys/libc-hooks.h>

extern void set_fault(unsigned int reason);
extern void clear_fault(void);

#ifdef CONFIG_ARCH_MEM_DOMAIN_SYNCHRONOUS_API
#define MAGIC1 0xA1
#endif
#define MAGIC2 0xB2
#define MAGIC3 0xC3

/* Test buffers live in linker-managed application memory partitions, so
 * their size and alignment satisfy each arch's MPU/MMU requirements
 * automatically.
 */
#ifdef CONFIG_ARCH_MEM_DOMAIN_SYNCHRONOUS_API
K_APPMEM_PARTITION_DEFINE(remove_part);
K_APP_BMEM(remove_part) volatile uint8_t remove_byte;
#endif
K_APPMEM_PARTITION_DEFINE(hole_part_a);
K_APPMEM_PARTITION_DEFINE(hole_part_b);
K_APPMEM_PARTITION_DEFINE(hole_part_c);
K_APP_BMEM(hole_part_a) volatile uint8_t hole_byte_a;
K_APP_BMEM(hole_part_b) volatile uint8_t hole_byte_b;
K_APP_BMEM(hole_part_c) volatile uint8_t hole_byte_c;

static struct k_thread part_thread;
static K_THREAD_STACK_DEFINE(part_stack, 2048);

/* File-scope domains: the ztest thread reuses the same stack slot across
 * tests, so two stack-local domains would alias one address, which the
 * x86 arch code rejects as a double arch_mem_domain_init().
 */
#ifdef CONFIG_ARCH_MEM_DOMAIN_SYNCHRONOUS_API
static struct k_mem_domain remove_dom;
#endif
static struct k_mem_domain hole_dom;

#ifdef CONFIG_ARCH_MEM_DOMAIN_SYNCHRONOUS_API
static K_SEM_DEFINE(part_started, 0, 1);
static K_SEM_DEFINE(part_go, 0, 1);

static void removed_part_write(void *p1, void *p2, void *p3)
{
	ARG_UNUSED(p1);
	ARG_UNUSED(p2);
	ARG_UNUSED(p3);

	k_sem_give(&part_started);
	k_sem_take(&part_go, K_FOREVER);
	remove_byte = MAGIC1;
}

/**
 * @brief Removed partition must not stay accessible to a started thread
 *
 * @details A user thread that is already started when
 * k_mem_domain_remove_partition() runs must lose access to the removed
 * partition. On Armv8-R AArch64 the arch remove hook rescanned the
 * domain before the kernel invalidated the slot, programming the
 * removed partition right back (issue #115177, defect 1).
 *
 * Only architectures with a synchronous memory domain API update the
 * memory configuration of already started threads on partition removal,
 * so this test is limited to those.
 *
 * @ingroup kernel_memprotect_tests
 */
ZTEST(userspace, test_domain_remove_partition_started_thread)
{
	/* z_libc_partition carries the arch TLS pointer that the user
	 * thread entry code reads on some architectures (e.g. Arm).
	 */
	struct k_mem_partition *parts[] = {
#if Z_LIBC_PARTITION_EXISTS
		&z_libc_partition,
#endif
		&remove_part,
	};
	k_tid_t tid;

	clear_fault();
	remove_byte = 0;

	zassert_equal(k_mem_domain_init(&remove_dom, ARRAY_SIZE(parts), parts), 0);

	tid = k_thread_create(&part_thread, part_stack, K_THREAD_STACK_SIZEOF(part_stack),
			      removed_part_write, NULL, NULL, NULL, 1, K_USER, K_FOREVER);
	k_thread_access_grant(tid, &part_started, &part_go);
	zassert_equal(k_mem_domain_add_thread(&remove_dom, tid), 0);

	/* The thread must be running before the removal happens. */
	k_thread_start(tid);
	zassert_equal(k_sem_take(&part_started, K_FOREVER), 0);

	zassert_equal(k_mem_domain_remove_partition(&remove_dom, &remove_part), 0);

	/* The correct outcome is a fault on the write; tolerate it so the
	 * assertion below can distinguish it from a silent write.
	 */
	set_fault(K_ERR_CPU_EXCEPTION);
	k_sem_give(&part_go);
	zassert_equal(k_thread_join(tid, K_FOREVER), 0);
	clear_fault();

	zassert_not_equal(remove_byte, MAGIC1,
			  "removed partition still accessible to started thread");
}
#endif /* CONFIG_ARCH_MEM_DOMAIN_SYNCHRONOUS_API */

static void hole_part_write(void *p1, void *p2, void *p3)
{
	ARG_UNUSED(p1);
	ARG_UNUSED(p2);
	ARG_UNUSED(p3);

	hole_byte_b = MAGIC2; /* control: must always succeed */
	hole_byte_c = MAGIC3; /* valid partition behind the hole */
}

/**
 * @brief A hole in partitions[] must not skip valid partitions
 *
 * @details Add P1,P2,P3 to a domain, remove P1 so the partition array
 * becomes [hole, P2, P3], then run a user thread accessing P3's memory.
 * The access must succeed. On Armv8-R AArch64 and ARC the region
 * programming loop decremented its remaining-partition counter for
 * holes too, so P3 was never programmed into the MPU (issue #115177,
 * defect 2).
 *
 * @ingroup kernel_memprotect_tests
 */
ZTEST(userspace, test_domain_remove_partition_hole_skip)
{
	/* z_libc_partition carries the arch TLS pointer that the user
	 * thread entry code reads on some architectures (e.g. Arm).
	 */
	struct k_mem_partition *parts[] = {
#if Z_LIBC_PARTITION_EXISTS
		&z_libc_partition,
#endif
		&hole_part_a,
		&hole_part_b,
		&hole_part_c,
	};
	k_tid_t tid;

	clear_fault();
	hole_byte_a = 0;
	hole_byte_b = 0;
	hole_byte_c = 0;

	zassert_equal(k_mem_domain_init(&hole_dom, ARRAY_SIZE(parts), parts), 0);

	tid = k_thread_create(&part_thread, part_stack, K_THREAD_STACK_SIZEOF(part_stack),
			      hole_part_write, NULL, NULL, NULL, 1, K_USER, K_FOREVER);
	zassert_equal(k_mem_domain_add_thread(&hole_dom, tid), 0);

	/* leaves partitions[] = [z_libc, hole, P2, P3], num_partitions = 3
	 * when z_libc_partition exists, [hole, P2, P3] otherwise.
	 */
	zassert_equal(k_mem_domain_remove_partition(&hole_dom, &hole_part_a), 0);

	/* On the buggy kernel the write to P3 faults; tolerate it so the
	 * assertion below can report the failure gracefully.
	 */
	set_fault(K_ERR_CPU_EXCEPTION);
	k_thread_start(tid);
	zassert_equal(k_thread_join(tid, K_FOREVER), 0);
	clear_fault();

	zassert_equal(hole_byte_b, MAGIC2, "control partition P2 not accessible");
	zassert_equal(hole_byte_c, MAGIC3, "valid partition P3 skipped by hole in partitions[]");
}
```

## src/switching.c
```c
/*
 * Copyright (c) 2025 Intel Corporation
 *
 * SPDX-License-Identifier: Apache-2.0
 */

#include <zephyr/kernel.h>
#include <zephyr/ztest.h>
#include <zephyr/app_memory/app_memdomain.h>
#include <zephyr/sys/util.h>
#include <zephyr/sys/barrier.h>
#include <zephyr/sys/libc-hooks.h> /* for z_libc_partition */

#define NUM_THREADS     3
#define TIMES_SWITCHING 10
#define STACKSIZE       (256 + CONFIG_TEST_EXTRA_STACK_SIZE)

extern void clear_fault(void);

#ifdef CONFIG_USERSPACE_SWITCHING_TESTS
/*
 * Even numbered threads use domain_a.
 * Odd numbered threads use domain_b.
 */

struct k_mem_domain domain_a;
K_APPMEM_PARTITION_DEFINE(partition_a);
K_APP_BMEM(partition_a) volatile unsigned int part_a_loops[NUM_THREADS];

struct k_mem_domain domain_b;
K_APPMEM_PARTITION_DEFINE(partition_b);
K_APP_BMEM(partition_b) volatile unsigned int part_b_loops[NUM_THREADS];

static struct k_thread threads[NUM_THREADS];
static K_THREAD_STACK_ARRAY_DEFINE(threads_stacks, NUM_THREADS, STACKSIZE);

static K_SEM_DEFINE(sem_switching, 1, 1);

static void switch_thread_fn(void *arg1, void *arg2, void *arg3)
{
	volatile unsigned int *loop_ptr;
	const uintptr_t thread_id = (uintptr_t)arg1;

	if ((thread_id % 2) == 0) {
		loop_ptr = &part_a_loops[thread_id];
	} else {
		loop_ptr = &part_b_loops[thread_id];
	}

	for (int i = 0; i < TIMES_SWITCHING; i++) {
#ifdef CONFIG_DEBUG
		TC_PRINT("Thread %lu (%u)\n", thread_id, *loop_ptr);
#endif

		*loop_ptr += 1;
		compiler_barrier();

		/* Make sure this can still use kernel objects. */
		k_sem_take(&sem_switching, K_FOREVER);
		k_sem_give(&sem_switching);

		k_yield();
	}
}

#endif /* CONFIG_USERSPACE_SWITCHING_TESTS */

static void run_switching(int num_kernel_threads)
{
#ifdef CONFIG_USERSPACE_SWITCHING_TESTS
	unsigned int i;
	int remaining_kernel_threads = num_kernel_threads;

	/* Not expecting any errors. */
	clear_fault();

	for (i = 0; i < NUM_THREADS; i++) {
		uint32_t perms;
		bool is_kernel_thread = remaining_kernel_threads > 0;

		if (is_kernel_thread) {
			perms = K_INHERIT_PERMS;

			remaining_kernel_threads--;
		} else {
			perms = K_INHERIT_PERMS | K_USER;
		}

		/* Clear loop counters. */
		part_a_loops[i] = 0;
		part_b_loops[i] = 0;

		/* Must delay start of threads to apply memory domains to them. */
		k_thread_create(&threads[i], threads_stacks[i], STACKSIZE, switch_thread_fn,
				(void *)(uintptr_t)i, NULL, NULL, -1, perms, K_FOREVER);

#ifdef CONFIG_SCHED_CPU_MASK
		/*
		 * Make sure all created threads run on the same CPU
		 * so that memory domain switching is being tested.
		 */
		(void)k_thread_cpu_pin(&threads[i], 0);
#endif /* CONFIG_SCHED_CPU_MASK */

		k_thread_access_grant(&threads[i], &sem_switching);

		/*
		 * Kernel threads by default has access to all memory.
		 * So no need to put them into memory domains.
		 */
		if (!is_kernel_thread) {
			/* Remember EVEN -> A, ODD -> B. */
			if ((i % 2) == 0) {
				k_mem_domain_add_thread(&domain_a, &threads[i]);
			} else {
				k_mem_domain_add_thread(&domain_b, &threads[i]);
			}
		}
	}

	/* Start the thread loops. */
	for (i = 0; i < NUM_THREADS; i++) {
		k_thread_start(&threads[i]);
	}

	/* Wait for all threads to finish. */
	for (i = 0; i < NUM_THREADS; i++) {
		k_thread_join(&threads[i], K_FOREVER);
	}

	/* Check to make sure all threads have looped enough times. */
	for (i = 0; i < NUM_THREADS; i++) {
		int loops;

		/*
		 * Each thread should never have access to the loop counters on
		 * the other partition. Accessing them should generate faults.
		 * Though we check just in case.
		 */
		if ((i % 2) == 0) {
			loops = part_a_loops[i];

			zassert_equal(part_b_loops[i], 0, "part_b_loops[%i] should be zero but not",
				      i);
		} else {
			loops = part_b_loops[i];

			zassert_equal(part_a_loops[i], 0, "part_a_loops[%i] should be zero but not",
				      i);
		}

		zassert_equal(loops, TIMES_SWITCHING,
			      "thread %u has not done enough loops (%u != %u)", i, loops,
			      TIMES_SWITCHING);
	}
#else  /* CONFIG_USERSPACE_SWITCHING_TESTS */
	ztest_test_skip();
#endif /* CONFIG_USERSPACE_SWITCHING_TESTS */
}

/**
 * @brief Verify the switching scenario with kernel threads as a baseline.
 *
 * @ingroup kernel_memprotect_tests
 *
 * @details
 * Threads pinned to one CPU alternate through the scheduler while belonging
 * to two disjoint memory domains -- even-numbered threads in domain A, odd in
 * domain B. Every reschedule must swap in the incoming thread's domain: each
 * thread increments a counter in its own partition every loop, and the
 * counter in the other domain's partition must stay untouched, so a stale
 * domain after a switch shows up as a fault or a stray count. Skipped without
 * CONFIG_USERSPACE_SWITCHING_TESTS.
 *
 * This variant runs every thread as a kernel thread, which has access to all
 * memory regardless of domains, proving the scenario itself is sound before
 * the user-mode variants rely on it.
 *
 * Test steps:
 * - Run the switching scenario with all threads created as kernel threads.
 *
 * Expected result:
 * - Every thread completes its loops and the cross-partition counters stay
 *   zero.
 *
 * @verifies ZEP-SRS-8-23
 */
ZTEST(userspace_domain_switching, test_userspace_kernel_only_switching)
{
	/*
	 * Run with all kernel threads.
	 *
	 * This should work as kernel threads by default have access to
	 * all memory, without having to attach them to memory domains.
	 * This serves as a baseline check.
	 */
	run_switching(NUM_THREADS);
}

/**
 * @brief Verify domain isolation while switching among user threads.
 *
 * @ingroup kernel_memprotect_tests
 *
 * @details
 * Threads pinned to one CPU alternate through the scheduler while belonging
 * to two disjoint memory domains -- even-numbered threads in domain A, odd in
 * domain B. Every reschedule must swap in the incoming thread's domain: each
 * thread increments a counter in its own partition every loop, and the
 * counter in the other domain's partition must stay untouched, so a stale
 * domain after a switch shows up as a fault or a stray count. Skipped without
 * CONFIG_USERSPACE_SWITCHING_TESTS.
 *
 * This is the full test: every thread is a user thread confined to its
 * domain, so each context switch has to reprogram the protection hardware.
 *
 * Test steps:
 * - Run the switching scenario with all threads created as user threads,
 *   assigned alternately to the two domains.
 *
 * Expected result:
 * - Every thread completes its loops and the cross-partition counters stay
 *   zero.
 *
 * @see k_mem_domain_add_thread()
 * @verifies ZEP-SRS-8-23
 */
ZTEST(userspace_domain_switching, test_userspace_user_only_switching)
{
	/* Run with all user threads. */
	run_switching(0);
}

/**
 * @brief Verify domain isolation with kernel and user threads interleaved.
 *
 * @ingroup kernel_memprotect_tests
 *
 * @details
 * Threads pinned to one CPU alternate through the scheduler while belonging
 * to two disjoint memory domains -- even-numbered threads in domain A, odd in
 * domain B. Every reschedule must swap in the incoming thread's domain: each
 * thread increments a counter in its own partition every loop, and the
 * counter in the other domain's partition must stay untouched, so a stale
 * domain after a switch shows up as a fault or a stray count. Skipped without
 * CONFIG_USERSPACE_SWITCHING_TESTS.
 *
 * One thread stays a kernel thread while the rest run in user mode, so the
 * scheduler alternates between threads that bypass the domains and threads
 * confined by them -- the transition each direction must restore the right
 * protection view.
 *
 * Test steps:
 * - Run the switching scenario with one kernel thread and the rest user
 *   threads.
 *
 * Expected result:
 * - Every thread completes its loops and the cross-partition counters stay
 *   zero.
 *
 * @see k_mem_domain_add_thread()
 * @verifies ZEP-SRS-8-23
 */
ZTEST(userspace_domain_switching, test_userspace_kernel_user_mix_switching)
{
	/* Run with one kernel thread while others are all user threads. */
	run_switching(1);
}

void *switching_setup(void)
{
#ifdef CONFIG_USERSPACE_SWITCHING_TESTS
	static bool already_inited;

	if (already_inited) {
		return NULL;
	}

	struct k_mem_partition *parts_a[] = {
#if Z_LIBC_PARTITION_EXISTS
		&z_libc_partition,
#endif
		&ztest_mem_partition, &partition_a
	};

	struct k_mem_partition *parts_b[] = {
#if Z_LIBC_PARTITION_EXISTS
		&z_libc_partition,
#endif
		&ztest_mem_partition, &partition_b
	};

	zassert_equal(k_mem_domain_init(&domain_a, ARRAY_SIZE(parts_a), parts_a), 0,
		      "failed to initialize memory domain A");

	zassert_equal(k_mem_domain_init(&domain_b, ARRAY_SIZE(parts_b), parts_b), 0,
		      "failed to initialize memory domain B");

	already_inited = true;
#endif /* CONFIG_USERSPACE_SWITCHING_TESTS */

	return NULL;
}

void switching_before(void *fixture)
{
#ifdef CONFIG_USERSPACE_SWITCHING_TESTS
	int i;

	for (i = 0; i < NUM_THREADS; i++) {
		k_thread_access_grant(k_current_get(), &threads[i]);
	}
#endif /* CONFIG_USERSPACE_SWITCHING_TESTS */
}

ZTEST_SUITE(userspace_domain_switching, NULL, switching_setup, switching_before, NULL, NULL);
```

## src/test_syscall.h
```c
/*
 * Copyright (c) 2019 Intel Corporation
 *
 * SPDX-License-Identifier: Apache-2.0
 */

#ifndef USERSPACE_TEST_SYSCALL_H
#define USERSPACE_TEST_SYSCALL_H

__syscall void missing_syscall(void);
__syscall void check_syscall_context(void);

#include <zephyr/syscalls/test_syscall.h>

#endif
```
