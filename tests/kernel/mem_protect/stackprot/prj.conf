## CMakeLists.txt
```
# SPDX-License-Identifier: Apache-2.0

cmake_minimum_required(VERSION 3.28.0)
find_package(Zephyr REQUIRED HINTS $ENV{ZEPHYR_BASE})
project(stackprot)

FILE(GLOB app_sources src/*.c)
target_sources(app PRIVATE ${app_sources})
```

## prj.conf
```kconfig
CONFIG_ZTEST=y
CONFIG_STACK_CANARIES=y
CONFIG_ENTROPY_GENERATOR=y
CONFIG_TEST_RANDOM_GENERATOR=y
CONFIG_TEST_USERSPACE=y
CONFIG_MAIN_STACK_SIZE=2048
CONFIG_KOBJECT_TEXT_AREA=512
```

## boards/qemu_x86_tiny_768.conf
```kconfig
# Copyright 2022 Intel Corporation
# SPDX-License-Identifier: Apache-2.0

# This is needed for coverage.
CONFIG_MAIN_STACK_SIZE=4096
```

## src/main.c
```c
/*
 * Copyright (c) 2012-2014 Wind River Systems, Inc.
 * Copyright (c) 2016 Intel Corporation
 *
 * SPDX-License-Identifier: Apache-2.0
 */


#include <zephyr/kernel.h>
#include <zephyr/toolchain.h>
#include <zephyr/ztest.h>


#define STACKSIZE       (2048 + CONFIG_TEST_EXTRA_STACK_SIZE)

ZTEST_BMEM static int count;
ZTEST_BMEM static int ret = TC_PASS;

void k_sys_fatal_error_handler(unsigned int reason, const struct arch_esf *esf)
{
	if (reason != K_ERR_STACK_CHK_FAIL) {
		printk("wrong error type\n");
		TC_END_REPORT(TC_FAIL);
		k_fatal_halt(reason);
	}
}

void check_input(const char *name, const char *input);

/**
 *
 * print_loop
 *
 * This function calls check_input 6 times with the input name and a short
 * string, which is printed properly by check_input.
 *
 * @param name    caller identification string
 *
 */

void print_loop(const char *name)
{
	while (count < 6) {
		/* A short input string to check_input.  It will pass. */
		check_input(name, "Stack ok");
		count++;
	}
}

/**
 *
 * check_input
 *
 * This function copies the input string to a buffer of 16 characters and
 * prints the name and buffer as a string.  If the input string is longer
 * than the buffer, an error condition is detected.
 *
 * When stack protection feature is enabled (see prj.conf file), the
 * system error handler is invoked and reports a "Stack Check Fail" error.
 * When stack protection feature is not enabled, the system crashes with
 * error like: Trying to execute code outside RAM or ROM.
 *
 */

void __noinline check_input(const char *name, const char *input)
{
	/* Stack will overflow when input is more than 16 characters */
	char buf[16];

	strcpy(buf, input);
	TC_PRINT("%s: %s\n", name, buf);
}

/**
 *
 * This thread passes a long string to check_input function.  It terminates due
 * to stack overflow and reports "Stack Check Fail" when stack protection
 * feature is enabled.  Hence it will not execute the print_loop function
 * and will not set ret to TC_FAIL.
 *
 */
void alternate_thread(void *p1, void *p2, void *p3)
{
	ARG_UNUSED(p1);
	ARG_UNUSED(p2);
	ARG_UNUSED(p3);
	/*
	 * Padding buffer to absorb the intentional overflow inside the thread stack.
	 * This prevents writes from crossing the thread stack boundary into the next
	 * MPU-protected region. Required to make the test independent of compiler-
	 * specific stack frame layouts.
	 */
	volatile __unused char overflow_guard_area[32] = "Forcing Initialization!";

	TC_PRINT("Starts %s\n", __func__);
	check_input(__func__,
		    "Input string is too long and stack overflowed!\n");
	/*
	 * Expect this thread to terminate due to stack check fail and will not
	 * execute pass here.
	 */
	print_loop(__func__);

	ret = TC_FAIL;
}



K_THREAD_STACK_DEFINE(alt_thread_stack_area, STACKSIZE);
static struct k_thread alt_thread_data;

/**
 * @brief Verify that legitimate stack use does not trip the canary.
 *
 * @ingroup kernel_memprotect_tests
 *
 * @details
 * The stack protector must be silent for well-behaved code: only an actual
 * overflow may trigger it. This case runs the same buffer-handling function
 * the overflow case uses, but with input that fits, and also checks that the
 * overflow case's failure flag was never set -- the overflowing thread must
 * have been stopped by the canary before it could reach the code that sets
 * the flag. Ztest orders a suite alphabetically, so the overflow case
 * (test_stackprot_canary_overflow) has already run when this check is made.
 *
 * Test steps:
 * - Check that the shared failure flag is still clear.
 * - Call the buffer-copying function repeatedly with input that fits.
 *
 * Expected result:
 * - The calls complete normally and no stack check failure is raised.
 *
 * @verifies ZEP-SRS-8-11
 * @verifies ZEP-SRS-8-12
 * @verifies ZEP-SRS-8-25
 */
ZTEST_USER(stackprot, test_stackprot_no_false_positive)
{
	zassert_true(ret == TC_PASS);
	print_loop(__func__);
}

/**
 * @brief Verify that a stack buffer overflow is caught by the canary.
 *
 * @ingroup kernel_memprotect_tests
 *
 * @details
 * With CONFIG_STACK_CANARIES a function whose local buffer is overrun must be
 * stopped when it returns, raising K_ERR_STACK_CHK_FAIL rather than letting
 * corrupted stack contents be used. The overflowing thread would set a shared
 * failure flag if it survived, and the suite's fatal error handler accepts
 * only the stack-check reason, so both a missed overflow and a wrong error
 * type are detected.
 *
 * Test steps:
 * - Spawn a thread that copies an over-long string into a 16-byte stack
 *   buffer.
 * - Let it run; the canary check fails when the overflowed function returns.
 * - The fatal error handler verifies the reason is K_ERR_STACK_CHK_FAIL.
 *
 * Expected result:
 * - The thread is terminated by the stack check and never reaches the code
 *   that would flag a failure.
 *
 * @verifies ZEP-SRS-8-12
 * @verifies ZEP-SRS-8-25
 * @verifies ZEP-SRS-8-31
 */
ZTEST(stackprot, test_stackprot_canary_overflow)
{
	/* Start thread */
	k_thread_create(&alt_thread_data, alt_thread_stack_area, STACKSIZE,
			alternate_thread, NULL, NULL, NULL,
			K_PRIO_COOP(1), K_USER, K_NO_WAIT);

	/* Note that this sleep is required on SMP platforms where
	 * that thread will execute asynchronously!
	 */
	k_sleep(K_MSEC(100));
}

#ifdef CONFIG_STACK_CANARIES_TLS
extern Z_THREAD_LOCAL volatile uintptr_t __stack_chk_guard;
#else
extern volatile uintptr_t __stack_chk_guard;
#endif

/**
 * This thread checks its canary value against its parent canary.
 * If CONFIG_STACK_CANARIES_TLS is enabled, it is expected that the
 * canaries have different values, otherwise there is only one global
 * canary and the value should be the same.
 */
void alternate_thread_canary(void *arg1, void *arg2, void *arg3)
{
	ARG_UNUSED(arg2);
	ARG_UNUSED(arg3);

	TC_PRINT("Starts %s\n", __func__);

#ifdef CONFIG_STACK_CANARIES_TLS
	zassert_false(__stack_chk_guard == (uintptr_t)arg1);
#else
	zassert_true(__stack_chk_guard == (uintptr_t)arg1);
#endif
}

/**
 * @brief Verify the scope of the stack canary value.
 *
 * @ingroup kernel_memprotect_tests
 *
 * @details
 * With CONFIG_STACK_CANARIES_TLS every thread gets its own canary value, so
 * leaking one thread's canary does not help overflow another's; without it
 * there is a single global canary shared by all threads. The spawned thread
 * compares its own canary against its parent's, and which relation is correct
 * depends on the configuration under test.
 *
 * Test steps:
 * - Read the current thread's canary value.
 * - Spawn a thread, passing it that value, and have it compare against its
 *   own canary.
 *
 * Expected result:
 * - With per-thread canaries the values differ; with a global canary they are
 *   identical.
 *
 * @verifies ZEP-SRS-8-25
 * @verifies ZEP-SRS-8-26
 */
ZTEST(stackprot, test_stackprot_canary_scope)
{
	/* Start thread */
	k_thread_create(&alt_thread_data, alt_thread_stack_area, STACKSIZE,
			alternate_thread_canary,
			(void *)__stack_chk_guard, NULL, NULL,
			K_PRIO_COOP(1), K_USER, K_NO_WAIT);

	/* Note that this sleep is required on SMP platforms where
	 * that thread will execute asynchronously!
	 */
	k_sleep(K_MSEC(100));
}

ZTEST_SUITE(stackprot, NULL, NULL, NULL, NULL, NULL);
```

## src/mapped_stack.c
```c
/*
 * Copyright (c) 2023 Intel Corporation
 *
 * SPDX-License-Identifier: Apache-2.0
 */

#include <zephyr/kernel.h>
#include <zephyr/ztest.h>
#include <zephyr/kernel/thread_stack.h>

#ifdef CONFIG_THREAD_STACK_MEM_MAPPED

#define STACK_SIZE (CONFIG_MMU_PAGE_SIZE + CONFIG_TEST_EXTRA_STACK_SIZE)

K_THREAD_STACK_DEFINE(mapped_thread_stack_area, STACK_SIZE);
static struct k_thread mapped_thread_data;

ZTEST_BMEM static char *mapped_stack_addr;
ZTEST_BMEM static size_t mapped_stack_sz;

/**
 * @brief To cause fault in guard pages.
 *
 * @param p1 0 if testing rear guard page, 1 if testing front guard page.
 * @param p2 Unused.
 * @param p3 Unused.
 */
void mapped_thread(void *p1, void *p2, void *p3)
{
	bool is_front = p1 == NULL ? false : true;
	volatile char *ptr;

	ARG_UNUSED(p2);
	ARG_UNUSED(p3);

	TC_PRINT("Starts %s\n", __func__);
	TC_PRINT("Mapped stack %p size %zu\n", mapped_stack_addr, mapped_stack_sz);

	ptr = mapped_stack_addr;

	/* Figure out where to cause the stack fault. */
	if (is_front) {
		/* Middle of front guard page. */
		ptr -= CONFIG_MMU_PAGE_SIZE / 2;
	} else {
		/* Middle of rear guard page. */
		ptr += mapped_stack_sz;
		ptr += CONFIG_MMU_PAGE_SIZE / 2;
	}

	TC_PRINT("Trying to cause stack fault at %p\n", ptr);

	*ptr = 0;

	TC_PRINT("Should have fault on guard page but not!\n");
	ztest_test_fail();
}

/* Number of create/abort cycles done by test_mapped_stack_abort_reuse().
 * A leaked mapping is caught within the first two cycles, so this only needs
 * to be big enough to also cover repeated reuse of the same stack object.
 */
#define ABORT_REUSE_CYCLES 32

static void mapped_stack_sleeper(void *p1, void *p2, void *p3)
{
	ARG_UNUSED(p1);
	ARG_UNUSED(p2);
	ARG_UNUSED(p3);

	k_sleep(K_FOREVER);
}

/**
 * @brief To create thread to fault on guard pages.
 *
 * @param is_front True if testing front guard page, false if testing rear guard page.
 * @param is_user True if creating a user thread, false if creating a kernel thread.
 */
void create_thread(bool is_front, bool is_user)
{
	/* Start thread */
	k_thread_create(&mapped_thread_data, mapped_thread_stack_area, STACK_SIZE,
			mapped_thread,
			is_front ? (void *)1 : (void *)0,
			NULL, NULL,
			K_PRIO_COOP(1), is_user ? K_USER : 0, K_FOREVER);

	zassert_true(mapped_thread_data.stack_info.mapped.addr != NULL);

	/* Grab the mapped stack object address and size so we can calculate
	 * where to cause a stack fault.
	 */
	mapped_stack_addr = (void *)mapped_thread_data.stack_info.mapped.addr;
	mapped_stack_sz = mapped_thread_data.stack_info.mapped.sz;

	k_thread_start(&mapped_thread_data);

	/* Note that this sleep is required on SMP platforms where
	 * that thread will execute asynchronously!
	 */
	k_sleep(K_MSEC(100));

	k_thread_join(&mapped_thread_data, K_FOREVER);
}

#endif /* CONFIG_THREAD_STACK_MEM_MAPPED */

/**
 * @brief Test faulting on front guard page
 *
 * @ingroup kernel_memprotect_tests
 */
ZTEST(stackprot_mapped_stack, test_guard_page_front)
{
#ifdef CONFIG_THREAD_STACK_MEM_MAPPED
	create_thread(true, false);
#else
	ztest_test_skip();
#endif
}

/**
 * @brief Test faulting on rear guard page
 *
 * @ingroup kernel_memprotect_tests
 */
ZTEST(stackprot_mapped_stack, test_guard_page_rear)
{
#ifdef CONFIG_THREAD_STACK_MEM_MAPPED
	create_thread(false, false);
#else
	ztest_test_skip();
#endif
}

/**
 * @brief Test faulting on front guard page in user mode
 *
 * @ingroup kernel_memprotect_tests
 */
ZTEST(stackprot_mapped_stack, test_guard_page_front_user)
{
#ifdef CONFIG_THREAD_STACK_MEM_MAPPED
	create_thread(true, true);
#else
	ztest_test_skip();
#endif
}

/**
 * @brief Test faulting on rear guard page in user mode
 *
 * @ingroup kernel_memprotect_tests
 */
ZTEST(stackprot_mapped_stack, test_guard_page_rear_user)
{
#ifdef CONFIG_THREAD_STACK_MEM_MAPPED
	create_thread(false, true);
#else
	ztest_test_skip();
#endif
}

/**
 * @brief Test that aborting a thread releases its mapped stack
 *
 * Repeatedly create a thread on the same stack object and abort it from
 * another thread, which takes the immediate cleanup path in
 * k_thread_abort_cleanup(). Each cycle must return the virtual address
 * region of the stack to the pool, so every cycle maps the stack object
 * at the same address again. If the mapping is leaked instead, the address
 * walks away from the first one and the address space is eventually
 * exhausted.
 *
 * @ingroup kernel_memprotect_tests
 */
ZTEST(stackprot_mapped_stack, test_mapped_stack_abort_reuse)
{
#ifdef CONFIG_THREAD_STACK_MEM_MAPPED
	void *first_addr = NULL;

	for (unsigned int i = 0; i < ABORT_REUSE_CYCLES; i++) {
		k_tid_t tid = k_thread_create(&mapped_thread_data, mapped_thread_stack_area,
					      STACK_SIZE, mapped_stack_sleeper,
					      NULL, NULL, NULL,
					      K_PRIO_COOP(1), 0, K_NO_WAIT);
		void *addr = mapped_thread_data.stack_info.mapped.addr;

		zassert_not_null(addr, "cycle %u: stack could not be mapped", i);

		if (first_addr == NULL) {
			first_addr = addr;
		}

		zassert_equal(addr, first_addr,
			      "cycle %u: stack mapped at %p, expected %p to be reused",
			      i, addr, first_addr);

		/* Needed on SMP platforms where the thread runs asynchronously. */
		k_msleep(1);

		k_thread_abort(tid);

		zassert_is_null(mapped_thread_data.stack_info.mapped.addr,
				"cycle %u: stack still reported as mapped after abort", i);
	}
#else
	ztest_test_skip();
#endif
}

ZTEST_SUITE(stackprot_mapped_stack, NULL, NULL, NULL, NULL, NULL);
```
