## CMakeLists.txt
```
# Copyright (c) 2026 Process Mission
# SPDX-License-Identifier: Apache-2.0

cmake_minimum_required(VERSION 3.20.0)
find_package(Zephyr REQUIRED HINTS $ENV{ZEPHYR_BASE})
project(user_domain)

target_include_directories(app PRIVATE
  ${ZEPHYR_BASE}/kernel/include
  ${ZEPHYR_BASE}/arch/${ARCH}/include
  )

target_sources(app PRIVATE
  src/fatal_handler.c
  src/user_fault.c
  src/domain_sync.c
  src/kernel_only_page.c
  )
```

## prj.conf
```kconfig
CONFIG_ZTEST=y
CONFIG_DEMAND_PAGING=y
CONFIG_TEST_USERSPACE=y
CONFIG_COMMON_LIBC_MALLOC_ARENA_SIZE=0
```

## boards/qemu_cortex_a53_smp.conf
```kconfig
CONFIG_BACKING_STORE_RAM=y
CONFIG_BACKING_STORE_RAM_PAGES=24
CONFIG_DEMAND_PAGING_ALLOW_IRQ=y
```

## boards/qemu_riscv64_qemu_virt_riscv64_smode.conf
```kconfig
# Copyright (c) 2026 Jisheng Zhang <jszhang@kernel.org>
# SPDX-License-Identifier: Apache-2.0

# Enable MMU support for RISC-V virtual memory testing.
CONFIG_RISCV_MMU=y
CONFIG_MAX_XLAT_TABLES=64
CONFIG_BACKING_STORE_RAM=y
CONFIG_BACKING_STORE_RAM_PAGES=24
```

## boards/qemu_x86.conf
```kconfig
CONFIG_BACKING_STORE_RAM=y
CONFIG_BACKING_STORE_RAM_PAGES=24
```

## boards/qemu_cortex_a53.overlay
```dts
/*
 * Copyright (c) 2026 Process Mission
 *
 * SPDX-License-Identifier: Apache-2.0
 */

/* Shrink RAM to keep the demand paging region small and the run fast. */
&sram0 {
	reg = <0x0 0x40000000 0x0 0x72000>;
};
```

## boards/qemu_cortex_a53_smp.overlay
```dts
/*
 * Copyright (c) 2026 Process Mission
 *
 * SPDX-License-Identifier: Apache-2.0
 */

/* Shrink RAM to keep the demand paging region small and the run fast. */
&sram0 {
	reg = <0x0 0x40000000 0x0 0x8c000>;
};
```

## src/common.h
```c
/*
 * Copyright (c) 2026 Process Mission
 *
 * SPDX-License-Identifier: Apache-2.0
 */

#ifndef USER_DOMAIN_COMMON_H
#define USER_DOMAIN_COMMON_H

/* Set by a suite before provoking a fault that must be fatal. */
extern volatile bool expect_fault;

#endif
```

## src/domain_sync.c
```c
/*
 * Copyright (c) 2026 Process Mission
 *
 * Demand paging must preserve domain-private partition mappings: a
 * partition added to a memory domain with user permissions must remain
 * user-accessible after the kernel pages its backing frames out and
 * back in.
 *
 * Boot image pages are pinned at boot (kernel/mmu.c: z_mem_manage_init()),
 * so the partition is placed over a page-aligned static buffer that
 * k_mem_unpin() makes evictable.
 *
 * SPDX-License-Identifier: Apache-2.0
 */

#include <zephyr/ztest.h>
#include <zephyr/app_memory/mem_domain.h>
#include <zephyr/kernel/mm.h>
#include <zephyr/kernel/mm/demand_paging.h>
#include <kernel_arch_interface.h>

#include "common.h"

static char part_page[CONFIG_MMU_PAGE_SIZE] __aligned(CONFIG_MMU_PAGE_SIZE);
K_MEM_PARTITION_DEFINE(test_part, part_page, sizeof(part_page), K_MEM_PARTITION_P_RW_U_RW);

static void domain_sync_before(void *data)
{
	struct k_mem_domain *domain = k_current_get()->mem_domain_info.mem_domain;

	ARG_UNUSED(data);

	zassert_not_null(domain, "test thread has no memory domain");

	/* write a marker so we can verify the contents survive the cycle */
	part_page[0] = 0x5a;

	/* hand the page to the test domain as a private U_RW partition */
	zassert_equal(k_mem_domain_add_partition(domain, &test_part), 0,
		      "k_mem_domain_add_partition failed");

	/* boot pages are pinned; make this one evictable */
	k_mem_unpin(part_page, CONFIG_MMU_PAGE_SIZE);

	/* simulate an eviction + refill cycle, as demand paging would do */
	zassert_equal(k_mem_page_out(part_page, CONFIG_MMU_PAGE_SIZE), 0, "k_mem_page_out failed");
	k_mem_page_in(part_page, CONFIG_MMU_PAGE_SIZE);
}

ZTEST_USER(demand_paging_domain_sync, test_partition_perms_after_page_out_in)
{
	/* the private U_RW mapping must still be there */
	zassert_equal(part_page[0], 0x5a, "partition contents lost, got 0x%hhx", part_page[0]);

	part_page[1] = 0xa5;
	zassert_equal(part_page[1], (char)0xa5, "partition no longer writable");

	part_page[0] = 0;
	part_page[1] = 0;
}

ZTEST_SUITE(demand_paging_domain_sync, NULL, NULL, domain_sync_before, NULL, NULL);

static char ro_part_page[CONFIG_MMU_PAGE_SIZE] __aligned(CONFIG_MMU_PAGE_SIZE);
K_MEM_PARTITION_DEFINE(ro_test_part, ro_part_page, sizeof(ro_part_page),
		       K_MEM_PARTITION_P_RO_U_RO);
K_THREAD_STACK_DEFINE(ro_bad_stack, 2048);
static struct k_thread ro_bad_thread;
static volatile bool ro_write_succeeded;

static void ro_bad_entry(void *p1, void *p2, void *p3)
{
	volatile char *page = p1;

	ARG_UNUSED(p2);
	ARG_UNUSED(p3);

	(void)page[0];
	page[1] = 0xa5;
	ro_write_succeeded = true;
}

static void read_only_before(void *data)
{
	struct k_mem_domain *domain = k_current_get()->mem_domain_info.mem_domain;

	ARG_UNUSED(data);

	ro_part_page[0] = 0x5a;
	zassert_equal(k_mem_domain_add_partition(domain, &ro_test_part), 0,
		      "k_mem_domain_add_partition failed");

	k_mem_unpin(ro_part_page, CONFIG_MMU_PAGE_SIZE);
	zassert_equal(k_mem_page_out(ro_part_page, CONFIG_MMU_PAGE_SIZE), 0,
		      "k_mem_page_out failed");
	k_mem_page_in(ro_part_page, CONFIG_MMU_PAGE_SIZE);

	k_thread_create(&ro_bad_thread, ro_bad_stack, K_THREAD_STACK_SIZEOF(ro_bad_stack),
			ro_bad_entry, ro_part_page, NULL, NULL, K_PRIO_PREEMPT(1), K_USER,
			K_FOREVER);
	zassert_equal(k_mem_domain_add_thread(domain, &ro_bad_thread), 0,
		      "k_mem_domain_add_thread failed");
}

ZTEST(demand_paging_read_only, test_user_write_to_read_only_partition_is_fatal)
{
	ro_write_succeeded = false;
	expect_fault = true;
	k_thread_start(&ro_bad_thread);
	zassert_ok(k_thread_join(&ro_bad_thread, K_SECONDS(10)),
		   "faulting thread was not aborted");

	expect_fault = false;
	zassert_false(ro_write_succeeded, "read-only partition accepted a user write");

#if defined(CONFIG_ARM64)
	zassert_false(arch_page_info_get(ro_part_page, NULL, false) & ARCH_DATA_PAGE_DIRTY,
		      "read-only partition write marked the page dirty");
#endif
}

ZTEST_SUITE(demand_paging_read_only, NULL, NULL, read_only_before, NULL, NULL);
```

## src/fatal_handler.c
```c
/*
 * Copyright (c) 2026 Process Mission
 *
 * Shared fatal error hook for the user/domain demand paging suites.
 *
 * By default a fatal error (e.g. an unexpected user-mode page fault)
 * is reported as a test failure instead of halting, so that the test
 * harness can report the result. Suites that expect a fault set
 * expect_fault first; the hook then lets the kernel abort the faulting
 * thread and records nothing.
 *
 * SPDX-License-Identifier: Apache-2.0
 */

#include <zephyr/ztest.h>

volatile bool expect_fault;

void k_sys_fatal_error_handler(unsigned int reason, const struct arch_esf *esf)
{
	ARG_UNUSED(esf);

	printk("Caught system error -- reason %d\n", reason);

	if (!expect_fault) {
		ztest_test_fail();
		return;
	}

	expect_fault = false;
	printk("System error was expected\n");
}
```

## src/kernel_only_page.c
```c
/*
 * Copyright (c) 2026 Process Mission
 *
 * A user-mode access to a paged-out page that grants no EL0 access
 * (kernel-only mapping) must stay fatal: the demand paging handler
 * must not page it in, dirty it or LRU-refresh it on behalf of the
 * thread.
 *
 * SPDX-License-Identifier: Apache-2.0
 */

#include <zephyr/ztest.h>
#include <zephyr/kernel/mm.h>
#include <zephyr/kernel/mm/demand_paging.h>
#include <kernel_arch_interface.h>

#include "common.h"

static ZTEST_DMEM volatile bool access_succeeded;

K_THREAD_STACK_DEFINE(bad_stack, 2048);
static struct k_thread bad_thread;

static void bad_entry(void *p1, void *p2, void *p3)
{
	volatile char *page = (volatile char *)p1;

	ARG_UNUSED(p2);
	ARG_UNUSED(p3);

	/* both the read and the write must fault */
	(void)page[0];
	page[1] = 0xa5;

	/* reached only if the fault was wrongly resolved */
	access_succeeded = true;
}

ZTEST(demand_paging_kernel_only_page, test_el0_touch_kernel_page_is_fatal)
{
	char *page = k_mem_map(CONFIG_MMU_PAGE_SIZE, K_MEM_PERM_RW);
	k_tid_t tid;

	zassert_not_null(page, "k_mem_map failed");

	memset(page, 0x5a, CONFIG_MMU_PAGE_SIZE);
	zassert_equal(k_mem_page_out(page, CONFIG_MMU_PAGE_SIZE), 0, "k_mem_page_out failed");

	access_succeeded = false;
	expect_fault = true;

	tid = k_thread_create(&bad_thread, bad_stack, K_THREAD_STACK_SIZEOF(bad_stack), bad_entry,
			      page, NULL, NULL, K_PRIO_PREEMPT(1), K_USER, K_NO_WAIT);

	/* the thread must fault and be aborted by the fatal handler */
	zassert_ok(k_thread_join(tid, K_SECONDS(10)), "faulting thread was not aborted");

	expect_fault = false;
	zassert_false(access_succeeded, "EL0 access to a kernel-only paged-out page was resolved");

	/* the fault must not have paged the frame in on the thread's behalf */
	if (IS_ENABLED(CONFIG_ARM64)) {
		/*
		 * arm64 validates EL0 access against the thread's page tables
		 * before any paging state changes; x86 pages the frame in on
		 * the not-present fault and only faults on the retried
		 * access, so the location check does not apply there.
		 */
		uintptr_t location;

		zassert_equal(arch_page_location_get(page, &location), ARCH_PAGE_LOCATION_PAGED_OUT,
			      "kernel-only page was paged in for an EL0 fault");
	}
}

ZTEST_SUITE(demand_paging_kernel_only_page, NULL, NULL, NULL, NULL, NULL);
```

## src/user_fault.c
```c
/*
 * Copyright (c) 2026 Process Mission
 *
 * Demand paging from user mode: accessing a paged-out anonymous page
 * from a user thread must page it back in, with its contents intact,
 * and the page must be writable again once paged in.
 *
 * SPDX-License-Identifier: Apache-2.0
 */

#include <zephyr/ztest.h>
#include <zephyr/kernel/mm.h>
#include <zephyr/kernel/mm/demand_paging.h>

static ZTEST_DMEM char *user_page;

static void user_fault_before(void *data)
{
	ARG_UNUSED(data);

	user_page = k_mem_map(CONFIG_MMU_PAGE_SIZE, K_MEM_PERM_RW | K_MEM_PERM_USER);
	zassert_not_null(user_page, "k_mem_map failed");

	/* fault the page in from kernel context, then evict it */
	memset(user_page, 0x5a, CONFIG_MMU_PAGE_SIZE);
	zassert_equal(k_mem_page_out(user_page, CONFIG_MMU_PAGE_SIZE), 0, "k_mem_page_out failed");
}

ZTEST_USER(demand_paging_user_fault, test_user_touch_after_page_out)
{
	/* read of an evicted page must page it back in, contents intact */
	zassert_equal(user_page[0], 0x5a, "paged-out contents lost, got 0x%hhx", user_page[0]);

	/* the paged-in page must be writable */
	user_page[1] = 0xa5;
	zassert_equal(user_page[1], (char)0xa5, "write to paged-in page lost");

	/* restore for potential re-runs */
	user_page[0] = 0;
	user_page[1] = 0;
}

ZTEST_SUITE(demand_paging_user_fault, NULL, NULL, user_fault_before, NULL, NULL);
```
