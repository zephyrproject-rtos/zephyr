## tests/kernel/mem_protect/mem_map/boards/qemu_cortex_a53.conf
```kconfig
# Copyright (c) 2021 Intel Corporation
# SPDX-License-Identifier: Apache-2.0

# Simply needs more space for the translation table
# for the mapping exhaustion test.
CONFIG_MAX_XLAT_TABLES=32
CONFIG_MAX_DOMAIN_PARTITIONS=24
CONFIG_PICOLIBC_HEAP_SIZE=0
```

## tests/kernel/mem_protect/mem_map/boards/qemu_riscv64_qemu_virt_riscv64_smode.conf
```kconfig
# Copyright (c) 2026 Alexios Lyrakis <alexios.lyrakis@gmail.com>
# SPDX-License-Identifier: Apache-2.0

# Enable MMU support for RISC-V virtual memory testing.
CONFIG_RISCV_MMU=y
CONFIG_MAX_XLAT_TABLES=128
```

## tests/kernel/mem_protect/mem_map/boards/qemu_x86_tiny.conf
```kconfig
# Copyright (c) 2024 Intel Corporation
#
# SPDX-License-Identifier: Apache-2.0

# Adjust this so that test_k_mem_map_unmap memory exhaustion
# test can run without failure, as we may run of free pages
# when there are changes in code and data size.
CONFIG_DEMAND_PAGING_PAGE_FRAMES_RESERVE=27
```

## tests/kernel/mem_protect/mem_map/testcase.yaml
```yaml
common:
  ignore_faults: true
  tags:
    - kernel
    - mmu
tests:
  kernel.memory_protection.mem_map:
    filter: CONFIG_MMU and not CONFIG_X86_64 and not CONFIG_SOC_FAMILY_INTEL_ADSP
    extra_sections: _TRANSPLANTED_FUNC
    extra_configs:
      - CONFIG_COMMON_LIBC_MALLOC_ARENA_SIZE=0
      - CONFIG_CBPRINTF_REDUCED_INTEGRAL=y
    platform_exclude:
      - qemu_x86_64
      - intel_adsp/ace30/ptl
    integration_platforms:
      - qemu_x86
  kernel.memory_protection.mem_map.x86_64:
    filter: CONFIG_MMU and CONFIG_X86_64 and not CONFIG_COVERAGE
    extra_sections: _TRANSPLANTED_FUNC
    integration_platforms:
      - qemu_x86_64
  kernel.memory_protection.mem_map.x86_64.coverage:
    filter: CONFIG_MMU and CONFIG_X86_64 and CONFIG_COVERAGE
    extra_sections: _TRANSPLANTED_FUNC
    extra_args:
      - EXTRA_CFLAGS=-DSKIP_EXECUTE_TESTS
    extra_configs:
      - CONFIG_COVERAGE=y
    platform_allow: qemu_x86_64
  kernel.memory_protection.mem_map.x86_64.coverage.exec:
    filter: CONFIG_MMU and CONFIG_X86_64 and CONFIG_COVERAGE
    extra_sections: _TRANSPLANTED_FUNC
    extra_args: CONF_FILE=prj_x86_64_coverage_exec.conf
    platform_allow: qemu_x86_64
  kernel.memory_protection.mem_map.soc_intel_adsp:
    # This needs special treatment because the TEST_MEM_MAP section
    # is placed at the end. Since there is code in TEST_MEM_MAP,
    # rimage thinks the whole text section spans from .text to
    # end of TEST_MEM_MAP, which overlaps .data and others, so
    # it complains. Skip the execution test to avoid this issue.
    extra_sections: _TRANSPLANTED_FUNC
    extra_args: EXTRA_CFLAGS=-DSKIP_EXECUTE_TESTS
    platform_allow:
      - intel_adsp/ace30/ptl
      - intel_adsp/ace30/ptl/sim
```

## tests/kernel/mem_protect/mem_protect/boards/qemu_cortex_a53.conf
```kconfig
# Copyright (c) 2021 Intel Corporation
# SPDX-License-Identifier: Apache-2.0

# Simply needs more space for the translation table
# for the mapping exhaustion test.
CONFIG_MAX_XLAT_TABLES=18
```

## tests/kernel/mem_protect/mem_protect/testcase.yaml
```yaml
common:
  ignore_faults: true
  tags:
    - kernel
    - security
    - userspace
tests:
  kernel.memory_protection:
    filter: CONFIG_ARCH_HAS_USERSPACE
    arch_exclude:
      - posix
    platform_exclude:
      - twr_ke18f
      - ucans32k1sic
    extra_args:
      - CONFIG_TEST_HW_STACK_PROTECTION=n
      - CONFIG_MINIMAL_LIBC=y
  kernel.memory_protection.gap_filling.arc:
    filter: CONFIG_ARCH_HAS_USERSPACE and CONFIG_MPU_REQUIRES_NON_OVERLAPPING_REGIONS
    arch_allow: arc
    extra_args: CONFIG_MPU_GAP_FILLING=y
  kernel.memory_protection.gap_filling.arm:
    filter: CONFIG_ARCH_HAS_USERSPACE and CONFIG_MPU_REQUIRES_NON_OVERLAPPING_REGIONS
    arch_allow: arm
    platform_allow:
      - slwrb4180a
      - mps3/corstone300/an547
      - nrf9160dk/nrf9160
      - xg29_rb4412a
    integration_platforms:
      - mps3/corstone300/an547
    extra_args: CONFIG_MPU_GAP_FILLING=y
```

## tests/kernel/mem_protect/obj_validation/testcase.yaml
```yaml
tests:
  kernel.memory_protection.obj_validation:
    filter: CONFIG_ARCH_HAS_USERSPACE
    arch_exclude:
      - posix
    tags:
      - kernel
      - security
      - userspace
```

## tests/kernel/mem_protect/protection/testcase.yaml
```yaml
tests:
  kernel.memory_protection.protection:
    filter: CONFIG_SRAM_REGION_PERMISSIONS
    tags:
      - kernel
      - security
    ignore_faults: true
```

## tests/kernel/mem_protect/stack_random/boards/intel_adsp_ace30_wcl.conf
```kconfig
# Due to CONFIG_DCACHE_LINE_SIZE=64, the stack is always aligned on 64 bytes.
# With data cache line size and CONFIG_STACK_POINTER_RANDOM=64, there is not
# much randomness as any added offset (<= 64) would be rounded up to 64 bytes
# due to stack alignment. So make CONFIG_STACK_POINTER_RANDOM larger such
# that the added offset to stack pointer will actually have an effect.
CONFIG_STACK_POINTER_RANDOM=256
```

## tests/kernel/mem_protect/stack_random/testcase.yaml
```yaml
tests:
  kernel.memory_protection.stack_random:
    arch_exclude:
      - posix
      - dspic
    tags:
      - kernel
      - memory_protection
```

## tests/kernel/mem_protect/stackprot/boards/qemu_x86_tiny_768.conf
```kconfig
# Copyright 2022 Intel Corporation
# SPDX-License-Identifier: Apache-2.0

# This is needed for coverage.
CONFIG_MAIN_STACK_SIZE=4096
```

## tests/kernel/mem_protect/stackprot/testcase.yaml
```yaml
common:
  tags:
    - kernel
    - userspace
  ignore_faults: true
  arch_exclude:
    - nios2
    - xtensa
    - posix
    - sparc
tests:
  kernel.memory_protection.stackprot:
    extra_configs:
      - CONFIG_STACK_CANARIES=y
  kernel.memory_protection.stackprot_strong:
    extra_configs:
      - CONFIG_STACK_CANARIES_STRONG=y
  kernel.memory_protection.stackprot_explicit:
    toolchain_allow: gcc
    extra_configs:
      - CONFIG_STACK_CANARIES_EXPLICIT=y
  kernel.memory_protection.stackprot_tls:
    filter: CONFIG_ARCH_HAS_STACK_CANARIES_TLS and CONFIG_ARCH_HAS_THREAD_LOCAL_STORAGE
    extra_configs:
      - CONFIG_THREAD_LOCAL_STORAGE=y
      - CONFIG_STACK_CANARIES_TLS=y
```

## tests/kernel/mem_protect/sys_sem/testcase.yaml
```yaml
tests:
  kernel.memory_protection.sys_sem:
    filter: CONFIG_ARCH_HAS_USERSPACE
    arch_exclude:
      - posix
    tags:
      - kernel
      - userspace
  kernel.memory_protection.sys_sem.nouser:
    extra_configs:
      - CONFIG_TEST_USERSPACE=n
    tags: kernel
```

## tests/kernel/mem_protect/syscalls/testcase.yaml
```yaml
common:
  platform_exclude:
    - qemu_arc/qemu_arc_em
    # Too few MPU regions for USERSPACE testing
    - numaker_m2l31ki
  filter: CONFIG_ARCH_HAS_USERSPACE
  arch_exclude:
    - posix
  tags:
    - kernel
    - security
    - userspace
  ignore_faults: true
  timeout: 180
tests:
  kernel.memory_protection.syscalls.timeslicing:
    filter: CONFIG_CPU_CORTEX_M == ""
    extra_configs:
      - CONFIG_TIMESLICING=y
      - CONFIG_TIMESLICE_SIZE=20
  # There are known races with userspace and arm-m-switch that this test hits
  kernel.memory_protection.syscalls.timeslicing.arm_m:
    filter: CONFIG_CPU_CORTEX_M
    extra_configs:
      - CONFIG_USE_SWITCH=n
      - CONFIG_TIMESLICING=y
      - CONFIG_TIMESLICE_SIZE=20
  kernel.memory_protection.syscalls.kyield:
    extra_configs:
      - CONFIG_TIMESLICING=y
      - CONFIG_TIMESLICE_SIZE=0
```

## tests/kernel/mem_protect/userspace/Kconfig
```kconfig
# Copyright (c) 2025 Intel Corporation
#
# SPDX-License-Identifier: Apache-2.0

mainmenu "Userspace test"

source "Kconfig.zephyr"

config USERSPACE_SWITCHING_TESTS
	bool "Run thread switching tests"
	select SCHED_CPU_MASK if MP_MAX_NUM_CPUS > 1
	help
	  Run userspace_domain_switching tests.

	  Enable this via board overlay.
```

## tests/kernel/mem_protect/userspace/boards/qemu_riscv64_qemu_virt_riscv64_sv48.conf
```kconfig
# Copyright (c) 2026 Alexios Lyrakis <alexios.lyrakis@gmail.com>
# SPDX-License-Identifier: Apache-2.0

# Enable MMU support for RISC-V virtual memory testing.
CONFIG_RISCV_MMU=y
CONFIG_MAX_XLAT_TABLES=128
# QEMU icount mode: jump to next timer deadline on wfi (needed for k_sleep)
CONFIG_QEMU_ICOUNT_SLEEP=y
CONFIG_USERSPACE_SWITCHING_TESTS=y
```

## tests/kernel/mem_protect/userspace/testcase.yaml
```yaml
common:
  ignore_faults: true
  tags:
    - kernel
    - security
    - userspace
  arch_exclude:
    - posix
tests:
  kernel.memory_protection.userspace:
    filter: CONFIG_ARCH_HAS_USERSPACE
    extra_configs:
      - CONFIG_TEST_HW_STACK_PROTECTION=n
      - CONFIG_COMMON_LIBC_MALLOC_ARENA_SIZE=0
    platform_exclude:
      - ucans32k1sic
  kernel.memory_protection.userspace.gap_filling.arc:
    filter: CONFIG_ARCH_HAS_USERSPACE and CONFIG_MPU_REQUIRES_NON_OVERLAPPING_REGIONS
    arch_allow: arc
    extra_args: CONFIG_MPU_GAP_FILLING=y
  kernel.memory_protection.userspace.gap_filling.arm:
    filter: CONFIG_ARCH_HAS_USERSPACE and CONFIG_MPU_REQUIRES_NON_OVERLAPPING_REGIONS
    arch_allow: arm
    platform_allow:
      - slwrb4180a
      - mps3/corstone300/an547
      - nrf9160dk/nrf9160
    integration_platforms:
      - mps3/corstone300/an547
    extra_args: CONFIG_MPU_GAP_FILLING=y
```

## tests/kernel/mem_protect/x86_mmu_api/testcase.yaml
```yaml
tests:
  kernel.memory_protection.mmu:
    platform_whitelist: qemu_x86 arduino_101
    tags: kernel
```

## tests/kernel/mem_safe/testcase.yaml
```yaml
tests:
-   test:
        filter: not CONFIG_X86_IAMCU
        platform_whitelist: qemu_x86 qemu_cortex_m3
        tags: kernel core
        timeout: '200'
```

## tests/kernel/mem_slab/mslab/Kconfig
```kconfig
# Copyright (c) 2025 Intel Corporation
# SPDX-License-Identifier: Apache-2.0

source "Kconfig.zephyr"

config TEST_ALLOC_TIMEOUT_MS
	int "k_mem_slab_alloc() test timeout, ms."
	default 50
	help
	  Use as k_mem_slab_alloc() timeout for the tests.
	  Adjust to platform performance if needed.
```

## tests/kernel/mem_slab/mslab/testcase.yaml
```yaml
tests:
  kernel.memory_slabs:
    tags:
      - kernel
      - memory_slabs
    extra_configs:
      - platform:intel_ish_5_8_0/intel_ish_5_8_0:CONFIG_TEST_ALLOC_TIMEOUT_MS=180
```

## tests/kernel/mem_slab/mslab_api/testcase.yaml
```yaml
tests:
  kernel.memory_slabs.api:
    tags:
      - kernel
      - memory_slabs
  kernel.memory_slabs.api.no-mt:
    tags:
      - kernel
      - memory_slabs
    platform_allow:
      - qemu_cortex_m3
      - qemu_cortex_m0
      - nsim/nsim_em
      - nsim/nsim_em7d_v22
      - nsim/nsim_hs
      - nsim/nsim_hs/mpuv6
      - nsim/nsim_hs5x
      - nsim/nsim_hs6x
      - qemu_arc/qemu_arc_em
      - qemu_arc/qemu_arc_hs
      - qemu_arc/qemu_arc_hs6x
      - qemu_riscv/qemu_virt_riscv/rv32
      - qemu_riscv/qemu_virt_riscv/rv32e
      - qemu_riscv/qemu_virt_riscv/rv64
      - qemu_leon3
    integration_platforms:
      - qemu_cortex_m3
      - qemu_arc/qemu_arc_hs
    extra_configs:
      - CONFIG_MULTITHREADING=n
```
