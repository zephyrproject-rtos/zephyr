## CMakeLists.txt
```
# SPDX-License-Identifier: Apache-2.0

cmake_minimum_required(VERSION 3.28.0)
find_package(Zephyr REQUIRED HINTS $ENV{ZEPHYR_BASE})
project(mem_protect)

target_include_directories(app PRIVATE
  ${ZEPHYR_BASE}/kernel/include
  ${ZEPHYR_BASE}/arch/${ARCH}/include
  )

FILE(GLOB app_sources src/*.c)
target_sources(app PRIVATE ${app_sources})
```

## prj.conf
```kconfig
CONFIG_STACK_CANARIES=n
CONFIG_ZTEST=y
CONFIG_ZTEST_STACK_SIZE=2048
CONFIG_MAX_THREAD_BYTES=4
CONFIG_TEST_USERSPACE=y
CONFIG_APPLICATION_DEFINED_SYSCALL=y
```

## boards/qemu_cortex_a53.conf
```kconfig
# Copyright (c) 2021 Intel Corporation
# SPDX-License-Identifier: Apache-2.0

# Simply needs more space for the translation table
# for the mapping exhaustion test.
CONFIG_MAX_XLAT_TABLES=24
```

## boards/qemu_cortex_a53_qemu_cortex_a53_smp.conf
```kconfig
# Copyright (c) 2021 Intel Corporation
# SPDX-License-Identifier: Apache-2.0

# Simply needs more space for the translation table
# for the mapping exhaustion test.
CONFIG_MAX_XLAT_TABLES=34
```

## boards/qemu_hexagon_qemu_hexagon_virt.conf
```kconfig
# test_kobj_create_out_of_memory() keeps a pointer for each of up to
# MAX_OBJ (4096 on this 32-bit arch, see mem_protect.h) allocated
# kobjects on the ztest thread's stack. Grow it to fit that array plus
# normal test overhead.
CONFIG_ZTEST_STACK_SIZE=24576
```

## boards/qemu_riscv32_qemu_virt_riscv32_smode.conf
```kconfig
# Copyright (c) 2026 Jisheng Zhang <jszhang@kernel.org>
# SPDX-License-Identifier: Apache-2.0

# Enable MMU support for RISC-V virtual memory testing.
CONFIG_RISCV_MMU=y
CONFIG_MAX_XLAT_TABLES=128
```

## src/main.c
```c
/*
 * Parts derived from tests/kernel/fatal/src/main.c, which has the
 * following copyright and license:
 *
 * Copyright (c) 2017, 2020 Intel Corporation
 *
 * SPDX-License-Identifier: Apache-2.0
 */

#include <zephyr/zephyr.h>
#include <zephyr/ztest.h>
#include <zephyr/kernel_structs.h>
#include <string.h>
#include <stdlib.h>
#include "mem_protect.h"

K_HEAP_DEFINE(test_mem_heap, TEST_HEAP_SIZE);

K_THREAD_STACK_DEFINE(test_stack, KOBJECT_STACK_SIZE);

void test_main(void)
{
	k_thread_priority_set(k_current_get(), -1);

	k_thread_heap_assign(k_current_get(), &test_mem_heap);

	ztest_test_suite(memory_protection_test_suite,
		/* inherit.c */
		ztest_unit_test(test_permission_inheritance),
		ztest_unit_test(test_inherit_resource_pool),

		/* mem_domain.c */
		ztest_unit_test(test_mem_domain_setup),
		ztest_unit_test(test_mem_domain_valid_access),
		ztest_unit_test(test_mem_domain_invalid_access),
		ztest_unit_test(test_mem_domain_no_writes_to_ro),
		ztest_unit_test(test_mem_domain_remove_add_partition),
		ztest_unit_test(test_mem_domain_api_supervisor_only),
		ztest_unit_test(test_mem_domain_boot_threads),
		ztest_unit_test(test_mem_domain_migration),
		ztest_unit_test(test_mem_part_overlap),
		ztest_unit_test(test_mem_domain_init_fail),
		ztest_unit_test(test_mem_domain_remove_part_fail),
		ztest_unit_test(test_mem_part_add_error_null),
		ztest_unit_test(test_mem_part_add_error_zerosize),
		ztest_unit_test(test_mem_part_error_wraparound),
		ztest_unit_test(test_mem_part_remove_error_zerosize),

		/* mem_partition.c */
		ztest_user_unit_test(test_mem_part_assign_bss_vars_zero),
		ztest_unit_test(test_mem_part_auto_determ_size),

		/* kobject.c */
		ztest_unit_test(test_kobject_access_grant),
		ztest_unit_test(test_kobject_access_grant_error),
		ztest_user_unit_test(test_kobject_access_grant_error_user_null),
		ztest_user_unit_test(test_kobject_access_grant_error_user),
		ztest_user_unit_test(test_kobject_access_all_grant_error),
		ztest_unit_test(test_syscall_invalid_kobject),
		ztest_unit_test(test_thread_without_kobject_permission),
		ztest_unit_test(test_kobject_revoke_access),
		ztest_unit_test(test_kobject_grant_access_kobj),
		ztest_unit_test(test_kobject_grant_access_kobj_invalid),
		ztest_unit_test(test_kobject_release_from_user),
		ztest_unit_test(test_kobject_invalid),
		ztest_unit_test(test_kobject_access_all_grant),
		ztest_unit_test(test_thread_has_residual_permissions),
		ztest_unit_test(test_kobject_access_grant_to_invalid_thread),
		ztest_user_unit_test(test_kobject_access_invalid_kobject),
		ztest_user_unit_test(test_access_kobject_without_init_access),
		ztest_unit_test(test_access_kobject_without_init_with_access),
		ztest_unit_test(test_kobject_reinitialize_thread_kobj),
		ztest_unit_test(test_create_new_thread_from_user),
		ztest_unit_test(test_new_user_thread_with_in_use_stack_obj),
		ztest_unit_test(test_create_new_thread_from_user_no_access_stack),
		ztest_unit_test(test_create_new_thread_from_user_invalid_stacksize),
		ztest_unit_test(test_create_new_thread_from_user_huge_stacksize),
		ztest_unit_test(test_create_new_supervisor_thread_from_user),
		ztest_unit_test(test_create_new_essential_thread_from_user),
		ztest_unit_test(test_create_new_higher_prio_thread_from_user),
		ztest_unit_test(test_create_new_invalid_prio_thread_from_user),
		ztest_unit_test(test_mark_thread_exit_uninitialized),
		ztest_unit_test(test_mem_part_assert_add_overmax),
		ztest_user_unit_test(test_kobject_init_error),
		ztest_unit_test(test_alloc_kobjects),
		ztest_unit_test(test_thread_alloc_out_of_idx),
		ztest_unit_test(test_kobj_create_out_of_memory),
		ztest_unit_test(test_kobject_perm_error),
		ztest_unit_test(test_kobject_free_error),
		ztest_unit_test(test_all_kobjects_str)
		);

	ztest_run_test_suite(memory_protection_test_suite);
}
```

## src/check_access.c
```c
/*
 * Copyright (c) Qualcomm Technologies, Inc. and/or its subsidiaries.
 * SPDX-License-Identifier: Apache-2.0
 */

#include <zephyr/ztest.h>
#include <zephyr/kernel.h>

K_SEM_DEFINE(obj_access, 0, 1);
K_SEM_DEFINE(obj_no_access, 0, 1);
int no_obj;

/**
 * @brief Verify that k_object_access_check() reports the caller's rights.
 *
 * @ingroup kernel_memprotect_tests
 *
 * @details
 * The check call lets a user thread ask, without side effects, whether it may
 * use an object. Each answer must match the actual state: granted object,
 * object never granted, address that is no kernel object, and the thread's
 * own thread object, which every thread implicitly owns.
 *
 * Test steps:
 * - Check a semaphore granted during suite setup.
 * - Check a semaphore that was never granted.
 * - Check an address that is not a kernel object.
 * - Check the calling thread's own thread object.
 *
 * Expected result:
 * - The calls return 0, -EPERM, -EBADF and 0 respectively.
 *
 * @see k_object_access_check()
 * @verifies ZEP-SRS-8-2
 */
ZTEST_USER(userspace_access_check, test_kobject_access_check)
{
	zexpect_equal(k_object_access_check(&obj_access), 0, "should have access but doesn't");
	zexpect_equal(k_object_access_check(&obj_no_access), -EPERM,
		      "should not have access but does");
	zexpect_equal(k_object_access_check(&no_obj), -EBADF, "should not be valid object but is");

	/* User thread should always have access to itself */
	zexpect_equal(k_object_access_check(k_current_get()), 0, "no access to itself");
}

static void *userspace_access_setup(void)
{
	k_object_access_grant(&obj_access, k_current_get());

	return NULL;
}

ZTEST_SUITE(userspace_access_check, NULL, userspace_access_setup, NULL, NULL, NULL);
```

## src/common.c
```c
/*
 * Copyright (c) 2017 Intel Corporation
 *
 * SPDX-License-Identifier: Apache-2.0
 */
#include <zephyr/kernel.h>
#include <zephyr/ztest.h>

ZTEST_BMEM volatile bool valid_fault;

void k_sys_fatal_error_handler(unsigned int reason, const struct arch_esf *pEsf)
{
	printk("Caught system error -- reason %d %d\n", reason, valid_fault);
	if (valid_fault) {
		printk("fatal error expected as part of test case\n");
		valid_fault = false; /* reset back to normal */
	} else {
		printk("fatal error was unexpected, aborting\n");
		TC_END_REPORT(TC_FAIL);
		k_fatal_halt(reason);
	}
}
```

## src/inherit.c
```c
/*
 * Copyright (c) 2017, 2020 Intel Corporation
 *
 * SPDX-License-Identifier: Apache-2.0
 */

#include "mem_protect.h"
#include <zephyr/internal/syscall_handler.h>
#include <zephyr/sys/libc-hooks.h> /* for z_libc_partition */

/* function prototypes */
static inline void dummy_start(struct k_timer *timer)
{
	ARG_UNUSED(timer);
}
static inline void dummy_end(struct k_timer *timer)
{
	ARG_UNUSED(timer);
}

/* Kernel objects */
K_THREAD_STACK_DEFINE(test_1_stack, INHERIT_STACK_SIZE);
K_THREAD_STACK_DEFINE(parent_thr_stack, STACK_SIZE);
K_THREAD_STACK_DEFINE(child_thr_stack, STACK_SIZE);
K_HEAP_DEFINE(heap_mem, BLK_SIZE_MAX * BLK_NUM_MAX);
K_SEM_DEFINE(inherit_sem, SEMAPHORE_INIT_COUNT, SEMAPHORE_MAX_COUNT);
K_SEM_DEFINE(sync_sem, SEM_INIT_VAL, SEM_MAX_VAL);
K_MUTEX_DEFINE(inherit_mutex);
K_TIMER_DEFINE(inherit_timer, dummy_start, dummy_end);
K_MSGQ_DEFINE(inherit_msgq, MSG_Q_SIZE, MSG_Q_MAX_NUM_MSGS, MSG_Q_ALIGN);
struct k_thread test_1_tid, parent_thr, child_thr;
k_tid_t parent_tid;

uint8_t MEM_DOMAIN_ALIGNMENT inherit_buf[MEM_REGION_ALLOC]; /* for mem domain */

K_MEM_PARTITION_DEFINE(inherit_memory_partition,
		       inherit_buf,
		       sizeof(inherit_buf),
		       K_MEM_PARTITION_P_RW_U_RW);

struct k_mem_partition *inherit_memory_partition_array[] = {
#if Z_LIBC_PARTITION_EXISTS
	&z_libc_partition,
#endif
	&inherit_memory_partition,
	&ztest_mem_partition
};

struct k_mem_domain inherit_mem_domain;

/* generic function to do check the access permissions. */
static void access_test(void)
{
	uint32_t msg_q_data = 0xA5A5;

	/* check for all accesses  */
	k_sem_give(&inherit_sem);
	k_mutex_lock(&inherit_mutex, K_FOREVER);
	(void) k_timer_status_get(&inherit_timer);
	k_msgq_put(&inherit_msgq, (void *)&msg_q_data, K_NO_WAIT);
	k_mutex_unlock(&inherit_mutex);
	inherit_buf[MEM_REGION_ALLOC-1] = 0xA5;
}

static void test_thread_1_for_user(void *p1, void *p2, void *p3)
{
	/* check that child thread inherited permissions */
	access_test();

	set_fault_valid(true);

	/* Check that child thread can't access parent thread object*/
	/* Kernel fault in that place will happen */
	k_thread_priority_get(parent_tid);
}

static void test_thread_1_for_SU(void *p1, void *p2, void *p3)
{
	set_fault_valid(false);

	access_test();

	/* Check if user mode inherit is working if control is passed from SU */
	k_thread_user_mode_enter(test_thread_1_for_user, NULL, NULL, NULL);
}

/**
 * @brief Test object permission inheritance except of the parent thread object
 *
 * @details
 * - To the parent current thread grant permissions on kernel objects.
 * - Create a child thread and check that it inherited permissions on that
 *   kernel objects.
 * - Then check child thread can't access to the parent thread object using API
 *   command k_thread_priority_get()
 * - At the same moment that test verifies that child thread was granted
 *   permission on a kernel objects. That means child user thread caller
 *   already has permission on the thread objects being granted.

 * @ingroup kernel_memprotect_tests
 *
 * @see k_mem_domain_init(), k_mem_domain_add_thread(),
 * k_thread_access_grant()
 * @verifies ZEP-SRS-8-2
 * @verifies ZEP-SRS-8-16
 */
ZTEST(mem_protect, test_permission_inheritance)
{
	parent_tid = k_current_get();
	k_mem_domain_add_thread(&inherit_mem_domain, parent_tid);

	k_thread_access_grant(parent_tid,
			      &inherit_sem,
			      &inherit_mutex,
			      &inherit_timer,
			      &inherit_msgq, &test_1_stack);

	k_thread_create(&test_1_tid,
			test_1_stack,
			INHERIT_STACK_SIZE,
			test_thread_1_for_SU,
			NULL, NULL, NULL,
			0, K_INHERIT_PERMS, K_NO_WAIT);

	k_thread_join(&test_1_tid, K_FOREVER);
}

struct k_heap *z_impl_ret_resource_pool_ptr(void)
{
	return _current->resource_pool;
}

static inline struct k_heap *z_vrfy_ret_resource_pool_ptr(void)
{
	return z_impl_ret_resource_pool_ptr();
}
#include <zephyr/syscalls/ret_resource_pool_ptr_mrsh.c>
struct k_heap *child_heap_mem_ptr;
struct k_heap *parent_heap_mem_ptr;

void child_handler(void *p1, void *p2, void *p3)
{
	child_heap_mem_ptr = ret_resource_pool_ptr();
	k_sem_give(&sync_sem);
}

void parent_handler(void *p1, void *p2, void *p3)
{
	parent_heap_mem_ptr = ret_resource_pool_ptr();
	k_thread_create(&child_thr, child_thr_stack,
			K_THREAD_STACK_SIZEOF(child_thr_stack),
			child_handler,
			NULL, NULL, NULL,
			PRIORITY, 0, K_NO_WAIT);

	k_thread_join(&child_thr, K_FOREVER);
}

/**
 * @brief Test child thread inherits parent's thread resource pool
 *
 * @details
 * - Create a memory heap heap_mem for the parent thread.
 * - Then special system call ret_resource_pool_ptr() returns pointer
 *   to the resource pool of the current thread.
 * - Call it in the parent_handler() and in the child_handler()
 * - Then in the main test function test_inherit_resource_pool()
 *   compare returned addresses
 * - If the addresses are the same, it means that child thread inherited
 *   resource pool of the parent's thread -test passed.
 *
 * @ingroup kernel_memprotect_tests
 *
 * @see k_thread_heap_assign()
 * @verifies ZEP-SRS-8-18
 */
ZTEST(mem_protect, test_inherit_resource_pool)
{
	k_sem_reset(&sync_sem);
	k_thread_create(&parent_thr, parent_thr_stack,
			K_THREAD_STACK_SIZEOF(parent_thr_stack),
			parent_handler,
			NULL, NULL, NULL,
			PRIORITY, 0, K_FOREVER);
	k_thread_heap_assign(&parent_thr, &heap_mem);
	k_thread_start(&parent_thr);
	k_sem_take(&sync_sem, K_FOREVER);
	zassert_true(parent_heap_mem_ptr == child_heap_mem_ptr,
		     "Resource pool of the parent thread not inherited,"
		     " by child thread");

	k_thread_join(&parent_thr, K_FOREVER);
}

void mem_protect_inhert_setup(void)
{
	int ret;

	ret = k_mem_domain_init(&inherit_mem_domain,
				ARRAY_SIZE(inherit_memory_partition_array),
				inherit_memory_partition_array);
	if (ret != 0) {
		ztest_test_fail();
	}
}


K_HEAP_DEFINE(test_mem_heap, TEST_HEAP_SIZE);

void *mem_protect_setup(void)
{
	k_thread_priority_set(k_current_get(), -1);

	k_thread_heap_assign(k_current_get(), &test_mem_heap);

	mem_protect_inhert_setup();

	return NULL;
}

ZTEST_SUITE(mem_protect, NULL, mem_protect_setup,
		NULL, NULL, NULL);
```

## src/mem_domain.c
```c
/*
 * Copyright (c) 2017, 2020 Intel Corporation
 *
 * SPDX-License-Identifier: Apache-2.0
 */

#include "mem_protect.h"
#include <kernel_internal.h> /* For z_main_thread */
#include <zephyr/sys/libc-hooks.h> /* for z_libc_partition */

static struct k_thread child_thread;
K_THREAD_STACK_DEFINE(child_stack, KOBJECT_STACK_SIZE);

/* Special memory domain for test case purposes */
static struct k_mem_domain test_domain;

#if Z_LIBC_PARTITION_EXISTS
#define PARTS_USED	3
#else
#define PARTS_USED	2
#endif
/* Maximum number of allowable memory partitions defined by the build */
#define NUM_RW_PARTS	(CONFIG_MAX_DOMAIN_PARTITIONS - PARTS_USED)

/* Max number of allowable partitions, derived at runtime. Might be less. */
ZTEST_BMEM int num_rw_parts;

/* Set of read-write buffers each in their own partition */
static volatile uint8_t __aligned(MEM_REGION_ALLOC)
	rw_bufs[NUM_RW_PARTS][MEM_REGION_ALLOC];
static struct k_mem_partition rw_parts[NUM_RW_PARTS];

/* A single read-only partition */
static volatile uint8_t __aligned(MEM_REGION_ALLOC) ro_buf[MEM_REGION_ALLOC];
K_MEM_PARTITION_DEFINE(ro_part, ro_buf, sizeof(ro_buf),
		       K_MEM_PARTITION_P_RO_U_RO);
/* A partition to test overlap that has same ro_buf as a partition ro_part */
K_MEM_PARTITION_DEFINE(overlap_part, ro_buf, sizeof(ro_buf),
		       K_MEM_PARTITION_P_RW_U_RW);

/* Static thread, used by a couple tests */
static void zzz_entry(void *p1, void *p2, void *p3)
{
	k_sleep(K_FOREVER);
}

static K_THREAD_DEFINE(zzz_thread, 512 + CONFIG_TEST_EXTRA_STACK_SIZE,
		       zzz_entry, NULL, NULL, NULL, 0, 0, 0);

void *test_mem_domain_setup(void)
{
	int max_parts = arch_mem_domain_max_partitions_get();
	struct k_mem_partition *parts[] = {
#if Z_LIBC_PARTITION_EXISTS
		&z_libc_partition,
#endif
		&ro_part, &ztest_mem_partition
	};

	num_rw_parts = max_parts - PARTS_USED;
	zassert_true(num_rw_parts <= NUM_RW_PARTS,
			"CONFIG_MAX_DOMAIN_PARTITIONS incorrectly tuned, %d should be at least %d",
			CONFIG_MAX_DOMAIN_PARTITIONS, max_parts);
	zassert_true(num_rw_parts > 0, "no free memory partitions");

	zassert_equal(
		k_mem_domain_init(&test_domain, ARRAY_SIZE(parts), parts),
		0, "failed to initialize memory domain");

	for (unsigned int i = 0; i < num_rw_parts; i++) {
		rw_parts[i].start = (uintptr_t)&rw_bufs[i];
		rw_parts[i].size = MEM_REGION_ALLOC;
		rw_parts[i].attr = K_MEM_PARTITION_P_RW_U_RW;

		for (unsigned int j = 0; j < MEM_REGION_ALLOC; j++) {
			rw_bufs[i][j] = (j % 256U);
		}

		zassert_equal(
			k_mem_domain_add_partition(&test_domain, &rw_parts[i]),
			0, "cannot add memory partition");
	}

	for (unsigned int j = 0; j < MEM_REGION_ALLOC; j++) {
		ro_buf[j] = (j % 256U);
	}

	return NULL;
}

void test_mem_domain_teardown(void *fixture)
{
	ARG_UNUSED(fixture);

#if defined(CONFIG_ARCH_MEM_DOMAIN_SUPPORTS_DEINIT)
	zassert_equal(k_mem_domain_deinit(&test_domain), 0,
		      "failed to de-initialize memory domain");
#endif /* CONFIG_ARCH_MEM_DOMAIN_SUPPORTS_DEINIT */
}

/* Helper function; run a function under a child user thread.
 * If domain is not NULL, add the child thread to that domain, instead of
 * whatever it would inherit.
 */
static void spawn_child_thread(k_thread_entry_t entry,
			       struct k_mem_domain *domain, bool should_fault)
{
	set_fault_valid(should_fault);

	k_thread_create(&child_thread, child_stack,
			K_THREAD_STACK_SIZEOF(child_stack), entry,
			NULL, NULL, NULL, 0, K_USER, K_FOREVER);
	k_thread_name_set(&child_thread, "child_thread");
	if (domain != NULL) {
		k_mem_domain_add_thread(domain, &child_thread);
	}
	k_thread_start(&child_thread);
	k_thread_join(&child_thread, K_FOREVER);

	if (should_fault && valid_fault) {
		/* valid_fault gets cleared if an expected exception
		 * took place
		 */
		printk("test function %p was supposed to fault but didn't\n",
		       entry);
		ztest_test_fail();
	}
}

/* read and write to all the rw_parts */
static void rw_part_access(void *p1, void *p2, void *p3)
{
	for (unsigned int i = 0; i < num_rw_parts; i++) {
		for (unsigned int j = 0; j < MEM_REGION_ALLOC; j++) {
			/* Test read */
			zassert_equal(rw_bufs[i][j], j % 256U,
				      "bad data in rw_buf[%d][%d]", i, j);
			/* Test writes */
			rw_bufs[i][j]++;
			rw_bufs[i][j]--;
		}
	}
}

/* read the ro_part */
static void ro_part_access(void *p1, void *p2, void *p3)
{
	for (unsigned int i = 0; i < MEM_REGION_ALLOC; i++) {
		zassert_equal(ro_buf[i], i % 256U,
			      "bad data in ro_buf[%d]", i);
	}
}

/* attempt to write to ro_part */
static void ro_write_entry(void *p1, void *p2, void *p3)
{
	/* Should fault here */
	ro_buf[0] = 200;
}

/**
 * @brief Verify that partitions in a thread's domain are accessible as
 *        declared.
 *
 * @ingroup kernel_memprotect_tests
 *
 * @details
 * A user thread that is a member of a domain must reach the data in that
 * domain's partitions with exactly the declared permissions: read-write data
 * is writable, read-only data is readable.
 *
 * Test steps:
 * - Spawn a user thread in the test domain that reads and writes the
 *   read-write partition.
 * - Spawn another that reads the read-only partition.
 *
 * Expected result:
 * - Both accesses succeed with no fault.
 *
 * @see k_mem_domain_add_thread()
 * @verifies ZEP-SRS-8-1
 * @verifies ZEP-SRS-8-17
 * @verifies ZEP-SRS-8-24
 */
ZTEST(mem_protect_domain, test_mem_domain_valid_access)
{
	spawn_child_thread(rw_part_access, &test_domain, false);
	spawn_child_thread(ro_part_access, &test_domain, false);
}

/**
 * @brief Verify that partitions outside a thread's domain are unreachable.
 *
 * @ingroup kernel_memprotect_tests
 *
 * @details
 * The same accesses as the valid case, made by a thread that was never added
 * to the test domain, must fault: domain membership is what grants access,
 * not the existence of the partition. The suite's fault hook marks the
 * faults as expected.
 *
 * Test steps:
 * - Spawn a user thread outside the test domain that touches the read-write
 *   partition.
 * - Spawn another that touches the read-only partition.
 *
 * Expected result:
 * - Both accesses fault.
 *
 * @verifies ZEP-SRS-8-1
 * @verifies ZEP-SRS-8-17
 * @verifies ZEP-SRS-8-24
 */
ZTEST(mem_protect_domain, test_mem_domain_invalid_access)
{
	/* child not added to test_domain, will fault for both */
	spawn_child_thread(rw_part_access, NULL, true);
	spawn_child_thread(ro_part_access, NULL, true);
}

/**
 * @brief Verify that a read-only partition rejects writes from its own
 *        domain.
 *
 * @ingroup kernel_memprotect_tests
 *
 * @details
 * Being inside the domain grants the declared permission, not more: a member
 * thread writing data in the read-only partition must fault even though it
 * can read it freely.
 *
 * Test steps:
 * - Spawn a user thread in the test domain that writes a variable in the
 *   read-only partition.
 *
 * Expected result:
 * - The write faults.
 *
 * @verifies ZEP-SRS-8-17
 */
ZTEST(mem_protect_domain, test_mem_domain_no_writes_to_ro)
{
	/* Show that trying to write to a read-only partition causes a fault */
	spawn_child_thread(ro_write_entry, &test_domain, true);
}

/**
 * @brief Verify that partition removal and re-addition track access rights.
 *
 * @ingroup kernel_memprotect_tests
 *
 * @details
 * Removing a partition from a domain must revoke exactly that partition:
 * other partitions stay reachable, the removed one faults, and adding it
 * back restores access. All three transitions are observed from member user
 * threads.
 *
 * Test steps:
 * - Remove one read-write partition and show another is still accessible.
 * - Access the removed partition and expect a fault.
 * - Add the partition back and access it again.
 *
 * Expected result:
 * - Access follows the domain's current partition set at each step.
 *
 * @see k_mem_domain_remove_partition()
 * @see k_mem_domain_add_partition()
 * @verifies ZEP-SRS-8-17
 * @verifies ZEP-SRS-8-21
 * @verifies ZEP-SRS-8-22
 */
ZTEST(mem_protect_domain, test_mem_domain_remove_add_partition)
{
	zassert_equal(
		k_mem_domain_remove_partition(&test_domain, &rw_parts[0]),
		0, "failed to remove memory partition");

	/* Should still work, we didn't remove ro_part */
	spawn_child_thread(ro_part_access, &test_domain, false);

	/* This will fault, we removed one of the rw_part from the domain */
	spawn_child_thread(rw_part_access, &test_domain, true);

	/* Restore test_domain contents so we don't mess up other tests */
	zassert_equal(
		k_mem_domain_add_partition(&test_domain, &rw_parts[0]),
		0, "failed to add memory partition");

	/* Should work again */
	spawn_child_thread(rw_part_access, &test_domain, false);
}

/* user mode will attempt to initialize this and fail */
static struct k_mem_domain no_access_domain;

/* Extra partition that a user thread can't add to a domain */
static volatile uint8_t __aligned(MEM_REGION_ALLOC)
	no_access_buf[MEM_REGION_ALLOC];
K_MEM_PARTITION_DEFINE(no_access_part, no_access_buf, sizeof(no_access_buf),
		       K_MEM_PARTITION_P_RW_U_RW);

static void mem_domain_init_entry(void *p1, void *p2, void *p3)
{
	zassert_equal(
		k_mem_domain_init(&no_access_domain, 0, NULL),
		0, "failed to initialize memory domain");

#if defined(CONFIG_ARCH_MEM_DOMAIN_SUPPORTS_DEINIT)
	zassert_equal(k_mem_domain_deinit(&no_access_domain), 0,
		      "failed to de-initialize memory domain");
#endif /* CONFIG_ARCH_MEM_DOMAIN_SUPPORTS_DEINIT */
}

static void mem_domain_add_partition_entry(void *p1, void *p2, void *p3)
{
	zassert_equal(
		k_mem_domain_add_partition(&test_domain, &no_access_part),
		0, "failed to add memory partition");
}

static void mem_domain_remove_partition_entry(void *p1, void *p2, void *p3)
{
	zassert_equal(
		k_mem_domain_remove_partition(&test_domain, &ro_part),
		0, "failed to remove memory partition");
}

static void mem_domain_add_thread_entry(void *p1, void *p2, void *p3)
{
	k_mem_domain_add_thread(&test_domain, zzz_thread);
}

/**
 * @brief Verify that the memory domain APIs are supervisor-only.
 *
 * @ingroup kernel_memprotect_tests
 *
 * @details
 * The domain configuration calls have no syscall wrappers: they reshape the
 * protection landscape and must be unreachable from user mode. A user thread
 * invoking any of them has to fault on the attempt.
 *
 * Test steps:
 * - From a user thread, call k_mem_domain_init(), add_partition,
 *   remove_partition and add_thread in turn.
 *
 * Expected result:
 * - Each call faults before doing anything.
 *
 * @see k_mem_domain_init()
 * @see k_mem_domain_add_partition()
 * @see k_mem_domain_remove_partition()
 * @see k_mem_domain_add_thread()
 * @verifies ZEP-SRS-8-3
 */
ZTEST(mem_protect_domain, test_mem_domain_api_supervisor_only)
{
	/* All of these should fault when invoked from a user thread */
	spawn_child_thread(mem_domain_init_entry, NULL, true);
	spawn_child_thread(mem_domain_add_partition_entry, NULL, true);
	spawn_child_thread(mem_domain_remove_partition_entry, NULL, true);
	spawn_child_thread(mem_domain_add_thread_entry, NULL, true);
}

/**
 * @brief Verify that boot-time threads start in the default memory domain.
 *
 * @ingroup kernel_memprotect_tests
 *
 * @details
 * Threads that exist before the application configures anything -- the main
 * thread and statically defined threads -- must be members of the default
 * domain, or they would run with no defined memory view at all. Membership
 * is read directly from the thread structures.
 *
 * Test steps:
 * - Check z_main_thread's domain membership.
 * - Start a static thread and check its membership.
 *
 * Expected result:
 * - Both belong to k_mem_domain_default.
 */
ZTEST(mem_protect_domain, test_mem_domain_boot_threads)
{
	/* Check that a static thread got put in the default memory domain */
	zassert_true(zzz_thread->mem_domain_info.mem_domain ==
		     &k_mem_domain_default, "unexpected mem domain %p",
		     zzz_thread->mem_domain_info.mem_domain);

	/* Check that the main thread is also a member of the default domain */
	zassert_true(z_main_thread.mem_domain_info.mem_domain ==
		     &k_mem_domain_default, "unexpected mem domain %p",
		     z_main_thread.mem_domain_info.mem_domain);

	k_thread_abort(zzz_thread);
}

static ZTEST_BMEM volatile bool spin_done;
static K_SEM_DEFINE(spin_sem, 0, 1);

static void spin_entry(void *p1, void *p2, void *p3)
{
	printk("spin thread entry\n");
	k_sem_give(&spin_sem);

	while (!spin_done) {
		k_busy_wait(1);
	}
	printk("spin thread completed\n");
}

/**
 * @brief Verify that a running thread can be migrated between domains.
 *
 * @ingroup kernel_memprotect_tests
 *
 * @details
 * k_mem_domain_add_thread() may be applied to a thread that is actively
 * running, and the migration must not fault it -- the destination domain
 * also carries the partitions the thread is using. On SMP the thread spins
 * on another CPU while the migration happens, which is the racy path this
 * case exists for. Re-adding the thread to the domain it is already in must
 * be a no-op.
 *
 * Test steps:
 * - Start a user thread that spins on shared state.
 * - While it runs, add it to the test domain, then add it again.
 * - Release the spin and join the thread.
 *
 * Expected result:
 * - The thread keeps running through the migration and the repeated add
 *   changes nothing.
 *
 * @see k_mem_domain_add_thread()
 * @verifies ZEP-SRS-8-30
 */

#if CONFIG_MP_MAX_NUM_CPUS > 1
#define PRIO	K_PRIO_COOP(0)
#else
#define PRIO	K_PRIO_PREEMPT(1)
#endif

ZTEST(mem_protect_domain, test_mem_domain_migration)
{
	int ret;

	set_fault_valid(false);

	k_thread_create(&child_thread, child_stack,
			K_THREAD_STACK_SIZEOF(child_stack), spin_entry,
			NULL, NULL, NULL,
			PRIO, K_USER | K_INHERIT_PERMS, K_FOREVER);
	k_thread_name_set(&child_thread, "child_thread");
	k_object_access_grant(&spin_sem, &child_thread);
	k_thread_start(&child_thread);

	/* Ensure that the child thread has started */
	ret = k_sem_take(&spin_sem, K_FOREVER);
	zassert_equal(ret, 0, "k_sem_take failed");

	/* Now move it to test_domain. This domain also has the ztest partition,
	 * so the child thread should keep running and not explode
	 */
	printk("migrate to new domain\n");
	k_mem_domain_add_thread(&test_domain, &child_thread);

	/**TESTPOINT: add to existing domain will do nothing */
	k_mem_domain_add_thread(&test_domain, &child_thread);

	/* set spin_done so the child thread completes */
	printk("set test completion\n");
	spin_done = true;

	k_thread_join(&child_thread, K_FOREVER);
}

/**
 * @brief Test system assert when new partition overlaps the existing partition
 *
 * @details
 * Test Objective:
 * - Test assertion if the new partition overlaps existing partition in domain
 *
 * Testing techniques:
 * - System testing
 *
 * Prerequisite Conditions:
 * - N/A
 *
 * Input Specifications:
 * - N/A
 *
 * Test Procedure:
 * -# Define testing memory partition overlap_part with the same start ro_buf
 *  as has the existing memory partition ro_part
 * -# Try to add overlap_part to the memory domain. When adding the new
 *  partition to the memory domain the system will assert that new partition
 *  overlaps with the existing partition ro_part .
 *
 * Expected Test Result:
 * - Must happen an assertion error indicating that the new partition overlaps
 *   the existing one.
 *
 * Pass/Fail Criteria:
 * - Success if the overlap assertion will happen.
 * - Failure if the overlap assertion will not happen.
 *
 * Assumptions and Constraints:
 * - N/A
 *
 * @ingroup kernel_memprotect_tests
 *
 * @see k_mem_domain_add_partition()
 * @verifies ZEP-SRS-8-21
 * @verifies ZEP-SRS-8-29
 */
ZTEST(mem_protect_domain, test_mem_part_overlap)
{
	set_fault_valid(false);

	zassert_not_equal(
		k_mem_domain_add_partition(&test_domain, &overlap_part),
		0, "should fail to add memory partition");
}

extern struct k_spinlock z_mem_domain_lock;

static struct k_mem_domain test_domain_fail;

static volatile uint8_t __aligned(MEM_REGION_ALLOC)
	exceed_buf[MEM_REGION_ALLOC];

K_MEM_PARTITION_DEFINE(exceed_part, exceed_buf, sizeof(exceed_buf),
		      K_MEM_PARTITION_P_RW_U_RW);

/**
 * @brief Test system assert when adding memory partitions more than possible
 *
 * @details
 * - Add memory partitions one by one and more than architecture allows to add.
 * - When partitions added more than it is allowed by architecture, test that
 *   k_mem_domain_add_partition() returns non-zero.
 *
 * @ingroup kernel_memprotect_tests
 * @verifies ZEP-SRS-8-21
 */
ZTEST(mem_protect_domain, test_mem_part_assert_add_overmax)
{
	int max_parts = num_rw_parts + PARTS_USED;

	/* Make sure the partitions of the domain is full, used in
	 * previous test cases.
	 */
	zassert_equal(max_parts, arch_mem_domain_max_partitions_get(),
			"domain still have room of partitions(%d).",
			max_parts);

	set_fault_valid(false);

	/* Add one more partition will fail due to exceeding */
	zassert_not_equal(
		k_mem_domain_add_partition(&test_domain, &exceed_part),
		0, "should fail to add memory partition");
}


#if defined(CONFIG_ASSERT)
static volatile uint8_t __aligned(MEM_REGION_ALLOC) misc_buf[MEM_REGION_ALLOC];
K_MEM_PARTITION_DEFINE(find_no_part, misc_buf, sizeof(misc_buf),
		       K_MEM_PARTITION_P_RO_U_RO);

/**
 * @brief Test error case of removing memory partition fail
 *
 * @details Try to remove a partition not in the domain.
 * k_mem_domain_remove_partition() should return non-zero.
 *
 * @ingroup kernel_memprotect_tests
 * @verifies ZEP-SRS-8-22
 */
ZTEST(mem_protect_domain, test_mem_domain_remove_part_fail)
{
	struct k_mem_partition *no_parts = &find_no_part;

	set_fault_valid(false);

	zassert_not_equal(
		k_mem_domain_remove_partition(&test_domain, no_parts),
		0, "should fail to remove memory partition");
}
#else
ZTEST(mem_protect_domain, test_mem_domain_remove_part_fail)
{
	ztest_test_skip();
}
#endif

/**
 * @brief Test error case of initializing memory domain fail
 *
 * @details Try to initialize a domain with invalid partition.
 * k_mem_domain_init() should return non-zero.
 *
 * @ingroup kernel_memprotect_tests
 * @verifies ZEP-SRS-8-20
 */
ZTEST(mem_protect_domain, test_mem_domain_init_fail)
{
	struct k_mem_partition *no_parts[] = {&ro_part, 0};

	/* init another domain fail */
	set_fault_valid(false);

	zassert_not_equal(
		k_mem_domain_init(&test_domain_fail, ARRAY_SIZE(no_parts),
				  no_parts),
		0, "should fail to initialize memory domain");

#if defined(CONFIG_ARCH_MEM_DOMAIN_SUPPORTS_DEINIT)
	zassert_equal(k_mem_domain_deinit(&test_domain_fail), 0,
		      "cannot de-initialize memory domain");
#endif /* CONFIG_ARCH_MEM_DOMAIN_SUPPORTS_DEINIT */
}

/**
 * @brief Test error case of de-initializing memory domain fail
 *
 * @details Try to de-initialize a domain with various invalid
 * conditions.
 *
 * @ingroup kernel_memprotect_tests
 * @verifies ZEP-SRS-8-20
 */
ZTEST(mem_protect_domain, test_mem_domain_deinit_fail)
{
#if defined(CONFIG_ARCH_MEM_DOMAIN_SUPPORTS_DEINIT)
	set_fault_valid(false);

	/* Should not be able to de-init the default domain. */
	zassert_equal(k_mem_domain_deinit(&k_mem_domain_default), -EINVAL,
		      "should fail de-initializing default domain");

	/* Create a thread and attach it to the test_domain.
	 * We should not be able to de-initialize the domain while
	 * there is a thread attached to it.
	 */
	k_thread_create(&child_thread, child_stack, K_THREAD_STACK_SIZEOF(child_stack),
			rw_part_access,	NULL, NULL, NULL, 0, K_USER, K_FOREVER);
	k_thread_name_set(&child_thread, "child_thread");
	k_mem_domain_add_thread(&test_domain, &child_thread);

	zassert_equal(k_mem_domain_deinit(&test_domain), -EBUSY,
		      "should fail de-initializing test domain with threads attached");

	/* Let the thread run to the end so any memory domain related
	 * cleanup will be done.
	 */
	k_thread_start(&child_thread);
	k_thread_join(&child_thread, K_FOREVER);

	/* Note that we cannot test the proper de-initialization of test_domain
	 * here (... where this should succeed). It is because the test_domain
	 * is still being used for other tests in this test suite.
	 * Instead, it will be tested in test_mem_domain_teardown() when all
	 * tests have run.
	 */

#else  /* CONFIG_ARCH_MEM_DOMAIN_SUPPORTS_DEINIT */
	ztest_test_skip();
#endif /* CONFIG_ARCH_MEM_DOMAIN_SUPPORTS_DEINIT */
}

/**
 * @brief Test error case of adding null memory partition fail
 *
 * @details Try to add a null partition to memory domain.
 * k_mem_domain_add_partition() should return error.
 *
 * @ingroup kernel_memprotect_tests
 * @verifies ZEP-SRS-8-21
 */
ZTEST(mem_protect_domain, test_mem_part_add_error_null)
{
	/* add partition fail */
	set_fault_valid(false);

	zassert_not_equal(
		k_mem_domain_add_partition(&test_domain_fail, NULL),
		0, "should fail to add memory partition");
}

static volatile uint8_t __aligned(MEM_REGION_ALLOC) nosize_buf[MEM_REGION_ALLOC];
K_MEM_PARTITION_DEFINE(nonsize_part, nosize_buf, sizeof(nosize_buf),
			K_MEM_PARTITION_P_RO_U_RO);

/**
 * @brief Test error case of adding zero sized memory partition fail
 *
 * @details Try to add a zero sized partition to memory domain.
 * k_mem_domain_add_partition() should return error.
 *
 * @ingroup kernel_memprotect_tests
 * @verifies ZEP-SRS-8-21
 */
ZTEST(mem_protect_domain, test_mem_part_add_error_zerosize)
{
	struct k_mem_partition *nosize_part = &nonsize_part;

	nosize_part->size = 0U;

	/* add partition fail */
	set_fault_valid(false);

	zassert_not_equal(
		k_mem_domain_add_partition(&test_domain_fail, nosize_part),
		0, "should fail to add memory partition");
}

/**
 * @brief Test error case of memory partition address wraparound
 *
 * @details Try to add a partition whose address is wraparound.
 * k_mem_domain_add_partition() should return error.
 *
 * @ingroup kernel_memprotect_tests
 * @verifies ZEP-SRS-8-21
 */
ZTEST(mem_protect_domain, test_mem_part_error_wraparound)
{
#ifdef CONFIG_64BIT
	K_MEM_PARTITION_DEFINE(wraparound_part, 0xfffffffffffff800, 2048,
		       K_MEM_PARTITION_P_RO_U_RO);
#else
	K_MEM_PARTITION_DEFINE(wraparound_part, 0xfffff800, 2048,
		       K_MEM_PARTITION_P_RO_U_RO);
#endif

	/* add partition fail */
	set_fault_valid(false);

	zassert_not_equal(
		k_mem_domain_add_partition(&test_domain_fail, &wraparound_part),
		0, "should fail to add memory partition");
}

/**
 * @brief Test error case of removing memory partition fail
 *
 * @details Try to remove a partition size mismatched will result
 * in k_mem_domain_remove_partition() returning error.
 *
 * @ingroup kernel_memprotect_tests
 * @verifies ZEP-SRS-8-22
 */
ZTEST(mem_protect_domain, test_mem_part_remove_error_zerosize)
{
	struct k_mem_partition *no_parts = &find_no_part;

	zassert_equal(
		k_mem_domain_remove_partition(&test_domain, &rw_parts[0]),
		0, "failed to remove memory partition");

	zassert_equal(
		k_mem_domain_add_partition(&test_domain, no_parts),
		0, "failed to add memory partition");

	no_parts->size = 0U;

	/* remove partition fail */
	set_fault_valid(false);

	zassert_not_equal(
		k_mem_domain_remove_partition(&test_domain, no_parts),
		0, "should fail to remove memory partition");
}

ZTEST_SUITE(mem_protect_domain, NULL, test_mem_domain_setup, NULL,
		NULL, test_mem_domain_teardown);
```

## src/mem_partition.c
```c
/*
 * Copyright (c) 2020 Intel Corporation
 *
 * SPDX-License-Identifier: Apache-2.0
 */

#include <zephyr/kernel.h>
#include "mem_protect.h"



/* Add volatile to disable pre-calculation in compile stage in some
 * toolchain, such as arcmwdt toolchain.
 */
static volatile K_APP_DMEM(ztest_mem_partition) int var = 1356;
static volatile K_APP_BMEM(ztest_mem_partition) int zeroed_var = 20420;
static volatile K_APP_BMEM(ztest_mem_partition) int bss_var;

/**
 * @brief Test assigning global data and BSS variables to memory partitions
 *
 * @details Test that system supports application assigning global data and BSS
 * variables using macros K_APP_BMEM() and K_APP_DMEM
 *
 * @ingroup kernel_memprotect_tests
 * @verifies ZEP-SRS-8-19
 */
ZTEST_USER(mem_protect_part, test_mem_part_assign_bss_vars_zero)
{
	/* The global variable var will be inside the bounds of
	 * ztest_mem_partition and be initialized with 1356 at boot.
	 */
	zassert_true(var == 1356);

	/* The global variable zeroed_var will be inside the bounds of
	 * ztest_mem_partition and must be zeroed at boot size K_APP_BMEM() was
	 * used, indicating a BSS variable.
	 */
	zassert_true(zeroed_var == 0);

	/* The global variable var will be inside the bounds of
	 * ztest_mem_partition and must be zeroed at boot size K_APP_BMEM() was
	 * used, indicating a BSS variable.
	 */
	zassert_true(bss_var == 0);
}

K_APPMEM_PARTITION_DEFINE(part_arch);
K_APP_BMEM(part_arch) uint8_t __aligned(MEM_REGION_ALLOC)
	buf_arc[MEM_REGION_ALLOC];

/**
 * @brief Test partitions sized per the constraints of the MPU hardware
 *
 * @details
 * - MEM_REGION_ALLOC is pre-sized to naturally fit in the target hardware's
 *   memory management granularity. Show that the partition size matches.
 * - Show that the base address of the partition is properly set, it should
 *   match the base address of buf_arc.
 *
 * @ingroup kernel_memprotect_tests
 * @verifies ZEP-SRS-8-19
 */
ZTEST(mem_protect_part, test_mem_part_auto_determ_size)
{
	zassert_true(part_arch.size == MEM_REGION_ALLOC);
	zassert_true(part_arch.start == (uintptr_t)buf_arc,
	   "Base address of memory partition not determined at build time");
}

ZTEST_SUITE(mem_protect_part, NULL, NULL, NULL, NULL, NULL);
```

## src/mem_protect.h
```c
/*
 * Copyright (c) 2017, 2020 Intel Corporation
 *
 * SPDX-License-Identifier: Apache-2.0
 */

#include <zephyr/kernel.h>
#include <zephyr/ztest.h>
#include <string.h>
#include <stdlib.h>

/* Flag needed to figure out if the fault was expected or not. */
extern volatile bool valid_fault;

static inline void set_fault_valid(bool valid)
{
	valid_fault = valid;
	/* Put a barrier here, such that no instructions get ordered by the
	 * compiler before we set valid_fault. This can happen with expansion
	 * of inline syscall invocation functions.
	 */
	compiler_barrier();
}

/* For inherit.c */
#define INHERIT_STACK_SIZE CONFIG_MAIN_STACK_SIZE
#define SEMAPHORE_MAX_COUNT (10)
#define SEMAPHORE_INIT_COUNT (0)
#define SYNC_SEM_MAX_COUNT (1)
#define SYNC_SEM_INIT_COUNT (0)
#define MSG_Q_SIZE (10)
#define MSG_Q_MAX_NUM_MSGS (10)
#define MSG_Q_ALIGN (2)
#define PRIORITY 5
#define STACK_SIZE (512 + CONFIG_TEST_EXTRA_STACK_SIZE)
#define BLK_SIZE_MIN 16
#define BLK_SIZE_MAX 64
#define BLK_NUM_MIN 8
#define BLK_NUM_MAX 2
#define BLK_ALIGN BLK_SIZE_MIN
#define SEM_INIT_VAL (0U)
#define SEM_MAX_VAL (1U)

/* For mem_domain.c  */
#define MEM_DOMAIN_STACK_SIZE CONFIG_MAIN_STACK_SIZE
#define MEM_PARTITION_INIT_NUM (1)
#define BLK_SIZE_MIN_MD 8
#define BLK_SIZE_MAX_MD 16
#define BLK_NUM_MAX_MD 4
#define BLK_ALIGN_MD BLK_SIZE_MIN_MD
#define DESC_SIZE	sizeof(struct sys_mem_pool_block)
#define STACK_SIZE_MD (512 + CONFIG_TEST_EXTRA_STACK_SIZE)
#define PRIORITY_MD 5

#if defined(CONFIG_X86)
#define MEM_REGION_ALLOC (4096)
#elif defined(CONFIG_ARC)
#define MEM_REGION_ALLOC (Z_ARC_MPU_ALIGN)
#elif defined(CONFIG_ARM64)
#define MEM_REGION_ALLOC (CONFIG_MMU_PAGE_SIZE)
#elif defined(CONFIG_ARM)
#define MEM_REGION_ALLOC (Z_THREAD_MIN_STACK_ALIGN)
#elif defined(CONFIG_RISCV)
#if defined(CONFIG_RISCV_PMP)
#define MEM_REGION_ALLOC (CONFIG_PMP_GRANULARITY)
#else
#define MEM_REGION_ALLOC (4)
#endif
#elif defined(CONFIG_XTENSA) || defined(CONFIG_HEXAGON)
#define MEM_REGION_ALLOC (4096)
#else
#error "Test suite not compatible for the given architecture"
#endif
#define MEM_DOMAIN_ALIGNMENT __aligned(MEM_REGION_ALLOC)

/* for kobject.c */
#define KOBJECT_STACK_SIZE (512 + CONFIG_TEST_EXTRA_STACK_SIZE)



#if (defined(CONFIG_X86_64) || defined(CONFIG_ARM64) || \
	(defined(CONFIG_RISCV) && defined(CONFIG_64BIT)))
#define TEST_HEAP_SIZE (2 << CONFIG_MAX_THREAD_BYTES) * 1024
#define MAX_OBJ 512
#elif defined(CONFIG_HEXAGON)
/* struct k_thread embeds the privileged stack */
#define TEST_HEAP_SIZE	(2 << CONFIG_MAX_THREAD_BYTES) * (256 + CONFIG_PRIVILEGED_STACK_SIZE)
/* Pointer-array bound in test_kobj_create_out_of_memory() */
#define MAX_OBJ 4096
#else
#define TEST_HEAP_SIZE (2 << CONFIG_MAX_THREAD_BYTES) * 512
#define MAX_OBJ 256
#endif

#ifndef _TEST_SYSCALLS_H_
#define _TEST_SYSCALLS_H_

__syscall struct k_heap *ret_resource_pool_ptr(void);

#include <zephyr/syscalls/mem_protect.h>

#endif /* _TEST_SYSCALLS_H_ */
```
