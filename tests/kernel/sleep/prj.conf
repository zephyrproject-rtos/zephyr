## CMakeLists.txt
```
# SPDX-License-Identifier: Apache-2.0

cmake_minimum_required(VERSION 3.28.0)
find_package(Zephyr REQUIRED HINTS $ENV{ZEPHYR_BASE})
project(sleep)

FILE(GLOB app_sources src/*.c)
target_sources(app PRIVATE ${app_sources})
```

## prj.conf
```kconfig
CONFIG_IRQ_OFFLOAD=y
CONFIG_ZTEST=y
CONFIG_TEST_USERSPACE=y
CONFIG_MP_MAX_NUM_CPUS=1
```

## src/main.c
```c
/*
 * Copyright (c) 2016 Wind River Systems, Inc.
 *
 * SPDX-License-Identifier: Apache-2.0
 */

#include <zephyr/tc_util.h>
#include <zephyr/ztest.h>
#include <zephyr/arch/cpu.h>
#include <zephyr/sys/util.h>
#include <zephyr/irq_offload.h>
#include <stdbool.h>

#if defined(CONFIG_ASSERT) && defined(CONFIG_DEBUG)
#define THREAD_STACK    (512 + CONFIG_TEST_EXTRA_STACK_SIZE)
#else
#define THREAD_STACK    (384 + CONFIG_TEST_EXTRA_STACK_SIZE)
#endif

#define TEST_THREAD_PRIORITY    -4
#define HELPER_THREAD_PRIORITY  -10

#define ONE_SECOND		(MSEC_PER_SEC)
#define ONE_SECOND_ALIGNED	\
	(uint32_t)(k_ticks_to_ms_floor64(k_ms_to_ticks_ceil32(ONE_SECOND) + _TICK_ALIGN))

#if defined(CONFIG_SOC_XILINX_ZYNQMP) || defined(CONFIG_SOC_VERSAL_RPU)
/*
 * The Xilinx QEMU, used to emulate the Xilinx ZynqMP and Versal platforms,
 * is particularly unstable in terms of timing. The tick margin of at least 5
 * is necessary to allow this test to pass with a reasonable repeatability.
 */
#define TICK_MARGIN		5
#else
#define TICK_MARGIN		1
#endif

static struct k_sem test_thread_sem;
static struct k_sem helper_thread_sem;
static struct k_sem task_sem;

static K_THREAD_STACK_DEFINE(test_thread_stack, THREAD_STACK);
static K_THREAD_STACK_DEFINE(helper_thread_stack, THREAD_STACK);

static k_tid_t test_thread_id;
static k_tid_t helper_thread_id;

static struct k_thread test_thread_data;
static struct k_thread helper_thread_data;

static bool test_failure = true;     /* Assume the test will fail */

/**
 * @brief Kernel thread sleep and wakeup tests
 * @defgroup tests_kernel_sleep Sleep Tests
 * @ingroup all_tests
 * @{
 */
static void test_objects_init(void)
{
	k_sem_init(&test_thread_sem, 0, UINT_MAX);
	k_sem_init(&helper_thread_sem, 0, UINT_MAX);
	k_sem_init(&task_sem, 0, UINT_MAX);
}

static void align_to_tick_boundary(void)
{
	uint32_t tick;

	tick = k_uptime_get_32();
	while (k_uptime_get_32() == tick) {
		/* Busy wait to align to tick boundary */
		Z_SPIN_DELAY(50);
	}

}

/* Shouldn't ever sleep for less than requested time, but allow for 1
 * tick of "too long" slop for aliasing between wakeup and
 * measurement. Qemu at least will leak the external world's clock
 * rate into the simulator when the host is under load.
 */
static int sleep_time_valid(uint32_t start, uint32_t end, uint32_t dur)
{
	uint32_t dt = end - start;

	return dt >= dur && dt <= (dur + TICK_MARGIN);
}

static void test_thread(void *p1, void *p2, void *p3)
{
	ARG_UNUSED(p1);
	ARG_UNUSED(p2);
	ARG_UNUSED(p3);

	uint32_t start_tick;
	uint32_t end_tick;

	k_sem_take(&test_thread_sem, K_FOREVER);

	align_to_tick_boundary();

	start_tick = k_uptime_get_32();
	k_sleep(K_SECONDS(1));
	end_tick = k_uptime_get_32();

	if (!sleep_time_valid(start_tick, end_tick, ONE_SECOND_ALIGNED)) {
		TC_ERROR(" *** k_sleep() slept for %d ticks not %d.",
			 end_tick - start_tick, ONE_SECOND_ALIGNED);

		return;
	}

	k_sem_give(&helper_thread_sem);   /* Activate helper thread */
	align_to_tick_boundary();

	start_tick = k_uptime_get_32();
	k_sleep(K_SECONDS(1));
	end_tick = k_uptime_get_32();

	if (end_tick - start_tick > TICK_MARGIN) {
		TC_ERROR(" *** k_wakeup() took too long (%d ticks)\n",
			 end_tick - start_tick);
		return;
	}

	k_sem_give(&helper_thread_sem);   /* Activate helper thread */
	align_to_tick_boundary();

	start_tick = k_uptime_get_32();
	k_sleep(K_SECONDS(1));
	end_tick = k_uptime_get_32();

	if (end_tick - start_tick > TICK_MARGIN) {
		TC_ERROR(" *** k_wakeup() took too long (%d ticks)\n",
			 end_tick - start_tick);
		return;
	}

	k_sem_give(&task_sem);    /* Activate task */
	align_to_tick_boundary();

	start_tick = k_uptime_get_32();
	k_sleep(K_SECONDS(1));	/* Task will execute */
	end_tick = k_uptime_get_32();

	if (end_tick - start_tick > TICK_MARGIN) {
		TC_ERROR(" *** k_wakeup() took too long (%d ticks) at LAST\n",
			 end_tick - start_tick);
		return;
	}
	test_failure = false;
}

static void irq_offload_isr(const void *arg)
{

	k_wakeup((k_tid_t) arg);
}

static void helper_thread(void *p1, void *p2, void *p3)
{
	ARG_UNUSED(p1);
	ARG_UNUSED(p2);
	ARG_UNUSED(p3);

	k_sem_take(&helper_thread_sem, K_FOREVER);
	/* Wake the test thread */
	k_wakeup(test_thread_id);
	k_sem_take(&helper_thread_sem, K_FOREVER);
	/* Wake the test thread from an ISR */
	irq_offload(irq_offload_isr, (const void *)test_thread_id);
}

#ifdef CONFIG_TIMEOUT_64BIT
static void abs_wakeup_fn(struct k_timer *timer)
{
	k_wakeup((k_tid_t)k_timer_user_data_get(timer));
}

K_TIMER_DEFINE(abs_wakeup_timer, abs_wakeup_fn, NULL);

static void sleep_abs_timeout_return(void)
{
	int32_t rem;
	const uint64_t deadline = sys_clock_tick_get() + k_ms_to_ticks_ceil64(1000);

	/* woken early: the remainder to the absolute deadline is reported */
	k_timer_user_data_set(&abs_wakeup_timer, k_current_get());
	k_timer_start(&abs_wakeup_timer, K_MSEC(100), K_NO_WAIT);
	rem = k_sleep(K_TIMEOUT_ABS_TICKS(deadline));
	zassert_true((rem > 0) && (rem <= 1000),
		     "woken sleeper reported %d ms remaining, not (0, 1000]", rem);

	/* re-arming against the same absolute deadline sleeps out the remainder */
	rem = k_sleep(K_TIMEOUT_ABS_TICKS(deadline));
	zassert_equal(rem, 0, "expired absolute sleep reported %d ms remaining", rem);
	zassert_true(sys_clock_tick_get() >= deadline, "woke before the absolute deadline");
}
#endif /* CONFIG_TIMEOUT_64BIT */

/**
 * @brief Verify that k_sleep() sleeps for the requested time and that
 *        k_wakeup() cancels a pending sleep immediately.
 *
 * @details
 * A cooperative test thread performs a sequence of one-second sleeps while a
 * helper thread, an ISR (via irq_offload()) and the main thread each wake it
 * early. The test validates both the timekeeping and the cancellation paths of
 * the sleep primitives:
 * - An uncancelled k_sleep() must block for at least the requested duration and
 *   no more than one tick of slop.
 * - A k_wakeup() targeting a sleeping thread must return it to the ready queue
 *   without waiting for the timeout to expire, regardless of whether the wakeup
 *   originates from a thread, an ISR, or the main thread.
 *
 * Test steps:
 * - Create a cooperative test thread and a higher-priority helper thread.
 * - Let the test thread run one uncancelled k_sleep(K_SECONDS(1)) and confirm
 *   the elapsed time matches the request within TICK_MARGIN.
 * - Have the helper thread, an irq_offload() ISR, and the main thread each
 *   call k_wakeup() on the test thread mid-sleep and confirm each sleep returns
 *   within TICK_MARGIN.
 * - Run one final uncancelled k_sleep() on the main thread and validate its
 *   duration.
 *
 * Expected result:
 * - Uncancelled sleeps elapse for the requested duration (within slop).
 * - Every k_wakeup() cancels the sleep promptly and test_failure stays false.
 *
 * @see k_sleep()
 * @see k_wakeup()
 * @see k_uptime_get_32()
 * @verifies ZEP-SRS-28-8
 * @verifies ZEP-SRS-28-10
 * @verifies ZEP-SRS-28-11
 */
ZTEST(sleep, test_sleep)
{
	int status = TC_FAIL;
	uint32_t start_tick;
	uint32_t end_tick;

	/*
	 * Main thread(test_main) priority is 0 but ztest thread runs at
	 * priority -1. To run the test smoothly make both main and ztest
	 * threads run at same priority level.
	 */
	k_thread_priority_set(k_current_get(), 0);
	test_objects_init();

	test_thread_id = k_thread_create(&test_thread_data, test_thread_stack,
					 THREAD_STACK,
					 test_thread,
					 0, 0, NULL, TEST_THREAD_PRIORITY,
					 0, K_NO_WAIT);

	helper_thread_id = k_thread_create(&helper_thread_data,
					   helper_thread_stack, THREAD_STACK,
					   helper_thread,
					   0, 0, NULL, HELPER_THREAD_PRIORITY,
					   0, K_NO_WAIT);

	/* Activate test_thread */
	k_sem_give(&test_thread_sem);

	/* Wait for test_thread to activate us */
	k_sem_take(&task_sem, K_FOREVER);

	/* Wake the test thread */
	k_wakeup(test_thread_id);

	zassert_false(test_failure, "test failure");

	align_to_tick_boundary();
	start_tick = k_uptime_get_32();
	k_sleep(K_SECONDS(1));
	end_tick = k_uptime_get_32();
	zassert_true(sleep_time_valid(start_tick, end_tick, ONE_SECOND_ALIGNED),
		     "k_sleep() slept for %d ticks, not %d\n",
		     end_tick - start_tick, ONE_SECOND_ALIGNED);

#ifdef CONFIG_TIMEOUT_64BIT
	/* absolute-timeout sleeps report the remainder when woken early */
	sleep_abs_timeout_return();
#endif

	status = TC_PASS;
}

static void forever_thread_entry(void *p1, void *p2, void *p3)
{
	int32_t ret;

	ret = k_sleep(K_FOREVER);
	zassert_equal(ret, K_TICKS_FOREVER, "unexpected return value");
	k_sem_give(&test_thread_sem);
}

/**
 * @brief Verify that k_sleep(K_FOREVER) blocks until an explicit wakeup and
 *        returns K_TICKS_FOREVER.
 *
 * @details
 * A user-mode thread calls k_sleep(K_FOREVER), which must never expire on its
 * own. The thread only becomes runnable again after the main thread issues a
 * k_wakeup(). On return, k_sleep() must report K_TICKS_FOREVER to indicate the
 * sleep was cancelled rather than timed out.
 *
 * Test steps:
 * - Create a user-mode thread that calls k_sleep(K_FOREVER).
 * - Yield so the thread reaches the sleeping state.
 * - Call k_wakeup() on the thread from the main thread.
 * - In the woken thread, assert the return value equals K_TICKS_FOREVER.
 *
 * Expected result:
 * - The thread stays asleep until woken and k_sleep() returns K_TICKS_FOREVER.
 *
 * @see k_sleep()
 * @see k_wakeup()
 * @verifies ZEP-SRS-28-8
 * @verifies ZEP-SRS-28-10
 * @verifies ZEP-SRS-28-11
 */
ZTEST(sleep, test_sleep_forever)
{
	test_objects_init();

	test_thread_id = k_thread_create(&test_thread_data,
					 test_thread_stack,
					 THREAD_STACK,
					 forever_thread_entry,
					 0, 0, NULL, TEST_THREAD_PRIORITY,
					 K_USER | K_INHERIT_PERMS, K_NO_WAIT);

	/* Allow forever thread to run */
	k_yield();

	k_wakeup(test_thread_id);
	k_sem_take(&test_thread_sem, K_FOREVER);
}

static volatile int32_t wakeup_remaining;

static void early_wake_thread_entry(void *p1, void *p2, void *p3)
{
	ARG_UNUSED(p1);
	ARG_UNUSED(p2);
	ARG_UNUSED(p3);

	/* Sleep for a long duration; the main thread wakes us well before it
	 * elapses. Capture the remaining time reported by k_sleep().
	 */
	wakeup_remaining = k_sleep(K_SECONDS(10));
	k_sem_give(&test_thread_sem);
}

/**
 * @brief Verify k_sleep() reports the remaining time when woken early
 *
 * @details Put a thread to sleep for a long, finite duration and wake it with
 * k_wakeup() before that duration elapses. k_sleep() must return the amount of
 * time that was still remaining, which is non-zero and does not exceed the
 * originally requested duration.
 *
 * Test steps:
 * - Start a thread that sleeps for 10 seconds and stores k_sleep()'s return.
 * - Yield so the thread begins sleeping, let ~100 ms pass, then wake it with
 *   k_wakeup().
 * - Inspect the stored return value.
 *
 * Expected result:
 * - k_sleep() returns a value greater than zero and less than the requested
 *   10000 ms, i.e. it reports the time that was still remaining.
 *
 * @see k_sleep()
 * @see k_wakeup()
 * @verifies ZEP-SRS-28-12
 */
ZTEST(sleep, test_sleep_wakeup_returns_remaining)
{
	test_objects_init();
	wakeup_remaining = 0;

	test_thread_id = k_thread_create(&test_thread_data,
					 test_thread_stack,
					 THREAD_STACK,
					 early_wake_thread_entry,
					 0, 0, NULL, TEST_THREAD_PRIORITY,
					 0, K_NO_WAIT);

	/* Allow early_wake_thread_entry to start. */
	k_yield();

	/* Let part of the sleep elapse, then wake it well before 10 seconds. */
	k_msleep(100);
	k_wakeup(test_thread_id);
	k_sem_take(&test_thread_sem, K_FOREVER);

	zassert_true(wakeup_remaining > 0,
		     "k_sleep() reported %d ms remaining; expected > 0",
		     wakeup_remaining);
	zassert_true(wakeup_remaining < 10000,
		     "k_sleep() reported %d ms remaining; expected less than the "
		     "requested 10000", wakeup_remaining);
}

static volatile int32_t usleep_wakeup_remaining;

static void early_wake_usleep_entry(void *p1, void *p2, void *p3)
{
	ARG_UNUSED(p1);
	ARG_UNUSED(p2);
	ARG_UNUSED(p3);

	/* Sleep for a long duration in microseconds; the main thread wakes us
	 * well before it elapses. Capture the remaining time, in microseconds,
	 * reported by k_usleep().
	 */
	usleep_wakeup_remaining = k_usleep(10 * USEC_PER_SEC);
	k_sem_give(&test_thread_sem);
}

/**
 * @brief Verify k_usleep() reports the remaining microseconds when woken early
 *
 * @details Put a thread to sleep for a long, finite duration expressed in
 * microseconds and wake it with k_wakeup() before that duration elapses.
 * k_usleep() must return the amount of time that was still remaining,
 * expressed in microseconds, which is non-zero and does not exceed the
 * requested duration.
 *
 * Test steps:
 * - Start a thread that sleeps for 10 seconds via k_usleep() and stores the
 *   return value.
 * - Let a fraction of the sleep elapse, then wake the thread with k_wakeup().
 *
 * Expected result:
 * - k_usleep() returns a value greater than zero and less than the requested
 *   10000000 us, i.e. it reports the time that was still remaining in
 *   microseconds.
 *
 * @see k_usleep()
 * @see k_wakeup()
 * @verifies ZEP-SRS-28-15
 */
ZTEST(sleep, test_usleep_wakeup_returns_remaining)
{
	test_objects_init();
	usleep_wakeup_remaining = 0;

	test_thread_id = k_thread_create(&test_thread_data,
					 test_thread_stack,
					 THREAD_STACK,
					 early_wake_usleep_entry,
					 0, 0, NULL, TEST_THREAD_PRIORITY,
					 0, K_NO_WAIT);

	/* Allow early_wake_usleep_entry to start. */
	k_yield();

	/* Let part of the sleep elapse, then wake it well before 10 seconds. */
	k_msleep(100);
	k_wakeup(test_thread_id);
	k_sem_take(&test_thread_sem, K_FOREVER);

	zassert_true(usleep_wakeup_remaining > 0,
		     "k_usleep() reported %d us remaining; expected > 0",
		     usleep_wakeup_remaining);
	zassert_true(usleep_wakeup_remaining < 10 * USEC_PER_SEC,
		     "k_usleep() reported %d us remaining; expected less than "
		     "the requested 10000000", usleep_wakeup_remaining);
}

/*test case main entry*/
static void *sleep_setup(void)
{
	k_thread_access_grant(k_current_get(), &test_thread_sem);

	return NULL;
}

ZTEST_SUITE(sleep, NULL, sleep_setup,
		ztest_simple_1cpu_before, ztest_simple_1cpu_after, NULL);

/**
 * @}
 */
```

## src/sleep.c
```c
/*
 * Copyright (c) 2016 Wind River Systems, Inc.
 *
 * SPDX-License-Identifier: Apache-2.0
 */

/*
 * @file
 * @brief Test sleep and wakeup APIs
 *
 * This module tests the following sleep and wakeup scenarios:
 * 1. k_sleep() without cancellation
 * 2. k_sleep() cancelled via k_wakeup()
 * 3. k_sleep() cancelled via k_wakeup()
 * 4. k_sleep() cancelled via k_wakeup()
 * 5. k_sleep() - no cancellation exists
 */

#include <tc_util.h>
#include <ztest.h>
#include <arch/cpu.h>
#include <misc/util.h>
#include <irq_offload.h>
#include <stdbool.h>

#if defined(CONFIG_ASSERT) && defined(CONFIG_DEBUG)
#define THREAD_STACK    (384 + CONFIG_TEST_EXTRA_STACKSIZE)
#else
#define THREAD_STACK    (256 + CONFIG_TEST_EXTRA_STACKSIZE)
#endif

#define TEST_THREAD_PRIORITY	-4
#define HELPER_THREAD_PRIORITY  -10

#define ONE_SECOND  (MSEC_PER_SEC)
#define TICKS_PER_MS  (MSEC_PER_SEC / CONFIG_SYS_CLOCK_TICKS_PER_SEC)

static struct k_sem test_thread_sem;
static struct k_sem helper_thread_sem;
static struct k_sem task_sem;

static K_THREAD_STACK_DEFINE(test_thread_stack, THREAD_STACK);
static K_THREAD_STACK_DEFINE(helper_thread_stack, THREAD_STACK);

static k_tid_t  test_thread_id;
static k_tid_t  helper_thread_id;

static struct k_thread test_thread_data;
static struct k_thread helper_thread_data;

static bool test_failure = true;     /* Assume the test will fail */

static void test_objects_init(void)
{
	k_sem_init(&test_thread_sem, 0, UINT_MAX);
	k_sem_init(&helper_thread_sem, 0, UINT_MAX);
	k_sem_init(&task_sem, 0, UINT_MAX);

	TC_PRINT("Kernel objects initialized\n");
}

static void align_to_tick_boundary(void)
{
	u32_t tick;

	tick = k_uptime_get_32();
	while (k_uptime_get_32() == tick) {
		/* Busy wait to align to tick boundary */
#if defined(CONFIG_ARCH_POSIX)
		posix_halt_cpu();
#endif
	}

}

/* Shouldn't ever sleep for less than requested time, but allow for 1
 * tick of "too long" slop for aliasing between wakeup and
 * measurement. Qemu at least will leak the external world's clock
 * rate into the simulator when the host is under load.
 */
static int sleep_time_valid(u32_t start, u32_t end, u32_t dur)
{
	u32_t dt = end - start;

	return dt >= dur && dt <= (dur + 1);
}

static void test_thread(int arg1, int arg2)
{
	u32_t start_tick;
	u32_t end_tick;

	k_sem_take(&test_thread_sem, K_FOREVER);

	TC_PRINT("Testing normal expiration of k_sleep()\n");
	align_to_tick_boundary();

	start_tick = k_uptime_get_32();

	/* FIXME: one tick less to account for
	 * one  extra tick for _TICK_ALIGN in k_sleep
	 */
	k_sleep(ONE_SECOND - TICKS_PER_MS);
	end_tick = k_uptime_get_32();

	if (!sleep_time_valid(start_tick, end_tick, ONE_SECOND)) {
		TC_ERROR(" *** k_sleep() slept for %d ticks not %d.",
				 end_tick - start_tick, ONE_SECOND);

		return;
	}

	TC_PRINT("Testing: test thread sleep + helper thread wakeup test\n");
	k_sem_give(&helper_thread_sem);   /* Activate helper thread */
	align_to_tick_boundary();

	start_tick = k_uptime_get_32();
	/* FIXME: one tick less to account for
	 * one  extra tick for _TICK_ALIGN in k_sleep
	 */
	k_sleep(ONE_SECOND - TICKS_PER_MS);
	end_tick = k_uptime_get_32();

	if (end_tick - start_tick > 1) {
		TC_ERROR(" *** k_wakeup() took too long (%d ticks)\n",
				 end_tick - start_tick);
		return;
	}

	TC_PRINT("Testing: test thread sleep + isr offload wakeup test\n");
	k_sem_give(&helper_thread_sem);   /* Activate helper thread */
	align_to_tick_boundary();

	start_tick = k_uptime_get_32();
	/* FIXME: one tick less to account for
	 * one  extra tick for _TICK_ALIGN in k_sleep
	 */
	k_sleep(ONE_SECOND - TICKS_PER_MS);
	end_tick = k_uptime_get_32();

	if (end_tick - start_tick > 1) {
		TC_ERROR(" *** k_wakeup() took too long (%d ticks)\n",
				 end_tick - start_tick);
		return;
	}

	TC_PRINT("Testing: test thread sleep + main wakeup test thread\n");
	k_sem_give(&task_sem);    /* Activate task */
	align_to_tick_boundary();

	start_tick = k_uptime_get_32();

	/* FIXME: one tick less to account for
	 * one  extra tick for _TICK_ALIGN in k_sleep
	 */
	k_sleep(ONE_SECOND - TICKS_PER_MS);           /* Task will execute */
	end_tick = k_uptime_get_32();

	if (end_tick - start_tick > 1) {
		TC_ERROR(" *** k_wakeup() took too long (%d ticks) at LAST\n",
				 end_tick - start_tick);
		return;
	}
	test_failure = false;
}

static void irq_offload_isr(void *arg)
{

	k_wakeup((k_tid_t) arg);
}

static void helper_thread(int arg1, int arg2)
{

	k_sem_take(&helper_thread_sem, K_FOREVER);
	/* Wake the test thread */
	k_wakeup(test_thread_id);
	k_sem_take(&helper_thread_sem, K_FOREVER);
	/* Wake the test thread from an ISR */
	irq_offload(irq_offload_isr, (void *)test_thread_id);
}

void testing_sleep(void)
{
	int       status = TC_FAIL;
	u32_t  start_tick;
	u32_t  end_tick;

	/*
	 * Main thread(test_main) priority is 0 but ztest thread runs at
	 * priority -1. To run the test smoothly make both main and ztest
	 * threads run at same priority level.
	 */
	k_thread_priority_set(k_current_get(), 0);
	test_objects_init();

	test_thread_id = k_thread_create(&test_thread_data, test_thread_stack,
					 THREAD_STACK,
					 (k_thread_entry_t) test_thread,
					 0, 0, NULL, TEST_THREAD_PRIORITY,
					 0, 0);

	TC_PRINT("Test thread started: id = %p\n", test_thread_id);

	helper_thread_id = k_thread_create(&helper_thread_data,
					   helper_thread_stack, THREAD_STACK,
					   (k_thread_entry_t) helper_thread,
					   0, 0, NULL, HELPER_THREAD_PRIORITY,
					   0, 0);

	TC_PRINT("Helper thread started: id = %p\n", helper_thread_id);

	/* Activate test_thread */
	k_sem_give(&test_thread_sem);

	/* Wait for test_thread to activate us */
	k_sem_take(&task_sem, K_FOREVER);

	/* Wake the test thread */
	k_wakeup(test_thread_id);

	zassert_false(test_failure, "test failure");

	TC_PRINT("Testing kernel k_sleep()\n");
	align_to_tick_boundary();
	start_tick = k_uptime_get_32();
	/* FIXME: one tick less to account for
	 * one  extra tick for _TICK_ALIGN in k_sleep
	 */
	k_sleep(ONE_SECOND - TICKS_PER_MS);
	end_tick = k_uptime_get_32();
	zassert_true(sleep_time_valid(start_tick, end_tick, ONE_SECOND),
		     "k_sleep() slept for %d ticks, not %d\n",
		     end_tick - start_tick, ONE_SECOND);

	status = TC_PASS;
}

/*test case main entry*/
void test_main(void)
{
	ztest_test_suite(test_sleep, ztest_unit_test(testing_sleep));
	ztest_run_test_suite(test_sleep);
}
```

## src/usleep.c
```c
/*
 * Copyright (c) 2019 Intel Corp.
 *
 * SPDX-License-Identifier: Apache-2.0
 */

#include <zephyr/ztest.h>
#include <zephyr/kernel.h>

/*
 * precision timing tests in an emulation environment are not reliable.
 * if the test passes at least once, we know it works properly, so we
 * attempt to repeat the test RETRIES times before reporting failure.
 */

#define RETRIES		10

/*
 * We need to know how many ticks will elapse when we ask for the
 * shortest possible tick timeout.  That's generally 1, but in some
 * cases it may be more.  On Nordic paths that take 5 or 6 ticks may
 * be observed depending on clock stability and alignment. The base
 * rate assumes 3 ticks for non-timeout effects so increase the
 * maximum effect of timeout to 3 ticks on this platform.
 */

#if defined(CONFIG_NRF_RTC_TIMER) && (CONFIG_SYS_CLOCK_TICKS_PER_SEC > 16384)
/* The overhead of k_usleep() adds three ticks per loop iteration on
 * nRF51, which has a slow CPU clock.
 */
#define MAXIMUM_SHORTEST_TICKS (IS_ENABLED(CONFIG_SOC_SERIES_NRF51) ? 6 : 3)
/* Similar situation for TI CC13XX/CC26XX RTC kernel timer due to the
 * limitation that a value too close to the current time cannot be
 * loaded to its comparator.
 */
#elif defined(CONFIG_CC13XX_CC26XX_RTC_TIMER) && \
	(CONFIG_SYS_CLOCK_TICKS_PER_SEC > 16384)
#define MAXIMUM_SHORTEST_TICKS 3
#elif defined(CONFIG_SILABS_SLEEPTIMER_TIMER) && (CONFIG_SYS_CLOCK_TICKS_PER_SEC > 16384)
/* Similar situation for Silabs devices using sleeptimer due to the
 * limitation that a value too close to the current time cannot be
 * loaded to its comparator.
 */
#define MAXIMUM_SHORTEST_TICKS 2
#elif defined(CONFIG_RISCV_CORE_NORDIC_VPR) && \
	(DT_PROP(DT_PATH(cpus, cpu_0), clock_frequency) < MHZ(32)) && \
	(CONFIG_SYS_CLOCK_TICKS_PER_SEC > 16384)
/* Similar for slow VPR cores (cpuppr, RISC-V core), it has a slow CPU clock
 * compared to other cores, causing the increased overhead.
 */
#define MAXIMUM_SHORTEST_TICKS (IS_ENABLED(CONFIG_XIP) ? 8 : 4)
#else
#define MAXIMUM_SHORTEST_TICKS 1
#endif

/*
 * Theory of operation: we can't use absolute units (e.g., "sleep for
 * 10us") in testing k_usleep() because the granularity of sleeps is
 * highly dependent on the hardware's capabilities and kernel
 * configuration. Instead, we test that k_usleep() actually sleeps for
 * the minimum possible duration, which is nominally two ticks.  So,
 * we loop k_usleep()ing for as many iterations as should comprise a
 * second, and check to see that a total of one second has elapsed.
 */

#define LOOPS (CONFIG_SYS_CLOCK_TICKS_PER_SEC / 2)

/* It should never iterate faster than the tick rate.  However the
 * app, sleep, and timeout layers may each add a tick alignment with
 * fast tick rates, and cycle layer may inject another to guarantee
 * the timeout deadline is met.
 */
#define LOWER_BOUND_MS	((1000 * LOOPS) / CONFIG_SYS_CLOCK_TICKS_PER_SEC)
#define UPPER_BOUND_MS	(((3 + MAXIMUM_SHORTEST_TICKS) * 1000 * LOOPS)	\
			 / CONFIG_SYS_CLOCK_TICKS_PER_SEC)

/**
 * @addtogroup tests_kernel_sleep
 * @{
 */

/**
 * @brief Verify that k_usleep() never sleeps for less than the minimum tick
 *        granularity.
 *
 * @details
 * Absolute microsecond sleep durations cannot be validated portably because the
 * granularity of k_usleep() depends on the tick rate and timer hardware.
 * Instead, this test issues k_usleep(1) in a loop sized to span one second of
 * ticks and checks that the aggregate elapsed time stays within a computed
 * lower and upper bound. This proves that each minimal sleep rounds up to at
 * least the tick period (never returns early) while remaining bounded above by
 * the per-iteration alignment overhead. Because precise timing is unreliable
 * under emulation, the measurement is retried up to RETRIES times and passes if
 * any iteration lands in range.
 *
 * Test steps:
 * - Record the uptime, then call k_usleep(1) for LOOPS iterations.
 * - Compute the elapsed time and compare it against LOWER_BOUND_MS and
 *   UPPER_BOUND_MS, retrying the whole measurement up to RETRIES times.
 * - Assert the elapsed time is neither below the lower bound (short sleep) nor
 *   above the upper bound (overslept).
 *
 * Expected result:
 * - Total elapsed time is within [LOWER_BOUND_MS, UPPER_BOUND_MS], confirming
 *   k_usleep() sleeps for at least the minimal granularity and no longer than
 *   the expected alignment overhead.
 *
 * @see k_usleep()
 * @see k_uptime_get()
 * @verifies ZEP-SRS-28-9
 * @verifies ZEP-SRS-28-10
 */
ZTEST_USER(sleep, test_usleep)
{
	int retries = 0;
	int64_t elapsed_ms = 0;

	while (retries < RETRIES) {
		int64_t start_ms;
		int64_t end_ms;
		int i;

		++retries;
		start_ms = k_uptime_get();

		for (i = 0; i < LOOPS; ++i) {
			k_usleep(1);
		}

		end_ms = k_uptime_get();
		elapsed_ms = end_ms - start_ms;

		/* if at first you don't succeed, keep sucking. */

		if ((elapsed_ms >= LOWER_BOUND_MS) &&
		    (elapsed_ms <= UPPER_BOUND_MS)) {
			break;
		}
	}

	zassert_true(elapsed_ms >= LOWER_BOUND_MS, "short sleep");
	zassert_true(elapsed_ms <= UPPER_BOUND_MS, "overslept");
}

/**
 * @}
 */
```

## src/wraparound.c
```c
/*
 * Copyright (c) 2024 Akaiwa Wataru <akaiwa@sonas.co.jp>
 *
 * SPDX-License-Identifier: Apache-2.0
 */
#include <zephyr/kernel.h>
#include <zephyr/ztest.h>

/**
 * @addtogroup tests_kernel_sleep
 * @{
 */

static k_tid_t thread_id;

static void alarm_callback(struct k_timer *timer)
{
	k_wakeup(thread_id);
}

K_TIMER_DEFINE(alarm, alarm_callback, NULL);

/**
 * @brief Verify k_sleep() handles a 32-bit tick counter wraparound correctly.
 *
 * @details
 * When the system tick counter wraps around 2^32 while a thread is sleeping, the
 * timeout math must remain correct so an early k_wakeup() is honored and the
 * reported remaining time is sane. The tick counter is preset close to the wrap
 * point, a timer wakes the sleeper before its long timeout, and the test checks
 * the sleep returned early with a plausible remaining duration.
 *
 * Test steps:
 * - Set the tick counter just below the 32-bit wrap point.
 * - Sleep for a long timeout while a timer fires an early k_wakeup().
 * - Verify k_sleep() returned with the expected non-zero remaining time.
 *
 * Expected result:
 * - The sleep is woken early across the tick wraparound with correct accounting.
 *
 * @see k_sleep()
 * @see k_wakeup()
 * @verifies ZEP-SRS-28-8
 */
ZTEST(wraparound, test_tick_wraparound_in_sleep)
{
	static const uint32_t start_ticks = 0xffffff00; /* It wraps around after 256 ticks! */
	static const uint32_t timeout_ticks = 300;      /* 3 seconds @ 100Hz tick */
	static const uint32_t wakeup_ticks = 10;        /* 100 ms @ 100Hz tick */

	sys_clock_tick_set(start_ticks);

	/* Wake up myself by alarm */
	thread_id = k_current_get();
	k_timer_start(&alarm, K_TICKS(wakeup_ticks), K_FOREVER);

	/* Waiting alarm's k_wakeup() call */
	int32_t left_ms = k_sleep(K_TICKS(timeout_ticks));

	zassert(left_ms > 0, "k_sleep() timed out");

	k_timer_stop(&alarm);
}

ZTEST_SUITE(wraparound, NULL, NULL, NULL, NULL, NULL);

/**
 * @}
 */
```
