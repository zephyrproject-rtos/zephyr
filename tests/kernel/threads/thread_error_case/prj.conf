## CMakeLists.txt
```
# SPDX-License-Identifier: Apache-2.0

cmake_minimum_required(VERSION 3.28.0)
find_package(Zephyr REQUIRED HINTS $ENV{ZEPHYR_BASE})
project(thread_apis)

FILE(GLOB app_sources src/*.c)
target_sources(app PRIVATE ${app_sources})

target_include_directories(app PRIVATE
  ${ZEPHYR_BASE}/kernel/include
  ${ZEPHYR_BASE}/arch/${ARCH}/include
  )
```

## prj.conf
```kconfig
CONFIG_ZTEST=y
CONFIG_THREAD_MONITOR=y
CONFIG_THREAD_CUSTOM_DATA=y
CONFIG_THREAD_NAME=y
CONFIG_THREAD_STACK_INFO=y
CONFIG_TEST_USERSPACE=y
CONFIG_MP_MAX_NUM_CPUS=1
CONFIG_IRQ_OFFLOAD=y
CONFIG_ZTEST_FATAL_HOOK=y
```

## boards/qemu_xtensa_dc233c_mmu.conf
```kconfig
# For some weird reasons, enabling ICOUNT would crash QEMU
# on this test. So disable it.
CONFIG_QEMU_ICOUNT=n
```

## src/main.c
```c
/*
 * Copyright (c) 2021 Intel Corporation
 *
 * SPDX-License-Identifier: Apache-2.0
 */
#include <zephyr/ztest.h>
#include <zephyr/ztest_error_hook.h>

#define STACK_SIZE (512 + CONFIG_TEST_EXTRA_STACK_SIZE)
#define THREAD_TEST_PRIORITY 5

/* selected negative test case, shared with the worker thread */
static ZTEST_DMEM int case_type;

static K_THREAD_STACK_DEFINE(tstack, STACK_SIZE);
static K_THREAD_STACK_DEFINE(test_stack, STACK_SIZE);
static K_THREAD_STACK_DEFINE(reuse_stack1, STACK_SIZE);
static K_THREAD_STACK_DEFINE(reuse_stack2, STACK_SIZE);
static struct k_thread tdata;
static struct k_thread test_tdata;
static struct k_thread reuse_tdata;

/* identifiers for each negative test scenario */
enum {
	THREAD_START,
	FLOAT_DISABLE,
	TIMEOUT_REMAINING_TICKS,
	TIMEOUT_EXPIRES_TICKS,
	THREAD_CREATE_NEWTHREAD_NULL,
	THREAD_CREATE_STACK_NULL,
	THREAD_CREATE_STACK_SIZE_OVERFLOW,
	THREAD_SUSPEND_NULL,
	THREAD_RESUME_NULL,
	THREAD_PRIORITY_SET_NULL,
	THREAD_PRIORITY_GET_NULL,
	THREAD_WAKEUP_NULL,
	THREAD_CREATE_SUPERVISOR,
	THREAD_CREATE_ESSENTIAL,
	THREAD_REUSE_ACTIVE_THREAD_ID
} neg_case;

static void test_thread(void *p1, void *p2, void *p3)
{
	/* intentionally empty target thread */
}

static void long_running_thread(void *p1, void *p2, void *p3)
{
	/* Sleep for a long time to keep thread active */
	k_sleep(K_FOREVER);
}

static void tThread_entry_negative(void *p1, void *p2, void *p3)
{
	ARG_UNUSED(p2);
	ARG_UNUSED(p3);

	int choice = *((int *)p1);
	uint32_t perm = K_INHERIT_PERMS;

	/* Arm the fatal-error hook before calling the API under test.
	 * Each case must not return; control resumes after the switch
	 * only if the error was not detected, which fails the test.
	 */
	switch (choice) {
	case THREAD_START:
		ztest_set_fault_valid(true);
		k_thread_start(NULL);
		break;
	case FLOAT_DISABLE:
		ztest_set_fault_valid(true);
		k_float_disable(NULL);
		break;
	case TIMEOUT_REMAINING_TICKS:
		ztest_set_fault_valid(true);
		k_thread_timeout_remaining_ticks(NULL);
		break;
	case TIMEOUT_EXPIRES_TICKS:
		ztest_set_fault_valid(true);
		k_thread_timeout_expires_ticks(NULL);
		break;
	case THREAD_CREATE_NEWTHREAD_NULL:
		ztest_set_fault_valid(true);
		if (k_is_user_context()) {
			perm = perm | K_USER;
		}

		k_thread_create((struct k_thread *)NULL, test_stack, STACK_SIZE,
			test_thread, NULL, NULL, NULL,
			K_PRIO_PREEMPT(THREAD_TEST_PRIORITY),
			perm, K_NO_WAIT);
		break;
	case THREAD_CREATE_STACK_NULL:
		ztest_set_fault_valid(true);
		if (k_is_user_context()) {
			perm = perm | K_USER;
		}

		k_thread_create(&test_tdata, NULL, STACK_SIZE,
			test_thread, NULL, NULL, NULL,
			K_PRIO_PREEMPT(THREAD_TEST_PRIORITY),
			perm, K_NO_WAIT);
		break;
	case THREAD_CREATE_STACK_SIZE_OVERFLOW:
		ztest_set_fault_valid(true);
		if (k_is_user_context()) {
			perm = perm | K_USER;
		}
		k_thread_create(&test_tdata, test_stack, -1,
			test_thread, NULL, NULL, NULL,
			K_PRIO_PREEMPT(THREAD_TEST_PRIORITY),
			perm, K_NO_WAIT);
		break;
	case THREAD_SUSPEND_NULL:
		ztest_set_fault_valid(true);
		k_thread_suspend(NULL);
		break;
	case THREAD_RESUME_NULL:
		ztest_set_fault_valid(true);
		k_thread_resume(NULL);
		break;
	case THREAD_PRIORITY_SET_NULL:
		ztest_set_fault_valid(true);
		k_thread_priority_set(NULL, K_PRIO_PREEMPT(THREAD_TEST_PRIORITY));
		break;
	case THREAD_PRIORITY_GET_NULL:
		ztest_set_fault_valid(true);
		k_thread_priority_get(NULL);
		break;
	case THREAD_WAKEUP_NULL:
		ztest_set_fault_valid(true);
		k_wakeup(NULL);
		break;
	case THREAD_CREATE_SUPERVISOR:
		/* Creating a supervisor thread (K_USER flag absent) is
		 * only rejected in user context; skip otherwise.
		 */
		if (!k_is_user_context()) {
			ztest_test_skip();
			break;
		}
		ztest_set_fault_valid(true);
		k_thread_create(&test_tdata, test_stack, STACK_SIZE,
			test_thread, NULL, NULL, NULL,
			K_PRIO_PREEMPT(THREAD_TEST_PRIORITY),
			K_INHERIT_PERMS, K_NO_WAIT);
		break;
	case THREAD_CREATE_ESSENTIAL:
		/* Creating an essential thread (K_ESSENTIAL flag) is
		 * only rejected in user context; skip otherwise.
		 */
		if (!k_is_user_context()) {
			ztest_test_skip();
			break;
		}
		ztest_set_fault_valid(true);
		k_thread_create(&test_tdata, test_stack, STACK_SIZE,
			test_thread, NULL, NULL, NULL,
			K_PRIO_PREEMPT(THREAD_TEST_PRIORITY),
			K_USER | K_ESSENTIAL, K_NO_WAIT);
		break;
	case THREAD_REUSE_ACTIVE_THREAD_ID:
		ztest_set_fault_valid(true);
		/* Create first thread that will run for a while */
		k_thread_create(&reuse_tdata, reuse_stack1, STACK_SIZE, long_running_thread, NULL,
				NULL, NULL, K_PRIO_PREEMPT(THREAD_TEST_PRIORITY + 1), perm,
				K_NO_WAIT);
		/* Try to reuse the same thread structure while it's still active */
		k_thread_create(&reuse_tdata, reuse_stack2, STACK_SIZE, test_thread, NULL, NULL,
				NULL, K_PRIO_PREEMPT(THREAD_TEST_PRIORITY), perm, K_NO_WAIT);
		break;
	default:
		TC_PRINT("should not be here!\n");
		break;
	}

	/* Reaching here means the expected error was not detected. */
	ztest_test_fail();
}

static void create_negative_test_thread(int choice)
{
	uint32_t perm = K_INHERIT_PERMS;

	if (k_is_user_context()) {
		perm = perm | K_USER;
	}

	case_type = choice;

	k_tid_t tid = k_thread_create(&tdata, tstack, STACK_SIZE,
			tThread_entry_negative,
			(void *)&case_type, NULL, NULL,
			K_PRIO_PREEMPT(THREAD_TEST_PRIORITY),
			perm, K_NO_WAIT);

	(void)k_thread_join(tid, K_FOREVER);
}

/**
 * @brief Verify that k_thread_start() rejects a NULL thread pointer.
 *
 * @ingroup kernel_thread_tests
 *
 * @details
 * The syscall verification layer must reject a NULL thread object before it
 * reaches the kernel, where it would be dereferenced.
 *
 * All cases in this suite share one mechanism: a worker thread, running in
 * user mode when the test case does, arms the ztest fatal-error hook and then
 * makes the offending call. The call must not return -- reaching the code
 * after it fails the test -- so a pass means the error really was caught.
 *
 * Test steps:
 * - Spawn a worker thread and arm the ztest fatal-error hook.
 * - Make the offending call from that thread.
 * - Join the worker thread.
 *
 * Expected result:
 * - The call raises the expected fatal error and never returns.
 *
 * @see k_thread_start()
 * @verifies ZEP-SRS-1-14
 */
ZTEST_USER(thread_error_case, test_thread_start_null)
{
	create_negative_test_thread(THREAD_START);
}

/**
 * @brief Verify that k_float_disable() rejects a NULL thread pointer.
 *
 * @ingroup kernel_thread_tests
 *
 * @details
 * The syscall verification layer must reject a NULL thread object before it
 * reaches the kernel, where it would be dereferenced.
 *
 * All cases in this suite share one mechanism: a worker thread, running in
 * user mode when the test case does, arms the ztest fatal-error hook and then
 * makes the offending call. The call must not return -- reaching the code
 * after it fails the test -- so a pass means the error really was caught.
 *
 * Test steps:
 * - Spawn a worker thread and arm the ztest fatal-error hook.
 * - Make the offending call from that thread.
 * - Join the worker thread.
 *
 * Expected result:
 * - The call raises the expected fatal error and never returns.
 *
 * @see k_float_disable()
 * @verifies ZEP-SRS-29-3
 */
ZTEST_USER(thread_error_case, test_thread_float_disable_null)
{
	create_negative_test_thread(FLOAT_DISABLE);
}

/**
 * @brief Verify that k_thread_timeout_remaining_ticks() rejects a NULL thread
 *        pointer.
 *
 * @ingroup kernel_thread_tests
 *
 * @details
 * The syscall verification layer must reject a NULL thread object before it
 * reaches the kernel, where it would be dereferenced.
 *
 * All cases in this suite share one mechanism: a worker thread, running in
 * user mode when the test case does, arms the ztest fatal-error hook and then
 * makes the offending call. The call must not return -- reaching the code
 * after it fails the test -- so a pass means the error really was caught.
 *
 * Test steps:
 * - Spawn a worker thread and arm the ztest fatal-error hook.
 * - Make the offending call from that thread.
 * - Join the worker thread.
 *
 * Expected result:
 * - The call raises the expected fatal error and never returns.
 *
 * @see k_thread_timeout_remaining_ticks()
 * @verifies ZEP-SRS-1-33
 */
ZTEST_USER(thread_error_case, test_thread_timeout_remaining_ticks_null)
{
	create_negative_test_thread(TIMEOUT_REMAINING_TICKS);
}

/**
 * @brief Verify that k_thread_timeout_expires_ticks() rejects a NULL thread pointer.
 *
 * @ingroup kernel_thread_tests
 *
 * @details
 * The syscall verification layer must reject a NULL thread object before it
 * reaches the kernel, where it would be dereferenced.
 *
 * All cases in this suite share one mechanism: a worker thread, running in
 * user mode when the test case does, arms the ztest fatal-error hook and then
 * makes the offending call. The call must not return -- reaching the code
 * after it fails the test -- so a pass means the error really was caught.
 *
 * Test steps:
 * - Spawn a worker thread and arm the ztest fatal-error hook.
 * - Make the offending call from that thread.
 * - Join the worker thread.
 *
 * Expected result:
 * - The call raises the expected fatal error and never returns.
 *
 * @see k_thread_timeout_expires_ticks()
 * @verifies ZEP-SRS-1-33
 */
ZTEST_USER(thread_error_case, test_thread_timeout_expires_ticks_null)
{
	create_negative_test_thread(TIMEOUT_EXPIRES_TICKS);
}

/**
 * @brief Verify that k_thread_create() rejects a NULL new-thread object.
 *
 * @ingroup kernel_thread_tests
 *
 * @details
 * The verifier requires the new thread to be a valid, uninitialized kernel
 * object, so a NULL pointer must be refused rather than initialized.
 *
 * All cases in this suite share one mechanism: a worker thread, running in
 * user mode when the test case does, arms the ztest fatal-error hook and then
 * makes the offending call. The call must not return -- reaching the code
 * after it fails the test -- so a pass means the error really was caught.
 *
 * Test steps:
 * - Spawn a worker thread and arm the ztest fatal-error hook.
 * - Make the offending call from that thread.
 * - Join the worker thread.
 *
 * Expected result:
 * - The call raises the expected fatal error and never returns.
 *
 * @see k_thread_create()
 * @verifies ZEP-SRS-1-1
 */
ZTEST_USER(thread_error_case, test_thread_create_null_thread)
{
	create_negative_test_thread(THREAD_CREATE_NEWTHREAD_NULL);
}

/**
 * @brief Verify that k_thread_create() rejects a NULL stack object.
 *
 * @ingroup kernel_thread_tests
 *
 * @details
 * The verifier requires the stack to be a valid, uninitialized kernel stack
 * object, so a NULL pointer must be refused rather than used as a stack.
 *
 * All cases in this suite share one mechanism: a worker thread, running in
 * user mode when the test case does, arms the ztest fatal-error hook and then
 * makes the offending call. The call must not return -- reaching the code
 * after it fails the test -- so a pass means the error really was caught.
 *
 * Test steps:
 * - Spawn a worker thread and arm the ztest fatal-error hook.
 * - Make the offending call from that thread.
 * - Join the worker thread.
 *
 * Expected result:
 * - The call raises the expected fatal error and never returns.
 *
 * @see k_thread_create()
 * @verifies ZEP-SRS-1-1
 */
ZTEST_USER(thread_error_case, test_thread_create_null_stack)
{
	create_negative_test_thread(THREAD_CREATE_STACK_NULL);
}

/**
 * @brief Verify that k_thread_create() rejects a stack size that overflows.
 *
 * @ingroup kernel_thread_tests
 *
 * @details
 * The verifier adds K_THREAD_STACK_RESERVED to the requested size, so a size
 * of SIZE_MAX wraps around; the overflow has to be detected instead of
 * yielding a small, bogus stack.
 *
 * All cases in this suite share one mechanism: a worker thread, running in
 * user mode when the test case does, arms the ztest fatal-error hook and then
 * makes the offending call. The call must not return -- reaching the code
 * after it fails the test -- so a pass means the error really was caught.
 *
 * Test steps:
 * - Spawn a worker thread and arm the ztest fatal-error hook.
 * - Make the offending call from that thread.
 * - Join the worker thread.
 *
 * Expected result:
 * - The call raises the expected fatal error and never returns.
 *
 * @see k_thread_create()
 * @verifies ZEP-SRS-1-1
 */
ZTEST_USER(thread_error_case, test_thread_create_stack_size_overflow)
{
	create_negative_test_thread(THREAD_CREATE_STACK_SIZE_OVERFLOW);
}

/**
 * @brief Verify that k_thread_create() asserts if a thread pointer is
 *        reused while the thread pointer is in use.
 *
 * @ingroup kernel_thread_tests
 *
 * @details
 * A thread structure must not be reused for a new thread while the
 * thread it currently backs is still active, so this must be detected
 * instead of silently corrupting the running thread's state.
 *
 * This test runs in kernel mode, a worker thread arms the ztest
 * fatal-error hook and then makes the offending call. The call must
 * not return -- reaching the code after it fails the test -- so a pass
 * means the error really was caught.
 *
 * Test steps:
 * - Spawn a worker thread and arm the ztest fatal-error hook.
 * - Create a first thread that keeps running, then try to reuse its thread
 *   structure to create a second thread from the same worker thread.
 * - Join the worker thread.
 *
 * Expected result:
 * - The call raises the expected fatal error and never returns.
 *
 * @see k_thread_create()
 */
ZTEST(thread_error_case, test_thread_reuse_active_thread_id)
{
	create_negative_test_thread(THREAD_REUSE_ACTIVE_THREAD_ID);
}

/**
 * @brief Verify that k_thread_suspend() rejects a NULL thread pointer.
 *
 * @ingroup kernel_thread_tests
 *
 * @details
 * The syscall verification layer must reject a NULL thread object before it
 * reaches the kernel, where it would be dereferenced.
 *
 * All cases in this suite share one mechanism: a worker thread, running in
 * user mode when the test case does, arms the ztest fatal-error hook and then
 * makes the offending call. The call must not return -- reaching the code
 * after it fails the test -- so a pass means the error really was caught.
 *
 * Test steps:
 * - Spawn a worker thread and arm the ztest fatal-error hook.
 * - Make the offending call from that thread.
 * - Join the worker thread.
 *
 * Expected result:
 * - The call raises the expected fatal error and never returns.
 *
 * @see k_thread_suspend()
 * @verifies ZEP-SRS-1-3
 */
ZTEST_USER(thread_error_case, test_thread_suspend_null)
{
	create_negative_test_thread(THREAD_SUSPEND_NULL);
}

/**
 * @brief Verify that k_thread_resume() rejects a NULL thread pointer.
 *
 * @ingroup kernel_thread_tests
 *
 * @details
 * The syscall verification layer must reject a NULL thread object before it
 * reaches the kernel, where it would be dereferenced.
 *
 * All cases in this suite share one mechanism: a worker thread, running in
 * user mode when the test case does, arms the ztest fatal-error hook and then
 * makes the offending call. The call must not return -- reaching the code
 * after it fails the test -- so a pass means the error really was caught.
 *
 * Test steps:
 * - Spawn a worker thread and arm the ztest fatal-error hook.
 * - Make the offending call from that thread.
 * - Join the worker thread.
 *
 * Expected result:
 * - The call raises the expected fatal error and never returns.
 *
 * @see k_thread_resume()
 * @verifies ZEP-SRS-1-4
 */
ZTEST_USER(thread_error_case, test_thread_resume_null)
{
	create_negative_test_thread(THREAD_RESUME_NULL);
}

/**
 * @brief Verify that k_thread_priority_set() rejects a NULL thread pointer.
 *
 * @ingroup kernel_thread_tests
 *
 * @details
 * The syscall verification layer must reject a NULL thread object before it
 * reaches the kernel, where it would be dereferenced.
 *
 * All cases in this suite share one mechanism: a worker thread, running in
 * user mode when the test case does, arms the ztest fatal-error hook and then
 * makes the offending call. The call must not return -- reaching the code
 * after it fails the test -- so a pass means the error really was caught.
 *
 * Test steps:
 * - Spawn a worker thread and arm the ztest fatal-error hook.
 * - Make the offending call from that thread.
 * - Join the worker thread.
 *
 * Expected result:
 * - The call raises the expected fatal error and never returns.
 *
 * @see k_thread_priority_set()
 * @verifies ZEP-SRS-1-2
 */
ZTEST_USER(thread_error_case, test_thread_priority_set_null)
{
	create_negative_test_thread(THREAD_PRIORITY_SET_NULL);
}

/**
 * @brief Verify that k_thread_priority_get() rejects a NULL thread pointer.
 *
 * @ingroup kernel_thread_tests
 *
 * @details
 * The syscall verification layer must reject a NULL thread object before it
 * reaches the kernel, where it would be dereferenced.
 *
 * All cases in this suite share one mechanism: a worker thread, running in
 * user mode when the test case does, arms the ztest fatal-error hook and then
 * makes the offending call. The call must not return -- reaching the code
 * after it fails the test -- so a pass means the error really was caught.
 *
 * Test steps:
 * - Spawn a worker thread and arm the ztest fatal-error hook.
 * - Make the offending call from that thread.
 * - Join the worker thread.
 *
 * Expected result:
 * - The call raises the expected fatal error and never returns.
 *
 * @see k_thread_priority_get()
 * @verifies ZEP-SRS-1-16
 */
ZTEST_USER(thread_error_case, test_thread_priority_get_null)
{
	create_negative_test_thread(THREAD_PRIORITY_GET_NULL);
}

/**
 * @brief Verify that k_wakeup() rejects a NULL thread pointer.
 *
 * @ingroup kernel_thread_tests
 *
 * @details
 * The syscall verification layer must reject a NULL thread object before it
 * reaches the kernel, where it would be dereferenced.
 *
 * All cases in this suite share one mechanism: a worker thread, running in
 * user mode when the test case does, arms the ztest fatal-error hook and then
 * makes the offending call. The call must not return -- reaching the code
 * after it fails the test -- so a pass means the error really was caught.
 *
 * Test steps:
 * - Spawn a worker thread and arm the ztest fatal-error hook.
 * - Make the offending call from that thread.
 * - Join the worker thread.
 *
 * Expected result:
 * - The call raises the expected fatal error and never returns.
 *
 * @see k_wakeup()
 * @verifies ZEP-SRS-28-11
 */
ZTEST_USER(thread_error_case, test_thread_wakeup_null)
{
	create_negative_test_thread(THREAD_WAKEUP_NULL);
}

/**
 * @brief Verify that a user thread cannot create a supervisor thread.
 *
 * @ingroup kernel_thread_tests
 *
 * @details
 * Omitting K_USER from a thread created in user context would hand
 * unprivileged code a privileged thread, so the verifier must require the
 * flag on every thread spawned from user mode.
 *
 * All cases in this suite share one mechanism: a worker thread, running in
 * user mode when the test case does, arms the ztest fatal-error hook and then
 * makes the offending call. The call must not return -- reaching the code
 * after it fails the test -- so a pass means the error really was caught.
 *
 * Test steps:
 * - Spawn a worker thread and arm the ztest fatal-error hook.
 * - Make the offending call from that thread.
 * - Join the worker thread.
 *
 * Expected result:
 * - The call raises the expected fatal error and never returns.
 *
 * @see k_thread_create()
 * @verifies ZEP-SRS-8-8
 */
ZTEST_USER(thread_error_case, test_thread_create_supervisor_denied)
{
	create_negative_test_thread(THREAD_CREATE_SUPERVISOR);
}

/**
 * @brief Verify that a user thread cannot create an essential thread.
 *
 * @ingroup kernel_thread_tests
 *
 * @details
 * Aborting an essential thread panics the kernel, so unprivileged code must
 * not be able to set K_ESSENTIAL on a thread it creates.
 *
 * All cases in this suite share one mechanism: a worker thread, running in
 * user mode when the test case does, arms the ztest fatal-error hook and then
 * makes the offending call. The call must not return -- reaching the code
 * after it fails the test -- so a pass means the error really was caught.
 *
 * Test steps:
 * - Spawn a worker thread and arm the ztest fatal-error hook.
 * - Make the offending call from that thread.
 * - Join the worker thread.
 *
 * Expected result:
 * - The call raises the expected fatal error and never returns.
 *
 * @see k_thread_create()
 * @verifies ZEP-SRS-8-8
 */
ZTEST_USER(thread_error_case, test_thread_create_essential_denied)
{
	create_negative_test_thread(THREAD_CREATE_ESSENTIAL);
}

/* Grant the test thread access to all shared kernel objects. */
void *thread_grant_setup(void)
{
	k_thread_access_grant(k_current_get(), &tdata, &tstack, &test_tdata, &test_stack);

	return NULL;
}

ZTEST_SUITE(thread_error_case, NULL, thread_grant_setup, NULL, NULL, NULL);
```
