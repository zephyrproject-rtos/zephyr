## CMakeLists.txt
```
# SPDX-License-Identifier: Apache-2.0

cmake_minimum_required(VERSION 3.20.0)
find_package(Zephyr REQUIRED HINTS $ENV{ZEPHYR_BASE})
project(thread_apis)

FILE(GLOB app_sources src/*.c)
target_sources(app PRIVATE ${app_sources})

target_include_directories(app PRIVATE
  ${ZEPHYR_BASE}/kernel/include
  ${ZEPHYR_BASE}/arch/${ARCH}/include
  )
```

## Kconfig
```
# Copyright (c) 2024 Intel Corporation
# SPDX-License-Identifier: Apache-2.0

mainmenu "Thread APIs test"

source "Kconfig.zephyr"

config THREAD_API_UNMAPPED_ADDRESS
	hex "Unmapped address from which to read"
	default 0xFFFFFFF0
	help
	  This is the unmapped address that test_thread_name_user_get_set()
	  will attempt to use if CONFIG_TRUSTED_EXECUTION_NONSECURE is not
	  enabled. For most platforms, this address can be expected to be
	  near the end of addressable memory; however it is not guaranteed
	  for all platforms.
```

## prj.conf
```kconfig
CONFIG_ZTEST=y
CONFIG_THREAD_MONITOR=y
CONFIG_THREAD_CUSTOM_DATA=y
CONFIG_THREAD_NAME=y
CONFIG_THREAD_STACK_INFO=y
CONFIG_TEST_USERSPACE=y
CONFIG_MP_MAX_NUM_CPUS=1
CONFIG_IRQ_OFFLOAD=y
CONFIG_THREAD_RUNTIME_STATS=y
CONFIG_INIT_STACKS=y
CONFIG_MAX_THREAD_BYTES=3
CONFIG_THREAD_RESULT=y
CONFIG_POLL=y
CONFIG_SIGNAL=y
CONFIG_SIGNAL_SET_SIZE=32
CONFIG_THREAD_CANCEL=y
CONFIG_THREAD_CLEANUP=y
```

## boards/qemu_cortex_r5.conf
```kconfig
CONFIG_THREAD_API_UNMAPPED_ADDRESS=0xF9200000
```

## src/test_essential_thread.c
```c
/*
 * Copyright (c) 2016 Intel Corporation
 *
 * SPDX-License-Identifier: Apache-2.0
 */
#include <zephyr/ztest.h>
#include <zephyr/kernel.h>

/* Internal APIs */
#include <kernel_internal.h>
#include <ksched.h>
#include <kthread.h>

struct k_thread kthread_thread;
struct k_thread kthread_thread1;

#define STACKSIZE (1024 + CONFIG_TEST_EXTRA_STACK_SIZE)
K_THREAD_STACK_DEFINE(kthread_stack, STACKSIZE);
K_SEM_DEFINE(sync_sem, 0, 1);

static bool fatal_error_signaled;

static void thread_entry(void *p1, void *p2, void *p3)
{
	ARG_UNUSED(p1);
	ARG_UNUSED(p2);
	ARG_UNUSED(p3);

	z_thread_essential_set(_current);

	if (z_is_thread_essential(_current)) {
		k_busy_wait(100);
	} else {
		zassert_unreachable("The thread is not set as essential");
	}

	z_thread_essential_clear(_current);
	zassert_false(z_is_thread_essential(_current),
		      "Essential flag of the thread is not cleared");

	k_sem_give(&sync_sem);
}

/**
 * @brief Verify that a thread can mark itself essential and clear it again.
 *
 * @ingroup kernel_thread_tests
 *
 * @details
 * The essential flag is part of a thread's own state and can be turned on and
 * off at run time, not only at creation. The spawned thread sets the flag,
 * checks that it reads back as set, clears it and checks again, so what is
 * validated is the flag the kernel actually recorded. Clearing it also lets
 * the thread be aborted afterwards without panicking the kernel.
 *
 * Test steps:
 * - Create a thread that calls k_thread_essential_set() and confirms
 *   k_is_essential() reports it.
 * - Have the thread clear the flag and confirm it no longer reports.
 * - Signal the test thread, which then aborts the worker.
 *
 * Expected result:
 * - The flag reads back as set after being set and clear after being cleared,
 *   and the thread aborts without raising a fatal error.
 *
 * @see k_thread_essential_set()
 * @see k_thread_essential_clear()
 * @see k_is_essential()
 * @verifies ZEP-SRS-1-11
 */
ZTEST(threads_lifecycle, test_thread_essential_set_clear)
{
	k_tid_t tid = k_thread_create(&kthread_thread, kthread_stack,
				      STACKSIZE, thread_entry, NULL,
				      NULL, NULL, K_PRIO_PREEMPT(0), 0,
				      K_NO_WAIT);

	k_sem_take(&sync_sem, K_FOREVER);
	k_thread_abort(tid);
}

void k_sys_fatal_error_handler(unsigned int reason,
				      const struct arch_esf *esf)
{
	ARG_UNUSED(esf);
	ARG_UNUSED(reason);

	fatal_error_signaled = true;
}

static void abort_thread_entry(void *p1, void *p2, void *p3)
{
	ARG_UNUSED(p1);
	ARG_UNUSED(p2);
	ARG_UNUSED(p3);

	if (z_is_thread_essential(_current)) {
		k_msleep(200);
	} else {
		zassert_unreachable("The thread is not set as essential");
	}

	zassert_true(false, "Should not reach this line");
}

static void abort_thread_self(void *p1, void *p2, void *p3)
{
	k_thread_abort(k_current_get());
	zassert_true(false, "Should not reach this line");
}

/**
 * @brief Verify that aborting an essential thread raises a fatal error.
 *
 * @ingroup kernel_thread_tests
 *
 * @details
 * An essential thread is one the system cannot continue without, so the kernel
 * must treat its termination as a fatal system error rather than reclaiming it
 * quietly. The test installs a fatal error handler that records the event and
 * lets the system continue, so the abort can be observed instead of halting
 * the run.
 *
 * Test steps:
 * - Create a thread with the K_ESSENTIAL option and let it start.
 * - Abort it from the test thread.
 * - Check the flag recorded by the fatal error handler.
 *
 * Expected result:
 * - The kernel raises a fatal error for the aborted essential thread.
 *
 * @see K_ESSENTIAL
 * @see k_thread_abort()
 * @see k_sys_fatal_error_handler()
 * @verifies ZEP-SRS-1-11
 */
ZTEST(threads_lifecycle, test_thread_essential_abort_panics)
{
	fatal_error_signaled = false;
	k_thread_create(&kthread_thread1, kthread_stack, STACKSIZE,
			abort_thread_entry,
			NULL, NULL, NULL, K_PRIO_PREEMPT(0), K_ESSENTIAL,
			K_NO_WAIT);

	k_msleep(100);
	k_thread_abort(&kthread_thread1);
	zassert_true(fatal_error_signaled, "fatal error was not signaled");
}

/**
 * @brief Verify that an essential thread aborting itself raises a fatal error.
 *
 * @ingroup kernel_thread_tests
 *
 * @details
 * The same rule has to hold when the essential thread ends itself rather than
 * being aborted by someone else, which is the harder path: the panic is raised
 * on the very thread that is going away, so the architecture layer has to
 * unwind a thread that aborts inside its own fatal error handling.
 *
 * Test steps:
 * - Create a thread with the K_ESSENTIAL option whose entry point returns,
 *   ending the thread from within itself.
 * - Wait for the fatal error handler to record the event.
 *
 * Expected result:
 * - The kernel raises a fatal error for the self-terminating essential thread.
 *
 * @see K_ESSENTIAL
 * @see k_sys_fatal_error_handler()
 * @verifies ZEP-SRS-1-11
 */
ZTEST(threads_lifecycle, test_thread_essential_abort_self_panics)
{
	/* This test case needs to be able to handle a k_panic() call
	 * that aborts the current thread inside of the panic handler
	 * itself.  That's putting a lot of strain on the arch layer
	 * to handle things that haven't traditionally been required.
	 * These ones aren't there yet.
	 *
	 * But run it for everyone else to catch regressions in the
	 * code we are actually trying to test.
	 */
	if (IS_ENABLED(CONFIG_X86) || IS_ENABLED(CONFIG_SPARC)) {
		ztest_test_skip();
	}

	fatal_error_signaled = false;
	k_thread_create(&kthread_thread1, kthread_stack, STACKSIZE,
			abort_thread_self,
			NULL, NULL, NULL, K_PRIO_PREEMPT(0), K_ESSENTIAL,
			K_NO_WAIT);

	k_msleep(100);
	zassert_true(fatal_error_signaled, "fatal error was not signaled");
}
```

## src/test_kthread_for_each.c
```c
/*
 * Copyright (c) 2018 Intel Corporation
 *
 * SPDX-License-Identifier: Apache-2.0
 */

#include <zephyr/ztest.h>
#include <zephyr/irq_offload.h>
#include <zephyr/debug/stack.h>

#include "tests_thread_apis.h"

#define SLEEP_MS 100
#define TEST_STRING "TEST"
#define TEST_STRING_UNLOCKED "TEST_UNLOCKED"

static int tcount;
static bool thread_flag;
static bool create_thread;
static k_tid_t in_callback_tid;

struct k_thread tdata1;
K_THREAD_STACK_DEFINE(tstack1, STACK_SIZE);

static void thread_entry(void *p1, void *p2, void *p3)
{
	ARG_UNUSED(p1);
	ARG_UNUSED(p2);
	ARG_UNUSED(p3);

	k_msleep(SLEEP_MS);
}

static void thread_callback(const struct k_thread *thread, void *user_data)
{
	char *str = (char *)user_data;

	if (thread == &tdata) {
		TC_PRINT("%s: Newly added thread found\n", str);
		TC_PRINT("%s: tid: %p, prio: %d\n",
				str, thread, thread->base.prio);
		thread_flag = true;
	}
	tcount++;
}

static
void thread_callback_unlocked(const struct k_thread *thread, void *user_data)
{
	char *str = (char *)user_data;

	if (create_thread) {
		in_callback_tid = k_thread_create(&tdata1, tstack1,
					STACK_SIZE,
					thread_entry,
					NULL, NULL, NULL, K_PRIO_PREEMPT(0),
					0, K_NO_WAIT);
		create_thread = false;
	}

	if (thread == &tdata) {
		TC_PRINT("%s: Newly added thread found\n", str);
		TC_PRINT("%s: tid: %p, prio: %d\n",
				str, thread, thread->base.prio);
		thread_flag = true;
	}

	if (thread == &tdata1) {
		TC_PRINT("%s: Newly added thread in callback found\n", str);
		TC_PRINT("%s: tid: %p, prio: %d\n",
				str, thread, thread->base.prio);
		thread_flag = true;
		k_thread_abort(in_callback_tid);
	}
	tcount++;
}

/**
 * @brief Verify that k_thread_foreach() visits every thread, including new
 *        ones.
 *
 * @ingroup kernel_thread_tests
 *
 * @details
 * The iterator has to walk the kernel's whole thread list and invoke the
 * caller's callback once per thread, picking up threads created since a
 * previous walk. Counting the callbacks before and after creating a thread
 * makes that growth observable. The iteration runs with the scheduler locked,
 * so the callback must not create or abort threads.
 *
 * Test steps:
 * - Call k_thread_foreach() and record how many threads were visited.
 * - Create an additional thread.
 * - Call k_thread_foreach() again and compare the new count.
 *
 * Expected result:
 * - The first walk visits at least one thread, and the second visits exactly
 *   one more than the first.
 *
 * @see k_thread_foreach()
 */
ZTEST(threads_lifecycle_1cpu, test_thread_foreach)
{
	int count;

	k_thread_foreach(thread_callback, TEST_STRING);

	/* Check thread_count non-zero, thread_flag
	 * and stack_flag are not set.
	 */
	zassert_true(tcount && !thread_flag,
				"thread_callback() not getting called");
	/* Save the initial thread count */
	count = tcount;

	/* Create new thread which should add a new entry to the thread list */
	k_tid_t tid = k_thread_create(&tdata, tstack,
			STACK_SIZE, thread_entry, NULL,
			NULL, NULL, K_PRIO_PREEMPT(0), 0, K_NO_WAIT);
	k_msleep(1);

	/* Call k_thread_foreach() and check
	 * thread_callback is getting called for
	 * the newly added thread.
	 */
	tcount = 0;
	k_thread_foreach(thread_callback, TEST_STRING);

	/* Check thread_count > temp, thread_flag and stack_flag are set */
	zassert_true((tcount > count) && thread_flag,
					"thread_callback() not getting called");
	k_thread_abort(tid);
}

/**
 * @brief Verify that k_thread_foreach_unlocked() iterates without holding the
 *        scheduler lock.
 *
 * @ingroup kernel_thread_tests
 *
 * @details
 * The unlocked iterator visits the same threads as the locked one but leaves
 * the scheduler unlocked between callbacks, which is what makes it legal for
 * the callback to create or abort threads. The callback used here aborts a
 * thread while the walk is in progress, so a pass shows the iteration
 * tolerates the list changing underneath it.
 *
 * Test steps:
 * - Call k_thread_foreach_unlocked() and record how many threads were visited.
 * - Create an additional thread.
 * - Call it again with a callback that aborts a thread mid-iteration.
 * - Compare the counts.
 *
 * Expected result:
 * - The first walk visits at least one thread, the second visits exactly one
 *   more, and aborting from the callback does not disturb the walk.
 *
 * @see k_thread_foreach_unlocked()
 */
ZTEST(threads_lifecycle_1cpu, test_thread_foreach_unlocked)
{
	int count;

	thread_flag = false;
	tcount = 0;
	k_thread_foreach_unlocked(thread_callback_unlocked,
				  TEST_STRING_UNLOCKED);

	/* Check thread_count non-zero, thread_flag
	 * and stack_flag are not set.
	 */
	zassert_true(tcount && !thread_flag,
				"thread_callback() not getting called");
	/* Save the initial thread count */
	count = tcount;

	/* Create new thread which should add a new entry to the thread list */
	k_tid_t tid = k_thread_create(&tdata, tstack,
			STACK_SIZE, thread_entry, NULL,
			NULL, NULL, K_PRIO_PREEMPT(0), 0, K_NO_WAIT);
	k_msleep(1);

	/* Call k_thread_foreach() and check
	 * thread_callback is getting called for
	 * the newly added thread.
	 * meanwhile, a new thread is created in callback but
	 * it is not be counted in this iteration
	 */
	tcount = 0;
	create_thread = true;
	k_thread_foreach_unlocked(thread_callback_unlocked,
				  TEST_STRING_UNLOCKED);

	/* Check thread_count > temp, thread_flag and stack_flag are set */
	zassert_true((tcount > count) && thread_flag,
					"thread_callback() not getting called");

	/* thread_count increase again,
	 * as there is a thread is created in last iteration
	 */
	tcount = 0;
	k_thread_foreach_unlocked(thread_callback_unlocked,
				  TEST_STRING_UNLOCKED);
	zassert_true((tcount > count) && thread_flag,
					"thread_callback() not getting called");
	k_thread_abort(tid);
}

/**
 * @brief Verify that k_thread_foreach() rejects a NULL callback.
 *
 * @ingroup kernel_thread_tests
 *
 * @details
 * There is nothing sensible to do with a NULL callback, so the iterator
 * asserts on it rather than walking the thread list and dereferencing it. The
 * assertion aborts this thread through the fatal error path, which the test
 * harness expects.
 *
 * Test steps:
 * - Call k_thread_foreach() with a NULL callback.
 *
 * Expected result:
 * - The call raises the expected fatal error and does not return.
 *
 * @see k_thread_foreach()
 */
ZTEST(threads_lifecycle_1cpu, test_thread_foreach_null_cb)
{
	k_thread_foreach(NULL, TEST_STRING);
}

/**
 * @brief Verify that k_thread_foreach_unlocked() rejects a NULL callback.
 *
 * @ingroup kernel_thread_tests
 *
 * @details
 * The unlocked iterator has to reject a NULL callback exactly as the locked
 * one does, asserting instead of walking the thread list and dereferencing it.
 *
 * Test steps:
 * - Call k_thread_foreach_unlocked() with a NULL callback.
 *
 * Expected result:
 * - The call raises the expected fatal error and does not return.
 *
 * @see k_thread_foreach_unlocked()
 */
ZTEST(threads_lifecycle_1cpu, test_thread_foreach_unlocked_null_cb)
{
	k_thread_foreach_unlocked(NULL, TEST_STRING_UNLOCKED);
}

/**
 * @brief Verify that k_thread_state_str() names every thread state.
 *
 * @ingroup kernel_thread_tests
 *
 * @details
 * k_thread_state_str() renders a thread's state bits as text for logs and
 * shell output, so every state and combination it knows about has to produce
 * the right string. Driving a real thread through each state in turn is not
 * possible, so the state field of a spare thread object is set directly and
 * the rendered string is compared against the expected name.
 *
 * Test steps:
 * - For each thread state, write it into a spare thread object's state field.
 * - Call k_thread_state_str() with a caller-provided buffer.
 * - Compare the returned string with the expected text.
 *
 * Expected result:
 * - Every state, including combinations and the empty state, renders as its
 *   documented name.
 *
 * @see k_thread_state_str()
 */
ZTEST(threads_lifecycle_1cpu, test_thread_state_str)
{
	char state_str[32];
	const char *str;
	k_tid_t tid = &tdata1;

	tid->base.thread_state = 0;
	str = k_thread_state_str(tid, state_str, sizeof(state_str));
	zassert_str_equal(str, "");

	tid->base.thread_state = _THREAD_DUMMY;

	str = k_thread_state_str(tid, NULL, sizeof(state_str));
	zassert_str_equal(str, "");

	str = k_thread_state_str(tid, state_str, 0);
	zassert_str_equal(str, "");

	str = k_thread_state_str(tid, state_str, sizeof(state_str));
	zassert_str_equal(str, "dummy");

	tid->base.thread_state = _THREAD_PENDING;
	str = k_thread_state_str(tid, state_str, sizeof(state_str));
	zassert_str_equal(str, "pending");

	tid->base.thread_state = _THREAD_DEAD;
	str = k_thread_state_str(tid, state_str, sizeof(state_str));
	zassert_str_equal(str, "dead");

	tid->base.thread_state = _THREAD_SLEEPING;
	str = k_thread_state_str(tid, state_str, sizeof(state_str));
	zassert_str_equal(str, "sleeping");

	tid->base.thread_state = _THREAD_SUSPENDED;
	str = k_thread_state_str(tid, state_str, sizeof(state_str));
	zassert_str_equal(str, "suspended");

	tid->base.thread_state = _THREAD_ABORTING;
	str = k_thread_state_str(tid, state_str, sizeof(state_str));
	zassert_str_equal(str, "aborting");

	tid->base.thread_state = _THREAD_QUEUED;
	str = k_thread_state_str(tid, state_str, sizeof(state_str));
	zassert_str_equal(str, "queued");

	tid->base.thread_state = _THREAD_PENDING | _THREAD_SUSPENDED;
	str = k_thread_state_str(tid, state_str, sizeof(state_str));
	zassert_str_equal(str, "pending+suspended");
}
```

## src/test_kthread_tss.c
```c
/*
 * Copyright (c) 2018 Intel Corporation
 * Copyright (c) 2026, Friedt Professional Engineering Services, Inc.
 *
 * SPDX-License-Identifier: Apache-2.0
 */

#include <zephyr/kernel.h>

#include <zephyr/sys/util.h>
#include <zephyr/ztest.h>

#define N_THR 2
#define N_KEY 2

ZTEST_BMEM static int entry_mode;
ZTEST_BMEM static void *keys[N_KEY];
ZTEST_BMEM static int alloc_count[N_THR];
ZTEST_BMEM static int dtor_count;

static K_SEM_DEFINE(tss_held, 0, 1);
static K_SEM_DEFINE(tss_release, 0, 1);

static void entry(void *arg1, void *arg2, void *arg3);

/* array of thread stacks */
#define K_THREAD_ARRAY_DEFINE_ELEM(idx, name_base, stack_size, entry, prio, options, delay)        \
	K_THREAD_DEFINE(name_base##_##idx, stack_size, entry, NULL, NULL, NULL, prio, options,     \
			delay)

#define K_THREAD_ARRAY_ELEM_ID(idx, name_base) &_k_thread_obj_##name_base##_##idx

#define K_THREAD_ARRAY_STACK_ELEM_ID(idx, name_base)                                               \
	(k_thread_stack_t *)&_k_thread_stack_##name_base##_##idx

#define K_THREAD_ARRAY_DEFINE_STATIC(name, num, stack_size, entry, prio, options, delay)           \
	LISTIFY(num, K_THREAD_ARRAY_DEFINE_ELEM, (;), \
		  name, stack_size, entry, prio, options, delay);      \
	ZTEST_DMEM __maybe_unused static struct k_thread *name[] = {                               \
		LISTIFY(num, K_THREAD_ARRAY_ELEM_ID, (,), name) };                                    \
	ZTEST_DMEM __maybe_unused static k_thread_stack_t *name##_stack[] = {                      \
		LISTIFY(num, K_THREAD_ARRAY_STACK_ELEM_ID, (,), name) }

K_THREAD_ARRAY_DEFINE_STATIC(thread, N_THR, CONFIG_ZTEST_STACK_SIZE, entry, K_PRIO_PREEMPT(10),
			     K_USER, K_TICKS_FOREVER);

static int get_thread_index(void)
{
	for (int i = 0; i < N_THR; i++) {
		if (k_current_get() == thread[i]) {
			return i;
		}
	}

	return -1;
}

static void entry(void *arg1, void *arg2, void *arg3)
{
	void *value;
	void *expected_value;

	if (entry_mode == 0) {
		value = (void *)0x42;
		expected_value = value;
		zassert_not_null(value, "thread could not allocate storage");
		zassert_ok(k_thread_setspecific(keys[0], value), "k_thread_setspecific failed");
		zassert_ok(k_thread_getspecific(keys[0], &value));
		zassert_equal(value, expected_value, "set and retrieved values are different");
	}

	if (entry_mode == 1) {
		value = (void *)0x73;
		expected_value = value;
		for (int i = 0; i < N_KEY; i++) {
			zassert_ok(k_thread_setspecific(keys[i], value));
			zassert_ok(k_thread_getspecific(keys[i], &value));
			zassert_equal(value, expected_value);
		}
	}

	if (entry_mode == 3) {
		int value = 42;
		int thread_index = get_thread_index();
		int *const count = &alloc_count[thread_index];

		while (1) {
			BUILD_ASSERT((N_KEY % N_THR == 0) && (N_KEY / N_THR > 0),
				     "N_KEY must be a multiple of N_THR for this test");
			/*
			 * This loop will keep creating and setting thread-specific keys until the
			 * thread hits the limit on how many keys it can set. At that point, the
			 * thread should have CONFIG_THREAD_SPECIFIC_STORAGE_KEYS_MAX / N_THR keys
			 * set, and thus alloc_count should be equal across all threads, which is
			 * verified in the test function. */
			if (*count == N_KEY / N_THR) {
				break;
			}

			if (k_thread_key_create(&keys[thread_index], NULL) < 0) {
				break;
			}
			if (k_thread_setspecific(keys[thread_index], &value) == -ENOMEM) {
				break;
			};
			*count += 1;
		}
	}

	if (entry_mode == 4) {
		for (int i = 0; i < N_KEY; i++) {
			zassert_ok(k_thread_setspecific(keys[i], INT_TO_POINTER(0x42 + i)));
		}
	}

	if (entry_mode == 5) {
		/* hold a value while the key is deleted by the test thread */
		zassert_ok(k_thread_setspecific(keys[0], (void *)0x42));
		k_sem_give(&tss_held);
		k_sem_take(&tss_release, K_FOREVER);
		zassert_equal(k_thread_setspecific(keys[0], (void *)0x73), -EINVAL);
	}

	if (entry_mode == 6) {
		/* a NULL value has no destructor call; the other value's destructor stores again */
		zassert_ok(k_thread_setspecific(keys[0], NULL));
		zassert_ok(k_thread_setspecific(keys[1], (void *)0x42));
	}
}

static void make_key(void)
{
	zassert_ok(k_thread_key_create(&keys[0], NULL), "insufficient memory to create key");
}

static void make_keys(void)
{
	for (int i = 0; i < N_KEY; i++) {
		zassert_ok(k_thread_key_create(&keys[i], NULL),
			   "insufficient memory to create keys");
	}
}

ZTEST_USER(threads_tss, test_key_popspecific)
{
	void *value = NULL;
	k_thread_key_destructor_t dtor = (k_thread_key_destructor_t)0x73;

	zassert_equal(k_thread_popspecific(&keys[0], &value, &dtor), -ENOENT);
	zassert_equal(k_thread_specific_count(), 0);
	zassert_ok(k_thread_key_create(&keys[0], NULL));
	zassert_ok(k_thread_setspecific(keys[0], (void *)0x42));
	zassert_equal(k_thread_specific_count(), 1);
	zassert_ok(k_thread_popspecific(&keys[1], &value, &dtor));
	zassert_equal(k_thread_specific_count(), 0);
	zassert_equal(keys[0], keys[1]);
	zassert_equal(value, (void *)0x42);
	zassert_equal(dtor, NULL);
	zassert_ok(k_thread_key_delete(keys[0]));
}

ZTEST_USER(threads_tss, test_key_1toN_thread)
{
	make_key();

	/* Different threads set different values to same key */
	entry_mode = 0;
	for (int i = 0; i < N_THR; i++) {
		k_thread_start(thread[i]);
	}

	for (int i = 0; i < N_THR; i++) {
		zassert_ok(k_thread_rejoin(thread[i], NULL, K_FOREVER), "failed to join thread %d",
			   i);
	}

	/* At this point, there should be no more thread-specific values associated with key[0] */
	zassert_ok(k_thread_key_delete(keys[0]), "attempt to delete key failed");
}

ZTEST_USER(threads_tss, test_key_Nto1_thread)
{
	make_keys();

	/* Single thread associates its value with different keys */

	entry_mode = 1;
	k_thread_start(thread[0]);
	zassert_ok(k_thread_rejoin(thread[0], NULL, K_FOREVER), "failed to join thread");

	/* At this point, there should be no more thread-specific values associated with any key */
	for (int i = 0; i < N_KEY; i++) {
		zassert_ok(k_thread_key_delete(keys[i]), "attempt to delete keys[%d] failed", i);
	}
}

ZTEST_USER(threads_tss, test_key_resource_leak)
{
	void *key;

	for (size_t i = 0; i < 2 * CONFIG_THREAD_SPECIFIC_STORAGE_KEYS_MAX; ++i) {
		zassert_ok(k_thread_key_create(&key, NULL), "failed to create key %zu", i);
		zassert_ok(k_thread_key_delete(key), "failed to delete key %zu", i);
	}
}

ZTEST_USER(threads_tss, test_correct_key_is_deleted)
{
	size_t j = CONFIG_THREAD_SPECIFIC_STORAGE_KEYS_MAX - 1;

	for (size_t i = 0; i < ARRAY_SIZE(keys); ++i) {
		zassert_ok(k_thread_key_create(&keys[i], NULL), "failed to create key %zu", i);
	}

	void *key = keys[j];
	zassert_ok(k_thread_key_delete(keys[j]));
	zassert_ok(k_thread_key_create(&keys[j], NULL), "failed to create key %zu", j);

	zassert_equal(key, keys[j], "deleted key %p instead of key %p", keys[j], key);

	for (size_t i = 0; i < ARRAY_SIZE(keys); ++i) {
		zassert_ok(k_thread_key_delete(keys[i]), "failed to delete key %zu", i);
	}
}

ZTEST_USER(threads_tss, test_thread_specific_data_allocation)
{
	entry_mode = 3;

	for (int i = 0; i < N_THR; ++i) {
		k_thread_start(thread[i]);
		zassert_ok(k_thread_rejoin(thread[i], NULL, K_FOREVER));
	}

	zassert_equal(alloc_count[0], N_KEY / N_THR);

	for (int i = 1; i < N_THR; ++i) {
		zassert_equal(alloc_count[i - 1], alloc_count[i],
			      "uneven distribution of thread keys. alloc_count[%d]: %d != "
			      "alloc_count[%d]: %d",
			      i, alloc_count[i], i - 1, alloc_count[i - 1]);
	}

	for (int i = 0; i < N_KEY; i++) {
		zassert_ok(k_thread_key_delete(keys[i]));
	}
}

static void tss_dtor(void *value)
{
	TC_PRINT("Thread %p: %s(%p)\n", k_current_get(), __func__, value);
	++dtor_count;
}

static void tss_dtor_store_again(void *value)
{
	++dtor_count;
	(void)k_thread_setspecific(keys[1], value);
}

static void make_keys_with_dtor(void)
{
	for (int i = 0; i < N_KEY; i++) {
		zassert_ok(k_thread_key_create(&keys[i], tss_dtor));
	}
}

ZTEST_USER(threads_tss, test_thread_specific_data_destructor)
{
	/*
	 * In this test, we set thread-specific values in the child thread, but intentionally do not
	 * delete them, in order to verify that they are destroyed via graceful thread termination
	 * with k_thread_exit().
	 */
	make_keys_with_dtor();

	entry_mode = 4;

	for (int i = 0; i < N_THR; ++i) {
		k_thread_start(thread[i]);
		zassert_ok(k_thread_rejoin(thread[i], NULL, K_FOREVER));
	}

	zassert_equal(dtor_count, N_THR * N_KEY,
		      "tss destructor call mismatch. expected: %d, actual: %d", N_THR * N_KEY,
		      dtor_count);

	for (int i = 0; i < N_KEY; i++) {
		zassert_ok(k_thread_key_delete(keys[i]));
	}

	/*
	 * A NULL value gets no destructor call, and a destructor that stores a value again is
	 * called once per pass, CONFIG_THREAD_SPECIFIC_STORAGE_DESTRUCTOR_ITERATIONS times, after
	 * which the thread still exits.
	 */
	zassert_ok(k_thread_key_create(&keys[0], tss_dtor));
	zassert_ok(k_thread_key_create(&keys[1], tss_dtor_store_again));
	dtor_count = 0;
	entry_mode = 6;
	k_thread_start(thread[0]);
	zassert_ok(k_thread_rejoin(thread[0], NULL, K_FOREVER));
	zassert_equal(dtor_count, CONFIG_THREAD_SPECIFIC_STORAGE_DESTRUCTOR_ITERATIONS,
		      "destructor called %d times", dtor_count);
	for (int i = 0; i < N_KEY; i++) {
		zassert_ok(k_thread_key_delete(keys[i]));
	}
}

ZTEST_USER(threads_tss, test_k_thread_key_delete)
{
	void *value = NULL;

	zassert_equal(k_thread_key_delete((void *)0x1), -EINVAL);

	/* deleting a key drops a value another thread still holds, without its destructor */
	zassert_ok(k_thread_key_create(&keys[0], tss_dtor));
	dtor_count = 0;
	entry_mode = 5;
	k_thread_start(thread[0]);
	k_sem_take(&tss_held, K_FOREVER);
	zassert_ok(k_thread_key_delete(keys[0]));
	k_sem_give(&tss_release);
	zassert_ok(k_thread_rejoin(thread[0], NULL, K_FOREVER));
	zassert_equal(dtor_count, 0, "destructor ran for a deleted key");

	/* the calling thread's own value goes the same way, and the slot is free again */
	zassert_ok(k_thread_key_create(&keys[0], tss_dtor));
	zassert_ok(k_thread_setspecific(keys[0], (void *)0x42));
	zassert_ok(k_thread_key_delete(keys[0]));
	zassert_equal(k_thread_getspecific(keys[0], &value), -EINVAL);
	zassert_ok(k_thread_key_create(&keys[1], NULL));
	zassert_equal(keys[0], keys[1]);
	zassert_equal(k_thread_getspecific(keys[1], &value), -EINVAL);
	zassert_ok(k_thread_key_delete(keys[1]));
	zassert_equal(dtor_count, 0);
}

void threads_tss_before(void *arg)
{
	ARG_UNUSED(arg);

	for (int i = 0; i < N_THR; ++i) {
#ifdef CONFIG_USERSPACE
		/* grant ztest_thread permissions on thread[i] */
		k_thread_access_grant(k_current_get(), thread[i], &tss_held, &tss_release);
		k_thread_access_grant(thread[i], &tss_held, &tss_release);
#endif

		/* So statically-defined userspace threads can be restarted with k_thread_start() */
		k_object_init(thread[i]);
		k_thread_create(thread[i], thread_stack[i], CONFIG_ZTEST_STACK_SIZE, entry, NULL,
				NULL, NULL, K_PRIO_PREEMPT(10), K_USER, K_FOREVER);
	}
}

ZTEST_SUITE(threads_tss, NULL, NULL, threads_tss_before, NULL, NULL);
```

## src/test_threads_cancel_abort.c
```c
/*
 * Copyright (c) 2016 Intel Corporation
 *
 * SPDX-License-Identifier: Apache-2.0
 */

#include <zephyr/ztest.h>

#include "tests_thread_apis.h"

static ZTEST_BMEM int execute_flag;

K_SEM_DEFINE(sync_sema, 0, 1);
#define BLOCK_SIZE 64

static void thread_entry(void *p1, void *p2, void *p3)
{
	execute_flag = 1;
	k_msleep(100);
	execute_flag = 2;
}

static void thread_entry_abort(void *p1, void *p2, void *p3)
{
	/**TESTPOINT: abort current thread*/
	execute_flag = 1;
	k_thread_abort(k_current_get());
	CODE_UNREACHABLE;
	/*unreachable*/
	execute_flag = 2;
	zassert_true(1 == 0);
}
/**
 * @brief Verify that a thread can abort itself.
 *
 * @ingroup kernel_thread_tests
 *
 * @details
 * A thread calling k_thread_abort() on itself must not return from the call:
 * it has to terminate at that point. The spawned thread raises a flag, aborts
 * itself, and would raise a second value on the line after the call, so the
 * flag distinguishes "ran and stopped there" from "ran past the abort".
 *
 * Test steps:
 * - Create a user thread that flags that it ran and then aborts itself.
 * - Sleep long enough for it to run.
 * - Read the flag back.
 *
 * Expected result:
 * - The thread ran and stopped inside the abort, never reaching the code
 *   after it.
 *
 * @see k_thread_abort()
 * @verifies ZEP-SRS-1-6
 */
ZTEST_USER(threads_lifecycle, test_thread_abort_self)
{
	execute_flag = 0;
	k_thread_create(&tdata, tstack, STACK_SIZE, thread_entry_abort,
			NULL, NULL, NULL, 0, K_USER, K_NO_WAIT);
	k_msleep(100);
	/**TESTPOINT: spawned thread executed but abort itself*/
	zassert_true(execute_flag == 1);
}

/**
 * @brief Verify that a thread can be aborted by another thread.
 *
 * @ingroup kernel_thread_tests
 *
 * @details
 * Aborting another thread has to work both before that thread has had a
 * chance to run and after it has started, since the two take different paths:
 * one removes a ready thread that was never scheduled, the other terminates
 * one that is already executing. Both are covered here from user mode.
 *
 * Test steps:
 * - Create a user thread and abort it immediately, before it can run.
 * - Sleep past the point it would have run and check its flag.
 * - Create a second user thread, let it start, then abort it.
 *
 * Expected result:
 * - The thread aborted before starting never runs, and the one aborted after
 *   starting is terminated.
 *
 * @see k_thread_abort()
 * @verifies ZEP-SRS-1-6
 */
ZTEST_USER(threads_lifecycle, test_thread_abort_others)
{
	execute_flag = 0;
	k_tid_t tid = k_thread_create(&tdata, tstack, STACK_SIZE,
				      thread_entry, NULL, NULL, NULL,
				      0, K_USER, K_NO_WAIT);

	k_thread_abort(tid);
	k_msleep(100);
	/**TESTPOINT: check not-started thread is aborted*/
	zassert_true(execute_flag == 0);

	tid = k_thread_create(&tdata, tstack, STACK_SIZE,
			      thread_entry, NULL, NULL, NULL,
			      0, K_USER, K_NO_WAIT);
	k_msleep(50);
	k_thread_abort(tid);
	/**TESTPOINT: check running thread is aborted*/
	zassert_true(execute_flag == 1);
	k_msleep(1000);
	zassert_true(execute_flag == 1);
}

/**
 * @brief Verify that aborting an already terminated thread is harmless.
 *
 * @ingroup kernel_thread_tests
 *
 * @details
 * A thread that has already been aborted may still be referenced by code that
 * does not know it is gone, so a second k_thread_abort() on it has to be
 * accepted quietly rather than corrupting the scheduler or faulting.
 *
 * Test steps:
 * - Create a thread and abort it.
 * - Call k_thread_abort() on the same thread again, twice.
 *
 * Expected result:
 * - The repeated aborts complete without error and the system keeps running.
 *
 * @see k_thread_abort()
 * @verifies ZEP-SRS-1-6
 */
ZTEST(threads_lifecycle_1cpu, test_thread_abort_repeat)
{
	execute_flag = 0;
	k_tid_t tid = k_thread_create(&tdata, tstack, STACK_SIZE,
				      thread_entry, NULL, NULL, NULL,
				      0, K_USER, K_NO_WAIT);

	k_thread_abort(tid);
	k_msleep(100);
	k_thread_abort(tid);
	k_msleep(100);
	k_thread_abort(tid);
	/* If no fault occurred till now. The test case passed. */
	ztest_test_pass();
}

static void delayed_thread_entry(void *p1, void *p2, void *p3)
{
	ARG_UNUSED(p1);
	ARG_UNUSED(p2);
	ARG_UNUSED(p3);

	execute_flag = 1;

	zassert_unreachable("Delayed thread shouldn't be executed");
}

/**
 * @ingroup kernel_thread_tests
 * @brief Test abort on delayed thread before it has started
 * execution
 *
 * @details
 * A thread that is still waiting out its start delay is not yet on any ready
 * queue, so aborting it has to cancel the pending start rather than leave a
 * timeout that would launch a dead thread later. Sleeping past the original
 * deadline is what makes a surviving timeout visible.
 *
 * Test steps:
 * - Create a thread with a 100 ms start delay.
 * - Abort it while it is still waiting to start.
 * - Sleep past the original start deadline.
 * - Check the flag the thread would have set had it run.
 *
 * Expected result:
 * - The thread never runs, so its flag stays clear.
 *
 * @see k_thread_abort()
 * @verifies ZEP-SRS-1-6
 */
ZTEST(threads_lifecycle_1cpu, test_thread_abort_delayed)
{
	int current_prio = k_thread_priority_get(k_current_get());

	execute_flag = 0;
	/* Make current thread preemptive */
	k_thread_priority_set(k_current_get(), K_PRIO_PREEMPT(2));

	/* Create a preemptive thread of higher priority than
	 * current thread
	 */
	k_tid_t tid = k_thread_create(&tdata, tstack, STACK_SIZE,
				      delayed_thread_entry, NULL, NULL, NULL,
				      K_PRIO_PREEMPT(1), 0, K_MSEC(100));

	/* Give up CPU */
	k_msleep(50);

	/* Test point: check if thread delayed for 100ms has not started*/
	zassert_true(execute_flag == 0, "Delayed thread created is not"
		     " put to wait queue");

	k_thread_abort(tid);

	/* Sleep past the thread's original 100ms start deadline. A working
	 * abort keeps execute_flag at 0; a broken abort would let the thread
	 * start and set it to 1.
	 */
	k_msleep(100);

	/* Test point: Test abort of thread before its execution*/
	zassert_true(execute_flag == 0, "Delayed thread has executed"
		     " after its start deadline despite being aborted");

	/* Restore the priority */
	k_thread_priority_set(k_current_get(), current_prio);
}

static volatile bool isr_finished;

static void offload_func(const void *param)
{
	struct k_thread *t = (struct k_thread *)param;

	k_thread_abort(t);

	/* Thread memory is unused now, validate that we can clobber it. */
	if (!IS_ENABLED(CONFIG_ARCH_POSIX)) {
		memset(t, 0, sizeof(*t));
	}

	/* k_thread_abort() in an isr shouldn't affect the ISR's execution */
	isr_finished = true;
}

static void entry_abort_isr(void *p1, void *p2, void *p3)
{
	/* Simulate taking an interrupt which kills this thread */
	irq_offload(offload_func, k_current_get());

	printk("shouldn't see this, thread should have been killed");
	ztest_test_fail();
}

extern struct k_sem offload_sem;

/**
 * @brief Verify that a thread can be aborted from an ISR interrupting it.
 *
 * @ingroup kernel_thread_tests
 *
 * @details
 * k_thread_abort() is callable from interrupt context, including on the very
 * thread the ISR interrupted. The kernel has to let the ISR run to completion
 * and only then drop the aborted thread, rather than switching away inside
 * the handler. The ISR sets a flag as its last act, so the test can tell that
 * it finished as well as that the thread died.
 *
 * Test steps:
 * - Spawn a thread that enters an ISR and aborts itself from there.
 * - Join the spawned thread.
 * - Check the flag the ISR sets before returning.
 *
 * Expected result:
 * - The ISR completes and the interrupted thread is terminated.
 *
 * @see k_thread_abort()
 * @see irq_offload()
 * @verifies ZEP-SRS-1-6
 */
ZTEST(threads_lifecycle, test_thread_abort_from_isr)
{
	isr_finished = false;
	k_thread_create(&tdata, tstack, STACK_SIZE, entry_abort_isr,
			NULL, NULL, NULL, 0, 0, K_NO_WAIT);


	k_thread_join(&tdata, K_FOREVER);
	zassert_true(isr_finished, "ISR did not complete");

	/* Thread struct was cleared after the abort, make sure it is
	 * still clear (i.e. that the arch layer didn't write to it
	 * during interrupt exit).  Doesn't work on posix, which needs
	 * the thread struct for its swap code.
	 */
	uint8_t *p = (uint8_t *)&tdata;

	if (!IS_ENABLED(CONFIG_ARCH_POSIX)) {
		for (int i = 0; i < sizeof(tdata); i++) {
			zassert_true(p[i] == 0, "Free memory write to aborted thread");
		}
	}

	/* Notice: Recover back the offload_sem: This is use for releasing
	 * offload_sem which might be held when thread aborts itself in ISR
	 * context, it will cause irq_offload cannot be used again.
	 */
	k_sem_give(&offload_sem);
}

/* use for sync thread start */
static struct k_sem sem_abort;

static void entry_aborted_thread(void *p1, void *p2, void *p3)
{
	k_sem_give(&sem_abort);

	/* wait for being aborted */
	while (1) {
		k_sleep(K_MSEC(1));
	}
	zassert_unreachable("should not reach here");
}

/**
 * @brief Verify that a thread can be aborted from an ISR on another thread.
 *
 * @ingroup kernel_thread_tests
 *
 * @details
 * The counterpart of aborting the interrupted thread: here the ISR runs on
 * the test thread and aborts a different, already running thread. That target
 * may be executing on another CPU or merely be ready, so the abort has to
 * complete from interrupt context without waiting on the target to reach a
 * scheduling point.
 *
 * Test steps:
 * - Spawn a thread and let it start running.
 * - From the test thread, enter an ISR and abort the spawned thread there.
 * - Join the spawned thread and check the flag the ISR sets.
 *
 * Expected result:
 * - The ISR completes and the target thread is terminated.
 *
 * @see k_thread_abort()
 * @see irq_offload()
 * @verifies ZEP-SRS-1-6
 */
ZTEST(threads_lifecycle, test_thread_abort_from_isr_not_self)
{
	k_tid_t tid;

	isr_finished = false;
	k_sem_init(&sem_abort, 0, 1);

	tid = k_thread_create(&tdata, tstack, STACK_SIZE, entry_aborted_thread,
			NULL, NULL, NULL, 0, 0, K_NO_WAIT);

	/* wait for thread started */
	k_sem_take(&sem_abort, K_FOREVER);

	/* Simulate taking an interrupt which kills spawn thread */
	irq_offload(offload_func, (void *)tid);

	zassert_true(isr_finished, "ISR did not complete");
}
```

## src/test_threads_cpu_mask.c
```c
/*
 * Copyright (c) 2019 Intel Corporation
 *
 * SPDX-License-Identifier: Apache-2.0
 */
#include <zephyr/ztest.h>
#include <zephyr/kernel.h>

#include "tests_thread_apis.h"

/* Very simple (and limited) test of the SMP cpu mask API.  Runs on
 * just one CPU.  Creates a thread, sets the CPU mask, starts it,
 * checks if it ran (or didn't run) as expected.
 */

struct k_thread child_thread;

bool child_has_run;

void child_fn(void *a, void *b, void *c)
{
	child_has_run = true;
}


/**
 * @brief Verify that a thread's CPU mask decides whether it can be scheduled.
 *
 * @ingroup kernel_thread_tests
 *
 * @details
 * The affinity APIs may only be applied to a thread that is prevented from
 * running, and the resulting mask decides whether the scheduler may dispatch
 * it at all. Both halves are checked: the calls are first refused on the
 * running caller, then a not-yet-started high priority thread is given each
 * shape of mask in turn and the test observes whether it runs when yielded to.
 * Skipped unless CONFIG_SCHED_CPU_MASK is enabled.
 *
 * Test steps:
 * - Call each mask API on the running thread itself and check the return.
 * - For each pass, create a higher priority thread in the K_FOREVER state and
 *   give it a mask: cleared, all enabled, CPU 0 disabled, or pinned to CPU 0.
 * - Start the thread, yield, and record whether it ran.
 * - Skip the pass that enables more than one CPU when PIN_ONLY is configured.
 *
 * Expected result:
 * - Every mask API returns -EINVAL for the running thread.
 * - The thread runs only for the masks that leave it eligible for this CPU.
 *
 * @see k_thread_cpu_mask_clear()
 * @see k_thread_cpu_mask_enable_all()
 * @see k_thread_cpu_mask_enable()
 * @see k_thread_cpu_mask_disable()
 * @see k_thread_cpu_pin()
 */
ZTEST(threads_lifecycle_1cpu, test_thread_cpu_mask)
{
#ifdef CONFIG_SCHED_CPU_MASK
	k_tid_t thread;
	int ret, pass, prio;

	/* Shouldn't be able to operate on a running thread */
	ret = k_thread_cpu_mask_clear(k_current_get());
	zassert_true(ret == -EINVAL, "");

	ret = k_thread_cpu_mask_enable_all(k_current_get());
	zassert_true(ret == -EINVAL, "");

	ret = k_thread_cpu_mask_enable(k_current_get(), 0);
	zassert_true(ret == -EINVAL, "");

	ret = k_thread_cpu_mask_disable(k_current_get(), 0);
	zassert_true(ret == -EINVAL, "");

	ret = k_thread_cpu_pin(k_current_get(), 0);
	zassert_true(ret == -EINVAL, "");

	for (pass = 0; pass < 4; pass++) {
		if (IS_ENABLED(CONFIG_SCHED_CPU_MASK_PIN_ONLY) && pass == 1) {
			/* Pass 1 enables more than one CPU in the
			 * mask, which is illegal when PIN_ONLY
			 */
			continue;
		}

		child_has_run = false;

		/* Create a thread at a higher priority, don't start
		 * it yet.
		 */
		prio = k_thread_priority_get(k_current_get());
		zassert_true(prio > K_HIGHEST_APPLICATION_THREAD_PRIO, "");
		thread = k_thread_create(&child_thread,
					 tstack, tstack_size,
					 child_fn, NULL, NULL, NULL,
					 K_HIGHEST_APPLICATION_THREAD_PRIO,
					 0, K_FOREVER);

		/* Set up the CPU mask */
		if (pass == 0) {
			ret = k_thread_cpu_mask_clear(thread);
			zassert_true(ret == 0, "");
		} else if (pass == 1) {
			ret = k_thread_cpu_mask_enable_all(thread);
			zassert_true(ret == 0, "");
		} else if (pass == 2) {
			ret = k_thread_cpu_mask_disable(thread, 0);
			zassert_true(ret == 0, "");
		} else {
			ret = k_thread_cpu_mask_enable(thread, 0);
			zassert_true(ret == 0, "");

			ret = k_thread_cpu_pin(thread, 0);
			zassert_true(ret == 0, "");
		}

		/* Start it.  If it is runnable, it will do so
		 * immediately when we yield.  Check to see if it ran.
		 */
		zassert_false(child_has_run, "");
		k_thread_start(thread);
		k_yield();

		if (pass == 1 || pass == 3) {
			zassert_true(child_has_run, "");
		} else {
			zassert_false(child_has_run, "");
		}

		k_thread_abort(thread);
	}
#else
	ztest_test_skip();
#endif
}
```

## src/test_threads_set_priority.c
```c
/*
 * Copyright (c) 2018 Intel Corporation
 *
 * SPDX-License-Identifier: Apache-2.0
 */

#include <zephyr/ztest.h>

#include <zephyr/irq_offload.h>

#include "tests_thread_apis.h"

static int thread2_data;

K_SEM_DEFINE(sem_thread2, 0, 1);
K_SEM_DEFINE(sem_thread1, 0, 1);

/** Arguments passed to the ISR that changes a thread's priority. */
struct isr_arg {
	k_tid_t thread;  /**< Thread whose priority is changed. */
	int     prio;    /**< Priority to set from the ISR. */
};

static struct isr_arg prio_args;

/**
 * @brief Test changing a thread's priority from an ISR
 */
static void test_isr(const void *arg)
{
	const struct isr_arg *data = arg;

	k_thread_priority_set(data->thread, data->prio);
}

/**
 * @brief Test thread behavior when its priority is changed
 */
void thread2_set_prio_test(void *p1, void *p2, void *p3)
{
	ARG_UNUSED(p1);
	ARG_UNUSED(p2);
	ARG_UNUSED(p3);

	/* lower thread2 priority by 5 */
	k_sem_take(&sem_thread2, K_FOREVER);
	thread2_data = k_thread_priority_get(k_current_get());
	k_sem_give(&sem_thread1);

	/* raise thread2 priority by 10 */
	k_sem_take(&sem_thread2, K_FOREVER);
	thread2_data = k_thread_priority_get(k_current_get());
	k_sem_give(&sem_thread1);

	/* restore thread2 priority */
	k_sem_take(&sem_thread2, K_FOREVER);
	thread2_data = k_thread_priority_get(k_current_get());
	k_sem_give(&sem_thread1);
}

/**
 * @brief Verify that a thread's priority can be changed and read back.
 *
 * @ingroup kernel_thread_tests
 *
 * @details
 * k_thread_priority_set() must take effect on both the calling thread and
 * another thread, and the new value has to be what k_thread_priority_get()
 * subsequently reports. The second thread reads its own priority back and
 * hands the result to the test through a semaphore, so what is checked is the
 * priority the scheduler actually recorded rather than the value that was
 * requested.
 *
 * Test steps:
 * - Lower the current thread's own priority and read it back.
 * - Create a second thread and change its priority from the test thread.
 * - Have the second thread read its own priority and report it.
 * - Compare the reported priority against the requested one and join.
 *
 * Expected result:
 * - Both threads report exactly the priorities that were set for them.
 *
 * @see k_thread_priority_set()
 * @see k_thread_priority_get()
 */
ZTEST(threads_lifecycle, test_thread_priority_set)
{
	int rv;
	int prio = k_thread_priority_get(k_current_get());

	/* Lower the priority of the current thread (thread1) */
	k_thread_priority_set(k_current_get(), prio + 2);
	rv = k_thread_priority_get(k_current_get());
	zassert_equal(rv, prio + 2,
			"Expected priority to be changed to %d, not %d\n",
			prio + 2, rv);

	/* Raise the priority of the current thread (thread1) */
	k_thread_priority_set(k_current_get(), prio - 2);
	rv = k_thread_priority_get(k_current_get());
	zassert_equal(rv, prio - 2,
			"Expected priority to be changed to %d, not %d\n",
			prio - 2, rv);

	/* Restore the priority of the current thread (thread1) */
	k_thread_priority_set(k_current_get(), prio);
	rv = k_thread_priority_get(k_current_get());
	zassert_equal(rv, prio,
			"Expected priority to be changed to %d, not %d\n",
			prio, rv);

	/* create thread with lower priority */
	int thread2_prio = prio + 1;

	k_tid_t thread2_id = k_thread_create(&tdata, tstack, STACK_SIZE,
			thread2_set_prio_test,
			NULL, NULL, NULL, thread2_prio, 0,
			K_NO_WAIT);

	/* Lower the priority of thread2 */
	k_thread_priority_set(thread2_id, thread2_prio + 2);
	k_sem_give(&sem_thread2);
	k_sem_take(&sem_thread1, K_FOREVER);
	zassert_equal(thread2_data, thread2_prio + 2,
			"Expected priority to be changed to %d, not %d\n",
			thread2_prio + 2, thread2_data);

	/* Raise the priority of thread2 */
	k_thread_priority_set(thread2_id, thread2_prio - 2);
	k_sem_give(&sem_thread2);
	k_sem_take(&sem_thread1, K_FOREVER);
	zassert_equal(thread2_data, thread2_prio - 2,
			"Expected priority to be changed to %d, not %d\n",
			thread2_prio - 2, thread2_data);

	/* Restore the priority of thread2 */
	k_thread_priority_set(thread2_id, thread2_prio);
	k_sem_give(&sem_thread2);
	k_sem_take(&sem_thread1, K_FOREVER);
	zassert_equal(thread2_data, thread2_prio,
			"Expected priority to be changed to %d, not %d\n",
			thread2_prio, thread2_data);

	k_thread_join(thread2_id, K_FOREVER);
}

/**
 * @brief Verify that a thread's priority can be changed from an ISR.
 *
 * @ingroup kernel_thread_tests
 *
 * @details
 * k_thread_priority_set() is callable from interrupt context, where it must
 * apply the same change without needing to reschedule inside the ISR. The
 * same priority changes as the thread-context case are therefore driven
 * through an offloaded interrupt, and the results are read back afterwards
 * from thread context.
 *
 * Test steps:
 * - Lower the current thread's own priority from an ISR via irq_offload().
 * - Read the priority back and compare it with the requested value.
 * - Change a second thread's priority from an ISR the same way.
 * - Have the second thread report its own priority and compare.
 *
 * Expected result:
 * - Both priority changes made from interrupt context take effect and are
 *   reported back.
 *
 * @see k_thread_priority_set()
 * @see k_thread_priority_get()
 * @see irq_offload()
 */
ZTEST(threads_lifecycle, test_thread_priority_set_from_isr)
{
	int rv;
	int prio = k_thread_priority_get(k_current_get());

	/* Lower the priority of the current thread (thread1) */
	prio_args.thread = k_current_get();
	prio_args.prio = prio + 2;
	irq_offload(test_isr, &prio_args);
	rv = k_thread_priority_get(k_current_get());
	zassert_equal(rv, prio + 2,
			"Expected priority to be changed to %d, not %d\n",
			prio + 2, rv);

	/* Raise the priority of the current thread (thread1) */
	prio_args.prio = prio - 2;
	irq_offload(test_isr, &prio_args);
	rv = k_thread_priority_get(k_current_get());
	zassert_equal(rv, prio - 2,
			"Expected priority to be changed to %d, not %d\n",
			prio - 2, rv);

	/* Restore the priority of the current thread (thread1) */
	prio_args.prio = prio;
	irq_offload(test_isr, &prio_args);
	rv = k_thread_priority_get(k_current_get());
	zassert_equal(rv, prio,
			"Expected priority to be changed to %d, not %d\n",
			prio, rv);

	/* create thread with lower priority */
	int thread2_prio = prio + 1;

	k_tid_t thread2_id = k_thread_create(&tdata, tstack, STACK_SIZE,
			thread2_set_prio_test,
			NULL, NULL, NULL, thread2_prio, 0,
			K_NO_WAIT);

	/* Lower the priority of thread2 */
	prio_args.thread = thread2_id;
	prio_args.prio = thread2_prio + 2;
	irq_offload(test_isr, &prio_args);
	k_sem_give(&sem_thread2);
	k_sem_take(&sem_thread1, K_FOREVER);
	zassert_equal(thread2_data, thread2_prio + 2,
			"Expected priority to be changed to %d, not %d\n",
			thread2_prio + 2, thread2_data);

	/* Raise the priority of thread2 */
	prio_args.prio = thread2_prio - 2;
	irq_offload(test_isr, &prio_args);
	k_sem_give(&sem_thread2);
	k_sem_take(&sem_thread1, K_FOREVER);
	zassert_equal(thread2_data, thread2_prio - 2,
			"Expected priority to be changed to %d, not %d\n",
			thread2_prio - 2, thread2_data);

	/* Restore the priority of thread2 */
	prio_args.prio = thread2_prio;
	irq_offload(test_isr, &prio_args);
	k_sem_give(&sem_thread2);
	k_sem_take(&sem_thread1, K_FOREVER);
	zassert_equal(thread2_data, thread2_prio,
			"Expected priority to be changed to %d, not %d\n",
			thread2_prio, thread2_data);
	k_thread_join(thread2_id, K_FOREVER);
}
```

## src/tests_thread_apis.h
```c
/*
 * Copyright (c) 2019 Jan Van Winkel <jan.van_winkel@dxplore.eu>
 *
 * SPDX-License-Identifier: Apache-2.0
 */

#ifndef ZEPHYR_TESTS_KERNEL_THREADS_THREAD_APIS_SRC_TEST_THREAD_APIS_H_
#define ZEPHYR_TESTS_KERNEL_THREADS_THREAD_APIS_SRC_TEST_THREAD_APIS_H_

#include <zephyr/kernel.h>

#ifdef __cplusplus
extern "C" {
#endif

#define STACK_SIZE (512 + CONFIG_TEST_EXTRA_STACK_SIZE)
K_THREAD_STACK_DECLARE(tstack, STACK_SIZE);
extern size_t tstack_size;
extern struct k_thread tdata;

#ifdef __cplusplus
}
#endif

#endif /* ZEPHYR_TESTS_KERNEL_THREADS_THREAD_APIS_SRC_TEST_THREAD_APIS_H_ */
```
