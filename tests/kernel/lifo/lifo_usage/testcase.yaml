## tests/kernel/lifo/lifo_usage/testcase.yaml
```yaml
tests:
  kernel.lifo.usage:
    # see #26646
    platform_exclude: m2gl025_miv/miv
    tags: kernel
    min_ram: 20
```

## tests/kernel/mbox/mbox_api/boards/qemu_rx_r5f562n8.conf
```kconfig
# Copyright (c) 2024 Tibor Kiss
# SPDX-License-Identifier: Apache-2.0

CONFIG_TEST_EXTRA_STACK_SIZE=128
```

## tests/kernel/mbox/mbox_api/boards/qemu_x86_lakemont.conf
```kconfig
# Copyright (c) 2022 Intel Corporation
# SPDX-License-Identifier: Apache-2.0

# Need a little bit more stack space
# after moving to new ztest API
CONFIG_TEST_EXTRA_STACK_SIZE=64
```

## tests/kernel/mbox/mbox_api/boards/qemu_x86_tiny.conf
```kconfig
# Copyright (c) 2021 Intel Corporation
# SPDX-License-Identifier: Apache-2.0

# Need a little bit more stack space
CONFIG_TEST_EXTRA_STACK_SIZE=256
```

## tests/kernel/mbox/mbox_api/boards/qemu_x86_tiny_ia32_768.conf
```kconfig
# Copyright (c) 2022 Intel Corporation
# SPDX-License-Identifier: Apache-2.0

# Need quite some space for coverage.
CONFIG_TEST_EXTRA_STACK_SIZE=1024
```

## tests/kernel/mbox/mbox_usage/testcase.yaml
```yaml
tests:
  kernel.mailbox.usage:
    tags: kernel mailbox
  kernel.mailbox.usage.linker_generator:
    platform_allow: qemu_cortex_m3
    tags: linker_generator
    extra_configs:
      - CONFIG_CMAKE_LINKER_GENERATOR=y
```

## tests/kernel/mem_heap/k_heap_api/testcase.yaml
```yaml
tests:
  kernel.k_heap_api:
    tags: k_heap_api kernel
  kernel.k_heap_api.linker_generator:
    platform_allow: qemu_cortex_m3
    tags: kernel linker_generator
    extra_configs:
      - CONFIG_CMAKE_LINKER_GENERATOR=y
```

## tests/kernel/mem_heap/mheap_api_concept/testcase.yaml
```yaml
tests:
  kernel.memory_heap:
    tags:
      - kernel
      - memory_heap
    extra_configs:
      - CONFIG_IRQ_OFFLOAD=y
  kernel.memory_heap.no_mt:
    tags:
      - kernel
      - memory_heap
    platform_allow:
      - qemu_cortex_m3
      - qemu_cortex_m0
      - nsim_em
      - nsim_em7d_v22
      - nsim_hs
      - nsim_hs_mpuv6
      - nsim_hs_sram
      - nsim_hs_flash_xip
      - nsim_hs3x_hostlink
      - nsim_hs5x
      - nsim_hs6x
      - qemu_arc_em
      - qemu_arc_hs
      - qemu_arc_hs5x
      - qemu_arc_hs6x
      - qemu_arc_hs6x
      - qemu_arc_hs_xip
      - qemu_riscv32
      - qemu_riscv32e
      - qemu_riscv64
    integration_platforms:
      - qemu_cortex_m3
    extra_configs:
      - CONFIG_MULTITHREADING=n
```

## tests/kernel/mem_heap/shared_multi_heap/testcase.yaml
```yaml
# Copyright 2021 Carlo Caione <ccaione@baylibre.com>
# SPDX-License-Identifier: Apache-2.0

tests:
  kernel.shared_multi_heap:
    platform_allow: qemu_cortex_a53 mps2_an521
    integration_platforms:
      - qemu_cortex_a53
    tags: kernel multi_heap
    harness: ztest
```

## tests/kernel/mem_pool/mem_pool_threadsafe/testcase.yaml
```yaml
tests:
  kernel.memory_pool.threadsafe:
    tags: kernel mem_pool
  kernel.memory_pool.threadsafe.legacy:
    tags: kernel mem_pool
    extra_configs:
      - CONFIG_MEM_POOL_HEAP_BACKEND=n
```

## tests/kernel/mem_pool/test_mpool/testcase.yaml
```yaml
tests:
-   test:
        filter: '( CONFIG_SRAM_SIZE > 32 or CONFIG_DCCM_SIZE
            > 32 or

            CONFIG_RAM_SIZE > 32 )'
        tags: bat_commit core
-   test_nios2:
        arch_whitelist: nios2
        tags: bat_commit core
```

## tests/kernel/mem_pool/test_mpool_options/testcase.yaml
```yaml
tests:
-   test_mpool_split_defrag:
        extra_args: CONF_FILE=prj_split_defrag.conf
        tags: kernel
-   test_mpool_defrag_split:
        extra_args: CONF_FILE=prj_defrag_split.conf
        tags: kernel
-   test_mpool_split_only:
        extra_args: CONF_FILE=prj_split_only.conf
        tags: kernel
```

## tests/kernel/mem_protect/app_memory/testcase.yaml
```yaml
tests:
  kernel.memory_protection:
    arch_whitelist: x86 arm arc
    tags: memory_protection
```

## tests/kernel/mem_protect/demand_paging/boards/qemu_x86_tiny.conf
```kconfig
# Copyright (c) 2021 Intel Corporation
# SPDX-License-Identifier: Apache-2.0

# The test is highly sensitive to size of kernel image.
# However, specifying how many pages used by
# the backing store must be done in build time.
# So here we are, tuning this manually.
CONFIG_BACKING_STORE_RAM_PAGES=14
```

## tests/kernel/mem_protect/demand_paging/mem_map/boards/qemu_cortex_a53_smp.conf
```kconfig
# Copyright (c) 2024 BayLibre SAS
# SPDX-License-Identifier: Apache-2.0

CONFIG_BACKING_STORE_RAM=y
CONFIG_BACKING_STORE_RAM_PAGES=24
CONFIG_SRAM_SIZE=450
CONFIG_DEMAND_PAGING_ALLOW_IRQ=y
```

## tests/kernel/mem_protect/demand_paging/mem_map/boards/qemu_x86_tiny.conf
```kconfig
# Copyright (c) 2021 Intel Corporation
# SPDX-License-Identifier: Apache-2.0

# The test is highly sensitive to size of kernel image.
# However, specifying how many pages used by
# the backing store must be done in build time.
# So here we are, tuning this manually.
CONFIG_BACKING_STORE_RAM_PAGES=10

# The following is needed so that .text and following
# sections are present in physical memory to test
# using backing store for anonymous memory.
CONFIG_KERNEL_VM_BASE=0x0
CONFIG_LINKER_GENERIC_SECTIONS_PRESENT_AT_BOOT=y
CONFIG_BACKING_STORE_RAM=y
CONFIG_BACKING_STORE_QEMU_X86_TINY_FLASH=n
```

## tests/kernel/mem_protect/demand_paging/ondemand_section/testcase.yaml
```yaml
common:
  tags:
    - kernel
    - mmu
    - demand_paging
tests:
  kernel.demand_paging.ondemand_section.arm64_semihost:
    platform_allow:
      - qemu_cortex_a53
    extra_configs:
      - CONFIG_SEMIHOST=y
      - CONFIG_BACKING_STORE_ONDEMAND_SEMIHOST=y
```

## tests/kernel/mem_protect/demand_paging/testcase.yaml
```yaml
common:
  ignore_faults: true
tests:
  kernel.demand_paging:
    tags:
      - kernel
      - mmu
      - demand_paging
    platform_allow: qemu_x86_tiny
    extra_configs:
      - CONFIG_COMMON_LIBC_MALLOC_ARENA_SIZE=0
  kernel.demand_paging.timing_funcs:
    tags:
      - kernel
      - mmu
      - demand_paging
    platform_allow: qemu_x86_tiny
    extra_configs:
      - CONFIG_DEMAND_PAGING_STATS_USING_TIMING_FUNCTIONS=y
      - CONFIG_COMMON_LIBC_MALLOC_ARENA_SIZE=0
```

## tests/kernel/mem_protect/futex/testcase.yaml
```yaml
tests:
  kernel.futex:
    filter: CONFIG_ARCH_HAS_USERSPACE
    arch_exclude:
      - posix
    tags:
      - kernel
      - userspace
```

## tests/kernel/mem_protect/integration/testcase.yaml
```yaml
tests:
  kernel.memory_protection.mem_protect_integration:
    filter: CONFIG_ARCH_HAS_USERSPACE
    tags: kernel userspace
```
