## CMakeLists.txt
```
# SPDX-License-Identifier: Apache-2.0

cmake_minimum_required(VERSION 3.28.0)
find_package(Zephyr REQUIRED HINTS $ENV{ZEPHYR_BASE})
project(mutex_api)

FILE(GLOB app_sources src/*.c)
target_sources(app PRIVATE ${app_sources})
```

## Kconfig
```
# SPDX-License-Identifier: Apache-2.0
# Copyright (c) 2022 Meta

config TEST_MUTEX_API_THREAD_CREATE_TICKS
	int "Wait time (in ticks) after thread creation"
	default 42

config MAX_THREAD_BYTES
	default 5 if USERSPACE

source "Kconfig"
```

## prj.conf
```kconfig
CONFIG_ZTEST=y
CONFIG_IRQ_OFFLOAD=y
CONFIG_TEST_USERSPACE=y
CONFIG_MP_MAX_NUM_CPUS=1
CONFIG_MUTEX_OPTIONS=y
```

## src/main.c
```c
/*
 * Copyright (c) 2016 Intel Corporation
 *
 * SPDX-License-Identifier: Apache-2.0
 */

#include <ztest.h>
extern void test_mutex_lock_unlock(void);
extern void test_mutex_reent_lock_forever(void);
extern void test_mutex_reent_lock_no_wait(void);
extern void test_mutex_reent_lock_timeout_fail(void);
extern void test_mutex_reent_lock_timeout_pass(void);

/*test case main entry*/
void test_main(void)
{
	ztest_test_suite(mutex_api,
			 ztest_unit_test(test_mutex_lock_unlock),
			 ztest_unit_test(test_mutex_reent_lock_forever),
			 ztest_unit_test(test_mutex_reent_lock_no_wait),
			 ztest_unit_test(test_mutex_reent_lock_timeout_fail),
			 ztest_unit_test(test_mutex_reent_lock_timeout_pass)
			 );
	ztest_run_test_suite(mutex_api);
}
```

## src/complex_inversion.c
```c
/*
 * Copyright 2024 by Garmin Ltd. or its subsidiaries.
 *
 * SPDX-License-Identifier: Apache-2.0
 */

/**
 * @file
 * @brief Test complex mutex priority inversion
 *
 * This module demonstrates the kernel's priority inheritance algorithm
 * with two mutexes and four threads, ensuring that boosting priority of
 * a thread waiting on another mutex does not break assumptions of the
 * mutex's waitq, causing the incorrect thread to run or a crash.
 *
 * Sequence for priority inheritance testing:
 *  - thread_08 takes mutex_1
 *  - thread_07 takes mutex_0 then waits on mutex_1
 *  - thread_06 waits on mutex_1
 *  - thread_05 waits on mutex_0, boosting priority of thread_07
 *  - thread_08 gives mutex_1, thread_07 takes mutex_1
 *  - thread_07 gives mutex_1, thread_06 takes mutex_1
 *  - thread_07 gives mutex_0, thread_05 takes mutex_0
 *  - thread_06 gives mutex_1
 *  - thread_05 gives mutex_0
 */

#include <zephyr/tc_util.h>
#include <zephyr/kernel.h>
#include <zephyr/ztest.h>
#include <zephyr/sys/mutex.h>

#define STACKSIZE (512 + CONFIG_TEST_EXTRA_STACK_SIZE)

static ZTEST_DMEM int tc_rc = TC_PASS; /* test case return code */

static K_MUTEX_DEFINE(mutex_0);
static K_MUTEX_DEFINE(mutex_1);

#define PARTICIPANT_THREAD_OPTIONS (K_INHERIT_PERMS)

#define DEFINE_PARTICIPANT_THREAD(id)                                                              \
	static K_THREAD_STACK_DEFINE(thread_##id##_stack_area, STACKSIZE);                         \
	static struct k_thread thread_##id##_thread_data;                                          \
	static k_tid_t thread_##id##_tid;                                                          \
	static K_SEM_DEFINE(thread_##id##_wait, 0, 1);                                             \
	static K_SEM_DEFINE(thread_##id##_done, 0, 1);

#define CREATE_PARTICIPANT_THREAD(id, pri)                                                         \
	thread_##id##_tid = k_thread_create(&thread_##id##_thread_data, thread_##id##_stack_area,  \
					    K_THREAD_STACK_SIZEOF(thread_##id##_stack_area),       \
					    (k_thread_entry_t)thread_##id, &thread_##id##_wait,    \
					    &thread_##id##_done, NULL, pri,                        \
					    PARTICIPANT_THREAD_OPTIONS, K_FOREVER);                \
	k_thread_name_set(thread_##id##_tid, "thread_" STRINGIFY(id));
#define START_PARTICIPANT_THREAD(id) k_thread_start(&(thread_##id##_thread_data));
#define JOIN_PARTICIPANT_THREAD(id)  k_thread_join(&(thread_##id##_thread_data), K_FOREVER);

#define WAIT_FOR_MAIN()                                                                            \
	k_sem_give(done);                                                                          \
	k_sem_take(wait, K_FOREVER);

#define ADVANCE_THREAD(id)                                                                         \
	SIGNAL_THREAD(id);                                                                         \
	WAIT_FOR_THREAD(id);

#define SIGNAL_THREAD(id) k_sem_give(&thread_##id##_wait);

#define WAIT_FOR_THREAD(id) zassert_ok(k_sem_take(&thread_##id##_done, K_MSEC(100)));

/**
 *
 * thread_05 -
 *
 */

static void thread_05(struct k_sem *wait, struct k_sem *done)
{
	int rv;

	/*
	 * Wait for mutex_0, boosting the priority of thread_07 so it will lock mutex_1 first.
	 */

	WAIT_FOR_MAIN();

	rv = k_mutex_lock(&mutex_0, K_FOREVER);
	if (rv != 0) {
		tc_rc = TC_FAIL;
		TC_ERROR("Failed to take mutex %p\n", &mutex_0);
		return;
	}

	WAIT_FOR_MAIN();

	k_mutex_unlock(&mutex_0);
}

/**
 *
 * thread_06 -
 *
 */

static void thread_06(struct k_sem *wait, struct k_sem *done)
{
	int rv;

	/*
	 * Wait for mutex_1. Initially it will be the highest priority waiter, but
	 * thread_07 will be boosted above thread_06 so thread_07 will lock it first.
	 */

	WAIT_FOR_MAIN();

	rv = k_mutex_lock(&mutex_1, K_FOREVER);
	if (rv != 0) {
		tc_rc = TC_FAIL;
		TC_ERROR("Failed to take mutex %p\n", &mutex_1);
		return;
	}

	WAIT_FOR_MAIN();

	k_mutex_unlock(&mutex_1);
}

/**
 *
 * thread_07 -
 *
 */

static void thread_07(struct k_sem *wait, struct k_sem *done)
{
	int rv;

	/*
	 * Lock mutex_0 and wait for mutex_1. After thread_06 is also waiting for
	 * mutex_1, thread_05 will wait for mutex_0, boosting the priority for
	 * thread_07 so it should lock mutex_1 first when it is unlocked by thread_08.
	 */

	WAIT_FOR_MAIN();

	rv = k_mutex_lock(&mutex_0, K_NO_WAIT);
	if (rv != 0) {
		tc_rc = TC_FAIL;
		TC_ERROR("Failed to take mutex %p\n", &mutex_0);
		return;
	}

	WAIT_FOR_MAIN();

	rv = k_mutex_lock(&mutex_1, K_FOREVER);
	if (rv != 0) {
		tc_rc = TC_FAIL;
		TC_ERROR("Failed to take mutex %p\n", &mutex_1);
		k_mutex_unlock(&mutex_0);
		return;
	}

	WAIT_FOR_MAIN();

	k_mutex_unlock(&mutex_1);
	k_mutex_unlock(&mutex_0);
}

/**
 *
 * thread_08 -
 *
 */

static void thread_08(struct k_sem *wait, struct k_sem *done)
{
	int rv;

	/*
	 * Lock mutex_1 and hold until priority has been boosted on thread_07
	 * to ensure that thread_07 is the first to lock mutex_1 when thread_08
	 * unlocks it.
	 */

	WAIT_FOR_MAIN();

	rv = k_mutex_lock(&mutex_1, K_NO_WAIT);
	if (rv != 0) {
		tc_rc = TC_FAIL;
		TC_ERROR("Failed to take mutex %p\n", &mutex_1);
		return;
	}

	WAIT_FOR_MAIN();

	k_mutex_unlock(&mutex_1);
}

DEFINE_PARTICIPANT_THREAD(05);
DEFINE_PARTICIPANT_THREAD(06);
DEFINE_PARTICIPANT_THREAD(07);
DEFINE_PARTICIPANT_THREAD(08);

static void create_participant_threads(void)
{
	CREATE_PARTICIPANT_THREAD(05, 5);
	CREATE_PARTICIPANT_THREAD(06, 6);
	CREATE_PARTICIPANT_THREAD(07, 7);
	CREATE_PARTICIPANT_THREAD(08, 8);
}

static void start_participant_threads(void)
{
	START_PARTICIPANT_THREAD(05);
	START_PARTICIPANT_THREAD(06);
	START_PARTICIPANT_THREAD(07);
	START_PARTICIPANT_THREAD(08);
}

static void join_participant_threads(void)
{
	JOIN_PARTICIPANT_THREAD(05);
	JOIN_PARTICIPANT_THREAD(06);
	JOIN_PARTICIPANT_THREAD(07);
	JOIN_PARTICIPANT_THREAD(08);
}

/**
 *
 * @brief Main thread to test mutex locking
 *
 * This thread orchestrates mutex locking on other threads and verifies that
 * the correct thread is holding mutexes at any given step.
 *
 * @verifies ZEP-SRS-6-1
 * @verifies ZEP-SRS-6-12
 */

ZTEST(mutex_api, test_complex_inversion)
{
	create_participant_threads();
	start_participant_threads();

	/* Wait for all the threads to start up */
	WAIT_FOR_THREAD(08);
	WAIT_FOR_THREAD(07);
	WAIT_FOR_THREAD(06);
	WAIT_FOR_THREAD(05);

	ADVANCE_THREAD(08); /* thread_08 takes mutex_1 */
	zassert_equal(thread_08_tid, mutex_1.owner, "expected owner %s, not %s\n",
		      thread_08_tid->name, mutex_1.owner->name);

	ADVANCE_THREAD(07); /* thread_07 takes mutex_0 */
	zassert_equal(thread_07_tid, mutex_0.owner, "expected owner %s, not %s\n",
		      thread_07_tid->name, mutex_0.owner->name);

	SIGNAL_THREAD(07);    /* thread_07 waits on mutex_1 */
	k_sleep(K_MSEC(100)); /* Give thread_07 some time to wait on mutex_1 */

	SIGNAL_THREAD(06);    /* thread_06 waits on mutex_1 */
	k_sleep(K_MSEC(100)); /* Give thread_06 some time to wait on mutex_1 */

	SIGNAL_THREAD(05); /* thread_05 waits on mutex_0, boosting priority of thread_07 */

	SIGNAL_THREAD(08); /* thread_08 gives mutex_1 */

	/* If thread_06 erroneously took mutex_1, giving it could cause a crash
	 * when CONFIG_WAITQ_SCALABLE is set. Give it a chance to run to make sure
	 * this crash isn't hit.
	 */
	SIGNAL_THREAD(06);

	WAIT_FOR_THREAD(07); /* thread_07 takes mutex_1 */
	zassert_equal(thread_07_tid, mutex_1.owner, "expected owner %s, not %s\n",
		      thread_07_tid->name, mutex_1.owner->name);

	SIGNAL_THREAD(07);   /* thread_07 gives mutex_1 then gives mutex_0 */
	WAIT_FOR_THREAD(06); /* thread_06 takes mutex_1 */
	WAIT_FOR_THREAD(05); /* thread_05 takes mutex_0 */
	zassert_equal(thread_06_tid, mutex_1.owner, "expected owner %s, not %s\n",
		      thread_06_tid->name, mutex_1.owner->name);
	zassert_equal(thread_05_tid, mutex_0.owner, "expected owner %s, not %s\n",
		      thread_05_tid->name, mutex_0.owner->name);

	SIGNAL_THREAD(06); /* thread_06 gives mutex_1 */
	SIGNAL_THREAD(05); /* thread_05 gives mutex_0 */

	zassert_equal(tc_rc, TC_PASS);

	join_participant_threads();
}
```

## src/priority_set_with_mutex.c
```c
/*
 * Copyright 2024 by Garmin Ltd. or its subsidiaries.
 *
 * SPDX-License-Identifier: Apache-2.0
 */

#include <zephyr/kernel.h>
#include <zephyr/ztest.h>

#define STACK_SIZE (512 + CONFIG_TEST_EXTRA_STACK_SIZE)

#define PRIO_HIGH K_PRIO_PREEMPT(1)
#define PRIO_MID  K_PRIO_PREEMPT(3)
#define PRIO_LOW  K_PRIO_PREEMPT(5)

#if Z_MUTEX_PI_ENABLED
static struct k_mutex mutex;
static K_THREAD_STACK_DEFINE(stack_high, STACK_SIZE);
static struct k_thread t_high;
static K_SEM_DEFINE(sem_waiter_started, 0, 1);

static void t_waiter(void *p1, void *p2, void *p3)
{
	struct k_mutex *m = p1;

	ARG_UNUSED(p2);
	ARG_UNUSED(p3);

	k_sem_give(&sem_waiter_started);
	k_mutex_lock(m, K_FOREVER);
	k_mutex_unlock(m);
}
#endif /* Z_MUTEX_PI_ENABLED */

/**
 * Verify that changing a mutex owner's base priority does not drop an active
 * priority-inheritance boost, and that unlock restores the new base priority.
 */
ZTEST(mutex_api, test_priority_set_with_mutex_locked)
{
#if Z_MUTEX_PI_ENABLED
	int original_priority = k_thread_priority_get(k_current_get());
	int priority_after_waiter;
	int priority_after_set;
	int priority_after_unlock;
	int attempt;

	k_sem_reset(&sem_waiter_started);
	k_mutex_init(&mutex);
	k_thread_priority_set(k_current_get(), PRIO_LOW);
	k_mutex_lock(&mutex, K_FOREVER);

	k_thread_create(&t_high, stack_high, STACK_SIZE, t_waiter, &mutex, NULL, NULL,
			PRIO_HIGH, 0, K_NO_WAIT);
	k_sem_take(&sem_waiter_started, K_FOREVER);

	/* Wait until the waiter blocks on the mutex and boosts its owner. */
	for (attempt = 0; attempt < 100; attempt++) {
		if (k_thread_priority_get(k_current_get()) == PRIO_HIGH) {
			break;
		}
		k_sleep(K_MSEC(1));
	}
	priority_after_waiter = k_thread_priority_get(k_current_get());

	/* Updating the base priority must not override the active PI boost. */
	k_thread_priority_set(k_current_get(), PRIO_MID);
	priority_after_set = k_thread_priority_get(k_current_get());

	k_mutex_unlock(&mutex);
	priority_after_unlock = k_thread_priority_get(k_current_get());

	k_thread_join(&t_high, K_FOREVER);
	k_thread_priority_set(k_current_get(), original_priority);

	zassert_equal(priority_after_waiter, PRIO_HIGH,
		      "Expected PI boost to %d, got %d", PRIO_HIGH,
		      priority_after_waiter);
	zassert_equal(priority_after_set, PRIO_HIGH,
		      "Expected PI boost to remain %d after priority_set, got %d",
		      PRIO_HIGH, priority_after_set);
	zassert_equal(priority_after_unlock, PRIO_MID,
		      "Expected priority to restore to %d after unlock, got %d",
		      PRIO_MID, priority_after_unlock);
#else
	ztest_test_skip();
#endif /* Z_MUTEX_PI_ENABLED */
}
```

## src/test_mutex_apis.c
```c
/*
 * Copyright (c) 2016 Intel Corporation
 *
 * SPDX-License-Identifier: Apache-2.0
 */
#include <zephyr/ztest.h>

#define TIMEOUT 500
#define STACK_SIZE (512 + CONFIG_TEST_EXTRA_STACK_SIZE)
#define THREAD_HIGH_PRIORITY 1
#define THREAD_MID_PRIORITY 3
#define THREAD_LOW_PRIORITY 5

/** @cond INTERNAL_HIDDEN */
/* use to pass case type to threads */
static ZTEST_DMEM int case_type;
static ZTEST_DMEM int thread_ret = TC_FAIL;

/* TESTPOINT: init via K_MUTEX_DEFINE */
K_MUTEX_DEFINE(kmutex);
/* only used by test_mutex_define, never re-initialized at run time */
K_MUTEX_DEFINE(kmutex_define);
static struct k_mutex tmutex;

static K_THREAD_STACK_DEFINE(tstack, STACK_SIZE);
static K_THREAD_STACK_DEFINE(tstack2, STACK_SIZE);
static K_THREAD_STACK_DEFINE(tstack3, STACK_SIZE);
static struct k_thread tdata;
static struct k_thread tdata2;
static struct k_thread tdata3;
/** @endcond */



/**
 * @defgroup kernel_mutex_tests Mutexes
 * @ingroup all_tests
 * @{
 * @}
 */

static void tThread_entry_lock_forever(void *p1, void *p2, void *p3)
{
	zassert_false(k_mutex_lock((struct k_mutex *)p1, K_FOREVER) == 0,
		      "access locked resource from spawn thread");
	/* should not hit here */
}

static void tThread_entry_lock_no_wait(void *p1, void *p2, void *p3)
{
	zassert_true(k_mutex_lock((struct k_mutex *)p1, K_NO_WAIT) != 0);
	TC_PRINT("bypass locked resource from spawn thread\n");
}

static void tThread_entry_lock_timeout_fail(void *p1, void *p2, void *p3)
{
	zassert_true(k_mutex_lock((struct k_mutex *)p1,
				  K_MSEC(TIMEOUT - 100)) != 0, NULL);
	TC_PRINT("bypass locked resource from spawn thread\n");
}

static void tThread_entry_lock_timeout_pass(void *p1, void *p2, void *p3)
{
	zassert_true(k_mutex_lock((struct k_mutex *)p1,
				  K_MSEC(TIMEOUT + 100)) == 0, NULL);
	TC_PRINT("access resource from spawn thread\n");
	k_mutex_unlock((struct k_mutex *)p1);
}

static void tmutex_test_lock(struct k_mutex *pmutex,
			     void (*entry_fn)(void *, void *, void *))
{
	k_mutex_init(pmutex);
	k_thread_create(&tdata, tstack, STACK_SIZE,
			entry_fn, pmutex, NULL, NULL,
			K_PRIO_PREEMPT(0),
			K_USER | K_INHERIT_PERMS, K_NO_WAIT);
	zassert_true(k_mutex_lock(pmutex, K_FOREVER) == 0);
	TC_PRINT("access resource from main thread\n");

	/* wait for spawn thread to take action */
	k_msleep(TIMEOUT);
}

static void tmutex_test_lock_timeout(struct k_mutex *pmutex,
				     void (*entry_fn)(void *, void *, void *))
{
	/**TESTPOINT: test k_mutex_init mutex*/
	k_mutex_init(pmutex);
	k_thread_create(&tdata, tstack, STACK_SIZE,
			entry_fn, pmutex, NULL, NULL,
			K_PRIO_PREEMPT(0),
			K_USER | K_INHERIT_PERMS, K_NO_WAIT);
	zassert_true(k_mutex_lock(pmutex, K_FOREVER) == 0);
	TC_PRINT("access resource from main thread\n");

	/* wait for spawn thread to take action */
	k_msleep(TIMEOUT);
	k_mutex_unlock(pmutex);
	k_msleep(TIMEOUT);

}

static void tmutex_test_lock_unlock(struct k_mutex *pmutex)
{
	k_mutex_init(pmutex);
	zassert_true(k_mutex_lock(pmutex, K_FOREVER) == 0,
		     "fail to lock K_FOREVER");
	k_mutex_unlock(pmutex);
	zassert_true(k_mutex_lock(pmutex, K_NO_WAIT) == 0,
		     "fail to lock K_NO_WAIT");
	k_mutex_unlock(pmutex);
	zassert_true(k_mutex_lock(pmutex, K_MSEC(TIMEOUT)) == 0,
		     "fail to lock TIMEOUT");
	k_mutex_unlock(pmutex);
}

static void tThread_T1_priority_inheritance(void *p1, void *p2, void *p3)
{
	ARG_UNUSED(p3);

	/* t1 will get mutex first */
	zassert_true(k_mutex_lock((struct k_mutex *)p1, K_FOREVER) == 0,
		      "access locked resource from spawn thread T1");

	/* record its original priority */
	int priority_origin = k_thread_priority_get((k_tid_t)p2);

	/* wait for a time period to see if priority inheritance happened */
	k_sleep(K_MSEC(500));

	int priority = k_thread_priority_get((k_tid_t)p2);

	if (case_type == 1) {
		zassert_equal(priority, THREAD_HIGH_PRIORITY,
			"priority inheritance not happened!");

		k_mutex_unlock((struct k_mutex *)p1);

		/* check if priority set back to original one */
		priority = k_thread_priority_get((k_tid_t)p2);

		zassert_equal(priority, priority_origin,
			"priority inheritance adjust back not happened!");
	} else if (case_type == 2) {
		zassert_equal(priority, priority_origin,
			"priority inheritance should not be happened!");

		/* wait for t2 timeout to get mutex*/
		k_sleep(K_MSEC(TIMEOUT));

		k_mutex_unlock((struct k_mutex *)p1);
	} else if (case_type == 3) {
		zassert_equal(priority, THREAD_HIGH_PRIORITY,
			"priority inheritance not happened!");

		/* wait for t2 timeout to get mutex*/
		k_sleep(K_MSEC(TIMEOUT));

		k_mutex_unlock((struct k_mutex *)p1);
	} else {
		zassert_true(0, "should not be here!");
	}
}

static void tThread_T2_priority_inheritance(void *p1, void *p2, void *p3)
{
	ARG_UNUSED(p2);
	ARG_UNUSED(p3);

	if (case_type == 1) {
		zassert_true(k_mutex_lock((struct k_mutex *)p1, K_FOREVER) == 0,
		      "access locked resource from spawn thread T2");

		k_mutex_unlock((struct k_mutex *)p1);
	} else if (case_type == 2 || case_type == 3) {
		zassert_false(k_mutex_lock((struct k_mutex *)p1,
				K_MSEC(100)) == 0,
				"T2 should not get the resource");
	} else {
		zassert_true(0, "should not be here!");
	}
}

static void tThread_lock_with_time_period(void *p1, void *p2, void *p3)
{
	ARG_UNUSED(p2);
	ARG_UNUSED(p3);

	zassert_true(k_mutex_lock((struct k_mutex *)p1, K_FOREVER) == 0,
		      "access locked resource from spawn thread");

	/* This thread will hold mutex for 600 ms, then release it */
	k_sleep(K_MSEC(TIMEOUT + 100));

	k_mutex_unlock((struct k_mutex *)p1);
}

static void tThread_waiter(void *p1, void *p2, void *p3)
{
	ARG_UNUSED(p2);
	ARG_UNUSED(p3);

	/* This thread participates in recursive locking tests */
	/* Wait for mutex to be released */
	zassert_true(k_mutex_lock((struct k_mutex *)p1, K_FOREVER) == 0,
			"Failed to get the test_mutex");

	/* keep the next waiter waiting for a while */
	thread_ret = TC_PASS;
	k_mutex_unlock((struct k_mutex *)p1);
}

/*test cases*/
/**
 * @brief Verify a mutex defined at compile time is ready for use.
 *
 * @details
 * A mutex created with K_MUTEX_DEFINE() must be fully initialized at boot:
 * unowned and immediately lockable without any run-time initialization
 * call. The mutex used here is touched by no other test, so it is
 * exercised exactly as the macro left it.
 *
 * Test steps:
 * - Lock the statically defined mutex with K_NO_WAIT.
 * - Unlock it.
 *
 * Expected result:
 * - Both operations succeed without any prior k_mutex_init() call.
 *
 * @ingroup kernel_mutex_tests
 * @see K_MUTEX_DEFINE
 * @verifies ZEP-SRS-6-2
 */
ZTEST(mutex_api, test_mutex_define)
{
	/* usable at boot without any run-time initialization */
	zassert_equal(k_mutex_lock(&kmutex_define, K_NO_WAIT), 0);
	zassert_equal(k_mutex_unlock(&kmutex_define), 0);
}

/**
 * @brief Verify run-time initialization of a mutex.
 *
 * @details
 * k_mutex_init() must succeed and yield an unowned mutex that is
 * immediately lockable.
 *
 * Test steps:
 * - Initialize a mutex at run time and check the call succeeds.
 * - Lock it with K_NO_WAIT and unlock it.
 *
 * Expected result:
 * - Initialization returns 0 and the mutex is immediately usable.
 *
 * @ingroup kernel_mutex_tests
 * @see k_mutex_init()
 * @verifies ZEP-SRS-6-3
 */
ZTEST(mutex_api, test_mutex_init)
{
	zassert_equal(k_mutex_init(&tmutex), 0);
	zassert_equal(k_mutex_lock(&tmutex, K_NO_WAIT), 0);
	zassert_equal(k_mutex_unlock(&tmutex), 0);
}

/**
 * @brief Verify reentrant locking with a waiter blocking forever.
 *
 * @details
 * A thread holds the mutex while a second thread blocks on it with K_FOREVER;
 * the waiter acquires the mutex once it is released. Exercised on both a
 * run-time initialized mutex and a compile-time K_MUTEX_DEFINE() mutex.
 *
 * @ingroup kernel_mutex_tests
 * @see k_mutex_init()
 * @see k_mutex_lock()
 * @see k_mutex_unlock()
 * @verifies ZEP-SRS-6-1
 * @verifies ZEP-SRS-6-6
 */
ZTEST_USER(mutex_api_1cpu, test_mutex_reent_lock_forever)
{
	/**TESTPOINT: test k_mutex_init mutex*/
	k_mutex_init(&tmutex);
	tmutex_test_lock(&tmutex, tThread_entry_lock_forever);
	k_thread_abort(&tdata);
	k_mutex_unlock(&tmutex);

	/**TESTPOINT: test K_MUTEX_DEFINE mutex*/
	tmutex_test_lock(&kmutex, tThread_entry_lock_forever);
	k_thread_abort(&tdata);
	k_mutex_unlock(&kmutex);
}

/**
 * @brief Verify locking a held mutex with K_NO_WAIT fails immediately.
 *
 * @details
 * While the mutex is held by another thread, a K_NO_WAIT lock attempt must
 * return without blocking. Exercised on a run-time and a K_MUTEX_DEFINE() mutex.
 *
 * @ingroup kernel_mutex_tests
 * @see k_mutex_lock()
 * @see k_mutex_unlock()
 * @verifies ZEP-SRS-6-1
 * @verifies ZEP-SRS-6-6
 */
ZTEST_USER(mutex_api, test_mutex_reent_lock_no_wait)
{
	/**TESTPOINT: test k_mutex_init mutex*/
	tmutex_test_lock(&tmutex, tThread_entry_lock_no_wait);
	k_mutex_unlock(&tmutex);

	/**TESTPOINT: test K_MUTEX_DEFINE mutex*/
	tmutex_test_lock(&kmutex, tThread_entry_lock_no_wait);
	k_mutex_unlock(&kmutex);
}

/**
 * @brief Verify locking a held mutex with a finite timeout times out.
 *
 * @details
 * While the mutex is held, a lock attempt with a finite timeout must fail once
 * the timeout elapses without the mutex being released.
 *
 * @ingroup kernel_mutex_tests
 * @see k_mutex_lock()
 * @see k_mutex_unlock()
 * @verifies ZEP-SRS-6-1
 * @verifies ZEP-SRS-6-7
 * @verifies ZEP-SRS-6-8
 */
ZTEST_USER(mutex_api, test_mutex_reent_lock_timeout_fail)
{
	/**TESTPOINT: test k_mutex_init mutex*/
	tmutex_test_lock_timeout(&tmutex, tThread_entry_lock_timeout_fail);

	/**TESTPOINT: test K_MUTEX_DEFINE mutex*/
	tmutex_test_lock_timeout(&kmutex, tThread_entry_lock_no_wait);
}

/**
 * @brief Verify a timed lock succeeds once the mutex is released in time.
 *
 * @details
 * A lock attempt with a finite timeout must succeed when the holding thread
 * releases the mutex before the timeout elapses.
 *
 * @ingroup kernel_mutex_tests
 * @see k_mutex_lock()
 * @see k_mutex_unlock()
 * @verifies ZEP-SRS-6-1
 * @verifies ZEP-SRS-6-7
 */
ZTEST_USER(mutex_api_1cpu, test_mutex_reent_lock_timeout_pass)
{
	/**TESTPOINT: test k_mutex_init mutex*/
	tmutex_test_lock_timeout(&tmutex, tThread_entry_lock_timeout_pass);

	/**TESTPOINT: test K_MUTEX_DEFINE mutex*/
	tmutex_test_lock_timeout(&kmutex, tThread_entry_lock_no_wait);
}

/**
 * @brief Verify basic mutex lock and unlock.
 *
 * @details
 * Lock and then unlock the mutex from a single thread and confirm the
 * operations succeed, on both a run-time initialized mutex and a compile-time
 * K_MUTEX_DEFINE() mutex.
 *
 * @ingroup kernel_mutex_tests
 * @see k_mutex_init()
 * @see k_mutex_lock()
 * @see k_mutex_unlock()
 * @verifies ZEP-SRS-6-4
 * @verifies ZEP-SRS-6-5
 * @verifies ZEP-SRS-6-10
 */
ZTEST_USER(mutex_api_1cpu, test_mutex_lock_unlock)
{
	/**TESTPOINT: test k_mutex_init mutex*/
	tmutex_test_lock_unlock(&tmutex);

	/**TESTPOINT: test K_MUTEX_DEFINE mutex*/
	tmutex_test_lock_unlock(&kmutex);
}

/**
 * @brief Test recursive mutex
 * @details To verify that getting a lock of a mutex already locked will
 * succeed and waiters will be unblocked only when the number of locks
 * reaches zero.
 * @ingroup kernel_mutex_tests
 * @verifies ZEP-SRS-6-1
 * @verifies ZEP-SRS-6-9
 */
ZTEST_USER(mutex_api, test_mutex_recursive)
{
	k_mutex_init(&tmutex);

	/**TESTPOINT: when mutex has no owner, we cannot unlock it */
	zassert_true(k_mutex_unlock(&tmutex) == -EINVAL,
			"fail: mutex has no owner");

	zassert_true(k_mutex_lock(&tmutex, K_NO_WAIT) == 0,
			"Failed to lock mutex");

	/**TESTPOINT: lock the mutex recursively */
	zassert_true(k_mutex_lock(&tmutex, K_NO_WAIT) == 0,
		"Failed to recursively lock mutex");

	thread_ret = TC_FAIL;
	/* Spawn a waiter thread */
	k_thread_create(&tdata3, tstack3, STACK_SIZE,
			tThread_waiter, &tmutex, NULL, NULL,
			K_PRIO_PREEMPT(12),
			K_USER | K_INHERIT_PERMS, K_NO_WAIT);

	zassert_true(thread_ret == TC_FAIL,
		"waiter thread should block on the recursively locked mutex");

	zassert_true(k_mutex_unlock(&tmutex) == 0, "fail to unlock");

	/**TESTPOINT: unlock the mutex recursively */
	zassert_true(thread_ret == TC_FAIL,
		"waiter thread should still block on the locked mutex");

	zassert_true(k_mutex_unlock(&tmutex) == 0, "fail to unlock");

	/* Give thread_waiter a chance to get the mutex */
	k_sleep(K_MSEC(1));

	/**TESTPOINT: waiter thread got the mutex */
	zassert_true(thread_ret == TC_PASS,
			"waiter thread can't take the mutex");
}

/**
 * @brief Test mutex's priority inheritance mechanism
 * @details To verify mutex provide priority inheritance to prevent priority
 * inversion, and there are 3 cases need to run.
 * The thread T1 hold the mutex first and cases list as below:
 * - case 1. When priority T2 > T1, priority inheritance happened.
 * - case 2. When priority T1 > T2, priority inheritance won't happened.
 * - case 3. When priority T2 > T3 > T1, priority inheritance happened but T2
 *   wait for timeout and T3 got the mutex.
 * @ingroup kernel_mutex_tests
 * @verifies ZEP-SRS-6-1
 * @verifies ZEP-SRS-6-11
 * @verifies ZEP-SRS-6-12
 */
ZTEST_USER(mutex_api_1cpu, test_mutex_priority_inheritance)
{
	/**TESTPOINT: run test case 1, given priority T1 < T2 */
	k_mutex_init(&tmutex);

	/* we told thread which case runs now */
	case_type = 1;

	/* spawn a lower priority thread t1 for holding the mutex */
	k_thread_create(&tdata, tstack, STACK_SIZE,
		tThread_T1_priority_inheritance,
			&tmutex, &tdata, NULL,
			K_PRIO_PREEMPT(THREAD_LOW_PRIORITY),
			K_USER | K_INHERIT_PERMS, K_NO_WAIT);

	/* wait for spawn thread t1 to take action */
	k_msleep(TIMEOUT);

	/**TESTPOINT: The current thread does not own the mutex.*/
	zassert_true(k_mutex_unlock(&tmutex) == -EPERM,
			"fail: current thread does not own the mutex");

	/* spawn a higher priority thread t2 for holding the mutex */
	k_thread_create(&tdata2, tstack2, STACK_SIZE,
		tThread_T2_priority_inheritance,
			&tmutex, &tdata2, NULL,
			K_PRIO_PREEMPT(THREAD_HIGH_PRIORITY),
			K_USER | K_INHERIT_PERMS, K_NO_WAIT);

	/* wait for spawn thread t2 to take action */
	k_msleep(TIMEOUT+1000);

	/**TESTPOINT: run test case 2, given priority T1 > T2, this means
	 * priority inheritance won't happen.
	 */
	k_mutex_init(&tmutex);
	case_type = 2;

	/* spawn a lower priority thread t1 for holding the mutex */
	k_thread_create(&tdata, tstack, STACK_SIZE,
		tThread_T1_priority_inheritance,
			&tmutex, &tdata, NULL,
			K_PRIO_PREEMPT(THREAD_HIGH_PRIORITY),
			K_USER | K_INHERIT_PERMS, K_NO_WAIT);

	/* wait for spawn thread t1 to take action */
	k_msleep(TIMEOUT);

	/* spawn a higher priority thread t2 for holding the mutex */
	k_thread_create(&tdata2, tstack2, STACK_SIZE,
		tThread_T2_priority_inheritance,
			&tmutex, &tdata2, NULL,
			K_PRIO_PREEMPT(THREAD_LOW_PRIORITY),
			K_USER | K_INHERIT_PERMS, K_NO_WAIT);

	/* wait for spawn thread t2 to take action */
	k_msleep(TIMEOUT+1000);

	/**TESTPOINT: run test case 3, given priority T1 < T3 < T2, but t2 do
	 * not get mutex due to timeout.
	 */
	k_mutex_init(&tmutex);
	case_type = 3;

	/* spawn a lower priority thread t1 for holding the mutex */
	k_thread_create(&tdata, tstack, STACK_SIZE,
		tThread_T1_priority_inheritance,
			&tmutex, &tdata, NULL,
			K_PRIO_PREEMPT(THREAD_LOW_PRIORITY),
			K_USER | K_INHERIT_PERMS, K_NO_WAIT);

	/* wait for spawn thread t1 to take action */
	k_msleep(TIMEOUT);

	/* spawn a higher priority thread t2 for holding the mutex */
	k_thread_create(&tdata2, tstack2, STACK_SIZE,
		tThread_T2_priority_inheritance,
			&tmutex, &tdata2, NULL,
			K_PRIO_PREEMPT(THREAD_HIGH_PRIORITY),
			K_USER | K_INHERIT_PERMS, K_NO_WAIT);

	/* spawn a higher priority thread t3 for holding the mutex */
	k_thread_create(&tdata3, tstack3, STACK_SIZE,
		tThread_lock_with_time_period,
			&tmutex, &tdata3, NULL,
			K_PRIO_PREEMPT(THREAD_MID_PRIORITY),
			K_USER | K_INHERIT_PERMS, K_NO_WAIT);

	/* wait for spawn thread t2 and t3 to take action */
	k_msleep(TIMEOUT+1000);
}

static void tThread_mutex_lock_should_fail(void *p1, void *p2, void *p3)
{
	struct k_mutex *mutex = (struct k_mutex *)p1;
	k_timeout_t timeout = *(k_timeout_t *)p2;

	zassert_equal(-EAGAIN, k_mutex_lock(mutex, timeout), NULL);
}

/**
 * @brief Test fix for subtle race during priority inversion
 *
 * - A low priority thread (Tlow) locks mutex A.
 * - A high priority thread (Thigh) blocks on mutex A, boosting the priority
 *   of Tlow.
 * - Thigh times out waiting for mutex A.
 * - Before Thigh has a chance to execute, Tlow unlocks mutex A (which now
 *   has no owner) and drops its own priority.
 * - Thigh now gets a chance to execute and finds that it timed out, and
 *   then enters the block of code to lower the priority of the thread that
 *   owns mutex A (now nobody).
 * - Thigh tries to the dereference the owner of mutex A (which is nobody,
 *   and thus it is NULL). This leads to an exception.
 *
 * @ingroup kernel_mutex_tests
 *
 * @see k_mutex_lock()
 * @verifies ZEP-SRS-6-7
 * @verifies ZEP-SRS-6-12
 */
ZTEST(mutex_api_1cpu, test_mutex_timeout_race_during_priority_inversion)
{
	const int low_prio = 2, helper_prio = 1, high_prio = 0;

	static ZTEST_DMEM k_timeout_t timeout;

	k_mutex_init(&tmutex);

	/* Set our priority to the "low" value so the thread can preempt us */
	k_thread_priority_set(k_current_get(), low_prio);

	timeout = K_TIMEOUT_ABS_TICKS(k_uptime_ticks()
		+ CONFIG_TEST_MUTEX_API_THREAD_CREATE_TICKS);

	k_mutex_lock(&tmutex, K_FOREVER);

	/* This thread will run immediately, preempt us, and boost our priority */
	k_thread_create(&tdata, tstack, K_THREAD_STACK_SIZEOF(tstack),
			tThread_mutex_lock_should_fail, &tmutex, &timeout, NULL, helper_prio,
			K_USER | K_INHERIT_PERMS, K_NO_WAIT);

	/* Now we wait for the same absolute timeout the thread is
	 * blocked on, so we wake up simultaneously.  But further
	 * boost our own priority so that we wake up first, creating
	 * the situation where the target thread sees both a timeout
	 * and an unlocked mutex simultaneously.
	 */
	k_thread_priority_set(k_current_get(), high_prio);
	k_sleep(timeout);

	k_mutex_unlock(&tmutex);
}

static void *mutex_api_tests_setup(void)
{
#ifdef CONFIG_USERSPACE
	k_thread_access_grant(k_current_get(), &tdata, &tstack, &tdata2,
				&tstack2, &tdata3, &tstack3, &kmutex,
				&tmutex);
#endif
	return NULL;
}

ZTEST_SUITE(mutex_api, NULL, mutex_api_tests_setup, NULL, NULL, NULL);
ZTEST_SUITE(mutex_api_1cpu, NULL, mutex_api_tests_setup,
			ztest_simple_1cpu_before, ztest_simple_1cpu_after, NULL);
```
