## tests/kernel/mem_slab/mslab_concept/testcase.yaml
```yaml
tests:
  kernel.memory_slabs.concept:
    tags: kernel
    timeout: 80
  kernel.memory_slabs.concept.linker_generator:
    platform_allow: qemu_cortex_m3
    tags: linker_generator
    extra_configs:
      - CONFIG_CMAKE_LINKER_GENERATOR=y
```

## tests/kernel/mem_slab/mslab_threadsafe/testcase.yaml
```yaml
tests:
  kernel.memory_slabs.threadsafe:
    tags: kernel
  kernel.memory_slabs.threadsafe.linker_generator:
    platform_allow: qemu_cortex_m3
    tags: kernel linker_generator
    extra_configs:
      - CONFIG_CMAKE_LINKER_GENERATOR=y
```

## tests/kernel/mem_slab_ref/mslab_ref/testcase.yaml
```yaml
tests:
  kernel.memory_slabs_ref:
    tags:
      - kernel
      - memory_slabs_ref
```

## tests/kernel/mp/Kconfig
```kconfig
# Copyright (c) 2023 Intel Corporation
#
# SPDX-License-Identifier: Apache-2.0

# Must have this on where available, otherwise the linker will place
# the shared variables in cached/incoherent memory.
config KERNEL_COHERENCE
	bool
	default y if ARCH_HAS_COHERENCE

source "Kconfig.zephyr"
```

## tests/kernel/mp/testcase.yaml
```yaml
tests:
  kernel.multiprocessing:
    tags:
      - kernel
      - smp
    filter: CONFIG_MP_MAX_NUM_CPUS > 1
    depends_on:
      - smp
```

## tests/kernel/msgq/msgq_api/Kconfig
```kconfig
# Copyright (c) 2024
# SPDX-License-Identifier: Apache-2.0

config TEST_MSGQ_PUT_FRONT
	bool "Test message queue put front feature"
	default n

# Include Zephyr's Kconfig.
source "Kconfig"
```

## tests/kernel/msgq/msgq_api/testcase.yaml
```yaml
tests:
  kernel.message_queue:
    tags:
      - kernel
      - userspace
  kernel.message_queue.prepend:
    tags:
      - kernel
      - userspace
    extra_configs:
      - CONFIG_TEST_MSGQ_PREPEND=y
```

## tests/kernel/msgq/msgq_usage/testcase.yaml
```yaml
tests:
  kernel.message_queue.usage:
    min_ram: 24
    tags:
      - kernel
      - message queue
```

## tests/kernel/multiprocessing/cpu_mask/Kconfig
```kconfig
# Copyright (c) 2024 Intel Corporation
# SPDX-License-Identifier: Apache-2.0

mainmenu "SMP CPU mask test"

source "Kconfig.zephyr"
```

## tests/kernel/multiprocessing/mp/Kconfig
```kconfig
# Copyright (c) 2023 Intel Corporation
#
# SPDX-License-Identifier: Apache-2.0

# Must have this on where available, otherwise the linker will place
# the shared variables in cached/incoherent memory.
config KERNEL_COHERENCE
	bool
	default y if CACHE_CAN_SAY_MEM_COHERENCE

source "Kconfig.zephyr"
```

## tests/kernel/multiprocessing/smp/boards/rpi_zero_2w.conf
```kconfig
CONFIG_BOOT_DELAY=200

CONFIG_MP_MAX_NUM_CPUS=4
CONFIG_PM_CPU_OPS=y
CONFIG_PM_CPU_OPS_SPINTABLE=y

# The suite assumes threads default to "runnable on any cpu" so it can
# observe migration. CONFIG_SCHED_CPU_MASK_PIN_ONLY makes the default
# cpu_mask = 1 (cpu 0 only), which traps every spawned thread on cpu 0
# and turns all the cross-cpu tests into single-core failures. Leave
# SCHED_CPU_MASK off here.

# arch_cpu_start uses sys_cache_data_flush_range to publish
# arm64_cpu_boot_params to the parked secondary core; without
# CACHE_MANAGEMENT the flush is a no-op and the secondary's voting
# loop in reset.S never sees the new mpid, so cpu 0 hangs in wfe.
# Explicit here because the ztest build has no peripheral driver
# whose Kconfig select would pull it in.
CONFIG_CACHE_MANAGEMENT=y

CONFIG_SMP_TEST_RUN_FACTOR=100
CONFIG_SMP_IPI_NUM_ITERS=20
```

## tests/kernel/multiprocessing/smp_suspend/Kconfig
```kconfig
# Copyright (c) 2024 Intel Corporation
# SPDX-License-Identifier: Apache-2.0

mainmenu "SMP suspend test"

source "Kconfig.zephyr"

config SMP_TEST_RELAX
	int "A delay to compensate for spinlock bias induced by arch_spin_relax"
	default 16
```

## tests/kernel/mutex/mutex_api/testcase.yaml
```yaml
tests:
  kernel.mutex:
    tags:
      - kernel
      - userspace
      - pearl_gecko
```

## tests/kernel/mutex/mutex_error_case/testcase.yaml
```yaml
tests:
  kernel.mutex.error:
    filter: CONFIG_USERSPACE
    arch_exclude:
      - posix
    tags:
      - kernel
      - userspace
      - mutex
    ignore_faults: true
```

## tests/kernel/mutex/sys_mutex/testcase.yaml
```yaml
tests:
  kernel.mutex.system:
    filter: CONFIG_ARCH_HAS_USERSPACE
    arch_exclude:
      - posix
    tags:
      - kernel
      - userspace
      - mutex
  kernel.mutex.system.nouser:
    tags:
      - kernel
      - mutex
    extra_configs:
      - CONFIG_TEST_USERSPACE=n
```

## tests/kernel/obj_core/obj_core_stats/testcase.yaml
```yaml
tests:
  kernel.obj_core.stats:
    tags: kernel
    ignore_faults: true
    integration_platforms:
      - qemu_x86
    platform_exclude:
      - qemu_x86_tiny
      - qemu_x86_tiny/ia32/768
```

## tests/kernel/obj_core/obj_core_stats_api/testcase.yaml
```yaml
tests:
  kernel.obj_core.stats.api:
    tags: kernel
    ignore_faults: true
    integration_platforms:
      - qemu_x86/atom
    platform_exclude:
      - qemu_x86_tiny/atom
      - qemu_x86_tiny/ia32/768
```

## tests/kernel/obj_tracking/testcase.yaml
```yaml
tests:
  kernel.objects.tracking:
    tags: kernel
    platform_exclude: qemu_x86_tiny
  kernel.objects.tracking.minimallibc:
    filter: CONFIG_MINIMAL_LIBC_SUPPORTED
    tags: kernel libc
    platform_exclude: qemu_x86_tiny
    extra_configs:
      - CONFIG_MINIMAL_LIBC=y
```
