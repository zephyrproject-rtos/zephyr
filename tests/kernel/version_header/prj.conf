## prj.conf
```kconfig
# nothing here
CONFIG_ZTEST=y
CONFIG_VERSION_HEADER=y
```

## src/main.c
```c
/*
 * Copyright (c) 2016 Intel Corporation.
 *
 * SPDX-License-Identifier: Apache-2.0
 */

#include <zephyr.h>
#include <ztest.h>
#include <misc/printk.h>
#include "version.h" /* generated by MAKE, at compile time */
#include <version_header.h>

void test_version(void)
{
#if CONFIG_VERSION_HEADER
	zassert_true(version_header.major ==
		     KERNEL_VERSION_MAJOR, "major version mismatch");
	zassert_true(version_header.minor ==
		     KERNEL_VERSION_MINOR, "minor version mismatch");
	zassert_true(version_header.patch
		     == KERNEL_PATCHLEVEL, "patchlevel version match");
#endif
}

void test_main(void)
{
	ztest_test_suite(test_version_header,
			 ztest_unit_test(test_version)
			 );
	ztest_run_test_suite(test_version_header);
}
```
