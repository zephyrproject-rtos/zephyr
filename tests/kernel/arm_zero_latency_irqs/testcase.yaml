## tests/kernel/arm_zero_latency_irqs/testcase.yaml
```yaml
tests:
  arch.zero_latency_interrupts:
    filter: CONFIG_ARMV7_M_ARMV8_M_MAINLINE
    tags: arm interrupt
    arch_whitelist: arm
```

## tests/kernel/boot_page_table/testcase.yaml
```yaml
tests:
  kernel.memory_protection:
    platform_whitelist: qemu_x86
    tags: mmu
```

## tests/kernel/cache/testcase.yaml
```yaml
tests:
  kernel.cache.api:
    tags:
      - kernel
      - cache
    filter: CONFIG_CACHE_MANAGEMENT
    platform_exclude:
      - bcm958402m2/bcm58402/m7
      - bcm958401m2
    integration_platforms:
      - qemu_xtensa
      - qemu_cortex_a53
      - nsim/nsim_em
      - qemu_x86
      - qemu_x86_64
  kernel.cache.api.minimallibc:
    tags:
      - kernel
      - cache
      - libc
    filter: CONFIG_CACHE_MANAGEMENT and CONFIG_MINIMAL_LIBC_SUPPORTED
    platform_exclude:
      - bcm958402m2/bcm58402/m7
      - bcm958401m2
    integration_platforms:
      - qemu_xtensa
      - qemu_cortex_a53
      - nsim/nsim_em
      - qemu_x86
      - qemu_x86_64
    extra_configs:
      - CONFIG_MINIMAL_LIBC=y
```

## tests/kernel/cleanup/testcase.yaml
```yaml
tests:
  kernel.cleanup.api:
    tags:
      - kernel
    toolchain_allow: gcc
    platform_allow:
      - native_sim
```

## tests/kernel/common/testcase.yaml
```yaml
common:
  tags:
    - base
    - kernel
    - userspace
  min_flash: 32
  min_ram: 32
  timeout: 120
tests:
  kernel.common: {}
  kernel.common.tls:
    # ARCMWDT can't handle THREAD_LOCAL_STORAGE with USERSPACE, see #52570 for details
    filter: >
      CONFIG_ARCH_HAS_THREAD_LOCAL_STORAGE and CONFIG_TOOLCHAIN_SUPPORTS_THREAD_LOCAL_STORAGE
      and not (CONFIG_TOOLCHAIN_ARCMWDT_SUPPORTS_THREAD_LOCAL_STORAGE and CONFIG_USERSPACE)
    extra_configs:
      - CONFIG_THREAD_LOCAL_STORAGE=y
  kernel.common.misra:
    platform_key:
      - arch
    # Some configurations are known-incompliant and won't build
    filter: not ((CONFIG_I2C or CONFIG_SPI) and CONFIG_USERSPACE)
    integration_platforms:
      - native_sim
    extra_configs:
      - CONFIG_MISRA_SANE=y
  kernel.common.minimallibc:
    platform_key:
      - arch
    filter: CONFIG_MINIMAL_LIBC_SUPPORTED
    tags: libc
    extra_configs:
      - CONFIG_MINIMAL_LIBC=y
    integration_platforms:
      - qemu_x86
      - mps2/an385
  kernel.common.nano32:
    platform_key:
      - arch
    tags:
      - nano
    filter: not CONFIG_KERNEL_COHERENCE
    extra_configs:
      - CONFIG_CBPRINTF_NANO=y
      - CONFIG_CBPRINTF_REDUCED_INTEGRAL=y
    integration_platforms:
      - qemu_x86
      - mps2/an385
  kernel.common.nano64:
    platform_key:
      - arch
    tags:
      - nano
    filter: not CONFIG_KERNEL_COHERENCE
    extra_configs:
      - CONFIG_CBPRINTF_NANO=y
      - CONFIG_CBPRINTF_FULL_INTEGRAL=y
    integration_platforms:
      - qemu_x86
      - mps2/an385
  kernel.common.picolibc:
    platform_key:
      - arch
    filter: CONFIG_PICOLIBC_SUPPORTED
    tags: picolibc
    extra_configs:
      - CONFIG_PICOLIBC=y
    integration_platforms:
      - qemu_x86
      - mps2/an385
  kernel.common.lto:
    platform_key:
      - arch
    # CONFIG_CODE_DATA_RELOCATION causes a build error (issue #69730)
    filter: CONFIG_ISR_TABLES_LOCAL_DECLARATION_SUPPORTED and not CONFIG_CODE_DATA_RELOCATION
    tags: lto
    extra_configs:
      - CONFIG_TEST_USERSPACE=n
      - CONFIG_ISR_TABLES_LOCAL_DECLARATION=y
      - CONFIG_LTO=y
    integration_platforms:
      - qemu_x86
      - mps2/an385
```

## tests/kernel/condvar/condvar_api/Kconfig
```kconfig
# Copyright (c) The Zephyr Project Contributors
# SPDX-License-Identifier: Apache-2.0

config MAX_THREAD_BYTES
	default 3 if USERSPACE && SMP

# Include Zephyr's Kconfig.
source "Kconfig.zephyr"
```

## tests/kernel/condvar/condvar_api/testcase.yaml
```yaml
tests:
  kernel.condvar:
    ignore_faults: true
    tags: kernel userspace condition_variables
```

## tests/kernel/context/Kconfig
```kconfig
# Copyright (c) 2024 Nordic Semiconductor ASA
# SPDX-License-Identifier: Apache-2.0

config MAX_IDLE_WAKES
	int "Maximum number of spurious wakes during k_cpu_idle() test"
	default 1 if NRF53_SYNC_RTC
	default 1 if RENESAS_RX_TIMER_CMT
	default 1 if INTEL_ADSP_SIM
	default 0
	help
	  The platform may have some component running in the background while the k_cpu_idle test is
	  running causing the CPU to awake. With this option we allow for a maximum number of wakes
	  for each 10ms idle test, which by default should be 0. The RX CMT driver uses a 16-bit
	  counter that cannot span more than one tick, so it has to schedule multi-tick timeouts in
	  stages and delivers an intermediate tick announcement before the requested deadline.
	  The Intel ADSP simulator may encounter an edge condition (which does not occur
	  on hardware) that permits it to harmlessly wake 1 tick early, reset the timer,
	  and then continue normally.


# Include Zephyr's Kconfig
source "Kconfig"
```

## tests/kernel/context/boards/apollo510_eb.conf
```kconfig
# Copyright (c) 2025 Ambiq Micro Inc. <www.ambiq.com>
# SPDX-License-Identifier: Apache-2.0
CONFIG_PM=n
CONFIG_UART_INTERRUPT_DRIVEN=n
```

## tests/kernel/context/boards/apollo510_evb.conf
```kconfig
# Copyright (c) 2025 Ambiq Micro Inc. <www.ambiq.com>
# SPDX-License-Identifier: Apache-2.0
CONFIG_PM=n
CONFIG_PM_DEVICE=n
```

## tests/kernel/context/boards/da1469x_dk_pro.conf
```kconfig
# Disable power management to prevent sleep code interfering
# with time critical tests.
CONFIG_PM=n
```

## tests/kernel/context/testcase.yaml
```yaml
common:
  # The k_cpu_idle test cannot tolerate background wake-ups from the
  # NRU eviction algorithm's periodic pulse.
  filter: not CONFIG_EVICTION_NRU

tests:
  kernel.context:
    tags: kernel
    extra_configs:
      - CONFIG_TEST_EXTRA_STACK_SIZE=1024
    min_ram: 16
  kernel.context.minimallibc:
    filter: CONFIG_MINIMAL_LIBC_SUPPORTED
    tags:
      - kernel
      - libc
    extra_configs:
      - CONFIG_TEST_EXTRA_STACK_SIZE=1024
      - CONFIG_MINIMAL_LIBC=y
    min_ram: 16
  linker.linker_generator:
    platform_allow: qemu_cortex_m3
    tags:
      - kernel
      - linker_generator
    extra_configs:
      - CONFIG_CMAKE_LINKER_GENERATOR=y
      - CONFIG_TEST_EXTRA_STACK_SIZE=1024
```

## tests/kernel/critical/testcase.yaml
```yaml
common:
  tags: kernel

tests:
  kernel.critical:
    platform_exclude: nsim_sem_mpu_stack_guard nsim_em_mpu_stack_guard
    filter: not CONFIG_WDT_SAM
  kernel.critical.sam:
    filter: CONFIG_WDT_SAM
    extra_configs:
     - CONFIG_WDT_DISABLE_AT_BOOT=y
  kernel.critical.nsim:
    platform_whitelist: nsim_sem_mpu_stack_guard nsim_em_mpu_stack_guard
    extra_configs:
      - CONFIG_TEST_HW_STACK_PROTECTION=n
```

## tests/kernel/device/basic/testcase.yaml
```yaml
common:
  tags: device userspace
tests:
  kernel.device:
    tags: device
    platform_whitelist: native_posix native_posix_64 qemu_x86
  kernel.device.pm:
    tags: device
    extra_configs:
      - CONFIG_DEVICE_POWER_MANAGEMENT=y
    platform_whitelist: native_posix native_posix_64 qemu_x86
```

## tests/kernel/device/control/testcase.yaml
```yaml
common:
  tags: device userspace
tests:
  kernel.device_control:
    tags: device
    platform_whitelist: native_posix native_posix_64 qemu_x86
  kernel.device_control.no_concurrent:
    tags: device
    extra_configs:
      - CONFIG_DEVICE_CONCURRENT_ACCESS=n
    platform_whitelist: native_posix native_posix_64 qemu_x86
```

## tests/kernel/device/dts/bindings/fakedeferdriver.yml
```yaml
# Copyright (c) 2023 Intel Corporation
# SPDX-License-Identifier: Apache-2.0

description: Properties for fake deferred driver.

compatible: "fakedeferdriver"

include: base.yaml
```

## tests/kernel/device/dts/bindings/fakedomain.yaml
```yaml
# Copyright (c) 2023, CSIRO
# SPDX-License-Identifier: Apache-2.0

description: Properties for fake power domain

compatible: "fakedomain"

include: base.yaml
```

## tests/kernel/device/testcase.yaml
```yaml
common:
  tags:
    - device
    - kernel
    - userspace
tests:
  kernel.device:
    integration_platforms:
      - native_sim
    platform_exclude: xenvm
  kernel.device.minimallibc:
    integration_platforms:
      - native_sim
    filter: CONFIG_MINIMAL_LIBC_SUPPORTED
    tags:
      - libc
    extra_configs:
      - CONFIG_MINIMAL_LIBC=y
    platform_exclude: xenvm
  kernel.device.pm:
    integration_platforms:
      - native_sim
    platform_exclude: mec15xxevb_assy6853 xenvm
    extra_configs:
      - CONFIG_PM_DEVICE=y
  kernel.device.linker_generator:
    platform_allow:
      - qemu_cortex_m3
    tags:
      - linker_generator
    extra_configs:
      - CONFIG_CMAKE_LINKER_GENERATOR=y
```

## tests/kernel/device_new/testcase.yaml
```yaml
# SPDX-License-Identifier: Apache-2.0

common:
  tags: device
  integration_platforms:
    - native_posix
tests:
  kernel.device.api:
    tags: kernel device multi api
    platform_exclude: beaglev_starlight_jh7100 mec15xxevb_assy6853
```

## tests/kernel/early_sleep/testcase.yaml
```yaml
tests:
  kernel.common.sleep:
    tags: kernel sleep
  kernel.common.sleep.linker_generator:
    platform_allow: qemu_cortex_m3
    tags: linker_generator
    extra_configs:
      - CONFIG_CMAKE_LINKER_GENERATOR=y
```

## tests/kernel/errno/testcase.yaml
```yaml
common:
  arch_exclude: xtensa
  min_ram: 32
  tags: kernel
tests:
  kernel.common.errno:
    tags: kernel
  kernel.common.errno.newlib:
    platform_exclude: qemu_x86_64
    extra_configs:
      - CONFIG_NEWLIB_LIBC=y
```

## tests/kernel/events/sys_event/testcase.yaml
```yaml
tests:
  kernel.events.usage:
    filter: CONFIG_ARCH_HAS_USERSPACE
    arch_exclude:
      - posix
    tags:
      - kernel
      - userspace
    ignore_faults: true
```
