## CMakeLists.txt
```
# SPDX-License-Identifier: Apache-2.0

cmake_minimum_required(VERSION 3.28.0)
find_package(Zephyr REQUIRED HINTS $ENV{ZEPHYR_BASE})
project(fifo_api)

FILE(GLOB app_sources src/*.c)
target_sources(app PRIVATE ${app_sources})
```

## prj.conf
```kconfig
CONFIG_ZTEST=y
CONFIG_IRQ_OFFLOAD=y
CONFIG_ZTEST_NEW_API=y
```

## prj_poll.conf
```kconfig
CONFIG_ZTEST=y
CONFIG_IRQ_OFFLOAD=y
CONFIG_POLL=y
```

## src/main.c
```c
/*
 * Copyright (c) 2016 Intel Corporation
 *
 * SPDX-License-Identifier: Apache-2.0
 */

/**
 * @brief Tests for the FIFO kernel object
 *
 * Verify the Zephyr FIFO APIs across thread and ISR contexts, including data
 * passing, emptiness queries, cancellation, timeouts and queueing order.
 *
 * - API coverage
 *   -# k_fifo_init() K_FIFO_DEFINE()
 *   -# k_fifo_put() k_fifo_put_list() k_fifo_put_slist()
 *   -# k_fifo_get() k_fifo_is_empty() k_fifo_cancel_wait()
 *
 * @defgroup tests_kernel_fifo FIFO tests
 * @ingroup all_tests
 * @{
 * @}
 */

#include <zephyr/ztest.h>

ZTEST_SUITE(fifo_api, NULL, NULL, NULL, NULL, NULL);

ZTEST_SUITE(fifo_api_1cpu, NULL, NULL,
		ztest_simple_1cpu_before, ztest_simple_1cpu_after, NULL);
```

## src/test_fifo.h
```c
/*
 * Copyright (c) 2017 Intel Corporation.
 *
 * SPDX-License-Identifier: Apache-2.0
 */

#ifndef __TEST_FIFO_H__
#define __TEST_FIFO_H__

#include <zephyr/ztest.h>
#include <zephyr/irq_offload.h>

typedef struct fdata {
	sys_snode_t snode;
	uint32_t data;
} fdata_t;
#endif
```

## src/test_fifo_cancel.c
```c
/*
 * Copyright (c) 2017 Linaro Limited
 *
 * SPDX-License-Identifier: Apache-2.0
 */

#include "test_fifo.h"

#define STACK_SIZE (512 + CONFIG_TEST_EXTRA_STACK_SIZE)
#define LIST_LEN 2
/**TESTPOINT: init via K_FIFO_DEFINE*/
K_FIFO_DEFINE(kfifo_c);

struct k_fifo fifo_c;

static K_THREAD_STACK_DEFINE(tstack_cancel, STACK_SIZE);
static struct k_thread thread;

static void t_cancel_wait_entry(void *p1, void *p2, void *p3)
{
	k_sleep(K_MSEC(50));
	k_fifo_cancel_wait((struct k_fifo *)p1);
}

static void tfifo_thread_thread(struct k_fifo *pfifo)
{
	k_tid_t tid = k_thread_create(&thread, tstack_cancel, STACK_SIZE,
				      t_cancel_wait_entry, pfifo, NULL, NULL,
				      K_PRIO_PREEMPT(0), 0, K_NO_WAIT);
	uint32_t start_t = k_uptime_get_32();
	void *ret = k_fifo_get(pfifo, K_MSEC(500));
	uint32_t dur = k_uptime_get_32() - start_t;

	/* While we observed the side effect of the last statement
	 * ( call to k_fifo_cancel_wait) of the thread, it's not fact
	 * that it returned, within the thread. Then it may happen
	 * that the test runner below will try to create another
	 * thread in the same stack space, then 1st thread returns
	 * from the call, leading to crash.
	 */
	k_thread_abort(tid);
	zassert_is_null(ret,
			"k_fifo_get didn't get 'timeout expired' status");
	/* 80 includes generous fuzz factor as k_sleep() will add an extra
	 * tick for non-tickless systems, and we may cross another tick
	 * boundary while doing this. We just want to ensure we didn't
	 * hit the timeout anyway.
	 */
	zassert_true(dur < 80,
		     "k_fifo_get didn't get cancelled in expected timeframe");
}

/**
 * @addtogroup tests_kernel_fifo
 * @{
 */

/**
 * @brief Verify k_fifo_cancel_wait() wakes a pending getter with NULL.
 *
 * @details
 * A thread blocked in k_fifo_get() with a long timeout must return immediately
 * with NULL when another thread calls k_fifo_cancel_wait() on that FIFO, rather
 * than waiting for its own timeout to expire. The test confirms both the NULL
 * return and that it happened well before the 500 ms get timeout.
 *
 * Test steps:
 * - Start a helper thread that sleeps briefly then calls k_fifo_cancel_wait().
 * - In the main thread, call k_fifo_get() with a 500 ms timeout and time it.
 * - Verify the get returned NULL and far sooner than its timeout.
 * - Repeat for a statically defined FIFO.
 *
 * Expected result:
 * - k_fifo_get() returns NULL promptly due to the cancel, not the timeout.
 *
 * @see k_fifo_cancel_wait()
 * @see k_fifo_get()
 * @verifies ZEP-SRS-24-2
 */
ZTEST(fifo_api_1cpu, test_fifo_cancel_wait)
{
	/**TESTPOINT: init via k_fifo_init*/
	k_fifo_init(&fifo_c);
	tfifo_thread_thread(&fifo_c);

	/**TESTPOINT: test K_FIFO_DEFINEed fifo*/
	tfifo_thread_thread(&kfifo_c);
}

/**
 * @}
 */
```

## src/test_fifo_contexts.c
```c
/*
 * Copyright (c) 2016 Intel Corporation
 *
 * SPDX-License-Identifier: Apache-2.0
 */

#include "test_fifo.h"

#define STACK_SIZE (512 + CONFIG_TEST_EXTRA_STACK_SIZE)
#define LIST_LEN 2
/**TESTPOINT: init via K_FIFO_DEFINE*/
K_FIFO_DEFINE(kfifo);

struct k_fifo fifo;
static fdata_t data[LIST_LEN];
static fdata_t data_l[LIST_LEN];
static fdata_t data_sl[LIST_LEN];

static K_THREAD_STACK_DEFINE(tstack_contexts, STACK_SIZE);
static struct k_thread tdata;
static struct k_sem end_sema;

static void tfifo_put(struct k_fifo *pfifo)
{
	for (int i = 0; i < LIST_LEN; i++) {
		/**TESTPOINT: fifo put*/
		k_fifo_put(pfifo, (void *)&data[i]);
	}

	/**TESTPOINT: fifo put list*/
	static fdata_t *head = &data_l[0], *tail = &data_l[LIST_LEN - 1];

	head->snode.next = (sys_snode_t *)tail;
	tail->snode.next = NULL;
	k_fifo_put_list(pfifo, (uint32_t *)head, (uint32_t *)tail);

	/**TESTPOINT: fifo put slist*/
	sys_slist_t slist;

	sys_slist_init(&slist);
	sys_slist_append(&slist, (sys_snode_t *)&(data_sl[0].snode));
	sys_slist_append(&slist, (sys_snode_t *)&(data_sl[1].snode));
	k_fifo_put_slist(pfifo, &slist);
}

static void tfifo_get(struct k_fifo *pfifo)
{
	void *rx_data;

	/*get fifo data from "fifo_put"*/
	for (int i = 0; i < LIST_LEN; i++) {
		/**TESTPOINT: fifo get*/
		rx_data = k_fifo_get(pfifo, K_NO_WAIT);
		zassert_equal(rx_data, (void *)&data[i]);
	}
	/*get fifo data from "fifo_put_list"*/
	for (int i = 0; i < LIST_LEN; i++) {
		rx_data = k_fifo_get(pfifo, K_NO_WAIT);
		zassert_equal(rx_data, (void *)&data_l[i]);
	}
	/*get fifo data from "fifo_put_slist"*/
	for (int i = 0; i < LIST_LEN; i++) {
		rx_data = k_fifo_get(pfifo, K_NO_WAIT);
		zassert_equal(rx_data, (void *)&data_sl[i]);
	}
}

/*entry of contexts*/
static void tIsr_entry_put(const void *p)
{
	tfifo_put((struct k_fifo *)p);
	zassert_false(k_fifo_is_empty((struct k_fifo *)p));
}

static void tIsr_entry_get(const void *p)
{
	tfifo_get((struct k_fifo *)p);
	zassert_true(k_fifo_is_empty((struct k_fifo *)p));
}

static void tThread_entry(void *p1, void *p2, void *p3)
{
	tfifo_get((struct k_fifo *)p1);
	k_sem_give(&end_sema);
}

static void tfifo_thread_thread(struct k_fifo *pfifo)
{
	k_sem_init(&end_sema, 0, 1);
	/**TESTPOINT: thread-thread data passing via fifo*/
	k_tid_t tid = k_thread_create(&tdata, tstack_contexts, STACK_SIZE,
				      tThread_entry, pfifo, NULL, NULL,
				      K_PRIO_PREEMPT(0), 0, K_NO_WAIT);
	tfifo_put(pfifo);
	k_sem_take(&end_sema, K_FOREVER);
	k_thread_abort(tid);
}

static void tfifo_thread_isr(struct k_fifo *pfifo)
{
	k_sem_init(&end_sema, 0, 1);
	/**TESTPOINT: isr-thread data passing via fifo*/
	irq_offload(tIsr_entry_put, (const void *)pfifo);
	tfifo_get(pfifo);
}

static void tfifo_isr_thread(struct k_fifo *pfifo)
{
	k_sem_init(&end_sema, 0, 1);
	/**TESTPOINT: thread-isr data passing via fifo*/
	tfifo_put(pfifo);
	irq_offload(tIsr_entry_get, (const void *)pfifo);
}

static void tfifo_is_empty(void *p)
{
	struct k_fifo *pfifo = (struct k_fifo *)p;

	tfifo_put(&fifo);
	/**TESTPOINT: return false when data available*/
	zassert_false(k_fifo_is_empty(pfifo));

	tfifo_get(&fifo);
	/**TESTPOINT: return true with data unavailable*/
	zassert_true(k_fifo_is_empty(pfifo));
}

/**
 * @addtogroup tests_kernel_fifo
 * @{
 */

/**
 * @brief Verify FIFO data passing between two threads.
 *
 * @details
 * A consumer thread blocks on k_fifo_get() while the main thread enqueues
 * items via the single, list and slist put APIs. The consumer must receive
 * every item in FIFO order. The scenario is run against both a k_fifo_init()ed
 * and a K_FIFO_DEFINE()d FIFO to confirm both initialization paths behave the
 * same.
 *
 * Test steps:
 * - Create a preemptible consumer thread that drains the FIFO.
 * - From the main thread, put items using k_fifo_put(), k_fifo_put_list() and
 *   k_fifo_put_slist().
 * - Synchronize on a semaphore once the consumer has read all items.
 * - Repeat for a statically defined FIFO.
 *
 * Expected result:
 * - The consumer dequeues every item in the order it was enqueued.
 *
 * @see k_fifo_put()
 * @see k_fifo_put_list()
 * @see k_fifo_put_slist()
 * @see k_fifo_get()
 * @verifies ZEP-SRS-24-3
 * @verifies ZEP-SRS-24-7
 */
ZTEST(fifo_api_1cpu, test_fifo_thread2thread)
{
	/**TESTPOINT: init via k_fifo_init*/
	k_fifo_init(&fifo);
	tfifo_thread_thread(&fifo);

	/**TESTPOINT: test K_FIFO_DEFINEed fifo*/
	tfifo_thread_thread(&kfifo);
}

/**
 * @brief Verify a FIFO defined at compile time is ready for use.
 *
 * @details
 * A FIFO created with K_FIFO_DEFINE() must be fully initialized at boot:
 * empty and immediately usable for data passing without any run-time
 * initialization call.
 *
 * Test steps:
 * - Check the statically defined FIFO is empty.
 * - Put an item and get it back, verifying the same item is returned.
 *
 * Expected result:
 * - The statically defined FIFO accepts and delivers items as-is.
 *
 * @see K_FIFO_DEFINE
 * @verifies ZEP-SRS-24-1
 */
ZTEST(fifo_api, test_fifo_define)
{
	/* usable at boot without any run-time initialization */
	zassert_true(k_fifo_is_empty(&kfifo));

	k_fifo_put(&kfifo, (void *)&data[0]);
	zassert_equal(k_fifo_get(&kfifo, K_NO_WAIT), (void *)&data[0]);
	zassert_true(k_fifo_is_empty(&kfifo));
}

/**
 * @brief Verify appending a singly-linked item list to the back of a FIFO.
 *
 * @details
 * k_fifo_put_list() must transfer a caller-built singly-linked list to the
 * back of the FIFO with its order preserved.
 *
 * Test steps:
 * - Put one item so the FIFO is non-empty.
 * - Link the items of an array into a list.
 * - Put the list and confirm it lands behind the pre-existing item.
 * - Get all items and verify list order is preserved.
 *
 * Expected result:
 * - The pre-existing item is delivered first, then every list item in its
 *   original order.
 *
 * @see k_fifo_put_list()
 * @see k_fifo_get()
 * @verifies ZEP-SRS-24-5
 */
ZTEST(fifo_api, test_fifo_put_list_order)
{
	static fdata_t *head = &data_l[0], *tail = &data_l[LIST_LEN - 1];

	k_fifo_init(&fifo);

	/* a pre-existing item so the list is demonstrably put behind it */
	k_fifo_put(&fifo, (void *)&data[0]);

	head->snode.next = (sys_snode_t *)tail;
	tail->snode.next = NULL;
	k_fifo_put_list(&fifo, (uint32_t *)head, (uint32_t *)tail);

	zassert_equal(k_fifo_get(&fifo, K_NO_WAIT), (void *)&data[0]);
	for (int i = 0; i < LIST_LEN; i++) {
		zassert_equal(k_fifo_get(&fifo, K_NO_WAIT),
			      (void *)&data_l[i]);
	}
	zassert_true(k_fifo_is_empty(&fifo));
}

/**
 * @brief Verify putting a sys_slist empties the list into the FIFO.
 *
 * @details
 * k_fifo_put_slist() must move every node of a sys_slist to the back of the
 * FIFO in list order and leave the source list empty.
 *
 * Test steps:
 * - Put one item so the FIFO is non-empty.
 * - Build a sys_slist with two nodes and put it on the FIFO.
 * - Verify the source list is empty afterwards.
 * - Get all items and confirm the nodes land behind the pre-existing item,
 *   in list order.
 *
 * Expected result:
 * - The pre-existing item is delivered first, then every node in order, and
 *   the source list is emptied.
 *
 * @see k_fifo_put_slist()
 * @see k_fifo_get()
 * @verifies ZEP-SRS-24-6
 */
ZTEST(fifo_api, test_fifo_put_slist_order)
{
	sys_slist_t slist;

	k_fifo_init(&fifo);

	/* a pre-existing item so the nodes land behind it */
	k_fifo_put(&fifo, (void *)&data[0]);

	sys_slist_init(&slist);
	sys_slist_append(&slist, (sys_snode_t *)&(data_sl[0].snode));
	sys_slist_append(&slist, (sys_snode_t *)&(data_sl[1].snode));
	k_fifo_put_slist(&fifo, &slist);

	/* the source list is emptied by the put */
	zassert_true(sys_slist_is_empty(&slist));

	zassert_equal(k_fifo_get(&fifo, K_NO_WAIT), (void *)&data[0]);
	for (int i = 0; i < LIST_LEN; i++) {
		zassert_equal(k_fifo_get(&fifo, K_NO_WAIT),
			      (void *)&data_sl[i]);
	}
	zassert_true(k_fifo_is_empty(&fifo));
}

/**
 * @brief Verify FIFO data passing from an ISR to a thread.
 *
 * @details
 * Items are enqueued from interrupt context (via irq_offload()) and dequeued in
 * thread context, confirming k_fifo_put() is ISR-safe and the thread receives
 * every item in FIFO order. Run against both an init()ed and a DEFINE()d FIFO.
 *
 * Test steps:
 * - From an ISR, put items into the FIFO and assert it is not empty.
 * - In thread context, get all items and verify their order.
 * - Repeat for a statically defined FIFO.
 *
 * Expected result:
 * - The thread dequeues every ISR-enqueued item in order.
 *
 * @see k_fifo_put()
 * @see k_fifo_get()
 * @verifies ZEP-SRS-24-3
 * @verifies ZEP-SRS-24-7
 */
ZTEST(fifo_api, test_fifo_thread2isr)
{
	/**TESTPOINT: init via k_fifo_init*/
	k_fifo_init(&fifo);
	tfifo_thread_isr(&fifo);

	/**TESTPOINT: test K_FIFO_DEFINEed fifo*/
	tfifo_thread_isr(&kfifo);
}

/**
 * @brief Verify FIFO data passing from a thread to an ISR.
 *
 * @details
 * Items are enqueued in thread context and dequeued from interrupt context (via
 * irq_offload()), confirming k_fifo_get() is ISR-safe and the ISR receives every
 * item in FIFO order. Run against both an init()ed and a DEFINE()d FIFO.
 *
 * Test steps:
 * - In thread context, put items into the FIFO.
 * - From an ISR, get all items, verify their order, and assert the FIFO is empty.
 * - Repeat for a statically defined FIFO.
 *
 * Expected result:
 * - The ISR dequeues every thread-enqueued item in order.
 *
 * @see k_fifo_put()
 * @see k_fifo_get()
 * @verifies ZEP-SRS-24-3
 * @verifies ZEP-SRS-24-7
 */
ZTEST(fifo_api, test_fifo_isr2thread)
{
	/**TESTPOINT: test k_fifo_init fifo*/
	k_fifo_init(&fifo);
	tfifo_isr_thread(&fifo);

	/**TESTPOINT: test K_FIFO_DEFINE fifo*/
	tfifo_isr_thread(&kfifo);
}

/**
 * @brief Verify k_fifo_is_empty() tracks FIFO contents in thread context.
 *
 * @details
 * k_fifo_is_empty() must report true for a freshly initialized FIFO, false once
 * items are enqueued, and true again after they are all dequeued. All operations
 * run in thread context.
 *
 * Test steps:
 * - Initialize a FIFO and assert it is empty.
 * - Put items and assert it is not empty.
 * - Get all items and assert it is empty again.
 *
 * Expected result:
 * - k_fifo_is_empty() reflects the presence or absence of queued data.
 *
 * @see k_fifo_is_empty()
 * @verifies ZEP-SRS-24-8
 */
ZTEST(fifo_api, test_fifo_is_empty_thread)
{
	k_fifo_init(&fifo);
	/**TESTPOINT: k_fifo_is_empty after init*/
	zassert_true(k_fifo_is_empty(&fifo));

	/**TESTPONT: check fifo is empty from thread*/
	tfifo_is_empty(&fifo);
}

/**
 * @brief Verify k_fifo_is_empty() tracks FIFO contents in ISR context.
 *
 * @details
 * Same emptiness contract as the thread-context case, but the put/get/is_empty
 * sequence is executed from interrupt context via irq_offload() to confirm
 * k_fifo_is_empty() is ISR-safe.
 *
 * Test steps:
 * - Initialize a FIFO and assert it is empty from thread context.
 * - From an ISR, put items (not empty) then get them all (empty again).
 *
 * Expected result:
 * - k_fifo_is_empty() reports the correct state when called from an ISR.
 *
 * @see k_fifo_is_empty()
 * @verifies ZEP-SRS-24-8
 */
ZTEST(fifo_api, test_fifo_is_empty_isr)
{
	k_fifo_init(&fifo);
	/**TESTPOINT: check fifo is empty from isr*/
	irq_offload((irq_offload_routine_t)tfifo_is_empty, &fifo);
}

/**
 * @brief Test peeking at the front and back items of a FIFO
 *
 * @details Enqueue two data items, then use k_fifo_peek_head() and
 * k_fifo_peek_tail() to inspect the items at the front and back of the FIFO and
 * verify the returned pointers match the first and last enqueued items without
 * removing them (a subsequent get still returns both items in order). Peeking an
 * empty FIFO returns NULL.
 *
 * @see k_fifo_peek_head(), k_fifo_peek_tail()
 * @verifies ZEP-SRS-24-9
 * @verifies ZEP-SRS-24-10
 */
ZTEST(fifo_api, test_fifo_peek)
{
	k_fifo_init(&fifo);

	k_fifo_put(&fifo, (void *)&data[0]);
	k_fifo_put(&fifo, (void *)&data[1]);

	/**TESTPOINT: peek front and back without removing*/
	zassert_equal(k_fifo_peek_head(&fifo), (void *)&data[0]);
	zassert_equal(k_fifo_peek_tail(&fifo), (void *)&data[1]);

	/* Peeking does not dequeue: both items are still retrievable in order. */
	zassert_equal(k_fifo_get(&fifo, K_NO_WAIT), (void *)&data[0]);
	zassert_equal(k_fifo_get(&fifo, K_NO_WAIT), (void *)&data[1]);

	/**TESTPOINT: peek of an empty fifo returns NULL*/
	zassert_is_null(k_fifo_peek_head(&fifo));
	zassert_is_null(k_fifo_peek_tail(&fifo));
}

K_HEAP_DEFINE(fifo_alloc_pool, 256);

/**
 * @brief Test enqueuing a data item to a FIFO with implicit memory allocation
 *
 * @details Use k_fifo_alloc_put() to enqueue a data item that does not reserve
 * space for the bookkeeping word, so the kernel allocates the container from the
 * calling thread's resource pool. Verify the call succeeds and that the same
 * data pointer is returned by a subsequent get.
 *
 * @see k_fifo_alloc_put()
 * @verifies ZEP-SRS-24-4
 */
ZTEST(fifo_api, test_fifo_alloc_put)
{
	static uint32_t payload = 0xDEADBEEF;

	k_fifo_init(&fifo);
	k_thread_heap_assign(k_current_get(), &fifo_alloc_pool);

	/**TESTPOINT: allocate the queue container from the thread resource pool*/
	zassert_equal(k_fifo_alloc_put(&fifo, &payload), 0);

	zassert_equal(k_fifo_get(&fifo, K_NO_WAIT), (void *)&payload);
}
/**
 * @}
 */
```

## src/test_fifo_fail.c
```c
/*
 * Copyright (c) 2016 Intel Corporation
 *
 * SPDX-License-Identifier: Apache-2.0
 */

#include "test_fifo.h"

#define TIMEOUT K_MSEC(100)

/**
 * @addtogroup tests_kernel_fifo
 * @{
 */

/**
 * @brief Verify k_fifo_get() on an empty FIFO returns NULL.
 *
 * @details
 * When no data is queued, k_fifo_get() must return NULL rather than block
 * indefinitely or return stale data. The contract is checked both with
 * K_NO_WAIT (immediate) and with a finite timeout that is allowed to expire.
 *
 * Test steps:
 * - Initialize an empty FIFO.
 * - Call k_fifo_get() with K_NO_WAIT and verify it returns NULL.
 * - Call k_fifo_get() with a finite timeout and verify it returns NULL.
 *
 * Expected result:
 * - Both k_fifo_get() calls return NULL.
 *
 * @see k_fifo_get()
 * @verifies ZEP-SRS-24-7
 */
ZTEST(fifo_api, test_fifo_get_fail)
{
	static struct k_fifo fifo;

	k_fifo_init(&fifo);
	/**TESTPOINT: fifo get returns NULL*/
	zassert_is_null(k_fifo_get(&fifo, K_NO_WAIT), NULL);
	zassert_is_null(k_fifo_get(&fifo, TIMEOUT), NULL);
}
/**
 * @}
 */
```

## src/test_fifo_loop.c
```c
/*
 * Copyright (c) 2016 Intel Corporation
 *
 * SPDX-License-Identifier: Apache-2.0
 */

#include "test_fifo.h"

#define STACK_SIZE (512 + CONFIG_TEST_EXTRA_STACK_SIZE)
#define LIST_LEN 4
#define LOOPS 32

static fdata_t data[LIST_LEN];
static struct k_fifo fifo;
static K_THREAD_STACK_DEFINE(tstack_loop, STACK_SIZE);
static struct k_thread tdata;
static struct k_sem end_sema;

static void tfifo_put(struct k_fifo *pfifo)
{
	/**TESTPOINT: fifo put*/
	for (int i = 0; i < LIST_LEN; i++) {
		k_fifo_put(pfifo, (void *)&data[i]);
	}
}

static void tfifo_get(struct k_fifo *pfifo)
{
	void *rx_data;

	/*get fifo data from "fifo_put"*/
	for (int i = 0; i < LIST_LEN; i++) {
		/**TESTPOINT: fifo get*/
		rx_data = k_fifo_get(pfifo, K_NO_WAIT);
		zassert_equal(rx_data, (void *)&data[i]);
	}
}

/*entry of contexts*/
static void tIsr_entry(const void *p)
{
	TC_PRINT("isr fifo get\n");
	tfifo_get((struct k_fifo *)p);
	TC_PRINT("isr fifo put ---> ");
	tfifo_put((struct k_fifo *)p);
}

static void tThread_entry(void *p1, void *p2, void *p3)
{
	TC_PRINT("thread fifo get\n");
	tfifo_get((struct k_fifo *)p1);
	k_sem_give(&end_sema);
	TC_PRINT("thread fifo put ---> ");
	tfifo_put((struct k_fifo *)p1);
	k_sem_give(&end_sema);
}

/* fifo read write job */
static void tfifo_read_write(struct k_fifo *pfifo)
{
	k_sem_init(&end_sema, 0, 1);
	/**TESTPOINT: thread-isr-thread data passing via fifo*/
	k_tid_t tid = k_thread_create(&tdata, tstack_loop, STACK_SIZE,
				      tThread_entry, pfifo, NULL, NULL,
				      K_PRIO_PREEMPT(0), 0, K_NO_WAIT);

	TC_PRINT("main fifo put ---> ");
	tfifo_put(pfifo);
	irq_offload(tIsr_entry, pfifo);
	k_sem_take(&end_sema, K_FOREVER);
	k_sem_take(&end_sema, K_FOREVER);

	TC_PRINT("main fifo get\n");
	tfifo_get(pfifo);
	k_thread_abort(tid);
	TC_PRINT("\n");
}

/**
 * @addtogroup tests_kernel_fifo
 * @{
 */

/**
 * @brief Verify FIFO data integrity under repeated cross-context traffic.
 *
 * @details
 * Stresses the FIFO by cycling data through main-thread, ISR and spawned-thread
 * contexts many times. Across every iteration the items must be passed without
 * loss, duplication or reordering, exercising put/get stability when producers
 * and consumers alternate between thread and interrupt context.
 *
 * Test steps:
 * - For LOOPS iterations: put from the main thread, get then put from an ISR,
 *   and get from a spawned thread.
 * - Verify each get returns the expected item.
 *
 * Expected result:
 * - Data passes correctly and in order across all contexts on every iteration.
 *
 * @see k_fifo_put()
 * @see k_fifo_get()
 * @verifies ZEP-SRS-24-3
 * @verifies ZEP-SRS-24-7
 */
ZTEST(fifo_api_1cpu, test_fifo_loop)
{
	k_fifo_init(&fifo);
	for (int i = 0; i < LOOPS; i++) {
		TC_PRINT("* Pass data by fifo in loop %d\n", i);
		tfifo_read_write(&fifo);
	}
}
/**
 * @}
 */
```
