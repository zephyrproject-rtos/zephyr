## prj.conf
```kconfig
CONFIG_ZTEST=y
#CONFIG_SYS_POWER_MANAGEMENT=y
#CONFIG_SYS_POWER_LOW_POWER_STATE=y
CONFIG_TICKLESS_IDLE=y
```

## src/main.c
```c
/*
 * Copyright (c) 2016 Intel Corporation
 *
 * SPDX-License-Identifier: Apache-2.0
 */


#include <ztest.h>
static int main_prio;

/* power hook functions if support */
int _sys_soc_suspend(s32_t ticks)
{
	/** TESTPOINT: check idle thread priority */
	zassert_true(k_thread_priority_get(k_current_get()) ==
			K_IDLE_PRIO, NULL);
	return 0;
}

/**
 * @brief System Thread Test Cases
 * @defgroup kernel_systemthreads System Threads
 * @ingroup all_tests
 * @brief Verify 2 system threads - main thread and idle thread
 * @{
 */
void test_systhreads_setup(void)
{
	main_prio = k_thread_priority_get(k_current_get());
}

void test_systhreads_main(void)
{
	zassert_true(main_prio == CONFIG_MAIN_THREAD_PRIORITY, NULL);
}

void test_systhreads_idle(void)
{
	k_sleep(100);
	/** TESTPOINT: check working thread priority should */
	zassert_true(k_thread_priority_get(k_current_get()) <
			K_IDLE_PRIO, NULL);
}
/**
 * @}
 */
void test_main(void)
{
	test_systhreads_setup();
	ztest_test_suite(systhreads,
		ztest_unit_test(test_systhreads_main),
		ztest_unit_test(test_systhreads_idle));
	ztest_run_test_suite(systhreads);
}
```

## src/test_systhreads.c
```c
/*
 * Copyright (c) 2016 Intel Corporation
 *
 * SPDX-License-Identifier: Apache-2.0
 */

#include <ztest.h>

static int main_prio;

/* power hook functions if support */
int _sys_soc_suspend(s32_t ticks)
{
	/** TESTPOINT: check idle thread priority */
	zassert_true(k_thread_priority_get(k_current_get()) ==
			K_IDLE_PRIO, NULL);
	return 0;
}

/* test cases */
void test_systhreads_setup(void)
{
	main_prio = k_thread_priority_get(k_current_get());
}

void test_systhreads_main(void)
{
	zassert_true(main_prio == CONFIG_MAIN_THREAD_PRIORITY, NULL);
}

void test_systhreads_idle(void)
{
	k_sleep(100);
	/** TESTPOINT: check working thread priority should */
	zassert_true(k_thread_priority_get(k_current_get()) <
			K_IDLE_PRIO, NULL);
}
```

## src/test_systhreads.h
```c
/*
 * Copyright (c) 2016 Intel Corporation
 *
 * SPDX-License-Identifier: Apache-2.0
 */

#ifndef __TEST_SYSTHREADS_H__
#define __TEST_SYSTHREADS_H__

void test_systhreads_setup(void);
void test_systhreads_main(void);
void test_systhreads_idle(void);

#endif /* __TEST_SYSTHREADS_H__ */
```
