/*
 * Copyright (c) 2023 Intel Corporation
 *
 * SPDX-License-Identifier: Apache-2.0
 */

/ {
	cpus {
		cpu@2 {
			device_type = "cpu";
			compatible = "intel,x86";
			d-cache-line-size = <64>;
			reg = <2>;
		};

		cpu@3 {
			device_type = "cpu";
			compatible = "intel,x86";
			d-cache-line-size = <64>;
			reg = <3>;
		};
	};
};
