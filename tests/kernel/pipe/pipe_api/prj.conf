## CMakeLists.txt
```
cmake_minimum_required(VERSION 3.28.0)

find_package(Zephyr REQUIRED HINTS $ENV{ZEPHYR_BASE})

project(app)

target_sources(app
  PRIVATE
  ${CMAKE_CURRENT_SOURCE_DIR}/src/basic.c
  ${CMAKE_CURRENT_SOURCE_DIR}/src/stress.c
  ${CMAKE_CURRENT_SOURCE_DIR}/src/concurrency.c
)
```

## prj.conf
```kconfig
CONFIG_ZTEST=y
CONFIG_ZTRESS=y

CONFIG_ZTEST_STACK_SIZE=4096
CONFIG_HEAP_MEM_POOL_SIZE=2048
CONFIG_MAIN_STACK_SIZE=4096

CONFIG_ENTROPY_GENERATOR=y
CONFIG_TEST_RANDOM_GENERATOR=y
```

## src/main.c
```c
/*
 * Copyright (c) 2016 Intel Corporation
 *
 * SPDX-License-Identifier: Apache-2.0
 */

/**
 * @defgroup kernel_pipe_tests PIPEs
 * @ingroup all_tests
 * @{
 * @}
 */

#include <zephyr/ztest.h>

/* k objects */
extern struct k_pipe pipe, kpipe, khalfpipe, put_get_pipe;
extern struct k_sem end_sema;
extern struct k_stack tstack;
extern struct k_thread tdata;
extern struct k_heap test_pool;

static void *pipe_api_setup(void)
{
	k_thread_access_grant(k_current_get(), &pipe,
			      &kpipe, &end_sema, &tdata, &tstack,
			      &khalfpipe, &put_get_pipe);

	k_thread_heap_assign(k_current_get(), &test_pool);

	return NULL;
}

ZTEST_SUITE(pipe_api, NULL, pipe_api_setup, NULL, NULL, NULL);

ZTEST_SUITE(pipe_api_1cpu, NULL, pipe_api_setup,
		ztest_simple_1cpu_before, ztest_simple_1cpu_after, NULL);
```

## src/basic.c
```c
/*
 * Copyright (c) 2024 Måns Ansgariusson <mansgariusson@gmail.com>
 *
 * SPDX-License-Identifier: Apache-2.0
 */
#include <limits.h>
#include <stdint.h>
#include <zephyr/kernel.h>
#include <zephyr/ztest.h>
#include <zephyr/random/random.h>

ZTEST_SUITE(k_pipe_basic, NULL, NULL, NULL, NULL, NULL);

static void mkrandom(uint8_t *buffer, size_t size)
{
	sys_rand_get(buffer, size);
}

K_PIPE_DEFINE(test_define, 256, 4);

static struct k_pipe pipe;

/**
 * @brief Pipe (byte stream) API tests
 * @defgroup tests_kernel_pipe Pipe tests
 * @ingroup all_tests
 * @{
 */

/**
 * @brief Verify k_pipe_init() opens a pipe for use.
 *
 * @details
 * After k_pipe_init() a pipe must be in the open state, ready for reads and
 * writes. The test initializes a pipe over a stack buffer and checks the open
 * flag is set.
 *
 * Test steps:
 * - Initialize a pipe with a backing buffer.
 * - Verify the pipe's flags indicate it is open.
 *
 * Expected result:
 * - The pipe reports PIPE_FLAG_OPEN.
 *
 * @see k_pipe_init()
 *
 * @verifies ZEP-SRS-32-1
 * @verifies ZEP-SRS-32-2
 */
ZTEST(k_pipe_basic, test_pipe_init)
{
	uint8_t buffer[10];

	k_pipe_init(&pipe, buffer, sizeof(buffer));
	zassert_true(pipe.flags == PIPE_FLAG_OPEN, "Unexpected pipe flags");
}

/**
 * @brief Verify a single byte written to a pipe is read back unchanged.
 *
 * @details
 * The most basic stream round trip: one byte written with k_pipe_write() must be
 * returned by k_pipe_read() with the same value.
 *
 * Test steps:
 * - Write one byte to an empty pipe (K_NO_WAIT).
 * - Read one byte back and compare.
 *
 * Expected result:
 * - The byte read equals the byte written.
 *
 * @see k_pipe_write()
 * @see k_pipe_read()
 *
 * @verifies ZEP-SRS-32-3
 * @verifies ZEP-SRS-32-4
 */
ZTEST(k_pipe_basic, test_pipe_write_read_one)
{
	uint8_t buffer[10];
	uint8_t data = 0x55;
	uint8_t read_data;

	k_pipe_init(&pipe, buffer, sizeof(buffer));
	zassert_true(k_pipe_write(&pipe, &data, 1, K_NO_WAIT) == 1,
	      "Failed to write to pipe");
	zassert_true(k_pipe_read(&pipe, &read_data, 1, K_NO_WAIT) == 1,
	      "Failed to read from pipe");
	zassert_true(read_data == data, "Unexpected data received from pipe");
}

/**
 * @brief Verify bytes are read back from a pipe in write (FIFO) order.
 *
 * @details
 * A pipe is a byte stream: multiple bytes written must be read back in the same
 * order they were written.
 *
 * Test steps:
 * - Write two bytes to the pipe.
 * - Read two bytes back and verify each matches in order.
 *
 * Expected result:
 * - Bytes are returned in FIFO order.
 *
 * @see k_pipe_write()
 * @see k_pipe_read()
 *
 * @verifies ZEP-SRS-32-3
 * @verifies ZEP-SRS-32-4
 */
ZTEST(k_pipe_basic, test_pipe_write_read_multiple)
{
	uint8_t buffer[10];
	uint8_t data = 0x55;
	uint8_t read_data;

	k_pipe_init(&pipe, buffer, sizeof(buffer));
	zassert_true(k_pipe_write(&pipe, &data, 1, K_NO_WAIT) == 1, "Failed to write to pipe");
	zassert_true(k_pipe_write(&pipe, &data, 1, K_NO_WAIT) == 1, "Failed to write to pipe");
	zassert_true(k_pipe_read(&pipe, &read_data, 1, K_NO_WAIT) == 1, "Failed to read from pipe");
	zassert_true(read_data == data, "Unexpected data received from pipe");
	zassert_true(k_pipe_read(&pipe, &read_data, 1, K_NO_WAIT) == 1, "Failed to read from pipe");
	zassert_true(read_data == data, "Unexpected data received from pipe");
}

/**
 * @brief Verify writing to a full pipe times out with -EAGAIN.
 *
 * @details
 * Once the pipe buffer is full, a write with a finite timeout and no reader must
 * block for the timeout and then fail with -EAGAIN rather than overrun.
 *
 * Test steps:
 * - Fill the pipe to capacity with a non-blocking write.
 * - Attempt another write with a finite timeout.
 *
 * Expected result:
 * - The first write stores all bytes; the second returns -EAGAIN.
 *
 * @see k_pipe_write()
 *
 * @verifies ZEP-SRS-32-3
 */
ZTEST(k_pipe_basic, test_pipe_write_full)
{
	uint8_t buffer[10];
	uint8_t data[10];

	k_pipe_init(&pipe, buffer, sizeof(buffer));
	zassert_true(k_pipe_write(&pipe, data, sizeof(data), K_NO_WAIT) == 10,
		"Failed to write multiple bytes to pipe");
	zassert_true(k_pipe_write(&pipe, data, sizeof(data), K_MSEC(1000)) == -EAGAIN,
		"Should not be able to write to full pipe");
}

/**
 * @brief Verify reading from an empty pipe times out with -EAGAIN.
 *
 * @details
 * With no data buffered and no writer, a read with a finite timeout must block
 * for the timeout and then fail with -EAGAIN.
 *
 * Test steps:
 * - Read from an empty pipe with a finite timeout.
 *
 * Expected result:
 * - k_pipe_read() returns -EAGAIN.
 *
 * @see k_pipe_read()
 *
 * @verifies ZEP-SRS-32-4
 */
ZTEST(k_pipe_basic, test_pipe_read_empty)
{
	uint8_t buffer[10];
	uint8_t read_data;

	k_pipe_init(&pipe, buffer, sizeof(buffer));
	zassert_true(k_pipe_read(&pipe, &read_data, 1, K_MSEC(1000)) == -EAGAIN,
		"Should not be able to read from empty pipe");
}

/**
 * @brief Verify a full-buffer write/read round trip preserves the data.
 *
 * @details
 * Writing a buffer that exactly fills the pipe and reading it all back must
 * return the identical byte sequence.
 *
 * Test steps:
 * - Write a buffer of random bytes that fills the pipe.
 * - Read the same number of bytes back and compare with memcmp.
 *
 * Expected result:
 * - The read buffer is byte-for-byte identical to what was written.
 *
 * @see k_pipe_write()
 * @see k_pipe_read()
 *
 * @verifies ZEP-SRS-32-3
 * @verifies ZEP-SRS-32-4
 */
ZTEST(k_pipe_basic, test_pipe_read_write_full)
{
	uint8_t buffer[10];
	uint8_t input[10];
	uint8_t res[10];

	mkrandom(input, sizeof(input));
	k_pipe_init(&pipe, buffer, sizeof(buffer));
	zassert_true(k_pipe_write(&pipe, input, sizeof(input), K_NO_WAIT) == sizeof(input),
		"Failed to write multiple bytes to pipe");
	zassert_true(k_pipe_read(&pipe, res, sizeof(res), K_NO_WAIT) == sizeof(res),
		"Failed to read multiple bytes from pipe");
	zassert_true(memcmp(input, res, sizeof(input)) == 0,
		"Unexpected data received from pipe");
}

/**
 * @brief Verify data integrity across a ring-buffer wrap-around.
 *
 * @details
 * The pipe's backing storage is a ring buffer. Partially draining and then
 * writing more than the remaining contiguous space forces the write/read to wrap
 * past the end of the buffer; the byte stream must stay correct and in order.
 *
 * Test steps:
 * - Write 8 bytes into a 12-byte pipe and read 5 back.
 * - Write 8 more bytes (forcing a wrap) and read the remaining 11.
 * - Verify the byte sequence across the wrap matches what was written.
 *
 * Expected result:
 * - All bytes are returned in order despite the buffer wrap.
 *
 * @see k_pipe_write()
 * @see k_pipe_read()
 *
 * @verifies ZEP-SRS-32-3
 * @verifies ZEP-SRS-32-4
 */
ZTEST(k_pipe_basic, test_pipe_read_write_wrap_around)
{
	uint8_t buffer[12];
	uint8_t input[8];
	uint8_t res[16];

	mkrandom(input, sizeof(input));
	k_pipe_init(&pipe, buffer, sizeof(buffer));
	zassert_true(k_pipe_write(&pipe, input, sizeof(input), K_NO_WAIT) == sizeof(input),
		"Failed to write bytes to pipe");
	zassert_true(k_pipe_read(&pipe, res, 5, K_NO_WAIT) == 5,
		"Failed to read bytes from pipe");
	zassert_true(memcmp(input, res, 5) == 0, "Unexpected data received from pipe");

	zassert_true(k_pipe_write(&pipe, input, sizeof(input), K_NO_WAIT) == sizeof(input),
		"Failed to write bytes to pipe");
	zassert_true(k_pipe_read(&pipe, res, sizeof(input) * 2 - 5, K_NO_WAIT) ==
		sizeof(input) * 2 - 5, "Failed to read remaining bytes from pipe");

	zassert_true(memcmp(&input[5], res, sizeof(input) - 5) == 0,
		"Unexpected data received from pipe");
	zassert_true(memcmp(input, &res[sizeof(input) - 5], sizeof(input)) == 0,
		"Unexpected data received from pipe");
}

/**
 * @brief Verify resetting an idle pipe has no side effects.
 *
 * @details
 * k_pipe_reset() on an empty pipe with no waiters must leave the pipe usable;
 * subsequent writes and reads must still work normally.
 *
 * Test steps:
 * - Reset a freshly initialized, empty pipe.
 * - Write a byte and read it back.
 *
 * Expected result:
 * - The pipe remains functional after the reset.
 *
 * @see k_pipe_reset()
 *
 * @verifies ZEP-SRS-32-7
 */
ZTEST(k_pipe_basic, test_pipe_reset)
{
	uint8_t buffer[10];
	uint8_t data = 0x55;
	uint8_t read_data;

	k_pipe_init(&pipe, buffer, sizeof(buffer));

	/* reset an empty pipe, & no waiting should not produce any side-effects*/
	k_pipe_reset(&pipe);
	zassert_true(k_pipe_write(&pipe, &data, 1, K_NO_WAIT) == 1,
		"Failed to write to reset pipe");
	zassert_true(k_pipe_read(&pipe, &read_data, 1, K_NO_WAIT) == 1,
		"Failed to read from reset pipe");
	zassert_true(read_data == data, "Unexpected data received from pipe");
}

/**
 * @brief Verify close blocks writes but lets buffered data drain.
 *
 * @details
 * After k_pipe_close(), new writes must fail with -EPIPE, but data already
 * buffered must still be readable; once that data is exhausted, reads also
 * return -EPIPE.
 *
 * Test steps:
 * - Write data into the pipe, then close it.
 * - Verify a further write returns -EPIPE.
 * - Read the buffered bytes back (in two reads) and verify their values.
 * - Verify a read on the now-empty closed pipe returns -EPIPE.
 *
 * Expected result:
 * - Writes fail with -EPIPE; buffered data is drained; empty closed reads
 *   return -EPIPE.
 *
 * @see k_pipe_close()
 * @see k_pipe_read()
 * @see k_pipe_write()
 *
 * @verifies ZEP-SRS-32-8
 */
ZTEST(k_pipe_basic, test_pipe_close)
{
	uint8_t buffer[12];
	uint8_t input[8];
	uint8_t res[16];

	mkrandom(input, sizeof(input));
	k_pipe_init(&pipe, buffer, sizeof(buffer));
	zassert_true(k_pipe_write(&pipe, input, sizeof(input), K_NO_WAIT) == sizeof(input),
		"Failed to write bytes to pipe");
	k_pipe_close(&pipe);

	zassert_true(k_pipe_write(&pipe, input, sizeof(input), K_NO_WAIT) == -EPIPE,
		"should not be able to write to closed pipe");
	zassert_true(k_pipe_read(&pipe, res, 5, K_NO_WAIT) == 5,
		"You should be able to read from closed pipe");
	zassert_true(memcmp(input, res, 5) == 0, "Sequence should be equal");

	zassert_true(k_pipe_read(&pipe, res, 5, K_NO_WAIT) == 3,
		"you should be able to read remaining bytes from closed pipe");
	zassert_true(memcmp(&input[5], res, 3) == 0, "Written and read bytes should be equal");
	zassert_true(k_pipe_read(&pipe, res, 5, K_NO_WAIT) == -EPIPE,
		"Closed and empty pipe should return -EPIPE");
}

/**
 * @brief Verify a length above INT_MAX is refused with -EOVERFLOW.
 *
 * @details
 * Both calls report a successful transfer as a positive int, so a request
 * they could not report the size of is refused up front rather than
 * truncated.
 *
 * Test steps:
 * - Ask to write, then to read, INT_MAX + 1 bytes.
 * - Verify both return -EOVERFLOW and leave the pipe untouched.
 *
 * Expected result:
 * - Both calls return -EOVERFLOW and the pipe is still empty.
 *
 * @see k_pipe_read()
 * @see k_pipe_write()
 */
ZTEST(k_pipe_basic, test_pipe_len_above_int_max)
{
	uint8_t buffer[16];
	uint8_t data[4];

	k_pipe_init(&pipe, buffer, sizeof(buffer));

	zassert_equal(k_pipe_write(&pipe, data, (size_t)INT_MAX + 1, K_NO_WAIT), -EOVERFLOW,
		"write of more than INT_MAX bytes should return -EOVERFLOW");
	zassert_equal(k_pipe_read(&pipe, data, (size_t)INT_MAX + 1, K_NO_WAIT), -EOVERFLOW,
		"read of more than INT_MAX bytes should return -EOVERFLOW");

	/* The rejected calls must not have consumed or produced anything. */
	zassert_equal(k_pipe_read(&pipe, data, sizeof(data), K_NO_WAIT), -EAGAIN,
		"pipe should still be empty");
}

/**
 * @}
 */

K_PIPE_DEFINE(timeout_pipe, 16, 4);

/**
 * @brief Verify a timed write on a full pipe fails with -EAGAIN.
 *
 * @details
 * When no data can be written within the specified maximum time, the write
 * must return an error indicating that no data was written. Fill the pipe,
 * then write with a finite timeout: the call must block for at least the
 * timeout and return -EAGAIN without storing anything.
 *
 * Test steps:
 * - Fill the pipe to capacity with a no-wait write.
 * - Write one more byte with a 100 ms timeout, measuring the elapsed time.
 *
 * Expected result:
 * - The timed write returns -EAGAIN after at least 100 ms.
 *
 * @see k_pipe_write()
 * @verifies ZEP-SRS-32-11
 */
ZTEST(k_pipe_basic, test_pipe_write_timeout)
{
	uint8_t buffer[16];
	int64_t start;
	int rc;

	mkrandom(buffer, sizeof(buffer));

	zassert_equal(k_pipe_write(&timeout_pipe, buffer, sizeof(buffer), K_NO_WAIT),
		      (int)sizeof(buffer), "could not fill the pipe");

	start = k_uptime_get();
	rc = k_pipe_write(&timeout_pipe, buffer, 1, K_MSEC(100));
	zassert_equal(rc, -EAGAIN, "timed write on a full pipe returned %d", rc);
	zassert_true(k_uptime_get() - start >= 100,
		     "timed write returned before the timeout elapsed");

	k_pipe_reset(&timeout_pipe);
}

/**
 * @brief Verify a timed read on an empty pipe fails with -EAGAIN.
 *
 * @details
 * When no data becomes available within the specified maximum time, the read
 * must return an error indicating that no data was read. Read from an empty
 * pipe with a finite timeout: the call must block for at least the timeout
 * and return -EAGAIN.
 *
 * Test steps:
 * - Read one byte from the empty pipe with a 100 ms timeout, measuring the
 *   elapsed time.
 *
 * Expected result:
 * - The timed read returns -EAGAIN after at least 100 ms.
 *
 * @see k_pipe_read()
 * @verifies ZEP-SRS-32-12
 */
ZTEST(k_pipe_basic, test_pipe_read_timeout)
{
	uint8_t data;
	int64_t start;
	int rc;

	start = k_uptime_get();
	rc = k_pipe_read(&timeout_pipe, &data, 1, K_MSEC(100));
	zassert_equal(rc, -EAGAIN, "timed read on an empty pipe returned %d", rc);
	zassert_true(k_uptime_get() - start >= 100,
		     "timed read returned before the timeout elapsed");
}
```

## src/benchmarks.c
```c
/*
 * Copyright (c) 2026 Måns Ansgariusson <mansgariusson@gmail.com>
 *
 * SPDX-License-Identifier: Apache-2.0
 */
#include <zephyr/kernel.h>
#include <zephyr/ztest.h>

ZTEST_BENCHMARK_SUITE(k_pipe, NULL, NULL);

K_PIPE_DEFINE(pipe, 128, 4);
static uint8_t data[128];

static void reset(void)
{
	k_pipe_reset(&pipe);
}

static void fill(void)
{
	int rc;

	rc = k_pipe_write(&pipe, data, sizeof(data), K_NO_WAIT);
	__ASSERT(rc == sizeof(data), "Failed to write to pipe: %d", rc);
}

ZTEST_BENCHMARK(k_pipe, buffered_write, 1000, reset, NULL)
{
	k_pipe_write(&pipe, data, 1, K_NO_WAIT);
}

ZTEST_BENCHMARK(k_pipe, buffered_read, 1000, fill, reset)
{
	k_pipe_read(&pipe, data, 1, K_NO_WAIT);
}

K_PIPE_DEFINE(dma_r, 0, 4);
static void reader_thread(void *p1, void *p2, void *p3)
{
	uint8_t rx;

	while (1) {
		k_pipe_read(&dma_r, &rx, sizeof(rx), K_FOREVER);
	}
}

K_THREAD_DEFINE(reader, 1024, reader_thread, NULL, NULL, NULL, CONFIG_ZTEST_THREAD_PRIORITY, 0, 0);

ZTEST_BENCHMARK(k_pipe, threaded_transfer_write, 1000, k_yield, k_yield)
{
	k_pipe_write(&dma_r, data, 1, K_FOREVER);
}

K_PIPE_DEFINE(dma_w, 0, 4);
static void writer_thread(void *p1, void *p2, void *p3)
{
	uint8_t tx = 0;

	while (1) {
		k_pipe_write(&dma_w, &tx, sizeof(tx), K_FOREVER);
	}
}

K_THREAD_DEFINE(writer, 1024, writer_thread, NULL, NULL, NULL, CONFIG_ZTEST_THREAD_PRIORITY, 0, 0);

ZTEST_BENCHMARK(k_pipe, threaded_transfer_read, 1000, k_yield, k_yield)
{
	k_pipe_read(&dma_w, data, 1, K_FOREVER);
}
```

## src/concurrency.c
```c
/*
 * Copyright (c) 2024 Måns Ansgariusson <mansgariusson@gmail.com>
 *
 * SPDX-License-Identifier: Apache-2.0
 */
#include <stdint.h>
#include <zephyr/kernel.h>
#include <zephyr/ztest.h>
#include <zephyr/random/random.h>
#include <zephyr/logging/log.h>

LOG_MODULE_REGISTER(k_pipe_concurrency, LOG_LEVEL_DBG);
ZTEST_SUITE(k_pipe_concurrency, NULL, NULL, NULL, NULL, NULL);

static const int partial_wait_time = 2000;
#define DUMMY_DATA_SIZE 16
static struct k_thread thread;
static K_THREAD_STACK_DEFINE(stack, 1024 + CONFIG_TEST_EXTRA_STACK_SIZE);
static struct k_pipe pipe;

static void thread_close(void *arg1, void *arg2, void *arg3)
{
	k_pipe_close((struct k_pipe *)arg1);
}

static void thread_reset(void *arg1, void *arg2, void *arg3)
{
	k_pipe_reset((struct k_pipe *)arg1);
}

static void thread_write(void *arg1, void *arg2, void *arg3)
{
	uint8_t garbage[DUMMY_DATA_SIZE] = {};

	zassert_true(k_pipe_write((struct k_pipe *)arg1, garbage, sizeof(garbage),
		K_MSEC(partial_wait_time)) == sizeof(garbage), "Failed to write to pipe");
}

static void thread_read(void *arg1, void *arg2, void *arg3)
{
	uint8_t garbage[DUMMY_DATA_SIZE];

	zassert_true(k_pipe_read((struct k_pipe *)arg1, garbage, sizeof(garbage),
		K_MSEC(partial_wait_time)) == sizeof(garbage), "Failed to read from pipe");
}

/**
 * @addtogroup tests_kernel_pipe
 * @{
 */

/**
 * @brief Verify closing a pipe releases a blocked reader with -EPIPE.
 *
 * @details
 * A reader blocked on an empty pipe must be woken and returned -EPIPE when
 * another thread closes the pipe, and the pipe must remain closed afterwards.
 *
 * Test steps:
 * - Start a thread that closes the pipe after a short delay.
 * - Block in k_pipe_read() on the empty pipe.
 * - Verify the read returns -EPIPE and the open flag is cleared.
 *
 * Expected result:
 * - The blocked read returns -EPIPE and the pipe stays closed.
 *
 * @see k_pipe_close()
 * @see k_pipe_read()
 *
 * @verifies ZEP-SRS-32-6
 * @verifies ZEP-SRS-32-8
 * @verifies ZEP-SRS-32-9
 */
ZTEST(k_pipe_concurrency, test_pipe_close_on_read)
{
	k_tid_t tid;
	uint8_t buffer[DUMMY_DATA_SIZE];
	uint8_t res;

	k_pipe_init(&pipe, buffer, sizeof(buffer));
	tid = k_thread_create(&thread, stack, K_THREAD_STACK_SIZEOF(stack),
		thread_close, &pipe, NULL, NULL, K_PRIO_COOP(0), 0, K_MSEC(100));
	zassert_true(tid, "k_thread_create failed");
	zassert_true(k_pipe_read(&pipe, &res, sizeof(res), K_MSEC(1000)) == -EPIPE,
		"Read on closed pipe should return -EPIPE");
	k_thread_join(tid, K_FOREVER);
	zassert_true((pipe.flags & PIPE_FLAG_OPEN) == 0,
		"Pipe should continue to be closed after all waiters have been released");
}

/**
 * @brief Verify closing a pipe releases a blocked writer with -EPIPE.
 *
 * @details
 * A writer blocked on a full pipe must be woken and returned -EPIPE when another
 * thread closes the pipe, and the pipe must remain closed afterwards.
 *
 * Test steps:
 * - Fill the pipe, then start a thread that closes it after a short delay.
 * - Block in k_pipe_write() on the full pipe.
 * - Verify the write returns -EPIPE and the open flag is cleared.
 *
 * Expected result:
 * - The blocked write returns -EPIPE and the pipe stays closed.
 *
 * @see k_pipe_close()
 * @see k_pipe_write()
 *
 * @verifies ZEP-SRS-32-5
 * @verifies ZEP-SRS-32-8
 * @verifies ZEP-SRS-32-9
 */
ZTEST(k_pipe_concurrency, test_pipe_close_on_write)
{
	k_tid_t tid;
	uint8_t buffer[DUMMY_DATA_SIZE];
	uint8_t garbage[DUMMY_DATA_SIZE];

	k_pipe_init(&pipe, buffer, sizeof(buffer));
	zassert_true(sizeof(garbage) == k_pipe_write(&pipe, garbage, sizeof(garbage), K_MSEC(1000)),
		"Failed to write to pipe");

	tid = k_thread_create(&thread, stack, K_THREAD_STACK_SIZEOF(stack),
		thread_close, &pipe, NULL, NULL, K_PRIO_COOP(0), 0, K_MSEC(100));
	zassert_true(tid, "k_thread_create failed");
	zassert_true(k_pipe_write(&pipe, garbage, sizeof(garbage), K_MSEC(1000)) == -EPIPE,
		"write should return -EPIPE, when pipe is closed");
	k_thread_join(tid, K_FOREVER);
	zassert_true((pipe.flags & PIPE_FLAG_OPEN) == 0,
		"pipe should continue to be closed after all waiters have been released");
}

/**
 * @brief Verify resetting a pipe releases a blocked reader with -ECANCELED.
 *
 * @details
 * Unlike close, k_pipe_reset() cancels in-flight waiters but leaves the pipe
 * open: a reader blocked on an empty pipe must return -ECANCELED, and afterwards
 * the reset flag is cleared and the pipe is still open.
 *
 * Test steps:
 * - Start a thread that resets the pipe after a short delay.
 * - Block in k_pipe_read() on the empty pipe.
 * - Verify the read returns -ECANCELED and the pipe is still open.
 *
 * Expected result:
 * - The blocked read returns -ECANCELED; the pipe remains open.
 *
 * @see k_pipe_reset()
 * @see k_pipe_read()
 *
 * @verifies ZEP-SRS-32-7
 * @verifies ZEP-SRS-32-10
 */
ZTEST(k_pipe_concurrency, test_pipe_reset_on_read)
{
	k_tid_t tid;
	uint8_t buffer[DUMMY_DATA_SIZE];
	uint8_t res;

	k_pipe_init(&pipe, buffer, sizeof(buffer));

	tid = k_thread_create(&thread, stack, K_THREAD_STACK_SIZEOF(stack),
		thread_reset, &pipe, NULL, NULL, K_PRIO_COOP(0), 0, K_MSEC(100));
	zassert_true(tid, "k_thread_create failed");
	zassert_true(k_pipe_read(&pipe, &res, sizeof(res), K_MSEC(1000)) == -ECANCELED,
		"reset on read should return -ECANCELED");
	k_thread_join(tid, K_FOREVER);
	zassert_true((pipe.flags & PIPE_FLAG_RESET) == 0,
		"pipe should not have reset flag after all waiters are done");
	zassert_true((pipe.flags & PIPE_FLAG_OPEN) != 0,
		"pipe should continue to be open after pipe is reset");
}

/**
 * @brief Verify resetting a pipe releases a blocked writer with -ECANCELED.
 *
 * @details
 * k_pipe_reset() cancels a writer blocked on a full pipe with -ECANCELED while
 * leaving the pipe open for reuse.
 *
 * Test steps:
 * - Fill the pipe, then start a thread that resets it after a short delay.
 * - Block in k_pipe_write() on the full pipe.
 * - Verify the write returns -ECANCELED and the pipe is still open.
 *
 * Expected result:
 * - The blocked write returns -ECANCELED; the pipe remains open.
 *
 * @see k_pipe_reset()
 * @see k_pipe_write()
 *
 * @verifies ZEP-SRS-32-5
 * @verifies ZEP-SRS-32-7
 * @verifies ZEP-SRS-32-10
 */
ZTEST(k_pipe_concurrency, test_pipe_reset_on_write)
{
	k_tid_t tid;
	uint8_t buffer[DUMMY_DATA_SIZE];
	uint8_t garbage[DUMMY_DATA_SIZE];

	k_pipe_init(&pipe, buffer, sizeof(buffer));
	zassert_true(sizeof(garbage) == k_pipe_write(&pipe, garbage, sizeof(garbage), K_MSEC(1000)),
		"Failed to write to pipe");

	tid = k_thread_create(&thread, stack, K_THREAD_STACK_SIZEOF(stack),
		thread_reset, &pipe, NULL, NULL, K_PRIO_COOP(0), 0, K_MSEC(100));
	zassert_true(tid, "k_thread_create failed");
	zassert_true(k_pipe_write(&pipe, garbage, sizeof(garbage), K_MSEC(1000)) == -ECANCELED,
		"reset on write should return -ECANCELED");
	k_thread_join(tid, K_FOREVER);
	zassert_true((pipe.flags & PIPE_FLAG_RESET) == 0,
		"pipe should not have reset flag after all waiters are done");
	zassert_true((pipe.flags & PIPE_FLAG_OPEN) != 0,
		"pipe should continue to be open after pipe is reset");
}

/**
 * @brief Verify a reader waiting for more data is satisfied by later writes.
 *
 * @details
 * A reader requesting a full buffer blocks until enough bytes arrive. The test
 * supplies the data in two partial writes and confirms the reader completes once
 * the requested amount is available.
 *
 * Test steps:
 * - Start a reader thread requesting DUMMY_DATA_SIZE bytes.
 * - Write half the bytes, wait, then write the other half.
 * - Join the reader and confirm it received the full amount.
 *
 * Expected result:
 * - The reader completes after the data is provided across multiple writes.
 *
 * @see k_pipe_read()
 * @see k_pipe_write()
 *
 * @verifies ZEP-SRS-32-4
 */
ZTEST(k_pipe_concurrency, test_pipe_partial_read)
{
	k_tid_t tid;
	uint8_t buffer[DUMMY_DATA_SIZE];
	uint8_t garbage[DUMMY_DATA_SIZE];
	size_t write_size = sizeof(garbage)/2;

	k_pipe_init(&pipe, buffer, sizeof(buffer));
	tid = k_thread_create(&thread, stack, K_THREAD_STACK_SIZEOF(stack),
		thread_read, &pipe, NULL, NULL, K_PRIO_COOP(0), 0, K_NO_WAIT);

	zassert_true(k_pipe_write(&pipe, garbage, write_size, K_NO_WAIT) == write_size,
		"write to pipe failed");
	k_msleep(partial_wait_time/4);
	zassert_true(k_pipe_write(&pipe, garbage, write_size, K_NO_WAIT) == write_size,
		"k_k_pipe_write should return number of bytes written");
	k_thread_join(tid, K_FOREVER);
}

/**
 * @brief Verify a writer waiting for space is satisfied by later reads.
 *
 * @details
 * A writer blocked because the pipe is full must complete once a reader drains
 * enough space. The test fills the pipe, starts a writer, then frees space with
 * partial reads and confirms the writer completes.
 *
 * Test steps:
 * - Fill the pipe, then start a writer thread.
 * - Read half the bytes, wait, then read more to free space.
 * - Join the writer and confirm it completed.
 *
 * Expected result:
 * - The writer completes once space becomes available.
 *
 * @see k_pipe_write()
 * @see k_pipe_read()
 *
 * @verifies ZEP-SRS-32-3
 */
ZTEST(k_pipe_concurrency, test_pipe_partial_write)
{
	k_tid_t tid;
	uint8_t buffer[DUMMY_DATA_SIZE];
	uint8_t garbage[DUMMY_DATA_SIZE];
	size_t read_size = sizeof(garbage)/2;

	k_pipe_init(&pipe, buffer, sizeof(buffer));

	zassert_true(k_pipe_write(&pipe, garbage, sizeof(garbage), K_NO_WAIT) == sizeof(garbage),
		"Failed to write to pipe");
	tid = k_thread_create(&thread, stack, K_THREAD_STACK_SIZEOF(stack),
		thread_write, &pipe, NULL, NULL, K_PRIO_COOP(0), 0, K_NO_WAIT);

	zassert_true(k_pipe_read(&pipe, garbage, read_size, K_NO_WAIT) == read_size,
		"Failed to read from pipe");
	k_msleep(partial_wait_time/2);
	zassert_true(k_pipe_read(&pipe, garbage, read_size, K_NO_WAIT) == read_size,
		"failed t read from pipe");
	k_thread_join(tid, K_FOREVER);
}

static volatile bool zero_thread_read;
static volatile bool zero_thread_write;
static void zero_thread_read_write(void *arg1, void *arg2, void *arg3)
{
	uint8_t tmp[DUMMY_DATA_SIZE];
	struct k_pipe *input = (struct k_pipe *)arg1;
	struct k_pipe *output = (struct k_pipe *)arg2;

	memset(tmp, 0xBB, sizeof(tmp));

	zero_thread_read = true;
	zassert_true(k_pipe_read(input, tmp, sizeof(tmp), K_FOREVER) == sizeof(tmp),
	      "Failed to read from pipe");
	zero_thread_write = true;
	zassert_true(k_pipe_write(output, tmp, sizeof(tmp), K_FOREVER) == sizeof(tmp),
	      "Failed to write to pipe");
}

/**
 * @brief Verify an unbuffered (zero-size) pipe transfers data thread-to-thread.
 *
 * @details
 * A pipe initialized with no backing buffer has no storage, so a write must
 * block until a reader is present and copy data directly between threads. The
 * test wires a worker that reads from one zero-size pipe and writes to another,
 * and confirms data passes intact in both directions. Skipped when
 * CONFIG_KERNEL_COHERENCE is set, where unbuffered pipes are unsupported.
 *
 * Test steps:
 * - Initialize two zero-size pipes and start a worker that reads then writes.
 * - Write into the input pipe and read from the output pipe (both K_FOREVER).
 * - Verify the data round-trips unchanged and the worker ran both operations.
 *
 * Expected result:
 * - Data is transferred directly between threads and matches end to end.
 *
 * @see k_pipe_init()
 * @see k_pipe_read()
 * @see k_pipe_write()
 *
 * @verifies ZEP-SRS-32-3
 * @verifies ZEP-SRS-32-4
 */
ZTEST(k_pipe_concurrency, test_pipe_zero_size_read_write)
{
	k_tid_t tid;
	struct k_pipe input_pipe;
	struct k_pipe output_pipe;
	uint8_t input[DUMMY_DATA_SIZE];
	uint8_t output[DUMMY_DATA_SIZE];

#ifdef CONFIG_KERNEL_COHERENCE
	/* Zero size pipes are not supported due to requiring cache
	 * management on data buffers as the buffers can reside in
	 * incoherent memory. So skip this test.
	 */
	ztest_test_skip();
#endif

	memset(input, 0xAA, sizeof(input));
	memset(output, 0xCC, sizeof(output));
	k_pipe_init(&input_pipe, NULL, 0);
	k_pipe_init(&output_pipe, NULL, 0);

	tid = k_thread_create(&thread, stack, K_THREAD_STACK_SIZEOF(stack),
		zero_thread_read_write, &input_pipe, &output_pipe, NULL, K_PRIO_COOP(0), 0,
		K_NO_WAIT);

	zassert_true(sizeof(input) == k_pipe_write(&input_pipe, input, sizeof(input), K_FOREVER),
	      "Failed to write to pipe");
	zassert_true(sizeof(output) == k_pipe_read(&output_pipe, output, sizeof(output), K_FOREVER),
	      "Failed to read from pipe");
	zassert_true(memcmp(input, output, sizeof(input)) == 0,
		"Unexpected data received from pipe");

	zassert_true(zero_thread_read && zero_thread_write,
		"Thread did not execute expected read/write operations");

	k_thread_join(tid, K_FOREVER);
}

#ifdef CONFIG_POLL
static struct k_poll_event poll_event;
static int poll_rc;
static struct k_thread poll_threads[3];
static K_THREAD_STACK_ARRAY_DEFINE(poll_stacks, 3, 1024 + CONFIG_TEST_EXTRA_STACK_SIZE);

static void thread_poll(void *arg1, void *arg2, void *arg3)
{
	ARG_UNUSED(arg1);
	ARG_UNUSED(arg2);
	ARG_UNUSED(arg3);

	poll_rc = k_poll(&poll_event, 1, K_MSEC(partial_wait_time));
}

static void thread_poll_read(void *arg1, void *arg2, void *arg3)
{
	ARG_UNUSED(arg3);

	zassert_equal(k_pipe_read(arg1, arg2, DUMMY_DATA_SIZE, K_FOREVER), DUMMY_DATA_SIZE,
		      "Failed to read from the pipe");
}

static void thread_poll_write(void *arg1, void *arg2, void *arg3)
{
	ARG_UNUSED(arg3);

	zassert_equal(k_pipe_write(arg1, arg2, DUMMY_DATA_SIZE, K_FOREVER), DUMMY_DATA_SIZE,
		      "Failed to write to the pipe");
}

ZTEST(k_pipe_concurrency, test_pipe_poll_direct_transfer)
{
	k_tid_t poll_tid;
	k_tid_t reader_tid;
	k_tid_t writer_tid;
	uint8_t input[DUMMY_DATA_SIZE];
	uint8_t output[DUMMY_DATA_SIZE] = {};

#ifdef CONFIG_KERNEL_COHERENCE
	ztest_test_skip();
#endif

	memset(input, 0xAA, sizeof(input));
	poll_rc = -EINVAL;
	k_pipe_init(&pipe, NULL, 0);
	k_poll_event_init(&poll_event, K_POLL_TYPE_PIPE_DATA_AVAILABLE, K_POLL_MODE_NOTIFY_ONLY,
			  &pipe);

	poll_tid = k_thread_create(&poll_threads[0], poll_stacks[0],
				   K_THREAD_STACK_SIZEOF(poll_stacks[0]), thread_poll, NULL, NULL,
				   NULL, K_PRIO_COOP(0), 0, K_NO_WAIT);
	reader_tid = k_thread_create(&poll_threads[1], poll_stacks[1],
				     K_THREAD_STACK_SIZEOF(poll_stacks[1]), thread_poll_read,
				     &pipe, output, NULL, K_PRIO_COOP(1), 0, K_NO_WAIT);
	writer_tid = k_thread_create(&poll_threads[2], poll_stacks[2],
				     K_THREAD_STACK_SIZEOF(poll_stacks[2]), thread_poll_write,
				     &pipe, input, NULL, K_PRIO_COOP(1), 0, K_NO_WAIT);

	k_thread_join(poll_tid, K_FOREVER);
	k_thread_join(reader_tid, K_FOREVER);
	k_thread_join(writer_tid, K_FOREVER);

	zassert_equal(poll_rc, -EAGAIN, "Poller woken although no data reached the pipe");
	zassert_mem_equal(input, output, sizeof(input), "Unexpected data received from pipe");
}

ZTEST(k_pipe_concurrency, test_pipe_poll_write_with_data)
{
	k_tid_t writer_tid;
	static uint8_t buffer[DUMMY_DATA_SIZE];
	uint8_t data[DUMMY_DATA_SIZE] = {};
	int rc;

	k_pipe_init(&pipe, buffer, sizeof(buffer));
	k_poll_event_init(&poll_event, K_POLL_TYPE_PIPE_DATA_AVAILABLE, K_POLL_MODE_NOTIFY_ONLY,
			  &pipe);

	writer_tid = k_thread_create(&poll_threads[0], poll_stacks[0],
				     K_THREAD_STACK_SIZEOF(poll_stacks[0]), thread_poll_write,
				     &pipe, data, NULL, K_PRIO_PREEMPT(0), 0, K_NO_WAIT);
	rc = k_poll(&poll_event, 1, K_MSEC(partial_wait_time));
	k_thread_join(writer_tid, K_FOREVER);

	zassert_equal(rc, 0, "Poller not woken although data reached the pipe");
	zassert_equal(poll_event.state, K_POLL_STATE_PIPE_DATA_AVAILABLE,
		      "Poll event does not report available data");
}
#endif /* CONFIG_POLL */

/**
 * @}
 */
```

## src/stress.c
```c
/*
 * Copyright (c) 2024 Måns Ansgariusson <mansgariusson@gmail.com>
 *
 * SPDX-License-Identifier: Apache-2.0
 */
#include <stdint.h>
#include <zephyr/ztest.h>
#include <zephyr/kernel.h>
#include <zephyr/ztress.h>
#include <zephyr/logging/log.h>
#include <zephyr/random/random.h>
#include <zephyr/timing/timing.h>

#define WRITE_LEN 512
#define READ_LEN  512

LOG_MODULE_REGISTER(k_k_pipe_stress, LOG_LEVEL_INF);

ZTEST_SUITE(k_pipe_stress, NULL, NULL, NULL, NULL, NULL);

static struct k_pipe pipe;

/**
 * @addtogroup tests_kernel_pipe
 * @{
 */

/**
 * @brief Stress k_pipe_write() with a large transfer.
 *
 * @details
 * Repeatedly writes until a large payload has been pushed into the pipe,
 * exercising the write path in bulk and confirming every write makes forward
 * progress. Elapsed time is logged for reference.
 *
 * Test steps:
 * - Initialize a pipe sized for the payload.
 * - Write WRITE_LEN bytes, looping until all bytes are accepted.
 *
 * Expected result:
 * - Every write returns a positive count and the full payload is written.
 *
 * @see k_pipe_write()
 */
ZTEST(k_pipe_stress, test_pipe_write)
{
	int rc;
	const size_t len = WRITE_LEN;
	uint8_t buffer[WRITE_LEN];
	uint8_t buf[WRITE_LEN];
	size_t sent;
	uint32_t start_cycles, end_cycles;

	k_pipe_init(&pipe, buffer, sizeof(buffer));
	start_cycles = k_uptime_get_32();
	sent = 0;
	while (sent < len) {
		rc = k_pipe_write(&pipe, &buf[sent], len - sent, K_FOREVER);
		zassert_true(rc > 0, "Failed to write to pipe");
		sent += rc;
	}
	end_cycles = k_uptime_get_32();
	LOG_INF("Elapsed cycles: %u\n", end_cycles - start_cycles);
}

/**
 * @brief Stress alternating write/read cycles through a pipe.
 *
 * @details
 * Runs many iterations of filling the pipe and draining it, exercising the
 * read/write paths repeatedly to surface throughput or state-tracking issues.
 * Elapsed time is logged for reference.
 *
 * Test steps:
 * - For 100 iterations: write READ_LEN bytes (looping) then read them all back.
 *
 * Expected result:
 * - Every read and write makes forward progress across all iterations.
 *
 * @see k_pipe_write()
 * @see k_pipe_read()
 */
ZTEST(k_pipe_stress, test_pipe_read)
{
	int rc;
	const size_t len = READ_LEN;
	uint8_t buffer[READ_LEN];
	uint8_t buf[READ_LEN];
	size_t sent, read;
	uint32_t start_cycles, end_cycles;

	k_pipe_init(&pipe, buffer, sizeof(buffer));
	start_cycles = k_uptime_get_32();
	for (int i = 0; i < 100; i++) {
		sent = 0;
		while (sent < len) {
			rc = k_pipe_write(&pipe, &buf[sent], len - sent, K_FOREVER);
			zassert_true(rc > 0, "Failed to write to pipe");
			sent += rc;
		}
		read = 0;
		while (read < len) {
			rc = k_pipe_read(&pipe, &buf[read], len - read, K_FOREVER);
			zassert_true(rc > 0, "Failed to read from pipe");
			read += rc;
		}
	}
	end_cycles = k_uptime_get_32();
	LOG_INF("Elapsed cycles: %u\n", end_cycles - start_cycles);
}

/**
 * @}
 */
```

## src/test_pipe.h
```c
/*
 * Copyright (c) 2018 Intel Corporation
 *
 * SPDX-License-Identifier: Apache-2.0
 */

#ifndef TEST_PIPE_H
#define TEST_PIPE_H

#include <kernel.h>

#define PIPE_LEN 16

extern void test_pipe_thread2thread(void);
extern void test_pipe_put_fail(void);
extern void test_pipe_get_fail(void);
extern void test_pipe_block_put(void);
extern void test_pipe_block_put_sema(void);
extern void test_pipe_get_put(void);

/* k objects */


#endif /* TEST_PIPE_H */
```

## src/test_pipe_avail.c
```c
/*
 * Copyright (c) 2020 Friedt Professional Engineering Services, Inc
 *
 * SPDX-License-Identifier: Apache-2.0
 */

/**
 * @brief Tests for the Pipe read / write availability
 * @ingroup kernel_pipe_tests
 * @{
 */

#include <zephyr/ztest.h>

static ZTEST_DMEM unsigned char __aligned(4) data[] = "abcdefgh";
static struct k_pipe pipe = {
	.buffer = data,
	.size = sizeof(data) - 1 /* '\0' */,
};

static struct k_pipe bufferless;

static struct k_pipe bufferless1 = {
	.buffer = data,
	.size = 0,
};

/**
 * @brief Pipes with no buffer or size 0 should return 0 bytes available
 *
 * Pipes can be created to be bufferless (i.e. @ref k_pipe.buffer is `NULL`
 * or @ref k_pipe.size is 0).
 *
 * If either of those conditions is true, then @ref k_pipe_read_avail and
 * @ref k_pipe_write_avail should return 0.
 *
 * @note
 * A distinction can be made between buffered and bufferless pipes in that
 * @ref k_pipe_read_avail and @ref k_pipe_write_avail will never
 * simultaneously return 0 for a buffered pipe, but they will both return 0
 * for an unbuffered pipe.
 */
ZTEST(pipe_api, test_pipe_avail_no_buffer)
{
	size_t r_avail;
	size_t w_avail;

	r_avail = k_pipe_read_avail(&bufferless);
	zassert_equal(r_avail, 0, "read: expected: 0 actual: %u", r_avail);

	w_avail = k_pipe_write_avail(&bufferless);
	zassert_equal(w_avail, 0, "write: expected: 0 actual: %u", w_avail);

	r_avail = k_pipe_read_avail(&bufferless1);
	zassert_equal(r_avail, 0, "read: expected: 0 actual: %u", r_avail);

	w_avail = k_pipe_write_avail(&bufferless1);
	zassert_equal(w_avail, 0, "write: expected: 0 actual: %u", w_avail);
}

/**
 * @brief Test available read / write space for r < w
 *
 * This test case is for buffered @ref k_pipe objects and covers the case
 * where @ref k_pipe.read_index is less than @ref k_pipe.write_index.
 *
 * In this case, @ref k_pipe.bytes_used is not relevant.
 *
 *      r     w
 *     |a|b|c|d|e|f|g|h|
 *     |0|1|2|3|4|5|6|7|
 *
 * As shown above, the pipe will be able to read 3 bytes without blocking
 * and write 5 bytes without blocking.
 *
 * Thus
 *     r_avail = w - r = 3
 *     would read: a b c d
 *
 *     w_avail = N - (w - r) = 5
 *     would overwrite: e f g h
 */
ZTEST(pipe_api, test_pipe_avail_r_lt_w)
{
	size_t r_avail;
	size_t w_avail;

	pipe.read_index = 0;
	pipe.write_index = 3;
	/* pipe.bytes_used is irrelevant */

	r_avail = k_pipe_read_avail(&pipe);
	zassert_equal(r_avail, 3, "read: expected: 3 actual: %u", r_avail);

	w_avail = k_pipe_write_avail(&pipe);
	zassert_equal(w_avail, 5, "write: expected: 5 actual: %u", w_avail);
}

/**
 * @brief Test available read / write space for w < r
 *
 * This test case is for buffered @ref k_pipe objects and covers the case
 * where @ref k_pipe.write_index is less than @ref k_pipe.read_index.
 *
 * In this case, @ref k_pipe.bytes_used is not relevant.
 *
 *      w     r
 *     |a|b|c|d|e|f|g|h|
 *     |0|1|2|3|4|5|6|7|
 *
 *
 * As shown above, the pipe will fbe able to read 5 bytes without blocking
 * and write 3 bytes without blocking.
 *
 * Thus
 *     r_avail = N - (r - w) = 5
 *     would read: e f g h
 *
 *     w_avail = r - w = 3
 *     would overwrite: a b c d
 */
ZTEST(pipe_api, test_pipe_avail_w_lt_r)
{
	size_t r_avail;
	size_t w_avail;

	pipe.read_index = 3;
	pipe.write_index = 0;
	/* pipe.bytes_used is irrelevant */

	r_avail = k_pipe_read_avail(&pipe);
	zassert_equal(r_avail, 5, "read: expected: 4 actual: %u", r_avail);

	w_avail = k_pipe_write_avail(&pipe);
	zassert_equal(w_avail, 3, "write: expected: 4 actual: %u", w_avail);
}

/**
 * @brief Test available read / write space for `r == w` and an empty buffer
 *
 * This test case is for buffered @ref k_pipe objects and covers the case
 * where @ref k_pipe.read_index is equal to @ref k_pipe.write_index and
 * @ref k_pipe.bytes_used is zero.
 *
 * In this case, @ref k_pipe.bytes_used is relevant because the read and
 * write indices are equal.
 *
 *            r
 *            w
 *     |a|b|c|d|e|f|g|h|
 *     |0|1|2|3|4|5|6|7|
 *
 * Regardless of whether the buffer is full or empty, the following holds:
 *
 *     r_avail = bytes_used
 *     w_avail = N - bytes_used
 *
 * Thus:
 *     r_avail = 0
 *     would read:
 *
 *     w_avail = N - 0 = 8
 *     would overwrite: e f g h a b c d
 */
ZTEST(pipe_api, test_pipe_avail_r_eq_w_empty)
{
	size_t r_avail;
	size_t w_avail;

	pipe.read_index = 4;
	pipe.write_index = 4;
	pipe.bytes_used = 0;

	r_avail = k_pipe_read_avail(&pipe);
	zassert_equal(r_avail, 0, "read: expected: 0 actual: %u", r_avail);

	w_avail = k_pipe_write_avail(&pipe);
	zassert_equal(w_avail, 8, "write: expected: 8 actual: %u", w_avail);
}

/**
 * @brief Test available read / write space for `r == w` and a full buffer
 *
 * This test case is for buffered @ref k_pipe objects and covers the case
 * where @ref k_pipe.read_index is equal to @ref k_pipe.write_index and
 * @ref k_pipe.bytes_used is equal to @ref k_pipe.size.
 *
 * In this case, @ref k_pipe.bytes_used is relevant because the read and
 * write indices are equal.
 *
 *            r
 *            w
 *     |a|b|c|d|e|f|g|h|
 *     |0|1|2|3|4|5|6|7|
 *
 * Regardless of whether the buffer is full or empty, the following holds:
 *
 *     r_avail = bytes_used
 *     w_avail = N - bytes_used
 *
 * Thus
 *     r_avail = N = 8
 *     would read: e f g h a b c d
 *
 *     w_avail = N - 8 = 0
 *     would overwrite:
 */
ZTEST(pipe_api, test_pipe_avail_r_eq_w_full)
{
	size_t r_avail;
	size_t w_avail;

	pipe.read_index = 4;
	pipe.write_index = 4;
	pipe.bytes_used = pipe.size;

	r_avail = k_pipe_read_avail(&pipe);
	zassert_equal(r_avail, 8, "read: expected: 8 actual: %u", r_avail);

	w_avail = k_pipe_write_avail(&pipe);
	zassert_equal(w_avail, 0, "write: expected: 0 actual: %u", w_avail);
}

/**
 * @}
 */
```

## src/test_pipe_bench.c
```c
/*
 * Copyright (c) 2016 Intel Corporation
 *
 * SPDX-License-Identifier: Apache-2.0
 */

#include <ztest.h>
#include <kernel_structs.h>
#include <ksched.h>
#include <wait_q.h>

#if CONFIG_X86
#define TIMING_INFO_PRE_READ()
#define TIMING_INFO_OS_GET_TIME() (_tsc_read())
#elif CONFIG_ARM
#define TIMING_INFO_PRE_READ()
#define TIMING_INFO_OS_GET_TIME()      (k_cycle_get_32())
#endif

#define STACK_SIZE      1024
#define PIPE_LEN 16
K_PIPE_DEFINE(kpipe4, PIPE_LEN, 4);
K_THREAD_STACK_DEFINE(tstack4, STACK_SIZE);
K_THREAD_STACK_DEFINE(tstack5, STACK_SIZE);
K_THREAD_STACK_DEFINE(tstack6, STACK_SIZE);
K_THREAD_STACK_DEFINE(tstack7, STACK_SIZE);
__kernel struct k_thread tdata4;
__kernel struct k_thread tdata5;
__kernel struct k_thread tdata6;
__kernel struct k_thread tdata7;


static void thread_handler(void *p1, void *p2, void *p3)
{
	while (1) {
		k_yield();
	}
}

void test_bench(void)
{
	struct k_thread *thread;

	k_tid_t tid1 = k_thread_create(&tdata4, tstack4, STACK_SIZE,
					thread_handler, NULL, NULL, NULL,
					K_PRIO_PREEMPT(1), 0, 0);

	k_tid_t tid2 = k_thread_create(&tdata5, tstack5, STACK_SIZE,
					thread_handler, NULL, NULL, NULL,
					K_PRIO_PREEMPT(2), 0, 0);

	k_tid_t tid3 = k_thread_create(&tdata6, tstack6, STACK_SIZE,
					thread_handler, NULL, NULL, NULL,
					K_PRIO_PREEMPT(3), 0, 0);

	k_tid_t tid4 = k_thread_create(&tdata7, tstack7, STACK_SIZE,
					thread_handler, &kpipe4, NULL, NULL,
					K_PRIO_PREEMPT(4), 0, 0);

	k_sleep(10);

	TIMING_INFO_PRE_READ();
	u32_t pre_pend_time1 = TIMING_INFO_OS_GET_TIME();

	_pend_thread((struct k_thread *) tid1,
			&kpipe4.wait_q.writers, K_NO_WAIT);

	TIMING_INFO_PRE_READ();
	u32_t post_pend_time1 = TIMING_INFO_OS_GET_TIME();
	u32_t time_for_pend1 = (post_pend_time1 - pre_pend_time1);

	TIMING_INFO_PRE_READ();
	u32_t pre_pend_time2 = TIMING_INFO_OS_GET_TIME();

	_pend_thread((struct k_thread *) tid2,
			&kpipe4.wait_q.writers, K_NO_WAIT);

	TIMING_INFO_PRE_READ();
	u32_t post_pend_time2 = TIMING_INFO_OS_GET_TIME();
	u32_t time_for_pend2 = (post_pend_time2 - pre_pend_time2);

	TIMING_INFO_PRE_READ();
	u32_t pre_pend_time3 = TIMING_INFO_OS_GET_TIME();

	_pend_thread((struct k_thread *) tid3,
			&kpipe4.wait_q.writers, K_NO_WAIT);

	TIMING_INFO_PRE_READ();
	u32_t post_pend_time3 = TIMING_INFO_OS_GET_TIME();
	u32_t time_for_pend3 = (post_pend_time3 - pre_pend_time3);

	TIMING_INFO_PRE_READ();
	u32_t pre_pend_time4 = TIMING_INFO_OS_GET_TIME();

	_pend_thread((struct k_thread *) tid4,
			&kpipe4.wait_q.writers, K_NO_WAIT);

	TIMING_INFO_PRE_READ();
	u32_t post_pend_time4 = TIMING_INFO_OS_GET_TIME();
	u32_t time_for_pend4 = (post_pend_time4 - pre_pend_time4);

	printk("time spent during pending for thread1  %d\n", time_for_pend1);
	printk("time spent during pending for thread2  %d\n", time_for_pend2);
	printk("time spent during pending for thread3  %d\n", time_for_pend3);
	printk("time spent during pending for thread4  %d\n", time_for_pend4);

	while ((thread = _waitq_head(&kpipe4.wait_q.writers)) != NULL) {
		TIMING_INFO_PRE_READ();
		u32_t pre_unpend_time = TIMING_INFO_OS_GET_TIME();

		_unpend_thread(thread);

		TIMING_INFO_PRE_READ();
		u32_t post_unpend_time = TIMING_INFO_OS_GET_TIME();

		u32_t time_for_unpend = post_unpend_time - pre_unpend_time;

		printk("time spent during unpend of thread %d\n",
							time_for_unpend);
	}
}
```
