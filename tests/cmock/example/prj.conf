## CMakeLists.txt
```
# SPDX-License-Identifier: Apache-2.0

cmake_minimum_required(VERSION 3.20.0)
find_package(Zephyr REQUIRED HINTS $ENV{ZEPHYR_BASE})
project(test)

if(CONFIG_CMOCK)
  unity_generate_test_runner(src/unit.c)
  cmock_generate_mocks(${ZEPHYR_BASE}/include/kernel.h .)
  target_sources(app PRIVATE src/unit.c)
else()
  unity_generate_test_runner(src/integration.c)
  target_sources(app PRIVATE src/integration.c)
endif()
```

## prj.conf
```kconfig
CONFIG_UNITY=y
```

## src/integration.c
```c
/*
 * Copyright (c) 2022 Martin Schröder Consulting
 *
 * SPDX-License-Identifier: Apache-2.0
 */
#include <unity.h>

void test_integration_example(void)
{
	TEST_ASSERT_EQUAL(0, 0);
}
```

## src/unit.c
```c
/*
 * Copyright (c) 2022 Martin Schröder Consulting
 *
 * SPDX-License-Identifier: Apache-2.0
 */
#include <unity.h>
#include <mock_kernel.h>

/**
 * this is a unit test so we will include the file directly
 * this is the only place where we do this - it is the optimal solution.
 * #include "../../../../../some/driver/we/are/unit/testing/driver.c"
 **/

void test_example_object_init_should_return_einval_on_invalid_args(void)
{
	/**
	 * Here you can use mocks of any kernel functions
	 * __wrap_k_mutex_init_ExpectAndReturn(&inst.mx, 0);
	 * TEST_ASSERT_EQUAL(0, _some_driver_function(&inst));
	 **/
}
```
