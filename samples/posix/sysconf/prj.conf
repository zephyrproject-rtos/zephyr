## CMakeLists.txt
```
# SPDX-License-Identifier: Apache-2.0

cmake_minimum_required(VERSION 3.20.0)

find_package(Zephyr REQUIRED HINTS $ENV{ZEPHYR_BASE})
project(sysconf)

FILE(GLOB app_sources src/*.c)
target_sources(app PRIVATE ${app_sources})
```

## sample.yaml
```
sample:
  description: Posix sysconf sample
  name: posix sysconf
common:
  tags: posix
  filter: not CONFIG_ARCH_POSIX
  integration_platforms:
    - native_posix_64
    - qemu_riscv64
  harness: console
  harness_config:
    type: one_line
    regex:
      - "\\[errno: \\d\\d\\d] _SC_.*\\(\\d+\\) = .*"
tests:
  sample.posix.sysconf:
    tags: sysconf
```

## prj.conf
```kconfig
CONFIG_POSIX_API=y
```

## src/main.c
```c
/*
 * Copyright (c) 2023 Meta
 *
 * SPDX-License-Identifier: Apache-2.0
 */

#include <stdio.h>
#include <stdlib.h>
#include <errno.h>
#include <unistd.h>

const char *get_sysconf_name(int sc);
int main(void)
{
	printk("\nPrint everything from sysconf:\n\n");

	for (int i = 0; errno != EINVAL; i++) {
		printk("[errno: %03d] %s(%d) = %ld\n", errno, get_sysconf_name(i), i, sysconf(i));
	}

	return 0;
}
```

## src/sysconf_name.c
```c
/*
 * Copyright (c) 2023 Meta
 *
 * SPDX-License-Identifier: Apache-2.0
 */

#include <unistd.h>

#include <zephyr/toolchain/common.h>

const char *get_sysconf_name(int sc)
{
	switch (sc) {
	case _SC_2_C_BIND:
		return STRINGIFY(_SC_2_C_BIND);
	case _SC_2_C_DEV:
		return STRINGIFY(_SC_2_C_DEV);
	case _SC_2_CHAR_TERM:
		return STRINGIFY(_SC_2_CHAR_TERM);
	case _SC_2_FORT_DEV:
		return STRINGIFY(_SC_2_FORT_DEV);
	case _SC_2_FORT_RUN:
		return STRINGIFY(_SC_2_FORT_RUN);
	case _SC_2_LOCALEDEF:
		return STRINGIFY(_SC_2_LOCALEDEF);
	case _SC_2_PBS:
		return STRINGIFY(_SC_2_PBS);
	case _SC_2_PBS_ACCOUNTING:
		return STRINGIFY(_SC_2_PBS_ACCOUNTING);
	case _SC_2_PBS_CHECKPOINT:
		return STRINGIFY(_SC_2_PBS_CHECKPOINT);
	case _SC_2_PBS_LOCATE:
		return STRINGIFY(_SC_2_PBS_LOCATE);
	case _SC_2_PBS_MESSAGE:
		return STRINGIFY(_SC_2_PBS_MESSAGE);
	case _SC_2_PBS_TRACK:
		return STRINGIFY(_SC_2_PBS_TRACK);
	case _SC_2_SW_DEV:
		return STRINGIFY(_SC_2_SW_DEV);
	case _SC_2_UPE:
		return STRINGIFY(_SC_2_UPE);
	case _SC_2_VERSION:
		return STRINGIFY(_SC_2_VERSION);
	case _SC_ADVISORY_INFO:
		return STRINGIFY(_SC_ADVISORY_INFO);
	case _SC_AIO_LISTIO_MAX:
		return STRINGIFY(_SC_AIO_LISTIO_MAX);
	case _SC_AIO_MAX:
		return STRINGIFY(_SC_AIO_MAX);
	case _SC_AIO_PRIO_DELTA_MAX:
		return STRINGIFY(_SC_AIO_PRIO_DELTA_MAX);
	case _SC_ARG_MAX:
		return STRINGIFY(_SC_ARG_MAX);
	case _SC_ASYNCHRONOUS_IO:
		return STRINGIFY(_SC_ASYNCHRONOUS_IO);
	case _SC_ATEXIT_MAX:
		return STRINGIFY(_SC_ATEXIT_MAX);
	case _SC_BARRIERS:
		return STRINGIFY(_SC_BARRIERS);
	case _SC_BC_BASE_MAX:
		return STRINGIFY(_SC_BC_BASE_MAX);
	case _SC_BC_DIM_MAX:
		return STRINGIFY(_SC_BC_DIM_MAX);
	case _SC_BC_SCALE_MAX:
		return STRINGIFY(_SC_BC_SCALE_MAX);
	case _SC_BC_STRING_MAX:
		return STRINGIFY(_SC_BC_STRING_MAX);
	case _SC_CHILD_MAX:
		return STRINGIFY(_SC_CHILD_MAX);
	case _SC_CLK_TCK:
		return STRINGIFY(_SC_CLK_TCK);
	case _SC_CLOCK_SELECTION:
		return STRINGIFY(_SC_CLOCK_SELECTION);
	case _SC_COLL_WEIGHTS_MAX:
		return STRINGIFY(_SC_COLL_WEIGHTS_MAX);
	case _SC_CPUTIME:
		return STRINGIFY(_SC_CPUTIME);
	case _SC_DELAYTIMER_MAX:
		return STRINGIFY(_SC_DELAYTIMER_MAX);
	case _SC_EXPR_NEST_MAX:
		return STRINGIFY(_SC_EXPR_NEST_MAX);
	case _SC_FSYNC:
		return STRINGIFY(_SC_FSYNC);
	case _SC_GETGR_R_SIZE_MAX:
		return STRINGIFY(_SC_GETGR_R_SIZE_MAX);
	case _SC_GETPW_R_SIZE_MAX:
		return STRINGIFY(_SC_GETPW_R_SIZE_MAX);
	case _SC_HOST_NAME_MAX:
		return STRINGIFY(_SC_HOST_NAME_MAX);
	case _SC_IOV_MAX:
		return STRINGIFY(_SC_IOV_MAX);
	case _SC_IPV6:
		return STRINGIFY(_SC_IPV6);
	case _SC_JOB_CONTROL:
		return STRINGIFY(_SC_JOB_CONTROL);
	case _SC_LINE_MAX:
		return STRINGIFY(_SC_LINE_MAX);
	case _SC_LOGIN_NAME_MAX:
		return STRINGIFY(_SC_LOGIN_NAME_MAX);
	case _SC_MAPPED_FILES:
		return STRINGIFY(_SC_MAPPED_FILES);
	case _SC_MEMLOCK:
		return STRINGIFY(_SC_MEMLOCK);
	case _SC_MEMLOCK_RANGE:
		return STRINGIFY(_SC_MEMLOCK_RANGE);
	case _SC_MEMORY_PROTECTION:
		return STRINGIFY(_SC_MEMORY_PROTECTION);
	case _SC_MESSAGE_PASSING:
		return STRINGIFY(_SC_MESSAGE_PASSING);
	case _SC_MONOTONIC_CLOCK:
		return STRINGIFY(_SC_MONOTONIC_CLOCK);
	case _SC_MQ_OPEN_MAX:
		return STRINGIFY(_SC_MQ_OPEN_MAX);
	case _SC_MQ_PRIO_MAX:
		return STRINGIFY(_SC_MQ_PRIO_MAX);
	case _SC_NGROUPS_MAX:
		return STRINGIFY(_SC_NGROUPS_MAX);
	case _SC_OPEN_MAX:
		return STRINGIFY(_SC_OPEN_MAX);
	case _SC_PAGE_SIZE:
		return STRINGIFY(_SC_PAGE_SIZE);
	case _SC_PAGESIZE:
		return STRINGIFY(_SC_PAGESIZE);
	case _SC_PRIORITIZED_IO:
		return STRINGIFY(_SC_PRIORITIZED_IO);
	case _SC_PRIORITY_SCHEDULING:
		return STRINGIFY(_SC_PRIORITY_SCHEDULING);
	case _SC_RAW_SOCKETS:
		return STRINGIFY(_SC_RAW_SOCKETS);
	case _SC_RE_DUP_MAX:
		return STRINGIFY(_SC_RE_DUP_MAX);
	case _SC_READER_WRITER_LOCKS:
		return STRINGIFY(_SC_READER_WRITER_LOCKS);
	case _SC_REALTIME_SIGNALS:
		return STRINGIFY(_SC_REALTIME_SIGNALS);
	case _SC_REGEXP:
		return STRINGIFY(_SC_REGEXP);
	case _SC_RTSIG_MAX:
		return STRINGIFY(_SC_RTSIG_MAX);
	case _SC_SAVED_IDS:
		return STRINGIFY(_SC_SAVED_IDS);
	case _SC_SEM_NSEMS_MAX:
		return STRINGIFY(_SC_SEM_NSEMS_MAX);
	case _SC_SEM_VALUE_MAX:
		return STRINGIFY(_SC_SEM_VALUE_MAX);
	case _SC_SEMAPHORES:
		return STRINGIFY(_SC_SEMAPHORES);
	case _SC_SHARED_MEMORY_OBJECTS:
		return STRINGIFY(_SC_SHARED_MEMORY_OBJECTS);
	case _SC_SHELL:
		return STRINGIFY(_SC_SHELL);
	case _SC_SIGQUEUE_MAX:
		return STRINGIFY(_SC_SIGQUEUE_MAX);
	case _SC_SPAWN:
		return STRINGIFY(_SC_SPAWN);
	case _SC_SPIN_LOCKS:
		return STRINGIFY(_SC_SPIN_LOCKS);
	case _SC_SPORADIC_SERVER:
		return STRINGIFY(_SC_SPORADIC_SERVER);
	case _SC_SS_REPL_MAX:
		return STRINGIFY(_SC_SS_REPL_MAX);
	case _SC_STREAM_MAX:
		return STRINGIFY(_SC_STREAM_MAX);
	case _SC_SYMLOOP_MAX:
		return STRINGIFY(_SC_SYMLOOP_MAX);
	case _SC_SYNCHRONIZED_IO:
		return STRINGIFY(_SC_SYNCHRONIZED_IO);
	case _SC_THREAD_ATTR_STACKADDR:
		return STRINGIFY(_SC_THREAD_ATTR_STACKADDR);
	case _SC_THREAD_ATTR_STACKSIZE:
		return STRINGIFY(_SC_THREAD_ATTR_STACKSIZE);
	case _SC_THREAD_CPUTIME:
		return STRINGIFY(_SC_THREAD_CPUTIME);
	case _SC_THREAD_DESTRUCTOR_ITERATIONS:
		return STRINGIFY(_SC_THREAD_DESTRUCTOR_ITERATIONS);
	case _SC_THREAD_KEYS_MAX:
		return STRINGIFY(_SC_THREAD_KEYS_MAX);
	case _SC_THREAD_PRIO_INHERIT:
		return STRINGIFY(_SC_THREAD_PRIO_INHERIT);
	case _SC_THREAD_PRIO_PROTECT:
		return STRINGIFY(_SC_THREAD_PRIO_PROTECT);
	case _SC_THREAD_PRIORITY_SCHEDULING:
		return STRINGIFY(_SC_THREAD_PRIORITY_SCHEDULING);
	case _SC_THREAD_PROCESS_SHARED:
		return STRINGIFY(_SC_THREAD_PROCESS_SHARED);
	case _SC_THREAD_ROBUST_PRIO_INHERIT:
		return STRINGIFY(_SC_THREAD_ROBUST_PRIO_INHERIT);
	case _SC_THREAD_ROBUST_PRIO_PROTECT:
		return STRINGIFY(_SC_THREAD_ROBUST_PRIO_PROTECT);
	case _SC_THREAD_SAFE_FUNCTIONS:
		return STRINGIFY(_SC_THREAD_SAFE_FUNCTIONS);
	case _SC_THREAD_SPORADIC_SERVER:
		return STRINGIFY(_SC_THREAD_SPORADIC_SERVER);
	case _SC_THREAD_STACK_MIN:
		return STRINGIFY(_SC_THREAD_STACK_MIN);
	case _SC_THREAD_THREADS_MAX:
		return STRINGIFY(_SC_THREAD_THREADS_MAX);
	case _SC_THREADS:
		return STRINGIFY(_SC_THREADS);
	case _SC_TIMEOUTS:
		return STRINGIFY(_SC_TIMEOUTS);
	case _SC_TIMER_MAX:
		return STRINGIFY(_SC_TIMER_MAX);
	case _SC_TIMERS:
		return STRINGIFY(_SC_TIMERS);
	case _SC_TRACE:
		return STRINGIFY(_SC_TRACE);
	case _SC_TRACE_EVENT_FILTER:
		return STRINGIFY(_SC_TRACE_EVENT_FILTER);
	case _SC_TRACE_EVENT_NAME_MAX:
		return STRINGIFY(_SC_TRACE_EVENT_NAME_MAX);
	case _SC_TRACE_INHERIT:
		return STRINGIFY(_SC_TRACE_INHERIT);
	case _SC_TRACE_LOG:
		return STRINGIFY(_SC_TRACE_LOG);
	case _SC_TRACE_NAME_MAX:
		return STRINGIFY(_SC_TRACE_NAME_MAX);
	case _SC_TRACE_SYS_MAX:
		return STRINGIFY(_SC_TRACE_SYS_MAX);
	case _SC_TRACE_USER_EVENT_MAX:
		return STRINGIFY(_SC_TRACE_USER_EVENT_MAX);
	case _SC_TTY_NAME_MAX:
		return STRINGIFY(_SC_TTY_NAME_MAX);
	case _SC_TYPED_MEMORY_OBJECTS:
		return STRINGIFY(_SC_TYPED_MEMORY_OBJECTS);
	case _SC_TZNAME_MAX:
		return STRINGIFY(_SC_TZNAME_MAX);
	case _SC_V7_ILP32_OFF32:
		return STRINGIFY(_SC_V7_ILP32_OFF32);
	case _SC_V7_ILP32_OFFBIG:
		return STRINGIFY(_SC_V7_ILP32_OFFBIG);
	case _SC_V7_LP64_OFF64:
		return STRINGIFY(_SC_V7_LP64_OFF64);
	case _SC_V7_LPBIG_OFFBIG:
		return STRINGIFY(_SC_V7_LPBIG_OFFBIG);
	case _SC_V6_ILP32_OFF32:
		return STRINGIFY(_SC_V6_ILP32_OFF32);
	case _SC_V6_ILP32_OFFBIG:
		return STRINGIFY(_SC_V6_ILP32_OFFBIG);
	case _SC_V6_LP64_OFF64:
		return STRINGIFY(_SC_V6_LP64_OFF64);
	case _SC_V6_LPBIG_OFFBIG:
		return STRINGIFY(_SC_V6_LPBIG_OFFBIG);
	case _SC_VERSION:
		return STRINGIFY(_SC_VERSION);
	case _SC_XOPEN_CRYPT:
		return STRINGIFY(_SC_XOPEN_CRYPT);
	case _SC_XOPEN_ENH_I18N:
		return STRINGIFY(_SC_XOPEN_ENH_I18N);
	case _SC_XOPEN_REALTIME:
		return STRINGIFY(_SC_XOPEN_REALTIME);
	case _SC_XOPEN_REALTIME_THREADS:
		return STRINGIFY(_SC_XOPEN_REALTIME_THREADS);
	case _SC_XOPEN_SHM:
		return STRINGIFY(_SC_XOPEN_SHM);
	case _SC_XOPEN_STREAMS:
		return STRINGIFY(_SC_XOPEN_STREAMS);
	case _SC_XOPEN_UNIX:
		return STRINGIFY(_SC_XOPEN_UNIX);
	case _SC_XOPEN_UUCP:
		return STRINGIFY(_SC_XOPEN_UUCP);
	case _SC_XOPEN_VERSION:
		return STRINGIFY(_SC_XOPEN_VERSION);
	default:
		return "unknown";
	}
}
```
