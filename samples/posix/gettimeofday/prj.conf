## CMakeLists.txt
```
# SPDX-License-Identifier: Apache-2.0

cmake_minimum_required(VERSION 3.20.0)

find_package(Zephyr REQUIRED HINTS $ENV{ZEPHYR_BASE})
project(gettimeofday)

target_sources(app PRIVATE src/main.c)
```

## sample.yaml
```
sample:
  description: POSIX API gettimeofday() example (with SNTP)
  name: gettimeofday
common:
  filter: ( CONFIG_FULL_LIBC_SUPPORTED and not CONFIG_NATIVE_LIBC
    and not CONFIG_SOC_FAMILY_INTEL_ADSP )
  harness: net
  min_ram: 32
  min_flash: 96
  tags:
    - posix
    - net
  platform_exclude:
    - nrf7120dk/nrf7120/cpuapp
tests:
  sample.posix.gettimeofday:
    harness: net
    platform_exclude: s32k148_evb/s32k148
  sample.posix.gettimeofday.s32k148_evb:
    harness: net
    extra_args: SHIELD=nxp_adtja1101
    platform_allow: s32k148_evb/s32k148
```

## prj.conf
```kconfig
# General config
CONFIG_MAIN_STACK_SIZE=2048
CONFIG_REQUIRES_FULL_LIBC=y
CONFIG_POSIX_AEP_CHOICE_BASE=y
CONFIG_XSI=y
CONFIG_XSI_SINGLE_PROCESS=y
CONFIG_POSIX_MULTI_PROCESS=y
CONFIG_SNTP=y
CONFIG_NET_CONFIG_CLOCK_SNTP_INIT=y
CONFIG_NET_CONFIG_SNTP_INIT_SERVER="time.nist.gov"
CONFIG_NET_CONFIG_SNTP_INIT_RESYNC=y

# Networking config
CONFIG_NETWORKING=y
CONFIG_NET_IPV4=y
CONFIG_NET_IPV6=y
CONFIG_NET_TCP=y
CONFIG_NET_SOCKETS=y

CONFIG_DNS_RESOLVER=y
CONFIG_DNS_SERVER_IP_ADDRESSES=y
CONFIG_DNS_SERVER1="192.0.2.2"

# Network driver config
CONFIG_TEST_RANDOM_GENERATOR=y

# Network address config
CONFIG_NET_CONFIG_SETTINGS=y
CONFIG_NET_CONFIG_NEED_IPV4=y
CONFIG_NET_CONFIG_MY_IPV4_ADDR="192.0.2.1"
CONFIG_NET_CONFIG_PEER_IPV4_ADDR="192.0.2.2"
CONFIG_NET_CONFIG_MY_IPV4_GW="192.0.2.2"

# Network debug config
CONFIG_NET_LOG=y

# Use realtime for log timestamps
CONFIG_LOG_TIMESTAMP_USE_REALTIME=y
CONFIG_POSIX_C_LANG_SUPPORT_R=y
```

## src/main.c
```c
/*
 * Copyright (c) 2019 Linaro Limited
 *
 * SPDX-License-Identifier: Apache-2.0
 */

#undef _POSIX_C_SOURCE
#define _POSIX_C_SOURCE 200809L
#include <stdio.h>
#include <stdlib.h>
#include <errno.h>
#include <sys/time.h>
#include <time.h>
#include <unistd.h>

int main(void)
{
	struct timeval tv;

	while (1) {
		int res = gettimeofday(&tv, NULL);
		time_t now = time(NULL);
		struct tm tm;
		localtime_r(&now, &tm);

		if (res < 0) {
			printf("Error in gettimeofday(): %d\n", errno);
			return 1;
		}

		printf("gettimeofday(): HI(tv_sec)=%d, LO(tv_sec)=%d, "
		       "tv_usec=%d\n\t%s\n", (unsigned int)(tv.tv_sec >> 32),
		       (unsigned int)tv.tv_sec, (unsigned int)tv.tv_usec,
		       asctime(&tm));
		sleep(1);
	}
}
```
