## CMakeLists.txt
```
# SPDX-License-Identifier: Apache-2.0

cmake_minimum_required(VERSION 3.20.0)

find_package(Zephyr REQUIRED HINTS $ENV{ZEPHYR_BASE})
project(eventfd)

target_sources(app PRIVATE src/main.c)

target_compile_options(app PRIVATE -U_POSIX_C_SOURCE -D_POSIX_C_SOURCE=200809L)
```

## sample.yaml
```
sample:
  description: Extended POSIX (Linux) API eventfd() example
  name: eventfd
common:
  filter: CONFIG_FULL_LIBC_SUPPORTED and not CONFIG_NATIVE_LIBC
  tags: posix
  platform_exclude: m2gl025_miv
  integration_platforms:
    - mps2/an385
tests:
  sample.posix.eventfd:
    min_ram: 32
    tags: posix
    harness: console
    platform_exclude:
      - nrf7120dk/nrf7120/cpuapp
    harness_config:
      type: multi_line
      ordered: true
      regex:
        - "Writing 1 to efd"
        - "Writing 2 to efd"
        - "Writing 3 to efd"
        - "Writing 4 to efd"
        - "Completed write loop"
        - "About to read"
        - "Read 10 \\(0xa\\) from efd"
        - "Finished"
```

## prj.conf
```kconfig
# General config
CONFIG_POSIX_AEP_CHOICE_PSE53=y
CONFIG_EVENTFD=y

# eventfd() implementation currently depends on some networking APIs,
# so provide reasonable defaults so it can be built.
CONFIG_NETWORKING=y
CONFIG_NET_TEST=y
CONFIG_TEST_RANDOM_GENERATOR=y
```

## src/main.c
```c
/*
 * Copyright (c) 2020 Linaro Limited
 *
 * SPDX-License-Identifier: Apache-2.0
 *
 * This sample application is roughly based on the sample code in Linux
 * manpage for eventfd().
 */
#include <sys/eventfd.h>
#include <unistd.h>
#include <stdlib.h>
#include <stdio.h>
#include <stdint.h>

#define fatal(msg) \
	do { perror(msg); exit(EXIT_FAILURE); } while (false)

/* As Zephyr doesn't provide command-line args, emulate them. */
char *input_argv[] = {"argv0", "1", "2", "3", "4"};

int efd;
int g_argc;
char **g_argv;

void writer(void)
{
	int j;
	uint64_t u;
	ssize_t s;

	for (j = 1; j < g_argc; j++) {
		printf("Writing %s to efd\n", g_argv[j]);
		u = strtoull(g_argv[j], NULL, 0);
		s = write(efd, &u, sizeof(uint64_t));
		if (s != sizeof(uint64_t)) {
			fatal("write");
		}
	}
	printf("Completed write loop\n");
}

void reader(void)
{
	uint64_t u;
	ssize_t s;

	sleep(1);

	printf("About to read\n");
	s = read(efd, &u, sizeof(uint64_t));
	if (s != sizeof(uint64_t)) {
		fatal("read");
	}
	printf("Read %llu (0x%llx) from efd\n",
	       (unsigned long long)u, (unsigned long long)u);
}

int main(int argc, char *argv[])
{
	argv = input_argv;
	argc = sizeof(input_argv) / sizeof(input_argv[0]);

	if (argc < 2) {
		fprintf(stderr, "Usage: %s <num>...\n", argv[0]);
		exit(EXIT_FAILURE);
	}

	g_argc = argc;
	g_argv = argv;

	efd = eventfd(0, 0);
	if (efd == -1) {
		fatal("eventfd");
	}

	writer();
	reader();

	printf("Finished\n");

	return 0;
}
```
