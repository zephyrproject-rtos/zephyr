## CMakeLists.txt
```
# SPDX-License-Identifier: Apache-2.0

cmake_minimum_required(VERSION 3.20.0)

find_package(Zephyr REQUIRED HINTS $ENV{ZEPHYR_BASE})
project(spi_loopback)

target_sources(app PRIVATE src/main.c)
# zephyr_library_include_directories(include(zephyr(drivers(gpio_shakti.h))))
if(CONFIG_XIP)
    zephyr_code_relocate(src/main.c ROM_TEXT NOCOPY)
    zephyr_code_relocate(src/main.c ROM_DATA)
    zephyr_code_relocate(src/main.c ROM_BSS)
endif()
```

## sample.yaml
```
sample:
  description: SPI application sample, the simplest Zephyr
    application
  name: spi_loopback  
common:
  tags: introduction
  integration_platforms:
    - native_posix
  harness: console
  harness_config:
    type: one_line
    regex:
      - "spi_loopback! (.*)"
tests:
  sample.spi_loopback:
    tags: introduction
```

## prj.conf
```kconfig
CONFIG_SPI=y
CONFIG_SPI_SHAKTI=y
CONFIG_MULTITHREADING=y
```

## secure-iot.overlay
```dts
/*
 * Copyright (c) 2022 STMicroelectronics
 *
 * SPDX-License-Identifier: Apache-2.0
 */

//  &spi0 {
//     status = "okay";
//  };
```

## src/main.c
```c
#include <zephyr/logging/log.h>
LOG_MODULE_REGISTER(app, LOG_LEVEL_INF);

#include <zephyr/kernel.h>
#include <zephyr/device.h>
#include <zephyr/devicetree.h>
#include <stdio.h>
#include <string.h>
#include <zephyr/drivers/spi.h>


int main()
{
    const struct device *const dev = DEVICE_DT_GET(DT_NODELABEL(spi1));
    struct spi_config config;
    config.operation = SPI_OP_MODE_MASTER | SPI_TRANSFER_MSB | SPI_WORD_SET(8);
    k_busy_wait(100);
    // uint8_t tx_buff[3] = {0x12, 0x34, 0x56};
    // uint16_t tx_buff[3] = {0x1234, 0xabcd, 0x5678};
    //uint32_t tx_buff[3] = {0x12345678, 0xabcdefaa, 0xafcefbca};

    // uint8_t rx_buff[3];
    // uint16_t rx_buff[3];
    //uint32_t rx_buff[3];
    uint8_t tx_buff[4];
    uint8_t rx_buff[4];
	int len = sizeof(tx_buff) / sizeof(tx_buff[0]);

    for(int i = 0;i<4;i++){
        tx_buff[i] = i;
        printf("\nTransmitted Data [%d] = %d", i, tx_buff[i]);
    }
    printf("\nlen :%d", len);

    struct spi_buf tx_buf = { .buf = tx_buff, .len = len };
	struct spi_buf_set tx_bufs = { .buffers = &tx_buf, .count = 1};

    struct spi_buf rx_buf = { .buf = rx_buff, .len = len};
    struct spi_buf_set rx_bufs = { .buffers = &rx_buf, .count = 1};

    int ret = spi_transceive(dev, &config, &tx_bufs, &rx_bufs);

    for (int i = 0; i < 4; i++)
    {
        printf("\nReceived Data [%d] = %d", i, rx_buff[i]);
    }
    printf("completed transmission\n");

}
```
