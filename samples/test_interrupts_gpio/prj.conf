## CMakeLists.txt
```
# SPDX-License-Identifier: Apache-2.0

cmake_minimum_required(VERSION 3.20.0)

find_package(Zephyr REQUIRED HINTS $ENV{ZEPHYR_BASE})
project(test_interrupts_gpio)

target_sources(app PRIVATE src/main.c)

# zephyr_library_include_directories(include(zephyr(drivers(gpio_shakti.h))))
if(CONFIG_XIP)
    zephyr_code_relocate(src/main.c ROM_TEXT NOCOPY)
    zephyr_code_relocate(src/main.c ROM_DATA)
    zephyr_code_relocate(src/main.c ROM_BSS)
endif()
```

## prj.conf
```kconfig
CONFIG_GPIO=y
CONFIG_MULTITHREADING=y
CONFIG_SERIAL=n
CONFIG_GEN_IRQ_VECTOR_TABLE=y
CONFIG_RISCV_HAS_PLIC=y
```

## src/main.c
```c
#include <zephyr/kernel.h>
#include <zephyr/device.h>
#include <zephyr/devicetree.h>

#include <stdio.h>
#include <string.h>

#include <zephyr/drivers/gpio.h>
#include <zephyr/drivers/interrupt_controller/riscv_plic.h>
#include <zephyr/irq.h>
#include <zephyr/sw_isr_table.h>

#define GPIO_PIN 2 
#define GPIO_PIN_FLAG 0

// struct _isr_table_entry _sw_isr_table[58];
// enum gpio_int_mode gpio_mode;
// enum gpio_int_trig gpio_trig;

// struct _isr_table_entry isr_param;

int gpio_mode = GPIO_INT_MODE_LEVEL;
int gpio_trig = GPIO_INT_TRIG_HIGH;

void gpio_application_isr(const void*)
{
    printk("Entered ISR from application side\n");
    // return 0;
}

// _sw_isr_table[3] = gpio_application_isr;

int main()
{   
    struct _isr_table_entry isr_param = {
        .isr = gpio_application_isr
    };
    _sw_isr_table[1] = isr_param;
    const struct device *dev = DEVICE_DT_GET(DT_NODELABEL(gpio0));
    //plic_init(dev);
    gpio_pin_configure(dev, GPIO_PIN, GPIO_PIN_FLAG);
    gpio_pin_interrupt_configure(dev, GPIO_PIN, 1);
    
    while(1)
    {
        printk("Testing GPIO Interrupt\n");
    }

    return 0;
}
```
