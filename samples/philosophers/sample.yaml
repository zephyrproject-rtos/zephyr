## samples/philosophers/sample.yaml
```yaml
sample:
  name: Dining Philosophers
common:
  platform_key:
    - arch
  extra_args: DEBUG_PRINTF=1
  tags:
    - introduction
    - kernel
  harness: console
  min_ram: 16
  integration_platforms:
    - native_sim
  harness_config:
    type: multi_line
    ordered: false
    regex:
      - ".*STARVING.*"
      - ".*DROPPED ONE FORK.*"
      - ".*THINKING.*"
      - ".*EATING.*"
tests:
  sample.kernel.philosopher: {}
  sample.kernel.philosopher.same_prio:
    platform_allow:
      - native_sim
    extra_args: SAME_PRIO=1
  sample.kernel.philosopher.static:
    platform_allow:
      - native_sim
    extra_args: STATIC_OBJS=1
  sample.kernel.philosopher.semaphores:
    platform_allow:
      - native_sim
    extra_args: FORKS=SEMAPHORES
  sample.kernel.philosopher.stacks:
    platform_allow:
      - native_sim
    extra_args: FORKS=STACKS
  sample.kernel.philosopher.fifos:
    platform_allow:
      - native_sim
    extra_args: FORKS=FIFOS
  sample.kernel.philosopher.lifos:
    platform_allow:
      - native_sim
    extra_args: FORKS=LIFOS
  sample.kernel.philosopher.preempt_only:
    platform_allow:
      - native_sim
    extra_configs:
      - CONFIG_NUM_PREEMPT_PRIORITIES=6
      - CONFIG_NUM_COOP_PRIORITIES=0
      - CONFIG_BT=n
      - CONFIG_NETWORKING=n
  sample.kernel.philosopher.coop_only:
    platform_allow:
      - native_sim
    extra_configs:
      - CONFIG_NUM_PREEMPT_PRIORITIES=0
      - CONFIG_NUM_COOP_PRIORITIES=7
```

## samples/portability/cmsis_rtos_v1/philosophers/sample.yaml
```yaml
sample:
  name: CMSIS_RTOS_V1 Dining Philosophers
common:
  integration_platforms:
    - native_posix
  extra_args: DEBUG_PRINTF=1
  tags: cmsis_rtos
  min_ram: 32
  min_flash: 34
  # qemu_x86_64 and up_squared need bigger stack
  # but CMSIS limits the stack size, resulting
  # in stack overflow.
  platform_exclude: qemu_xtensa qemu_x86_64 qemu_leon3 up_squared
  harness: console
  harness_config:
    type: multi_line
    ordered: false
    regex:
      - ".*STARVING.*"
      - ".*DROPPED ONE FORK.*"
      - ".*THINKING.*"
      - ".*EATING.*"
tests:
  sample.portability.cmsis_rtos_v1.philosopher:
    tags: cmsis_rtos
  sample.portability.cmsis_rtos_v1.philosopher.same_prio:
    extra_args: "-DSAME_PRIO=1"
  sample.portability.cmsis_rtos_v1.philosopher.semaphores:
    extra_args: "-DFORKS=SEMAPHORES"
```

## samples/portability/cmsis_rtos_v1/timer_synchronization/sample.yaml
```yaml
sample:
  name: CMSIS_RTOS_V1 Syncronization
tests:
  sample.portability.cmsis_rtos_v1.timer_synchronization:
    tags: cmsis_rtos_v1_syncronization
    min_ram: 32
    min_flash: 34
    harness: console
    harness_config:
      type: multi_line
      ordered: true
      regex:
        - "Wrote to message queue: (.*)"
        - "Read from message queue: (.*)"
        - "Sample execution successful"
```

## samples/portability/cmsis_rtos_v2/timer_synchronization/sample.yaml
```yaml
sample:
  name: CMSIS_RTOS_V2 Synchronization
tests:
  sample.portability.cmsis_rtos_v2.timer_synchronization:
    timeout: 60
    tags: cmsis_rtos_v2_synchronization emu_time
    min_ram: 32
    min_flash: 34
    harness: console
    harness_config:
      type: multi_line
      ordered: true
      regex:
        - "Wrote to message queue: (.*)"
        - "Read from message queue: (.*)"
        - "Sample execution successful"
```

## samples/posix/env/sample.yaml
```yaml
sample:
  description: posix env sample
  name: posix env
common:
  tags:
    - posix
    - env
  platform_exclude:
    - native_posix
    - native_posix/native/64
  integration_platforms:
    - native_sim
  harness: console
  harness_config:
    type: multi_line
    regex:
      - "BOARD=.*"
      - "BUILD_VERSION=.*"
      - "ALERT="
tests:
  sample.posix.env: {}
```

## samples/posix/eventfd/sample.yaml
```yaml
sample:
  description: Extended POSIX (Linux) API eventfd() example
  name: eventfd
common:
  filter: TOOLCHAIN_HAS_NEWLIB == 1
  tags: posix
  platform_exclude: m2gl025_miv intel_adsp_cavs15
  integration_platforms:
    - mps2_an385
tests:
  sample.posix.eventfd:
    min_ram: 32
    tags: posix
    harness: console
    harness_config:
      type: multi_line
      ordered: true
      regex:
        - "Writing 1 to efd"
        - "Writing 2 to efd"
        - "Writing 3 to efd"
        - "Writing 4 to efd"
        - "Completed write loop"
        - "About to read"
        - "Read 10 \\(0xa\\) from efd"
        - "Finished"
```

## samples/posix/gettimeofday/sample.yaml
```yaml
sample:
  description: POSIX API gettimeofday() example (with SNTP)
  name: gettimeofday
common:
  filter: ( CONFIG_FULL_LIBC_SUPPORTED and not CONFIG_NATIVE_LIBC
    and not CONFIG_SOC_FAMILY_INTEL_ADSP )
  harness: net
  min_ram: 32
  min_flash: 96
  tags:
    - posix
    - net
tests:
  sample.posix.gettimeofday:
    harness: net
    platform_exclude: s32k148_evb/s32k148
  sample.posix.gettimeofday.s32k148_evb:
    harness: net
    extra_args: SHIELD=nxp_adtja1101
    platform_allow: s32k148_evb/s32k148
```

## samples/posix/philosophers/Kconfig
```kconfig
# Copyright (c) 2024, Meta
#
# SPDX-License-Identifier: Apache-2.0

config SAMPLE_ERROR_CHECKING
	bool "Perform error checking"

config SAMPLE_DEBUG_PRINTF
	bool "Print debug information"
	default y

config SAMPLE_SAME_PRIO
	bool "Print debug information"
	default n

source "Kconfig.zephyr"
```

## samples/posix/philosophers/sample.yaml
```yaml
sample:
  name: POSIX Philosophers
common:
  tags:
    - inroduction
    - posix
  harness: console
  min_ram: 16
  integration_platforms:
    - native_sim
  filter: not CONFIG_NATIVE_APPLICATION
  harness_config:
    type: multi_line
    ordered: false
    regex:
      - ".*STARVING.*"
      - ".*DROPPED ONE FORK.*"
      - ".*THINKING.*"
      - ".*EATING.*"
tests:
  sample.posix.philosopher: {}
```

## samples/posix/sysconf/sample.yaml
```yaml
sample:
  description: Posix sysconf sample
  name: posix sysconf
common:
  tags: posix
  filter: not CONFIG_ARCH_POSIX
  integration_platforms:
    - native_posix_64
    - qemu_riscv64
  harness: console
  harness_config:
    type: one_line
    regex:
      - "\\[errno: \\d\\d\\d] _SC_.*\\(\\d+\\) = .*"
tests:
  sample.posix.sysconf:
    tags: sysconf
```

## samples/posix/timerfd/sample.yaml
```yaml
sample:
  description: Extended POSIX (Linux) API timerfd() example
  name: timerfd
common:
  filter: CONFIG_FULL_LIBC_SUPPORTED and not CONFIG_NATIVE_LIBC
  tags: posix
  platform_exclude: m2gl025_miv
  integration_platforms:
    - mps2/an385
tests:
  sample.posix.timerfd:
    min_ram: 32
    tags: posix
    harness: console
    harness_config:
      type: multi_line
      ordered: true
      regex:
        - "Timer expired 1 times"
        - "Timer expired 3 times"
        - "Timer closed"
```

## samples/posix/uname/sample.yaml
```yaml
sample:
  description: posix uname sample
  name: posix uname
common:
  tags: posix
  platform_exclude:
    - native_posix
    - native_posix/native/64
  integration_platforms:
    - native_sim
    - qemu_riscv64
  harness: console
  harness_config:
    type: multi_line
    ordered: true
    regex:
      - "sysname\\[7\\]: Zephyr"
      - "nodename\\[\\d+\\]: .*"
      - "release\\[\\d+\\]: \\d+\\.\\d+\\.\\d+"
      - "version\\[\\d+\\]: .*"
      - "machine\\[\\d+\\]: .*"
tests:
  sample.posix.uname:
    tags: uname
```

## samples/psa/its/sample.yaml
```yaml
sample:
  name: PSA ITS API sample
  description: Demonstration of PSA Internal Trusted Storage (ITS) API usage.
common:
  tags:
    - psa.secure_storage
  timeout: 10
  harness: console
  harness_config:
    type: one_line
    regex:
      - "Sample finished successfully."
tests:
  sample.psa.its.tfm:
    filter: CONFIG_BUILD_WITH_TFM
    tags:
      - trusted-firmware-m
  sample.psa.its.secure_storage.entropy_driver:
    filter: CONFIG_SECURE_STORAGE and not CONFIG_SECURE_STORAGE_ITS_STORE_IMPLEMENTATION_NONE
            and CONFIG_ENTROPY_HAS_DRIVER
    extra_args: EXTRA_CONF_FILE=overlay-secure_storage.conf;overlay-entropy_driver.conf
    tags:
      - drivers.entropy
      - settings
  sample.psa.its.secure_storage.entropy_not_secure:
    filter: CONFIG_SECURE_STORAGE and not CONFIG_SECURE_STORAGE_ITS_STORE_IMPLEMENTATION_NONE
            and not CONFIG_ENTROPY_HAS_DRIVER
    extra_args: EXTRA_CONF_FILE="overlay-secure_storage.conf;overlay-entropy_not_secure.conf"
    tags:
      - random
      - settings
```

## samples/psa/persistent_key/sample.yaml
```yaml
sample:
  name: PSA Crypto persistent key sample
  description: Demonstration of persistent key usage in the PSA Crypto API.
common:
  tags:
    - psa.secure_storage
  timeout: 10
  harness: console
  harness_config:
    type: one_line
    regex:
      - "Sample finished successfully."
tests:
  sample.psa.persistent_key.tfm:
    filter: CONFIG_BUILD_WITH_TFM
    extra_args: EXTRA_CONF_FILE=overlay-tfm.conf
    tags:
      - trusted-firmware-m
  sample.psa.persistent_key.secure_storage.entropy_driver:
    filter: CONFIG_SECURE_STORAGE and not CONFIG_SECURE_STORAGE_ITS_STORE_IMPLEMENTATION_NONE
            and CONFIG_ENTROPY_HAS_DRIVER
    extra_args: EXTRA_CONF_FILE=overlay-secure_storage.conf
    tags:
      - drivers.entropy
      - settings
  sample.psa.persistent_key.secure_storage.entropy_not_secure:
    filter: CONFIG_SECURE_STORAGE and not CONFIG_SECURE_STORAGE_ITS_STORE_IMPLEMENTATION_NONE
            and not CONFIG_ENTROPY_HAS_DRIVER
    extra_args: EXTRA_CONF_FILE=overlay-secure_storage.conf;overlay-entropy_not_secure.conf
    tags:
      - random
      - settings
```

## samples/pxp/Kconfig
```kconfig
# Config for pxp sample

# Copyright (c) 2019 NXP Semiconductor
# SPDX-License-Identifier: Apache-2.0

choice
	prompt "Build which PXP sample"
	default PXP_ROTATE_FLIP

config PXP_ROTATE_FLIP
	bool "PXP rotate & flip sample"

config PXP_SCALER
	bool "PXP scaler sample"

endchoice

source "Kconfig.zephyr"
```

## samples/pxp/sample.yaml
```yaml
sample:
  name: pxp
tests:
  sample.pxp:
    build_only: true
    tags: pxp
    platform_allow: mimxrt1050_evk mimxrt1060_evk mimxrt1064_evk mimxrt1170_evk_cm7
    depends_on: pxp
```

## samples/rtio/ramp_reader/sample.yaml
```yaml
sample:
  name: Ramp Reader Sample
tests:
  sample.rtio.ramp_reader:
    harness: rtio
    tags: rtio
    depends_on: rtio
```

## samples/rtio/ramp_throughput/sample.yaml
```yaml
sample:
  name: Ramp Throughput Sample
tests:
  sample.rtio.ramp_throughput:
    harness: rtio
    tags: rtio
    depends_on: rtio
```

## samples/rust/hello_rust/sample.yaml
```yaml
sample:
  description: Hello world, but in Rust
  name: hello rust
common:
  harness: console
  harness_config:
    type: one_line
    regex:
      - "Hello world from Rust on (.*)"
  filter: CONFIG_RUST_SUPPORTED
tests:
  sample.rust.hellorust:
    tags: introduction
```

## samples/rust/hello_world/sample.yaml
```yaml
sample:
  description: Hello world, but in Rust
  name: hello rust world
common:
  harness: console
  harness_config:
    type: one_line
    regex:
      - "Hello world from Rust on (.*)"
  tags: rust
  filter: CONFIG_RUST_SUPPORTED
tests:
  sample.rust.helloworld:
    tags: introduction
```

## samples/security/protection_psoc6/sample.yaml
```yaml
sample:
    description: Sample app that creates a secure domain on CM0+ side with
        protected from CM4 access Flash, SRAM and restricted access to some
        peripheral.
    name: PSoC6 Secure/Unsecure Domain Sample
tests:
    test:
        platform_whitelist: cy8ckit_062_wifi_bt_m0
        tags: protection
```

## samples/sensor/2smpb_02e/sample.yaml
```yaml
sample:
  name: 2SMPB-02E sensor sample
tests:
  sample.sensor.2smpb_02e:
    harness: sensor
    tags: sensors
    depends_on:
      - i2c
    filter: dt_compat_enabled("omron,2smpb_02e")
```

## samples/sensor/6dof_fifo_stream/boards/sensortile_box_pro.conf
```kconfig
# Copyright (c) 2025 STMicroelectronics
# SPDX-License-Identifier: Apache-2.0

CONFIG_SPI_RTIO=y
CONFIG_LSM6DSV16X_STREAM=y
CONFIG_LSM6DSV16X_ENABLE_TEMP=y
```

## samples/sensor/6dof_motion_drdy/Kconfig
```kconfig
# Copyright (c) 2024, TDK Invensense
# SPDX-License-Identifier: Apache-2.0

# Trigger mode: sample is using interrupt triggering
choice ICM42670_TRIGGER_MODE
	default ICM42670_TRIGGER_OWN_THREAD
endchoice

source "Kconfig.zephyr"
```

## samples/sensor/6dof_motion_drdy/sample.yaml
```yaml
sample:
  name: 6DOF Motion dataready sample
tests:
  sample.sensor.6dof_motion_drdy:
    build_only: true
    tags: sensors
    filter: dt_alias_exists("6dof_motion_drdy0")
    integration_platforms:
      - nrf52dk/nrf52832
```
