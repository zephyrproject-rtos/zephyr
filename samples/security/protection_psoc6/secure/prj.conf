## CMakeLists.txt
```
cmake_minimum_required(VERSION 3.8.2)
#
# Copyright (c) 2018, Cypress Semiconductor
#
# SPDX-License-Identifier: Apache-2.0
#

set(BOARD cy8ckit_062_wifi_bt_m0)

include($ENV{ZEPHYR_BASE}/cmake/app/boilerplate.cmake NO_POLICY_SCOPE)
project(prot_psoc6_server)

if(NOT ("${BOARD}" STREQUAL "cy8ckit_062_wifi_bt_m0"))
  message(FATAL_ERROR "${BOARD} was specified, but this sample only supports cy8ckit_062_wifi_bt_m0")
endif()

target_include_directories(app PRIVATE $ENV{ZEPHYR_BASE}/drivers)
target_sources(app PRIVATE src/main.c)
```

## prj.conf
```kconfig
CONFIG_STDOUT_CONSOLE=y
CONFIG_PRINTK=y
CONFIG_CONSOLE=y
CONFIG_SERIAL=y
```

## src/main.c
```c
/*
 * Copyright (c) 2018, Cypress Semiconductor
 *
 * SPDX-License-Identifier: Apache-2.0
 */
#include <zephyr.h>

#include "cy_sysint.h"
#include "cy_wdt.h"
#include <init.h>
#include <misc/printk.h>
#include <string.h>

#define SIMPLE_RESOURCES_PROTECTION

#ifdef SIMPLE_RESOURCES_PROTECTION
#include "cyprotection_simple_config.h"
#else
#include "cyprotection_full_config.h"
#endif

#define PRIVIL_ACCESS 1
#define UNPRIVIL_ACCESS 0
#define SECURE_ACCESS 0
#define UNSECURE_ACCESS 1

#define REGION_SIZE 0x1

#define CM0_MEMORY_ADDR (CONFIG_SRAM_BASE_ADDRESS + 0x500)
#define CM4_MEMORY_ADDR (0x08024000 + 0x500)

#define SLEEP_TIME 500

#ifdef SIMPLE_RESOURCES_PROTECTION
static cy_en_prot_status_t protect_cm0(void)
{
	cy_en_prot_status_t status = CY_PROT_SUCCESS;

	/* smpu */
	status = smpu_protect(flash_spm_smpu_config,
		ARRAY_SIZE(flash_spm_smpu_config));
	if (status == CY_PROT_SUCCESS) {
		status = smpu_protect(sram_spm_smpu_config,
			ARRAY_SIZE(sram_spm_smpu_config));
	}

	/* fixed region ppu */
	if (status == CY_PROT_SUCCESS) {
		status = ppu_fixed_rg_protect(fixed_rg_ppu_config,
			ARRAY_SIZE(fixed_rg_ppu_config));
	}
	/* fixed slave ppu */
	if (status == CY_PROT_SUCCESS) {
		status = ppu_fixed_sl_protect(fixed_sl_ppu_config,
			ARRAY_SIZE(fixed_sl_ppu_config));
	}
	/* programmable ppu */
	if (status == CY_PROT_SUCCESS) {
		status = ppu_prog_protect(prog_ppu_config,
			ARRAY_SIZE(prog_ppu_config));
	}
	/* fixed group ppu */
	if (status == CY_PROT_SUCCESS) {
		status = ppu_fixed_gr_protect(fixed_gr_ppu_config,
			ARRAY_SIZE(fixed_gr_ppu_config));
	}

	/* bus masters */
	if (status == CY_PROT_SUCCESS) {
		status = bus_masters_protect(bus_masters_config,
			ARRAY_SIZE(bus_masters_config));
	}

	return status;
}
#else
static cy_en_prot_status_t protect_cm0(void)
{
	cy_en_prot_status_t status = CY_PROT_SUCCESS;

	/* smpu */
	status = smpu_protect(flash_spm_smpu_config,
		ARRAY_SIZE(flash_spm_smpu_config));
	if (status == CY_PROT_SUCCESS) {
		status = smpu_protect(sram_spm_smpu_config,
			ARRAY_SIZE(sram_spm_smpu_config));
	}
	if (status == CY_PROT_SUCCESS) {
		status = smpu_protect_unprotected(&spm_other_smpu_config);
	}

	/* fixed region ppu */
	if (status == CY_PROT_SUCCESS) {
		status = ppu_fixed_rg_protect(fixed_rg_pc0_ppu_config,
			ARRAY_SIZE(fixed_rg_pc0_ppu_config));
	}
	if (status == CY_PROT_SUCCESS) {
		status = ppu_fixed_rg_protect(fixed_rg_spm_ppu_config,
			ARRAY_SIZE(fixed_rg_spm_ppu_config));
	if (status == CY_PROT_SUCCESS) {
	}
		status = ppu_fixed_rg_protect(fixed_rg_any_ppu_config,
			ARRAY_SIZE(fixed_rg_any_ppu_config));
	}
	/* fixed slave ppu */
	if (status == CY_PROT_SUCCESS) {
		status = ppu_fixed_sl_protect(fixed_sl_pc0_ppu_config,
			ARRAY_SIZE(fixed_sl_pc0_ppu_config));
	}
	if (status == CY_PROT_SUCCESS) {
		status = ppu_fixed_sl_protect(fixed_sl_spm_ppu_config,
			ARRAY_SIZE(fixed_sl_spm_ppu_config));
	}
	if (status == CY_PROT_SUCCESS) {
		status = ppu_fixed_sl_protect(fixed_sl_any_ppu_config,
			ARRAY_SIZE(fixed_sl_any_ppu_config));
	}
	/* programmable ppu */
	if (status == CY_PROT_SUCCESS) {
		status = ppu_prog_protect(prog_pc0_ppu_config,
			ARRAY_SIZE(prog_pc0_ppu_config));
	}
	if (status == CY_PROT_SUCCESS) {
		status = ppu_prog_protect(prog_spm_ppu_config,
			ARRAY_SIZE(prog_spm_ppu_config));
	}
	/* fixed group ppu */
	if (status == CY_PROT_SUCCESS) {
		status = ppu_fixed_gr_protect(fixed_gr_pc0_ppu_config,
			ARRAY_SIZE(fixed_gr_pc0_ppu_config));
	}
	if (status == CY_PROT_SUCCESS) {
		status = ppu_fixed_gr_protect(fixed_gr_spm_ppu_config,
			ARRAY_SIZE(fixed_gr_spm_ppu_config));
	}

	/* bus masters */
	if (status == CY_PROT_SUCCESS) {
		status = bus_masters_protect(bus_masters_config,
			ARRAY_SIZE(bus_masters_config));
	}

	return status;
}
#endif

void main(void)
{
	u8_t access_flag;
	u32_t *mem_addr;

	/* Disable watchdog */
	Cy_WDT_Unlock();
	Cy_WDT_Disable();

	printk("PSoC6 Secure core has started\n\n");

	if (protect_cm0() == CY_PROT_SUCCESS) {
		printk("PSoC6 CM0+ resources protected\n\n");
	} else {
		printk("PSoC6 CM0+ resourses protection failed\n");
		while (1) {
		}
	}

	printk("Check access rights before executing CM4 requests\n\n");
	access_flag = isPeripheralAccessAllowed((u32_t)SCB2, REGION_SIZE,
		PRIVIL_ACCESS, UNSECURE_ACCESS, CY_PROT_PC6, CY_PROT_PERM_RW);
	printk("CM4 privileged unsecured access to SCB2 is %s\n",
		access_flag ? "allowed" : "forbidden");
	access_flag = isPeripheralAccessAllowed((u32_t)SCB2, REGION_SIZE,
		UNPRIVIL_ACCESS, SECURE_ACCESS, CY_PROT_PC1, CY_PROT_PERM_RW);
	printk("CM0+ unprivileged secured access to SCB2 is %s\n",
		access_flag ? "allowed" : "forbidden");
	access_flag = isPeripheralAccessAllowed((u32_t)SCB2, REGION_SIZE,
		PRIVIL_ACCESS, SECURE_ACCESS, CY_PROT_PC1, CY_PROT_PERM_RW);
	printk("CM0+ privileged secured access to SCB2 is %s\n\n",
		access_flag ? "allowed" : "forbidden");

	access_flag = isMemoryAccessAllowed(CM4_MEMORY_ADDR, REGION_SIZE,
		UNPRIVIL_ACCESS, UNSECURE_ACCESS, CY_PROT_PC6, CY_PROT_PERM_RW);
	printk("CM4 unprivileged unsecured access to CM4 memory is %s\n",
		access_flag ? "allowed" : "forbidden");
	access_flag = isMemoryAccessAllowed(CM4_MEMORY_ADDR, REGION_SIZE,
		PRIVIL_ACCESS, SECURE_ACCESS, CY_PROT_PC1, CY_PROT_PERM_RW);
	printk("CM0 privileged secured access to CM4 memory is %s\n\n",
		access_flag ? "allowed" : "forbidden");

	access_flag = isMemoryAccessAllowed(CM0_MEMORY_ADDR, REGION_SIZE,
		UNPRIVIL_ACCESS, UNSECURE_ACCESS, CY_PROT_PC6, CY_PROT_PERM_RW);
	printk("CM4 unprivileged unsecured access to CM0 memory is %s\n",
		access_flag ? "allowed" : "forbidden");
	access_flag = isMemoryAccessAllowed(CM0_MEMORY_ADDR, REGION_SIZE,
		PRIVIL_ACCESS, SECURE_ACCESS, CY_PROT_PC1, CY_PROT_PERM_RW);
	printk("CM0 privileged secured access to CM0 memory is %s\n\n",
		access_flag ? "allowed" : "forbidden");

	printk("Read from CM4 memory\n");
	mem_addr = (u32_t *)CM4_MEMORY_ADDR;
	printk("Content of CM4 memory by address 0x%x is 0x%x\n\n",
		(u32_t)mem_addr, *mem_addr);
	printk("Read from CM0 memory\n");
	mem_addr = (u32_t *)CM0_MEMORY_ADDR;
	printk("Content of CM0 memory by address 0x%x is 0x%x\n",
		(u32_t)mem_addr, *mem_addr);

	/* Wait a bit to avoid terminal output corruption */
	k_sleep(SLEEP_TIME);

	/* Enable CM4 */
	Cy_SysEnableCM4(CONFIG_SLAVE_BOOT_ADDRESS_PSOC6);

	while (1) {
	}
}
```

## src/cyprotection_simple_config.h
```c
/*
 * Copyright (c) 2018, Cypress Semiconductor
 *
 * SPDX-License-Identifier: Apache-2.0
 */

#ifndef _CYPROTECTION_CONFIG_H_
#define _CYPROTECTION_CONFIG_H_

#include "cyprotection.h"

/* Only 7 protection contexts are available in PSoC6-BLE2 */
#define ALL_PROTECTION_CONTEXTS_MASK (CY_PROT_PCMASK1 + CY_PROT_PCMASK2 +\
CY_PROT_PCMASK3 + CY_PROT_PCMASK4 + CY_PROT_PCMASK5 + CY_PROT_PCMASK6 +\
CY_PROT_PCMASK7)
#define SECURE_CONTEXTS_MASK (CY_PROT_PCMASK1 + CY_PROT_PCMASK2 +\
CY_PROT_PCMASK3 + CY_PROT_PCMASK4)

#define ALL_SUBREGIONS (0x0)

const cy_smpu_region_config_t flash_spm_smpu_config[] = {
	{
		.address = (u32_t *) CONFIG_FLASH_BASE_ADDRESS,
		.regionSize = CY_PROT_SIZE_512KB,
		.subregions = 0xC0, /* Only 384kB is used by CM0+ */
		.userPermission = CY_PROT_PERM_RX,
		.privPermission = CY_PROT_PERM_RWX,
		.secure = true,
		.pcMatch = false,
		.pcMask = SECURE_CONTEXTS_MASK,
		.prot_region = PROT_SMPU_SMPU_STRUCT7,
		.userMstPermission = CY_PROT_PERM_R,
		.privMstPermission = CY_PROT_PERM_R,
	}
};

const cy_smpu_region_config_t sram_spm_smpu_config[] = {
	/* SRAM_SPM_PRIV */
	{
		.address = (u32_t *) CONFIG_SRAM_BASE_ADDRESS,
		.regionSize = CY_PROT_SIZE_128KB,
		.subregions = ALL_SUBREGIONS,
		.userPermission = CY_PROT_PERM_DISABLED,
		.privPermission = CY_PROT_PERM_RWX,
		.secure = true,
		.pcMatch = false,
		.pcMask = SECURE_CONTEXTS_MASK,
		.prot_region = PROT_SMPU_SMPU_STRUCT12,
		.userMstPermission = CY_PROT_PERM_R,
		.privMstPermission = CY_PROT_PERM_R,
	}
};

const cy_ppu_fixed_rg_cfg_t fixed_rg_ppu_config[] = {
	{
		.userPermission = CY_PROT_PERM_DISABLED,
		.privPermission = CY_PROT_PERM_RW,
		.secure = true,
		.pcMatch = false,
		.pcMask = SECURE_CONTEXTS_MASK,
		.userMstPermission = CY_PROT_PERM_R,
		.privMstPermission = CY_PROT_PERM_R,
		.secureMst = false,
		.pcMstMask = ALL_PROTECTION_CONTEXTS_MASK,
		.pPpuStr = PERI_GR_PPU_RG_IPC_STRUCT0,
	},
	{
		.userPermission = CY_PROT_PERM_RW,
		.privPermission = CY_PROT_PERM_RW,
		.secure = false,
		.pcMatch = false,
		.pcMask = ALL_PROTECTION_CONTEXTS_MASK - CY_PROT_PCMASK7,
		.userMstPermission = CY_PROT_PERM_R,
		.privMstPermission = CY_PROT_PERM_R,
		.secureMst = false,
		.pcMstMask = ALL_PROTECTION_CONTEXTS_MASK,
		.pPpuStr = PERI_GR_PPU_RG_IPC_STRUCT1,
	}
};

const cy_ppu_fixed_sl_cfg_t fixed_sl_ppu_config[] = {
	{
		.userPermission = CY_PROT_PERM_DISABLED,
		.privPermission = CY_PROT_PERM_RW,
		.secure = true,
		.pcMatch = false,
		.pcMask = SECURE_CONTEXTS_MASK,
		.userMstPermission = CY_PROT_PERM_RW,
		.privMstPermission = CY_PROT_PERM_RW,
		.secureMst = false,
		.pcMstMask = ALL_PROTECTION_CONTEXTS_MASK,
		.pPpuStr = PERI_GR_PPU_SL_SCB2,
	}
};

const cy_ppu_prog_cfg_t prog_ppu_config[] = {
	{
		.address = (u32_t *)0x40010000,
		.regionSize = CY_PROT_SIZE_1KB,/* 0x00400 */
		.subregions = ALL_SUBREGIONS,
		.userPermission = CY_PROT_PERM_DISABLED,
		.privPermission = CY_PROT_PERM_RW,
		.secure = true,
		.pcMatch = false,
		.pcMask = SECURE_CONTEXTS_MASK,
		.userMstPermission = CY_PROT_PERM_R,
		.privMstPermission = CY_PROT_PERM_RW,
		.secureMst = true,
		.pcMstMask = SECURE_CONTEXTS_MASK,
		.pPpuStr = PERI_PPU_PR4,
	}
};

const cy_ppu_fixed_gr_cfg_t fixed_gr_ppu_config[] = {
	{
		.userPermission = CY_PROT_PERM_RW,
		.privPermission = CY_PROT_PERM_RW,
		.secure = false,
		.pcMatch = false,
		.pcMask = ALL_PROTECTION_CONTEXTS_MASK,
		.userMstPermission = CY_PROT_PERM_R,
		.privMstPermission = CY_PROT_PERM_RW,
		.secureMst = true,
		.pcMstMask = SECURE_CONTEXTS_MASK,
		.pPpuStr = PERI_PPU_GR0,
	}
};

const cy_bus_master_config_t bus_masters_config[] = {
	{
		.busMaster = CPUSS_MS_ID_CM4,
		.privileged = true,
		.secure = false,
		.pcMask = CY_PROT_PCMASK6,
		.act_pc = CY_PROT_PC6,
	},
	{
		.busMaster = CPUSS_MS_ID_TC,
		.privileged = false,
		.secure = false,
		.pcMask = CY_PROT_PCMASK1 + CY_PROT_PCMASK6,
		.act_pc = CY_PROT_PC1,
	},
	{
		.busMaster = CPUSS_MS_ID_CRYPTO,
		.privileged = true,
		.secure = true,
		.pcMask = SECURE_CONTEXTS_MASK,
		.act_pc = CY_PROT_PC1,
	},
	{
		.busMaster = CPUSS_MS_ID_CM0,
		.privileged = true,
		.secure = true,
		.pcMask = SECURE_CONTEXTS_MASK,
		.act_pc = CY_PROT_PC1,
	}
};

#endif /* _CYPROTECTION_CONFIG_H_ */
```
