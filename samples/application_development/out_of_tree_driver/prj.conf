## CMakeLists.txt
```
# SPDX-License-Identifier: Apache-2.0

# For the sake of demonstration, we add the driver directory as a zephyr module
# by hand. The sample ensures that it can be blindly built but in your application,
# please adding all extra modules in a consistently way.
# If your driver is a project that's managed by west, you can remove those condition checkers.
if (DEFINED CACHE{EXTRA_ZEPHYR_MODULES})
  message(WARNING "All extra modules should be consistently added over -DEXTRA_ZEPHYR_MODULES")
  set(EXTRA_ZEPHYR_MODULES ${EXTRA_ZEPHYR_MODULES} ${CMAKE_CURRENT_SOURCE_DIR}/hello_world_module CACHE INTERNAL "" FORCE)
elseif(DEFINED ENV{EXTRA_ZEPHYR_MODULES})
  message(WARNING "All extra modules should be consistently added over environment variable EXTRA_ZEPHYR_MODULES")
  set(ENV{EXTRA_ZEPHYR_MODULES} "$ENV{EXTRA_ZEPHYR_MODULES};${CMAKE_CURRENT_SOURCE_DIR}/hello_world_module")
else()
  list(APPEND EXTRA_ZEPHYR_MODULES ${CMAKE_CURRENT_SOURCE_DIR}/hello_world_module)
endif()

cmake_minimum_required(VERSION 3.20.0)

find_package(Zephyr REQUIRED HINTS $ENV{ZEPHYR_BASE})
project(out_of_tree_driver)

target_sources(app PRIVATE
  src/main.c
  )
```

## sample.yaml
```
sample:
  description: Sample that uses an out-of-tree driver
  name: Out-of-tree driver
tests:
  sample.drivers.out_of_tree:
    integration_platforms:
      - native_posix
    tags: out_of_tree
    harness: console
    harness_config:
      type: multi_line
      regex:
        - "Hello World from the app!"
        - "device is (.*), name is CUSTOM_DRIVER"
        - "Hello World from the kernel: 5"
```

## prj.conf
```kconfig
CONFIG_HELLO_WORLD_DRIVER=y
CONFIG_APPLICATION_DEFINED_SYSCALL=y
```

## src/main.c
```c
/*
 * Copyright (c) 2019 Nordic Semiconductor
 *
 * SPDX-License-Identifier: Apache-2.0
 */

#include "hello_world_driver.h"
#include <stdio.h>
#include <zephyr/kernel.h>

const struct device *dev;

static void user_entry(void *p1, void *p2, void *p3)
{
	hello_world_print(dev);
}

int main(void)
{
	printk("Hello World from the app!\n");

	dev = device_get_binding("CUSTOM_DRIVER");

	__ASSERT(dev, "Failed to get device binding");

	printk("device is %p, name is %s\n", dev, dev->name);

	k_object_access_grant(dev, k_current_get());
	k_thread_user_mode_enter(user_entry, NULL, NULL, NULL);
	return 0;
}
```

## src/hello_world_driver.c
```c
/*
 * SPDX-License-Identifier: Apache-2.0
 */

#include "hello_world_driver.h"
#include <zephyr/types.h>

/**
 * This is a minimal example of an out-of-tree driver
 * implementation. See the header file of the same name for details.
 */

static struct hello_world_dev_data {
	u32_t foo;
} data;

static int init(struct device *dev)
{
	data.foo = 5;

	return 0;
}

static void print_impl(struct device *dev)
{
	printk("Hello World from the kernel: %d\n", data.foo);

	__ASSERT(data.foo == 5, "Device was not initialized!");
}

DEVICE_AND_API_INIT(hello_world, "CUSTOM_DRIVER",
		    init, &data, NULL,
		    PRE_KERNEL_1, CONFIG_KERNEL_INIT_PRIORITY_DEVICE,
		    &((struct hello_world_driver_api){ .print = print_impl }));
```

## src/hello_world_driver.h
```c
/*
 * SPDX-License-Identifier: Apache-2.0
 */
#ifndef __HELLO_WORLD_DRIVER_H__
#define __HELLO_WORLD_DRIVER_H__

#ifdef __cplusplus
extern "C" {
#endif

#include <device.h>

/*
 * This 'Hello World' driver has a 'print' syscall that prints the
 * famous 'Hello World!' string.
 *
 * The string is formatted with some internal driver data to
 * demonstrate that drivers are initialized during the boot process.
 *
 * The driver exists to demonstrate (and test) custom drivers that are
 * maintained outside of Zephyr.
 */

struct hello_world_driver_api {
	/* This struct has a member called 'print'. 'print' is function
	 * pointer to a function that takes 'struct device *dev' as an
	 * argument and returns 'void'.
	 */
	void (*print)(struct device *dev);
};

__syscall void hello_world_print(struct device *dev);
static inline void _impl_hello_world_print(struct device *dev)
{
	const struct hello_world_driver_api *api = dev->driver_api;
	__ASSERT(api->print, "Callback pointer should not be NULL");
	api->print(dev);
}

#ifdef __cplusplus
}
#endif

#include <syscalls/hello_world_driver.h>

#endif /* __HELLO_WORLD_DRIVER_H__ */
```
