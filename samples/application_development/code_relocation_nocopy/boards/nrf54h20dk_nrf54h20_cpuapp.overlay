/*
 * Copyright (c) 2024 Nordic Semiconductor ASA
 *
 * SPDX-License-Identifier: Apache-2.0
 */

&xip_region {
	status = "okay";
};

&gpio6 {
	status = "okay";
};

&exmif {
	status = "okay";
};

&mx25uw63 {
	status = "okay";

	memmap-config = <1 0 0x20000000 0>;
};
