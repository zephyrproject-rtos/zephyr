/*
 * Copyright (c) 2026 STMicroelectronics
 *
 * SPDX-License-Identifier: Apache-2.0
 */

/ {
	aliases {
		/* The sample gets the DT_ALIAS(flash0) as the mspi device */
		flash0 = &mx25lm51245;
	};

	ext_mem: memory@90000000 {
		compatible = "zephyr,memory-region";
		reg = <0x90000000 DT_SIZE_M(8)>;
		zephyr,memory-region = "EXTMEM";
		zephyr,memory-attr = <DT_MEM_ARM(ATTR_MPU_IO)>;
	};
};

&mx25lm51245 {
	/* permission = 1 for Rd only */
	memmap-config = <1 0 DT_SIZE_M(64) 1>;

	#address-cells = <1>;
	#size-cells = <1>;
	ranges = <0x0 0x90000000 DT_SIZE_M(64)>;
};
