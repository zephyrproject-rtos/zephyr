## samples/Kconfig
```kconfig
# General configuration options for samples

# Copyright (c) 2025 The Zephyr Project Contributors
# SPDX-License-Identifier: Apache-2.0

config SYSTEM_WORKQUEUE_STACK_MIN_SIZE_SAMPLE
	int "System workqueue stack size for a sample application"
	default 1024
```

## samples/application_development/app_kconfig/src/Kconfig
```kconfig
config MERGE_PATCH
	bool "Merge patch"
	default y
	help
	Will this patch, supporting application
	Kconfig configuration, be merged?
```

## samples/application_development/code_relocation/sample.yaml
```yaml
sample:
  description: Code data relocation Sample
  name: code relocation
tests:
  sample.app_dev.code_relocation:
    harness: console
    harness_config:
      type: one_line
      regex:
      - "Hello World! (.*)"
    platform_whitelist: qemu_cortex_m3 mps2_an385 sam_e70_xplained
    tags: linker
    extra_sections: _SRAM2_RODATA_SECTION_NAME _SRAM_TEXT_SECTION_NAME _SRAM_RODATA_SECTION_NAME _SRAM_DATA_SECTION_NAME _CUSTOM_SECTION_NAME2
```

## samples/application_development/code_relocation_nocopy/boards/disco_l475_iot1.conf
```kconfig
# SPDX-FileCopyrightText: Copyright The Zephyr Project Contributors
# SPDX-License-Identifier: Apache-2.0

CONFIG_FLASH=y
CONFIG_STM32_MEMMAP=y
```

## samples/application_development/code_relocation_nocopy/boards/stm32h573i_dk.conf
```kconfig
# SPDX-FileCopyrightText: Copyright The Zephyr Project Contributors
# SPDX-License-Identifier: Apache-2.0

CONFIG_FLASH=y
CONFIG_FLASH_STM32_NOR_MEMMAP=y
```

## samples/application_development/code_relocation_nocopy/sample.yaml
```yaml
sample:
  description: Code data relocation nocopy Sample
  name: code relocation nocopy
tests:
  sample.app_dev.code_relocation_nocopy:
    platform_allow:
      - qemu_cortex_m3
      - nrf5340dk/nrf5340/cpuapp
      - stm32f769i_disco
      - stm32h7b3i_dk
      - stm32h573i_dk
      - b_u585i_iot02a
      - stm32h745i_disco/stm32h745xx/m7
      - stm32h750b_dk
      - stm32f746g_disco
    integration_platforms:
      - qemu_cortex_m3
    tags: linker
    harness: console
    harness_config:
      type: one_line
      regex:
        - "Hello World! (.*)"
```

## samples/application_development/deinit/sample.yaml
```yaml
sample:
  name: Device deinit
tests:
  sample.application_development.deinit:
    platform_allow:
      - nrf5340dk/nrf5340/cpuapp
    harness: console
    harness_config:
      type: one_line
      regex:
        - "sample complete"
```

## samples/application_development/external_lib/sample.yaml
```yaml
sample:
  name: External Library
tests:
  sample.app_dev.external_lib:
    integration_platforms:
      - native_sim
    tags: external
    harness: console
    harness_config:
      type: multi_line
      regex:
        - "Hello World!"
        - "mylib says: Hello World!"
```

## samples/application_development/linker_regions/sample.yaml
```yaml
sample:
  name: Linker regions
tests:
  sample.app_dev.linker_regions:
    tags: linker
    harness: console
    harness_config:
      type: one_line
      regex:
        - "First @ 0x38000: 0xdeadbeef"
    platform_allow: qemu_cortex_m3
  sample.app_dev.linker_regions_multiple:
    tags: linker
    harness: console
    harness_config:
      type: multi_line
      regex:
        - "First @ 0x3c000: 0xdeadbeef"
        - "Second @ 0x38000: 0xf00dcafe"
    platform_allow: qemu_cortex_m3
    extra_args: SECOND_REGION DTC_OVERLAY_FILE=boards/qemu_cortex_m3_multiple.overlay
```

## samples/application_development/out_of_tree_board/boards/arm/nrf52840_pca10056/Kconfig
```kconfig
# Kconfig - nRF52840 PCA10056 board configuration
#
# Copyright (c) 2016 Nordic Semiconductor ASA
#
# SPDX-License-Identifier: Apache-2.0

if BOARD_NRF52840_PCA10056

config GPIO_AS_PINRESET
	bool "GPIO as pin reset (reset button)"
	default y

endif # BOARD_NRF52840_PCA10056
```

## samples/application_development/out_of_tree_board/boards/arm/nrf52840_pca10056/Kconfig.board
```kconfig
# nRF52840 PCA10056

# Copyright (c) 2016 Nordic Semiconductor ASA
# SPDX-License-Identifier: Apache-2.0

config BOARD_NRF52840_PCA10056
	def_bool "$(BOARD)" = "nrf52840_pca10056"
	select HAS_DTS_GPIO
	depends on SOC_NRF52840_QIAA
```

## samples/application_development/out_of_tree_board/boards/arm/nrf52840_pca10056/Kconfig.defconfig
```kconfig
# Kconfig - nRF52 PCA10040 board configuration
#
# Copyright (c) 2016 Nordic Semiconductor ASA
#
# SPDX-License-Identifier: Apache-2.0

if BOARD_NRF52840_PCA10056

config BOARD
	default "nrf52840_pca10056"

if USB

config USB_NRF52840
	def_bool y

config USB_DEVICE_STACK
	def_bool y

endif # USB

endif # BOARD_NRF52840_PCA10056
```

## samples/application_development/out_of_tree_board/boards/arm/nrf52840dk_nrf52840/Kconfig
```kconfig
# nRF52840 DK NRF52840 board configuration

# Copyright (c) 2016 Nordic Semiconductor ASA
# SPDX-License-Identifier: Apache-2.0

if BOARD_NRF52840DK_NRF52840

config GPIO_AS_PINRESET
	bool "GPIO as pin reset (reset button)"
	default y

endif # BOARD_NRF52840DK_NRF52840
```

## samples/application_development/out_of_tree_board/boards/arm/nrf52840dk_nrf52840/Kconfig.defconfig
```kconfig
# nRF52840 DK NRF52840 board configuration

# Copyright (c) 2016 Nordic Semiconductor ASA
# SPDX-License-Identifier: Apache-2.0

if BOARD_NRF52840DK_NRF52840

config BOARD
	default "nrf52840dk_nrf52840"

if USB

config USB_DEVICE_STACK
	default y

endif # USB

endif # BOARD_NRF52840DK_NRF52840
```

## samples/application_development/out_of_tree_board/sample.yaml
```yaml
sample:
  description: Sample that uses an out-of-tree board
  name: Out-of-tree board
tests:
  sample.app_dev.out_of_tree:
    tags: out_of_tree
    platform_allow: nrf52840dk_nrf52840 nrf52dk_nrf52832
    harness: console
    harness_config:
      type: one_line
      regex:
        - "Hello World! (.*)"
```

## samples/application_development/out_of_tree_driver/hello_world_module/zephyr/Kconfig
```kconfig
# Copyright (c) 2019 Nordic Semiconductor
# SPDX-License-Identifier: Apache-2.0

config HELLO_WORLD_DRIVER
	bool "Support for the demonstration out of tree driver"
	select APPLICATION_DEFINED_SYSCALL
```

## samples/application_development/out_of_tree_driver/sample.yaml
```yaml
sample:
  description: Sample that uses an out-of-tree driver
  name: Out-of-tree driver
tests:
  sample.drivers.out_of_tree:
    integration_platforms:
      - native_posix
    tags: out_of_tree
    harness: console
    harness_config:
      type: multi_line
      regex:
        - "Hello World from the app!"
        - "device is (.*), name is CUSTOM_DRIVER"
        - "Hello World from the kernel: 5"
```

## samples/application_development/sysbuild/with_mcuboot/sample.yaml
```yaml
sample:
  description: Sample with MCUboot built through sysbuild
  name: with mcuboot
tests:
  sample.application_development.sysbuild.with_mcuboot:
    sysbuild: true
    # Platform allowed is used as twister using sysbuild still lacks proper
    # filtering support, see discussion in #49552.
    platform_allow:
      - reel_board
      - nrf52840dk_nrf52840
    integration_platforms:
      - nrf52840dk_nrf52840
    tags: mcuboot
    harness: console
    harness_config:
      type: multi_line
      regex:
        - "Address of sample(.*)"
        - "Hello sysbuild with mcuboot!(.*)"
```

## samples/arch/mpu/mpu/sample.yaml
```yaml
sample:
  name: Memory Protection Unit (MPU) Sample
tests:
  sample.mpu.read_write:
    platform_key:
      - arch
    arch_allow:
      - arm
    tags:
      - mpu
    depends_on:
      - mpu
    harness: keyboard
```

## samples/arch/mpu/mpu_test/sample.yaml
```yaml
sample:
  name: MPU Test
tests:
  sample.mpu.mpu_test:
    arch_allow: arm
    filter: CONFIG_CPU_HAS_MPU and not CONFIG_ARM64 and not CONFIG_SOC_SERIES_S32ZE
    platform_exclude:
      - versal2_rpu/amd_versal2_rpu
    tags:
      - mpu
    harness: shell
    integration_platforms:
      - mps2/an385
  sample.mpu.mpu_test.versal2_rpu:
    arch_allow: arm
    filter: CONFIG_CPU_HAS_MPU and not CONFIG_ARM64
    platform_allow:
      - versal2_rpu/amd_versal2_rpu
    tags:
      - mpu
    harness: shell
    harness_config:
      shell_commands_file: boards/versal2_rpu_amd_versal2_rpu.test_shell.yml
```
