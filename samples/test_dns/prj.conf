## CMakeLists.txt
```
# SPDX-License-Identifier: Apache-2.0

option(FEATURE_TEST "ZTEST" OFF)
option(FEATURE_DEBUG "debug setings" ON)

cmake_minimum_required(VERSION 3.13.1)

find_package(Zephyr REQUIRED HINTS $ENV{ZEPHYR_BASE})

project(dkmz VERSION ${VERSION})

FILE(GLOB app_sources src/*.c*)

target_sources(app PRIVATE 
	${app_sources}
)

target_include_directories(app PRIVATE
	build
	${CMAKE_SOURCE_DIR}
)
```

## prj.conf
```kconfig
CONFIG_SIZE_OPTIMIZATIONS=y
CONFIG_BOOT_BANNER=n
CONFIG_REBOOT=y

CONFIG_MINIMAL_LIBC_MALLOC_ARENA_SIZE=51024

CONFIG_MAIN_STACK_SIZE=2560

CONFIG_ENTROPY_GENERATOR=y
CONFIG_TEST_RANDOM_GENERATOR=y

CONFIG_GPIO=y
CONFIG_SERIAL=y
CONFIG_UART_INTERRUPT_DRIVEN=y
CONFIG_WATCHDOG=y
CONFIG_WDT_DISABLE_AT_BOOT=y
CONFIG_ADC=n
CONFIG_ADC_ASYNC=n
CONFIG_I2C=n
CONFIG_EEPROM=n
CONFIG_EEPROM_AT24=n

CONFIG_RING_BUFFER=y

CONFIG_CBPRINTF_FP_SUPPORT=y

CONFIG_PRINTK=y

CONFIG_CONSOLE=y
CONFIG_UART_CONSOLE=y
CONFIG_STDOUT_CONSOLE=y


CONFIG_LOG_PRINTK=y
CONFIG_LOG_PRINTK_MAX_STRING_LENGTH=256
CONFIG_LOG_BUFFER_SIZE=8192
CONFIG_LOG_STRDUP_MAX_STRING=76
CONFIG_LOG_STRDUP_BUF_COUNT=164
CONFIG_LOG_BLOCK_IN_THREAD=y
CONFIG_LOG_PROCESS_TRIGGER_THRESHOLD=0
CONFIG_LOG_PROCESS_THREAD_SLEEP_MS=1

CONFIG_DEBUG_COREDUMP=y
CONFIG_DEBUG_INFO=y
CONFIG_THREAD_ANALYZER=y
CONFIG_STACK_USAGE=y

CONFIG_ESP32_WIFI_IRAM_OPT=n
CONFIG_ESP32_WIFI_RX_IRAM_OPT=n

CONFIG_POSIX_API=n
CONFIG_POSIX_CLOCK=n

CONFIG_NET_SHELL=n
CONFIG_ADC_SHELL=n


CONFIG_MBEDTLS=y
CONFIG_MBEDTLS_BUILTIN=y
CONFIG_MBEDTLS_ENABLE_HEAP=y
CONFIG_MBEDTLS_HEAP_SIZE=65536
CONFIG_MBEDTLS_SSL_MAX_CONTENT_LEN=6144
CONFIG_MBEDTLS_MAC_SHA256_ENABLED=y
CONFIG_MBEDTLS_MAC_SHA512_ENABLED=y
CONFIG_MBEDTLS_KEY_EXCHANGE_ECDH_ECDSA_ENABLED=y
CONFIG_MBEDTLS_KEY_EXCHANGE_ECDHE_ECDSA_ENABLED=y
CONFIG_MBEDTLS_KEY_EXCHANGE_ECDHE_RSA_ENABLED=y
CONFIG_MBEDTLS_ECP_DP_SECP384R1_ENABLED=y
CONFIG_MBEDTLS_CIPHER_GCM_ENABLED=y
CONFIG_MBEDTLS_ENTROPY_ENABLED=y

CONFIG_WIFI=y
CONFIG_WIFI_ESP32=y
CONFIG_NETWORKING=y
CONFIG_NET_L2_ETHERNET=y
CONFIG_NET_L2_WIFI_MGMT=y
CONFIG_NET_MGMT=y
CONFIG_NET_MGMT_EVENT=y
CONFIG_NET_IPV6=n
CONFIG_NET_IPV4=y
CONFIG_NET_DHCPV4=y
CONFIG_NET_LOG=y
CONFIG_NET_TCP=y
CONFIG_NET_TCP_TIME_WAIT_DELAY=0
CONFIG_NET_TCP_BACKLOG_SIZE=4
CONFIG_NET_TCP_ACK_TIMEOUT=5000
CONFIG_NET_SOCKETS=y
CONFIG_NET_L2_WIFI_MGMT=y
CONFIG_NET_MAX_CONN=8

CONFIG_DNS_RESOLVER=y
CONFIG_DNS_SERVER_IP_ADDRESSES=y
CONFIG_DNS_SERVER1="8.8.8.8"

CONFIG_HEAP_MEM_POOL_SIZE=48072

CONFIG_ESP32_WIFI_STA_AUTO=y
CONFIG_ESP32_WIFI_SSID="ASUS_68_2G"
CONFIG_ESP32_WIFI_PASSWORD="password"
```

## src/main.c
```c
/*
 * main.c
 *
 *  Created on: Oct 17, 2021
 *      Author: Serhii Kulyk
 */


#include <zephyr.h>
#include <sys/printk.h>
#include <time.h>
#include <net/socket.h>
#include <net/net_ip.h>
#include <stdio.h>

#include <logging/log.h>
LOG_MODULE_REGISTER(main, LOG_LEVEL_DBG);

#define SERVER_ADDR "google.com"
#define SERVER_PORT 443

static bool dhcpAcquired = false;

static int getAddrinfo(struct zsock_addrinfo **haddr, const char *srv, int sPort) {
    struct zsock_addrinfo hints = {
            .ai_family = AF_INET,
            .ai_socktype = SOCK_STREAM,
            .ai_protocol = 0,
    };
    char port[6] = {0};
    snprintf(port, sizeof(port), "%u", SERVER_PORT);

    int rc = -EINVAL;
    rc = zsock_getaddrinfo(srv, port, &hints, haddr);
    if (!rc) {
        LOG_INF("DNS resolved");
    }
    return rc;
}

#ifdef CONFIG_NET_L2_ETHERNET
#include <net/net_if.h>
#include <net/net_core.h>
#include <net/net_context.h>
#include <net/net_mgmt.h>
static struct net_mgmt_event_callback dhcp_cb;
static void handler_cb(struct net_mgmt_event_callback *cb, uint32_t mgmt_event, struct net_if *iface) {
    if (mgmt_event != NET_EVENT_IPV4_DHCP_BOUND) {
        return;
    }

    char buf[NET_IPV4_ADDR_LEN];
    LOG_INF("Your address: %s", log_strdup(net_addr_ntop(AF_INET, &iface->config.dhcpv4.requested_ip, buf, sizeof(buf))));
    LOG_INF("Lease time: %u seconds", iface->config.dhcpv4.lease_time);
    LOG_INF("Subnet: %s", log_strdup(net_addr_ntop(AF_INET, &iface->config.ip.ipv4->netmask, buf, sizeof(buf))));
    LOG_INF("Router: %s", log_strdup(net_addr_ntop(AF_INET, &iface->config.ip.ipv4->gw, buf, sizeof(buf))));

    dhcpAcquired = true;
}
#endif

void main() {

#ifdef CONFIG_NET_L2_ETHERNET
    net_mgmt_init_event_callback(&dhcp_cb, handler_cb, NET_EVENT_IPV4_DHCP_BOUND);
    net_mgmt_add_event_callback(&dhcp_cb);

    struct net_if *iface = net_if_get_default();
    if (iface) {
        net_dhcpv4_start(iface);
    } else
        LOG_ERR("wifi interface not available");
#endif

    while (1) {
        k_sleep(K_MSEC(100));
        if (!dhcpAcquired)
            continue;

        struct zsock_addrinfo *haddr = NULL;
        int rc = getAddrinfo(&haddr, SERVER_ADDR, SERVER_PORT);
        if (rc) {
            LOG_INF("Hostname is not resolved %s:%d, %d", log_strdup(SERVER_ADDR), SERVER_PORT, rc);
            continue;
        }

        LOG_INF("Got add info");
        char addr[17] = { 0 };
        snprintf(addr, sizeof(addr), "%u.%u.%u.%u",
                        net_sin((haddr)->ai_addr)->sin_addr.s4_addr[0],
                        net_sin((haddr)->ai_addr)->sin_addr.s4_addr[1],
                        net_sin((haddr)->ai_addr)->sin_addr.s4_addr[2],
                        net_sin((haddr)->ai_addr)->sin_addr.s4_addr[3]);
        zsock_freeaddrinfo(haddr);
        LOG_INF("Got IP %s", log_strdup(addr));
    }
}
```
