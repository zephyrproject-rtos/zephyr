## CMakeLists.txt
```
cmake_minimum_required(VERSION 3.20.0)

find_package(Zephyr REQUIRED HINTS $ENV{ZEPHYR_BASE})
project(shell_over_bt)

target_sources(app PRIVATE
        src/main.c
        src/bt_app.c
)
```

## sample.yaml
```
sample:
  name: Shell over Bluetooth Sample
tests:
  sample.shell.bluetooth:
    tags:
      - shell
      - bluetooth
    harness: keyboard
    platform_allow: nrf52833dk_nrf52833
    integration_platforms:
      - nrf52833dk_nrf52833
```

## prj.conf
```kconfig
# Shell Config
CONFIG_SHELL=y
CONFIG_SHELL_BACKEND_BT=y
CONFIG_SHELL_LOG_BACKEND=n

# Additional Shell Commands
CONFIG_INIT_STACKS=y
CONFIG_THREAD_STACK_INFO=y
CONFIG_KERNEL_SHELL=y
CONFIG_THREAD_MONITOR=y
CONFIG_BOOT_BANNER=n
CONFIG_THREAD_NAME=y
CONFIG_DEVICE_SHELL=y
CONFIG_POSIX_CLOCK=y
CONFIG_DATE_SHELL=y
CONFIG_THREAD_RUNTIME_STATS=y
CONFIG_THREAD_RUNTIME_STATS_USE_TIMING_FUNCTIONS=y

# Bluetooth Configuration
CONFIG_BT=y
CONFIG_BT_PERIPHERAL=y
CONFIG_BT_DEVICE_NAME="Shell-Sample"
CONFIG_BT_RX_STACK_SIZE=2048
# Allow for large Bluetooth data packets.
CONFIG_BT_L2CAP_TX_MTU=512
CONFIG_BT_BUF_ACL_RX_SIZE=502
CONFIG_BT_BUF_ACL_TX_SIZE=502
CONFIG_BT_CTLR_DATA_LENGTH_MAX=251
```

## src/main.c
```c
/*
 * Copyright (c) 2024 Croxel, Inc.
 *
 * SPDX-License-Identifier: Apache-2.0
 */

#include <zephyr/kernel.h>

extern int bt_app_init(void);

int main(void)
{
	int err = -1;

	err = bt_app_init();
	if (err) {
		printk("Bluetooth failed to initialize: %d\n", err);
		return err;
	}

	printk("Shell over Bluetooth Sample started!\n");

	return 0;
}
```

## src/bt_app.c
```c
/*
 * Copyright (c) 2024 Croxel, Inc.
 *
 * SPDX-License-Identifier: Apache-2.0
 */

#include <zephyr/shell/shell_bt.h>
#include <zephyr/bluetooth/bluetooth.h>
#include <zephyr/bluetooth/conn.h>

#define DEVICE_NAME		CONFIG_BT_DEVICE_NAME
#define DEVICE_NAME_LEN		(sizeof(DEVICE_NAME) - 1)

static const struct bt_data ad[] = {
	BT_DATA_BYTES(BT_DATA_FLAGS, (BT_LE_AD_GENERAL | BT_LE_AD_NO_BREDR)),
	BT_DATA(BT_DATA_NAME_COMPLETE, DEVICE_NAME, DEVICE_NAME_LEN),
};

static const struct bt_data sd[] = {
	BT_DATA_BYTES(BT_DATA_UUID128_ALL, BT_UUID_SHELL_SRV_VAL),
};

static void connected(struct bt_conn *conn, uint8_t err)
{
	if (err) {
		printk("Connection failed (err %u)\n", err);
		return;
	}

	printk("Connected\n");
}

static void disconnected(struct bt_conn *conn, uint8_t reason)
{
	printk("Disconnected (reason %u)\n", reason);
}

BT_CONN_CB_DEFINE(conn_callbacks) = {
	.connected        = connected,
	.disconnected     = disconnected,
};

int bt_app_init(void)
{
	int err = -1;

	err = bt_enable(NULL);
	if (err) {
		return err;
	}

	err = bt_le_adv_start(BT_LE_ADV_CONN, ad, ARRAY_SIZE(ad), sd, ARRAY_SIZE(sd));
	if (err) {
		return err;
	}

	return 0;
}
```
