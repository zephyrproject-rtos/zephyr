## CMakeLists.txt
```
# Copyright 2025 Nordic Semiconductor ASA
# SPDX-License-Identifier: Apache-2.0

cmake_minimum_required(VERSION 3.20.0)

find_package(Zephyr REQUIRED HINTS $ENV{ZEPHYR_BASE})
project(shell_threadless)

target_sources(app PRIVATE src/main.c)
```

## sample.yaml
```
sample:
  description: Threadless shell using uart backend
  name: Threadless shell
tests:
  sample.subsys.shell.threadless:
    tags: threadless
    min_ram: 2
    min_flash: 32
    filter: CONFIG_ARCH_HAS_SINGLE_THREAD_SUPPORT and
            dt_chosen_enabled("zephyr,shell-uart")
    harness: shell
    harness_config:
      shell_commands:
        - command: "sample foobar"
          expected: "foobar"
    platform_exclude:
      - qemu_cortex_a53
      - qemu_cortex_a53/qemu_cortex_a53/smp
```

## prj.conf
```kconfig
CONFIG_MULTITHREADING=n
CONFIG_SHELL=y
CONFIG_SHELL_MINIMAL=y
```

## src/main.c
```c
/*
 * Copyright 2025 Nordic Semiconductor ASA
 *
 * SPDX-License-Identifier: Apache-2.0
 */

#include <zephyr/shell/shell.h>
#include <zephyr/shell/shell_uart.h>

static int sample_sh_echo(const struct shell *sh, size_t argc, char **argv)
{
	shell_print(sh, "%s", argv[1]);
	return 0;
}

SHELL_CMD_ARG_REGISTER(sample, NULL, "Echo", sample_sh_echo, 2, 2);

int main(void)
{
	/*
	 * Start the shell. This prints the shell prompt and enables
	 * input reception.
	 */
	shell_start(shell_backend_uart_get_ptr());

	while (1) {
		/* Check for new input and process it if present */
		shell_process(shell_backend_uart_get_ptr());
	}

	return 0;
}
```
