## CMakeLists.txt
```
include($ENV{ZEPHYR_BASE}/cmake/app/boilerplate.cmake NO_POLICY_SCOPE)
project(NONE)

target_sources(app PRIVATE src/main.c src/dynamic_cmd.c src/qsort.c)
```

## sample.yaml
```
sample:
  description: Hello World sample, the simplest Zephyr
    application
  name: hello world
  platforms: all
common:
    tags: samples
    harness: console
    harness_config:
      type: one_line
      regex:
        - "Hello World! (.*)"
tests:
  sample.helloworld.singlethread:
    extra_args: CONF_FILE=prj_single.conf
    filter: not CONFIG_BT and not CONFIG_GPIO_SCH and ASSERT == 0
  sample.helloworld.multithread:
    tags: samples
```

## prj.conf
```kconfig
CONFIG_PRINTK=y
CONFIG_SHELL=y
CONFIG_SHELL_RTT=y
CONFIG_INIT_STACKS=y
```

## src/main.c
```c
/*
 * Copyright (c) 2015 Intel Corporation
 *
 * SPDX-License-Identifier: Apache-2.0
 */

#include <zephyr.h>
#include <misc/printk.h>
#include <shell/cli.h>
#include <shell/shell_uart.h>
#include <shell/shell_rtt.h>
#include <version.h>

#if CONFIG_SHELL
void test_cmd(const struct shell *shell, size_t argc, char **argv)
{
	shell_fprintf(shell, SHELL_NORMAL, "hello\r\n");
}
SHELL_UART_DEFINE(shell_transport_uart);
SHELL_RTT_DEFINE(shell_transport_rtt);
SHELL_CMD_REGISTER(test, NULL, "help", test_cmd);

SHELL_DEF(uart_shell, "uart:~$ ", &shell_transport_uart, '\r', 10);
SHELL_DEF(rtt_shell, "rtt:~$ ", &shell_transport_rtt, '\r', 10);
#endif

void main(void)
{
	//(void)shell_init(&uart_shell, NULL, true, false, 0);
#if CONFIG_SHELL
	(void)shell_init(&rtt_shell, NULL, true, false, 0);
#endif
}
```

## src/dynamic_cmd.c
```c
/*
 * Copyright (c) 2018 Nordic Semiconductor ASA
 *
 * SPDX-License-Identifier: Apache-2.0
 */

#include <shell/cli.h>
#include <ctype.h>
#include <stdio.h>

#define MAX_CMD_CNT (20u)
#define MAX_CMD_LEN (33u)

/* buffer holding dynamicly created user commands */
static char dynamic_cmd_buffer[MAX_CMD_CNT][MAX_CMD_LEN];
/* commands counter */
static uint8_t dynamic_cmd_cnt;

typedef int cmp_t(const void *, const void *);
extern void qsort(void *a, size_t n, size_t es, cmp_t *cmp);

static void cmd_dynamic(const struct shell * shell, size_t argc, char **argv)
{
	if ((argc == 1) || shell_help_requested(shell)) {
		shell_help_print(shell, NULL, 0);
		return;
	}

	if (argc > 2)
	{
		shell_fprintf(shell, SHELL_ERROR,
			      "%s: bad parameter count\r\n", argv[0]);
	}
	else
	{
		shell_fprintf(shell, SHELL_ERROR,
			      "%s: please specify subcommand\r\n", argv[0]);
	}
}

/* function required by qsort */
static int string_cmp(const void * p_a, const void * p_b)
{
	return strcmp((const char *)p_a, (const char *)p_b);
}

static void cmd_dynamic_add(const struct shell * shell,
			    size_t argc, char **argv)
{
	uint8_t idx;
	u16_t cmd_len;

	if (shell_help_requested(shell)) {
		shell_help_print(shell, NULL, 0);
		return;
	}

	if (argc != 2) {
		shell_fprintf(shell, SHELL_ERROR,
			      "%s: bad parameter count\r\n", argv[0]);
		return;
	}

	if (dynamic_cmd_cnt >= MAX_CMD_CNT) {
		shell_fprintf(shell, SHELL_ERROR, "command limit reached\r\n");
		return;
	}

	cmd_len = strlen(argv[1]);

	if (cmd_len >= MAX_CMD_LEN) {
		shell_fprintf(shell, SHELL_ERROR, "too long command\r\n");
		return;
	}

	for (idx = 0; idx < cmd_len; idx++) {
		if (!isalnum((int)(argv[1][idx]))) {
			shell_fprintf(shell, SHELL_ERROR,
				     "bad command name - please use only"
				     "alphanumerical characters\r\n");
			return;
		}
	}

	for (idx = 0; idx < MAX_CMD_CNT; idx++) {
		if (!strcmp(dynamic_cmd_buffer[idx], argv[1])) {
			shell_fprintf(shell, SHELL_ERROR,
				      "duplicated command\r\n");
			return;
		}
	}

	sprintf(dynamic_cmd_buffer[dynamic_cmd_cnt++], "%s", argv[1]);

	qsort(dynamic_cmd_buffer, dynamic_cmd_cnt,
	      sizeof (dynamic_cmd_buffer[0]), string_cmp);

	shell_fprintf(shell, SHELL_NORMAL, "command added successfully\r\n");
}

static void cmd_dynamic_show(const struct shell * shell,
			     size_t argc, char **argv)
{
	if (shell_help_requested(shell)) {
		shell_help_print(shell, NULL, 0);
		return;
	}

	if (argc != 1) {
		shell_fprintf(shell, SHELL_ERROR,
			      "%s: bad parameter count\r\n", argv[0]);
		return;
	}

	if (dynamic_cmd_cnt == 0) {
		shell_fprintf(shell, SHELL_WARNING,
			      "Please add some commands first.\r\n");
		return;
	}

	shell_fprintf(shell, SHELL_NORMAL, "Dynamic command list:\r\n");

	for (uint8_t i = 0; i < dynamic_cmd_cnt; i++) {
		shell_fprintf(shell, SHELL_NORMAL,
			      "[%3d] %s\r\n", i, dynamic_cmd_buffer[i]);
	}
}

static void cmd_dynamic_execute(const struct shell * shell,
				size_t argc, char **argv)
{
	if (shell_help_requested(shell)) {
		shell_help_print(shell, NULL, 0);
		return;
	}

	if (argc != 2) {
		shell_fprintf(shell, SHELL_ERROR,
			      "%s: bad parameter count\r\n", argv[0]);
		return;
	}

	for (uint8_t idx = 0; idx <  dynamic_cmd_cnt; idx++) {
		if (!strcmp(dynamic_cmd_buffer[idx], argv[1])) {
			shell_fprintf(shell, SHELL_NORMAL,
				      "dynamic command: %s\r\n", argv[1]);
			return;
		}
	}

	shell_fprintf(shell, SHELL_ERROR,
		      "%s: uknown parameter: %s\r\n", argv[0], argv[1]);
}

static void cmd_dynamic_remove(const struct shell * shell, size_t argc, char **argv)
{
	if ((argc == 1) || shell_help_requested(shell)) {
		shell_help_print(shell, NULL, 0);
		return;
	}

	if (argc != 2) {
		shell_fprintf(shell, SHELL_ERROR,
			      "%s: bad parameter count\r\n", argv[0]);
		return;
	}

	for (uint8_t idx = 0; idx <  dynamic_cmd_cnt; idx++) {
		if (!strcmp(dynamic_cmd_buffer[idx], argv[1])) {
			if (idx == MAX_CMD_CNT - 1) {
				dynamic_cmd_buffer[idx][0] = '\0';
			} else {
				memmove(dynamic_cmd_buffer[idx],
					dynamic_cmd_buffer[idx + 1],
					sizeof(dynamic_cmd_buffer[idx]) *
					(dynamic_cmd_cnt - idx));
			}

			--dynamic_cmd_cnt;
			shell_fprintf(shell, SHELL_NORMAL,
				      "command removed successfully\r\n");
			return;
		}
	}
	shell_fprintf(shell, SHELL_ERROR,
		      "did not find command: %s\r\n", argv[1]);
}

/* dynamic command creation */
static void dynamic_cmd_get(size_t idx, struct shell_static_entry * entry)
{
	if (idx < dynamic_cmd_cnt)
	{
		/* m_dynamic_cmd_buffer must be sorted alphabetically to ensure
		 * correct CLI completion
		 */
		entry->syntax = dynamic_cmd_buffer[idx];
		entry->handler  = NULL;
		entry->subcmd = NULL;
		entry->help = "Show dynamic command name.";
	}
	else
	{
		/* if there are no more dynamic commands available syntax
		 * must be set to NULL.
		 */
		entry->syntax = NULL;
	}
}

SHELL_CREATE_DYNAMIC_CMD(m_sub_dynamic_set, dynamic_cmd_get);
SHELL_CREATE_STATIC_SUBCMD_SET(m_sub_dynamic)
{
	SHELL_CMD(add, NULL,
		"Add a new dynamic command.\nExample usage: [ dynamic add test "
		"] will add a dynamic command 'test'.\nIn this example, command"
		" name length is limited to 32 chars. You can add up to 20"
		"commands. Commands are automatically sorted to ensure correct "
		"CLI completion.",
		cmd_dynamic_add),
	SHELL_CMD(execute, &m_sub_dynamic_set,
		"Execute a command.", cmd_dynamic_execute),
	SHELL_CMD(remove, &m_sub_dynamic_set,
		"Remove a command.", cmd_dynamic_remove),
	SHELL_CMD(show, NULL,
		"Show all added dynamic commands.", cmd_dynamic_show),
	SHELL_SUBCMD_SET_END
};

SHELL_CMD_REGISTER(dynamic, &m_sub_dynamic,
		   "Demonstrate dynamic command usage.", cmd_dynamic);
```

## src/qsort.c
```c
/*-
 * SPDX-License-Identifier: BSD-3-Clause
 *
 * Copyright (c) 1992, 1993
 *	The Regents of the University of California.  All rights reserved.
 *
 * Redistribution and use in source and binary forms, with or without
 * modification, are permitted provided that the following conditions
 * are met:
 * 1. Redistributions of source code must retain the above copyright
 *    notice, this list of conditions and the following disclaimer.
 * 2. Redistributions in binary form must reproduce the above copyright
 *    notice, this list of conditions and the following disclaimer in the
 *    documentation and/or other materials provided with the distribution.
 * 3. Neither the name of the University nor the names of its contributors
 *    may be used to endorse or promote products derived from this software
 *    without specific prior written permission.
 *
 * THIS SOFTWARE IS PROVIDED BY THE REGENTS AND CONTRIBUTORS ``AS IS'' AND
 * ANY EXPRESS OR IMPLIED WARRANTIES, INCLUDING, BUT NOT LIMITED TO, THE
 * IMPLIED WARRANTIES OF MERCHANTABILITY AND FITNESS FOR A PARTICULAR PURPOSE
 * ARE DISCLAIMED.  IN NO EVENT SHALL THE REGENTS OR CONTRIBUTORS BE LIABLE
 * FOR ANY DIRECT, INDIRECT, INCIDENTAL, SPECIAL, EXEMPLARY, OR CONSEQUENTIAL
 * DAMAGES (INCLUDING, BUT NOT LIMITED TO, PROCUREMENT OF SUBSTITUTE GOODS
 * OR SERVICES; LOSS OF USE, DATA, OR PROFITS; OR BUSINESS INTERRUPTION)
 * HOWEVER CAUSED AND ON ANY THEORY OF LIABILITY, WHETHER IN CONTRACT, STRICT
 * LIABILITY, OR TORT (INCLUDING NEGLIGENCE OR OTHERWISE) ARISING IN ANY WAY
 * OUT OF THE USE OF THIS SOFTWARE, EVEN IF ADVISED OF THE POSSIBILITY OF
 * SUCH DAMAGE.
 */

#if defined(LIBC_SCCS) && !defined(lint)
static char sccsid[] = "@(#)qsort.c	8.1 (Berkeley) 6/4/93";
#endif /* LIBC_SCCS and not lint */
#include <sys/cdefs.h>
#include <stdlib.h>

#ifdef I_AM_QSORT_R
typedef int		 cmp_t(void *, const void *, const void *);
#else
typedef int		 cmp_t(const void *, const void *);
#endif
static inline char	*med3(char *, char *, char *, cmp_t *, void *);

#define	MIN(a, b)	((a) < (b) ? a : b)

/*
 * Qsort routine from Bentley & McIlroy's "Engineering a Sort Function".
 */

static inline void
swapfunc(char *a, char *b, size_t es)
{
	char t;

	do {
		t = *a;
		*a++ = *b;
		*b++ = t;
	} while (--es > 0);
}

#define	vecswap(a, b, n)				\
	if ((n) > 0) swapfunc(a, b, n)

#ifdef I_AM_QSORT_R
#define	CMP(t, x, y) (cmp((t), (x), (y)))
#else
#define	CMP(t, x, y) (cmp((x), (y)))
#endif

static inline char *
med3(char *a, char *b, char *c, cmp_t *cmp, void *thunk)
{
	return CMP(thunk, a, b) < 0 ?
	       (CMP(thunk, b, c) < 0 ? b : (CMP(thunk, a, c) < 0 ? c : a ))
	      :(CMP(thunk, b, c) > 0 ? b : (CMP(thunk, a, c) < 0 ? a : c ));
}

#ifdef I_AM_QSORT_R
void
qsort_r(void *a, size_t n, size_t es, void *thunk, cmp_t *cmp)
#else
#define	thunk NULL
void
qsort(void *a, size_t n, size_t es, cmp_t *cmp)
#endif
{
	char *pa, *pb, *pc, *pd, *pl, *pm, *pn;
	size_t d1, d2;
	int cmp_result;
	int swap_cnt;

loop:
	swap_cnt = 0;
	if (n < 7) {
		for (pm = (char *)a + es; pm < (char *)a + n * es; pm += es)
			for (pl = pm;
			     pl > (char *)a && CMP(thunk, pl - es, pl) > 0;
			     pl -= es)
				swapfunc(pl, pl - es, es);
		return;
	}
	pm = (char *)a + (n / 2) * es;
	if (n > 7) {
		pl = a;
		pn = (char *)a + (n - 1) * es;
		if (n > 40) {
			size_t d = (n / 8) * es;

			pl = med3(pl, pl + d, pl + 2 * d, cmp, thunk);
			pm = med3(pm - d, pm, pm + d, cmp, thunk);
			pn = med3(pn - 2 * d, pn - d, pn, cmp, thunk);
		}
		pm = med3(pl, pm, pn, cmp, thunk);
	}
	swapfunc(a, pm, es);
	pa = pb = (char *)a + es;

	pc = pd = (char *)a + (n - 1) * es;
	for (;;) {
		while (pb <= pc && (cmp_result = CMP(thunk, pb, a)) <= 0) {
			if (cmp_result == 0) {
				swap_cnt = 1;
				swapfunc(pa, pb, es);
				pa += es;
			}
			pb += es;
		}
		while (pb <= pc && (cmp_result = CMP(thunk, pc, a)) >= 0) {
			if (cmp_result == 0) {
				swap_cnt = 1;
				swapfunc(pc, pd, es);
				pd -= es;
			}
			pc -= es;
		}
		if (pb > pc)
			break;
		swapfunc(pb, pc, es);
		swap_cnt = 1;
		pb += es;
		pc -= es;
	}
	if (swap_cnt == 0) {  /* Switch to insertion sort */
		for (pm = (char *)a + es; pm < (char *)a + n * es; pm += es)
			for (pl = pm;
			     pl > (char *)a && CMP(thunk, pl - es, pl) > 0;
			     pl -= es)
				swapfunc(pl, pl - es, es);
		return;
	}

	pn = (char *)a + n * es;
	d1 = MIN(pa - (char *)a, pb - pa);
	vecswap(a, pb - d1, d1);
	d1 = MIN(pd - pc, pn - pd - es);
	vecswap(pb, pn - d1, d1);

	d1 = pb - pa;
	d2 = pd - pc;
	if (d1 <= d2) {
		/* Recurse on left partition, then iterate on right partition */
		if (d1 > es) {
#ifdef I_AM_QSORT_R
			qsort_r(a, d1 / es, es, thunk, cmp);
#else
			qsort(a, d1 / es, es, cmp);
#endif
		}
		if (d2 > es) {
			/* Iterate rather than recurse to save stack space */
			/* qsort(pn - d2, d2 / es, es, cmp); */
			a = pn - d2;
			n = d2 / es;
			goto loop;
		}
	} else {
		/* Recurse on right partition, then iterate on left partition */
		if (d2 > es) {
#ifdef I_AM_QSORT_R
			qsort_r(pn - d2, d2 / es, es, thunk, cmp);
#else
			qsort(pn - d2, d2 / es, es, cmp);
#endif
		}
		if (d1 > es) {
			/* Iterate rather than recurse to save stack space */
			/* qsort(a, d1 / es, es, cmp); */
			n = d1 / es;
			goto loop;
		}
	}
}
```
