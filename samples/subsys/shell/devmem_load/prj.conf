## CMakeLists.txt
```
# Copyright (c) 2021 Antmicro <www.antmicro.com>
# SPDX-License-Identifier: Apache-2.0

cmake_minimum_required(VERSION 3.28.0)
find_package(Zephyr REQUIRED HINTS $ENV{ZEPHYR_BASE})
project(devmem_load)

target_sources(app PRIVATE src/main.c)
```

## sample.yaml
```
sample:
  name: devmem_load
  description: devmem load sample
common:
  harness: keyboard
  tags:
    - devmem
    - devmem_load
tests:
  sample.devmem_load.polled:
    integration_platforms:
      - native_sim
    extra_args: CONF_FILE="prj_poll.conf"
  sample.devmem_load.uart.interrupt:
    integration_platforms:
      - frdm_k64f
    filter: CONFIG_SERIAL_SUPPORT_INTERRUPT
```

## prj.conf
```kconfig
CONFIG_BOOT_BANNER=n
CONFIG_SHELL=y
```

## prj_poll.conf
```kconfig
CONFIG_SHELL=y
CONFIG_SHELL_BACKEND_SERIAL_INTERRUPT_DRIVEN=n
CONFIG_SHELL_BACKEND_SERIAL_RX_POLL_PERIOD=1
CONFIG_BOOT_BANNER=n
```

## src/main.c
```c
/*
 * Copyright (c) 2024-2025 TSI
 *
 */

#include <stddef.h>
#include <stdio.h>
#include <zephyr/kernel.h>
#include <zephyr/logging/log.h>
#include <zephyr/sys/printk.h>
#include <zephyr/logging/log_ctrl.h>
#include <zephyr/logging/log_output.h>

#define DATA_MAX_DLEN 8
#define LOG_MODULE_NAME m85
LOG_MODULE_REGISTER(LOG_MODULE_NAME);
#define PRINT_TSI_BOOT_BANNER()  printk("        Tsavorite Scalable Intelligence \n")

int main(void)
{
	/* TSI banner */
	PRINT_TSI_BOOT_BANNER();
	printf("\n");
	printf("    |||||||||||||||||||||||||||||||||||||\n");
	printf("    |||||||||||||||||||||||||||||||||||||\n");
	printf("    ||||||                          |||||\n");
	printf("    ||||||                          |||||\n");
	printf("    |||||||||||||||||   |||||       |||||\n");
  printf("               ||||||   |||||\n");
	printf("    ||||||     ||||||   |||||      ||||||\n");
	printf("     ||||||||  ||||||   |||||   ||||||||\n");
	printf("       ||||||||||||||   ||||||||||||||\n");
	printf("          |||||||||||   ||||||||||||\n");
	printf("            |||||||||   ||||||||||\n");
	printf("              |||||||   ||||||||\n");
	printf("                |||||   |||||\n");
	printf("                  |||   |||\n");
	printf("                        |\n");
  
        LOG_INF("Logging Info: Test Platform: %s", CONFIG_BOARD_TARGET);
	LOG_WRN("Logging Warning : Testing on FPGA");
	printk(" From printk: TSI Logging enabled & printk is functional\n");
	/* By this point, SCU Global Reset register was exercised has pulled A53 & M85 out of reset */
        printk(" SCU Global Reset exercised successfully.\n");
}
```
