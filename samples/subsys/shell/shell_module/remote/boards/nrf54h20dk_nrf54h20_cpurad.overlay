/*
 * Copyright (c) 2026 Nordic Semiconductor ASA
 *
 * SPDX-License-Identifier: Apache-2.0
 */

/ {
	chosen {
		/delete-property/ zephyr,console;
		/delete-property/ zephyr,shell-uart;
		/delete-property/ zephyr,uart-mcumgr;
	};
};

&uart135 {
	status = "disabled";
};
