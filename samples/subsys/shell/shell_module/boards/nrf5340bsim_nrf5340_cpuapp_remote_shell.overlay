/*
 * Copyright (c) 2026 Nordic Semiconductor ASA
 *
 * SPDX-License-Identifier: Apache-2.0
 */

#include "nrf5340dk_nrf5340_cpuapp_remote_shell.overlay"

/ {
	chosen {
		zephyr,console = &uart0;
		zephyr,shell-uart = &uart0;
	};
};

&uart0 {
	status = "okay";
	compatible = "zephyr,native-pty-uart";
	/delete-property/ pinctrl-0;
	/delete-property/ pinctrl-1;
	/delete-property/ pinctrl-names;
};
