## samples/subsys/shell/fs/boards/mimxrt1060_evk.conf
```kconfig
#
# Copyright (c) 2021 NXP.
# SPDX-License-Identifier: Apache-2.0
#

CONFIG_MPU_ALLOW_FLASH_WRITE=y
```

## samples/subsys/shell/fs/sample.yaml
```yaml
sample:
  description: FS shell sample
  name: FS shell
common:
  tags:
    - shell
    - filesystem
  harness: keyboard
tests:
  sample.shell.filesystem:
    platform_allow:
      - reel_board
      - mimxrt1060_evk/mimxrt1062/qspi
      - mr_canhubk3
      - native_sim
      - s32z2xxdc2/s32z270/rtu0
      - s32z2xxdc2/s32z270/rtu1
      - s32z2xxdc2@D/s32z270/rtu0
      - s32z2xxdc2@D/s32z270/rtu1
      - s32k5xxcvb/s32k566/m7
      - s32k5xxcvb/s32k566/r52
    integration_platforms:
      - native_sim
  sample.shell.filesystem.fuse:
    platform_allow:
      - native_sim
    extra_configs:
      - CONFIG_FUSE_FS_ACCESS=y
    # This test cannot be run in CI as we lack the fuse library
    skip: true
  sample.shell.filesystem.flash_load:
    tags:
      - flash_load
    platform_allow: nrf52dk/nrf52832
    extra_args: CONF_FILE=prj_flash_load.conf
    integration_platforms:
      - nrf52dk/nrf52832
```

## samples/subsys/shell/new_shell/sample.yaml
```yaml
sample:
  description: Hello World sample, the simplest Zephyr
    application
  name: hello world
  platforms: all
common:
    tags: samples
    harness: console
    harness_config:
      type: one_line
      regex:
        - "Hello World! (.*)"
tests:
  sample.helloworld.singlethread:
    extra_args: CONF_FILE=prj_single.conf
    filter: not CONFIG_BT and not CONFIG_GPIO_SCH and ASSERT == 0
  sample.helloworld.multithread:
    tags: samples
```

## samples/subsys/shell/shell/sample.yaml
```yaml
sample:
  name: Shell Sample
tests:
  test:
    filter: CONFIG_UART_CONSOLE and CONFIG_SERIAL_SUPPORT_INTERRUPT
    tags: samples shell
    min_ram: 20
    harness: keyboard
```

## samples/subsys/shell/shell_ble/sample.yaml
```yaml
sample:
  name: BLE Shell
  description: Demonstrates BLE Zephyr shell backend
tests:
  sample.shell_ble:
    harness: bluetooth
    platform_allow:
      - qemu_x86
    integration_platforms:
      - qemu_x86
    tags: bluetooth
    build_only: true
```

## samples/subsys/shell/shell_doc_generator/sample.yaml
```yaml
sample:
  description: Generate hierarchical documentation of all available shell commands and subcommands using Zephyr's shell API and introspection.
  name: Shell Documentation Generator
common:
  tags: shell
  integration_platforms:
    - qemu_x86
  harness: pytest
  timeout: 10
  harness_config:
    pytest_root:
      - pytest/test_shell_doc.py
tests:
  sample.shell.doc_generator:
    tags: shell
```

## samples/subsys/shell/shell_module/Kconfig
```kconfig
# Kconfig - Config options for logger sample app
#
# Copyright (c) 2018 Nordic Semiconductor ASA
#
# SPDX-License-Identifier: Apache-2.0
#

mainmenu "Logger sample application"

menu "Application configuration"

config SHELL_FOREGROUND_CMDS
	bool "Shell foreground commands example"
	default y

config SHELL_DYNAMIC_CMDS
	bool "Shell dynamic commands example"
	default y

endmenu

source "Kconfig.zephyr"
```

## samples/subsys/shell/shell_module/Kconfig.sysbuild
```kconfig
#
# Copyright (c) 2026 Nordic Semiconductor ASA
#
# SPDX-License-Identifier: Apache-2.0
#

config REMOTE_BOARD
	string
	default "$(BOARD)/nrf5340/cpunet" if BOARD_NRF5340DK_NRF5340_CPUAPP
	default "$(BOARD)/nrf5340/cpunet" if BOARD_NRF5340BSIM_NRF5340_CPUAPP
	default "$(BOARD)/nrf54h20/cpurad" if SOC_NRF54H20_CPUAPP
	default "$(BOARD)/nrf54l15/cpuflpr" if SOC_NRF54L15_CPUAPP
	default "$(BOARD)/nrf54lm20a/cpuflpr" if SOC_NRF54LM20A_CPUAPP

source "share/sysbuild/Kconfig"
```

## samples/subsys/shell/shell_module/boards/efm32pg_stk3402a.conf
```kconfig
# Copyright (c) 2023 T-Mobile USA, Inc.
#
# SPDX-License-Identifier: Apache-2.0

CONFIG_REBOOT=y
```

## samples/subsys/shell/shell_module/boards/intel_socfpga_agilex5_socdk.conf
```kconfig
# Copyright (c) 2022-2023, Intel Corporation.
# SPDX-License-Identifier: Apache-2.0

# Misc
CONFIG_HEAP_MEM_POOL_SIZE=16384
CONFIG_SHELL_STACK_SIZE=8192

# Setting the max argc
CONFIG_SHELL_ARGC_MAX=12

# Enable the Zephyr boot banner
CONFIG_BOOT_BANNER=y

# Enable timer driver
CONFIG_COUNTER=y

# Enable Timer shell commands
CONFIG_COUNTER_SHELL=y

#SiP SVC Service
CONFIG_ARM_SIP_SVC_DRIVER=y
CONFIG_ARM_SIP_SVC_SUBSYS=y
CONFIG_ARM_SIP_SVC_SUBSYS_SINGLY_OPEN=y

#SiP SVC Service Shell
CONFIG_ARM_SIP_SVC_SUBSYS_SHELL=y

# Enable File System Shell
CONFIG_FILE_SYSTEM_SHELL=y

# Enable Disk access
CONFIG_DISK_ACCESS=y

# File System Setting
CONFIG_FILE_SYSTEM=y
CONFIG_FAT_FILESYSTEM_ELM=y

# Enable SDMMC
CONFIG_DISK_DRIVER_SDMMC=y

# Enable SDHC
CONFIG_SDHC=y
```

## samples/subsys/shell/shell_module/boards/qemu_x86_64.conf
```kconfig
CONFIG_PCIE=y
CONFIG_PCIE_SHELL=y
CONFIG_ACPI=y
CONFIG_ACPI_SHELL=y
CONFIG_EARLY_CONSOLE=y
```

## samples/subsys/shell/shell_module/sample.yaml
```yaml
sample:
  name: Shell Sample
common:
  filter: not CONFIG_NATIVE_LIBC and not CONFIG_SOC_SERIES_BSIM_NRFXX
tests:
  sample.shell.shell_module:
    filter: CONFIG_SERIAL and dt_chosen_enabled("zephyr,shell-uart")
    tags: shell
    harness: shell
    min_ram: 40
    integration_platforms:
      - native_sim
    extra_configs:
      - arch:posix:CONFIG_UART_NATIVE_PTY_0_ON_STDINOUT=y
  sample.shell.shell_module.usb:
    depends_on: usb_device
    tags:
      - shell
      - usb
    harness: keyboard
    min_ram: 40
    extra_args:
      - EXTRA_CONF_FILE="overlay-usb.conf"
      - DTC_OVERLAY_FILE="usb.overlay"
    integration_platforms:
      - native_sim
  sample.shell.shell_module.minimal:
    filter: CONFIG_SERIAL and dt_chosen_enabled("zephyr,shell-uart")
    tags: shell
    harness: keyboard
    extra_args: CONF_FILE="prj_minimal.conf"
    integration_platforms:
      - native_sim
  sample.shell.shell_module.getopt:
    integration_platforms:
      - qemu_x86
    arch_exclude: posix
    filter: CONFIG_SERIAL and dt_chosen_enabled("zephyr,shell-uart") and not CONFIG_NEWLIB_LIBC
    tags: shell
    harness: keyboard
    min_ram: 40
    extra_args: CONF_FILE="prj_getopt.conf"
  sample.shell.shell_module.minimal_rtt:
    filter: CONFIG_HAS_SEGGER_RTT
    tags: shell
    harness: keyboard
    extra_args: CONF_FILE="prj_minimal_rtt.conf"
    integration_platforms:
      - nrf52833dk/nrf52833
  sample.shell.shell_module.bt:
    platform_allow:
      - nrf52840dk/nrf52840
    integration_platforms:
      - nrf52840dk/nrf52840
    tags:
      - shell
      - bluetooth
    filter: CONFIG_DT_HAS_ZEPHYR_NUS_UART_ENABLED
    harness: bluetooth_nus
    arch_exclude:
      - posix
    extra_args:
      - EXTRA_CONF_FILE="overlay-bt.conf"
      - DTC_OVERLAY_FILE="bt.overlay"
  sample.shell.shell_module.login:
    filter: CONFIG_SERIAL and dt_chosen_enabled("zephyr,shell-uart")
    tags: shell
    harness: keyboard
    min_ram: 40
    extra_args: CONF_FILE="prj_login.conf"
    integration_platforms:
      - native_sim
  sample.shell.shell_module.robot:
    harness: robot
    harness_config:
      robot_testsuite: shell_module.robot
```

## samples/subsys/shell/threadless/sample.yaml
```yaml
sample:
  description: Threadless shell using uart backend
  name: Threadless shell
tests:
  sample.subsys.shell.threadless:
    tags: threadless
    min_ram: 2
    min_flash: 32
    filter: CONFIG_ARCH_HAS_SINGLE_THREAD_SUPPORT and
            dt_chosen_enabled("zephyr,shell-uart")
    harness: shell
    harness_config:
      shell_commands:
        - command: "sample foobar"
          expected: "foobar"
    platform_exclude:
      - qemu_cortex_a53
      - qemu_cortex_a53/qemu_cortex_a53/smp
```

## samples/subsys/sip_svc/sample.yaml
```yaml
sample:
  name: SIP SVC sample
common:
  filter: CONFIG_ARM_SIP_SVC_HAS_INTEL_SDM_MAILBOX_FIFO
  integration_platforms:
    - intel_socfpga_agilex_socdk
tests:
  sample.subsys.sip_svc:
    tags:
      - sipsvc
    platform_allow:
      - intel_socfpga_agilex_socdk
    integration_platforms:
      - intel_socfpga_agilex_socdk
    harness: console
    harness_config:
      type: one_line
      ordered: true
      regex:
        - "Got response of transaction id 0x[0-9a-f][0-9a-f] and voltage is [0-9].[0-9]+v"
```

## samples/subsys/smf/hsm_psicc2/sample.yaml
```yaml
sample:
  name: SMF HSM PSiCC2 Demo
common:
  tags:
    - smf
  integration_platforms:
    - native_sim
  harness: console
  harness_config:
    type: multi_line
    ordered: true
    regex:
      - ".*<inf> hsm_psicc2_thread: initial_entry.*"
      - ".*<inf> hsm_psicc2_thread: s_entry.*"
      - ".*<inf> hsm_psicc2_thread: s2_entry.*"
      - ".*<inf> hsm_psicc2_thread: s21_entry.*"
      - ".*<inf> hsm_psicc2_thread: s211_entry.*"
tests:
  sample.smf.hsm_psicc2: {}
```

## samples/subsys/smf/psicc2/sample.yaml
```yaml
sample:
  name: SMF PSiCC2 Demo
common:
  tags:
    - smf
  integration_platforms:
    - native_sim
  harness: console
  harness_config:
    type: multi_line
    ordered: true
    regex:
      - ".*<inf> psicc2_thread: initial_entry.*"
      - ".*<inf> psicc2_thread: s_entry.*"
      - ".*<inf> psicc2_thread: s2_entry.*"
      - ".*<inf> psicc2_thread: s21_entry.*"
      - ".*<inf> psicc2_thread: s211_entry.*"
tests:
  sample.smf.psicc2:
    tags: smf
```

## samples/subsys/smf/smf_calculator/sample.yaml
```yaml
sample:
  description: SMF Calculator GUI Application
  name: smf_calculator
tests:
  sample.smf.smf_calculator:
    filter: dt_chosen_enabled("zephyr,display")
    # Sample takes ~300k on disco_l475_iot1 board, add 50k just in case.
    # Ram usage is 70k on disco_l475_iot1 board with adafruit_2_8_tft_touch_v2.
    # Can be reduced by changing CONFIG_LV_Z_VDB_SIZE,
    # CONFIG_LV_Z_MEM_POOL_SIZE and CONFIG_MAIN_STACK_SIZE.
    min_flash: 350
    min_ram: 75
    harness: none
    tags:
      - samples
      - display
      - gui
      - lvgl
      - smf
    modules:
      - lvgl
    integration_platforms:
      - native_sim/native/64
```

## samples/subsys/storage/flash_map/flash_area_type/sample.yaml
```yaml
#
# Copyright (c) 2020 Nordic Semiconductor ASA
#
# SPDX-License-Identifier: Apache-2.0
#

sample:
  name: flash_area_type
  description: Flash area type API usage for partition enumeration
common:
  tags: flash_area
tests:
  sample.storage.flash_area:
    platform_allow: nrf52840dk_nrf52840 native_posix
    tags: flash_area
    harness: console
    harness_config:
        type: multi_line
        regex:
          - "Known types:(.*)"
          - "(.*)"
```

## samples/subsys/task_wdt/boards/apollo510_eb.conf
```kconfig
CONFIG_TASK_WDT_HW_FALLBACK=y
CONFIG_TASK_WDT_HW_FALLBACK_DELAY=5000

CONFIG_WDT_MULTISTAGE=y
```
