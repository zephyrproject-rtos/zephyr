## CMakeLists.txt
```
# SPDX-License-Identifier: Apache-2.0

cmake_minimum_required(VERSION 3.20.0)
find_package(Zephyr REQUIRED HINTS $ENV{ZEPHYR_BASE})
project(log_backend_fcb)

#provide path to private header file fcb_priv.h for this library only
zephyr_library_include_directories(${ZEPHYR_BASE}/subsys/fs/fcb)


target_sources(app PRIVATE src/main.c)
```

## Kconfig
```
menu "Zephyr Kernel"
source "$ZEPHYR_BASE/Kconfig.zephyr"
endmenu
```

## sample.yaml
```
sample:
  name: Log backend FCB Sample
tests:
  sample.loggin.fcb:
    tags:
      - LED
      - gpio
      - flash
      - logging
      - shell
    depends_on: gpio, external flash 
    integration_platforms:
      - nrf52840dk
      - nrf9151dk
```

## prj.conf
```kconfig
# fs_dirent structures are big.
CONFIG_MAIN_STACK_SIZE=4096
CONFIG_HEAP_MEM_POOL_SIZE=4096

# Let __ASSERT do its job
CONFIG_DEBUG=y
#CONFIG_SPI=y
CONFIG_NORDIC_QSPI_NOR=y
CONFIG_NORDIC_QSPI_NOR_FLASH_LAYOUT_PAGE_SIZE=4096

CONFIG_FLASH=y
CONFIG_FLASH_MAP=y
CONFIG_FLASH_PAGE_LAYOUT=y
CONFIG_MPU_ALLOW_FLASH_WRITE=y

CONFIG_FCB=y
CONFIG_LOG=y
CONFIG_LOG_PROCESS_THREAD_STACK_SIZE=2048
CONFIG_LOG_BACKEND_UART=y
CONFIG_LOG_BACKEND_FCB=y
CONFIG_SHELL=y
CONFIG_FCB_LOG_SHELL=y

CONFIG_LED=y
CONFIG_PM_DEVICE=y
```

## src/main.c
```c
/*
 * Copyright (c) 2016 Intel Corporation
 *
 * SPDX-License-Identifier: Apache-2.0
 */

#include <zephyr/kernel.h>
#include <zephyr/drivers/gpio.h>

#include <zephyr/device.h>
#include <zephyr/devicetree.h>
#include <zephyr/logging/log.h>
#include <zephyr/logging/log_ctrl.h>
#include <zephyr/logging/log_backend.h>
#include <zephyr/logging/log_output.h>
#include <zephyr/pm/device.h>



#include <zephyr/settings/settings.h>


LOG_MODULE_REGISTER(main);

/* 1000 msec = 1 sec */
#define SLEEP_TIME_MS   5000

#if CONFIG_LED
#include <zephyr/drivers/led.h>
/* The devicetree node identifier for the "led0" alias. */
#define LED0_NODE DT_ALIAS(led0)
static const struct gpio_dt_spec led = GPIO_DT_SPEC_GET(LED0_NODE, gpios);
#endif


int main(void)
{
	int ret=-1;
	LOG_INF("Example Started");
	static bool on = false;

	while (1) {
#if CONFIG_LED		
		ret = gpio_pin_toggle_dt(&led);
#else
		ret = 0;
#endif
		LOG_INF("Led %s", (on?"On":"Off"));
		on = !on;
		if (ret < 0) {
			return 0;
		}
		k_sleep( K_MSEC(SLEEP_TIME_MS));
	}

	return 0;
}
```
