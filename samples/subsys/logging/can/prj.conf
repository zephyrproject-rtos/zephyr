## CMakeLists.txt
```
# SPDX-License-Identifier: Apache-2.0

cmake_minimum_required(VERSION 3.20.0)


find_package(Zephyr REQUIRED HINTS $ENV{ZEPHYR_BASE})
project(logger_can)

FILE(GLOB app_sources src/*.c)
target_sources(app PRIVATE ${app_sources})
```

## sample.yaml
```
sample:
  description: This application showcases various features of the CAN logging backend.
  name: logger can sample
tests:
  sample.logger.can:
    tags: logging can
    depends_on: can
    filter: dt_chosen_enabled("zephyr,canbus")
    integration_platforms:
      - native_sim
    harness: console
    harness_config:
      type: one_line
      regex:
        - "<inf> sample_main: example message 9"
```

## prj.conf
```kconfig
# basic requirements
CONFIG_CAN=y
CONFIG_LOG=y
CONFIG_LOG_BACKEND_CAN=y

# for CAN-FD
CONFIG_CAN_FD_MODE=y

# enable this to send CAN-FD frames without explicitly enabling
CONFIG_LOG_BACKEND_CAN_USE_FD=n

# prevent infinite recursions between can_send and line_out in log backend
CONFIG_CAN_LOG_LEVEL_OFF=y
```

## boards/native_sim.conf
```kconfig
# Copyright (c) 2025 Paul Wedeck <paulwedeck@gmail.com>
# SPDX-License-Identifier: Apache-2.0

# For POSIX, the default is immediate mode but this leads
# to one CAN frame per character. While this is not wrong,
# deferred mode better showcases this feature.
CONFIG_LOG_MODE_DEFERRED=y
```

## boards/native_sim.overlay
```dts
/*
 * Copyright (c) 2025 Paul Wedeck <paulwedeck@gmail.com>
 *
 * SPDX-License-Identifier: Apache-2.0
 */

&can0 {
	status = "okay";
};

/ {
	chosen {
		zephyr,canbus = &can0;
	};
};
```

## src/main.c
```c
/*
 * Copyright (c) 2025 Paul Wedeck <paulwedeck@gmail.com>
 *
 * SPDX-License-Identifier: Apache-2.0
 */

#include <zephyr/logging/log.h>
#include <zephyr/drivers/can.h>
#include <zephyr/kernel.h>
#include <zephyr/logging/log_backend_can.h>

LOG_MODULE_REGISTER(sample_main, LOG_LEVEL_DBG);

int main(void)
{
	LOG_INF("These log messages are sent under CAN ID 0x7ff (std CAN ID)");
	LOG_INF("Listen to these messages using candump -a or scripts/logging/can/recv_can_log.c");
	k_sleep(K_MSEC(1000));

	for (int i = 1; i <= 3; i++) {
		LOG_INF("example message %d", i);
		k_sleep(K_MSEC(1000));
	}

	LOG_INF("Switching to CAN ID 0x1234abcd (extended CAN ID)");
	log_backend_can_set_frameopts(0x1234abcd, CAN_FRAME_IDE);
	k_sleep(K_MSEC(3000));

	for (int i = 4; i <= 6; i++) {
		LOG_INF("example message %d", i);
		k_sleep(K_MSEC(1000));
	}

	LOG_INF("Switching to CAN FD with baud rate switching (same CAN ID)");
	log_backend_can_set_frameopts(0x1234abcd, CAN_FRAME_IDE | CAN_FRAME_FDF | CAN_FRAME_BRS);
	k_sleep(K_MSEC(3000));

	for (int i = 7; i <= 9; i++) {
		LOG_INF("example message %d", i);
		k_sleep(K_MSEC(1000));
	}

	return 0;
}
```
