## CMakeLists.txt
```
# Copyright (c) 2020 STMicroelectronics
# Copyright (c) 2025 Lexmark
#
# SPDX-License-Identifier: Apache-2.0

cmake_minimum_required(VERSION 3.20.0)

find_package(Zephyr REQUIRED HINTS $ENV{ZEPHYR_BASE})
project(logger_rpmsg_backend)

target_include_directories(app PRIVATE ${LIBMETAL_INCLUDE_DIR} ${OPENAMP_INCLUDE_DIR} ${PLATFORM_DIR})

target_sources(app PRIVATE
    src/main.c
)
```

## sample.yaml
```
sample:
  description: This app provides an example of how to integrate OpenAMP
    with Zephyr including a resource table and add a logging backend using rpmsg endpoint.
  name: OpenAMP with resource table and rpmsg logging backend example integration
tests:
  sample.subsys.logging.rpmsg_backend:
    build_only: true
    platform_allow:
      - imx8mp_evk/mimx8ml8/adsp
    integration_platforms:
      - imx8mp_evk/mimx8ml8/adsp
    tags:
      - ipm
      - openamp
      - logging
```

## prj.conf
```kconfig
CONFIG_IPM=y
CONFIG_MAIN_STACK_SIZE=1024
CONFIG_HEAP_MEM_POOL_SIZE=1024
CONFIG_OPENAMP_RSC_TABLE_NUM_RPMSG_BUFF=8
CONFIG_OPENAMP_RSC_TABLE=y
CONFIG_OPENAMP_MASTER=n

CONFIG_SHELL=y

CONFIG_LOG=y
CONFIG_LOG_PRINTK=n
CONFIG_LOG_BACKEND_RPMSG=y
```

## boards/colibri_imx7d_mcimx7d_m4.conf
```kconfig
CONFIG_IPM_IMX_MAX_DATA_SIZE_4=y
CONFIG_OPENAMP_WITH_DCACHE=y
CONFIG_SOC_RESET_HOOK=n
CONFIG_OPENAMP_RSC_TABLE_NUM_RPMSG_BUFF=32

CONFIG_ROMSTART_RELOCATION_ROM=y
CONFIG_BUILD_OUTPUT_BIN=n
```

## boards/imx8mp_evk_mimx8ml8_adsp.conf
```kconfig
CONFIG_IPM_IMX_MAX_DATA_SIZE_16=n
CONFIG_IPM_IMX_MAX_DATA_SIZE_4=y
CONFIG_OPENAMP_WITH_DCACHE=y

#vendor-specific resource table
CONFIG_OPENAMP_VENDOR_RSC_TABLE=y
CONFIG_OPENAMP_VENDOR_RSC_TABLE_FILE="nxp_resource_table.c"
```

## boards/imx8mp_evk_mimx8ml8_m7.conf
```kconfig
CONFIG_IPM_IMX_MAX_DATA_SIZE_16=n
CONFIG_IPM_IMX_MAX_DATA_SIZE_4=y
CONFIG_OPENAMP_WITH_DCACHE=y
CONFIG_LOG_DEFAULT_LEVEL=0
CONFIG_OPENAMP_RSC_TABLE_IPM_RX_ID=1
CONFIG_OPENAMP_RSC_TABLE_IPM_TX_ID=0
```

## boards/imx8ulp_evk_mimx8ud7_adsp.conf
```kconfig
CONFIG_OPENAMP_WITH_DCACHE=y

CONFIG_MBOX=y
CONFIG_MBOX_INIT_PRIORITY=3

CONFIG_IPM_MBOX=y

#vendor-specific resource table
CONFIG_OPENAMP_VENDOR_RSC_TABLE=y
CONFIG_OPENAMP_VENDOR_RSC_TABLE_FILE="nxp_resource_table.c"

#address translation support
CONFIG_OPENAMP_VENDOR_ADDR_TRANSLATION=y
CONFIG_OPENAMP_VENDOR_ADDR_TRANSLATION_FILE="nxp_addr_translation.h"
```

## boards/imx95_evk_mimx9596_m7.conf
```kconfig
CONFIG_CLOCK_CONTROL=y
CONFIG_CONSOLE=y
CONFIG_OPENAMP_WITH_DCACHE=y
CONFIG_UART_CONSOLE=y
CONFIG_ARM_SCMI=y
CONFIG_IPM_MBOX=y
CONFIG_MBOX_NXP_IMX_MU=y
CONFIG_MBOX_INIT_PRIORITY=0
CONFIG_LOG_DEFAULT_LEVEL=0
CONFIG_OPENAMP_COPY_RSC_TABLE=y
```

## src/main.c
```c
/*
 * Copyright (c) 2020, STMICROELECTRONICS
 * Copyright (c) 2025, Lexmark
 *
 * SPDX-License-Identifier: Apache-2.0
 */

#include <addr_translation.h>
#include <metal/io.h>
#include <metal/sys.h>
#include <openamp/open_amp.h>
#include <resource_table.h>
#include <stdio.h>
#include <stdlib.h>
#include <string.h>
#include <zephyr/device.h>
#include <zephyr/drivers/ipm.h>
#include <zephyr/kernel.h>
#include <zephyr/logging/log.h>
#include <zephyr/logging/log_backend_rpmsg.h>
LOG_MODULE_REGISTER(rpmsg_backend);

#define SHM_DEVICE_NAME "shm"

#if !DT_HAS_CHOSEN(zephyr_ipc_shm)
#error "Sample requires definition of shared memory for rpmsg"
#endif

#if CONFIG_IPM_MAX_DATA_SIZE > 0
#define IPM_SEND(dev, w, id, d, s) ipm_send(dev, w, id, d, s)
#else
#define IPM_SEND(dev, w, id, d, s) ipm_send(dev, w, id, NULL, 0)
#endif

/* Constants derived from device tree */
#define SHM_NODE       DT_CHOSEN(zephyr_ipc_shm)
#define SHM_START_ADDR DT_REG_ADDR(SHM_NODE)
#define SHM_SIZE       DT_REG_SIZE(SHM_NODE)

static const struct device *const ipm_handle = DEVICE_DT_GET(DT_CHOSEN(zephyr_ipc));

static metal_phys_addr_t shm_physmap = SHM_START_ADDR;
static metal_phys_addr_t rsc_tab_physmap;

static struct metal_io_region shm_io_data; /* shared memory */
static struct metal_io_region rsc_io_data; /* rsc_table memory */

static struct metal_io_region *shm_io = &shm_io_data;

static struct metal_io_region *rsc_io = &rsc_io_data;
static struct rpmsg_virtio_device rvdev;

static void *rsc_table;
static struct rpmsg_device *rpdev;

static void platform_ipm_callback(const struct device *dev, void *context, uint32_t id,
				  volatile void *data)
{
	ARG_UNUSED(dev);
	ARG_UNUSED(context);
	ARG_UNUSED(data);

	printk("Message received\n");
	rproc_virtio_notified(rvdev.vdev, VRING1_ID);
}

static void new_service_cb(struct rpmsg_device *rdev, const char *name, uint32_t src)
{
	ARG_UNUSED(rdev);
	ARG_UNUSED(src);
	printk("%s: unexpected ns service receive for name %s\n", __func__, name);
}

int mailbox_notify(void *priv, uint32_t id)
{
	ARG_UNUSED(priv);

	IPM_SEND(ipm_handle, 0, id, &id, 4);

	return 0;
}

int platform_init(void)
{
	int rsc_size;
	struct metal_init_params metal_params = METAL_INIT_DEFAULTS;
	int status;

	status = metal_init(&metal_params);
	if (status) {
		LOG_ERR("metal_init: failed: %d", status);
		return -1;
	}

	/* declare shared memory region */
	metal_io_init(shm_io, (void *)SHM_START_ADDR, &shm_physmap, SHM_SIZE, -1, 0,
		      addr_translation_get_ops(shm_physmap));

	/* declare resource table region */
	rsc_table_get(&rsc_table, &rsc_size);
	rsc_tab_physmap = (uintptr_t)rsc_table;

	metal_io_init(rsc_io, rsc_table, &rsc_tab_physmap, rsc_size, -1, 0, NULL);

	/* setup IPM */
	if (!device_is_ready(ipm_handle)) {
		LOG_ERR("IPM device is not ready");
		return -1;
	}

	ipm_register_callback(ipm_handle, platform_ipm_callback, NULL);

	return 0;
}

static void cleanup_system(void)
{
	ipm_set_enabled(ipm_handle, 0);
	rpmsg_deinit_vdev(&rvdev);
	metal_finish();
}

struct rpmsg_device *platform_create_rpmsg_vdev(unsigned int vdev_index, unsigned int role,
						void (*rst_cb)(struct virtio_device *vdev),
						rpmsg_ns_bind_cb ns_cb)
{
	struct fw_rsc_vdev_vring *vring_rsc;
	struct virtio_device *vdev;
	int ret;

	vdev = rproc_virtio_create_vdev(VIRTIO_DEV_DEVICE, VDEV_ID, rsc_table_to_vdev(rsc_table),
					rsc_io, NULL, mailbox_notify, NULL);

	if (!vdev) {
		LOG_ERR("failed to create vdev");
		return NULL;
	}

	/* wait master rpmsg init completion */
	rproc_virtio_wait_remote_ready(vdev);

	vring_rsc = rsc_table_get_vring0(rsc_table);
	ret = rproc_virtio_init_vring(vdev, 0, vring_rsc->notifyid, (void *)vring_rsc->da, rsc_io,
				      vring_rsc->num, vring_rsc->align);
	if (ret) {
		LOG_ERR("failed to init vring 0");
		goto failed;
	}

	vring_rsc = rsc_table_get_vring1(rsc_table);
	ret = rproc_virtio_init_vring(vdev, 1, vring_rsc->notifyid, (void *)vring_rsc->da, rsc_io,
				      vring_rsc->num, vring_rsc->align);
	if (ret) {
		LOG_ERR("failed to init vring 1");
		goto failed;
	}

	ret = rpmsg_init_vdev(&rvdev, vdev, ns_cb, shm_io, NULL);
	if (ret) {
		LOG_ERR("failed rpmsg_init_vdev");
		goto failed;
	}

	return rpmsg_virtio_get_rpmsg_device(&rvdev);

failed:
	rproc_virtio_remove_vdev(vdev);

	return NULL;
}

int main(void)
{
	k_sleep(K_SECONDS(1));
	LOG_INF("Starting application!");
	int ret = 0;

	LOG_INF("OpenAMP[remote] Linux rpmsg logger demo started");

	/* Initialize platform */
	ret = platform_init();
	if (ret) {
		LOG_ERR("Failed to initialize platform");
		ret = -1;
		goto task_end;
	}

	rpdev = platform_create_rpmsg_vdev(0, VIRTIO_DEV_DEVICE, NULL, new_service_cb);
	if (!rpdev) {
		LOG_ERR("Failed to create rpmsg virtio device");
		ret = -1;
		goto task_end;
	}

	ret = ipm_set_enabled(ipm_handle, 1);
	if (ret) {
		LOG_ERR("ipm_set_enabled failed");
		goto task_end;
	}

	ret = log_backend_rpmsg_init_transport(rpdev);
	if (ret < 0) {
		LOG_ERR("Failed to initialize rpmsg log backend, err %d", ret);
		goto task_end;
	}

	while (1) {
		k_sleep(K_SECONDS(2));
		/* Send only to console */
		printk("Sending message...\n");
		/* Send to all log backends */
		LOG_INF("OpenAMP[remote] Hello Linux!");
	}

	log_backend_rpmsg_deinit_transport();

task_end:
	cleanup_system();

	LOG_INF("OpenAMP demo ended");
	return ret;
}
```
