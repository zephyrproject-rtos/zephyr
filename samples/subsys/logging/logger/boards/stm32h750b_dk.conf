## samples/subsys/mgmt/mcumgr/smp_svr/boards/mimxrt1050_evk_hyperflash_ram_load.conf
```kconfig
CONFIG_USE_DT_CODE_PARTITION=y
# Force the slot size- imgtool will try to use the smaller slot size, but
# we want to add a trailing on the primary slot (which is larger)
CONFIG_MCUBOOT_EXTRA_IMGTOOL_ARGS="--slot-size=3670016"
```

## samples/subsys/mgmt/mcumgr/smp_svr/boards/native_sim_native_64.conf
```kconfig
# Use offloaded sockets using host BSD sockets
CONFIG_ETH_DRIVER=n
CONFIG_ETH_NATIVE_POSIX=n
CONFIG_NET_DRIVERS=y
CONFIG_NET_SOCKETS=y
CONFIG_NET_SOCKETS_OFFLOAD=y
CONFIG_NET_NATIVE_OFFLOADED_SOCKETS=y
CONFIG_HEAP_MEM_POOL_SIZE=1024

# Use embedded libc to use Zephyr's eventfd instead of host eventfd
CONFIG_PICOLIBC=y

# Static networking
CONFIG_NET_CONFIG_LOG_LEVEL_DBG=y
CONFIG_NET_CONFIG_SETTINGS=y
CONFIG_NET_CONFIG_NEED_IPV4=y
CONFIG_NET_CONFIG_MY_IPV4_ADDR="192.0.2.1"
CONFIG_NET_CONFIG_MY_IPV4_GW="192.0.2.2"
CONFIG_NET_CONFIG_PEER_IPV4_ADDR="192.0.2.2"

# mcumgr over UDP
CONFIG_MCUMGR_TRANSPORT_UDP_STACK_SIZE=2048
CONFIG_NET_IPV6=n
CONFIG_MCUMGR_TRANSPORT_UDP_IPV6=n
```

## samples/subsys/mgmt/mcumgr/smp_svr/boards/nrf52840dk_nrf52840_ram_load.conf
```kconfig
CONFIG_RETAINED_MEM_NRF_GPREGRET=n

# With USE_SWITCH enabled, the .text grows by few bytes (~0x36c), which pushes __rodata_region_end
# slightly beyond the MPU aligned boundary but the MPU_REQUIRES_POWER_OF_TWO_ALIGNMENT pushes the
# padding_section beyond the available sram. Using a custom changes the alignment to 32byte.
CONFIG_CUSTOM_SECTION_ALIGN=y
```

## samples/subsys/mgmt/mcumgr/smp_svr/boards/nrf52dk_nrf52832.conf
```kconfig
# Use minimal logging mode and disable info/debug logging to reduce flash space
CONFIG_LOG_MODE_MINIMAL=y
CONFIG_LOG_MAX_LEVEL=2
CONFIG_LOG_DEFAULT_LEVEL=2

# Disable RTT support
CONFIG_USE_SEGGER_RTT=n

# Disable Bluetooth PHY update support
CONFIG_BT_USER_PHY_UPDATE=n
CONFIG_BT_PHY_UPDATE=n
```

## samples/subsys/mgmt/mcumgr/smp_svr/boards/nrf54h20dk_nrf54h20_cpuapp_iron.conf
```kconfig
# Disable GPD because no IPC is enabled in SSDFW
CONFIG_SOC_NRF54H20_GPD=n
CONFIG_PM=n
```

## samples/subsys/mgmt/mcumgr/smp_svr/boards/pinnacle_100_dvk.conf
```kconfig
# Enable QSPI (MX25R64) - Slot 1 in QSPI
CONFIG_NORDIC_QSPI_NOR=y
CONFIG_NORDIC_QSPI_NOR_FLASH_LAYOUT_PAGE_SIZE=4096
CONFIG_NORDIC_QSPI_NOR_STACK_WRITE_BUFFER_SIZE=4
```
