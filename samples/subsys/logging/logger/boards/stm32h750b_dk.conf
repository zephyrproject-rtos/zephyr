## samples/subsys/logging/logger/boards/stm32h750b_dk.conf
```kconfig
# SPDX-FileCopyrightText: Copyright The Zephyr Project Contributors
# SPDX-License-Identifier: Apache-2.0

CONFIG_UART_ASYNC_API=y
CONFIG_LOG_BACKEND_UART_ASYNC=y

# for Log UART Backend DMA buffers
CONFIG_NOCACHE_MEMORY=y
```

## samples/subsys/logging/logger/sample.yaml
```yaml
sample:
  description: A simple application that demonstrate use of logging feature.
  name: logger sample
tests:
  sample.logger.basic:
    platform_key:
      - arch
    integration_platforms:
      - native_sim
    tags: logging
    harness: console
    harness_config:
      type: one_line
      regex:
        - Instance level logging showcase
        - Changing filter to warning
        - Disabling logging
        - Severity levels showcase
        - Logging performance showcase
        - Logs from external logging system showcase

  sample.logger.rtt:
    integration_platforms:
      - frdm_k64f
    tags: logging
    filter: CONFIG_HAS_SEGGER_RTT
    arch_allow:
      - arm
    harness: keyboard
    extra_configs:
      - CONFIG_LOG_BACKEND_RTT=y
      - CONFIG_USE_SEGGER_RTT=y

  sample.logger.bt:
    platform_allow:
      - nrf52840dk/nrf52840
    integration_platforms:
      - nrf52840dk/nrf52840
    tags:
      - logging
      - bluetooth
    harness: bluetooth_nus
    extra_args:
      - OVERLAY_CONFIG="overlay-bt.conf"
      - DTC_OVERLAY_FILE="bt.overlay"

  sample.logger.usermode:
    integration_platforms:
      - mps2/an385
    depends_on_anyof:
      - mmu
      - mpu
    tags:
      - logging
      - userspace
    harness: keyboard
    extra_configs:
      - CONFIG_USERSPACE=y
```

## samples/subsys/logging/multidomain/boards/nrf5340bsim_nrf5340_cpuapp.conf
```kconfig
CONFIG_MBOX_NRFX_IPC=y
# For the mailbox to be initialized logger initialization is delayed like in real HW
CONFIG_LOG_PROCESS_THREAD=y
CONFIG_LOG_MODE_DEFERRED=y
```

## samples/subsys/logging/multidomain/sample.yaml
```yaml
sample:
  name: Logging in multi-domain environment
common:
  sysbuild: true
  tags: ipc
tests:
  sample.logging.multidomain.ipc_static_vrings:
    platform_allow:
      - nrf5340dk/nrf5340/cpuapp
      - nrf5340bsim/nrf5340/cpuapp
    integration_platforms:
      - nrf5340dk/nrf5340/cpuapp
      - nrf5340bsim/nrf5340/cpuapp
    harness: console
    harness_config:
      type: multi_line
      ordered: false
      regex:
        - "Hello World!"
        - "app: IPC-service HOST \\[INST 1\\] demo started"
        - "app: loop: 0"
        - "app: ipc open"
        - "app: wait for bound"
        - "app: bounded"
        - "app: REMOTE \\[1\\]: 0"
        - "app: HOST \\[1\\]: 1"
        - "app: IPC-service HOST \\[INST 1\\] demo ended."
```

## samples/subsys/logging/rpmsg_backend/boards/imx8mp_evk_mimx8ml8_m7.conf
```kconfig
CONFIG_IPM_IMX_MAX_DATA_SIZE_16=n
CONFIG_IPM_IMX_MAX_DATA_SIZE_4=y
CONFIG_OPENAMP_WITH_DCACHE=y
CONFIG_LOG_DEFAULT_LEVEL=0
CONFIG_OPENAMP_RSC_TABLE_IPM_RX_ID=1
CONFIG_OPENAMP_RSC_TABLE_IPM_TX_ID=0
```

## samples/subsys/logging/rpmsg_backend/sample.yaml
```yaml
sample:
  description: This app provides an example of how to integrate OpenAMP
    with Zephyr including a resource table and add a logging backend using rpmsg endpoint.
  name: OpenAMP with resource table and rpmsg logging backend example integration
tests:
  sample.subsys.logging.rpmsg_backend:
    build_only: true
    platform_allow:
      - imx8mp_evk/mimx8ml8/adsp
    integration_platforms:
      - imx8mp_evk/mimx8ml8/adsp
    tags:
      - ipm
      - openamp
      - logging
```

## samples/subsys/logging/syst/boards/intel_adsp_cavs25.conf
```kconfig
CONFIG_LOG_BACKEND_UART=n
CONFIG_LOG_BACKEND_UART_OUTPUT_SYST=n
CONFIG_LOG_BACKEND_ADSP=y
CONFIG_LOG_MIPI_SYST_ENABLE=y
CONFIG_LOG_BACKEND_ADSP_OUTPUT_SYST=y
```

## samples/subsys/logging/syst/sample.yaml
```yaml
sample:
  name: syst sample
common:
  tags:
    - logging
    - mipi-sys-t
  modules:
    - mipi-sys-t
  arch_exclude:
    - mips
    - nios2
    - posix
    - sparc
tests:
  sample.logger.syst.deferred:
    toolchain_exclude: xcc
    integration_platforms:
      - mps2_an385
      - qemu_x86
    extra_args: OVERLAY_CONFIG=overlay_deferred.conf
    harness: console
    harness_config:
      type: multi_line
      regex:
        - "SYS-T RAW DATA: "
        - "SYST Sample Execution Completed"
    # "CONFIG_FULL_LIBC_SUPPORTED" filter was applied
    # because of following chain of dependencies:
    # LOG_MIPI_SYST_ENABLE=y --> CONFIG_MIPI_SYST_LIB --> \
    # --> REQUIRES_FULL_LIBC.
    #
    # Not all compillers announced in Zephyr support a full C library
    filter: CONFIG_FULL_LIBC_SUPPORTED
    extra_configs:
      - CONFIG_REQUIRES_FULL_LIBC=y
  sample.logger.syst.immediate:
    toolchain_exclude: xcc
    extra_args: OVERLAY_CONFIG=overlay_immediate.conf
    integration_platforms:
      - qemu_x86
      - sam_e70_xplained
    harness: console
    harness_config:
      type: multi_line
      regex:
        - "SYS-T RAW DATA: "
        - "SYST Sample Execution Completed"
    filter: CONFIG_FULL_LIBC_SUPPORTED
    extra_configs:
      - CONFIG_REQUIRES_FULL_LIBC=y
  sample.logger.syst.catalog.deferred:
    toolchain_exclude: xcc
    extra_args: OVERLAY_CONFIG=overlay_deferred.conf
    integration_platforms:
      - qemu_x86
      - qemu_x86_64
    harness: console
    harness_config:
      type: one_line
      regex:
        - "SYS-T RAW DATA: "
    extra_configs:
      - CONFIG_LOG_MIPI_SYST_USE_CATALOG=y
      - CONFIG_REQUIRES_FULL_LIBC=y
    filter: CONFIG_FULL_LIBC_SUPPORTED
  sample.logger.syst.catalog.immediate:
    toolchain_exclude: xcc
    integration_platforms:
      - qemu_x86
      - qemu_x86_64
    harness: console
    harness_config:
      type: one_line
      regex:
        - "SYS-T RAW DATA: "
    extra_configs:
      - CONFIG_LOG_MIPI_SYST_USE_CATALOG=y
      - CONFIG_REQUIRES_FULL_LIBC=y
    filter: CONFIG_FULL_LIBC_SUPPORTED
  sample.logger.syst.deferred_cpp:
    toolchain_exclude: xcc
    extra_args: OVERLAY_CONFIG=overlay_deferred.conf
    integration_platforms:
      - qemu_x86
      - qemu_x86_64
    harness: console
    harness_config:
      type: one_line
      regex:
        - "SYS-T RAW DATA: "
    extra_configs:
      - CONFIG_CPP=y
      - CONFIG_REQUIRES_FULL_LIBC=y
    filter: CONFIG_FULL_LIBC_SUPPORTED
  sample.logger.syst.immediate_cpp:
    toolchain_exclude: xcc
    integration_platforms:
      - mps2_an385
      - qemu_x86
    harness: console
    harness_config:
      type: one_line
      regex:
        - "SYS-T RAW DATA: "
    extra_configs:
      - CONFIG_CPP=y
      - CONFIG_REQUIRES_FULL_LIBC=y
    filter: CONFIG_FULL_LIBC_SUPPORTED
  sample.logger.syst.catalog.deferred_cpp:
    toolchain_exclude: xcc
    extra_args: OVERLAY_CONFIG=overlay_deferred.conf
    integration_platforms:
      - qemu_x86
      - qemu_x86_64
    harness: console
    harness_config:
      type: one_line
      regex:
        - "SYS-T RAW DATA: "
    extra_configs:
      - CONFIG_LOG_MIPI_SYST_USE_CATALOG=y
      - CONFIG_CPP=y
      - CONFIG_REQUIRES_FULL_LIBC=y
    filter: CONFIG_FULL_LIBC_SUPPORTED
  sample.logger.syst.catalog.immediate_cpp:
    toolchain_exclude: xcc
    integration_platforms:
      - qemu_x86
      - qemu_x86_64
    harness: console
    harness_config:
      type: one_line
      regex:
        - "SYS-T RAW DATA: "
    extra_configs:
      - CONFIG_LOG_MIPI_SYST_USE_CATALOG=y
      - CONFIG_CPP=y
      - CONFIG_REQUIRES_FULL_LIBC=y
    filter: CONFIG_FULL_LIBC_SUPPORTED
```

## samples/subsys/lorawan/class_a/sample.yaml
```yaml
common:
  tags: lorawan
  depends_on: lora
  harness: console
  harness_config:
    type: one_line
    regex:
      - "<inf> lorawan_class_a: Joining network over OTAA"
sample:
  description: Demonstration of Class-A LoRaWAN functionality
  name: LoRaWAN Class-A
tests:
  sample.lorawan.class_a.as923:
    extra_configs:
      - CONFIG_LORAWAN_REGION_AS923=y
  sample.lorawan.class_a.au915:
    extra_configs:
      - CONFIG_LORAWAN_REGION_AU915=y
  sample.lorawan.class_a.cn470:
    extra_configs:
      - CONFIG_LORAWAN_REGION_CN470=y
  sample.lorawan.class_a.cn779:
    extra_configs:
      - CONFIG_LORAWAN_REGION_CN779=y
  sample.lorawan.class_a.eu433:
    extra_configs:
      - CONFIG_LORAWAN_REGION_EU433=y
  sample.lorawan.class_a.eu868:
    extra_configs:
      - CONFIG_LORAWAN_REGION_EU868=y
  sample.lorawan.class_a.kr920:
    extra_configs:
      - CONFIG_LORAWAN_REGION_KR920=y
  sample.lorawan.class_a.in865:
    extra_configs:
      - CONFIG_LORAWAN_REGION_IN865=y
  sample.lorawan.class_a.us915:
    extra_configs:
      - CONFIG_LORAWAN_REGION_US915=y
  sample.lorawan.class_a.ru864:
    extra_configs:
      - CONFIG_LORAWAN_REGION_RU864=y
  sample.lorawan.class_a.multiregion:
    extra_configs:
      - CONFIG_LORAWAN_REGION_EU868=y
      - CONFIG_LORAWAN_REGION_US915=y
  # lora-basics-modem backend tests (sx126x only)
  sample.lorawan.class_a.lora-basics-modem.as923:
    filter: CONFIG_LORA_SX126X
    extra_configs:
      - CONFIG_LORA_MODULE_BACKEND_LORA_BASICS_MODEM=y
      - CONFIG_LORAWAN_LBM_ACK_DOWNLINK_CB=y
      - CONFIG_LORAWAN_REGION_AS923=y
  sample.lorawan.class_a.lora-basics-modem.au915:
    filter: CONFIG_LORA_SX126X
    extra_configs:
      - CONFIG_LORA_MODULE_BACKEND_LORA_BASICS_MODEM=y
      - CONFIG_LORAWAN_LBM_ACK_DOWNLINK_CB=y
      - CONFIG_LORAWAN_REGION_AU915=y
  sample.lorawan.class_a.lora-basics-modem.cn470:
    filter: CONFIG_LORA_SX126X
    extra_configs:
      - CONFIG_LORA_MODULE_BACKEND_LORA_BASICS_MODEM=y
      - CONFIG_LORAWAN_LBM_ACK_DOWNLINK_CB=y
      - CONFIG_LORAWAN_REGION_CN470=y
  sample.lorawan.class_a.lora-basics-modem.eu868:
    filter: CONFIG_LORA_SX126X
    extra_configs:
      - CONFIG_LORA_MODULE_BACKEND_LORA_BASICS_MODEM=y
      - CONFIG_LORAWAN_LBM_ACK_DOWNLINK_CB=y
      - CONFIG_LORAWAN_REGION_EU868=y
  sample.lorawan.class_a.lora-basics-modem.kr920:
    filter: CONFIG_LORA_SX126X
    extra_configs:
      - CONFIG_LORA_MODULE_BACKEND_LORA_BASICS_MODEM=y
      - CONFIG_LORAWAN_LBM_ACK_DOWNLINK_CB=y
      - CONFIG_LORAWAN_REGION_KR920=y
  sample.lorawan.class_a.lora-basics-modem.in865:
    filter: CONFIG_LORA_SX126X
    extra_configs:
      - CONFIG_LORA_MODULE_BACKEND_LORA_BASICS_MODEM=y
      - CONFIG_LORAWAN_LBM_ACK_DOWNLINK_CB=y
      - CONFIG_LORAWAN_REGION_IN865=y
  sample.lorawan.class_a.lora-basics-modem.us915:
    filter: CONFIG_LORA_SX126X
    extra_configs:
      - CONFIG_LORA_MODULE_BACKEND_LORA_BASICS_MODEM=y
      - CONFIG_LORAWAN_LBM_ACK_DOWNLINK_CB=y
      - CONFIG_LORAWAN_REGION_US915=y
  sample.lorawan.class_a.lora-basics-modem.ru864:
    filter: CONFIG_LORA_SX126X
    extra_configs:
      - CONFIG_LORA_MODULE_BACKEND_LORA_BASICS_MODEM=y
      - CONFIG_LORAWAN_LBM_ACK_DOWNLINK_CB=y
      - CONFIG_LORAWAN_REGION_RU864=y
  sample.lorawan.class_a.lora-basics-modem.multiregion:
    filter: CONFIG_LORA_SX126X
    extra_configs:
      - CONFIG_LORA_MODULE_BACKEND_LORA_BASICS_MODEM=y
      - CONFIG_LORAWAN_LBM_ACK_DOWNLINK_CB=y
      - CONFIG_LORAWAN_REGION_EU868=y
      - CONFIG_LORAWAN_REGION_US915=y
```

## samples/subsys/lorawan/fuota/boards/nucleo_wl55jc.conf
```kconfig
# use fixed frag size (min and max 232 bytes) to avoid RAM overflow
CONFIG_LORAWAN_FRAG_TRANSPORT_MIN_FRAG_SIZE=232

# alternatively, the redundancy could be reduced
# CONFIG_LORAWAN_FRAG_TRANSPORT_MAX_REDUNDANCY=7
```

## samples/subsys/lorawan/fuota/sample.yaml
```yaml
sample:
  description: Demonstration of LoRaWAN Firmware Upgrade Over The Air
  name: LoRaWAN FUOTA
common:
  depends_on: lora
  tags: lorawan
  filter: dt_label_with_parent_compat_enabled("slot0_partition", "fixed-partitions")
    and dt_label_with_parent_compat_enabled("slot1_partition", "fixed-partitions")
    and dt_chosen_enabled("zephyr,flash-controller") and CONFIG_FLASH_HAS_DRIVER_ENABLED
  harness: console
  harness_config:
    type: one_line
    regex:
      - "<inf> lorawan_fuota: Joining network over OTAA"
tests:
  sample.lorawan.fuota:
    integration_platforms:
      - nucleo_wl55jc
    # only allow selected boards which are known to have sufficient RAM for the given settings
    platform_allow:
      - nucleo_wl55jc
```

## samples/subsys/lw_sched/sample.yaml
```yaml
sample:
  description: Lightweight (LW) scheduler sample application
  name: Lightweight (LW) scheduler
common:
  integration_platforms:
    - native_posix
  harness: console
  harness_config:
    type: multi_line
    regex:
      - "Final task 1 count: 70"
      - "Final task 2 count: 120"
tests:
  sample.subsys.lw_sched:
    tags: kernel
```

## samples/subsys/mgmt/delta/sample.yaml
```yaml
sample:
  description: Delta Firmware Over The Air (DFOTA) update sample demonstrating
    how to apply binary delta patches to update firmware efficiently.
  name: dfota
common:
  sysbuild: true
  tags:
    - dfu
    - delta
  depends_on:
    - flash
  modules:
    - heatshrink
tests:
  sample.subsys.mgmt.delta:
    tags:
      - dfu
      - delta
    platform_allow:
      - nrf7002dk/nrf5340/cpuapp
```

## samples/subsys/mgmt/ec_host_cmd_usb/Kconfig
```kconfig
# Copyright 2026 Google LLC
# SPDX-License-Identifier: Apache-2.0

source "samples/subsys/usb/common/Kconfig.sample_usbd"

source "Kconfig.zephyr"
```

## samples/subsys/mgmt/ec_host_cmd_usb/sample.yaml
```yaml
sample:
  name: EC Host Commands over USB
tests:
  sample.mgmt.ec_host_cmd_usb:
    depends_on: usbd
    tags: usb
    build_only: true
    platform_allow:
      - nucleo_c071rb
```

## samples/subsys/mgmt/hawkbit/Kconfig
```kconfig
#
# Copyright (c) 2020 Linumiz
#
# SPDX-License-Identifier: Apache-2.0
#
mainmenu "hawkBit sample configuration"

choice
	prompt "hawkBit mode"
	default HAWKBIT_POLLING
	depends on HAWKBIT

config HAWKBIT_POLLING
	bool "hawkBit Polling mode"
	help
	  Polling mode runs automatically on a predefined period, probing the
	  server for updates and installing them without requiring user
	  intervention.

config HAWKBIT_MANUAL
	bool "hawkBit manual mode"
	help
	  Manual mode requires the user to call the server probe and then, if
	  there is an available update, also requires the user to decide if
	  it is appropriate to update now or later.

endchoice

source "Kconfig.zephyr"
```

## samples/subsys/mgmt/hawkbit/sample.yaml
```yaml
common:
  filter: CONFIG_FULL_LIBC_SUPPORTED
  harness: net
  tags: net
  depends_on: netif
  build_only: true
  platform_allow:
    - frdm_k64f
    - stm32h573i_dk
    - stm32h573i_dk/stm32h573xx/ext_flash_app
    - stm32h750b_dk/stm32h750xx/ext_flash_app
  integration_platforms:
    - frdm_k64f
    - stm32h573i_dk
    - stm32h573i_dk/stm32h573xx/ext_flash_app
sample:
  description: hawkBit Firmware Over-the-Air (FOTA)
  name: hawkbit
tests:
  sample.net.hawkbit.default: {}
  sample.net.hawkbit.sysbuild:
    sysbuild: true
  sample.net.hawkbit.manual:
    extra_configs:
      - CONFIG_HAWKBIT_MANUAL=y
  sample.net.hawkbit.ddi.target:
    extra_configs:
      - CONFIG_HAWKBIT_DDI_GATEWAY_SECURITY=n
      - CONFIG_HAWKBIT_DDI_TARGET_SECURITY=y
  sample.net.hawkbit.ddi.no_security:
    extra_configs:
      - CONFIG_HAWKBIT_DDI_GATEWAY_SECURITY=n
      - CONFIG_HAWKBIT_DDI_NO_SECURITY=y
  sample.net.hawkbit.tls:
    extra_configs:
      - CONFIG_HAWKBIT_USE_TLS=y
      - CONFIG_NET_SOCKETS_SOCKOPT_TLS=y
  sample.net.hawkbit.set_settings_runtime:
    extra_configs:
      - CONFIG_HAWKBIT_SET_SETTINGS_RUNTIME=y
  sample.net.hawkbit.save_progress:
    extra_configs:
      - CONFIG_HAWKBIT_SAVE_PROGRESS=y
      - CONFIG_STREAM_FLASH_PROGRESS=y
```

## samples/subsys/mgmt/mcumgr/smp_svr/Kconfig
```kconfig
# Copyright (c) 2025 Nordic Semiconductor ASA
# SPDX-License-Identifier: Apache-2.0

config SMP_SVR_NRF54H20_SAMPLE
	bool
	default y if SOC_NRF54H20_CPUAPP
	select EXPERIMENTAL

source "Kconfig.zephyr"
```
