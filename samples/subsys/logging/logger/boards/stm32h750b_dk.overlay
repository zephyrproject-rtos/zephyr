/*
 * SPDX-License-Identifier: Apache-2.0
 */

/* console UART */
&usart3 {
	dmas = <&dmamux1 2 46 STM32_DMA_PERIPH_TX>,
	       <&dmamux1 3 45 STM32_DMA_PERIPH_RX>;
	dma-names = "tx", "rx";
	status = "okay";
};

&dma1 {
	status = "okay";
};

&dma2 {
	status = "okay";
};

&dmamux1 {
	status = "okay";
};
