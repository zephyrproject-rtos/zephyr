## CMakeLists.txt
```
cmake_minimum_required(VERSION 3.8.2)
include($ENV{ZEPHYR_BASE}/cmake/app/boilerplate.cmake NO_POLICY_SCOPE)
project(nsetting)

FILE(GLOB app_sources src/*.c)
target_sources(app PRIVATE ${app_sources})
```

## sample.yaml
```
sample:
  name: Settings Sample

tests:
  test:
    tags: settings
    depends_on: settings
```

## prj.conf
```kconfig
CONFIG_FLASH=y
CONFIG_FLASH_PAGE_LAYOUT=y
CONFIG_LOG=y
CONFIG_ARM_MPU=n

CONFIG_MAIN_STACK_SIZE=3096
CONFIG_HEAP_MEM_POOL_SIZE=1024

#Enable NVS
CONFIG_NVS=y
CONFIG_NVS_LOG_LEVEL_OFF=y

CONFIG_SETTINGS=y
CONFIG_SETTINGS_NVS=y
CONFIG_SETTINGS_RUNTIME=y
#Disable the default backend
CONFIG_SETTINGS_DEFAULT_NONE=y

CONFIG_REBOOT=y
#CONFIG_MPU_ALLOW_FLASH_WRITE=y
```

## src/main.c
```c
/*
 * SETTINGS Sample for Zephyr
 *
 * Copyright (c) 2018 Laczen
 *
 * SPDX-License-Identifier: Apache-2.0
 */


#include <zephyr.h>
#include <misc/reboot.h>
#include <string.h>
#include <settings/settings.h>

#ifdef CONFIG_SETTINGS_DEFAULT_NONE
#include <device.h>
static struct settings_nvs settings1;
static struct settings_nvs settings2;

/* For custom settings sources and destination we need to provide our own
 * settings_backend_init().
 */
int settings_backend_init(void)
{
	int rc;
	struct flash_pages_info info;

	rc = flash_get_page_info_by_offs(device_get_binding(DT_FLASH_DEV_NAME),
					 DT_FLASH_AREA_STORAGE_OFFSET, &info);
	if (rc) {
		return rc;
	}

	/* define the nvs file system settings 1 using the page_info */
	settings1.cf_nvs.sector_size = info.size;
	settings1.cf_nvs.sector_count = 3;
	settings1.cf_nvs.offset = DT_FLASH_AREA_STORAGE_OFFSET

	/* setup settings 1 and register it as first source */
	rc = nvs_init(&settings1.cf_nvs, DT_FLASH_DEV_NAME);
	if (rc) {
		return rc;
	}

	rc = settings_nvs_backend_init(&settings1);
	if (rc) {
		return rc;
	}

	rc = settings_nvs_src(&settings1);

	if (rc) {
		return rc;
	}

	/* define the nvs file system settings 2 using the page_info */
	settings2.cf_nvs.sector_size = info.size;
	settings2.cf_nvs.sector_count = 3;
	settings2.cf_nvs.offset = DT_FLASH_AREA_STORAGE_OFFSET + 3 * info.size;

	/* setup settings 2 and register it as second source and destination */
	rc = nvs_init(&settings2.cf_nvs, DT_FLASH_DEV_NAME);
	if (rc) {
		return rc;
	}

	rc = settings_nvs_backend_init(&settings2);
	if (rc) {
		return rc;
	}

	rc = settings_nvs_src(&settings2);

	if (rc) {
		return rc;
	}

	rc = settings_nvs_dst(&settings2);

	return rc;
}
#endif /* CONFIG_SETTINGS_DEFAULT_NONE */

#define SLEEP_TIME	K_SECONDS(2)

u8_t rst_cnt; /* reset counter */

static int ps_set(int argc, char **argv, size_t len, settings_read_fn read,
		  void *store)
{
	int rc;
	u8_t test;

	if (argc == 1) {
		if (!strcmp(argv[0], "rst_cnt")) {
			if (len) {
				rc = read(store, &rst_cnt, sizeof(rst_cnt));
				printk("Reset Counter: %d\n", rst_cnt);
			} else {
				/* catch deleted item */
				rst_cnt = 0;
				printk("Reset Counter deleted\n");
			}
		}
		if (!strcmp(argv[0], "ra0")) {
			if (len) {
				rc = read(store, &test, sizeof(test));
				printk("Entry ra0: %d\n", test);
			} else {
				printk("Entry ra0 deleted\n");
			}
		}
		if (!strcmp(argv[0], "ra1")) {
			if (len) {
				printk("Entry ra1 set\n");
			} else {
				printk("Entry ra1 deleted\n");
			}
		}
		if (!strcmp(argv[0], "ra2")) {
			if (len) {
				printk("Entry ra2 set\n");
			} else {
				printk("Entry ra2 deleted\n");
			}
		}
	}

	return (len < 0) ? len : 0;

}

static struct settings_handler ps_settings = {
	.name = "ps",
	.h_set = ps_set,
};

int ps_settings_init(void)
{
	int err;

	err = settings_subsys_init();
	if (err) {
		printk("settings_subsys_init failed (err %d)\n", err);
		return err;
	}

	err = settings_register(&ps_settings);
	if (err) {
		printk("ps_settings_register failed (err %d)\n", err);
		return err;
	}
	return 0;
}

void main(void)
{
	int rc;
	u8_t test0 = 0U, test1 = 0U, test2 = 0U;

	rst_cnt = 0U;

	rc = ps_settings_init();
	printk("Initialize settings [%d]\n", rc);

	rc = settings_load();
	printk("Settings load [%d]\n", rc);

	while (rst_cnt < 6) {

		rst_cnt++;
		test0 = rst_cnt + 16;
		test1 = test0 + 16;
		test2 = test1 + 16;
		printk("Reset counter %u\n", rst_cnt);
		if (rst_cnt == 1) {
			settings_runtime_set("ps/ra0", &test0, sizeof(test0));
			settings_runtime_set("ps/ra1", &test1, sizeof(test1));
			settings_runtime_set("ps/ra2", &test2, sizeof(test2));
		}
		settings_save_one("ps/rst_cnt", &rst_cnt, sizeof(rst_cnt));
		settings_save_one("ps/ra0", &test0, sizeof(test0));
		settings_save_one("ps/ra1", &test1, sizeof(test1));
		settings_save_one("ps/ra2", &test2, sizeof(test2));
		if (rst_cnt == 2) {
			/* Delete one entry ps/ra0 */
			settings_delete("ps/ra0");
		}
		if (rst_cnt == 4) {
			/* Delete all entries that match ps/ra... */
			settings_delete("ps/ra");
		}
		k_sleep(SLEEP_TIME);
		sys_reboot(0);
	}
	printk("Finished");
}
```
