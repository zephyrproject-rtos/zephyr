## CMakeLists.txt
```
# Copyright (c) 2023 KNS Group LLC (YADRO)
#
# SPDX-License-Identifier: Apache-2.0

cmake_minimum_required(VERSION 3.28.0)

find_package(Zephyr REQUIRED HINTS $ENV{ZEPHYR_BASE})
project(perf)

target_sources(app PRIVATE src/main.c)
```

## Kconfig
```
# Copyright 2026 Arm Limited and/or its affiliates <open-source-office@arm.com>
#
# SPDX-License-Identifier: Apache-2.0

configdefault EXTRA_EXCEPTION_INFO
	default y if CPU_CORTEX_M && CORTEX_M_SYSTICK

configdefault ARCH_STACKWALK
	default y if CPU_CORTEX_M && CORTEX_M_SYSTICK

source "Kconfig.zephyr"
```

## sample.yaml
```
sample:
  description: Sample, that can be used for testing profiling perf tool
  name: perf sample

tests:
  sample.perf:
    tags:
      - perf
      - profiling
    extra_configs:
      - CONFIG_PROFILING_PERF_BUFFER_SIZE=128
    filter: CONFIG_RISCV or CONFIG_X86
    integration_platforms:
      - qemu_riscv64
      - qemu_riscv32/qemu_virt_riscv32
      - qemu_x86_64
      - qemu_x86
    harness: pytest
```

## prj.conf
```kconfig
CONFIG_PROFILING=y
CONFIG_PROFILING_PERF=y
CONFIG_PROFILING_PERF_EVENTS=y
CONFIG_PROFILING_PERF_EVENTS_SHELL=y
CONFIG_PROFILING_PERF_EVENT_PROVIDER_CPU=y
CONFIG_THREAD_STACK_INFO=y
CONFIG_SMP=n
CONFIG_SHELL=y
CONFIG_FRAME_POINTER=y
```

## src/main.c
```c
/*
 *  Copyright (c) 2023 KNS Group LLC (YADRO)
 *  Copyright 2026 Arm Limited and/or its affiliates <open-source-office@arm.com>
 *
 *  SPDX-License-Identifier: Apache-2.0
 */

#include <zephyr/kernel.h>
#include <zephyr/toolchain.h>
#include <stdio.h>

BUILD_ASSERT(IS_ENABLED(CONFIG_PROFILING_PERF),
	     "The perf sample requires CONFIG_PROFILING_PERF");

#define WAIT_KOEF 10000

int __noinline func_0_0(void)
{
	k_busy_wait(1*WAIT_KOEF);
	return 0;
}

int __noinline func_0_1(void)
{
	k_busy_wait(2*WAIT_KOEF);
	return 0;
}

int __noinline func_0(void)
{
	k_busy_wait(1*WAIT_KOEF);
	func_0_0();
	func_0_1();
	return 0;
}

int __noinline func_1(void)
{
	k_busy_wait(3*WAIT_KOEF);
	return 0;
}

int __noinline func_2(void)
{
	k_busy_wait(4*WAIT_KOEF);
	return 0;
}

int main(void)
{
	while (1) {
		k_usleep(1000);
		func_0();
		func_1();
		func_2();
	}
	return 0;
}
```
