## samples/subsys/profiling/perf/Kconfig
```kconfig
# Copyright 2026 Arm Limited and/or its affiliates <open-source-office@arm.com>
#
# SPDX-License-Identifier: Apache-2.0

configdefault EXTRA_EXCEPTION_INFO
	default y if CPU_CORTEX_M && CORTEX_M_SYSTICK

configdefault ARCH_STACKWALK
	default y if CPU_CORTEX_M && CORTEX_M_SYSTICK

source "Kconfig.zephyr"
```

## samples/subsys/profiling/perf/sample.yaml
```yaml
sample:
  description: Sample, that can be used for testing profiling perf tool
  name: perf sample

tests:
  sample.perf:
    tags:
      - perf
      - profiling
    extra_configs:
      - CONFIG_PROFILING_PERF_BUFFER_SIZE=128
    filter: CONFIG_RISCV or CONFIG_X86
    integration_platforms:
      - qemu_riscv/qemu_virt_riscv/rv64
      - qemu_riscv/qemu_virt_riscv/rv32
      - qemu_x86_64
      - qemu_x86
    harness: pytest
```

## samples/subsys/rtio/producer_consumer/sample.yaml
```yaml
sample:
  name: RTIO producer consumer sample
tests:
  sample.rtio.producer_consumer:
    tags: rtio
    integration_platforms:
      - native_sim
    harness: console
    harness_config:
      type: multi_line
      regex:
        - "(.*)producer (.*) trigger"
        - "(.*)buf (.*), len 8"
        - "(.*)read result 0, cycle count is (.*)"
```

## samples/subsys/rtio/sensor_batch_processing/dts/bindings/vnd,sensor.yaml
```yaml
# Copyright (c) 2022 Intel Corporation
#
# SPDX-License-Identifier: Apache-2.0

description: Sensor

include: base.yaml

compatible: "vnd,sensor"

properties:
  sample-period:
    type: int
    required: true

  sample-size:
    type: int
    required: true

  max-msgs:
    type: int
    required: true
```

## samples/subsys/rtio/sensor_batch_processing/sample.yaml
```yaml
sample:
  name: RTIO sample
tests:
  sample.rtio.sensor_batch_processing:
    tags: rtio
    integration_platforms:
      - native_sim
    harness: console
    harness_config:
      type: multi_line
      regex:
        - "(.*)Submitting (.*) read requests"
        - "(.*)Start processing (.*) samples"
        - "(.*)Finished processing (.*) samples"
```

## samples/subsys/sd_dev/shell/sample.yaml
```yaml
/*
 * SPDX-FileCopyrightText: 2026 NXP
 *
 * SPDX-License-Identifier: Apache-2.0
 */

sample:
  name: SD Device Sample
  description: Sample application for SD device driver

common:
  tags:
    - sd
    - device
    - nxp

tests:
  sample.subsys.sd_dev.shell:
    harness: console
    integration_platforms:
      - rd_rw612_bga
    harness_config:
      type: multi_line
      regex:
        - "SD Device Sample Started"
        - "SD Device is ready
```

## samples/subsys/sensing/simple/sample.yaml
```yaml
sample:
  description: A sensor framework sample
  name: sensing sample
common:
  tags: sensing
  integration_platforms:
    - native_sim
  harness: console
  harness_config:
    type: multi_line
    regex:
      - "sensing subsystem run successfully"
tests:
  sample.sensing.simple:
    platform_allow:
      - native_sim
    tags: sensing
```

## samples/subsys/senss/sample.yaml
```yaml
sample:
  description: sensorsubsys sample application
  name: sensorsubsys
common:
    tags: introduction
    integration_platforms:
      - native_posix
    harness: console
    harness_config:
      type: one_line
      regex:
        - "Hello Sensor Subsystem! (.*)"
tests:
  sample.basic.sensorsubsys:
    tags: introduction
```

## samples/subsys/settings/boards/esp32c3_luatos_core_usb.conf
```kconfig
CONFIG_HEAP_MEM_POOL_SIZE=256
CONFIG_NVS=y
CONFIG_SETTINGS_NVS=y
CONFIG_MPU_ALLOW_FLASH_WRITE=y
```

## samples/subsys/settings/boards/mr_canhubk3.conf
```kconfig
# Copyright 2023 NXP
# SPDX-License-Identifier: Apache-2.0

# Use LittleFS file system as Settings backend
CONFIG_FILE_SYSTEM=y
CONFIG_FILE_SYSTEM_LITTLEFS=y
CONFIG_SETTINGS_FILE=y
CONFIG_SETTINGS_FILE_PATH="/ff/settings/run"
```

## samples/subsys/settings/boards/native_posix.conf
```kconfig
# Enable the LittleFS file system.
CONFIG_FILE_SYSTEM=y
CONFIG_FILE_SYSTEM_LITTLEFS=y
CONFIG_SETTINGS_FS=y
CONFIG_SETTINGS_FS_DIR="/ff/settings"
CONFIG_SETTINGS_FS_FILE="/ff/settings/run"
```

## samples/subsys/settings/boards/native_sim_64.conf
```kconfig
# Enable the LittleFS file system.
CONFIG_FILE_SYSTEM=y
CONFIG_FILE_SYSTEM_LITTLEFS=y
CONFIG_SETTINGS_FILE=y
CONFIG_SETTINGS_FILE_PATH="/ff/settings/run"
```

## samples/subsys/settings/boards/s32z2xxdc2_s32z270_rtu1.conf
```kconfig
# Copyright 2024 NXP
# SPDX-License-Identifier: Apache-2.0

CONFIG_NVS=y
CONFIG_SETTINGS_NVS=y
```

## samples/subsys/settings/sample.yaml
```yaml
sample:
  name: Settings Sample

tests:
  sample.subsys.settings:
    tags: settings
    timeout: 20
    filter: dt_label_with_parent_compat_enabled("storage_partition", "fixed-partitions")
    platform_exclude:
      - nucleo_h723zg
      - stm32h735g_disco
      - nucleo_h743zi
      - stm32h745i_disco/stm32h745xx/m7
      - nucleo_h745zi_q/stm32h745xx/m7
      - stm32h747i_disco/stm32h747xx/m7
      - stm32h750b_dk
      - nucleo_h753zi
      - nucleo_h755zi_q/stm32h755xx/m7
      - qemu_cortex_m0/nrf51822
    integration_platforms:
      - native_sim
    harness: console
    harness_config:
      type: multi_line
      regex:
        - "subtree <alpha> handler registered: OK"
        - "# iteration 0"
        - "[.]*<alpha/length> value exist in the storage"
        - "[.]*Can\\'t to load the <alpha/length> value as expected"
        - "<gamma> = 0 \\(default\\)"
        - "# iteration 1"
        - "<alpha/length/2> = 59"
        - "# iteration 2"
        - "<alpha/length/1> = 42"
        - "# iteration 3"
        - "<alpha/beta/voltage> = -3100"
        - "# iteration 4"
        - "<alpha/beta/source> = abcd"
        - "# iteration 5"
        - "<alpha/angle/1> = 5"
        - "<alpha/beta/source> is not compatible with the application"
        - "direct.length = 100"
        - "direct.length_1 = 46"
        - "direct.length_2 = 54"
        - "<gamma> = 5"
        - "The settings destination off the key <alpha/beta/source> has got value:\
        \ \"RT\""
        - "String value \"rtos\" was retrieved from the settings destination off the\
        \ key <alpha/beta/source>"
```

## samples/subsys/sfcb/sample.yaml
```yaml
sample:
  name: Blinky Sample
tests:
  test:
    platform_whitelist: arduino_101
    tags: samples
    depends_on: gpio
```

## samples/subsys/shell/bluetooth/sample.yaml
```yaml
sample:
  name: Shell over Bluetooth Sample
tests:
  sample.shell.bluetooth:
    tags:
      - shell
      - bluetooth
    harness: keyboard
    platform_allow: nrf52833dk_nrf52833
    integration_platforms:
      - nrf52833dk_nrf52833
```

## samples/subsys/shell/devmem_load/sample.yaml
```yaml
sample:
  name: devmem_load
  description: devmem load sample
common:
  harness: keyboard
  tags:
    - devmem
    - devmem_load
tests:
  sample.devmem_load.polled:
    integration_platforms:
      - native_sim
    extra_args: OVERLAY_CONFIG="prj_poll.conf"
  sample.devmem_load.uart.interrupt:
    integration_platforms:
      - frdm_k64f
    filter: CONFIG_SERIAL_SUPPORT_INTERRUPT
```

## samples/subsys/shell/envdaq/Kconfig
```kconfig
# SPDX-License-Identifier: Apache-2.0

mainmenu "EnvDAQ sample application"

source "Kconfig.zephyr"
```

## samples/subsys/shell/envdaq/sample.yaml
```yaml
sample:
  name: EnvDAQ
  description: LED blink and relay cycle test application for HIKIT SC1
common:
  platform_allow:
    - hikit_sc1
  integration_platforms:
    - hikit_sc1
  harness: console
  build_only: true
  tags:
    - envdaq
    - gpio
tests:
  sample.subsys.shell.envdaq:
    filter: dt_alias_exists("led0") and dt_alias_exists("relay")
```

## samples/subsys/shell/fs/boards/actinius_icarus_bee.conf
```kconfig
#
# Copyright (c) 2021 Actinius
#
# SPDX-License-Identifier: Apache-2.0
#
CONFIG_SPI=y
CONFIG_SPI_NOR=y
CONFIG_SPI_NOR_FLASH_LAYOUT_PAGE_SIZE=4096

CONFIG_MPU_ALLOW_FLASH_WRITE=y
```

## samples/subsys/shell/fs/boards/circuitdojo_feather_nrf9160.conf
```kconfig
#
# Copyright (c) 2020 Circuit Dojo LLC
#
# SPDX-License-Identifier: Apache-2.0
#
CONFIG_SPI=y
CONFIG_SPI_NOR=y
CONFIG_SPI_NOR_FLASH_LAYOUT_PAGE_SIZE=4096
```
