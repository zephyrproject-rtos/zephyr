## CMakeLists.txt
```
# SPDX-License-Identifier: Apache-2.0

cmake_minimum_required(VERSION 3.28.0)
find_package(Zephyr REQUIRED HINTS $ENV{ZEPHYR_BASE})

project(app LANGUAGES C)

target_sources(app PRIVATE src/main.c src/pubsub.c)
zephyr_include_directories(include)
```

## sample.yaml
```
common:
  tags:
    - llext
    - edk
  arch_allow:
    - arm
  filter: CONFIG_ARCH_HAS_USERSPACE
sample:
  description: EDK sample application
  name: EDK sample application
tests:
  sample.edk.app:
    build_only: true
    tags:
      - edk
      - llext
```

## prj.conf
```kconfig
CONFIG_APPLICATION_DEFINED_SYSCALL=y
CONFIG_USERSPACE=y
CONFIG_LLEXT=y

CONFIG_MAIN_STACK_SIZE=4096

CONFIG_DYNAMIC_OBJECTS=y
CONFIG_DYNAMIC_THREAD=y
CONFIG_DYNAMIC_THREAD_ALLOC=y
CONFIG_DYNAMIC_THREAD_PREFER_ALLOC=y
CONFIG_ZBUS=y
CONFIG_ZBUS_CHANNEL_NAME=y

CONFIG_LLEXT_HEAP_SIZE=32

# Uncomment to disable kext1.
#CONFIG_LLEXT_EDK_USERSPACE_ONLY=y

CONFIG_EVENTS=y
```

## src/main.c
```c
/*
 * Copyright (c) 2024 Intel Corporation
 *
 * SPDX-License-Identifier: Apache-2.0
 */

#include <zephyr/kernel.h>
#include <zephyr/app_memory/mem_domain.h>
#include <zephyr/llext/llext.h>
#include <zephyr/llext/buf_loader.h>
#include <zephyr/sys/libc-hooks.h>

#include <app_api.h>

#include <string.h>

/**
 * Assume that if the extension 1 is not built, we are building the
 * EDK. If others are not built, this will just fail.
 */
#if defined __has_include
#  if __has_include("../../ext1/build/ext1.inc")
#    undef EDK_BUILD
#  else
#    pragma message "Extension 1 not built, assuming EDK build."
#    define EDK_BUILD
#  endif
#endif

#ifndef EDK_BUILD
#include <../../ext1/build/ext1.inc>
#define ext1_inc ext1_llext
#define ext1_len ext1_llext_len
#include <../../ext2/build/ext2.inc>
#define ext2_inc ext2_llext
#define ext2_len ext2_llext_len
#include <../../ext3/build/ext3.inc>
#define ext3_inc ext3_llext
#define ext3_len ext3_llext_len
#ifndef CONFIG_LLEXT_EDK_USERSPACE_ONLY
#include <../../k-ext1/build/kext1.inc>
#define kext1_inc kext1_llext
#define kext1_len kext1_llext_len
#endif
#endif

#define USER_STACKSIZE  2048
#define USER_HEAPSIZE  8192
#define MAX_EXTENSIONS 4

extern k_tid_t start_subscriber_thread(void);

/* Maybe make all this depend on MAX_EXTENSIONS? */
struct k_thread user_thread1, user_thread2, user_thread3, kernel_thread1;
K_THREAD_STACK_DEFINE(user_stack1, USER_STACKSIZE);
K_THREAD_STACK_DEFINE(user_stack2, USER_STACKSIZE);
K_THREAD_STACK_DEFINE(user_stack3, USER_STACKSIZE);
K_THREAD_STACK_DEFINE(kernel_stack1, USER_STACKSIZE);

K_HEAP_DEFINE(user_heap1, USER_HEAPSIZE);
K_HEAP_DEFINE(user_heap2, USER_HEAPSIZE);
K_HEAP_DEFINE(user_heap3, USER_HEAPSIZE);
K_HEAP_DEFINE(kernel_heap1, USER_HEAPSIZE);

struct {
	k_tid_t thread;
	struct llext *ext;
} extension_threads[MAX_EXTENSIONS];
int max_extension_thread_idx;

static const void * const load(const char *name, struct llext **ext, void *buf,
			       size_t len)
{
#ifndef EDK_BUILD
	struct llext_buf_loader buf_loader = LLEXT_BUF_LOADER(buf, len);
	struct llext_loader *loader = &buf_loader.loader;
	struct llext_load_param ldr_parm = LLEXT_LOAD_PARAM_DEFAULT;

	llext_load(loader, name, ext, &ldr_parm);

	return llext_find_sym(&(*ext)->exp_tab, "start");
#else
	return NULL;
#endif
}

static void unload(struct llext **ext)
{
	llext_unload(ext);
}

static void user_function(void *p1, void *p2, void *p3)
{
	int (*start_fn)(void) = p1;

	printk("[app]Thread %p created to run extension [%s], at %s\n",
	       k_current_get(), (char *)p2,
	       k_is_user_context() ? "userspace." : "privileged mode.");

	start_fn();
	printk("[app]Thread %p done\n", k_current_get());
}

void k_sys_fatal_error_handler(unsigned int reason, const struct arch_esf *esf)
{
	int i;

	printk("[app]Fatal handler! Thread: %p\n", k_current_get());

	for (i = 0; i < max_extension_thread_idx; i++) {
		if (extension_threads[i].thread == k_current_get()) {
			unload(&extension_threads[i].ext);
		}
	}
}

void run_extension_on_thread(void *ext_inc, size_t ext_len,
			     struct k_mem_domain *domain,
			     struct k_thread *thread,
			     k_thread_stack_t *stack,
			     struct k_heap *heap,
			     const char *name,
			     k_tid_t subscriber_thread_id,
			     int flag)
{
	int (*start_fn)(void);
	struct llext **ext = &extension_threads[max_extension_thread_idx].ext;

	printk("[app]Loading extension [%s].\n", name);
	start_fn = load(name, ext, ext_inc, ext_len);

	llext_add_domain(*ext, domain);

	k_thread_create(thread, stack, USER_STACKSIZE,
			user_function, start_fn, (void *)name, NULL,
			-1, flag | K_INHERIT_PERMS, K_FOREVER);
	k_mem_domain_add_thread(domain, thread);
	k_mem_domain_add_thread(domain, subscriber_thread_id);

	k_thread_heap_assign(thread, heap);

	extension_threads[max_extension_thread_idx].thread = thread;
	max_extension_thread_idx++;

	k_thread_start(thread);
}

int main(void)
{
	struct k_mem_domain domain1, domain2, domain3, kdomain1;

#ifndef EDK_BUILD
	k_tid_t subscriber_thread_id = start_subscriber_thread();
#endif
	/* This and all other similar sleeps are here to provide a chance for
	 * the newly created thread to run.
	 */
	k_sleep(K_MSEC(1));

	k_mem_domain_init(&domain1, 0, NULL);
	k_mem_domain_init(&domain2, 0, NULL);
	k_mem_domain_init(&domain3, 0, NULL);
	k_mem_domain_init(&kdomain1, 0, NULL);

#if Z_LIBC_PARTITION_EXISTS
	k_mem_domain_add_partition(&domain1, &z_libc_partition);
	k_mem_domain_add_partition(&domain2, &z_libc_partition);
	k_mem_domain_add_partition(&domain3, &z_libc_partition);
#endif

#ifndef EDK_BUILD
#ifndef CONFIG_LLEXT_EDK_USERSPACE_ONLY
	run_extension_on_thread(kext1_inc, kext1_len, &kdomain1,
				&kernel_thread1, kernel_stack1, &kernel_heap1,
				"kext1", subscriber_thread_id, 0);
	k_sleep(K_MSEC(1));
#endif
	run_extension_on_thread(ext1_inc, ext1_len, &domain1, &user_thread1,
				user_stack1, &user_heap1, "ext1",
				subscriber_thread_id, K_USER);
	k_sleep(K_MSEC(1));
	run_extension_on_thread(ext2_inc, ext2_len, &domain2, &user_thread2,
				user_stack2, &user_heap2, "ext2",
				subscriber_thread_id, K_USER);
	k_sleep(K_MSEC(1));
	run_extension_on_thread(ext3_inc, ext3_len, &domain3, &user_thread3,
				user_stack3, &user_heap3, "ext3",
				subscriber_thread_id, K_USER);
#endif

	k_sleep(K_FOREVER);

	return 0;
}
```

## include/app_api.h
```c
/*
 * Copyright (c) 2024 Intel Corporation
 *
 * SPDX-License-Identifier: Apache-2.0
 */

#ifndef _TEST_EDK_H_
#define _TEST_EDK_H_
#include <zephyr/kernel.h>
#include <zephyr/toolchain.h>

#include <stddef.h>

#ifdef __cplusplus
extern "C" {
#endif

	enum Channels {
		CHAN_TICK = 1,
		CHAN_LAST
	};

	struct channel_tick_data {
		unsigned long l;
	};

	__syscall int publish(enum Channels channel, void *data,
			      size_t data_len);
	__syscall int receive(enum Channels channel, void *data,
			      size_t data_len);
	__syscall int register_subscriber(enum Channels channel,
			      struct k_event *evt);
#ifdef __cplusplus
}
#endif

#include <zephyr/syscalls/app_api.h>
#endif /* _TEST_EDK_H_ */
```

## src/pubsub.c
```c
/*
 * Copyright (c) 2024 Intel Corporation
 *
 * SPDX-License-Identifier: Apache-2.0
 */

#include <app_api.h>

#include <zephyr/kernel.h>
#include <zephyr/internal/syscall_handler.h>
#include <zephyr/zbus/zbus.h>
#include <zephyr/llext/symbol.h>

#include <string.h>

#define MAX_SUBSCRIBERS 64
#define SUBSCRIBER_THREAD_STACK_SIZE 1024
#define SUBSCRIBER_THREAD_PRIORITY K_PRIO_PREEMPT(1)

ZBUS_CHAN_DEFINE(tick_chan,
		struct channel_tick_data,
		NULL,
		NULL,
		ZBUS_OBSERVERS(default_sub),
		ZBUS_MSG_INIT(.l = 0));

ZBUS_SUBSCRIBER_DEFINE(default_sub, 4);

K_THREAD_STACK_DEFINE(subscriber_thread_stack, SUBSCRIBER_THREAD_STACK_SIZE);
static struct k_thread subscriber_thread;

static struct subs {
	struct {
		k_tid_t thread;
		struct k_event *evt;
	} subscribers[MAX_SUBSCRIBERS];
	struct k_mutex subscribers_mtx;
	int subscribers_count;
	const struct zbus_channel *chan;
} channel_subscribers[] = {
	/* Empty one first, so no channel is zero (first item on enum == 1) */
	{{ }},
	{ .chan = &tick_chan },
	{{ }}
};

static int remove_subscriber(k_tid_t thread, struct subs *sus)
{
	int i;

	for (i = 0; i < sus->subscribers_count; i++) {
		if (sus->subscribers[i].thread == thread) {
			sus->subscribers[i].thread = NULL;
			sus->subscribers[i].evt = NULL;
			break;
		}
	}

	if (i == sus->subscribers_count) {
		return -ENOENT;
	}

	/* Move all entries after excluded one, to keep things tidy */
	memmove(&sus->subscribers[i], &sus->subscribers[i + 1],
			(sus->subscribers_count - i - 1) *
			sizeof(sus->subscribers[0]));
	sus->subscribers_count--;

	return 0;
}

static int add_subscriber(k_tid_t thread, struct subs *sus,
			  struct k_event *evt)
{
	if (sus->subscribers_count >= MAX_SUBSCRIBERS) {
		return -ENOMEM;
	}

	sus->subscribers[sus->subscribers_count].thread = thread;
	sus->subscribers[sus->subscribers_count].evt = evt;
	sus->subscribers_count++;

	printk("[app]Thread [%p] registered event [%p]\n", thread, evt);
	return 0;
}

static void notify_subscribers(enum Channels channel)
{
	int i;
	struct subs *subs = &channel_subscribers[channel];

	for (i = 0; i < subs->subscribers_count; i++) {
		k_event_post(subs->subscribers[i].evt, channel);
	}
}

static void subscriber_thread_fn(void *p0, void *p1, void *p2)
{
	const struct zbus_channel *chan;
	int i;

	printk("[app]Subscriber thread [%p] started.\n", k_current_get());
	while (zbus_sub_wait(&default_sub, &chan, K_FOREVER) == 0) {
		printk("[app][subscriber_thread]Got channel %s\n",
		       zbus_chan_name(chan));

		for (i = 0; i < CHAN_LAST; i++) {
			if (channel_subscribers[i].chan == chan) {
				notify_subscribers((enum Channels)i);
				break;
			}
		}
	}
}

k_tid_t start_subscriber_thread(void)
{
	return k_thread_create(&subscriber_thread, subscriber_thread_stack,
			       SUBSCRIBER_THREAD_STACK_SIZE,
			       subscriber_thread_fn, NULL, NULL, NULL,
			       SUBSCRIBER_THREAD_PRIORITY, 0, K_NO_WAIT);
}

int z_impl_publish(enum Channels channel, void *data, size_t data_len)
{
	const struct zbus_channel *chan = channel_subscribers[channel].chan;

	if (channel == CHAN_LAST) {
		return -EINVAL;
	}

	return zbus_chan_pub(chan, data, K_NO_WAIT);
}
EXPORT_SYMBOL(z_impl_publish);

#ifdef CONFIG_USERSPACE
static inline int z_vrfy_publish(enum Channels channel, void *data,
				 size_t data_len)
{
	int ret;
	void *copy_data;

	copy_data = k_usermode_alloc_from_copy(data, data_len);
	if (copy_data == NULL) {
		return -EINVAL;
	}

	ret = z_impl_publish(channel, copy_data, data_len);

	k_free(copy_data);

	return ret;
}
#include <zephyr/syscalls/publish_mrsh.c>
#endif

int z_impl_receive(enum Channels channel, void *data, size_t data_len)
{
	size_t msg_size;

	if (channel == CHAN_LAST || data == NULL) {
		return -EINVAL;
	}

	msg_size = channel_subscribers[channel].chan->message_size;
	if (data_len < msg_size) {
		return -EINVAL;
	}

	return zbus_chan_read(channel_subscribers[channel].chan, data,
			      K_NO_WAIT);
}
EXPORT_SYMBOL(z_impl_receive);

#ifdef CONFIG_USERSPACE
static inline int z_vrfy_receive(enum Channels channel, void *data,
				 size_t data_len)
{
	if (K_SYSCALL_MEMORY_WRITE(data, data_len)) {
		return -EINVAL;
	}

	return z_impl_receive(channel, data, data_len);
}
#include <zephyr/syscalls/receive_mrsh.c>
#endif

int z_impl_register_subscriber(enum Channels channel, struct k_event *evt)
{
	struct subs *subs = &channel_subscribers[channel];
	int ret;

	if (channel == CHAN_LAST) {
		return -EINVAL;
	}

	k_mutex_lock(&subs->subscribers_mtx, K_FOREVER);

	if (evt == NULL) {
		ret = remove_subscriber(k_current_get(), subs);
	} else {
		ret = add_subscriber(k_current_get(), subs, evt);
	}

	k_mutex_unlock(&subs->subscribers_mtx);

	return ret;
}
EXPORT_SYMBOL(z_impl_register_subscriber);

#ifdef CONFIG_USERSPACE
static inline int z_vrfy_register_subscriber(enum Channels channel,
		struct k_event *evt)
{
	if (K_SYSCALL_OBJ(evt, K_OBJ_EVENT)) {
		return -EINVAL;
	}

	return z_impl_register_subscriber(channel, evt);
}
#include <zephyr/syscalls/register_subscriber_mrsh.c>
#endif
```
