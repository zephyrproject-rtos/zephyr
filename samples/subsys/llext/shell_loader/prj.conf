## CMakeLists.txt
```
# SPDX-License-Identifier: Apache-2.0

cmake_minimum_required(VERSION 3.28.0)

find_package(Zephyr REQUIRED HINTS $ENV{ZEPHYR_BASE})
project(fs_shell)

FILE(GLOB app_sources src/*.c)
target_sources(app PRIVATE ${app_sources})

# Add a target for building the extension code
set(ext_src ${PROJECT_SOURCE_DIR}/hello_world.c)
set(ext_bin ${PROJECT_BINARY_DIR}/hello_world.llext)
add_llext_target(hello_world_ext
  OUTPUT  ${ext_bin}
  SOURCES ${ext_src}
)
```

## sample.yaml
```
common:
  tags:
    - shell
    - llext
  arch_allow:
    - arm
    - xtensa
  filter: not CONFIG_MPU and not CONFIG_MMU and not CONFIG_SOC_SERIES_S32ZE
    and not CONFIG_SOC_SERIES_RZA2M
  platform_exclude:
    # platforms with active issues
    - apollo4p_evb            # See #73443
    - apollo4p_blue_kxr_evb   # See #73443
    - numaker_pfm_m487        # See #63167
    - s32z2xxdc2/s32z270/rtu0 # See commit 18a0660
    - s32z2xxdc2/s32z270/rtu1 # See commit 18a0660
    # platforms that are always skipped by the runtime filter
    - qemu_arc/qemu_arc_em
    - qemu_arc/qemu_arc_hs
    - qemu_arc/qemu_arc_hs/xip
    - qemu_arc/qemu_arc_hs5x
    - qemu_arc/qemu_arc_hs6x
    - qemu_cortex_m0
    - qemu_xtensa/dc233c/mmu
    - rza2m_evk

sample:
  description: Loadable extensions with shell sample
  name: Extension loader shell

tests:
  sample.llext.shell:
    harness: keyboard
    extra_configs:
      - arch:arm:CONFIG_ARM_MPU=n
      - arch:arm:CONFIG_ARM_AARCH32_MMU=n
```

## prj.conf
```kconfig
CONFIG_LOG=y
CONFIG_LOG_MODE_IMMEDIATE=y

CONFIG_SHELL=y
CONFIG_SHELL_CMD_BUFF_SIZE=8192
CONFIG_SHELL_LOG_LEVEL_INF=y
CONFIG_SHELL_STACK_SIZE=4096

CONFIG_LLEXT=y
CONFIG_LLEXT_LOG_LEVEL_DBG=y
CONFIG_LLEXT_IMPORT_ALL_GLOBALS=y
CONFIG_LLEXT_HEAP_SIZE=8
CONFIG_LLEXT_SHELL=y
```

## src/main.c
```c
/*
 * Copyright (c) 2023 Intel Corporation
 *
 * SPDX-License-Identifier: Apache-2.0
 */


#define LOG_LEVEL CONFIG_LOG_DEFAULT_LEVEL
#include <zephyr/logging/log.h>
LOG_MODULE_REGISTER(app);

int main(void)
{
	return 0;
}
```
