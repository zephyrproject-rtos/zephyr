## CMakeLists.txt
```
# SPDX-License-Identifier: Apache-2.0

cmake_minimum_required(VERSION 3.28.0)
find_package(Zephyr REQUIRED HINTS $ENV{ZEPHYR_BASE})
project(task_wdt)

target_sources(app PRIVATE src/main.c)
```

## sample.yaml
```
sample:
  name: Task Watchdog Subsytem Sample
common:
  harness: console
  tags:
    - task_wdt
  harness_config:
    type: multi_line
    ordered: true
    regex:
      - "Task watchdog sample application."
      - "Control thread started."
      - "Main thread still alive..."
      - "Control thread getting stuck..."
      - "Task watchdog channel 1 callback, thread: control"
      - "Resetting device...(.*)"
      - "Task watchdog sample application."
  depends_on: watchdog
  platform_exclude:
    - s32z2xxdc2/s32z270/rtu0
    - s32z2xxdc2/s32z270/rtu1
    - s32z2xxdc2@D/s32z270/rtu0
    - s32z2xxdc2@D/s32z270/rtu1
tests:
  sample.task_wdt:
    integration_platforms:
      - nucleo_g474re
```

## prj.conf
```kconfig
CONFIG_LOG=y
CONFIG_LOG_MODE_IMMEDIATE=y

CONFIG_WATCHDOG=y
CONFIG_WDT_LOG_LEVEL_DBG=y
CONFIG_WDT_DISABLE_AT_BOOT=y

CONFIG_TASK_WDT=y
CONFIG_TASK_WDT_MIN_TIMEOUT=500

CONFIG_THREAD_NAME=y
```

## prj_no_hw_fallback.conf
```kconfig
CONFIG_LOG=y
CONFIG_LOG_MODE_IMMEDIATE=y

CONFIG_WATCHDOG=n

CONFIG_TASK_WDT=y

CONFIG_THREAD_NAME=y
```

## boards/apollo510_eb.conf
```kconfig
CONFIG_TASK_WDT_HW_FALLBACK=y
CONFIG_TASK_WDT_HW_FALLBACK_DELAY=5000

CONFIG_WDT_MULTISTAGE=y
```

## boards/lp_mspm0l2228.overlay
```dts
/*
 * Copyright (c) 2026 Texas Instruments Inc.
 * SPDX-License-Identifier: Apache-2.0
 *
 * lp_mspm0l2228 has two watchdog peripherals: WWDT (window watchdog,
 * wdt_mspm0.c) and IWDT (independent watchdog, wdt_mspm0_iwdt.c). This
 * overlay selects the WWDT as watchdog0 for this sample: once armed the
 * IWDT keeps running across debug resets and keeps resetting the board
 * until VBAT is power-cycled, which breaks every later test on that board.
 */

/ {
	aliases {
		watchdog0 = &wdt0;
	};
};

&wdt0 {
	status = "okay";
};
```

## boards/lp_mspm33c321a.overlay
```dts
/*
 * Copyright (c) 2026 Texas Instruments Inc.
 * SPDX-License-Identifier: Apache-2.0
 *
 * Use the WWDT as watchdog0, not the IWDT. Once armed the IWDT keeps
 * running across debug resets and keeps resetting the board until VBAT
 * is power-cycled, which breaks every later test on the same board.
 */

/ {
	aliases {
		watchdog0 = &wdt0;
	};
};

&wdt0 {
	status = "okay";
};
```

## boards/mr_canhubk3.overlay
```dts
/*
 * Copyright 2023 NXP
 *
 * SPDX-License-Identifier: Apache-2.0
 */

/*
 * FS26 watchdog cannot be used as hardware watchdog fallback on this SoC, since
 * the SPI driver being used to communicate with the device, cannot transceive
 * from interrupt context. In order to run this sample, FS26 must be started in
 * DEBUG mode (see board documentation).
 */
&fs26_wdt {
	status = "disabled";
};
```

## boards/nucleo_f091rc.overlay
```dts
/*
 * Copyright 2024 STMicroelectronics
 *
 * SPDX-License-Identifier: Apache-2.0
 */

/*
 * stm32F0 has a WWDG clock by APB1 where the APB1 prescaler is 1..16
 * Adjust the APB1 clock to match the WDG timeout.
 */

&rcc {
	/delete-property/ apb1-prescaler;
	apb1-prescaler = <16>;
};

&iwdg {
	status = "disabled";
};

&wwdg {
	status = "okay";
};
```

## boards/nucleo_f401re.overlay
```dts
/*
 * Copyright 2024 STMicroelectronics
 *
 * SPDX-License-Identifier: Apache-2.0
 */

/*
 * stm32F4 has a WWDG clock by APB1 where the APB1 prescaler is 1..16
 * this is too low to configure the WWDG clock for this sample.
 * Thus, use the IWDG instead for running this sample.
 */

&wwdg {
	status = "disabled";
};

&iwdg {
	status = "okay";
};
```

## src/main.c
```c
/*
 * Copyright (c) 2020 Libre Solar Technologies GmbH
 *
 * SPDX-License-Identifier: Apache-2.0
 */

#include <zephyr/kernel.h>
#include <zephyr/device.h>
#include <zephyr/drivers/watchdog.h>
#include <zephyr/sys/reboot.h>
#include <zephyr/task_wdt/task_wdt.h>
#include <zephyr/sys/printk.h>
#include <stdbool.h>

/*
 * To use this sample, either the devicetree's /aliases must have a
 * 'watchdog0' property, or one of the following watchdog compatibles
 * must have an enabled node.
 *
 * If the devicetree has a watchdog node, we get the watchdog device
 * from there. Otherwise, the task watchdog will be used without a
 * hardware watchdog fallback.
 */
#if DT_NODE_HAS_STATUS_OKAY(DT_ALIAS(watchdog0))
#define WDT_NODE DT_ALIAS(watchdog0)
#elif DT_HAS_COMPAT_STATUS_OKAY(st_stm32_window_watchdog)
#define WDT_NODE DT_COMPAT_GET_ANY_STATUS_OKAY(st_stm32_window_watchdog)
#elif DT_HAS_COMPAT_STATUS_OKAY(st_stm32_watchdog)
#define WDT_NODE DT_COMPAT_GET_ANY_STATUS_OKAY(st_stm32_watchdog)
#elif DT_HAS_COMPAT_STATUS_OKAY(nordic_nrf_wdt)
#define WDT_NODE DT_COMPAT_GET_ANY_STATUS_OKAY(nordic_nrf_wdt)
#elif DT_HAS_COMPAT_STATUS_OKAY(espressif_esp32_watchdog)
#define WDT_NODE DT_COMPAT_GET_ANY_STATUS_OKAY(espressif_esp32_watchdog)
#elif DT_HAS_COMPAT_STATUS_OKAY(silabs_gecko_wdog)
#define WDT_NODE DT_COMPAT_GET_ANY_STATUS_OKAY(silabs_gecko_wdog)
#elif DT_HAS_COMPAT_STATUS_OKAY(nxp_wdog32)
#define WDT_NODE DT_COMPAT_GET_ANY_STATUS_OKAY(nxp_wdog32)
#elif DT_HAS_COMPAT_STATUS_OKAY(microchip_xec_watchdog)
#define WDT_NODE DT_COMPAT_GET_ANY_STATUS_OKAY(microchip_xec_watchdog)
#else
#define WDT_NODE DT_INVALID_NODE
#endif

static void task_wdt_callback(const struct task_wdt_fault *fault, void *user_data)
{
	const char *name = (fault->thread != NULL) ? k_thread_name_get(fault->thread) : NULL;

	ARG_UNUSED(user_data);

	printk("Task watchdog channel %d callback, thread: %s\n", fault->channel_id,
	       name != NULL ? name : "<unknown>");

	/*
	 * If the issue could be resolved, call task_wdt_feed(fault->channel_id)
	 * here to continue operation.
	 *
	 * Otherwise we can perform some cleanup and reset the device.
	 */

	printk("Resetting device...\n");

	sys_reboot(SYS_REBOOT_COLD);
}

int main(void)
{
	int ret;
	const struct device *const hw_wdt_dev = DEVICE_DT_GET_OR_NULL(WDT_NODE);

	printk("Task watchdog sample application.\n");

	if (!device_is_ready(hw_wdt_dev)) {
		printk("Hardware watchdog not ready; ignoring it.\n");
		ret = task_wdt_init(NULL);
	} else {
		ret = task_wdt_init(hw_wdt_dev);
	}

	if (ret != 0) {
		printk("task wdt init failure: %d\n", ret);
		return 0;
	}


	/* passing NULL instead of callback to trigger system reset */
	int task_wdt_id = task_wdt_add(1100U, NULL, NULL);

	while (true) {
		printk("Main thread still alive...\n");
		task_wdt_feed(task_wdt_id);
		k_sleep(K_MSEC(1000));
	}
	return 0;
}

/*
 * This high-priority thread needs a tight timing
 */
void control_thread(void)
{
	int task_wdt_id;
	int count = 0;

	printk("Control thread started.\n");

	/*
	 * Add a new task watchdog channel with a custom callback. The owning
	 * thread is tracked by the task watchdog and passed in the fault info.
	 */
	task_wdt_id = task_wdt_add(100U, task_wdt_callback, NULL);

	while (true) {
		if (count == 50) {
			printk("Control thread getting stuck...\n");
			k_sleep(K_FOREVER);
		}

		task_wdt_feed(task_wdt_id);
		k_sleep(K_MSEC(50));
		count++;
	}
}

K_THREAD_DEFINE(control, 1024, control_thread, NULL, NULL, NULL, -1, 0, 1000);
```
