/*
 * Copyright (c) 2026 Texas Instruments Inc.
 * SPDX-License-Identifier: Apache-2.0
 *
 * lp_mspm0l2228 has two watchdog peripherals: WWDT (window watchdog,
 * wdt_mspm0.c) and IWDT (independent watchdog, wdt_mspm0_iwdt.c). This
 * overlay selects the WWDT as watchdog0 for this sample: once armed the
 * IWDT keeps running across debug resets and keeps resetting the board
 * until VBAT is power-cycled, which breaks every later test on that board.
 */

/ {
	aliases {
		watchdog0 = &wdt0;
	};
};

&wdt0 {
	status = "okay";
};
