/*
 * Copyright 2023 NXP
 *
 * SPDX-License-Identifier: Apache-2.0
 */

/*
 * FS26 watchdog cannot be used as hardware watchdog fallback on this SoC, since
 * the SPI driver being used to communicate with the device, cannot transceive
 * from interrupt context. In order to run this sample, FS26 must be started in
 * DEBUG mode (see board documentation).
 */
&fs26_wdt {
	status = "disabled";
};
