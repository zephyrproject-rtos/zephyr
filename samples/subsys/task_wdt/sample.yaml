## samples/subsys/usb/console/sample.yaml
```yaml
sample:
  name: Console over CDC ACM serial
common:
  depends_on:
    - usbd
  tags: usb
  harness: console
  harness_config:
    fixture: fixture_usb_cdc
  integration_platforms:
    - nrf52840dk/nrf52840
    - frdm_k64f
    - stm32f723e_disco
    - nucleo_f413zh
    - mimxrt685_evk/mimxrt685s/cm33
    - mimxrt1060_evk/mimxrt1062/qspi
tests:
  sample.usbd.console: {}
  sample.usbd.console.multiple-instances:
    extra_configs:
      - CONFIG_CDC_ACM_SERIAL_MULTIPLE_INSTANCES=y
```

## samples/subsys/usb/dfu-next/sample.yaml
```yaml
sample:
  name: USB DFU sample
common:
  min_ram: 64
  depends_on:
    - usbd
  integration_platforms:
    - nrf52840dk/nrf52840
    - frdm_k64f
    - mimxrt1060_evk
tests:
  sample.usbd.dfu:
    tags: usb
  sample.usbd.dfu-flash:
    min_flash: 1024
    tags: usb
    extra_configs:
      - CONFIG_APP_USB_DFU_USE_FLASH_BACKEND=y
```
