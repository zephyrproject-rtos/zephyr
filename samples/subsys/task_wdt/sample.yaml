## samples/subsys/task_wdt/sample.yaml
```yaml
sample:
  name: Task Watchdog Subsytem Sample
common:
  tags:
    - task_wdt
  depends_on: watchdog
  platform_exclude:
    - s32z2xxdc2/s32z270/rtu0
    - s32z2xxdc2/s32z270/rtu1
    - s32z2xxdc2@D/s32z270/rtu0
    - s32z2xxdc2@D/s32z270/rtu1

tests:
  sample.task_wdt:
    harness: console
    harness_config:
      type: multi_line
      ordered: true
      regex:
        - "Task watchdog sample application."
        - "Control thread started."
        - "Main thread still alive..."
        - "Control thread getting stuck..."
        - "Task watchdog channel 1 callback, thread: control"
        - "Resetting device...(.*)"
        - "Task watchdog sample application."
    integration_platforms:
      - nucleo_g474re

  sample.task_wdt.multistage:
    platform_allow:
      - apollo3_evb
      - apollo3p_evb
      - apollo4p_evb
      - apollo4p_blue_kxr_evb
      - apollo510_evb
      - apollo510_eb
    timeout: 240
    extra_configs:
      - CONFIG_TASK_WDT_HW_FALLBACK=y
      - CONFIG_TASK_WDT_HW_FALLBACK_DELAY=5000
      - CONFIG_WDT_MULTISTAGE=y
    harness: console
    harness_config:
      type: multi_line
      ordered: false
      regex:
        - "\\[HW WDT\\] bark stage reached \\(interrupt\\)"
```

## samples/subsys/testsuite/benchmark/testcase.yaml
```yaml
# Copyright (c) 2025 Måns Ansgariusson <mansgariusson@gmail.com>
# SPDX-License-Identifier: Apache-2.0

tests:
  sample.testing.ztest.benchmark:
    platform_allow:
      - qemu_x86
    integration_platforms:
      - qemu_x86
    tags: test_framework
```

## samples/subsys/testsuite/integration/testcase.yaml
```yaml
tests:
  # section.subsection
  sample.testing.ztest:
    build_only: true
    platform_allow:
      - native_posix
      - native_sim
    integration_platforms:
      - native_sim
    tags: test_framework
```

## samples/subsys/testsuite/pytest/basic/testcase.yaml
```yaml
tests:
  sample.twister.pytest:
    platform_allow:
      - native_posix/native
      - native_sim/native
    harness: pytest
    harness_config:
      pytest_args: ["--custom-pytest-arg", "foo", "--cmdopt", "."]
    tags:
      - test_framework
      - pytest
    integration_platforms:
      - native_sim/native
```

## samples/subsys/testsuite/pytest/shell/testcase.yaml
```yaml
common:
  tags:
    - test_framework
    - pytest
    - shell
  platform_exclude: qemu_rx
  filter: CONFIG_SERIAL and not CONFIG_SMP and dt_chosen_enabled("zephyr,shell-uart")
  extra_configs:
    - arch:posix:CONFIG_UART_NATIVE_PTY_0_ON_STDINOUT=y
  min_ram: 40
tests:
  sample.pytest.shell:
    harness: pytest
    integration_platforms:
      - native_sim
      - qemu_cortex_m3
  sample.pytest.shell.vt100_colors_off:
    harness: pytest
    integration_platforms:
      - native_sim
      - qemu_cortex_m3
    extra_configs:
      - CONFIG_SHELL_VT100_COLORS=n
  sample.pytest.rtt:
    harness: pytest
    integration_platforms:
      - native_sim
    platform_exclude:
      - qemu_leon3/leon3
      - qemu_malta/qemu_malta/be
      - qemu_malta/qemu_malta
      - qemu_riscv32/qemu_virt_riscv32
      - qemu_riscv32e/qemu_virt_riscv32e
      - qemu_riscv64/qemu_virt_riscv64
      - qemu_x86/atom
      - qemu_arc/qemu_arc_em
      - qemu_arc/qemu_arc_hs/xip
      - qemu_arc/qemu_arc_hs
      - qemu_arc/qemu_arc_hs5x
      - qemu_arc/qemu_arc_hs6x
      - qemu_cortex_a53/qemu_cortex_a53
      - qemu_cortex_a9/xc7z007s
      - qemu_cortex_m3/ti_lm3s6965
      - qemu_cortex_r5/zynqmp_rpu
      - mps2/an385
      - mps2/an386
      - mps2/an521/cpu0
      - mps3/corstone300/an547
    extra_args:
      - EXTRA_CONF_FILE=overlay-rtt-shell.conf
  sample.harness.shell:
    harness: shell
    integration_platforms:
      - native_sim
      - qemu_cortex_m3
    harness_config:
      shell_commands: &kernel_commands
        - command: "kernel cycles"
          expected: "cycles: .* hw cycles"
        - command: "kernel version"
          expected: "Zephyr version .*"
        - command: "kernel sleep 100"
  sample.harness.shell.vt100_colors_off:
    harness: shell
    integration_platforms:
      - native_sim
      - qemu_cortex_m3
    extra_configs:
      - CONFIG_SHELL_VT100_COLORS=n
    harness_config:
      shell_commands: *kernel_commands
  sample.pytest.required_app_demo:
    integration_platforms:
      - native_sim
      - qemu_cortex_m3
    required_applications:
      - name: sample.pytest.shell
      - name: sample.harness.shell
    harness: pytest
    harness_config:
      pytest_root:
        - "pytest_shared_app/test_shared_app.py"
```

## samples/subsys/testsuite/pytest/testcase.yaml
```yaml
tests:
  sample.twister.pytest:
    platform_allow: native_posix
    harness: pytest
    harness_config:
      pytest_args: ["--custom-pytest-arg", "foo"]
    tags: testing pytest
    integration_platforms:
      - native_posix
```

## samples/subsys/testsuite/robotframework/shell/testcase.yaml
```yaml
tests:
  sample.robot.shell:
    filter: CONFIG_SERIAL and dt_chosen_enabled("zephyr,shell-uart")
    min_ram: 40
    harness: robotframework
    extra_configs:
      - arch:posix:CONFIG_NATIVE_UART_0_ON_STDINOUT=y
    integration_platforms:
      - native_posix
      - qemu_cortex_m3
    simulation_exclude:
      - renode
    tags:
      - test_framework
      - robot
      - shell
```

## samples/subsys/testsuite/shared_app/testcase.yaml
```yaml
common:
  filter: CONFIG_SERIAL and dt_chosen_enabled("zephyr,shell-uart")
  min_ram: 40
  extra_configs:
    - arch:posix:CONFIG_NATIVE_UART_0_ON_STDINOUT=y
  integration_platforms:
    - native_sim
tests:
  sample.shared.build_only:
    build_only: true
  sample.shared.with_own_image.pytest:
    required_images:
      - sample.shared.build_only
    harness: pytest
    harness_config:
      pytest_dut_scope: module
    tags: pytest shared
  sample.shared.no_own_image.pytest:
    no_own_image: true
    required_images:
      - sample.shared.with_own_image.pytest
      - sample.shared.build_only
    harness: pytest
    harness_config:
      pytest_dut_scope: module
    tags: pytest shared
  sample.shared.no_own_image.helloworld:
    no_own_image: true
    required_images:
      - sample.basic.helloworld
    harness: console
    harness_config:
      type: one_line
      regex:
        - "Hello World! (.*)"
    tags: shared
```

## samples/subsys/tracing/pipeline/Kconfig
```kconfig
# SPDX-FileCopyrightText: Copyright The Zephyr Project Contributors
# SPDX-License-Identifier: Apache-2.0

mainmenu "Tracing sensor pipeline sample"

choice
	prompt "Shared bus lock primitive"
	default SAMPLE_BUS_MUTEX
	help
	  Selects the primitive guarding the shared "bus" that the aggregator
	  and the storage thread contend for. Switch to the semaphore variant
	  to reproduce a priority inversion that is visible in the trace.

config SAMPLE_BUS_MUTEX
	bool "Mutex (priority inheritance, no inversion)"
	help
	  Guard the bus with a mutex. The high priority aggregator briefly
	  boosts the low priority storage thread, so it never waits long.

config SAMPLE_BUS_SEM
	bool "Semaphore (no inheritance, demonstrates priority inversion)"
	help
	  Guard the bus with a plain semaphore. With no priority inheritance a
	  medium priority consumer can run while the low priority storage
	  thread holds the bus, leaving the high priority aggregator blocked.

endchoice

source "Kconfig.zephyr"
```

## samples/subsys/tracing/sample.yaml
```yaml
common:
  tags:
    - tracing
    - debug
  harness: console
  harness_config:
    type: multi_line
    regex:
      - "thread_a: Hello World from (.*)!"
      - "thread_b: Hello World from (.*)!"
tests:
  sample.tracing.user:
    extra_args: CONF_FILE="prj_user.conf"
    integration_platforms:
      - qemu_x86
    platform_exclude:
      - mr_canhubk3
    harness_config:
      type: multi_line
      regex:
        - "thread_a: Hello World from (.*)!"
        - "thread_b: Hello World from (.*)!"
        - "sys_trace_.*_user.*"
  sample.tracing.format.sysview:
    platform_allow:
      - nrf52840dk/nrf52840
      - mimxrt1050_evk
      - mimxrt1064_evk
    integration_platforms:
      - nrf52840dk/nrf52840
    extra_args: SNIPPET="rtt-tracing"
  sample.tracing.osawareness.openocd:
    arch_exclude:
      - posix
      - xtensa
    platform_exclude: qemu_x86_64
    integration_platforms:
      - qemu_x86
  sample.tracing.transport.uart:
    platform_allow:
      - qemu_x86
      - qemu_x86_64
    integration_platforms:
      - qemu_x86
    extra_args: CONF_FILE="prj_uart.conf"
    filter: dt_chosen_enabled("zephyr,tracing-uart")
  sample.tracing.transport.usb:
    platform_allow: sam_e70_xplained/same70q21
    depends_on: usb_device
    extra_args: CONF_FILE="prj_usb.conf"
  sample.tracing.transport.uart.ctf:
    platform_allow:
      - qemu_x86
      - qemu_x86_64
    integration_platforms:
      - qemu_x86
    extra_args: CONF_FILE="prj_uart_ctf.conf"
    filter: dt_chosen_enabled("zephyr,tracing-uart")
  sample.tracing.transport.usb.ctf:
    platform_allow: sam_e70_xplained/same70q21
    depends_on: usb_device
    extra_args: CONF_FILE="prj_usb_ctf.conf"
  sample.tracing.transport.native:
    platform_allow:
      - native_sim
    integration_platforms:
      - native_sim
  sample.tracing.transport.native.ctf:
    platform_allow:
      - native_sim
    integration_platforms:
      - native_sim
    extra_args: CONF_FILE="prj_native_ctf.conf"
  sample.tracing.percepio:
    platform_allow: frdm_k64f
    extra_args: CONF_FILE="prj_percepio.conf"
    modules:
      - percepio
  sample.tracing.gpio:
    depends_on: gpio
    harness: ztest
    harness_config:
      fixture: gpio_loopback
    extra_args:
      - CONF_FILE="prj_gpio.conf"
      - EXTRA_DTC_OVERLAY_FILE="gpio.overlay"
    integration_platforms:
      - native_sim
```

## samples/subsys/usb/audio/headphones_microphone/sample.yaml
```yaml
sample:
  name: USB audio Headphones Microphone sample
tests:
  sample.usb.audio.headphones_microphone:
    depends_on: usb_device
    tags: usb
    arch_exclude: posix
    integration_platforms:
      - nrf52840dk/nrf52840
      - nrf5340dk/nrf5340/cpuapp
    harness: console
    harness_config:
      type: multi_line
      ordered: true
      regex:
        - "Entered main"
        - "Found USB Headphones Device"
        - "Found USB Microphone Device"
        - "USB enabled"
```

## samples/subsys/usb/audio/headset/sample.yaml
```yaml
sample:
  name: USB audio headset sample
tests:
  sample.usb.audio.headset:
    depends_on: usb_device
    tags: usb
    arch_exclude: posix
    integration_platforms:
      - nrf52840dk_nrf52840
      - nrf5340dk_nrf5340_cpuapp
    harness: console
    harness_config:
      type: multi_line
      ordered: true
      regex:
        - "Entered main"
        - "Found USB Headset Device"
        - "USB enabled"
```

## samples/subsys/usb/ccid/Kconfig
```kconfig
# SPDX-License-Identifier: Apache-2.0
source "samples/subsys/usb/common/Kconfig.sample_usbd"
source "Kconfig.zephyr"
```

## samples/subsys/usb/cdc_acm/Kconfig
```kconfig
# Copyright (c) 2019 Nordic Semiconductor ASA
# SPDX-License-Identifier: Apache-2.0

config USB_DEVICE_PID
	default USB_PID_CDC_ACM_SAMPLE

source "Kconfig.zephyr"
```

## samples/subsys/usb/cdc_acm/boards/native_posix_64.conf
```kconfig
CONFIG_LOG_BACKEND_UART=n
CONFIG_LOG_BACKEND_NATIVE_POSIX=y
CONFIG_LOG_MODE_IMMEDIATE=y

CONFIG_USB_DRIVER_LOG_LEVEL_INF=y
CONFIG_USB_DEVICE_LOG_LEVEL_INF=y

CONFIG_NETWORKING=y
CONFIG_NET_IPV4=y
CONFIG_NET_IPV6=n
CONFIG_NET_TCP=y
CONFIG_NET_SOCKETS=y
CONFIG_NET_SOCKETS_POSIX_NAMES=y

CONFIG_MAIN_STACK_SIZE=2048

# Network address config
CONFIG_NET_CONFIG_SETTINGS=y
CONFIG_NET_CONFIG_NEED_IPV4=y
CONFIG_NET_CONFIG_MY_IPV4_ADDR="192.0.2.1"
CONFIG_NET_CONFIG_PEER_IPV4_ADDR="192.0.2.2"

CONFIG_NET_PKT_RX_COUNT=32
CONFIG_NET_PKT_TX_COUNT=32
CONFIG_NET_BUF_RX_COUNT=96
CONFIG_NET_BUF_TX_COUNT=96

CONFIG_NET_LOG=y
CONFIG_NET_TCP_LOG_LEVEL_WRN=y
```

## samples/subsys/usb/cdc_acm/sample.yaml
```yaml
sample:
  name: CDC ACM USB
tests:
  sample.usb_device_next.cdc-acm:
    depends_on: usbd
    tags: usb
    integration_platforms:
      - nrf52840dk/nrf52840
      - nrf54h20dk/nrf54h20/cpuapp
      - frdm_k64f
      - stm32f723e_disco
      - nucleo_f413zh
      - mimxrt685_evk/mimxrt685s/cm33
      - mimxrt1060_evk/mimxrt1062/qspi
      - max32690evkit/max32690/m4
      - samd21_xpro
      - same54_xpro
    harness: console
    harness_config:
      type: one_line
      regex:
        - "Wait for DTR"
  sample.usb_device_next.cdc-acm-workqueue:
    depends_on: usbd
    tags: usb
    extra_args:
      - DCONFIG_USBD_CDC_ACM_WORKQUEUE=y
    integration_platforms:
      - frdm_k64f
    harness: console
    harness_config:
      type: one_line
      regex:
        - "Wait for DTR"
```

## samples/subsys/usb/cdc_acm_bridge/sample.yaml
```yaml
sample:
  name: CDC ACM USB bridge
tests:
  sample.usb.cdc-acm-bridge.arduino_serial:
    tags: usb
    build_only: true
    depends_on: usbd arduino_serial
  sample.usb.cdc-acm-bridge.two_devices:
    tags: usb
    build_only: true
    platform_allow:
      - rpi_pico
```

## samples/subsys/usb/cdc_acm_composite/sample.yaml
```yaml
sample:
  name: CDC ACM Composite USB
tests:
  sample.usb.cdc-acm-composite:
    depends_on: usb_device
    tags: usb
    arch_exclude: posix
    harness: console
    harness_config:
      type: one_line
      regex:
        - "Wait for DTR"
```

## samples/subsys/usb/cdc_acm_perf/sample.yaml
```yaml
sample:
  name: CDC ACM USB Performance
tests:
  sample.usb.cdc-acm-perf:
    depends_on: usb_device
    tags: usb
    arch_exclude: posix
    harness: console
    harness_config:
      type: one_line
      regex:
        - "Wait for DTR"
```

## samples/subsys/usb/common/Kconfig.sample_usbd
```kconfig
# Copyright (c) 2023 Nordic Semiconductor ASA
# SPDX-License-Identifier: Apache-2.0

# This file contains Kconfig options and defaults for configuring USB devices
# using the new experimental USB device support. The scope of these options is
# limited to USB samples in project tree, you cannot use them in your own
# application.

menu "USB sample options"
	depends on USB_DEVICE_STACK_NEXT

config SAMPLE_USBD_MANUFACTURER
	string "USB device sample manufacturer string"
	default "Zephyr Project"
	help
	  USB device sample manufacturer string.

config SAMPLE_USBD_PRODUCT
	string "USB device sample product string"
	default "USBD sample"
	help
	  USB device sample product stringa.

config SAMPLE_USBD_PID
	hex "USB device sample Product ID"
	default 0x0001
	help
	  USB device sample Product ID.

config SAMPLE_USBD_SELF_POWERED
	bool "USB device sample Self-powered attribute"
	default y
	help
	  Set the Self-powered attribute in the sample configuration.

config SAMPLE_USBD_REMOTE_WAKEUP
	bool "USB device sample Remote Wakeup attribute"
	help
	  Set the Remote Wakeup attribute in the sample configuration.

config SAMPLE_USBD_MAX_POWER
	int "USB device sample bMaxPower value"
	default 125
	range 0 250
	help
	  bMaxPower value in the sample configuration in 2 mA units.

config SAMPLE_USBD_20_EXTENSION_DESC
	bool "Use default USB 2.0 Extension Descriptor"
	help
	  Set bcdUSB value to 0201 and use default USB 2.0 Extension Descriptor.

endmenu
```

## samples/subsys/usb/console-next/sample.yaml
```yaml
sample:
  name: Console over CDC ACM serial
tests:
  sample.usbd.console:
    depends_on:
      - usbd
    tags: usb
    harness: console
    harness_config:
      fixture: fixture_usb_cdc
```

## samples/subsys/usb/console/Kconfig
```kconfig
#
# Copyright (c) 2019 Nordic Semiconductor ASA
#
# SPDX-License-Identifier: Apache-2.0
#

config USB_DEVICE_PID
	default USB_PID_CONSOLE_SAMPLE

source "Kconfig.zephyr"
```
