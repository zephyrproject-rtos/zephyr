/*
 * SPDX-FileCopyrightText: <text>Copyright (c) 2026 Infineon Technologies AG,
 * or an affiliate of Infineon Technologies AG. All rights reserved.</text>
 *
 * SPDX-License-Identifier: Apache-2.0
 */

&flash0 {
	partitions {
		#address-cells = <1>;
		#size-cells = <1>;
		compatible = "fixed-partitions";

		/* Set 3Kb of storage at the end of the of 2Mb flash 0 */
		storage_partition: partition@1ff400 {
			label = "storage";
			reg = <0x1ff400 DT_SIZE_K(3)>;
		};
	};
};
