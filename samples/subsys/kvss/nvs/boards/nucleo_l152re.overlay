/*
 * Copyright (c) 2022 STMicroelectronics
 *
 * SPDX-License-Identifier: Apache-2.0
 */

/delete-node/ &storage_partition;

&flash0 {
	partitions {
		/* Set 12KB of storage at the end of 128KB flash */
		storage_partition: partition@1d000 {
			label = "storage";
			reg = <0x0001d000 DT_SIZE_K(12)>;
		};
	};
};
