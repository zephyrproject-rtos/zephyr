/*
 * SPDX-FileCopyrightText: Copyright (c) 2026 Infineon Technologies AG,
 * SPDX-FileCopyrightText: or an affiliate of Infineon Technologies AG. All rights reserved.
 *
 * SPDX-License-Identifier: Apache-2.0
 */

&flash0 {
	partitions {
		compatible = "fixed-partitions";
		#address-cells = <1>;
		#size-cells = <1>;

		/* Set 3Kb of storage at the end of the of 1Mb flash 0 */
		storage_partition: partition@ff400 {
			reg = <0xff400 DT_SIZE_K(3)>;
			label = "storage";
		};
	};
};
