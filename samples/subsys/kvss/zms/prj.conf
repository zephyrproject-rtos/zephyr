## CMakeLists.txt
```
# SPDX-License-Identifier: Apache-2.0

cmake_minimum_required(VERSION 3.28.0)

find_package(Zephyr REQUIRED HINTS $ENV{ZEPHYR_BASE})
project(zms)


target_sources(app PRIVATE src/main.c)
target_include_directories(app PRIVATE ${ZEPHYR_BASE}/subsys/kvss/zms)
```

## Kconfig
```
# Copyright 2025 NXP
# SPDX-License-Identifier: Apache-2.0

mainmenu "ZMS sample configuration"

config MAX_ITERATIONS
	int "The number of iterations that the sample writes the all set of data."
	default 300
	range 1 300

config DELETE_ITERATION
	int "The number of iterations after the sample delete all set of data and verify that it has been deleted."
	default 10
	range 1 MAX_ITERATIONS

source "Kconfig.zephyr"
```

## prj.conf
```kconfig
CONFIG_FLASH=y
CONFIG_FLASH_MAP=y

CONFIG_ZMS=y
CONFIG_LOG=y
CONFIG_LOG_BLOCK_IN_THREAD=y
```

## boards/frdm_mcxn236.conf
```kconfig
# Copyright 2025 NXP
# SPDX-License-Identifier: Apache-2.0

CONFIG_ZMS_CUSTOMIZE_BLOCK_SIZE=y
CONFIG_ZMS_CUSTOM_BLOCK_SIZE=128
CONFIG_MAIN_STACK_SIZE=2048
```

## src/main.c
```c
/*
 * Copyright (c) 2024 BayLibre SAS
 *
 * SPDX-License-Identifier: Apache-2.0
 *
 * ZMS Sample for Zephyr using high level API.
 *
 */

#include <zephyr/kernel.h>
#include <zephyr/sys/reboot.h>
#include <zephyr/device.h>
#include <errno.h>
#include <inttypes.h>
#include <string.h>
#include <zephyr/drivers/flash.h>
#include <zephyr/storage/flash_map.h>
#include <zephyr/kvss/zms.h>

#define ZMS_PARTITION        storage_partition
#define ZMS_PARTITION_DEVICE PARTITION_DEVICE(ZMS_PARTITION)
#define ZMS_PARTITION_OFFSET PARTITION_OFFSET(ZMS_PARTITION)

#define IP_ADDRESS_ID 1
#define KEY_VALUE_ID  COND_CODE_1(CONFIG_ZMS_ID_64BIT, (0xbeefdead00000002ULL), (0xbeefdeadULL))
#define CNT_ID        2
#define LONG_DATA_ID  3
#define ITER_ARRAY_MAX_ENTRIES 32

struct iter_array_entry {
	zms_id_t id;
	size_t len;
};

static bool filter_out_id_2(zms_id_t id)
{
	return id != CNT_ID;
}

static int delete_and_verify_items(struct zms_fs *fs, zms_id_t id)
{
	int rc = 0;

	rc = zms_delete(fs, id);
	if (rc) {
		goto error1;
	}
	rc = zms_get_data_length(fs, id);
	if (rc > 0) {
		goto error2;
	}

	return 0;
error1:
	printk("Error while deleting item rc=%d\n", rc);
	return rc;
error2:
	printk("Error, Delete failed item should not be present\n");
	return -1;
}

static int delete_basic_items(struct zms_fs *fs)
{
	int rc = 0;

	rc = delete_and_verify_items(fs, IP_ADDRESS_ID);
	if (rc) {
		printk("Error while deleting item %x rc=%d\n", IP_ADDRESS_ID, rc);
		return rc;
	}
	rc = delete_and_verify_items(fs, KEY_VALUE_ID);
	if (rc) {
		printk("Error while deleting item %llx rc=%d\n", KEY_VALUE_ID, rc);
		return rc;
	}
	rc = delete_and_verify_items(fs, CNT_ID);
	if (rc) {
		printk("Error while deleting item %x rc=%d\n", CNT_ID, rc);
		return rc;
	}
	rc = delete_and_verify_items(fs, LONG_DATA_ID);
	if (rc) {
		printk("Error while deleting item %x rc=%d\n", LONG_DATA_ID, rc);
	}

	return rc;
}

static int get_history_depth(struct zms_fs *fs, zms_id_t id, uint32_t *depth)
{
	ssize_t len;
	uint32_t cnt = 0U;

	if (!depth) {
		return -EINVAL;
	}

	while (true) {
		len = zms_read_hist(fs, id, NULL, 0, cnt);
		if (len == -ENOENT) {
			break;
		}

		if (len < 0) {
			return (int)len;
		}

		cnt++;
	}

	*depth = cnt;

	return 0;
}

static int enumerate_live_entries(struct zms_fs *fs)
{
	int rc;
	uint32_t depth;
	zms_id_t id;
	size_t len;
	struct zms_iter iter;
	/* Buffer large enough to receive any data that ZMS stores inside the ATE.
	 * The iterator fills it directly for such entries, avoiding an extra read.
	 */
	uint8_t data[ZMS_DATA_IN_ATE_SIZE];

	/* fs->zms_lock is a plain struct k_mutex that zms_write()/zms_delete() take
	 * internally. Holding it here blocks writes from other threads for the
	 * whole traversal below, keeping the iterator's snapshot valid. This is
	 * safe against self-deadlock: k_mutex is recursive for its owning thread,
	 * and zms_iter_next() takes the same mutex internally on every call.
	 * It does not protect against a write issued by this same thread between
	 * zms_iter_next() calls; the caller must simply not do that.
	 */
	k_mutex_lock(&fs->zms_lock, K_FOREVER);

	rc = zms_iter_init(fs, &iter);
	if (rc) {
		printk("Iterator init failed, rc=%d\n", rc);
		goto end;
	}

	printk("Enumerating live entries with zms_iter_next:\n");
	while (true) {
		rc = zms_iter_next(fs, &iter, &id, &len, data, sizeof(data));
		if (rc == 0) {
			break;
		}

		if (rc < 0) {
			printk("Iterator step failed, rc=%d\n", rc);
			goto end;
		}

		rc = get_history_depth(fs, id, &depth);
		if (rc) {
			printk("History query failed for id=0x%" PRIx64 ", rc=%d\n", (uint64_t)id,
			      rc);
			goto end;
		}

		printk("  id=0x%" PRIx64 ", len=%zu, revisions=%" PRIu32, (uint64_t)id, len, depth);
		/* Data that fits inside the ATE has been copied into the buffer by
		 * the iterator, so it can be printed without a separate read.
		 */
		if ((len > 0) && (len <= sizeof(data))) {
			printk(", data=");
			for (size_t i = 0; i < len; i++) {
				printk("%02x", data[i]);
			}
		}
		printk("\n");
	}

	rc = 0;

end:
	k_mutex_unlock(&fs->zms_lock);
	return rc;
}

static int enumerate_live_entries_with_filters(struct zms_fs *fs, zms_id_t mask_id,
				       zms_id_t min_id, zms_id_t max_id)
{
	int rc;
	uint32_t depth;
	zms_id_t id;
	size_t len;
	struct zms_iter iter;
	struct zms_iter_config config = {
		.mask_id = mask_id,
		.min_id = min_id,
		.max_id = max_id,
		.use_mask = true,
		.use_range = true,
		.use_predicate = true,
		.predicate_func = filter_out_id_2,
	};

	/* See the fs->zms_lock note in enumerate_live_entries() above. */
	k_mutex_lock(&fs->zms_lock, K_FOREVER);

	rc = zms_iter_init_with_config(fs, &iter, &config);
	if (rc) {
		printk("Iterator init with filters failed, rc=%d\n", rc);
		goto end;
	}

	printk("Enumerating live entries with zms_iter_next, mask 0x%" PRIx64
	       ", range [0x%" PRIx64 ", 0x%" PRIx64 "], predicate: id != 0x%" PRIx64
	       "\n",
	       (uint64_t)mask_id, (uint64_t)min_id, (uint64_t)max_id,
	       (uint64_t)CNT_ID);
	while (true) {
		rc = zms_iter_next(fs, &iter, &id, &len, NULL, 0);
		if (rc == 0) {
			break;
		}

		if (rc < 0) {
			printk("Iterator step failed, rc=%d\n", rc);
			goto end;
		}

		rc = get_history_depth(fs, id, &depth);
		if (rc) {
			printk("History query failed for id=0x%" PRIx64 ", rc=%d\n", (uint64_t)id,
			      rc);
			goto end;
		}

		printk("  id=0x%" PRIx64 ", len=%zu, revisions=%" PRIu32 "\n", (uint64_t)id,
		       len, depth);
	}

	rc = 0;

end:
	k_mutex_unlock(&fs->zms_lock);
	return rc;
}

static int enumerate_all_ates(struct zms_fs *fs, zms_id_t mask_id,
			      zms_id_t min_id, zms_id_t max_id)
{
	int rc;
	zms_id_t id;
	size_t len;
	size_t i;
	size_t used_entries = 0U;
	size_t live_entries = 0U;
	struct zms_iter iter;
	static struct iter_array_entry entries[ITER_ARRAY_MAX_ENTRIES];
	struct zms_iter_config config = {
		.mask_id = mask_id,
		.min_id = min_id,
		.max_id = max_id,
		.use_mask = true,
		.use_range = true,
		.use_predicate = true,
		.predicate_func = filter_out_id_2,
	};

	/* See the fs->zms_lock note in enumerate_live_entries() above. Released
	 * as soon as the traversal is done, since the rest of this function only
	 * touches the local entries[] array, not fs.
	 */
	k_mutex_lock(&fs->zms_lock, K_FOREVER);

	rc = zms_iter_init_with_config(fs, &iter, &config);
	if (rc) {
		printk("All-ATE iterator init with filters failed, rc=%d\n", rc);
		goto end;
	}

	printk("Building array from zms_iter_next_all (mask 0x%" PRIx64
	       ", range [0x%" PRIx64 ", 0x%" PRIx64 "], predicate: id != 0x%" PRIx64
	       ")\n",
	       (uint64_t)mask_id, (uint64_t)min_id, (uint64_t)max_id,
	       (uint64_t)CNT_ID);

	while (true) {
		bool exists = false;

		rc = zms_iter_next_all(fs, &iter, &id, &len, NULL, 0);
		if (rc == 0) {
			break;
		}

		if (rc < 0) {
			printk("All-ATE iterator step failed, rc=%d\n", rc);
			goto end;
		}

		for (i = 0U; i < used_entries; i++) {
			if (entries[i].id == id) {
				exists = true;
				break;
			}
		}

		if (exists) {
			continue;
		}

		if (used_entries >= ARRAY_SIZE(entries)) {
			printk("Array dedupe storage full while processing id=0x%" PRIx64 "\n",
			       (uint64_t)id);
			rc = -ENOMEM;
			goto end;
		}

		entries[used_entries].id = id;
		entries[used_entries].len = len;
		used_entries++;

		printk("  kept id=0x%" PRIx64 " as %s\n", (uint64_t)id,
		       len == 0U ? "deleted" : "live");
	}

	rc = 0;

end:
	k_mutex_unlock(&fs->zms_lock);
	if (rc) {
		return rc;
	}

	/* Remove tombstones from the deduplicated array. */
	for (i = 0U; i < used_entries; i++) {
		if (entries[i].len == 0U) {
			continue;
		}

		entries[live_entries] = entries[i];
		live_entries++;
	}

	printk("Live IDs after tombstone removal (%zu entries):\n", live_entries);
	for (i = 0U; i < live_entries; i++) {
		printk("  id=0x%" PRIx64 "\n", (uint64_t)entries[i].id);
	}

	return 0;
}

int main(void)
{
	struct zms_fs fs = {0};
	int rc = 0;
	static char buf[16];
	static uint8_t key[8] = {0xDE, 0xAD, 0xBE, 0xEF, 0xDE, 0xAD, 0xBE, 0xEF};
	static uint8_t longarray[128];
	uint32_t i_cnt = 0U;
	uint32_t i;
	zms_id_t id = 0;
	ssize_t free_space = 0;
	struct flash_pages_info info;

	/* Initialize longarray with pattern */
	for (int n = 0; n < sizeof(longarray); n++) {
		longarray[n] = n;
	}

	/* define the zms file system by settings with:
	 *	sector_size equal to the pagesize,
	 *	3 sectors
	 *	starting at ZMS_PARTITION_OFFSET
	 */
	fs.flash_device = ZMS_PARTITION_DEVICE;
	if (!device_is_ready(fs.flash_device)) {
		printk("Storage device %s is not ready\n", fs.flash_device->name);
		return 0;
	}
	fs.offset = ZMS_PARTITION_OFFSET;
	rc = flash_get_page_info_by_offs(fs.flash_device, fs.offset, &info);
	if (rc) {
		printk("Unable to get page info, rc=%d\n", rc);
		return 0;
	}
	fs.sector_size = info.size;
	fs.sector_count = 3U;

	for (i = 0; i < CONFIG_MAX_ITERATIONS; i++) {
		rc = zms_mount(&fs);
		if (rc) {
			printk("Storage Init failed, rc=%d\n", rc);
			return 0;
		}

		printk("ITERATION: %u\n", i);
		/* IP_ADDRESS_ID is used to store an address, lets see if we can
		 * read it from flash, since we don't know the size read the
		 * maximum possible
		 */
		rc = zms_read(&fs, IP_ADDRESS_ID, &buf, sizeof(buf));
		if (rc > 0) {
			/* item was found, show it */
			buf[rc] = '\0';
			printk("ID: %u, IP Address: %s\n", IP_ADDRESS_ID, buf);
		}
		/* Rewriting ADDRESS IP even if we found it */
		strncpy(buf, "172.16.254.1", sizeof(buf) - 1);
		printk("Adding IP_ADDRESS %s at id %u\n", buf, IP_ADDRESS_ID);
		rc = zms_write(&fs, IP_ADDRESS_ID, &buf, strlen(buf));
		if (rc < 0) {
			printk("Error while writing Entry rc=%d\n", rc);
			break;
		}

		/* KEY_VALUE_ID is used to store a key/value pair , lets see if we can read
		 * it from storage.
		 */
		rc = zms_read(&fs, KEY_VALUE_ID, &key, sizeof(key));
		if (rc > 0) { /* item was found, show it */
			printk("Id: %llx, Key: ", KEY_VALUE_ID);
			for (uint8_t n = 0; n < 8; n++) {
				printk("%x ", key[n]);
			}
			printk("\n");
		}
		/* Rewriting KEY_VALUE even if we found it */
		printk("Adding key/value at id %llx\n", KEY_VALUE_ID);
		rc = zms_write(&fs, KEY_VALUE_ID, &key, sizeof(key));
		if (rc < 0) {
			printk("Error while writing Entry rc=%d\n", rc);
			break;
		}

		/* CNT_ID is used to store the loop counter, lets see
		 * if we can read it from storage
		 */
		rc = zms_read(&fs, CNT_ID, &i_cnt, sizeof(i_cnt));
		if (rc > 0) { /* item was found, show it */
			printk("Id: %d, loop_cnt: %u\n", CNT_ID, i_cnt);
			if ((i > 0) && (i_cnt != (i - 1))) {
				printk("Error loop_cnt %u must be %d\n", i_cnt, i - 1);
				break;
			}
		}
		printk("Adding counter at id %u\n", CNT_ID);
		rc = zms_write(&fs, CNT_ID, &i, sizeof(i));
		if (rc < 0) {
			printk("Error while writing Entry rc=%d\n", rc);
			break;
		}

		/* LONG_DATA_ID is used to store a larger dataset ,lets see if we can read
		 * it from flash
		 */
		rc = zms_read(&fs, LONG_DATA_ID, &longarray, sizeof(longarray));
		if (rc > 0) {
			/* item was found, show it */
			printk("Id: %d, Longarray: ", LONG_DATA_ID);
			for (uint16_t n = 0; n < sizeof(longarray); n++) {
				printk("%x ", longarray[n]);
			}
			printk("\n");
		}
		/* Rewrite the entry even if we found it */
		printk("Adding Longarray at id %d\n", LONG_DATA_ID);
		rc = zms_write(&fs, LONG_DATA_ID, &longarray, sizeof(longarray));
		if (rc < 0) {
			printk("Error while writing Entry rc=%d\n", rc);
			break;
		}

		/* Each CONFIG_DELETE_ITERATION delete all basic items */
		if (!(i % CONFIG_DELETE_ITERATION) && (i)) {
			rc = delete_basic_items(&fs);
			if (rc) {
				break;
			}
		}
	}

	if (i != CONFIG_MAX_ITERATIONS) {
		printk("Error: Something went wrong at iteration %u rc=%d\n", i, rc);
		return 0;
	}

	/* Application-style enumeration of all currently live entries. */
	rc = enumerate_live_entries(&fs);
	if (rc) {
		printk("Error while enumerating entries, rc=%d\n", rc);
		return 0;
	}

	/* Application-style enumeration with an ID mask and inclusive range. */
	rc = enumerate_live_entries_with_filters(&fs, (zms_id_t)0x03, (zms_id_t)0x01,
						 (zms_id_t)0x03);
	if (rc) {
		printk("Error while enumerating filtered entries, rc=%d\n", rc);
		return 0;
	}

	rc = enumerate_all_ates(&fs, (zms_id_t)0x03, (zms_id_t)0x01, (zms_id_t)0x03);
	if (rc) {
		printk("Error while enumerating all ATEs, rc=%d\n", rc);
		return 0;
	}

	while (1) {
		/* fill all storage */
		rc = zms_write(&fs, id, &id, sizeof(uint32_t));
		if (rc < 0) {
			break;
		}
		id++;
	}

	if (rc == -ENOSPC) {
		/* Calculate free space and verify that it is 0 */
		free_space = zms_calc_free_space(&fs);
		if (free_space < 0) {
			printk("Error while computing free space, rc=%d\n", free_space);
			return 0;
		}
		if (free_space > 0) {
			printk("Error: free_space should be 0, computed %u\n", free_space);
			return 0;
		}
		printk("Memory is full let's delete all items\n");

		/* Now delete all previously written items */
		for (uint64_t n = 0; n < id; n++) {
			rc = delete_and_verify_items(&fs, n);
			if (rc) {
				printk("Error deleting at id %llu\n", n);
				return 0;
			}
		}
		rc = delete_basic_items(&fs);
		if (rc) {
			printk("Error deleting basic items\n");
			return 0;
		}
	}

	/*
	 * Let's compute free space in storage. But before doing that let's Garbage collect
	 * all sectors where we deleted all entries and then compute the free space
	 */
	for (i = 0; i < fs.sector_count; i++) {
		rc = zms_sector_use_next(&fs);
		if (rc) {
			printk("Error while changing sector rc=%d\n", rc);
		}
	}
	free_space = zms_calc_free_space(&fs);
	if (free_space < 0) {
		printk("Error while computing free space, rc=%d\n", free_space);
		return 0;
	}
	printk("Free space in storage is %u bytes\n", free_space);

	/* Let's clean the storage now */
	rc = zms_clear(&fs);
	if (rc < 0) {
		printk("Error while cleaning the storage, rc=%d\n", rc);
	}

	printk("Sample code finished Successfully\n");

	return 0;
}
```
