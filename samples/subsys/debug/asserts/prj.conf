## CMakeLists.txt
```
# Copyright (c) 2026 Måns Ansgariusson <mansgariusson@gmail.com>
# SPDX-License-Identifier: Apache-2.0

cmake_minimum_required(VERSION 3.20.0)

find_package(Zephyr REQUIRED HINTS $ENV{ZEPHYR_BASE})
project(assert)

target_sources(app PRIVATE src/main.c)
```

## Kconfig
```
# Copyright (c) 2026 Måns Ansgariusson <mansgariusson@gmail.com>
# SPDX-License-Identifier: Apache-2.0

menu "Zephyr"
source "Kconfig.zephyr"
endmenu

# Generate CONFIG_ASSERT_MODULE_MYMODULE_LEVEL (a user-facing Off/On/Verbose
# choice plus the derived, non-assignable level) consumed by
# ZASSERT_MODULE(MYMODULE).
module = MYMODULE
module-str = the MYMODULE assert module
source "subsys/debug/zassert/Kconfig.template.assert"
```

## prj.conf
```kconfig
CONFIG_ASSERT=y
CONFIG_ASSERT_MODULE_MYMODULE_LEVEL_VERBOSE=y
```

## src/main.c
```c
/*
 * Copyright (c) 2026 Måns Ansgariusson <mansgariusson@gmail.com>
 *
 * SPDX-License-Identifier: Apache-2.0
 */

#include <zephyr/kernel.h>
#include <zephyr/sys/zassert.h>
#include <setjmp.h>

ZASSERT_MODULE(MYMODULE);

static jmp_buf assert_escape;

/*
 * Custom assert hook. The ZASSERT() failure path is marked unreachable, so the
 * hook must not return normally. Here it longjmp()s back to main() to let the
 * sample continue (and exit cleanly) after demonstrating a failing assertion.
 */
FUNC_NORETURN void zassert_post_action(const char *file, unsigned int line)
{
	printk("(assertion caught[%s:%d]; recovering)\n", file, line);
	longjmp(assert_escape, 1);
}

int main(void)
{
	printk("Granular assert sample\n");
	printk("MYMODULE assert level = %d\n", CONFIG_ASSERT_MODULE_MYMODULE_LEVEL);

	/*
	 * The MYMODULE module is raised, so ZASSERT() below is active.
	 */
	ZASSERT(1 == 1, "passing module assertion is a no-op");
	printk("Passed module ZASSERT(1 == 1)\n");

	printk("Triggering a failing module ZASSERT() ...\n");

	int x = 2;

	if (setjmp(assert_escape) == 0) {
		ZASSERT(x == 3, "x was %d, expected 3", x);
	}

	printk("Continued after the failing ZASSERT()\n");

	return 0;
}
```
