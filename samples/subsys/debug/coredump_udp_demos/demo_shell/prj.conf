## CMakeLists.txt
```
# SPDX-License-Identifier: Apache-2.0

cmake_minimum_required(VERSION 3.20.0)

find_package(Zephyr REQUIRED HINTS $ENV{ZEPHYR_BASE})
project(coredump_udp_demo_shell)

target_sources(app PRIVATE src/main.c)
```

## prj.conf
```kconfig
# SPDX-License-Identifier: Apache-2.0

CONFIG_SHELL=y
CONFIG_SHELL_STACK_SIZE=8192
CONFIG_SHELL_BACKEND_SERIAL=y
CONFIG_SHELL_REMOTE=n

# Network stack + logging/UDP coredump backend (defaults 192.0.2.x).
CONFIG_MAIN_STACK_SIZE=4096
CONFIG_SYSTEM_WORKQUEUE_STACK_SIZE=4096

CONFIG_NETWORKING=y
CONFIG_NET_IPV4=y
CONFIG_NET_IPV6=y
CONFIG_NET_UDP=y
CONFIG_NET_TCP=n
CONFIG_NET_SOCKETS=y
CONFIG_NET_CONNECTION_MANAGER=y
# zsock_socket()+zsock_bind() in the L4_CONNECTED callback need more mgmt stack
CONFIG_NET_MGMT_EVENT_STACK_SIZE=2048

CONFIG_ENTROPY_GENERATOR=y
CONFIG_TEST_RANDOM_GENERATOR=y

CONFIG_LOG=y
CONFIG_PRINTK=y

CONFIG_NET_PKT_RX_COUNT=16
CONFIG_NET_PKT_TX_COUNT=16
CONFIG_NET_BUF_RX_COUNT=64
CONFIG_NET_BUF_TX_COUNT=64
CONFIG_NET_CONTEXT_NET_PKT_POOL=y

CONFIG_NET_CONFIG_SETTINGS=y
CONFIG_NET_CONFIG_NEED_IPV4=y
CONFIG_NET_CONFIG_AUTO_INIT=y
CONFIG_NET_CONFIG_MY_IPV4_ADDR="192.0.2.1"
CONFIG_NET_CONFIG_PEER_IPV4_ADDR="192.0.2.2"

CONFIG_DEBUG_COREDUMP_LOGGING_UDP_HOST="192.0.2.2"

CONFIG_DEBUG_COREDUMP=y
CONFIG_DEBUG_COREDUMP_BACKEND_LOGGING_UDP=y
CONFIG_DEBUG_COREDUMP_MEMORY_DUMP_MIN=y
```

## boards/versalnet_apu.conf
```kconfig
# SPDX-License-Identifier: Apache-2.0

CONFIG_NET_CONFIG_MY_IPV4_ADDR="10.10.70.1"
CONFIG_NET_CONFIG_PEER_IPV4_ADDR="10.10.70.101"
CONFIG_DEBUG_COREDUMP_LOGGING_UDP_HOST="10.10.70.101"
CONFIG_COMPILER_WARNINGS_AS_ERRORS=n
```

## src/main.c
```c
/*
 * Copyright (c) 2026 Advanced Micro Devices, Inc.
 *
 * SPDX-License-Identifier: Apache-2.0
 *
 * Demo: stay running; user types shell command to trigger fault (good for repeatable UDP runs).
 */

#include <zephyr/kernel.h>
#include <zephyr/shell/shell.h>
#include <zephyr/sys/printk.h>
#include <zephyr/debug/coredump.h>

void k_sys_fatal_error_handler(unsigned int reason, const struct arch_esf *pEsf)
{
	ARG_UNUSED(pEsf);

	printk("%s is expected; reason = %u; halting ...\n", __func__, reason);
	k_fatal_halt(reason);
}

static int cmd_coredump_crash(const struct shell *sh, size_t argc, char **argv)
{
	ARG_UNUSED(argc);
	ARG_UNUSED(argv);

	shell_print(sh, "Triggering null deref for coredump (UDP + UART)...");
	uint32_t *p = NULL;

	*p = 0;
	return 0;
}

SHELL_CMD_REGISTER(coredump_crash, NULL, "Trigger coredump via fault", cmd_coredump_crash);

int main(void)
{
	printk("demo_shell: %s — open shell, run: coredump_crash\n", CONFIG_BOARD);
	return 0;
}
```
