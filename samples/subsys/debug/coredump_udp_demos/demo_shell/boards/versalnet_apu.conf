## samples/subsys/debug/coredump_udp_demos/demo_shell/boards/versalnet_apu.conf
```kconfig
# SPDX-License-Identifier: Apache-2.0

CONFIG_NET_CONFIG_MY_IPV4_ADDR="10.10.70.1"
CONFIG_NET_CONFIG_PEER_IPV4_ADDR="10.10.70.101"
CONFIG_DEBUG_COREDUMP_LOGGING_UDP_HOST="10.10.70.101"
CONFIG_COMPILER_WARNINGS_AS_ERRORS=n
```

## samples/subsys/debug/debugmon/sample.yaml
```yaml
sample:
  name: debug monitor sample
tests:
  sample.debug.debugmon:
    build_only: true
    platform_allow: reel_board/nrf52840
    tags: debug
```

## samples/subsys/debug/fuzz/Kconfig
```kconfig
# Copyright (c) 2017 Intel Corporation
# SPDX-License-Identifier: Apache-2.0

config ARCH_POSIX_FUZZ_IRQ
	int "OS interrupt via which to deliver fuzz cases"
	default 31
	help
	  In this sample, new fuzz cases are delivered to Zephyr
	  via interrupts.  The IRQ should be otherwise unused, but can
	  be any value desired by the app.

config ARCH_POSIX_FUZZ_TICKS
	int "Ticks to allow for fuzz case processing"
	default 2
	help
	  Fuzz interrupts are delivered, from the perspective of the
	  OS, at a steady cadence in simulated time.  In general most
	  apps won't require much time to reach an idle state
	  following a unit-test style case, so the default is short to
	  prevent interaction with regular timer workloads.

source "Kconfig.zephyr"
```

## samples/subsys/debug/fuzz/sample.yaml
```yaml
sample:
  description: native_posix-based libfuzzer example
  name: fuzz
tests:
  sample.debug.fuzz:
    toolchain_allow: llvm
    platform_allow: native_posix_64
    harness: console
    harness_config:
      type: one_line
      # The sample will run all the way to key 6 (to show off its
      # ability to search a 1-in-2^56 haystack), but that takes 20-60s
      # and is quite variable.  It's enough to know that it's finding
      # new code paths by the third new coverage announcement.
      regex:
        - "Found key 2"
```

## samples/subsys/debug/fuzz_mqtt/Kconfig
```kconfig
# Copyright (c) 2017 Intel Corporation
# SPDX-License-Identifier: Apache-2.0

config ARCH_POSIX_FUZZ_IRQ
	int "OS interrupt via which to deliver fuzz cases"
	default 31
	help
	  In this sample, new fuzz cases are delivered to Zephyr
	  via interrupts.  The IRQ should be otherwise unused, but can
	  be any value desired by the app.

config ARCH_POSIX_FUZZ_TICKS
	int "Ticks to allow for fuzz case processing"
	default 10
	help
	  Fuzz interrupts are delivered, from the perspective of the
	  OS, at a steady cadence in simulated time.  The default of 10
	  ticks gives enough simulated time for multi-step processing
	  (e.g. DISCONNECT triggering a transport disconnect callback,
	  CONNACK advancing the state machine, and payload draining) to
	  complete before the next fuzz case is delivered.

source "Kconfig.zephyr"
```

## samples/subsys/debug/gdbstub/sample.yaml
```yaml
#
# Copyright (c) 2020 intel Corporation.
#
# SPDX-License-Identifier: Apache-2.0
#

sample:
  name: gdbstub sample
tests:
  sample.debug.gdbstub:
    platform_allow: qemu_x86
    harness: pytest
    tags:
      - debug
      - gdbstub
```

## samples/subsys/debug/granular_assert/Kconfig
```kconfig
# Copyright (c) 2026 Måns Ansgariusson <mansgariusson@gmail.com>
# SPDX-License-Identifier: Apache-2.0

menu "Zephyr"
source "Kconfig.zephyr"
endmenu

# Generate CONFIG_MYGROUP_ZASSERT_LEVEL (a user-facing Off/On/Verbose
# choice plus the derived, non-assignable level) consumed by
# ZASSERT_GROUP(MYGROUP).
zassert-group = MYGROUP
zassert-group-str = the MYGROUP assert group
source "lib/os/zassert/Kconfig.template.zassert"
```

## samples/subsys/debug/granular_assert/sample.yaml
```yaml
sample:
  name: Granular per-file assertions
tests:
  sample.debug.granular_assert:
    platform_allow:
      - native_sim
    integration_platforms:
      - native_sim
    tags: debug assert
    harness: console
    harness_config:
      type: multi_line
      ordered: true
      regex:
        - "MYGROUP assert level        = 2"
        - "Passed group ZASSERT\\(1 == 1\\)"
        - "ASSERTION FAIL \\[x == 3\\]"
```

## samples/subsys/debug/sysview/sample.yaml
```yaml
sample:
  name: Systemview Demo
tests:
  test:
    filter: CONFIG_HAS_SEGGER_RTT
    tags: debug tracing
    min_ram: 18
    harness: console
    harness_config:
      type: one_line
      regex:
        - "RTT block address is.*"
```

## samples/subsys/dfu/delta/Kconfig
```kconfig
# Copyright (c) 2026 Clovis Corde
# SPDX-License-Identifier: Apache-2.0

mainmenu "Delta Firmware Update Sample"

source "Kconfig.zephyr"

config DELTA_SAMPLE_TARGET_MODE
	bool "Build as the target firmware for delta patch generation"
	help
	  When enabled, the application simply prints a message and
	  exits without applying any delta patch. This is used to
	  produce the target firmware binary needed by
	  generate_patch.py to compute the delta between the source
	  and target images.
```

## samples/subsys/disk/rwcheck/sample.yaml
```yaml
sample:
  name: Disk Access Speed Test
common:
  tags: diskaccess
tests:
  sample.subsys.disk.rwcheck:
    depends_on: sdhc
    harness: console
    harness_config:
      fixture: fixture_sdhc
```

## samples/subsys/display/cfb/Kconfig
```kconfig
# Copyright (c) 2024 TOKITA Hiroshi
# SPDX-License-Identifier: Apache-2.0

mainmenu "CFB Sample Application"

config CFB_SAMPLE_TRANSFER_BUFFER_SIZE
	int "Buffer size for image transfer"
	default 0
	help
	  Dynamically allocate display object if set 0 to this option,

source "Kconfig.zephyr"
```

## samples/subsys/display/cfb/boards/native_posix.conf
```kconfig
CONFIG_SDL_DISPLAY_DEV_NAME="DISPLAY"
CONFIG_SDL_DISPLAY_X_RES=250
CONFIG_SDL_DISPLAY_Y_RES=120
```

## samples/subsys/display/cfb/boards/native_sim_64.conf
```kconfig
CONFIG_STDOUT_CONSOLE=n
CONFIG_HEAP_MEM_POOL_SIZE=1244160
CONFIG_SDL_DISPLAY_DEFAULT_PIXEL_FORMAT_MONO01=y
```

## samples/subsys/display/cfb/sample.yaml
```yaml
common:
  harness: display
  tags: display
sample:
  description: Character framebuffer test
  name: cfb sample
tests:
  sample.display.cfb.ssd1306_arduino:
    platform_allow: frdm_k64f
    extra_args: SHIELD=ssd1306_128x64_arduino
    tags: shield
  sample.display.cfb.ssd1306_feather:
    platform_allow: adafruit_feather_m0_basic_proto
    extra_args: SHIELD=ssd1306_128x64_feather
    tags: shield
  sample.display.cfb.ssd16xx:
    platform_allow: reel_board
```

## samples/subsys/display/cfb_custom_font/Kconfig
```kconfig
# Copyright (c) 2024 TOKITA Hiroshi
# SPDX-License-Identifier: Apache-2.0

mainmenu "CFB Custom Font Sample Application"

config CFB_CUSTOM_FONT_SAMPLE_TRANSFER_BUFFER_SIZE
	int "Buffer size for image transfer"
	default 0

config CFB_CUSTOM_FONT_SAMPLE_COMMAND_BUFFER_SIZE
	int "Buffer size for store commands"
	default 0

source "Kconfig.zephyr"
```

## samples/subsys/display/cfb_custom_font/boards/longan_nano.conf
```kconfig
CONFIG_HEAP_MEM_POOL_SIZE=4096
CONFIG_CFB_SAMPLE_TRANSFER_BUFFER_SIZE=6400
CONFIG_CFB_SAMPLE_COMMAND_BUFFER_SIZE=128
```

## samples/subsys/display/cfb_custom_font/sample.yaml
```yaml
common:
  harness: display
  tags: display
sample:
  description: Compact Framebuffer subsystem font example
  name: CFB custom font sample
tests:
  sample.display.cfb_custom_font.ssd16xx:
    platform_allow: reel_board
```

## samples/subsys/display/cfb_shell/sample.yaml
```yaml
common:
  harness: display
  tags: display
sample:
  description: Character framebuffer shell test
  name: cfb shell sample
tests:
  sample.display.cfb_shell.ssd1306_arduino:
    platform_allow: frdm_k64f
    extra_args: SHIELD=ssd1306_128x32_arduino
    tags: shield
  sample.display.cfb_shell.ssd1306_feather:
    platform_allow:  adafruit_feather_m0_basic_proto
    extra_args: SHIELD=ssd1306_128x32_feather
    tags: shield
  sample.display.cfb_shell.ssd16xx:
    platform_allow: reel_board
```

## samples/subsys/display/color_palette/boards/native_sim.conf
```kconfig
# Copyright (c) 2026 Fabian Blatz <fabianblatz@gmail.com>
# SPDX-License-Identifier: Apache-2.0

CONFIG_DISPLAY_COLOR_PALETTE=y
CONFIG_DISPLAY_COLOR_PALETTE_MAX_SIZE=16
```

## samples/subsys/display/color_palette/boards/native_sim_64.conf
```kconfig
# Copyright (c) 2026 Fabian Blatz <fabianblatz@gmail.com>
# SPDX-License-Identifier: Apache-2.0

CONFIG_SDL_DISPLAY_DEFAULT_PIXEL_FORMAT_I_4=y
CONFIG_DISPLAY_COLOR_PALETTE=y
CONFIG_DISPLAY_COLOR_PALETTE_MAX_SIZE=16
```
