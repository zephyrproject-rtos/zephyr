## sample.yaml
```
sample:
  description: Non Deep Sleep Well Power Sequencing
  name: Non DSx
common:
    tags: introduction
```

## prj.conf
```kconfig
CONFIG_SYS_POWER_MANAGEMENT=y
CONFIG_X86_NON_DSX_POWER_SEQ=y
```

## src/main.c
```c
/*
 * Copyright (c) 2020 Intel Corporation.
 *
 * SPDX-License-Identifier: Apache-2.0
 */

#include <power/x86_non_dsx.h>

/* Application main Thread */
void main(void)
{
	int32_t t_time = 1000;

	pwrseq_thread((void *)&t_time, NULL, NULL);
}
```
