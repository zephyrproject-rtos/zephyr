## sample.yaml
```
sample:
  name: Low Power Timer Sample for nucleo board
tests:
  sample.power.pm.stm32_lptim.lsi:
    build_only: true
    depends_on: lptim
    filter: dt_compat_enabled_with_alias("gpio-leds", "led0") and
            dt_compat_enabled_with_alias("gpio-leds", "led1") and
            dt_compat_enabled("st,stm32-lptim")
  sample.power.pm.stm32_lptim.lse:
    build_only: true
    depends_on: lptim
    filter: dt_compat_enabled_with_alias("gpio-leds", "led0") and
            dt_compat_enabled_with_alias("gpio-leds", "led1") and
            dt_compat_enabled("st,stm32-lptim")
    extra_configs:
      - CONFIG_STM32_LPTIM_CLOCK_LSE=y
```

## prj.conf
```kconfig
CONFIG_TIMESLICING=n
CONFIG_DEBUG=y

CONFIG_SYS_POWER_MANAGEMENT=y
CONFIG_SYS_POWER_SLEEP_STATES=y
CONFIG_SYS_POWER_DEEP_SLEEP_STATES=n

CONFIG_SYS_PM_STATE_LOCK=y
CONFIG_SYS_PM_POLICY_RESIDENCY=y
CONFIG_SYS_PM_MIN_RESIDENCY_SLEEP_1=2
```

## src/main.c
```c
/*
 * Copyright (c) 2016 Intel Corporation.
 * Copyright (c) 2019 STMicroelectronics.
 *
 * SPDX-License-Identifier: Apache-2.0
 */

#include "sample.h"

struct device *gpio_bn, *gpio_led, *gpio_led2;

/* in msec */
#define WAIT_TIME 500
#define SLEEP_TIME 4001
/* setting to K_TICKS_FOREVER willl activate the deepsleep mode */

#define DEMO_DESCRIPTION	\
	"Demo Description\n"	\
	"Application is demonstrating the LPTIMER used as systick.\n"\
	"The system goes to sleep mode on k_sleep() and wakes-up\n" \
	"(red led on) by the lptim timeout expiration\n" \
	"or when pressing the user push button (WUP2 is PC13)\n\n"

static struct gpio_callback gpio_cb;

void button_pressed(struct device *gpiob, struct gpio_callback *cb,
		    uint32_t pins)
{
		/* Set pin to HIGH/LOW */
		gpio_pin_set(gpio_led, PIN0, 1);

		k_busy_wait(10000);
}

/* Application main Thread */
void main(void)
{
	printk("\n\n*** LPTIM Management Demo on %s ***\n", CONFIG_BOARD);
	printk(DEMO_DESCRIPTION);

	gpio_bn = device_get_binding(SW);

	if (IS_ENABLED(CONFIG_SYS_POWER_MANAGEMENT)) {
	/* Configure Button 1 to wakeup from sleep mode */
		gpio_pin_configure(gpio_bn, PIN,
				SW0_FLAGS | GPIO_INPUT);
		gpio_pin_interrupt_configure(gpio_bn,
					   PIN,
					   GPIO_INT_EDGE_TO_ACTIVE);
		gpio_init_callback(&gpio_cb, button_pressed, BIT(PIN));
		gpio_add_callback(gpio_bn, &gpio_cb);

	}
	/* Configure LEDs */
	gpio_led = device_get_binding(LED0);
	if (gpio_led == NULL) {
		return;
	}

	if (gpio_pin_configure(gpio_led, PIN0,
			GPIO_OUTPUT_ACTIVE | LED0_FLAGS) < 0) {
		return;
	}

	/*
	 * Start the demo.
	 */

	while (1) {

		gpio_pin_set(gpio_led, PIN0, 0);

		k_msleep(SLEEP_TIME);
	}
}
```

## src/sample.h
```c
/*
 * Copyright (c) 2018 Intel Corporation.
 * Copyright (c) 2019 STMicroelectronics.
 *
 * SPDX-License-Identifier: Apache-2.0
 */

#include <zephyr.h>

#include <string.h>
#include <soc.h>
#include <device.h>
#include <drivers/gpio.h>
#include <sys/printk.h>

/* The devicetree node identifier for the "sw0" alias. */
#define SW0_NODE DT_ALIAS(sw0)
/* GPIO for the User push button */
#if DT_NODE_HAS_STATUS(SW0_NODE, okay)
#define SW	DT_GPIO_LABEL(SW0_NODE, gpios)
#define PIN	DT_GPIO_PIN(SW0_NODE, gpios)
#if DT_PHA_HAS_CELL(SW0_NODE, gpios, flags)
#define SW0_FLAGS DT_GPIO_FLAGS(SW0_NODE, gpios)
#else
#define SW0_FLAGS 0
#endif
#else
/* A build error here means your board isn't set up to input a button. */
#error "Unsupported board: sw0 devicetree alias is not defined"
#define SW	""
#define PIN	0
#endif

/* The devicetree node identifier for the "led0" alias. */
#define LED0_NODE DT_ALIAS(led0)
/* GPIO for the Led */
#if DT_NODE_HAS_STATUS(LED0_NODE, okay)
#define LED0	DT_GPIO_LABEL(LED0_NODE, gpios)
#define PIN0	DT_GPIO_PIN(LED0_NODE, gpios)
#if DT_PHA_HAS_CELL(LED0_NODE, gpios, flags)
#define LED0_FLAGS DT_GPIO_FLAGS(LED0_NODE, gpios)
#else
#define LED0_FLAGS 0
#endif
#else
/* A build error here means your board isn't set up to blink an LED. */
#error "Unsupported board: led0 devicetree alias is not defined"
#define LED0	""
#define PIN0	0
#endif

#define LOW		0
#define HIGH		1
#define LED_ON		HIGH
#define LED_OFF		LOW
```
