## CMakeLists.txt
```
# SPDX-License-Identifier: Apache-2.0

cmake_minimum_required(VERSION 3.13.1)
include($ENV{ZEPHYR_BASE}/cmake/app/boilerplate.cmake NO_POLICY_SCOPE)
project(stm32_lptim)

FILE(GLOB app_sources src/*.c)
target_sources(app PRIVATE ${app_sources})
```

## sample.yaml
```
sample:
  name: Low Power Timer Sample for nucleo board
tests:
  sample.power.pm.stm32_lptim.lsi:
    platform_whitelist: nucleo_l4r5zi
    build_only: true
    tags: lptim
  sample.power.pm.stm32_lptim.lse:
    platform_whitelist: nucleo_l4r5zi
    build_only: true
    tags: lptim
    extra_configs:
      - CONFIG_STM32_LPTIM_CLOCK_LSE=y
```

## prj.conf
```kconfig
CONFIG_TIMESLICING=n
CONFIG_DEBUG=y

CONFIG_STM32_LPTIM_TIMER=y

# CONFIG_STM32_LPTIM_CLOCK_LSE=y
```

## src/main.c
```c
/*
 * Copyright (c) 2016 Intel Corporation.
 * Copyright (c) 2019 STMicroelectronics.
 *
 * SPDX-License-Identifier: Apache-2.0
 */

#include "sample.h"

struct device *gpio_port, *gpio_port0;

/* 1000 msec = 1 sec */
#define WAIT_TIME 500
#define SLEEP_TIME 2001
/* measurement gives TIME VALUE +- 0.1ms */

#define DEMO_DESCRIPTION	\
	"Demo Description\n"	\
	"Application is demonstrating the LPTIMER use as systick.\n"	\
	"The led ON duration is increased by 500ms\n"	\
	"and the total elapsed time is displayed\n"	\
	"when pressing the user push button\n\n"

static struct gpio_callback gpio_cb;
static u32_t timeout = WAIT_TIME;
static s64_t last_time;

void button_pressed(struct device *gpiob, struct gpio_callback *cb,
		    u32_t pins)
{
		LL_PWR_ClearFlag_WU();
		timeout = timeout + WAIT_TIME;

		printk(" time = %d s with delta = %d s   \r",
		 (u32_t)last_time/1000, k_uptime_delta_32(&last_time)/1000);
		last_time = k_uptime_get_32();
}

/* Application main Thread */
void main(void)
{

	printk("\n\n*** LPTIM Management Demo on %s ***\n", CONFIG_BOARD);
	printk(DEMO_DESCRIPTION);

	gpio_port = device_get_binding(PORT);

	/* Configure Button 1 to increase timmeout value (no Pull up on PA0) */
	gpio_pin_configure(gpio_port, SW,
				GPIO_DIR_IN | GPIO_INT |
				GPIO_INT_EDGE | GPIO_INT_ACTIVE_LOW);

	gpio_init_callback(&gpio_cb, button_pressed, BIT(SW));

	gpio_add_callback(gpio_port, &gpio_cb);
	gpio_pin_enable_callback(gpio_port, SW);

	/* Configure LEDs */
	gpio_port0 = device_get_binding(PORT0);
	gpio_pin_configure(gpio_port0, LED0, GPIO_DIR_OUT);
	gpio_pin_write(gpio_port0, LED0, LED_OFF);

	/*
	 * Start the demo.
	 */
	last_time = k_uptime_get_32();

	while (1) {
		/* Set pin to HIGH/LOW */
		gpio_pin_write(gpio_port0, LED0, LED_ON);

		k_sleep(timeout);

		gpio_pin_write(gpio_port0, LED0, LED_OFF);

		k_sleep(SLEEP_TIME);
	}
}
```

## src/sample.h
```c
/*
 * Copyright (c) 2018 Intel Corporation.
 * Copyright (c) 2019 STMicroelectronics.
 *
 * SPDX-License-Identifier: Apache-2.0
 */

#include <zephyr.h>

#include <string.h>
#include <soc.h>
#include <device.h>
#include <drivers/gpio.h>
#include <sys/printk.h>

/* GPIO for the User push button */
#define PORT		DT_ALIAS_SW0_GPIOS_CONTROLLER
#define SW		DT_ALIAS_SW0_GPIOS_PIN
/* GPIO for the Led */
#define PORT0		DT_ALIAS_LED0_GPIOS_CONTROLLER
#define LED0		DT_ALIAS_LED0_GPIOS_PIN

#define LOW		0
#define HIGH		1
#define LED_ON		HIGH
#define LED_OFF		LOW
```
