## CMakeLists.txt
```
cmake_minimum_required(VERSION 3.13.1)
include($ENV{ZEPHYR_BASE}/cmake/app/boilerplate.cmake NO_POLICY_SCOPE)
project(power_mgr)

FILE(GLOB app_sources src/*.c)
target_sources(app PRIVATE ${app_sources})
```

## sample.yaml
```
sample:
  name: OS managed Power Management Sample
tests:
  ospm.low_power_state:
    platform_whitelist: nrf52840_pca10056 nrf52_pca10040
    tags: power
    harness: console
    harness_config:
      regex:
        - "OS managed Power Management Test completed"
```

## prj.conf
```kconfig
CONFIG_SYS_POWER_MANAGEMENT=y
CONFIG_SYS_POWER_LOW_POWER_STATE=y
CONFIG_SYS_POWER_DEEP_SLEEP=y
CONFIG_DEVICE_POWER_MANAGEMENT=y
CONFIG_PM_CONTROL_OS_DEBUG=y
CONFIG_PM_CONTROL_STATE_LOCK=y

CONFIG_PM_CONTROL_OS=y
CONFIG_PM_POLICY_RESIDENCY=y
CONFIG_LOG=y
CONFIG_PM_LOG_LEVEL_DBG=y
CONFIG_PM_LPS_MIN_RES=5
CONFIG_PM_LPS_1_MIN_RES=10
CONFIG_PM_DEEP_SLEEP_MIN_RES=60
```

## prj_tickless.conf
```kconfig
CONFIG_NUM_COOP_PRIORITIES=29
CONFIG_NUM_PREEMPT_PRIORITIES=40
CONFIG_SYS_POWER_MANAGEMENT=y
CONFIG_SYS_POWER_LOW_POWER_STATE=y
CONFIG_SYS_POWER_DEEP_SLEEP=y
CONFIG_DEVICE_POWER_MANAGEMENT=y
CONFIG_TICKLESS_KERNEL=y

CONFIG_PM_CONTROL_OS=y
CONFIG_PM_POLICY_RESIDENCY=y
CONFIG_PM_LPS_MIN_RES=5
CONFIG_PM_LPS_1_MIN_RES=10
CONFIG_PM_DEEP_SLEEP_MIN_RES=60
```

## src/main.c
```c
/*
 * Copyright (c) 2016 Intel Corporation.
 *
 * SPDX-License-Identifier: Apache-2.0
 */

#include <zephyr.h>
#include <power.h>
#include <soc_power.h>
#include <misc/printk.h>
#include <string.h>
#include <device.h>
#include <gpio.h>

#define SECONDS_TO_SLEEP	1

#define BUSY_WAIT_DELAY_US		(10 * 1000000)

#define LPS_STATE_ENTER_TO		((CONFIG_PM_LPS_MIN_RES + 1) * 1000)
#define LPS1_STATE_ENTER_TO		((CONFIG_PM_LPS_1_MIN_RES + 1) * 1000)

#define DEMO_DESCRIPTION	\
	"Demo Description\n"	\
	"Application creates Idleness, Due to which System Idle Thread is\n"\
	"scheduled and it enters into various Low Power States.\n"\

void sys_pm_notify_lps_entry(enum power_states state)
{
	printk("Entering Low Power state (%d)\n", state);
}

void sys_pm_notify_lps_exit(enum power_states state)
{
	printk("Exiting Low Power state (%d)\n", state);
}

/* Application main Thread */
void main(void)
{
	printk("\n\n***OS Power Management Demo on %s****\n", CONFIG_ARCH);
	printk(DEMO_DESCRIPTION);

	for (int i = 1; i <= 4; i++) {
		printk("\n<-- App doing busy wait for 10 Sec -->\n");
		k_busy_wait(BUSY_WAIT_DELAY_US);

		/* Create Idleness to make Idle thread run */
		if ((i % 2) == 0) {
			printk("\n<-- App going to sleep for %d msec -->\n",
							LPS1_STATE_ENTER_TO);
			k_sleep(LPS1_STATE_ENTER_TO);
		} else {
			printk("\n<-- App going to sleep for %d msec -->\n",
							LPS_STATE_ENTER_TO);
			k_sleep(LPS_STATE_ENTER_TO);
		}
	}

	sys_pm_dump_debug_info();
	sys_pm_ctrl_disable_state(SYS_PM_LOW_POWER_STATE);

	k_sleep(LPS1_STATE_ENTER_TO);

	/* Debug counts should remain same */
	sys_pm_dump_debug_info();
	sys_pm_ctrl_enable_state(SYS_PM_LOW_POWER_STATE);

	k_sleep(LPS1_STATE_ENTER_TO);

	/* Debug counts should have increased */
	sys_pm_dump_debug_info();

	printk("OS managed Power Management Test completed\n");
}
```
