## CMakeLists.txt
```
# SPDX-License-Identifier: Apache-2.0

cmake_minimum_required(VERSION 3.20.0)

find_package(Zephyr REQUIRED HINTS $ENV{ZEPHYR_BASE})
project(J1939)

target_sources(app PRIVATE src/main.c)
```

## Kconfig
```
# Private config options to the J1939 sample

# Copyright (c) 2026 Deere & Company
# SPDX-License-Identifier: Apache-2.0

mainmenu "J1939 sample"

source "Kconfig.zephyr"
```

## sample.yaml
```
sample:
  name: J1939 sample
tests:
  sample.subsys.canbus.j1939:
    tags:
      - can
      - j1939
    depends_on: can
    filter: dt_chosen_enabled("zephyr,canbus")
    harness: console
    harness_config:
      type: one_line
      regex:
        - "(.*)Got 247 bytes in total"
```

## prj.conf
```kconfig
CONFIG_LOG=y

CONFIG_POLL=y

CONFIG_CAN=y

CONFIG_J1939=y

CONFIG_J1939_MAX_NODES_IN_SYSTEM=10
CONFIG_J1939_TRANSPORT_PROTOCOL=y


CONFIG_NO_OPTIMIZATIONS=y
```

## boards/native_sim.overlay
```dts
/*
 * Copyright (c) 2026 Deere & Company
 * SPDX-License-Identifier: Apache-2.0
 */

/ {
	chosen {
		zephyr,canbus = &can0;
	};
};

&can0 {
	status = "okay";
	/* adjust zcan0 to desired host interface or create an alternative
	 * name, e.g.: sudo ip link property add dev vcan0 altname zcan0
	 */
	host-interface = "vcan0";
};
```

## src/main.c
```c
/*
 * Copyright (c) 2026 Deere & Company
 * SPDX-License-Identifier: Apache-2.0
 */

#include <stdio.h>

#include <zephyr/kernel.h>
#include <zephyr/sys/printk.h>
#include <zephyr/device.h>

#include <stdio.h>
#include <string.h>
#include <zephyr/canbus/j1939.h>
#include <zephyr/sys/iterable_sections.h>

#define SLEEP_TIME K_MSEC(1000)

const struct device *const can_dev = DEVICE_DT_GET(DT_CHOSEN(zephyr_canbus));

J1939_NODE_DEFINE(diag_node, /* Name */
			can_dev, /* CAN device */
			0x11, /* Default Source address */
			1234, /* ID number */
			1, /* Manufacturer code */
			1, /* ECU instance */
			1, /* Function instance */
			1, /* Function */
			1, /* Vehicle system */
			1, /* Vehicle system instance */
			1, /* Industry group */
			false /* Arbitrary address capable */
		);

J1939_NODE_DEFINE(data_node, /* Name */
			can_dev, /* CAN device */
			0x12, /* Default Source address */
			1235, /* ID number */
			1, /* Manufacturer code */
			1, /* ECU instance */
			1, /* Function instance */
			1, /* Function */
			1, /* Vehicle system */
			1, /* Vehicle system instance */
			1, /* Industry group */
			false /* Arbitrary address capable */
		);

/** Serial number of the device */
char hardware_serial_number[] = "12345";

/** Hardware revision of the device */
char hardware_revision[] = "1.0";

/** Part number of the device */
char hardware_part_number[] = "ABC123";

void j1939_app_get_device_info(j1939_device_info_t *device_info)
{
	*device_info = (j1939_device_info_t){
		.hardware_serial_number = hardware_serial_number,
		.hardware_revision = hardware_revision,
		.hardware_part_number = hardware_part_number,
	};
}

char *my_stpcpy(char *dest, const char *src)
{
	while ((*dest = *src)) {
		dest++;
		src++;
	}
	return dest;
}

void j1939_get_software_id(uint8_t **software_id_ptr)
{
	/* SW: Software assembly 0001 */
	*software_id_ptr = my_stpcpy(*software_id_ptr, "SW0001");
	*software_id_ptr = my_stpcpy(*software_id_ptr, ",");
	*software_id_ptr = my_stpcpy(*software_id_ptr, "ABC123");
	*software_id_ptr = my_stpcpy(*software_id_ptr, ",");
	*software_id_ptr = my_stpcpy(*software_id_ptr, "1.0");
	*software_id_ptr = my_stpcpy(*software_id_ptr, "#");
	/* AP: Application 0101 (Application SW) */
	*software_id_ptr = my_stpcpy(*software_id_ptr, "AP0101");
	*software_id_ptr = my_stpcpy(*software_id_ptr, ",");
	/* TODO: Get software part number */
	*software_id_ptr = my_stpcpy(*software_id_ptr, "MyApp");
	*software_id_ptr = my_stpcpy(*software_id_ptr, ",");
	/* TODO: Get software version number */
	*software_id_ptr = my_stpcpy(*software_id_ptr, "1.0.0");
	*software_id_ptr = my_stpcpy(*software_id_ptr, "#");
	/* AC: Application Config 0101 (Application SW Details) */
	*software_id_ptr = my_stpcpy(*software_id_ptr, "AC0101");
	*software_id_ptr = my_stpcpy(*software_id_ptr, ",");
	*software_id_ptr = my_stpcpy(*software_id_ptr, __DATE__);
	*software_id_ptr = my_stpcpy(*software_id_ptr, ",");
	*software_id_ptr = my_stpcpy(*software_id_ptr, "1.0.0");
	*software_id_ptr = my_stpcpy(*software_id_ptr, "#");
	/* '*' at the end of the entire set of s/w assembly */
	*software_id_ptr = my_stpcpy(*software_id_ptr, "*");
}

int main(void)
{
	int ret;
	int j1939_nodes_count;

	STRUCT_SECTION_COUNT(j1939_node_cfg, &j1939_nodes_count);
	printf("Number of nodes: %d\n", j1939_nodes_count);

	if (!device_is_ready(can_dev)) {
		printf("CAN: Device %s not ready.\n", can_dev->name);
		return 0;
	}

	can_mode_t mode = (IS_ENABLED(CONFIG_SAMPLE_LOOPBACK_MODE) ? CAN_MODE_LOOPBACK : 0);

	ret = can_set_mode(can_dev, mode);
	if (ret != 0) {
		printk("CAN: Failed to set mode [%d]", ret);
		return 0;
	}

	ret = can_start(can_dev);
	if (ret != 0) {
		printf("Error starting CAN controller [%d]", ret);
		return ret;
	}

	ret = j1939_init();
	if (ret != 0) {
		printf("Error starting J1939 [%d]", ret);
		return ret;
	}

	(void)j1939_register_request_pgn(J1939_SOFTWARE_ID_PGN, &diag_node);
	(void)j1939_register_request_pgn(J1939_ECU_ID_INFO_PGN, &diag_node);

	printf("Finished init.\n");

	uint8_t data[8] = {0x01, 0x02, 0x03, 0x04, 0x05, 0x06, 0x07, 0x08};

	while (1) {
		/* node will automatically address claim */


		/* TODO - looks like this is sending before address claim is complete
		 * Need to implement a method to prevent sending from an unclaimed address
		 */
		j1939_transmit_pgn(
			J1939_Priority_6,
			0x1200,
			0x34,
			data,
			8,
			&diag_node);

		k_sleep(SLEEP_TIME);
	}
}
```
