/*
 * Copyright (c) 2025 Dmitrii Sharshakov <d3dx12.xx@gmail.com>
 *
 * SPDX-License-Identifier: Apache-2.0
 */

/ {
	chosen {
		zephyr,canbus = &can0;
	};
};

&can0 {
	status = "okay";
};

&uart1 {
	status = "okay";
};
