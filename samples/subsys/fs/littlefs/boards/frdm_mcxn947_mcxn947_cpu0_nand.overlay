/*
 * Copyright 2026 NXP
 *
 * SPDX-License-Identifier: Apache-2.0
 */

&ext_flash_ctrl {
	status = "disabled";
};

&mx35lf1ge4ab {
	status = "okay";
};

/ {
	ftl_nand: ftl_nand {
		compatible = "zephyr,ftl-dhara";
		partition = <&nand_storage>;
		disk-name = "NAND";
		buffer-size = <2048>;
	};
};
