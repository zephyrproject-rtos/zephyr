## samples/subsys/fs/littlefs/boards/nucleo_h743zi_qspi.conf
```kconfig
#
# Copyright (c) 2021 Lukasz Majewski, DENX Software Engineering GmbH
#
# SPDX-License-Identifier: Apache-2.0
#

CONFIG_COMMON_LIBC_MALLOC_ARENA_SIZE=8192

# Littlefs configuration to utilize QSPI operation
CONFIG_FS_LITTLEFS_FC_HEAP_SIZE=8192

CONFIG_NOCACHE_MEMORY=y
```

## samples/subsys/fs/littlefs/boards/nucleo_h7a3zi_q.conf
```kconfig
#
# Copyright (c) 2022 Christoph Heller
#
# SPDX-License-Identifier: Apache-2.0
#

# Set MPU to allow write accesses to flash memory.
# This is required by the flash driver to be able
# to write to the internal flash.
CONFIG_MPU_ALLOW_FLASH_WRITE=y
```

## samples/subsys/fs/littlefs/boards/particle_xenon.conf
```kconfig
#
# Copyright (c) 2019 Peter Bigot Consulting, LLC
#
# SPDX-License-Identifier: Apache-2.0
#
CONFIG_SPI=y
CONFIG_SPI_NOR=y
CONFIG_SPI_NOR_FLASH_LAYOUT_PAGE_SIZE=4096
```

## samples/subsys/fs/littlefs/boards/rak5010_nrf52840.conf
```kconfig
#
# Copyright (c) 2024 Linumiz
# SPDX-License-Identifier: Apache-2.0
#

# Need this when storage is on flash
CONFIG_MPU_ALLOW_FLASH_WRITE=y

CONFIG_NORDIC_QSPI_NOR=y
CONFIG_NORDIC_QSPI_NOR_FLASH_LAYOUT_PAGE_SIZE=4096
```

## samples/subsys/fs/littlefs/boards/rcar_h3ulcb_r8a77951_a57.conf
```kconfig
#
# Copyright (c) 2023 EPAM Systems
#
# SPDX-License-Identifier: Apache-2.0
#
CONFIG_MAIN_STACK_SIZE=4096
CONFIG_COMMON_LIBC_MALLOC_ARENA_SIZE=8192
CONFIG_FS_LITTLEFS_FC_HEAP_SIZE=8192

CONFIG_DISK_ACCESS=y
CONFIG_DISK_DRIVERS=y
CONFIG_DISK_DRIVER_MMC=y

CONFIG_FS_LITTLEFS_BLK_DEV=y
CONFIG_APP_LITTLEFS_STORAGE_BLK_SDMMC=y

CONFIG_FS_LITTLEFS_FMP_DEV=n
```

## samples/subsys/fs/littlefs/boards/rcar_salvator_xs_blk.conf
```kconfig
#
# Copyright (c) 2023 EPAM Systems
#
# SPDX-License-Identifier: Apache-2.0
#
CONFIG_COMMON_LIBC_MALLOC_ARENA_SIZE=8192
CONFIG_FS_LITTLEFS_FC_HEAP_SIZE=8192

CONFIG_DISK_DRIVER_SDMMC=n
```

## samples/subsys/fs/littlefs/boards/stm32h747i_disco_stm32h747xx_m7.conf
```kconfig
# SPDX-FileCopyrightText: Copyright The Zephyr Project Contributors
# SPDX-License-Identifier: Apache-2.0

CONFIG_FS_LITTLEFS_FC_HEAP_SIZE=2048
CONFIG_MAIN_STACK_SIZE=2048
```

## samples/subsys/fs/littlefs/sample.yaml
```yaml
sample:
  name: littlefs filesystem sample
common:
  tags:
    - filesystem
    - littefs
tests:
  sample.filesystem.littlefs:
    build_only: true
    platform_allow:
      - nrf52840dk/nrf52840
      - particle_xenon
      - disco_l475_iot1
      - mimxrt685_evk/mimxrt685s/cm33
      - mimxrt1060_evk
      - mimxrt1064_evk
      - qemu_x86
      - native_sim
      - mimxrt1160_evk/mimxrt1166/cm7
      - lpcxpresso55s69/lpc55s69/cpu0
      - mr_canhubk3
      - stm32f429i_disc1
      - stm32f746g_disco
      - stm32h747i_disco/stm32h747xx/m7
      - stm32h750b_dk
      - nrf54l15dk/nrf54l15/cpuapp
      - nrf54l15pdk/nrf54l15/cpuapp
      - frdm_ke17z
      - frdm_ke17z512
    integration_platforms:
      - nrf52840dk/nrf52840
  sample.filesystem.littlefs.blk:
    build_only: true
    extra_args:
      - CONF_FILE=prj_blk.conf
    platform_allow:
      - rcar_h3ulcb/r8a77951/a57
      - rcar_salvator_xs
  sample.filesystem.littlefs.nrf52840dk_spi:
    build_only: true
    platform_allow: nrf52840dk/nrf52840
    extra_args:
      - OVERLAY_CONFIG=boards/nrf52840dk_nrf52840_spi.conf
      - DTC_OVERLAY_FILE=boards/nrf52840dk_nrf52840_spi.overlay
  sample.filesystem.littlefs.nrf52840dk_qspi:
    build_only: true
    platform_allow: nrf52840dk/nrf52840
    extra_args:
      - OVERLAY_CONFIG=boards/nrf52840dk_nrf52840_qspi.conf
      - DTC_OVERLAY_FILE=boards/nrf52840dk_nrf52840_qspi.overlay
  sample.filesystem.littlefs.stm32h747i_disco_m7_blk:
    build_only: true
    platform_allow: stm32h747i_disco/stm32h747xx/m7
    extra_args:
      - OVERLAY_CONFIG=boards/stm32_blk.conf
      - CONF_FILE=prj_blk.conf
    extra_configs:
      - CONFIG_SDMMC_STM32_HWFC=y
  sample.filesystem.littlefs.nucleo_h743zi_qspi:
    build_only: true
    platform_allow: nucleo_h743zi
    extra_args:
      - OVERLAY_CONFIG=boards/nucleo_h743zi_qspi.conf
  sample.filesystem.littlefs.nucleo_h743zi_blk:
    build_only: true
    platform_allow: nucleo_h743zi
    extra_args:
      - OVERLAY_CONFIG=boards/nucleo_h743zi_blk.conf
      - CONF_FILE=prj_blk.conf
  sample.filesystem.littlefs.stm32l562e_dk_ospi:
    build_only: true
    platform_allow: stm32l562e_dk
    extra_args:
      - OVERLAY_CONFIG=boards/stm32l562e_dk_ospi.conf
  sample.filesystem.littlefs.stm32f746g_disco_blk:
    build_only: true
    platform_allow: stm32f746g_disco
    extra_args:
      - OVERLAY_CONFIG=boards/stm32_blk.conf
      - CONF_FILE=prj_blk.conf
    extra_configs:
      - CONFIG_SDMMC_STM32_HWFC=y
```

## samples/subsys/fs/nffs/sample.yaml
```yaml
sample:
  name: NFFS file system test for nrf52
tests:
  test:
    platform_whitelist: nrf52840_pca10056

tags: nrf52 NFFS file system
```

## samples/subsys/fs/ramdisk_diskimage/Kconfig
```kconfig
#
# Copyright (c) 2025 Siemens AG
#
# SPDX-License-Identifier: Apache-2.0
#

mainmenu "RAM Disk backed by Embedded Disk Image Sample Application"

config RAMDISK_DISKIMAGE_SAMPLE_DISK_SIZE
	int "Size of the disk image (in KiB) to be created for the sample"
	default 1024

source "Kconfig.zephyr"
```

## samples/subsys/fs/ramdisk_diskimage/sample.yaml
```yaml
sample:
  name: RAM disk from Disk Image sample
tests:
  sample.filesystem.ramdisk_diskimage:
    integration_platforms:
      - qemu_x86
      - qemu_cortex_a9
      - qemu_cortex_a53
    extra_args:
      - DTC_OVERLAY_FILE="ramdisk.overlay"
    tags: filesystem
    harness: console
    harness_config:
      type: multi_line
      regex:
        - "This is an existing test file."
        - "This is a newly created test file."

    # This test cannot be run in CI as it requires Python pyfatfs module
    # which is not among the standard host-side dependencies for Zephyr
    # build environment.
    skip: true
```

## samples/subsys/fs/sample.yaml
```yaml
sample:
  name: Fat filesystem sample
tests:
  sample.subsys.fs:
    build_only: true
    platform_whitelist: nrf52840_blip olimexino_stm32
    tags: filesystem
```

## samples/subsys/fs/virtiofs/sample.yaml
```yaml
sample:
  name: virtio filesystem sample
common:
  tags:
    - filesystem
    - virtio
tests:
  sample.filesystem.virtiofs:
    build_only: true
    filter: CONFIG_DT_HAS_VIRTIO_PCI_ENABLED
```

## samples/subsys/fs/zffs/boards/nrf52840_pca10056.conf
```kconfig
CONFIG_BT=n
CONFIG_BT_CTLR=n

CONFIG_QSPI_FLASH_NRF=y
CONFIG_ZFFS_AREA_ALIGNED_SIZE=4
CONFIG_MAIN_STACK_SIZE=2048
```

## samples/subsys/fs/zms/sample.yaml
```yaml
sample:
  name: ZMS Sample

tests:
  sample.zms.basic:
    tags: zms
    platform_allow:
      - qemu_x86
      - native_sim
    harness: console
    harness_config:
      type: one_line
      regex:
        - "Sample code finished Successfully"
  sample.zms.id_64bit:
    extra_configs:
      - CONFIG_ZMS_ID_64BIT=y
    tags: zms
    platform_allow:
      - qemu_x86
      - native_sim
    harness: console
    harness_config:
      type: one_line
      regex:
        - "Sample code finished Successfully"
```

## samples/subsys/greybus/sample.yaml
```yaml
sample:
  description: TBD
  name: TBD
tests:
  sample.greybus.uart:
    harness: greybus_uart
    platform_whitelist: qemu_x86 qemu_cortex_m3
    tags: greybus uart
  sample.greybus.uart.cc1352r1_launchxl:
    extra_args: OVERLAY_CONFIG="cc1352r1_launchxl.conf"
  sample.greybus.uart.nrf52840dk_nrf52840:
    extra_args: OVERLAY_CONFIG="nrf52840dk_nrf52840.conf"
```

## samples/subsys/input/draw_touch_events/Kconfig
```kconfig
# Copyright (c) 2024 Antmicro <www.antmicro.com>
# SPDX-License-Identifier: Apache-2.0

config SCREEN_WIDTH_TO_CROSS_DIM
	int "Screen width to cross horizontal/vertical dimension ratio"
	default 25

source "Kconfig.zephyr"
```

## samples/subsys/input/draw_touch_events/sample.yaml
```yaml
sample:
  description: Sample application for touch controllers
  name: touch_sample
tests:
  sample.touch.native:
    build_only: true
    platform_allow: native_sim/native/64
    tags:
      - touch
  sample.touch.ft5336:
    platform_allow:
      - stm32f429i_disc1
      - stm32f746g_disco
    tags:
      - touch
    harness: none
  sample.touch.ft5336.esp32s3_lcd_ev:
    platform_allow:
      - esp32s3_lcd_ev/esp32s3/procpu
    tags:
      - touch
    build_only: true
```

## samples/subsys/input/input_dump/Kconfig
```kconfig
# Copyright 2023 Google LLC
# SPDX-License-Identifier: Apache-2.0

configdefault INPUT_SHELL
	default y

configdefault INPUT_SHELL_KBD_MATRIX_STATE
	default y

source "Kconfig.zephyr"
```

## samples/subsys/input/input_dump/sample.yaml
```yaml
sample:
  name: Input Dump
common:
  tags: input
  build_only: true
  integration_platforms:
    - native_sim
tests:
  sample.input.input_dump: {}
  sample.input.input_dump_shell:
    extra_configs:
      - CONFIG_SHELL=y
```

## samples/subsys/ipc/ipc_service/boards/nrf5340dk_nrf5340_cpuapp.conf
```kconfig
CONFIG_BOARD_ENABLE_CPUNET=y

# Backend configuration for IPC Service
CONFIG_IPM=y
CONFIG_IPM_NRFX=y

# Enable all needed IPM channels
CONFIG_IPM_MSG_CH_0_ENABLE=y
CONFIG_IPM_MSG_CH_1_ENABLE=y
CONFIG_IPM_MSG_CH_2_ENABLE=y
CONFIG_IPM_MSG_CH_3_ENABLE=y

# Configure all RX channels
CONFIG_IPM_MSG_CH_0_RX=y
CONFIG_IPM_MSG_CH_2_RX=y

# Configure all TX channels
CONFIG_IPM_MSG_CH_1_TX=y
CONFIG_IPM_MSG_CH_3_TX=y

CONFIG_RPMSG_MULTI_INSTANCE_1_IPM_TX_NAME="IPM_1"
CONFIG_RPMSG_MULTI_INSTANCE_1_IPM_RX_NAME="IPM_0"
CONFIG_RPMSG_MULTI_INSTANCE_2_IPM_TX_NAME="IPM_3"
CONFIG_RPMSG_MULTI_INSTANCE_2_IPM_RX_NAME="IPM_2"
```

## samples/subsys/ipc/ipc_service/icmsg/Kconfig.sysbuild
```kconfig
# Copyright 2023 Nordic Semiconductor ASA
#
# SPDX-License-Identifier: Apache-2.0

source "share/sysbuild/Kconfig"

config REMOTE_BOARD
string
	default "nrf5340dk/nrf5340/cpunet" if $(BOARD) = "nrf5340dk"
	default "nrf5340bsim/nrf5340/cpunet" if $(BOARD) = "nrf5340bsim"
	default "nrf54l15dk/nrf54l15/cpuflpr" if $(BOARD) = "nrf54l15dk"
	default "stm32h747i_disco/stm32h747xx/m4" if $(BOARD) = "stm32h747i_disco"
	default "ek_ra8p1/r7ka8p1kflcac/cm33" if $(BOARD) = "ek_ra8p1"
```

## samples/subsys/ipc/ipc_service/icmsg/boards/apard32690_max32690_m4.conf
```kconfig
# Copyright (c) 2026 Analog Devices, Inc.
# SPDX-License-Identifier: Apache-2.0
CONFIG_MAX32_SECONDARY_RV32=y
```
