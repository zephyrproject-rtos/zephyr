## CMakeLists.txt
```
# SPDX-FileCopyrightText: Copyright The Zephyr Project Contributors
# SPDX-License-Identifier: Apache-2.0

cmake_minimum_required(VERSION 3.20.0)

find_package(Zephyr REQUIRED HINTS $ENV{ZEPHYR_BASE})
project(fs_unmount_path)

target_sources(app PRIVATE src/main.c)
```

## prj.conf
```kconfig
CONFIG_DISK_ACCESS=y
CONFIG_DISK_DRIVER_RAM=y
CONFIG_FILE_SYSTEM=y
CONFIG_FILE_SYSTEM_MKFS=y
CONFIG_FAT_FILESYSTEM_ELM=y
CONFIG_FS_FATFS_MKFS=y
CONFIG_MAIN_STACK_SIZE=4096
```

## boards/native_sim.overlay
```dts
/*
 * SPDX-FileCopyrightText: Copyright The Zephyr Project Contributors
 * SPDX-License-Identifier: Apache-2.0
 */

/ {
	ramdisk0 {
		compatible = "zephyr,ram-disk";
		disk-name = "RAM";
		sector-size = <512>;
		sector-count = <256>;
	};
};
```

## src/main.c
```c
/*
 * SPDX-FileCopyrightText: Copyright The Zephyr Project Contributors
 *
 * SPDX-License-Identifier: Apache-2.0
 */

#include <zephyr/fs/fs.h>
#include <zephyr/kernel.h>
#include <zephyr/storage/disk_access.h>
#include <ff.h>

#define RAM_DISK "RAM:"

static FATFS fat_fs;
static struct fs_mount_t mp = {
	.type = FS_FATFS,
	.mnt_point = "/RAM:",
	.fs_data = &fat_fs,
};

int main(void)
{
	int ret;

	printk("fs_unmount_path sample\n");

	ret = fs_unmount_path(NULL);
	if (ret != -EINVAL) {
		printk("fs_unmount_path(NULL) expected -EINVAL got %d\n", ret);
		return 1;
	}

	ret = fs_mkfs(FS_FATFS, (uintptr_t)RAM_DISK, NULL, 0);
	if (ret != 0) {
		printk("fs_mkfs failed: %d\n", ret);
		return 1;
	}

	ret = fs_mount(&mp);
	if (ret != 0) {
		printk("fs_mount failed: %d\n", ret);
		return 1;
	}

	ret = fs_unmount_path("/RAM:");
	if (ret != 0) {
		printk("fs_unmount_path failed: %d\n", ret);
		return 1;
	}

	printk("fs_unmount_path OK\n");

	return 0;
}
```
