&pcie0 {
	virtio_pci: virtio_pci {
		compatible = "virtio,pci";

		vendor-id = <0x1af4>;
		device-id = <0x105a>;

		interrupts = <0xb 0x0 0x0>;
		interrupt-parent = <&intc>;

		status = "okay";
	};
};
