/*
 * Copyright (c) 2019 Tavish Naruka <tavishnaruka@gmail.com>
 *
 * SPDX-License-Identifier: Apache-2.0
 */

&spi1 {
        status = "okay";
        cs-gpios = <&gpio0 17 GPIO_ACTIVE_HIGH>;

        sdhc0: sdhc@0 {
                compatible = "zephyr,mmc-spi-slot";
                reg = <0>;
                status = "okay";
                spi-max-frequency = <24000000>;
        };
};
