/*
 * Copyright (c) 2025 Siemens AG
 *
 * SPDX-License-Identifier: Apache-2.0
 */

/ {
	ramdisk0 {
		compatible = "zephyr,ram-disk";
		disk-name = "RAM";
		sector-size = <512>;

		/* Actual sector count will be automatically computed at build time,
		 * from size of the disk image and the `sector-size`.
		 */
		sector-count = <0>;

		zephyr,disk-image-path = "test.img";
	};
};
