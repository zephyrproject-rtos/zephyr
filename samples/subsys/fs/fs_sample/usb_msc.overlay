/*
 * Copyright (c) 2026 Espressif Systems (Shanghai) Co., Ltd.
 * SPDX-License-Identifier: Apache-2.0
 */

/ {
	usb_disk: usb_disk {
		compatible = "zephyr,usb-msc-disk";
		disk-name = "USB";
		status = "okay";
	};
};
