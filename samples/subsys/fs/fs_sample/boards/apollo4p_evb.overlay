/*
 * Copyright (C) 2025 Ambiq Micro Inc. <www.ambiq.com>
 *
 * SPDX-License-Identifier: Apache-2.0
 */

/ {
	aliases {
		sdhc0 = &sdio0;
	};
};

&sdio0 {
	status = "okay";
	mmc {
		status = "okay";
	};
};
