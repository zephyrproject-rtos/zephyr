## samples/subsys/fs/fs_sample/boards/arduino_opta_stm32h747xx_m7.conf
```kconfig
#
# Copyright (c) 2025 DNDG srl
#
# SPDX-License-Identifier: Apache-2.0
#

# Usually, some files are already present on the first partition,
# don't create new ones or format the partition in case of failure.
CONFIG_FILE_SYSTEM_MKFS=n
CONFIG_FS_SAMPLE_CREATE_SOME_ENTRIES=n
CONFIG_FS_FATFS_MOUNT_MKFS=n

# Arduino format FAT volumes using a 4096 bytes sector size.
CONFIG_FS_FATFS_MAX_SS=4096
```

## samples/subsys/fs/fs_sample/boards/ek_ra8m1.conf
```kconfig
# Copyright (c) 2025 Renesas Electronics Corporation
# SPDX-License-Identifier: Apache-2.0

CONFIG_FS_SAMPLE_CREATE_SOME_ENTRIES=y
```

## samples/subsys/fs/fs_sample/boards/native_sim.conf
```kconfig
# Copyright (c) 2024 Nordic Semiconductor ASA
# Copyright (c) 2025 Ezurio LLC
#
# SPDX-License-Identifier: Apache-2.0

CONFIG_DISK_DRIVERS=y
CONFIG_DISK_DRIVER_FLASH=y
# There may be no file on internal flash, so this Kconfig
# option has been enabled to create some if listing does not
# find any initially.
CONFIG_FS_SAMPLE_CREATE_SOME_ENTRIES=y
```

## samples/subsys/fs/fs_sample/boards/nrf52840dk_nrf52840.conf
```kconfig
#
# Copyright (c) 2023 Nordic Semiconductor ASA
#
# SPDX-License-Identifier: Apache-2.0
#

CONFIG_DISK_DRIVERS=y
CONFIG_DISK_DRIVER_FLASH=y
# There may be no files on internal SoC flash, so this Kconfig
# options has ben enabled to create some if listing does not
# find in the first place.
CONFIG_FS_SAMPLE_CREATE_SOME_ENTRIES=y
```

## samples/subsys/fs/fs_sample/boards/ophelia4ev_nrf54l15_cpuapp.conf
```kconfig
#
# Copyright (c) 2025 Würth Elektronik eiSos GmbH & Co. KG
#
# SPDX-License-Identifier: Apache-2.0
#

CONFIG_DISK_DRIVERS=y
# There may be no files on internal SoC flash, so this Kconfig
# options has ben enabled to create some if listing does not
# find in the first place.
CONFIG_FS_SAMPLE_CREATE_SOME_ENTRIES=y
```

## samples/subsys/fs/fs_sample/boards/stm32f746g_disco_dma.conf
```kconfig
#
# Copyright (c) 2024 Antmicro <www.antmicro.com>
#
# SPDX-License-Identifier: Apache-2.0
#

CONFIG_EXT2_SUPERBLOCK_ALIGNMENT=32
```

## samples/subsys/fs/fs_sample/boards/stm32h747i_disco_stm32h747xx_m7.conf
```kconfig
# SPDX-FileCopyrightText: Copyright The Zephyr Project Contributors
# SPDX-License-Identifier: Apache-2.0

CONFIG_SDMMC_STM32_HWFC=y
```

## samples/subsys/fs/fs_sample/sample.yaml
```yaml
sample:
  name: Filesystems sample
common:
  tags: filesystem
  modules:
    - fatfs
tests:
  sample.filesystem.fat_fs:
    depends_on: sdhc
    harness: console
    harness_config:
      fixture: fixture_sdhc
      type: multi_line
      regex:
        - "Block count"
        - "Sector size"
        - "Memory Size"
        - "Disk mounted"
  sample.filesystem.fat_fs.overlay:
    platform_allow: nrf52840_blip
  sample.filesystem.fat_fs.adafruit_2_8_tft_touch_v2:
    depends_on:
      - arduino_spi
      - arduino_gpio
      - arduino_i2c
    platform_exclude:
      - stm32f769i_disco
      - pan1781_evb
      - pan1782_evb
      - frdm_k64f
      - mimxrt1010_evk
    extra_args: SHIELD=adafruit_2_8_tft_touch_v2
    tags: shield
    harness: console
    harness_config:
      fixture: fixture_shield_adafruit_2_8_tft_touch_v2
      type: multi_line
      regex:
        - "Block count"
        - "Sector size"
        - "Memory Size"
        - "Disk mounted"
  sample.filesystem.fat_fs.nrf52840dk_nrf52840:
    build_only: true
    platform_allow: nrf52840dk/nrf52840
  sample.filesystem.fat_fs.nrf52840dk_nrf52840_ram_disk:
    build_only: true
    platform_allow: nrf52840dk/nrf52840
    extra_args:
      - EXTRA_CONF_FILE=boards/nrf52840dk_nrf52840_ram_disk.conf
      - DTC_OVERLAY_FILE=boards/nrf52840dk_nrf52840_ram_disk.overlay
  sample.filesystem.fat_fs.nrf52840dk_nrf52840_ram_disk_region:
    build_only: true
    platform_allow: nrf52840dk/nrf52840
    extra_args:
      - EXTRA_CONF_FILE=boards/nrf52840dk_nrf52840_ram_disk.conf
      - DTC_OVERLAY_FILE=boards/nrf52840dk_nrf52840_ram_disk_region.overlay
  sample.filesystem.fat_fs.nrf54l15dk:
    build_only: true
    platform_allow: nrf54l15dk/nrf54l15/cpuapp
  sample.filesystem.fat_fs.nrf52840dk_nrf52840.qspi:
    build_only: true
    platform_allow: nrf52840dk/nrf52840
    extra_args:
      - EXTRA_CONF_FILE=boards/nrf52840dk_nrf52840_qspi.conf
      - DTC_OVERLAY_FILE=boards/nrf52840dk_nrf52840_qspi.overlay
  sample.filesystem.fat_fs.has_sdmmc_disk:
    build_only: true
    filter: dt_compat_enabled("zephyr,sdmmc-disk")
    integration_platforms:
      - frdm_k64f
  sample.filesystem.ext2:
    simulation_exclude:
      - renode
    extra_args: CONF_FILE="prj_ext.conf"
    platform_allow:
      - hifive_unmatched/fu740/s7
      - bl5340_dvk/nrf5340/cpuapp
  sample.filesystem.fat_fs.stm32h747i_disco_m7_sdmmc:
    build_only: true
    platform_allow: stm32h747i_disco/stm32h747xx/m7
```

## samples/subsys/fs/littlefs/Kconfig
```kconfig
# Copyright (c) 2019 Peter Bigot Consulting, LLC
# SPDX-License-Identifier: Apache-2.0

mainmenu "littlefs sample"

config APP_WIPE_STORAGE
	bool "Option to clear the flash area before mounting"
	help
	  Use this to force an existing file system to be created.

choice
	prompt "Storage backend type used by the application"
	default APP_LITTLEFS_STORAGE_FLASH
	help
	  Specify the type of storage backend.

config APP_LITTLEFS_STORAGE_FLASH
	bool "Use flash memory backend"

config APP_LITTLEFS_STORAGE_BLK_SDMMC
	bool "Use block device (e.g. SD MMC) backend"
endchoice

source "Kconfig.zephyr"
```

## samples/subsys/fs/littlefs/boards/b_u585i_iot02a.conf
```kconfig
#
# Copyright (c) 2023 OS Systems
#
# SPDX-License-Identifier: Apache-2.0
#

CONFIG_FS_LITTLEFS_FC_HEAP_SIZE=8192
```

## samples/subsys/fs/littlefs/boards/bmd_345_eval.conf
```kconfig
#
# Copyright (c) 2021 Linumiz
#
# SPDX-License-Identifier: Apache-2.0

# Need this when storage is on flash
CONFIG_MPU_ALLOW_FLASH_WRITE=y

# Need this when storage is on MX25R64
CONFIG_NORDIC_QSPI_NOR=y
CONFIG_NORDIC_QSPI_NOR_FLASH_LAYOUT_PAGE_SIZE=4096
```

## samples/subsys/fs/littlefs/boards/ek_ra8d2_r7ka8d2kflcac_cm85.conf
```kconfig
# Copyright (c) 2026 Renesas Electronics Corporation
# SPDX-License-Identifier: Apache-2.0

CONFIG_HEAP_MEM_POOL_SIZE=2048
```

## samples/subsys/fs/littlefs/boards/frdm_mcxa156.conf
```kconfig
# Copyright 2025 NXP
# SPDX-License-Identifier: Apache-2.0

CONFIG_FS_LITTLEFS_PROG_SIZE=128
CONFIG_FS_LITTLEFS_CACHE_SIZE=128
```

## samples/subsys/fs/littlefs/boards/frdm_mcxn947_mcxn947_cpu0_nand.conf
```kconfig
# Copyright 2026 NXP
# SPDX-License-Identifier: Apache-2.0

# Must be > CRC_DRIVER_INIT_PRIORITY (50) so hardware CRC is ready for ONFI probe.
CONFIG_FLASH_MCUX_FLEXSPI_NAND_INIT_PRIORITY=51

# FTL block device backend for littlefs
CONFIG_DISK_ACCESS=y
CONFIG_APP_LITTLEFS_STORAGE_BLK_FTL=y
CONFIG_FS_LITTLEFS_BLK_DEV=y
CONFIG_FS_LITTLEFS_CACHE_SIZE=2048
CONFIG_FS_LITTLEFS_LOOKAHEAD_SIZE=64

# LittleFS + Dhara + FlexSPI HAL call chain exceeds default stack size.
CONFIG_MAIN_STACK_SIZE=16384
```

## samples/subsys/fs/littlefs/boards/frdm_rw612_nand.conf
```kconfig
# Copyright 2026 NXP
# SPDX-License-Identifier: Apache-2.0

# Re-initialize FlexSPI even in XIP mode so Zephyr configures PortB1 (NAND).
# Without this, memc skips init when XIP is active and PortB1 is never set up.
CONFIG_MEMC_MCUX_FLEXSPI_INIT_XIP=y

# Must be > MEMC_INIT_PRIORITY so FlexSPI controller is ready first.
CONFIG_FLASH_MCUX_FLEXSPI_NAND_INIT_PRIORITY=51

# FTL block device backend for littlefs
CONFIG_DISK_DRIVER_FTL=y
CONFIG_DISK_ACCESS=y
CONFIG_APP_LITTLEFS_STORAGE_BLK_FTL=y
CONFIG_FS_LITTLEFS_BLK_DEV=y
CONFIG_FS_LITTLEFS_CACHE_SIZE=2048
CONFIG_FS_LITTLEFS_LOOKAHEAD_SIZE=64

# LittleFS + Dhara + FlexSPI HAL call chain exceeds default stack size.
CONFIG_MAIN_STACK_SIZE=16384
```

## samples/subsys/fs/littlefs/boards/lpcxpresso55s36.conf
```kconfig
# Copyright 2023 NXP
# SPDX-License-Identifier: Apache-2.0

CONFIG_FS_LITTLEFS_PROG_SIZE=512
CONFIG_FS_LITTLEFS_CACHE_SIZE=512
```

## samples/subsys/fs/littlefs/boards/mimxrt1060_evk.conf
```kconfig
#
# Copyright (c) 2021 NXP.
# SPDX-License-Identifier: Apache-2.0
#

# Need this when storage is on flash
CONFIG_MPU_ALLOW_FLASH_WRITE=y
```

## samples/subsys/fs/littlefs/boards/nrf52840_pca10056.conf
```kconfig
#
# Copyright (c) 2019 Peter Bigot Consulting, LLC
# Copyright (c) 2019 Nordic Semiconductor ASA
#
# SPDX-License-Identifier: Apache-2.0
#

# Need this when storage is on flash
CONFIG_MPU_ALLOW_FLASH_WRITE=y

# Need this when storage is on MX25R64
CONFIG_NORDIC_QSPI_NOR=y
CONFIG_NORDIC_QSPI_NOR_FLASH_LAYOUT_PAGE_SIZE=4096
```

## samples/subsys/fs/littlefs/boards/nrf52840dk_nrf52840_spi.conf
```kconfig
#
# Copyright (c) 2023 Nordic Semiconductor ASA
#
# SPDX-License-Identifier: Apache-2.0
#
CONFIG_SPI=y
CONFIG_SPI_NOR=y
CONFIG_SPI_NOR_FLASH_LAYOUT_PAGE_SIZE=4096
```

## samples/subsys/fs/littlefs/boards/nucleo_f429zi.conf
```kconfig
#
# Copyright (c) 2020 Linaro Limited.
#
# SPDX-License-Identifier: Apache-2.0
#

# Need this when storage is on flash
CONFIG_MPU_ALLOW_FLASH_WRITE=y
```

## samples/subsys/fs/littlefs/boards/nucleo_h743zi.conf
```kconfig
#
# Copyright (c) 2021 Lukasz Majewski, DENX Software Engineering GmbH
#
# SPDX-License-Identifier: Apache-2.0
#

CONFIG_DEBUG=y
CONFIG_FILE_SYSTEM_LITTLEFS=y
CONFIG_FLASH=y
CONFIG_FLASH_MAP=y
CONFIG_FLASH_PAGE_LAYOUT=y
CONFIG_FLASH_STM32_QSPI=y

CONFIG_MINIMAL_LIBC_MALLOC_ARENA_SIZE=8192

# Littlefs configuration to utilize QSPI operation
CONFIG_FS_LITTLEFS_CACHE_SIZE=256
CONFIG_FS_LITTLEFS_PROG_SIZE=32
CONFIG_FS_LITTLEFS_READ_SIZE=32
CONFIG_FS_LITTLEFS_LOOKAHEAD_SIZE=64
CONFIG_FS_LITTLEFS_FC_HEAP_SIZE=8192

CONFIG_NOCACHE_MEMORY=y
```

## samples/subsys/fs/littlefs/boards/nucleo_h743zi_blk.conf
```kconfig
#
# Copyright (c) 2022 Lukasz Majewski, DENX Software Engineering GmbH
#
# SPDX-License-Identifier: Apache-2.0
#
CONFIG_MAIN_STACK_SIZE=2048
CONFIG_MINIMAL_LIBC_MALLOC_ARENA_SIZE=8192

CONFIG_FS_LITTLEFS_FC_HEAP_SIZE=8192
```
