/*
 * Copyright (c) 2024 Renesas Electronics Corporation
 * SPDX-License-Identifier: Apache-2.0
 */

/ {
	aliases {
		sdhc1 = &sdhc1;
	};
};

&sdhc1 {
	compatible = "renesas,ra-sdhc";
	interrupt-names = "accs", "card", "dma-req";
	interrupts = <60 12>, <61 12>, <62 12>;
	pinctrl-0 = <&sdhc1_default>;
	pinctrl-names = "default";
	status = "okay";
	sdmmc {
		compatible = "zephyr,sdmmc-disk";
		disk-name = "SD";
	    status = "okay";
	};
};
