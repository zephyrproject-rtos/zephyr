/*
 * Copyright (c) 2025, Qingsong Gou <gouqs@hotmail.com>
 * SPDX-License-Identifier: Apache-2.0
 */

&spi1 {
	status = "okay";

	sdhc0: sdhc@0 {
		compatible = "zephyr,sdhc-spi-slot";
		reg = <0>;
		spi-max-frequency = <24000000>;

		mmc {
			compatible = "zephyr,sdmmc-disk";
			disk-name = "SD";
		};
	};
};
