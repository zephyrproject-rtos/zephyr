## CMakeLists.txt
```
# Copyright (c) 2025 Arch-Embedded B.V.
# SPDX-License-Identifier: Apache-2.0

cmake_minimum_required(VERSION 3.28.0)
find_package(Zephyr REQUIRED HINTS $ENV{ZEPHYR_BASE})
project(ext2_fstab_sample)

FILE(GLOB app_sources src/*.c)
target_sources(app PRIVATE ${app_sources})
```

## sample.yaml
```
sample:
  name: EXT2 fstab sample
tests:
  sample.filesystem.ext2.fstab:
    platform_allow:
      - native_sim
    extra_args:
      - EXTRA_DTC_OVERLAY_FILE="ext2_fstab.overlay"
    tags: filesystem
    harness: console
    harness_config:
      type: one_line
      regex:
        - "I: Filesystem access successful"
```

## prj.conf
```kconfig
CONFIG_DISK_ACCESS=y
CONFIG_DISK_DRIVERS=y

CONFIG_LOG=y
CONFIG_LOG_MODE_MINIMAL=y

CONFIG_FILE_SYSTEM=y
CONFIG_FILE_SYSTEM_MKFS=y
CONFIG_FILE_SYSTEM_EXT2=y
CONFIG_EXT2_FSTAB_AUTOMOUNT=y

# Needed for MKFS
CONFIG_ENTROPY_GENERATOR=y
CONFIG_XOSHIRO_RANDOM_GENERATOR=y
```

## ext2_fstab.overlay
```dts
/*
 * Copyright (c) 2025 Arch-Embedded B.V.
 *
 * SPDX-License-Identifier: Apache-2.0
 */

/ {
	fstab {
		compatible = "zephyr,fstab";

		ext2fs1: ext2fs1 {
			compatible = "zephyr,fstab,ext2";
			automount;
			disk-access;
			disk-name = "RAM";
			mount-point = "/ext2";
		};
	};

	ramdisk0 {
		compatible = "zephyr,ram-disk";
		disk-name = "RAM";
		sector-size = <512>;
		sector-count = <128>;
	};
};
```

## src/main.c
```c
/*
 * Copyright (c) 2025 Endress+Hauser AG
 * Copyright (c) 2025 Arch-Embedded B.V.
 *
 * SPDX-License-Identifier: Apache-2.0
 */

#include <zephyr/device.h>
#include <zephyr/fs/fs.h>
#include <zephyr/kernel.h>
#include <zephyr/logging/log.h>
#include <zephyr/storage/disk_access.h>

LOG_MODULE_REGISTER(main, LOG_LEVEL_INF);

#define AUTOMOUNT_NODE DT_NODELABEL(ext2fs1)
#define MOUNT_POINT DT_PROP(AUTOMOUNT_NODE, mount_point)

FS_FSTAB_DECLARE_ENTRY(AUTOMOUNT_NODE);

#define FILE_PATH MOUNT_POINT "/hello.txt"

int main(void)
{
	struct fs_file_t file;
	int rc;
	static const char data[] = "Hello";
	/* You can get direct mount point to automounted node too */
	struct fs_mount_t *auto_mount_point = &FS_FSTAB_ENTRY(AUTOMOUNT_NODE);
	struct fs_dirent stat;

	fs_file_t_init(&file);

	rc = fs_open(&file, FILE_PATH, FS_O_CREATE | FS_O_WRITE);
	if (rc != 0) {
		LOG_ERROR("Accessing filesystem failed");
		return rc;
	}

	rc = fs_write(&file, data, strlen(data));
	if (rc != strlen(data)) {
		LOG_ERROR("Writing filesystem failed");
		return rc;
	}

	rc = fs_close(&file);
	if (rc != 0) {
		LOG_ERROR("Closing file failed");
		return rc;
	}

	/* You can unmount the automount node */
	rc = fs_unmount(auto_mount_point);
	if (rc != 0) {
		LOG_ERROR("Failed to do unmount");
		return rc;
	};

	/* And mount it back */
	rc = fs_mount(auto_mount_point);
	if (rc != 0) {
		LOG_ERROR("Failed to remount the auto-mount node");
		return rc;
	}

	/* Is the file still there? */
	rc = fs_stat(FILE_PATH, &stat);
	if (rc != 0) {
		LOG_ERROR("File status check failed %d", rc);
		return rc;
	}

	LOG_INF("Filesystem access successful");

	return 0;
}
```
