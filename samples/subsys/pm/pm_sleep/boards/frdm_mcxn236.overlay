/*
 * Copyright (c) 2026 Rithic Chellaram Hariharan
 *
 * SPDX-License-Identifier: Apache-2.0
 *
 * Use the LPTMR as the low-power wake-up timer for the MCXN SoC.
 */

cpu0: &{/cpus/cpu@0} {};

&lptmr0 {
	status = "okay";
	clock-frequency = <16384>;
	timer-mode-sel = <0>;
};
