## samples/subsys/pm/pm_sleep/boards/native_sim.conf
```kconfig
# native_sim has no SoC PM backend, so the sample provides a simulated one and
# a custom policy that only enters explicitly requested states.
CONFIG_MP_MAX_NUM_CPUS=1
CONFIG_PM_POLICY_CUSTOM=y
```

## samples/subsys/pm/pm_sleep/sample.yaml
```yaml
sample:
  name: PM Unified Sleep
  description: Portable light, deep and soft-off system sleep helpers
tests:
  sample.pm.unified_sleep:
    platform_allow:
      - native_sim
      - esp32_devkitc/esp32/procpu
      - esp32s3_devkitc/esp32s3/procpu
      - frdm_mcxa153/mcxa153
      - frdm_mcxn236/mcxn236
    integration_platforms:
      - native_sim
    tags: pm
    harness: console
    harness_config:
      type: multi_line
      ordered: true
      regex:
        - "PM unified sleep sample"
        - "Requesting light sleep"
        - "SoC entering suspend-to-idle"
        - "Resumed from light sleep"
        - "Requesting deep sleep"
        - "SoC entering suspend-to-ram"
        - "Resumed from deep sleep"
        - "Requesting soft-off"
        - "SoC entering soft-off"
        - "Resumed from soft-off"
        - "PM unified sleep sample complete"
```

## samples/subsys/pm/power_domain_tree/boards/native_sim.conf
```kconfig
# Copyright (c) 2026 Rodrigo Peixoto <rodrigopex@gmail.com>
# SPDX-License-Identifier: Apache-2.0

# Route the shell to the process stdin/stdout so the sample can be driven
# interactively, and let the native backend own logging. Without this the
# shell log backend and the native backend would both reach the terminal and
# every line would be printed twice.
CONFIG_UART_NATIVE_PTY_0_ON_STDINOUT=y
CONFIG_SHELL_LOG_BACKEND=n
```

## samples/subsys/pm/power_domain_tree/dts/bindings/zephyr,power-domain-log.yaml
```yaml
# Copyright (c) 2026 Rodrigo Peixoto <rodrigopex@gmail.com>
# SPDX-License-Identifier: Apache-2.0

description: |
  Software power domain used by the power_domain_tree sample. It logs each of
  its power transitions and notifies the devices that depend on it. The same
  compatible is used for the leaf devices of the sample, which simply have no
  dependents to notify.

compatible: "zephyr,power-domain-log"

include: base.yaml
```

## samples/subsys/pmci/mctp/host/sample.yaml
```yaml
sample:
  name: MCTP Uart Host Endpoint
common:
  tags:
    - pmci
    - mctp
tests:
  sample.pmci.mctp.uart_host:
    platform_allow:
      - nrf52840dk/nrf52840
    harness: console
    harness_config:
      type: multi_line
      regex:
        - "(.*)MCTP Host EID: (.*) on (.*)"
        - "received message (.*) for endpoint (.*)"
```

## samples/subsys/pmci/mctp/i2c_gpio_bus_owner/sample.yaml
```yaml
sample:
  name: MCTP I2C+GPIO Bus Owner
common:
  tags:
    - pmci
    - mctp
tests:
  sample.pmci.mctp.i2c_gpio_bus_owner:
    platform_allow:
      - frdm_mcxn947/mcxn947/cpu0
    harness: console
    harness_config:
      type: multi_line
      regex:
        - "(.*)MCTP Host EID: (.*) on (.*)"
        - "(.*)received message (.*) from endpoint (.*)"
```

## samples/subsys/pmci/mctp/i2c_smbus_echo/Kconfig
```kconfig
# Copyright 2026 NXP
# SPDX-License-Identifier: Apache-2.0

source "Kconfig.zephyr"

menu "MCTP SMBus/I2C echo sample"

choice MCTP_I2C_SMBUS_ECHO_ROLE
	prompt "Sample role"
	default MCTP_I2C_SMBUS_ECHO_ROLE_REQUESTER

config MCTP_I2C_SMBUS_ECHO_ROLE_REQUESTER
	bool "Requester role"

config MCTP_I2C_SMBUS_ECHO_ROLE_RESPONDER
	bool "Responder role"

endchoice

config MCTP_I2C_SMBUS_ECHO_REMOTE_EID
	int "Remote MCTP endpoint ID"
	default 8 if MCTP_I2C_SMBUS_ECHO_ROLE_REQUESTER
	default 20 if MCTP_I2C_SMBUS_ECHO_ROLE_RESPONDER
	range 0 255
	help
	  Remote MCTP endpoint ID used by the requester when sending test
	  messages. The responder replies to the source EID from received
	  messages, so its default is informational.

config MCTP_I2C_SMBUS_ECHO_COUNT
	int "Number of echo transactions"
	default 100
	range 1 100000
	help
	  Number of MCTP echo transactions to run before printing final status.

config MCTP_I2C_SMBUS_ECHO_INTERVAL_MS
	int "Requester interval in milliseconds"
	default 500
	range 1 60000
	help
	  Delay between requester transmissions.

config MCTP_I2C_SMBUS_ECHO_PAYLOAD_SIZE
	int "Payload size in bytes"
	default 8
	range 1 32
	help
	  Number of payload bytes used in each echo transaction.

endmenu
```

## samples/subsys/pmci/mctp/i3c_bus_endpoint/boards/it51xxx_evb_it51526aw.conf
```kconfig
CONFIG_I3CS_TX_FIFO_4096_BYTE=y
CONFIG_I3CS_RX_FIFO_4096_BYTE=y
CONFIG_I3C_SHELL=y
CONFIG_I3C_TARGET_ROLE_ONLY=y
```

## samples/subsys/pmci/mctp/i3c_bus_host/boards/nucleo_u385rg_q.conf
```kconfig
CONFIG_I3C_USE_IBI=n
CONFIG_MCTP_I3C_CONTROLLER_POLLING_MODE=y
CONFIG_MCTP_I3C_CONTROLLER_POLL_INTERVAL_MS=10
CONFIG_I3C_LOG_LEVEL_OFF=y
```

## samples/subsys/pmci/mctp/i3c_ssd_mctp_discover/Kconfig
```kconfig
# Copyright (c) 2026 Intel Corporation
# SPDX-License-Identifier: Apache-2.0

mainmenu "MCTP I3C bus discovery sample"

module = APP
module-str = app
source "subsys/logging/Kconfig.template.log_config"

source "Kconfig.zephyr"
```

## samples/subsys/portability/cmsis_rtos_v1/philosophers/sample.yaml
```yaml
sample:
  name: CMSIS_RTOS_V1 Dining Philosophers
common:
  integration_platforms:
    - native_posix
  extra_args: DEBUG_PRINTF=1
  tags: cmsis_rtos
  min_ram: 32
  min_flash: 34
  harness: console
  harness_config:
    type: multi_line
    ordered: false
    regex:
      - ".*STARVING.*"
      - ".*DROPPED ONE FORK.*"
      - ".*THINKING.*"
      - ".*EATING.*"
tests:
  sample.portability.cmsis_rtos_v1.philosopher:
    tags: cmsis_rtos
  sample.portability.cmsis_rtos_v1.philosopher.same_prio:
    extra_args: SAME_PRIO=1
  sample.portability.cmsis_rtos_v1.philosopher.semaphores:
    extra_args: FORKS=SEMAPHORES
```

## samples/subsys/portability/cmsis_rtos_v2/philosophers/sample.yaml
```yaml
sample:
  name: CMSIS_RTOS_V2 Dining Philosophers
common:
  integration_platforms:
    - native_sim
  extra_args: DEBUG_PRINTF=1
  tags: cmsis_rtos
  min_ram: 32
  min_flash: 34
  platform_exclude:
    - qemu_xtensa
    - qemu_x86_64
  harness: console
  harness_config:
    type: multi_line
    ordered: false
    regex:
      - ".*STARVING.*"
      - ".*DROPPED ONE FORK.*"
      - ".*THINKING.*"
      - ".*EATING.*"
tests:
  sample.portability.cmsis_rtos_v2.philosopher:
    tags: cmsis_rtos
  sample.portability.cmsis_rtos_v2.philosopher.same_prio:
    extra_args: SAME_PRIO=1
  sample.portability.cmsis_rtos_v2.philosopher.semaphores:
    extra_args: FORKS=SEMAPHORES
```

## samples/subsys/portability/cmsis_rtos_v2/timer_synchronization/sample.yaml
```yaml
sample:
  name: CMSIS_RTOS_V2 Synchronization
tests:
  sample.portability.cmsis_rtos_v2.timer_synchronization:
    integration_platforms:
      - native_posix
    platform_exclude:
      - qemu_arc_hs5x  # See issue #62405
    tags: cmsis_rtos
    min_ram: 32
    min_flash: 34
    harness: console
    harness_config:
      type: multi_line
      ordered: true
      regex:
        - "Wrote to message queue: (.*)"
        - "Read from message queue: (.*)"
        - "Sample execution successful"
```

## samples/subsys/portability/posix/env/sample.yaml
```yaml
sample:
  description: posix env sample
  name: posix env
common:
  tags:
    - posix
    - env
  integration_platforms:
    - native_sim
  harness: console
  harness_config:
    type: multi_line
    regex:
      - "BOARD=.*"
      - "BUILD_VERSION=.*"
      - "ALERT="
tests:
  sample.posix.env: {}
```

## samples/subsys/portability/posix/eventfd/sample.yaml
```yaml
sample:
  description: Extended POSIX (Linux) API eventfd() example
  name: eventfd
common:
  filter: CONFIG_FULL_LIBC_SUPPORTED and not CONFIG_NATIVE_LIBC
  tags: posix
  platform_exclude: m2gl025_miv
  integration_platforms:
    - mps2/an385
tests:
  sample.posix.eventfd:
    min_ram: 32
    tags: posix
    harness: console
    harness_config:
      type: multi_line
      ordered: true
      regex:
        - "Writing 1 to efd"
        - "Writing 2 to efd"
        - "Writing 3 to efd"
        - "Writing 4 to efd"
        - "Completed write loop"
        - "About to read"
        - "Read 10 \\(0xa\\) from efd"
        - "Finished"
```

## samples/subsys/power/device_pm/sample.yaml
```yaml
sample:
  name: Device Idle Power Management
tests:
  sample.power.ospm.dev_idle_pm:
    platform_whitelist: nrf52840_pca10056 nrf52_pca10040
    tags: power
    harness: console
    harness_config:
      type: multi_line
      regex:
        - "Device PM sample app start"
        - "parent resuming\\.\\."
        - "child resuming\\.\\."
        - "Async wakeup request queued"
        - "Dummy device resumed"
        - "child suspending\\.\\."
        - "parent suspending\\.\\."
        - "Device PM sample app complete"
```

## samples/subsys/power/power_mgr/sample.yaml
```yaml
sample:
  name: OS managed Power Management Sample
tests:
  ospm.low_power_state:
    platform_whitelist: nrf52840_pca10056 nrf52_pca10040
    tags: power
```

## samples/subsys/power/stm32_pm/lptim/sample.yaml
```yaml
sample:
  name: Low Power Timer Sample for nucleo board
tests:
  sample.power.pm.stm32_lptim.lsi:
    platform_whitelist: nucleo_l4r5zi
    build_only: true
    tags: lptim
  sample.power.pm.stm32_lptim.lse:
    platform_whitelist: nucleo_l4r5zi
    build_only: true
    tags: lptim
    extra_configs:
      - CONFIG_STM32_LPTIM_CLOCK_LSE=y
```

## samples/subsys/power/stm32_pm/sample.yaml
```yaml
sample:
  name: Low Power Timer Sample for nucleo board
tests:
  sample.power.pm.stm32_lptim.lsi:
    build_only: true
    depends_on: lptim
    filter: dt_compat_enabled_with_alias("gpio-leds", "led0") and
            dt_compat_enabled_with_alias("gpio-leds", "led1") and
            dt_compat_enabled("st,stm32-lptim")
  sample.power.pm.stm32_lptim.lse:
    build_only: true
    depends_on: lptim
    filter: dt_compat_enabled_with_alias("gpio-leds", "led0") and
            dt_compat_enabled_with_alias("gpio-leds", "led1") and
            dt_compat_enabled("st,stm32-lptim")
    extra_configs:
      - CONFIG_STM32_LPTIM_CLOCK_LSE=y
```

## samples/subsys/power/x86_ndsx/sample.yaml
```yaml
sample:
  description: Non Deep Sleep Well Power Sequencing
  name: Non DSx
common:
    tags: introduction
```

## samples/subsys/process/sample.yaml
```yaml
sample:
  description: Subprocess start and stop with userspace
  name: Subprocess
tests:
  sample.subprocess.userspace:
    platform_allow:
      - nrf54l15/nrf54l15/cpuapp
    harness: console
    harness_config:
      type: multi_line
      ordered: true
      regex:
        - "starting subprocesses from user mode"
        - "hello from ext"
        - "hello from builtin"
        - "starting subprocesses from supervisor mode"
        - "hello from ext"
        - "hello from builtin"
```
