/*
 * Copyright (c) 2025 Nordic Semiconductor ASA
 *
 * SPDX-License-Identifier: Apache-2.0
 */

 / {
	chosen {
		zephyr,timeout-event-domain = &cpuapp_wakeup_event_domain;
	};

	aliases {
		sample-request-button = &button0;
		sample-response-led = &led0;
		sample-event-domain = &cpuapp_wakeup_event_domain;
	};
};
