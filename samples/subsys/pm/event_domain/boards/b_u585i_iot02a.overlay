/*
 * Copyright (c) 2025 Nordic Semiconductor ASA
 *
 * SPDX-License-Identifier: Apache-2.0
 */

/ {
	aliases {
		sample-request-button = &user_button;
		sample-response-led = &red_led_1;
		sample-event-domain = &wakeup_event_domain;
	};
};

&user_button {
	gpios = <&gpioc 13 GPIO_ACTIVE_HIGH>;
};
