/*
 * Copyright (c) 2020 Phytec Messtechnik GmbH
 *
 * SPDX-License-Identifier: Apache-2.0
 */

&arduino_serial {
	status = "okay";

	modbus0 {
		compatible = "zephyr,modbus-serial";
		de-gpios = <&arduino_header 15 GPIO_ACTIVE_LOW>;	/* D9 */
		status = "okay";
	};
};
