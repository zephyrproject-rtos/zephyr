/*
 * Copyright (c) 2020 Phytec Messtechnik GmbH
 *
 * SPDX-License-Identifier: Apache-2.0
 */

&arduino_serial {
	current-speed = <115200>;
	status = "okay";

	modbus0 {
		compatible = "zephyr,modbus-serial";
		status = "okay";
	};
};
