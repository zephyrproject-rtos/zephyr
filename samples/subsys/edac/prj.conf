## CMakeLists.txt
```
# SPDX-License-Identifier: Apache-2.0

cmake_minimum_required(VERSION 3.28.0)

find_package(Zephyr REQUIRED HINTS $ENV{ZEPHYR_BASE})
project(edac)

target_sources(app PRIVATE src/main.c)
```

## sample.yaml
```
sample:
  description: EDAC shell sample application
  name: edac shell
common:
  tags: edac
  harness: console
  harness_config:
    type: one_line
    regex:
      - "EDAC shell application initialized"

tests:
  sample.drivers.edac:
    platform_allow: intel_ehl_crb
    integration_platforms:
      - intel_ehl_crb
    tags: edac
  sample.drivers.edac.nxp_sram_noecc:
    extra_args: EXTRA_DTC_OVERLAY_FILE="sram_noecc.overlay"
    depends_on: edac
    platform_allow:
      - frdm_mcxa153
      - frdm_mcxa156
      - frdm_mcxa266
      - frdm_mcxa344
      - frdm_mcxa346
      - frdm_mcxa366
      - frdm_mcxa577
```

## prj.conf
```kconfig
CONFIG_LOG=y

CONFIG_EDAC=y
CONFIG_EDAC_ERROR_INJECT=y
CONFIG_EDAC_LOG_LEVEL_ERR=y

CONFIG_SHELL=y
CONFIG_EDAC_SHELL=y
```

## boards/intel_ehl_crb.conf
```kconfig
CONFIG_EDAC_IBECC=y
```

## boards/frdm_mcxa577.overlay
```dts
/*
 * Copyright 2025 NXP
 *
 * SPDX-License-Identifier: Apache-2.0
 */

/ {
	sram0_noecc: memory@20010000 {
		compatible = "mmio-sram";
		reg = <0x20010000 DT_SIZE_K(448)>;
	};

	chosen {
		zephyr,sram = &sram0_noecc;
	};
};
```

## boards/frdm_mcxn236.overlay
```dts
/*
 * Copyright 2025 NXP
 *
 * SPDX-License-Identifier: Apache-2.0
 */

&eim0_channel1 {
	status = "disabled";
};
```

## src/main.c
```c
/*
 * Copyright (c) 2020 Intel Corporation
 * Copyright 2025 NXP
 *
 * SPDX-License-Identifier: Apache-2.0
 */

#include <zephyr/kernel.h>
#include <zephyr/device.h>
#include <zephyr/devicetree.h>

#include <zephyr/drivers/edac.h>

#include <zephyr/logging/log.h>
LOG_MODULE_REGISTER(main, CONFIG_LOG_DEFAULT_LEVEL);

#define STACKSIZE 1024
#define PRIORITY  15

static atomic_t handled;

/**
 * Callback called from ISR. Runs in supervisor mode
 */
static void notification_callback(const struct device *dev, void *data)
{
	ARG_UNUSED(dev);
	ARG_UNUSED(data);

	/* This runs in interrupt (ISR) context: k_work/mutex/semaphore are
	 * not safe here, so just raise an atomic flag for the worker thread
	 * to observe.
	 */
	atomic_set(&handled, 1);
}

int main(void)
{
	const struct device *const dev = DEVICE_DT_GET(DT_CHOSEN(zephyr_edac));

	if (!device_is_ready(dev)) {
		LOG_ERR_DEVICE_NOT_READY(dev);
		return 0;
	}

	if (edac_notify_callback_set(dev, notification_callback)) {
		LOG_ERR("Cannot set notification callback");
		return 0;
	}

	LOG_INF("EDAC shell application initialized");
	return 0;
}

static void thread_function(void)
{
	LOG_DBG("Thread started");

	while (true) {
		if (atomic_cas(&handled, 1, 0)) {
			printk("Got notification about ECC event\n");
			k_sleep(K_MSEC(300));
		}
	}
}

K_THREAD_DEFINE(thread_edac, STACKSIZE, thread_function, NULL, NULL, NULL, PRIORITY, 0, 0);
```
