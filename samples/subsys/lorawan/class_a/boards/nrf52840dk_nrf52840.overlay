&spi3 {
        compatible = "nordic,nrf-spim";
        status = "okay";
        pinctrl-0 = <&spi3_default>;
        pinctrl-1 = <&spi3_sleep>;
        pinctrl-names = "default", "sleep";
	cs-gpios = <&gpio1 8 GPIO_ACTIVE_LOW>;

        lora: sx1262@0 {
                compatible = "semtech,sx1262";
                reg = <0>;
                label = "sx1262";
                reset-gpios = <&gpio0 3 GPIO_ACTIVE_LOW>;
                busy-gpios = <&gpio1 4 GPIO_ACTIVE_HIGH>;
		antenna-enable-gpios = <&gpio1 10 GPIO_ACTIVE_HIGH>;
		dio1-gpios = <&gpio1 6 GPIO_ACTIVE_HIGH>;
		dio2-tx-enable;
		tcxo-power-startup-delay-ms = <5>;
                spi-max-frequency = <1000000>;
        };
};

/ {

        aliases {
		lora0 = &lora;
        };
};
