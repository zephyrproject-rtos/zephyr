## samples/subsys/ebpf/hello_trace/sample.yaml
```yaml
# SPDX-FileCopyrightText: Copyright 2026 NXP
# SPDX-License-Identifier: Apache-2.0

sample:
  name: eBPF Hello Trace
  description: >
    Demonstrates attaching an eBPF program to the THREAD_SWITCHED_IN
    tracepoint to count context switches.

common:
  platform_allow:
    - native_sim
    - qemu_cortex_m3
    - qemu_x86
  tags: ebpf

tests:
  sample.ebpf.hello_trace:
    integration_platforms:
      - frdm_mcxn236
    platform_allow:
      - frdm_mcxn236
    harness: console
    harness_config:
      type: one_line
      regex:
        - "eBPF program detached\\. Sample complete\\."
    tags: ebpf
```

## samples/subsys/ebpf/isr_latency/sample.yaml
```yaml
# SPDX-FileCopyrightText: Copyright 2026 NXP
# SPDX-License-Identifier: Apache-2.0

sample:
  name: eBPF ISR Latency Profiler
  description: >
    Demonstrates using two cooperating eBPF programs to measure ISR
    execution latency via the ring buffer map type.

common:
  platform_allow:
    - native_sim
    - qemu_cortex_m3
    - qemu_x86
  tags: ebpf

tests:
  sample.ebpf.isr_latency:
    integration_platforms:
      - frdm_mcxn236
    platform_allow:
      - frdm_mcxn236
    harness: console
    harness_config:
      type: one_line
      regex:
        - "eBPF programs detached\\. Profiling complete\\."
    tags: ebpf
```

## samples/subsys/edac/sample.yaml
```yaml
sample:
  description: EDAC shell sample application
  name: edac shell
common:
  tags: edac
  harness: console
  harness_config:
    type: one_line
    regex:
      - "EDAC shell application initialized"

tests:
  sample.drivers.edac:
    platform_allow: intel_ehl_crb
    integration_platforms:
      - intel_ehl_crb
    tags: edac
  sample.drivers.edac.nxp_sram_noecc:
    extra_args: EXTRA_DTC_OVERLAY_FILE="sram_noecc.overlay"
    depends_on: edac
    platform_allow:
      - frdm_mcxa153
      - frdm_mcxa156
      - frdm_mcxa266
      - frdm_mcxa344
      - frdm_mcxa346
      - frdm_mcxa366
      - frdm_mcxa577
```

## samples/subsys/factory_data/sample.yaml
```yaml
sample:
  name: Factory data sample
common:
    tags: factory_data
    build_only: true

tests:
  sample.subsys.factory_data.read_write:
    platform_allow: >
      gd32f450i_eval
      native_posix
      native_posix_64
  sample.subsys.factory_data.read_only:
    extra_args: CONF_FILE=read_only.conf
    platform_allow:
      native_posix
      native_posix_64
```

## samples/subsys/fcb/Kconfig
```kconfig
# Copyright 2025 Tomas Jurena
# SPDX-License-Identifier: Apache-2.0

mainmenu "FCB Sample Configuration"
menu "Sample configuration"
config FCB_SECTOR_CNT
	int "Number of FCB sectors"
	default 2
	help
		"Minimum value is 2 but any number larger than this can be used.
		The number have impact on memory footprint as this is then used for a pool
		where details about sectors are stored."
endmenu
menu "Zephyr"
source "Kconfig.zephyr"
endmenu
```

## samples/subsys/fcb/sample.yaml
```yaml
sample:
  name: FCB Sample

common:
  tags: fcb
  filter: dt_label_with_parent_compat_enabled("storage_partition", "fixed-partitions")
  harness: console
  harness_config:
    type: multi_line
    regex:
      - "Booted 0 times"
      - "Saving boot_cnt 1 to FCB"
      - "New boot_cnt value written to flash"
      - "Rebooting in 1 second"

tests:
  sample.fcb.basic:
    platform_allow:
      - stm32f4_disco/stm32f407xx
    integration_platforms:
      - stm32f4_disco/stm32f407xx
```

## samples/subsys/fs/ext2_fstab/sample.yaml
```yaml
sample:
  name: EXT2 fstab sample
tests:
  sample.filesystem.ext2.fstab:
    platform_allow:
      - native_sim
    extra_args:
      - EXTRA_DTC_OVERLAY_FILE="ext2_fstab.overlay"
    tags: filesystem
    harness: console
    harness_config:
      type: one_line
      regex:
        - "I: Filesystem access successful"
```

## samples/subsys/fs/fat_fs/Kconfig
```kconfig
#
# Copyright (c) 2023 Nordic Semiconductor ASA
# Copyright (c) 2023 Intel Corporation

# SPDX-License-Identifier: Apache-2.0
#

mainmenu "FAT Filesystem Sample Application"

source "samples/subsys/fs/fat_fs/Kconfig.usb2"

config DISK_DRIVE_NAME
	string "Disk drive name to be used by application"
	default "SD"
	help
	  Name of the disk drive to be used by sample application.

config DEV_CONNECTION_WAIT
	int "Device connection wait value"
	default 1
	help
	  Before using devices like USB wait for the enumeration process to
	  complete. The wait value configured is in seconds.

config SAMPLE_FATFS_CREATE_SOME_ENTRIES
	bool "When no files are found on mounted partition create some"
	default y
	help
	  In case when no files could be listed, because there are none,
	  "some.dir" directory and "other.txt" file will be created
	  and list will run again to show them. This is useful when
	  showing how FAT works on non-SD devices like internal flash
	  or (Q)SPI connected memories, where it is not possible to
	  easily add files with use of other device.

source "Kconfig.zephyr"
```

## samples/subsys/fs/fat_fs/Kconfig.usb2
```kconfig
# Copyright (c) 2023 Intel Corporation
# SPDX-License-Identifier: Apache-2.0

menuconfig USB2_FAT_FS
	bool "Configure USB 2.0 for FAT FS sample application"
	default n
	help
	  Enable USB 2.0 drive to be mounted and used by FAT FS sample
	  application.

if USB2_FAT_FS

config DISK_DRIVE_NAME
	default "USB2"

config DEV_CONNECTION_WAIT
	default 10

config USB_HOST_CLASS_DRIVER
	default y

config USB_HOST_MSC_DRIVER
	default y

config DISK_DRIVER_USB2
	default y

endif # USB2_FAT_FS
```

## samples/subsys/fs/fat_fs/boards/intel_socfpga_agilex5_socdk.conf
```kconfig
# Copyright (c) 2023 Intel Corporation.
# SPDX-License-Identifier: Apache-2.0

# Enable USB DWC2 Host stack
CONFIG_USB_HOST_CLASS_DRIVER=y
CONFIG_USB_HOST_MSC_DRIVER=y
CONFIG_DISK_DRIVER_USB2=y

# Configure USB 2.0 values to work with file system application
CONFIG_DEV_CONNECTION_WAIT=10
CONFIG_DISK_DRIVE_NAME="USB2"
```

## samples/subsys/fs/fat_fs/boards/intel_socfpga_agilex_socdk.conf
```kconfig
# Copyright (c) 2023 Intel Corporation
# SPDX-License-Identifier: Apache-2.0

# Increase stack size for no optimization flag
CONFIG_MAIN_STACK_SIZE=4096
```

## samples/subsys/fs/fat_fs/boards/nrf52840dk_nrf52840.conf
```kconfig
#
# Copyright (c) 2023 Nordic Semiconductor ASA
#
# SPDX-License-Identifier: Apache-2.0
#

CONFIG_DISK_DRIVERS=y
CONFIG_DISK_DRIVER_FLASH=y
```

## samples/subsys/fs/fat_fs/boards/nrf52840dk_nrf52840_qspi.conf
```kconfig
#
# Copyright (c) 2023 Nordic Semiconductor ASA
#
# SPDX-License-Identifier: Apache-2.0
#

CONFIG_NORDIC_QSPI_NOR=y
# The mx25 erase page size
CONFIG_NORDIC_QSPI_NOR_FLASH_LAYOUT_PAGE_SIZE=4096
CONFIG_DISK_DRIVERS=y
CONFIG_DISK_DRIVER_FLASH=y
# There may be no files on internal SoC flash, so this Kconfig
# options has ben enabled to create some if listing does not
# find in the first place.
CONFIG_SAMPLE_FATFS_CREATE_SOME_ENTRIES=y
```

## samples/subsys/fs/fat_fs/boards/nucleo_l4r5zi.conf
```kconfig
CONFIG_DISK_ACCESS_SDHC=y
CONFIG_DISK_ACCESS_SPI_SDHC=y
CONFIG_SPI=y
CONFIG_SPI_1=y
```

## samples/subsys/fs/fat_fs/sample.yaml
```yaml
sample:
  name: Fat filesystem sample
common:
  tags: filesystem
  modules:
    - fatfs
tests:
  sample.filesystem.fat_fs:
    depends_on: sdhc
    harness: console
    harness_config:
      fixture: fixture_sdhc
  sample.filesystem.fat_fs.overlay:
    platform_allow: nrf52840_blip
  sample.filesystem.fat_fs.adafruit_2_8_tft_touch_v2:
    depends_on: arduino_spi arduino_gpio arduino_i2c
    platform_exclude: stm32f769i_disco pan1781_evb pan1782_evb frdm_k64f
    extra_args: SHIELD=adafruit_2_8_tft_touch_v2
    tags: shield
    harness: console
    harness_config:
      fixture: fixture_shield_adafruit_2_8_tft_touch_v2
```

## samples/subsys/fs/fat_fs_basic/sample.yaml
```yaml
#
# Copyright (c) 2020 Nordic Semiconductor ASA
#
# SPDX-License-Identifier: Apache-2.0
#
sample:
  name: Simple FAT file system in internal/external flash sample
common:
  tags: filesystem, fat
tests:
  sample.filesystem.fat_fs_basic.nrf52840dk_nrf52840.internal:
    platform_allow: nrf52840dk_nrf52840
    extra_args: DTC_OVERLAY_FILE="boards/nrf52840dk_nrf52840.overlay"
  sample.filesystem.fat_fs_basic.nrf9160dk_nrf52840.internal:
    platform_allow: nrf9160dk_nrf52840
    extra_args: DTC_OVERLAY_FILE="boards/nrf9160dk_nrf52840.overlay"
  sample.filesystem.fat_fs_basic.nrf52840dk_nrf52840.external:
    platform_allow: nrf52840dk_nrf52840
    extra_args: DTC_OVERLAY_FILE="boards/nrf52840dk_nrf52840.overlay" CONF_FILE="prj_external_qspi.conf"
  sample.filesystem.fat_fs_basic.nrf9160dk_nrf9160.external:
    platform_allow: nrf9160dk_nrf9160@0.14.0
    extra_args: DTC_OVERLAY_FILE="boards/nrf9160dk_nrf9160.overlay" CONF_FILE="prj_external_spi.conf"
  sample.filesystem.fat_fs_basic.nrf9160dk_nrf9160.internal:
    platform_allow: nrf9160dk_nrf9160@0.14.0
    extra_args: DTC_OVERLAY_FILE="boards/nrf9160dk_nrf9160.overlay"
```

## samples/subsys/fs/fatfs_fstab/sample.yaml
```yaml
sample:
  name: fatfs fstab sample
tests:
  sample.filesystem.fat_fs.fstab:
    platform_allow:
      - native_sim
    extra_args:
      - EXTRA_DTC_OVERLAY_FILE="fatfs_fstab.overlay"
    tags: filesystem
    harness: console
    harness_config:
      type: one_line
      regex:
        - "I: Filesystem access successful"
```

## samples/subsys/fs/format/sample.yaml
```yaml
sample:
  name: format filesystem sample
tests:
  sample.filesystem.format.littlefs:
    platform_allow:
      - native_sim
      - nrf52dk/nrf52832
    build_only: true
    tags: filesystem
  sample.filesystem.format.fat_fs:
    platform_allow:
      - native_sim
      - mimxrt1064_evk
    build_only: true
    extra_args:
      - CONF_FILE="prj_ram.conf"
      - EXTRA_DTC_OVERLAY_FILE="ramdisk.overlay"
    tags: filesystem
```

## samples/subsys/fs/fs_sample/Kconfig
```kconfig
#
# Copyright (c) 2023 Nordic Semiconductor ASA
# Copyright (c) 2023 Antmicro <www.antmicro.com>
#
# SPDX-License-Identifier: Apache-2.0
#

mainmenu "Filesystems Sample Application"

config FS_SAMPLE_CREATE_SOME_ENTRIES
	bool "When no files are found on mounted partition create some"
	default y
	help
	  In case when no files could be listed, because there are none,
	  "some.dir" directory and "other.txt" file will be created
	  and list will run again to show them. This is useful when
	  showing how file system works on non-SD devices like internal
	  flash or (Q)SPI connected memories, where it is not possible to
	  easily add files with use of other device.

source "Kconfig.zephyr"
```

## samples/subsys/fs/fs_sample/boards/apollo4p_evb.conf
```kconfig
CONFIG_MMC_STACK=y

CONFIG_MAIN_STACK_SIZE=8192
CONFIG_IDLE_STACK_SIZE=4096
CONFIG_AMBIQ_SDIO_ASYNC=y
CONFIG_PM=y
CONFIG_PM_DEVICE=y
CONFIG_PM_DEVICE_RUNTIME=y
```

## samples/subsys/fs/fs_sample/boards/apollo510_eb.conf
```kconfig
CONFIG_MMC_STACK=y

CONFIG_MAIN_STACK_SIZE=8192
CONFIG_IDLE_STACK_SIZE=4096
CONFIG_AMBIQ_SDIO_ASYNC=y
CONFIG_MMC_DDR50=y
CONFIG_MMC_CARD_8BIT_WIDTH=y
```
