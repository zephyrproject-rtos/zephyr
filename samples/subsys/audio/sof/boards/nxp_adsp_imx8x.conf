## samples/subsys/audio/sof/boards/nxp_adsp_imx8x.conf
```kconfig
CONFIG_IMX8X=y
CONFIG_HAVE_AGENT=n
CONFIG_FORMAT_CONVERT_HIFI3=n
CONFIG_KPB_FORCE_COPY_TYPE_NORMAL=n
```

## samples/subsys/audio/sof/sample.yaml
```yaml
sample:
  description: Audio with SOF
  name: sof
common:
  tags: audio
  modules:
    - sof
tests:
  sample.audio.sof:
    tags: sof
    build_only: true
    platform_allow: intel_adsp_cavs15 intel_adsp_cavs18 intel_adsp_cavs20 intel_adsp_cavs25 nxp_adsp_imx8 nxp_adsp_imx8x nxp_adsp_imx8m
    integration_platforms:
      - intel_adsp_cavs15
      - intel_adsp_cavs18
      - intel_adsp_cavs20
      - intel_adsp_cavs25
      - nxp_adsp_imx8
      - nxp_adsp_imx8x
      - nxp_adsp_imx8m
```

## samples/subsys/authentication/fido2/boards/weact_esp32s3_b_procpu.conf
```kconfig
CONFIG_USBD_CDC_ACM_CLASS=y
CONFIG_CDC_ACM_SERIAL_INITIALIZE_AT_BOOT=n
CONFIG_USBD_CDC_ACM_LOG_LEVEL_OFF=y
CONFIG_ESP_SPIRAM=y
CONFIG_SPIRAM_MODE_OCT=y
CONFIG_INPUT_ESP32_TOUCH_SENSOR=y
```

## samples/subsys/bindesc/hello_bindesc/sample.yaml
```yaml
sample:
  name: Hello Bindesc
tests:
  sample.bindesc:
    tags: bindesc
    filter: CONFIG_ARCH_SUPPORTS_ROM_START
    build_only: true
    integration_platforms:
      - native_posix
```

## samples/subsys/bindesc/read_bindesc/sample.yaml
```yaml
sample:
  name: Bindesc read

common:
  build_only: true
  platform_exclude:
    - nucleo_c031c6

tests:
  sample.bindesc.read_bindesc:
    tags: bindesc
    filter: dt_chosen_enabled("zephyr,flash-controller") and CONFIG_FLASH_HAS_DRIVER_ENABLED
      and CONFIG_ARCH_SUPPORTS_ROM_START
    integration_platforms:
      - mps2/an385
```

## samples/subsys/canbus/canopen/sample.yaml
```yaml
sample:
  name: CANopen sample
common:
  tags: can canopen
  depends_on: can
  platform_allow: twr_ke18f frdm_k64f
  harness: console
  harness_config:
    type: one_line
    regex:
      - "(.*)CANopen stack initialized"
tests:
  sample.subsys.canbus.canopen:
    tags: introduction
  sample.subsys.canbus.canopen.program_download:
    build_only: true
    extra_configs:
      - CONFIG_BOOTLOADER_MCUBOOT=y
  sample.subsys.canbus.canopen.no_storage:
    extra_args: CONF_FILE=prj_no_storage.conf
```

## samples/subsys/canbus/isotp/Kconfig
```kconfig
# Private config options to the ISO-TP sample

# Copyright (c) 2023 Vestas Wind Systems A/S
# SPDX-License-Identifier: Apache-2.0

mainmenu "ISO-TP sample"

config SAMPLE_LOOPBACK_MODE
	bool "Use CAN loopback mode"
	help
	  Set the CAN controller to loopback mode. This allows testing without a second board.

config SAMPLE_RX_THREAD_STACK_SIZE
	int "RX threads stack size"
	default 1024
	help
	  Stack size (in bytes) used for the RX threads.

config SAMPLE_RX_THREAD_PRIORITY
	int "RX threads priority"
	default 2
	help
	  Priority used for the RX threads.

config SAMPLE_CAN_FD_MODE
	bool "Use CAN-FD"
	select CAN_FD_MODE

config ISOTP_RX_BUF_COUNT
	default 4 if SAMPLE_CAN_FD_MODE
	default 2

source "Kconfig.zephyr"
```

## samples/subsys/canbus/isotp/sample.yaml
```yaml
sample:
  name: ISO-TP sample
tests:
  sample.subsys.canbus.isotp:
    tags:
      - can
      - isotp
    depends_on: can
    filter: dt_chosen_enabled("zephyr,canbus") and not dt_compat_enabled("kvaser,pcican")
    extra_configs:
      - CONFIG_SAMPLE_LOOPBACK_MODE=y
    harness: console
    harness_config:
      type: one_line
      regex:
        - "(.*)Got 247 bytes in total"
  sample.subsys.canbus.isotp.fd:
    tags:
      - can
      - isotp
    depends_on: can
    extra_configs:
      - CONFIG_SAMPLE_LOOPBACK_MODE=y
      - CONFIG_SAMPLE_CAN_FD_MODE=y
    platform_allow:
      - native_sim
      - native_sim/native/64
    harness: console
    harness_config:
      type: one_line
      regex:
        - "(.*)Got 247 bytes in total"
```

## samples/subsys/canbus/j1939/sample.yaml
```yaml
sample:
  name: J1939 sample
tests:
  sample.subsys.canbus.j1939:
    tags:
      - can
      - j1939
    depends_on: can
    filter: dt_chosen_enabled("zephyr,canbus")
    harness: console
    harness_config:
      type: one_line
      regex:
        - "(.*)Got 247 bytes in total"
```

## samples/subsys/clock/sample.yaml
```yaml
sample:
  name: Real-Time Clock with OLED Display

tests:
  sample.drivers.rtc.oled:
    platform_allow:
      - xiao_ble
    integration_platforms:
      - xiao_ble
    tags:
      - samples
      - rtc
      - display
      - cfb
    depends_on:
      - rtc
      - display
    harness: ignore
```

## samples/subsys/console/echo/sample.yaml
```yaml
sample:
  name: echo Sample
tests:
  sample.console.echo:
    integration_platforms:
      - mps2/an385
    filter: CONFIG_UART_CONSOLE and CONFIG_SERIAL_SUPPORT_INTERRUPT
    tags: console
    harness: keyboard
```

## samples/subsys/console/getchar/sample.yaml
```yaml
sample:
  name: getchar sample
tests:
  sample.drivers.console.getchar:
    integration_platforms:
      - mps2/an385
    filter: CONFIG_UART_CONSOLE and CONFIG_SERIAL_SUPPORT_INTERRUPT
    tags: console
    harness: keyboard
```

## samples/subsys/console/getline/sample.yaml
```yaml
sample:
  name: getline Sample
tests:
  sample.console.getline:
    integration_platforms:
      - mps2/an385
    filter: CONFIG_UART_CONSOLE and CONFIG_SERIAL_SUPPORT_INTERRUPT
    tags: console
    harness: pytest
```

## samples/subsys/cpp/cpp_exceptions/sample.yaml
```yaml
sample:
  name: Exceptions (C++)
tests:
  sample.cpp.synchronization:
    tags: cpp
    toolchain_exclude: issm xcc
    arch_exclude: posix
    integration_platforms:
      - qemu_x86
    harness: console
    harness_config:
      type: one_line
      regex:
        - "Exception caught: foobar"
```

## samples/subsys/cpp/cpp_synchronization/sample.yaml
```yaml
sample:
  name: Syncronisation (C++)
tests:
  sample.cpp.synchronization:
    tags: cpp
    toolchain_exclude: issm xcc
    arch_exclude: posix
    integration_platforms:
      - qemu_x86
    harness: console
    harness_config:
      type: multi_line
      regex:
        - "Create semaphore (.*)"
        - "main: Hello World!"
        - "coop_thread_entry: Hello World!"
```

## samples/subsys/cpu_freq/on_demand/sample.yaml
```yaml
sample:
  description: CPU frequency scaling on-demand policy sample
  name: CPU Freq On-demand Sample
common:
  tags: cpu_freq
  harness: console
  harness_config:
    type: multi_line
    regex:
      - "^.*<inf> cpu_freq_on_demand_sample: Starting CPU Freq on-demand policy Sample!"
      - "^.*<dbg> cpu_load_metric: cpu_load_metric_get: CPU[0-9]+ Execution cycles: \
         [0-9]+, Total cycles: [0-9]+"
      - "^.*<dbg> cpu_freq_policy_on_demand: cpu_freq_policy_select_pstate: \
         CPU[0-9]+ Load: [0-9]+%"
      - "^.*<dbg> cpu_freq_policy_on_demand: cpu_freq_policy_select_pstate: On-Demand Policy: \
         Selected P-state [0-9]+ with load_threshold=[0-9]+%"

tests:
  sample.cpu_freq.soc:
    integration_platforms:
      - native_sim
      - native_sim/native/64
    platform_allow:
      - native_sim
      - native_sim/native/64

  sample.cpu_freq.stub:
    integration_platforms:
      - qemu_cortex_a53/qemu_cortex_a53/smp
      - qemu_x86
    platform_allow:
      - qemu_cortex_a53/qemu_cortex_a53/smp
      - qemu_x86
    extra_dtc_overlay_files:
      - pstate-stub.overlay
    extra_configs:
      - CONFIG_CPU_FREQ_PSTATE_SET_STUB=y
```

## samples/subsys/cpu_freq/pressure/sample.yaml
```yaml
sample:
  description: CPU frequency scaling pressure policy sample
  name: CPU Freq Pressure Sample
common:
  tags: cpu_freq
  harness: console
  harness_config:
    type: multi_line
    regex:
      - "^.*<inf> cpu_freq_pressure_sample: Mode 1: Low only"
      - "^.*<dbg> cpu_freq_policy_pressure: thread_eval_cb: Evaluating thread: 0x[0-9a-fA-F]+ \
         with prio: [0-9]+ status: [0-9]+"
      - "^.*<dbg> cpu_freq_policy_pressure: thread_eval_cb: Evaluating thread: 0x[0-9a-fA-F]+ \
         with prio: [0-9]+ status: [0-9]+"
      - "^.*<dbg> cpu_freq_policy_pressure: thread_eval_cb: Evaluating thread: 0x[0-9a-fA-F]+ \
         with prio: [0-9]+ status: [0-9]+"
      - "^.*<dbg> cpu_freq_policy_pressure: thread_eval_cb: Evaluating thread: 0x[0-9a-fA-F]+ \
         with prio: [0-9]+ status: [0-9]+"
      - "^.*<dbg> cpu_freq_policy_pressure: thread_eval_cb: Evaluating thread: 0x[0-9a-fA-F]+ \
         with prio: [0-9]+ status: [0-9]+"
      - "^.*<dbg> cpu_freq_policy_pressure: get_normalized_sys_pressure: System pressure is: \
         [0-9]+% \\(raw: [0-9]+ / max: [0-9]+\\)"
      - "^.*<dbg> cpu_freq_policy_pressure: cpu_freq_policy_select_pstate: CPU[0-9]+ Pressure: \
         [0-9]+%"
      - "^.*<dbg> cpu_freq_policy_pressure: cpu_freq_policy_select_pstate: Pressure Policy: \
         Selected P-state [0-9]+ with load_threshold=[0-9]+%"

tests:
  sample.cpu_freq_pressure:
    integration_platforms:
      - native_sim
      - native_sim/native/64
      - frdm_mcxn236
    platform_allow:
      - native_sim
      - native_sim/native/64
      - frdm_mcxn236
```

## samples/subsys/cpu_freq/side_channel_defense/sample.yaml
```yaml
sample:
  description: CPU frequency side-channel defense policy sample
  name: CPU Freq Side-Channel Defense Policy
common:
  tags: cpu_freq
  harness: console
  harness_config:
    type: multi_line
    regex:
    - "^Starting timing side-channel attack\\.\\s*$"
    - "^found pos [0-9]+ try [A-Za-z0-9!@#\\$%\\^&\\*()\\-_=\\+]+ -> [0-9]+ cycles\\s*$"
    - "^Recovered so far: .+\\s*$"

tests:
  sample.cpu_freq_side_channel_defense:
    extra_args: EXTRA_CONF_FILE=defense_prj.conf
    integration_platforms:
    - frdm_mcxn236
    platform_allow:
    - frdm_mcxn236
```

## samples/subsys/crc/sample.yaml
```yaml
sample:
  name: CRC Subsystem
tests:
  samples.subsys.crc:
    depends_on: crc
    tags:
      - subsys
      - crc
    harness: console
    harness_config:
      type: one_line
      regex:
        - "CRC computation completed successfully"
```

## samples/subsys/dap/boards/stm32_debug_probe.conf
```kconfig
CONFIG_MAIN_STACK_SIZE=768
CONFIG_SYSTEM_WORKQUEUE_STACK_SIZE=768
CONFIG_LOG_BUFFER_SIZE=128
CONFIG_USBD_CDC_ACM_LOG_LEVEL_OFF=y
```

## samples/subsys/dap/boards/thingy91_nrf52840.conf
```kconfig
CONFIG_USB_DEVICE_REMOTE_WAKEUP=n
CONFIG_USB_MAX_POWER=250
CONFIG_CMSIS_DAP_DEVICE_VENDOR="Nordic Semiconductor"
CONFIG_CMSIS_DAP_DEVICE_NAME="nrf9160_xxaa"
```

## samples/subsys/dap/sample.yaml
```yaml
sample:
  name: DAP USB
tests:
  sample.dap.bulk:
    build_only: true
    depends_on: arduino_gpio usb_device
    platform_allow:
      - nrf52840dk/nrf52840
      - frdm_k64f
    tags: dap
```
