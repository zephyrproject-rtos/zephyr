## CMakeLists.txt
```
# SPDX-License-Identifier: Apache-2.0

cmake_minimum_required(VERSION 3.20.0)

find_package(Zephyr REQUIRED HINTS $ENV{ZEPHYR_BASE})
project(factory_data_sample)

target_sources(app PRIVATE src/main.c src/factory_data_custom_eeprom.c)
```

## sample.yaml
```
sample:
  name: Factory data sample
common:
    tags: factory_data
    build_only: true

tests:
  sample.subsys.factory_data.read_write:
    platform_allow: >
      gd32f450i_eval
      native_posix
      native_posix_64
  sample.subsys.factory_data.read_only:
    extra_args: CONF_FILE=read_only.conf
    platform_allow:
      native_posix
      native_posix_64
```

## prj.conf
```kconfig
CONFIG_EEPROM=y
CONFIG_SHELL=y

CONFIG_FACTORY_DATA=y
CONFIG_FACTORY_DATA_CUSTOM=y
CONFIG_FACTORY_DATA_SHELL=y
```

## read_only.conf
```kconfig
CONFIG_EEPROM=y

CONFIG_FACTORY_DATA=y
CONFIG_FACTORY_DATA_CUSTOM=y
```

## boards/native_posix.overlay
```dts
/*
 * Copyright (c) 2022 GARDENA GmbH
 * SPDX-License-Identifier: Apache-2.0
 */

/* Reduce storage partition to 12 kB. */
&storage_partition {
	reg = <0x000f8000 0x00003000>;
};

/* factory data: 1 page (4 kB) */
&flash0 {
	partitions {
		factory_partition: partition@fb000 {
			label = "factory";
			reg = <0x000fb000 0x00001000>;
		};
	};
};
```

## src/main.c
```c
/*
 * Copyright (c) 2022 GARDENA GmbH
 *
 * SPDX-License-Identifier: Apache-2.0
 */

#include <string.h>

#include <zephyr/factory_data/factory_data.h>
#include <zephyr/sys/printk.h>
#include <zephyr/sys/util.h>

struct factory_data {
	uint8_t uuid[16];
	uint8_t mac_address[6];
	uint8_t value_max_len[CONFIG_FACTORY_DATA_VALUE_LEN_MAX];
};

static int load_callback(const char *name, const uint8_t *value, size_t len, const void *param)
{
	struct factory_data *fd = (struct factory_data *)param;

	if (!strcmp(name, "uuid")) {
		memcpy(fd->uuid, value, MIN(sizeof(fd->uuid), len));
	} else if (!strcmp(name, "mac_address")) {
		memcpy(fd->mac_address, value, MIN(sizeof(fd->mac_address), len));
	} else if (!strcmp(name, "value_max_len")) {
		memcpy(fd->value_max_len, value, MIN(sizeof(fd->value_max_len), len));
	} else {
		/* unknown entry */
		printk("Error: unknown element '%s'\n", name);
	}

	return 0;
}

void main(void)
{
	struct factory_data fd;
	char uuid_hex_str[32 + 1];
	size_t i = 0;
	int ret;

	printk("\n*** Simplistic custom factory data implementation example ***\n");

	ret = factory_data_init();
	if (ret) {
		printk("Failed to initialize factory data: %d", ret);
		return;
	}

	printk("\nLoad all factory data entries\n");
	factory_data_load(load_callback, &fd);

	printk("\nPrint all factory data entries\n");

	bin2hex(fd.uuid, 16, uuid_hex_str, sizeof(uuid_hex_str));

	printk("- uuid: %s\n", uuid_hex_str);
	printk("- mac_address: %02x:%02x:%02x:%02x:%02x:%02x\n", fd.mac_address[0],
	       fd.mac_address[1], fd.mac_address[2], fd.mac_address[3], fd.mac_address[4],
	       fd.mac_address[5]);
	printk("- value_max_len:\n");
	for (i = 0; i < sizeof(fd.value_max_len); i++) {
		if (i % 16 == 0) {
			printk("  ");
		}
		if (i % 16 == 8) {
			printk("  ");
		}
		printk("%02x", fd.value_max_len[i]);
		if (i % 16 == 15) {
			printk("\n");
		}
	}

	printk("\nAbove values are booring? Use the factory data shell to manipulate them!\n");
}
```

## src/factory_data_custom_eeprom.c
```c
/*
 * Copyright (c) 2022 GARDENA GmbH
 *
 * SPDX-License-Identifier: Apache-2.0
 */

#include <errno.h>
#include <stdio.h>
#include <string.h>

#include <zephyr/drivers/eeprom.h>
#include <zephyr/factory_data/factory_data.h>

#define sample_factory_data_magic 0xfac70123

static bool factory_data_subsys_initialized;

struct sample_factory_data_v1 {
	uint32_t magic;
	uint8_t version;
	uint8_t uuid[16];
	uint8_t mac_address[6];
	uint8_t value_max_len[CONFIG_FACTORY_DATA_VALUE_LEN_MAX];
} __packed;

struct sample_factory_data_field_description {
	const char *const name;
	const size_t offset;
	const size_t size;
};

struct sample_factory_data_field_description description[] = {
	{.name = "uuid",
	 .offset = offsetof(struct sample_factory_data_v1, uuid),
	 sizeof(((struct sample_factory_data_v1){0}).uuid)},
	{.name = "mac_address",
	 .offset = offsetof(struct sample_factory_data_v1, mac_address),
	 sizeof(((struct sample_factory_data_v1){0}).mac_address)},
	{.name = "value_max_len",
	 .offset = offsetof(struct sample_factory_data_v1, value_max_len),
	 sizeof(((struct sample_factory_data_v1){0}).value_max_len)}};

static const struct device *eeprom_dev = DEVICE_DT_GET(DT_ALIAS(eeprom_0));

/**
 * Return pointer to description of a named field.
 *
 * @param name Name of the value to look for
 *
 * @return Pointer to the field description, NULL when not found
 */
static struct sample_factory_data_field_description *find_description(const char *const name)
{
	size_t i;

	for (i = 0; i < ARRAY_SIZE(description); i++) {
		if (strcmp(description[i].name, name) == 0) {
			return description + i;
		}
	}

	return NULL;
}

static int factory_data_init_partition(void);

int factory_data_init(void)
{
	int ret;
	uint32_t magic;
	uint8_t version;

	if (factory_data_subsys_initialized) {
		return 0;
	}

	if (!device_is_ready(eeprom_dev)) {
		return -EIO;
	}

	if (eeprom_get_size(eeprom_dev) < sizeof(struct sample_factory_data_v1)) {
		return -ENOMEM;
	}

	ret = eeprom_read(eeprom_dev, 0, &magic, sizeof(magic));
	if (ret) {
		return ret;
	}

	/* Check version if partition was initialized before, initialize (write header) otherwise */
	if (magic != sample_factory_data_magic) {
		return factory_data_init_partition();
	}

	ret = eeprom_read(eeprom_dev, sizeof(magic), &version, sizeof(version));
	if (ret) {
		return ret;
	}
	if (version != 1) {
		return -EIO;
	}

	factory_data_subsys_initialized = true;

	return 0;
}

#if CONFIG_FACTORY_DATA_WRITE
static int factory_data_init_partition(void)
{
	struct sample_factory_data_v1 initial_state = {.magic = sample_factory_data_magic,
						       .version = 1};

	if (!device_is_ready(eeprom_dev)) {
		return -EIO;
	}

	return eeprom_write(eeprom_dev, 0, &initial_state, sizeof(initial_state));
}

int factory_data_save_one(const char *name, const void *value, size_t val_len)
{
	struct sample_factory_data_field_description *d = find_description(name);
	int ret;

	if (!factory_data_subsys_initialized) {
		return -ECANCELED;
	}

	if (!d) {
		return -EINVAL;
	}

	if (val_len > d->size) {
		return -EFBIG;
	}

	ret = eeprom_write(eeprom_dev, d->offset, value, val_len);
	if (ret) {
		return ret;
	}

	return 0;
}

int factory_data_erase(void)
{
	return factory_data_init_partition();
}

#else /* CONFIG_FACTORY_DATA_WRITE */

static int factory_data_init_partition(void)
{
	return -EACCES;
}

#endif /* CONFIG_FACTORY_DATA_WRITE */

int factory_data_load(factory_data_load_direct_cb cb, const void *param)
{
	size_t i;
	uint8_t buf[FACTORY_DATA_TOTAL_LEN_MAX];

	if (!factory_data_subsys_initialized) {
		return -ECANCELED;
	}

	for (i = 0; i < ARRAY_SIZE(description); i++) {
		int ret;

		ret = eeprom_read(eeprom_dev, description[i].offset, buf, description[i].size);
		if (ret) {
			return ret;
		}

		ret = cb(description[i].name, buf, description[i].size, param);
		if (ret) {
			return ret;
		}
	}

	return 0;
}

ssize_t factory_data_load_one(const char *name, uint8_t *value, size_t val_len)
{
	struct sample_factory_data_field_description *d = find_description(name);
	size_t num_bytes;
	int ret;

	if (!factory_data_subsys_initialized) {
		return -ECANCELED;
	}

	if (!d) {
		return -ENOENT;
	}

	num_bytes = MIN(d->size, val_len);

	ret = eeprom_read(eeprom_dev, d->offset, value, num_bytes);
	if (ret) {
		return ret;
	}

	return num_bytes;
}
```
