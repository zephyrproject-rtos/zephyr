/*
 * SPDX-FileCopyrightText: Copyright 2026 NXP
 *
 * SPDX-License-Identifier: Apache-2.0
 */

/*
 * 2x2 key matrix on J11, as in the MCUXpresso SDK kpp example:
 * ROW2 J11-8, ROW3 J11-12, COL2 J11-10, COL3 J11-6.
 */
&pinctrl {
	kpp_default: kpp_default {
		group0 {
			pinmux = <&iomuxc_gpio_ad_30_kpp_row02>,
				 <&iomuxc_gpio_ad_28_kpp_row03>,
				 <&iomuxc_gpio_ad_31_kpp_col02>,
				 <&iomuxc_gpio_ad_29_kpp_col03>;
			drive-strength = "high";
			bias-pull-up;
			slew-rate = "fast";
		};
	};
};

&kpp {
	pinctrl-0 = <&kpp_default>;
	pinctrl-names = "default";
	status = "okay";
};
