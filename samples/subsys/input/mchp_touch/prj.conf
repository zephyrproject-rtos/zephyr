## CMakeLists.txt
```
# SPDX-FileCopyrightText: Copyright (c) 2026 Microchip Technology Inc.
# SPDX-License-Identifier: Apache-2.0

cmake_minimum_required(VERSION 3.20.0)
set(DTC_OVERLAY_FILE "${CMAKE_CURRENT_SOURCE_DIR}/ptc.overlay")
find_package(Zephyr REQUIRED HINTS $ENV{ZEPHYR_BASE})
project(mchp_touch)
target_sources(app PRIVATE src/main.c)
```

## prj.conf
```kconfig
# SPDX-FileCopyrightText: Copyright (c) 2026 Microchip Technology Inc.
# SPDX-License-Identifier: Apache-2.0

CONFIG_GPIO=y
CONFIG_INPUT=y
CONFIG_INPUT_MCHP_TOUCH=y
CONFIG_INPUT_MCHP_TOUCH_EN_FREQ_HOP=y
CONFIG_INPUT_MCHP_TOUCH_EN_FREQ_AUTO_TUNE=y
CONFIG_INPUT_MCHP_TOUCH_DATASTREAMER=y
CONFIG_INPUT_MODE_SYNCHRONOUS=y
CONFIG_INPUT_GPIO_KEYS=n
CONFIG_CONSOLE=n
CONFIG_UART_CONSOLE=n
```

## ptc.overlay
```dts
/*
 * SPDX-FileCopyrightText: Copyright (c) 2026 Microchip Technology Inc.
 * SPDX-License-Identifier: Apache-2.0
 */

/*
 * PTC overlay
 *
 */

&ptc {
	status = "okay";
};
```

## src/main.c
```c
/*
 * SPDX-FileCopyrightText: Copyright (c) 2026 Microchip Technology Inc.
 * SPDX-License-Identifier: Apache-2.0
 */

#include <stdio.h>
#include <zephyr/kernel.h>
#include <zephyr/drivers/gpio.h>
#include <zephyr/input/input.h>
#include <zephyr/input/input_mchp_touch_api.h>

/* 1000 msec = 1 sec */
#define SLEEP_TIME_MS 1000

/* LED on (or) off value */
#define LED_ON  1
#define LED_OFF 0

/* The devicetree node identifier for the "led0" alias. */
#define LED0_NODE  DT_ALIAS(led0)
#define TOUCH_NODE DT_NODELABEL(ptc)

static const struct gpio_dt_spec led0 = GPIO_DT_SPEC_GET(LED0_NODE, gpios);

static void touch_callback(struct input_event *evt, void *user_data)
{
	if (evt != NULL) {
		if (evt->code == INPUT_KEY_0) {
			gpio_pin_set_dt(&led0, evt->value);
		}
	}
}

INPUT_CALLBACK_DEFINE_NAMED(DEVICE_DT_GET(TOUCH_NODE), touch_callback, NULL, button);

int main(void)
{
	int ret;

	if (!gpio_is_ready_dt(&led0)) {
		printk("GPIO controller device is not ready\n");
		return 0;
	}

	/* turn off the led by default */
	ret = gpio_pin_configure_dt(&led0, GPIO_OUTPUT_INIT_LOW);
	if (ret < 0) {
		printk("Failed to configure Led. ret code = %d\n", ret);
		return 0;
	}

	while (1) {
		/* user code */
		k_msleep(SLEEP_TIME_MS);
	}

	return 0;
}
```
