/*
 * Copyright (c) 2026 RAKwireless Technology Limited
 *
 * SPDX-License-Identifier: Apache-2.0
 */

/ {
	aliases {
		nfc0 = &nfc_emul;
	};

	nfc_emul: nfc-reader {
		compatible = "zephyr,nfc-emul";
		backend = "initiator";
		status = "okay";
	};
};
