/*
 * Copyright (c) 2026 RAKwireless Technology Limited
 *
 * SPDX-License-Identifier: Apache-2.0
 */

/ {
	aliases {
		nfc0 = &mfrc522;
	};
};

&spi1 {
	pinctrl-0 = <&spi1_sck_pa5 &spi1_miso_pa6 &spi1_mosi_pa7>;
	pinctrl-names = "default";
	cs-gpios = <&gpioa 3 GPIO_ACTIVE_LOW>;

	mfrc522: mfrc522@0 {
		compatible = "nxp,mfrc522";
		reg = <0>;
		spi-max-frequency = <4000000>;
		irq-gpios = <&gpioa 1 GPIO_ACTIVE_LOW>;
		reset-gpios = <&gpioa 2 GPIO_ACTIVE_LOW>;
	};
};
