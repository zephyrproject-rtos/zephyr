## CMakeLists.txt
```
# Copyright (c) 2026 Espressif Systems (Shanghai) Co., Ltd.
# SPDX-License-Identifier: Apache-2.0

cmake_minimum_required(VERSION 3.28.0)

find_package(Zephyr REQUIRED HINTS $ENV{ZEPHYR_BASE})
project(fota_http)

target_sources(app PRIVATE src/main.c)

if(CONFIG_FOTA_HTTP_TLS)
  set(gen_dir ${ZEPHYR_BINARY_DIR}/include/generated/)
  generate_inc_file_for_target(app src/ca_cert.pem ${gen_dir}/ca_cert.pem.inc)
endif()
```

## Kconfig
```
# Copyright (c) 2026 Espressif Systems (Shanghai) Co., Ltd.
# SPDX-License-Identifier: Apache-2.0

mainmenu "FOTA HTTP sample"

config SAMPLE_FOTA_HTTP_AUTO_URL
	string "Image URL to download once the network is up"
	default ""
	help
	  When set, the sample waits for the connection manager to report
	  the network as connected, then downloads this image on the
	  library thread and prints the progress on the console. The image
	  is only stored. 'fota apply' is still needed to boot it. Leave
	  empty to drive everything from the shell.

source "Kconfig.zephyr"
```

## sysbuild.conf
```
SB_CONFIG_BOOTLOADER_MCUBOOT=y
SB_CONFIG_MCUBOOT_MODE_SWAP_USING_OFFSET=y
```

## prj.conf
```kconfig
CONFIG_MAIN_STACK_SIZE=4096
CONFIG_LOG=y
CONFIG_SHELL=y
CONFIG_KERNEL_SHELL=y

CONFIG_NETWORKING=y
CONFIG_NET_IPV4=y
CONFIG_NET_IPV6=n
CONFIG_NET_TCP=y
CONFIG_NET_SOCKETS=y
CONFIG_NET_DHCPV4=y
CONFIG_NET_MGMT=y
CONFIG_NET_MGMT_EVENT=y
CONFIG_NET_MGMT_EVENT_INFO=y
CONFIG_NET_CONNECTION_MANAGER=y
CONFIG_NET_SHELL=y
CONFIG_DNS_RESOLVER=y
CONFIG_HTTP_CLIENT=y

CONFIG_NET_CONFIG_SETTINGS=y

CONFIG_NET_PKT_RX_COUNT=16
CONFIG_NET_PKT_TX_COUNT=16
CONFIG_NET_BUF_RX_COUNT=32
CONFIG_NET_BUF_TX_COUNT=32

CONFIG_FLASH=y
CONFIG_FLASH_MAP=y
CONFIG_STREAM_FLASH=y
CONFIG_IMG_MANAGER=y
CONFIG_REBOOT=y
CONFIG_BOOTLOADER_MCUBOOT=y

CONFIG_FOTA_HTTP=y
CONFIG_FOTA_HTTP_SHELL=y
```

## resume.conf
```kconfig
CONFIG_NVS=y
CONFIG_SETTINGS=y
CONFIG_SETTINGS_NVS=y
CONFIG_STREAM_FLASH_PROGRESS=y

CONFIG_FOTA_HTTP_RESUME=y
```

## tls.conf
```kconfig
CONFIG_MBEDTLS=y
CONFIG_MBEDTLS_ENABLE_HEAP=y
CONFIG_MBEDTLS_HEAP_SIZE=60000
CONFIG_MBEDTLS_SSL_IN_CONTENT_LEN=16384
CONFIG_MBEDTLS_SSL_OUT_CONTENT_LEN=16384
CONFIG_MBEDTLS_CIPHERSUITE_TLS_ECDHE_RSA_WITH_AES_128_GCM_SHA256=y
CONFIG_MBEDTLS_PEM_PARSE_C=y

CONFIG_NET_SOCKETS_SOCKOPT_TLS=y
CONFIG_TLS_CREDENTIALS=y
CONFIG_TLS_CREDENTIALS_SHELL=y
CONFIG_BASE64=y

CONFIG_FOTA_HTTP_TLS=y
```

## boards/esp32c5_devkitc_esp32c5_hpcore.conf
```kconfig
CONFIG_NET_CONFIG_SETTINGS=n

CONFIG_WIFI=y
CONFIG_NET_L2_WIFI_SHELL=y
```

## src/main.c
```c
/*
 * Copyright (c) 2026 Espressif Systems (Shanghai) Co., Ltd.
 *
 * SPDX-License-Identifier: Apache-2.0
 */

#include <string.h>

#include <zephyr/kernel.h>
#include <zephyr/logging/log.h>
#include <zephyr/mgmt/fota_http.h>
#include <zephyr/net/conn_mgr_monitor.h>
#include <zephyr/net/net_event.h>
#include <zephyr/net/net_mgmt.h>

LOG_MODULE_REGISTER(main, LOG_LEVEL_INF);

#if defined(CONFIG_FOTA_HTTP_TLS)
static const unsigned char ca_certificate[] = {
#include "ca_cert.pem.inc"
	0x00,
};
#endif

static K_SEM_DEFINE(network_connected, 0, 1);
static struct net_mgmt_event_callback l4_cb;
static int last_pct;

static void l4_event_handler(struct net_mgmt_event_callback *cb, uint64_t mgmt_event,
			     struct net_if *iface)
{
	if (mgmt_event == NET_EVENT_L4_CONNECTED) {
		k_sem_give(&network_connected);
	}
}

static void progress_cb(const struct fota_http_progress *progress, void *user_data)
{
	int pct;

	if (progress->total == 0) {
		return;
	}

	pct = (int)(progress->written * 100 / progress->total);
	if (pct / 10 != last_pct / 10) {
		last_pct = pct;
		LOG_INF("Downloaded %zu of %zu bytes (%d%%)", progress->written, progress->total,
			pct);
	}
}

static void done_cb(int result, void *user_data)
{
	if (result != 0) {
		LOG_ERR("Download failed (%d)", result);
		return;
	}

	LOG_INF("Stored %zu bytes in the secondary slot, run 'fota apply' to boot it",
		fota_http_nvm_bytes_written());
}

static bool secondary_holds_running_version(void)
{
	struct mcuboot_img_header running;
	struct mcuboot_img_header secondary;

	if (boot_read_bank_header(boot_fetch_active_slot_area_id(), &running, sizeof(running)) !=
		    0 ||
	    fota_http_get_image_header(0, &secondary) != 0) {
		return false;
	}

	return memcmp(&running.h.v1.sem_ver, &secondary.h.v1.sem_ver,
		      sizeof(running.h.v1.sem_ver)) == 0;
}

static void auto_download(void)
{
	static const struct fota_http_download_params params = {
		.url = CONFIG_SAMPLE_FOTA_HTTP_AUTO_URL,
		.progress_cb = progress_cb,
#if defined(CONFIG_FOTA_HTTP_RESUME)
		.resume = true,
#endif
	};
	int ret;

	if (fota_http_confirm_pending()) {
		LOG_WRN("Running image is not confirmed, skipping the automatic download");
		return;
	}

	if (secondary_holds_running_version()) {
		LOG_INF("Secondary slot already holds the running version");
		return;
	}

	net_mgmt_init_event_callback(&l4_cb, l4_event_handler, NET_EVENT_L4_CONNECTED);
	net_mgmt_add_event_callback(&l4_cb);
	conn_mgr_mon_resend_status();

	LOG_INF("Waiting for the network to download %s", params.url);
	k_sem_take(&network_connected, K_FOREVER);

	ret = fota_http_download_async(&params, done_cb);
	if (ret != 0) {
		LOG_ERR("Cannot start download (%d)", ret);
	}
}

int main(void)
{
	LOG_INF("FOTA HTTP sample, image version %s", CONFIG_MCUBOOT_IMGTOOL_SIGN_VERSION);

	if (fota_http_confirm_pending()) {
		LOG_WRN("Running a test image, confirm it with 'fota confirm' or "
			"reboot to revert");
	} else {
		LOG_INF("Running a confirmed image");
	}

#if defined(CONFIG_FOTA_HTTP_TLS)
	if (fota_http_tls_add_ca(ca_certificate, sizeof(ca_certificate)) != 0) {
		LOG_ERR("Failed to register the CA certificate");
	}
#endif

	if (sizeof(CONFIG_SAMPLE_FOTA_HTTP_AUTO_URL) > 1) {
		auto_download();
		return 0;
	}

	LOG_INF("Bring the network up, then run:");
	LOG_INF("  fota download http://<host>:<port>/zephyr.signed.bin");
	LOG_INF("  fota apply");
	LOG_INF("  kernel reboot cold");

	return 0;
}
```

## src/ca_certificate.h
```c
/*
 * Copyright (c) 2026 Espressif Systems (Shanghai) Co., Ltd.
 *
 * SPDX-License-Identifier: Apache-2.0
 */

#ifndef CA_CERTIFICATE_H_
#define CA_CERTIFICATE_H_

/* Self-signed test certificate for localhost, replace it with the server's CA. */
static const unsigned char ca_certificate[] =
	"-----BEGIN CERTIFICATE-----\r\n"
	"MIIDJzCCAg+gAwIBAgIUCvlxxYDX0QDpTj+8mHduQJfL36MwDQYJKoZIhvcNAQEL\r\n"
	"BQAwFDESMBAGA1UEAwwJbG9jYWxob3N0MCAXDTI2MDkwNDE2MTg1NloYDzIxMjYw\r\n"
	"ODExMTYxODU2WjAUMRIwEAYDVQQDDAlsb2NhbGhvc3QwggEiMA0GCSqGSIb3DQEB\r\n"
	"AQUAA4IBDwAwggEKAoIBAQC+NOVyZ9cyisDfBVAfTmb3Ml6eMeKkL1K6+fEK/To0\r\n"
	"k5EVz2E3v/Rbrf4IeqdZ+26YX0aSNajWXsSDJT1Elvq0b+DuSv4krdZGd4Thgx33\r\n"
	"7QtNncKkbSCXFjrNQ5dcu4iDHguDDx1aouvvlPoBTe8LPLf4lmJhXVTPJ/kz1wiF\r\n"
	"wruWb15Jzd8z1wTvbfQ14yiuWMjmU1xlEIT+i7qpU3mZXwi4Y3Yn7pceIRz8jy+M\r\n"
	"jcYrcKLQW90iI6Hx+FD5XvtgPOTwE3+u0NLd2FzQO+Nz9emGAMtftRTn0NASl1qQ\r\n"
	"1r9m0RwnOODx6CNg5yQL021Bdei4hdaNDsrLorzW0asBAgMBAAGjbzBtMB0GA1Ud\r\n"
	"DgQWBBQZ11rhHi7VlRYCqj71OlGaaV8HbzAfBgNVHSMEGDAWgBQZ11rhHi7VlRYC\r\n"
	"qj71OlGaaV8HbzAPBgNVHRMBAf8EBTADAQH/MBoGA1UdEQQTMBGCCWxvY2FsaG9z\r\n"
	"dIcEfwAAATANBgkqhkiG9w0BAQsFAAOCAQEAajFfYRnby8AJ8f3T6n6TEYkz5617\r\n"
	"6Wl1STAqwbxwT5TiOwjGwlM/FkK3lsdZAGjH46dbGLAtxfqjrgjuKHBiyZq54+kP\r\n"
	"2req8kiA6psOPKMDyhJEkeYqSaJl2z88eEpZ902fFxRLz17TgSOyJ3CRgw5WRkmc\r\n"
	"rZja3hNuHH6AEyJJVTqu3XDv3HCQLE3E4KRpIf4dt/yq5hJGkAo/QROE0egeeFD5\r\n"
	"rigiS98Fs7aHhVbPrEWiV35EFnUA1gY8haOnFJIeOY8qduMnJBvtam9/ewqPxe60\r\n"
	"kV1hkEWrDKOzVtxaLJAuh68NJTuUy5GTjW7Z1+ed4cMZ0bmdyNPIRbt8qA==\r\n"
	"-----END CERTIFICATE-----\r\n";

#endif /* CA_CERTIFICATE_H_ */
```
