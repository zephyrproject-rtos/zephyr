## CMakeLists.txt
```
# SPDX-License-Identifier: Apache-2.0

cmake_minimum_required(VERSION 3.20.0)
find_package(Zephyr REQUIRED HINTS $ENV{ZEPHYR_BASE})
project(ec_host_cmd_usb)

include(${ZEPHYR_BASE}/samples/subsys/usb/common/common.cmake)
FILE(GLOB app_sources src/*.c)
target_sources(app PRIVATE ${app_sources})
```

## Kconfig
```
# Copyright 2026 Google LLC
# SPDX-License-Identifier: Apache-2.0

source "samples/subsys/usb/common/Kconfig.sample_usbd"

source "Kconfig.zephyr"
```

## sample.yaml
```
sample:
  name: EC Host Commands over USB
tests:
  sample.mgmt.ec_host_cmd_usb:
    depends_on: usbd
    tags: usb
    build_only: true
    platform_allow:
      - nucleo_c071rb
```

## prj.conf
```kconfig
CONFIG_USB_DEVICE_STACK_NEXT=y
CONFIG_CDC_ACM_SERIAL_INITIALIZE_AT_BOOT=n
CONFIG_UDC_BUF_POOL_SIZE=2048

CONFIG_LOG=y
CONFIG_INPUT=y
CONFIG_USBD_LOG_LEVEL_WRN=y
CONFIG_UDC_DRIVER_LOG_LEVEL_WRN=y
CONFIG_SAMPLE_USBD_VID=0x18d1

CONFIG_EC_HOST_CMD=y
CONFIG_EC_HOST_CMD_DEDICATED_THREAD=y
CONFIG_UDC_DRIVER_HIGH_SPEED_SUPPORT_ENABLED=n
CONFIG_USBD_MAX_SPEED_FULL=y
```

## src/main.c
```c
/*
 * Copyright 2026 Google LLC
 *
 * SPDX-License-Identifier: Apache-2.0
 */

#include <zephyr/logging/log.h>
#include <sample_usbd.h>

LOG_MODULE_REGISTER(main, LOG_LEVEL_INF);

int main(void)
{
	struct usbd_context *sample_usbd;
	int ret;

	LOG_INF("EC Host Command over USB sample started");

	sample_usbd = sample_usbd_setup_device(NULL);
	if (sample_usbd == NULL) {
		LOG_ERR("Failed to setup USB device");
		return -ENODEV;
	}

	ret = usbd_init(sample_usbd);
	if (ret) {
		LOG_ERR("Failed to initialize device support");
		return ret;
	}

	ret = usbd_enable(sample_usbd);
	if (ret) {
		LOG_ERR("Failed to enable device support");
		return ret;
	}

	k_sleep(K_FOREVER);

	return 0;
}
```

## src/host_commands.c
```c
/*
 * Copyright 2026 Google LLC
 *
 * SPDX-License-Identifier: Apache-2.0
 */

#include <zephyr/device.h>
#include <zephyr/input/input.h>
#include <zephyr/kernel.h>
#include <zephyr/logging/log.h>
#include <zephyr/mgmt/ec_host_cmd/ec_host_cmd.h>
#include <zephyr/version.h>

#include "host_commands.h"

LOG_MODULE_REGISTER(host_commands, LOG_LEVEL_INF);

#define USBHC_MAX_REQUEST_SIZE CONFIG_EC_HOST_CMD_HANDLER_RX_BUFFER_SIZE
#define USBHC_MAX_RESPONSE_SIZE CONFIG_EC_HOST_CMD_HANDLER_TX_BUFFER_SIZE

static uint8_t row0;
#define MKBP_COLS 8

static void mod_input_cb(struct input_event *evt, void *user_data)
{
	uint8_t bit;

	if (!evt->sync) {
		return;
	}

	switch (evt->code) {
	case INPUT_KEY_0:
	case INPUT_KEY_A:
		bit = 0;
		break;
	case INPUT_KEY_1:
	case INPUT_KEY_B:
		bit = 1;
		break;
	case INPUT_KEY_2:
	case INPUT_KEY_C:
		bit = 2;
		break;
	case INPUT_KEY_3:
	case INPUT_KEY_D:
		bit = 3;
		break;
	default:
		return;
	}

	if (evt->value) {
		row0 |= BIT(bit);
	} else {
		row0 &= ~BIT(bit);
	}

	ec_host_cmd_backend_usb_trigger_event();
}

INPUT_CALLBACK_DEFINE(NULL, mod_input_cb, NULL);

static enum ec_host_cmd_status ec_cmd_version(struct ec_host_cmd_handler_args *args)
{
	struct ec_response_get_version_v1 *const response = args->output_buf;

	strncpy(response->version_string_ro,
		STRINGIFY(BUILD_VERSION), sizeof(response->version_string_ro));

	if (args->version == 0) {
		args->output_buf_size = sizeof(struct ec_response_get_version);
	} else {
		args->output_buf_size = sizeof(*response);
	}

	return EC_HOST_CMD_SUCCESS;
}

EC_HOST_CMD_HANDLER_RESP_ONLY(EC_CMD_GET_VERSION, ec_cmd_version, BIT(1) | BIT(0),
			      struct ec_response_get_version_v1);


static enum ec_host_cmd_status host_command_protocol_info(struct ec_host_cmd_handler_args *args)
{
	struct ec_response_get_protocol_info *r = args->output_buf;

	memset(r, 0, sizeof(*r));
	r->protocol_versions |= BIT(3);
	r->max_request_packet_size = USBHC_MAX_REQUEST_SIZE;
	r->max_response_packet_size = USBHC_MAX_RESPONSE_SIZE;
	r->flags = EC_PROTOCOL_INFO_IN_PROGRESS_SUPPORTED;

	args->output_buf_size = sizeof(*r);

	return EC_HOST_CMD_SUCCESS;
}

EC_HOST_CMD_HANDLER_RESP_ONLY(EC_CMD_GET_PROTOCOL_INFO, host_command_protocol_info, BIT(0),
			      struct ec_response_get_protocol_info);

static enum ec_host_cmd_status hc_get_features(struct ec_host_cmd_handler_args *args)
{
	struct ec_response_get_features *r = args->output_buf;

	memset(r, 0, sizeof(*r));
	r->flags[0] = 0;
	r->flags[1] = 0;

	args->output_buf_size = sizeof(*r);

	return EC_HOST_CMD_SUCCESS;
}

EC_HOST_CMD_HANDLER_RESP_ONLY(EC_CMD_GET_FEATURES, hc_get_features, BIT(0),
			      struct ec_response_get_features);

static enum ec_host_cmd_status ec_mkbp_info(struct ec_host_cmd_handler_args *args)
{
	const struct ec_params_mkbp_info *p = args->input_buf;

	switch (p->info_type) {
	case EC_MKBP_INFO_SUPPORTED:
		union ec_response_get_next_data *r = args->output_buf;

		switch (p->event_type) {
		case EC_MKBP_EVENT_BUTTON:
			r->buttons = 0;
			args->output_buf_size = sizeof(r->buttons);
			return EC_HOST_CMD_SUCCESS;
		case EC_MKBP_EVENT_SWITCH:
			r->switches = 0;
			args->output_buf_size = sizeof(r->switches);
			return EC_HOST_CMD_SUCCESS;
		default:
			return EC_HOST_CMD_INVALID_PARAM;
		}
	default:
		return EC_HOST_CMD_INVALID_PARAM;
	}
}

EC_HOST_CMD_HANDLER(EC_CMD_MKBP_INFO, ec_mkbp_info, BIT(1),
		    struct ec_params_mkbp_info, struct ec_response_mkbp_info);

static enum ec_host_cmd_status mkbp_get_next_event(struct ec_host_cmd_handler_args *args)
{
	struct ec_response_get_next_event_v3 *r = args->output_buf;

	memset(r, 0, sizeof(*r));

	r->event_type = EC_MKBP_EVENT_KEY_MATRIX;
	r->data.key_matrix[0] = row0;

	args->output_buf_size = MKBP_COLS + 1;

	return EC_HOST_CMD_SUCCESS;
}

EC_HOST_CMD_HANDLER_RESP_ONLY(EC_CMD_GET_NEXT_EVENT, mkbp_get_next_event, BIT(3),
			      struct ec_response_get_next_event_v3);

static enum ec_host_cmd_status ec_get_cmd_versions(struct ec_host_cmd_handler_args *args)
{
	const struct ec_params_get_cmd_versions *p = args->input_buf;
	struct ec_response_get_cmd_versions *r = args->output_buf;

	STRUCT_SECTION_FOREACH(ec_host_cmd_handler, handler) {
		if (p->cmd == handler->id) {
			r->version_mask = handler->version_mask;
			args->output_buf_size = sizeof(*r);
			return EC_HOST_CMD_SUCCESS;
		}
	}

	return EC_HOST_CMD_INVALID_PARAM;
}

EC_HOST_CMD_HANDLER(EC_CMD_GET_CMD_VERSIONS, ec_get_cmd_versions, BIT(0),
		    struct ec_params_get_cmd_versions,
		    struct ec_response_get_cmd_versions);

static enum ec_host_cmd_status get_uptime_info(struct ec_host_cmd_handler_args *args)
{
	struct ec_response_uptime_info *r = args->output_buf;

	memset(r, 0, sizeof(*r));

	r->time_since_ec_boot_ms = k_uptime_get_32();
	args->output_buf_size = sizeof(*r);

	return EC_HOST_CMD_SUCCESS;
}

EC_HOST_CMD_HANDLER_RESP_ONLY(EC_CMD_GET_UPTIME_INFO, get_uptime_info, BIT(0),
			      struct ec_response_uptime_info);
```

## src/host_commands.h
```c
/*
 * Copyright 2026 Google LLC
 *
 * SPDX-License-Identifier: Apache-2.0
 *
 * Subset of command request/response formats, full list:
 * https://chromium.googlesource.com/chromiumos/platform/ec/+/refs/heads/main/include/ec_commands.h
 */

#include <stdint.h>

#define EC_CMD_GET_VERSION 0x0002

struct ec_response_get_version {
	char version_string_ro[32];
	char version_string_rw[32];
	char reserved[32]; /* Changed to cros_fwid_ro in version 1 */
	uint32_t current_image;
} __packed __aligned(4);

struct ec_response_get_version_v1 {
	char version_string_ro[32];
	char version_string_rw[32];
	char cros_fwid_ro[32]; /* Added in version 1 (Used to be reserved) */
	uint32_t current_image;
	char cros_fwid_rw[32]; /* Added in version 1 */
} __packed __aligned(4);

#define EC_CMD_GET_CMD_VERSIONS 0x0008

struct ec_params_get_cmd_versions {
	uint8_t cmd;
} __packed;

struct ec_response_get_cmd_versions {
	uint32_t version_mask;
} __packed __aligned(4);

#define EC_CMD_GET_PROTOCOL_INFO 0x000B

struct ec_response_get_protocol_info {
	/* Fields which exist if at least protocol version 3 supported */
	uint32_t protocol_versions;
	uint16_t max_request_packet_size;
	uint16_t max_response_packet_size;
	uint32_t flags;
} __packed __aligned(4);

#define EC_PROTOCOL_INFO_IN_PROGRESS_SUPPORTED BIT(0)

#define EC_CMD_GET_FEATURES 0x000D

struct ec_response_get_features {
	uint32_t flags[2];
} __packed __aligned(4);

#define EC_CMD_MKBP_INFO 0x0061

struct ec_response_mkbp_info {
	uint32_t rows;
	uint32_t cols;
	uint8_t reserved;
} __packed;

struct ec_params_mkbp_info {
	uint8_t info_type;
	uint8_t event_type;
} __packed;

enum ec_mkbp_info_type {
	EC_MKBP_INFO_SUPPORTED = 1,
};

enum ec_mkbp_event {
	EC_MKBP_EVENT_KEY_MATRIX = 0,
	EC_MKBP_EVENT_BUTTON = 3,
	EC_MKBP_EVENT_SWITCH = 4,
};

union ec_response_get_next_data {
	uint8_t key_matrix[13];
	uint32_t host_event;
	uint64_t host_event64;
	uint32_t buttons;
	uint32_t switches;
	uint32_t fp_events;
	uint32_t sysrq;
	uint32_t cec_events;
} __packed;

#define EC_CMD_GET_NEXT_EVENT 0x0067

#define EC_MKBP_HAS_MORE_EVENTS_SHIFT 7
#define EC_MKBP_HAS_MORE_EVENTS BIT(EC_MKBP_HAS_MORE_EVENTS_SHIFT)
#define EC_MKBP_EVENT_TYPE_MASK (BIT(EC_MKBP_HAS_MORE_EVENTS_SHIFT) - 1)

union ec_response_get_next_data_v3 {
	uint8_t key_matrix[18];
	uint32_t host_event;
	uint64_t host_event64;
	uint32_t buttons;
	uint32_t switches;
	uint32_t fp_events;
	uint32_t sysrq;
	uint32_t cec_events;
	uint8_t cec_message[16];
} __packed;

struct ec_response_get_next_event_v3 {
	uint8_t event_type;
	union ec_response_get_next_data_v3 data;
} __packed;

#define EC_CMD_GET_UPTIME_INFO 0x0121

struct ec_response_uptime_info {
	uint32_t time_since_ec_boot_ms;
	uint32_t ap_resets_since_ec_boot;
	uint32_t ec_reset_flags;
	struct ap_reset_log_entry {
		uint16_t reset_cause;
		uint16_t reserved;
		uint32_t reset_time_ms;
	} recent_ap_reset[4];
} __packed __aligned(4);
```
