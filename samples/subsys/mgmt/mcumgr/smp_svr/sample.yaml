## samples/subsys/mp/dmic_i2s/Kconfig
```kconfig
# Copyright 2026 NXP
# SPDX-License-Identifier: Apache-2.0

source "Kconfig.zephyr"

choice SAMPLE_AUDIO_SOURCE
	prompt "Capture source the pipeline reads from"
	default SAMPLE_AUDIO_SOURCE_DMIC
	help
	  Which source element the pipeline is built with. The rest of the
	  pipeline is the same either way.

config SAMPLE_AUDIO_SOURCE_DMIC
	bool "Digital microphone"
	help
	  Capture from a PDM microphone through the DMIC API. Requires a
	  dmic_dev node label.

config SAMPLE_AUDIO_SOURCE_I2S
	bool "I2S receiver"
	help
	  Capture from an I2S receiver, either a microphone that outputs I2S
	  directly or a codec's ADC. Requires an i2s-codec-rx alias, and an
	  audio-codec-capture alias when the capture path runs through a codec
	  that has to be configured.

endchoice

config SAMPLE_AUDIO_GAIN_PERCENT
	int "Gain applied by the pipeline (percent)"
	default 90
	range 0 1000
	help
	  Gain the pipeline's gain element applies, as a percentage: 0 mutes,
	  100 is unity and 1000 amplifies ten times. Values above 100 can clip,
	  in which case samples saturate at full scale.

config USE_I2S_TARGET_CODEC_CONTROLLER
	bool "I2S BCK is generated by a selected codec device"
	help
	  If selected, the I2S selected peripheral will be configured to consume
	  (receive) the I2S BCK and WS signals and the codec will be configured
	  to generate those. If not selected, the I2S peripheral will generate
	  them and the codec will be expected to consume them.
```

## samples/subsys/mp/dmic_i2s/boards/mcx_n5xx_evk_mcxn547_cpu0.conf
```kconfig
# Copyright 2026 NXP
#
# SPDX-License-Identifier: Apache-2.0

CONFIG_I3C=y
CONFIG_AUDIO_CODEC=y

CONFIG_MP_ZAUD_BUFFER_POOL_SZ_MAX=4096
CONFIG_MP_ZAUD_BUFFER_POOL_NUM_MAX=8

CONFIG_DMA_TCD_QUEUE_SIZE=4
CONFIG_AUDIO_CODEC_DA7212=y
```

## samples/subsys/mp/dmic_i2s/sample.yaml
```yaml
sample:
  name: Audio loopback pipeline sample

tests:
  sample.mp.audio_loopback:
    tags:
      - audio
      - samples
    platform_allow:
      - mimxrt685_evk/mimxrt685s/cm33
      - mimxrt1170_evk@B/mimxrt1176/cm7
      - mimxrt595_evk/mimxrt595s/cm33
      - mcx_n5xx_evk/mcxn547/cpu0
      - native_sim/native/64
    harness: console
    harness_config:
      type: one_line
      regex:
        - "Capture started"

  # Run the pipeline headless on native_sim and compare its output against the
  # input scaled by the configured gain. Unity gain and a gain above unity are
  # both covered, the latter exercising saturation.
  sample.mp.audio_loopback.output.unity_gain:
    tags:
      - audio
      - samples
    platform_allow:
      - native_sim/native/64
    integration_platforms:
      - native_sim/native/64
    extra_configs:
      - CONFIG_SAMPLE_AUDIO_GAIN_PERCENT=100
    harness: pytest
    harness_config:
      pytest_root:
        - "pytest/test_pipeline.py"

  sample.mp.audio_loopback.output.amplified:
    tags:
      - audio
      - samples
    platform_allow:
      - native_sim/native/64
    integration_platforms:
      - native_sim/native/64
    extra_configs:
      - CONFIG_SAMPLE_AUDIO_GAIN_PERCENT=200
    harness: pytest
    harness_config:
      pytest_root:
        - "pytest/test_pipeline.py"

  # The same pipeline reading from an I2S receiver instead of a DMIC. Built for
  # every board here that has an i2s-codec-rx alias.
  sample.mp.audio_loopback.i2s_source:
    tags:
      - audio
      - samples
    platform_allow:
      - mimxrt685_evk/mimxrt685s/cm33
      - mimxrt595_evk/mimxrt595s/cm33
      - mcx_n5xx_evk/mcxn547/cpu0
      - native_sim/native/64
    integration_platforms:
      - native_sim/native/64
    extra_configs:
      - CONFIG_SAMPLE_AUDIO_SOURCE_I2S=y
    harness: console
    harness_config:
      type: one_line
      regex:
        - "Capture started"

  sample.mp.audio_loopback.i2s_source.output:
    tags:
      - audio
      - samples
    platform_allow:
      - native_sim/native/64
    integration_platforms:
      - native_sim/native/64
    extra_configs:
      - CONFIG_SAMPLE_AUDIO_SOURCE_I2S=y
      - CONFIG_SAMPLE_AUDIO_GAIN_PERCENT=200
    harness: pytest
    harness_config:
      pytest_root:
        - "pytest/test_pipeline.py"
```

## samples/subsys/mp/fs/boards/native_sim_64.conf
```kconfig
# native_sim uses a flash-backed file (flash.bin) to emulate SDCard.
CONFIG_FLASH_SIMULATOR=y
CONFIG_DISK_DRIVER_FLASH=y
```

## samples/subsys/mp/ipc_multi_core/Kconfig.sysbuild
```kconfig
# Copyright 2026 NXP
# SPDX-License-Identifier: Apache-2.0

source "$(ZEPHYR_BASE)/share/sysbuild/Kconfig"

config REMOTE_BOARD
	string "The board used for remote target"
	default "mps2/an521/cpu1" if BOARD_MPS2_AN521_CPU0
	default "nrf5340dk/nrf5340/cpunet" if BOARD_NRF5340DK_NRF5340_CPUAPP
```

## samples/subsys/mp/ipc_multi_core/remote/dts/bindings/zephyr,mbox-mock.yaml
```yaml
description: Mock MBOX-to-IPM Shim

compatible: "zephyr,mbox-mock"

include: base.yaml

properties:
  "#mbox-cells":
    type: int
    const: 0
```

## samples/subsys/mp/jpeg_dec/Kconfig
```kconfig
# Copyright 2026 NXP
# SPDX-License-Identifier: Apache-2.0

mainmenu "MJPEG decode pipeline"

menu "Pipeline configuration"

config FILE_INPUT_PATH
	string "Input MJPEG file path"
	default "/SD:/test.mjpeg"
	help
	  Absolute path to the MJPEG input file.

config JPEG_IMAGE_WIDTH
	int "Width of the decoded JPEG image"
	default 320

config JPEG_IMAGE_HEIGHT
	int "Height of the decoded JPEG image"
	default 240

config MJPEG_NUM_FRAMES
	int "Number of frames in the generated test MJPEG file"
	default 150
	help
	  Number of video frames to generate in the test MJPEG file.
	  The file is produced at build time using GStreamer CLI.

config VIDEO_ROTATION_ANGLE
	int "Rotate the decoded frame by a specified angle"
	range 0 270
	default 0
	help
	  Specify one of these values {0, 90, 180, 270} in degree to rotate the video frame.
	  Only applies when a zephyr,videotrans device is present.

endmenu

source "Kconfig.zephyr"
```

## samples/subsys/mp/jpeg_dec/boards/mimxrt1170_evk_mimxrt1176_cm7.conf
```kconfig
CONFIG_VIDEO_BUFFER_POOL_NUM_MAX=2
CONFIG_VIDEO_BUFFER_POOL_HEAP_SIZE=307600
CONFIG_VIDEO_ROTATION_ANGLE=90

CONFIG_MP_VID=y
CONFIG_MP_VID_CONVERT=y
```

## samples/subsys/mp/jpeg_dec/boards/mimxrt700_evk_mimxrt798s_cm33_cpu0.conf
```kconfig
CONFIG_DCACHE=n
# 3 (jpeg decoder: 2 input + 1 output) + 1 (video converter output)
CONFIG_VIDEO_BUFFER_POOL_NUM_MAX=4
# Resolution: 320x240, Format: NV12 + RGB565 + 2 * JPEG + alignment = 320 * 240 * (1.5 + 2 + 2 * 2) + alignment
CONFIG_VIDEO_BUFFER_POOL_HEAP_SIZE=580000
CONFIG_VIDEO_BUFFER_POOL_ZEPHYR_REGION=y
CONFIG_VIDEO_BUFFER_POOL_ZEPHYR_REGION_NAME="SRAM1"

CONFIG_MP_PLUGIN_ZVID=y
CONFIG_MP_ZVID_CONVERT=y
```
