## samples/subsys/mgmt/mcumgr/smp_svr/sample.yaml
```yaml
sample:
  description: Simple Management Protocol sample
  name: smp svr
common:
  sysbuild: true
  build_only: true
tests:
  sample.mcumgr.smp_svr.bt:
    harness: bluetooth
    tags: bluetooth
    extra_args: EXTRA_CONF_FILE="overlay-bt.conf"
    platform_allow:
      - nrf52dk/nrf52832
      - nrf52840dk/nrf52840
      - pinnacle_100_dvk
      - mg100
    integration_platforms:
      - nrf52dk/nrf52832
      - nrf52840dk/nrf52840
  sample.mcumgr.smp_svr.bt_static_svc:
    harness: bluetooth
    tags: bluetooth
    extra_args: EXTRA_CONF_FILE="overlay-bt.conf"
    extra_configs:
      - CONFIG_MCUMGR_TRANSPORT_BT_DYNAMIC_SVC_REGISTRATION=n
    platform_allow:
      - nrf52840dk/nrf52840
      - pinnacle_100_dvk
      - mg100
    integration_platforms:
      - nrf52840dk/nrf52840
  sample.mcumgr.smp_svr.udp:
    extra_args: EXTRA_CONF_FILE="overlay-udp.conf"
    platform_allow:
      - frdm_mcxn947/mcxn947/cpu0
      - mcx_n9xx_evk/mcxn947/cpu0
      - frdm_k64f
    integration_platforms:
      - frdm_k64f
  sample.mcumgr.smp_svr.cdc:
    extra_args:
      - EXTRA_CONF_FILE="overlay-cdc.conf"
      - DTC_OVERLAY_FILE="usb.overlay"
    platform_allow:
      - frdm_mcxn947/mcxn947/cpu0
      - mcx_n9xx_evk/mcxn947/cpu0
      - nrf52833dk/nrf52820
      - nrf52833dk/nrf52833
      - nrf52840dk/nrf52840
      - nrf5340dk/nrf5340/cpuapp
      - pinnacle_100_dvk
    integration_platforms:
      - nrf52833dk/nrf52820
      - nrf52833dk/nrf52833
      - nrf52840dk/nrf52840
      - nrf5340dk/nrf5340/cpuapp
  sample.mcumgr.smp_svr.serial:
    extra_args: EXTRA_CONF_FILE="overlay-serial.conf"
    platform_allow:
      - frdm_k22f
      - frdm_k64f
      - frdm_k82f
      - frdm_ke17z
      - frdm_ke17z512
      - rddrone_fmuk66
      - twr_ke18f
      - twr_kv58f220m
      - frdm_mcxn947/mcxn947/cpu0
      - mcx_n9xx_evk/mcxn947/cpu0
      - lpcxpresso55s06
      - lpcxpresso55s16
      - lpcxpresso55s28
      - lpcxpresso55s36
      - lpcxpresso55s69/lpc55s69/cpu0
      - mimxrt1010_evk
      - mimxrt1015_evk
      - mimxrt1020_evk
      - mimxrt1024_evk
      - mimxrt1040_evk
      - mimxrt1050_evk/mimxrt1052/hyperflash
      - mimxrt1060_evk/mimxrt1062/qspi
      - mimxrt1062_fmurt6
      - mimxrt1064_evk
      - mimxrt1160_evk/mimxrt1166/cm7
      - mimxrt1170_evk/mimxrt1176/cm7
      - vmu_rt1170/mimxrt1176/cm7
      - mimxrt595_evk/mimxrt595s/cm33
      - mimxrt685_evk/mimxrt685s/cm33
      - rd_rw612_bga
      - nrf52840dk/nrf52840
      - nrf54h20dk/nrf54h20/cpuapp
      - pinnacle_100_dvk
      - mg100
    integration_platforms:
      - nrf52840dk/nrf52840
  # In mcuboot_flags test overlay-serial.conf is used for convenience as it is the simplest
  # transport. Transport does not affect flags so it does not really matter which is selected,
  # flags should affect any transport the same way.
  sample.mcumgr.smp_svr.mcuboot_flags.direct_xip_withrevert:
    extra_args:
      - EXTRA_CONF_FILE="overlay-serial.conf"
      - SB_CONFIG_MCUBOOT_MODE_DIRECT_XIP_WITH_REVERT=y
    platform_allow:
      - nrf52840dk/nrf52840
      - pinnacle_100_dvk
      - mg100
    integration_platforms:
      - nrf52840dk/nrf52840
  sample.mcumgr.smp_svr.serial-console:
    extra_args: EXTRA_CONF_FILE="overlay-serial-console.conf"
    platform_allow:
      - nrf52840dk/nrf52840
      - pinnacle_100_dvk
      - mg100
    integration_platforms:
      - nrf52840dk/nrf52840
  sample.mcumgr.smp_svr.shell:
    extra_args: EXTRA_CONF_FILE="overlay-shell.conf"
    platform_allow:
      - frdm_k22f
      - frdm_k64f
      - frdm_k82f
      - frdm_ke17z
      - frdm_ke17z512
      - rddrone_fmuk66
      - twr_ke18f
      - twr_kv58f220m
      - frdm_mcxn947/mcxn947/cpu0
      - mcx_n9xx_evk/mcxn947/cpu0
      - lpcxpresso55s06
      - lpcxpresso55s16
      - lpcxpresso55s28
      - lpcxpresso55s36
      - lpcxpresso55s69/lpc55s69/cpu0
      - mimxrt1010_evk
      - mimxrt1015_evk
      - mimxrt1020_evk
      - mimxrt1024_evk
      - mimxrt1040_evk
      - mimxrt1050_evk/mimxrt1052/hyperflash
      - mimxrt1060_evk/mimxrt1062/qspi
      - mimxrt1062_fmurt6
      - mimxrt1064_evk
      - mimxrt1160_evk/mimxrt1166/cm7
      - mimxrt1170_evk/mimxrt1176/cm7
      - vmu_rt1170/mimxrt1176/cm7
      - mimxrt595_evk/mimxrt595s/cm33
      - mimxrt685_evk/mimxrt685s/cm33
      - rd_rw612_bga
      - nrf52840dk/nrf52840
      - pinnacle_100_dvk
      - mg100
    integration_platforms:
      - nrf52840dk/nrf52840
      - mimxrt1060_evk/mimxrt1062/qspi
      - mimxrt1064_evk
  sample.mcumgr.smp_svr.shell_mgmt:
    extra_args: EXTRA_CONF_FILE="overlay-shell-mgmt.conf"
    platform_allow:
      - nrf52840dk/nrf52840
      - pinnacle_100_dvk
      - mg100
    integration_platforms:
      - nrf52840dk/nrf52840
  sample.mcumgr.smp_svr.fs:
    extra_args: EXTRA_CONF_FILE="overlay-fs.conf"
    platform_allow:
      - nrf52840dk/nrf52840
      - pinnacle_100_dvk
      - mg100
    integration_platforms:
      - nrf52840dk/nrf52840
  sample.mcumgr.smp_svr.ram_load:
    extra_args: FILE_SUFFIX="ram_load"
    platform_allow:
      - nrf52840dk/nrf52840
    integration_platforms:
      - nrf52840dk/nrf52840
  sample.mcumgr.smp_svr.ram_load.serial:
    extra_args:
      - FILE_SUFFIX="ram_load"
      - EXTRA_CONF_FILE="overlay-serial.conf"
    platform_allow:
      - nrf52840dk/nrf52840
      - mimxrt1050_evk/mimxrt1052/hyperflash
  sample.mcumgr.smp_svr.ram_load_revert.serial:
    extra_args:
      - FILE_SUFFIX="ram_load"
      - EXTRA_CONF_FILE="overlay-serial.conf"
      - SB_CONFIG_MCUBOOT_MODE_RAM_LOAD_WITH_REVERT=y
      - smp_svr_CONFIG_MCUBOOT_GENERATE_CONFIRMED_IMAGE=y
    platform_allow:
      - mimxrt1050_evk/mimxrt1052/hyperflash
    integration_platforms:
      - mimxrt1050_evk/mimxrt1052/hyperflash
  sample.mcumgr.smp_svr.ram_load.serial.fs.shell:
    extra_args:
      - FILE_SUFFIX="ram_load"
      - EXTRA_CONF_FILE="overlay-serial.conf;overlay-fs.conf;overlay-shell.conf"
    platform_allow:
      - nrf52840dk/nrf52840
    integration_platforms:
      - nrf52840dk/nrf52840
```

## samples/subsys/mgmt/osdp/control_panel/sample.yaml
```yaml
sample:
  description: OSDP Control Panel Sample
  name: osdp
tests:
  sample.mgmt.osdp.control_panel:
    tags: osdp
    depends_on: gpio
    filter: dt_enabled_alias_with_parent_compat("led0", "gpio-leds") and
            dt_chosen_enabled("zephyr,osdp-uart") and CONFIG_SERIAL
    harness: osdp
    integration_platforms:
      - stm32_min_dev_black
```

## samples/subsys/mgmt/osdp/peripheral_device/sample.yaml
```yaml
sample:
  description: OSDP Peripheral Device Sample
  name: osdp
common:
  tags: osdp
  depends_on: gpio
  filter: dt_enabled_alias_with_parent_compat("led0", "gpio-leds") and
          dt_chosen_enabled("zephyr,osdp-uart") and CONFIG_SERIAL
  harness: osdp
  integration_platforms:
    - stm32_min_dev@black
    - stm32_min_dev@blue
tests:
  sample.mgmt.osdp.peripheral_device:
    extra_args: CONF_FILE=prj.conf

  sample.mgmt.osdp.peripheral_device_sc:
    build_only: true
    extra_args: CONF_FILE=prj_sc.conf
```

## samples/subsys/mgmt/osdp/sample.yaml
```yaml
sample:
  description: OSDP Sample
  name: osdp
tests:
  sample.mgmt.osdp:
    tags: osdp
    filter: dt_compat_enabled_with_alias("gpio-leds", "led0") and CONFIG_SERIAL
    harness: osdp
    integration_platforms:
      - frdm_k64f
```

## samples/subsys/mgmt/updatehub/Kconfig
```kconfig
#  Copyright (c) 2018-2020 O.S.Systems
#  SPDX-License-Identifier: Apache-2.0

mainmenu "Sample app Configuration"

config UPDATEHUB_SAMPLE_MANUAL
	bool "UpdateHub manual mode"
	help
	  Manual mode requires the user to call the server probe and then, if
	  there is an available update, also requires the user to decide if
	  it is appropriate to update now or later.

if !UPDATEHUB_SAMPLE_MANUAL
config UPDATEHUB_SAMPLE_POLLING
	bool "UpdateHub polling mode"
	default y
	help
	  Polling mode runs automatically on a predefined period, probing the
	  server for updates and installing them without requiring user
	  intervention.
endif #!UPDATEHUB_SAMPLE_MANUAL

if WIFI
config UPDATEHUB_SAMPLE_WIFI_SSID
	string "WIFI SSID - Network name"
	default "my_network"
config UPDATEHUB_SAMPLE_WIFI_PSK
	string "WIFI PSK - Network password key"
	default "secret_passwd"
endif

source "Kconfig.zephyr"
```

## samples/subsys/mgmt/updatehub/sample.yaml
```yaml
sample:
  description: UpdateHub enterprise-grade Firmware Over-the-Air (FOTA)
  name: UpdateHub
common:
  harness: net
  tags:
    - net
    - wifi
    - updatehub
  depends_on: netif
  build_only: true
  platform_allow: frdm_k64f
  integration_platforms:
    - frdm_k64f
tests:
  sample.net.updatehub:
    extra_configs:
      - CONFIG_UPDATEHUB_PRODUCT_UID="e4d37cfe6ec48a2d069cc0bbb8b078677e9a0d8df3a027c4d8ea131130c4265f"
      - CONFIG_UPDATEHUB_POLL_INTERVAL=1
      - CONFIG_UPDATEHUB_CE=y
      - CONFIG_UPDATEHUB_SERVER="updatehub.io"
  sample.net.updatehub.psa:
    extra_args: OVERLAY_CONFIG="overlay-psa.conf"
    extra_configs:
      - CONFIG_UPDATEHUB_PRODUCT_UID="e4d37cfe6ec48a2d069cc0bbb8b078677e9a0d8df3a027c4d8ea131130c4265f"
      - CONFIG_UPDATEHUB_POLL_INTERVAL=1
      - CONFIG_UPDATEHUB_CE=y
      - CONFIG_UPDATEHUB_SERVER="updatehub.io"
  sample.net.updatehub.userspace:
    extra_configs:
      - CONFIG_UPDATEHUB_PRODUCT_UID="e4d37cfe6ec48a2d069cc0bbb8b078677e9a0d8df3a027c4d8ea131130c4265f"
      - CONFIG_UPDATEHUB_POLL_INTERVAL=1
      - CONFIG_UPDATEHUB_CE=y
      - CONFIG_UPDATEHUB_SERVER="updatehub.io"
      - CONFIG_USERSPACE=y
  sample.net.updatehub.dtls:
    extra_args: OVERLAY_CONFIG="overlay-dtls.conf"
    extra_configs:
      - CONFIG_UPDATEHUB_PRODUCT_UID="e4d37cfe6ec48a2d069cc0bbb8b078677e9a0d8df3a027c4d8ea131130c4265f"
      - CONFIG_UPDATEHUB_POLL_INTERVAL=1
      - CONFIG_UPDATEHUB_CE=y
      - CONFIG_UPDATEHUB_SERVER="updatehub.io"
```

## samples/subsys/modbus/rtu_client/sample.yaml
```yaml
sample:
  name: Modbus RTU Client Sample
tests:
  sample.modbus.rtu_client:
    build_only: true
    platform_allow: nrf52840dk_nrf52840 frdm_k64f
    tags: uart modbus
    depends_on: gpio arduino_serial
```

## samples/subsys/modbus/rtu_server/sample.yaml
```yaml
sample:
  name: Modbus RTU Server Sample
tests:
  sample.modbus.rtu_server:
    build_only: true
    platform_allow:
      - nrf52840dk/nrf52840
      - frdm_k64f
    integration_platforms:
      - nrf52840dk/nrf52840
    tags:
      - uart
      - modbus
    filter: dt_enabled_alias_with_parent_compat("led0", "gpio-leds") and
            dt_enabled_alias_with_parent_compat("led1", "gpio-leds") and
            dt_enabled_alias_with_parent_compat("led2", "gpio-leds")
    depends_on:
      - gpio
      - arduino_serial
  sample.modbus.rtu_server.cdc_acm:
    build_only: true
    platform_allow:
      - nrf52840dk/nrf52840
      - frdm_k64f
    integration_platforms:
      - nrf52840dk/nrf52840
    tags:
      - usb
      - modbus
    filter: dt_enabled_alias_with_parent_compat("led0", "gpio-leds") and
            dt_enabled_alias_with_parent_compat("led1", "gpio-leds") and
            dt_enabled_alias_with_parent_compat("led2", "gpio-leds")
    extra_args:
      - EXTRA_CONF_FILE="overlay-cdc-acm.conf"
      - DTC_OVERLAY_FILE="cdc-acm.overlay"
    depends_on: usb_device
```

## samples/subsys/modbus/tcp_gateway/sample.yaml
```yaml
sample:
  name: Modbus TCP to serial line gateway sample
tests:
  sample.modbus.tcp_gateway:
    tags: modbus
    depends_on: gpio, netif, arduino_serial
    integration_platforms:
      - frdm_k64f
```

## samples/subsys/modbus/tcp_server/sample.yaml
```yaml
sample:
  name: Modbus TCP Server Sample
tests:
  sample.modbus.tcp_server:
    build_only: true
    platform_allow: frdm_k64f
    integration_platforms:
      - frdm_k64f
    tags: modbus
    filter: dt_enabled_alias_with_parent_compat("led0", "gpio-leds") and
            dt_enabled_alias_with_parent_compat("led1", "gpio-leds") and
            dt_enabled_alias_with_parent_compat("led2", "gpio-leds")
    depends_on: gpio netif
```

## samples/subsys/modules/shell_loader/sample.yaml
```yaml
sample:
  description: Loadable modules with shell sample
  name: Module loader shell
tests:
  sample.modules.shell:
    tags: shell filesystem modules
    harness: keyboard
```

## samples/subsys/morse/morse_code/sample.yaml
```yaml
sample:
  name: Morse Code Sample
tests:
  sample.subsys.morse.morse_code:
    tags:
      - morse
    platform_allow:
      - nrf52840dk/nrf52840
      - nucleo_f767zi
      - nucleo_g474re
      - nucleo_h753zi
      - sam_v71_xult/samv71q21
      - sam4e_xpro
```

## samples/subsys/mp/audio_loopback/boards/mimxrt685_evk_mimxrt685s_cm33.conf
```kconfig
#
# Copyright 2025 NXP
#
# SPDX-License-Identifier: Apache-2.0
#

CONFIG_I3C=y
CONFIG_AUDIO_CODEC=y

CONFIG_MP_ZAUD_BUFFER_POOL_SZ_MAX=4096
CONFIG_MP_ZAUD_BUFFER_POOL_NUM_MAX=8

CONFIG_USE_I2S_TARGET_CODEC_CONTROLLER=y

# The I2S codec sink primes ZAUD_I2S_SINK_START_PRIME (3) writes into the I2S TX
# queue before issuing I2S_TRIGGER_START. The TX in_queue must therefore be able
# to hold at least that many buffers, otherwise the priming writes block on a
# full queue, START never fires, and the shared buffer pool drains.
CONFIG_I2S_MCUX_FLEXCOMM_TX_BLOCK_COUNT=4
```

## samples/subsys/mp/audio_loopback/boards/native_sim_native_64.conf
```kconfig
#
# Copyright 2026 NXP
#
# SPDX-License-Identifier: Apache-2.0
#

CONFIG_AUDIO_CODEC=y
CONFIG_AUDIO_CODEC_DUMMY=y
CONFIG_AUDIO_DMIC=y
CONFIG_AUDIO_DMIC_NATIVE_SIM=y
CONFIG_I2S=y
CONFIG_I2S_NATIVE_SIM=y

CONFIG_MP_ZAUD_BUFFER_POOL_SZ_MAX=4096
CONFIG_MP_ZAUD_BUFFER_POOL_NUM_MAX=8

CONFIG_I2S_NATIVE_SIM_TX_FILE_PATH="build/native_sim_audio_pipeline_tx.pcm"
```

## samples/subsys/mp/cam_disp/boards/mimxrt700_evk_mimxrt798s_cm33_cpu0.conf
```kconfig
CONFIG_DCACHE=n

CONFIG_VIDEO_BUFFER_POOL_NUM_MAX=3
CONFIG_VIDEO_BUFFER_POOL_HEAP_SIZE=307200

CONFIG_MP_VID=y
CONFIG_MP_VID_CONVERT=y
CONFIG_MP_NET_BUF_POOL_COUNT=3

CONFIG_VIDEO_PIXEL_FORMAT="JPEG"
CONFIG_VIDEO_FRAME_WIDTH=320
CONFIG_VIDEO_FRAME_HEIGHT=160
```

## samples/subsys/mp/cam_disp/boards/native_sim_64.conf
```kconfig
CONFIG_VIDEO_FRAME_WIDTH=320
CONFIG_VIDEO_FRAME_HEIGHT=240
CONFIG_MP_BASE_CAPSFILTER=y
CONFIG_PROP_NUM_BUFS=10

# Bind the native PTY UART to stdin/stdout so the shell reads keystrokes typed
# on the launching terminal (otherwise the shell sits on a separate PTY and the
# p/s/r/q commands never receive input).
CONFIG_UART_NATIVE_PTY_0_ON_STDINOUT=y

# Log directly to stdout via the native backend, which is active from boot so
# the boot banner and early log lines (before the shell is up) are printed.
# Disable the shell log backend so those same lines are not printed a second
# time once the shell starts.
CONFIG_LOG_BACKEND_NATIVE_POSIX=y
CONFIG_SHELL_LOG_BACKEND=n
```
