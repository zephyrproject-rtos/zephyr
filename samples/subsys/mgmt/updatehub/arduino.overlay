/*
 * Copyright (c) 2020 O.S.Systems
 *
 * SPDX-License-Identifier: Apache-2.0
 */

&arduino_serial {
	status = "okay";
	current-speed = <115200>;
	gsm: gsm-modem {
		compatible = "zephyr,gsm-ppp";
	};
};
