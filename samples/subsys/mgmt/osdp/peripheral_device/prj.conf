## CMakeLists.txt
```
#
# Copyright (c) 2020 Siddharth Chandrasekaran <siddharth@embedjournal.com>
#
# SPDX-License-Identifier: Apache-2.0
#

cmake_minimum_required(VERSION 3.28.0)
find_package(Zephyr REQUIRED HINTS $ENV{ZEPHYR_BASE})

project(osdp_pd_sample)

target_sources(app PRIVATE src/main.c)
```

## sample.yaml
```
sample:
  description: OSDP Peripheral Device Sample
  name: osdp
common:
  tags: osdp
  depends_on: gpio
  filter: dt_enabled_alias_with_parent_compat("led0", "gpio-leds") and
          dt_chosen_enabled("zephyr,osdp-uart") and CONFIG_SERIAL
  harness: osdp
  integration_platforms:
    - stm32_min_dev@black
    - stm32_min_dev@blue
tests:
  sample.mgmt.osdp.peripheral_device:
    extra_args: CONF_FILE=prj.conf

  sample.mgmt.osdp.peripheral_device_sc:
    build_only: true
    extra_args: CONF_FILE=prj_sc.conf
```

## prj.conf
```kconfig
#
# Copyright (c) 2020 Siddharth Chandrasekaran <siddharth@embedjournal.com>
#
# SPDX-License-Identifier: Apache-2.0
#

CONFIG_PRINTK=y
CONFIG_LOG=y
CONFIG_GPIO=y

# OSDP config
CONFIG_OSDP=y
CONFIG_OSDP_MODE_PD=y

# Secure Channel
CONFIG_ENTROPY_GENERATOR=y

CONFIG_OSDP_LOG_LEVEL=4
```

## prj_sc.conf
```kconfig
#
# Copyright (c) 2020 Siddharth Chandrasekaran <siddharth@embedjournal.com>
#
# SPDX-License-Identifier: Apache-2.0
#

CONFIG_PRINTK=y
CONFIG_LOG=y
CONFIG_GPIO=y

# OSDP config
CONFIG_OSDP=y
CONFIG_OSDP_MODE_PD=y

# Secure Channel
CONFIG_ENTROPY_GENERATOR=y
CONFIG_OSDP_SC_ENABLED=y

CONFIG_OSDP_LOG_LEVEL=4
```

## app.overlay
```dts
/*
 * Copyright (c) 2022 Siddharth Chandrasekaran <sidcha.dev@gmail.com>
 *
 * SPDX-License-Identifier: Apache-2.0
 */

/ {
	chosen {
		zephyr,osdp-uart = &arduino_serial;
	};
};
```

## src/main.c
```c
/*
 * Copyright (c) 2020 Siddharth Chandrasekaran <siddharth@embedjournal.com>
 *
 * SPDX-License-Identifier: Apache-2.0
 */

#include <zephyr/kernel.h>
#include <zephyr/device.h>
#include <zephyr/drivers/gpio.h>
#include <zephyr/mgmt/osdp.h>

/* The devicetree node identifier for the "led0" alias. */
#define LED0_NODE DT_ALIAS(led0)

#if !DT_NODE_HAS_STATUS_OKAY(LED0_NODE)
#error "BOARD does not define a debug LED"
#endif

static const struct gpio_dt_spec led0 = GPIO_DT_SPEC_GET_OR(LED0_NODE, gpios, {0});

#define SLEEP_TIME_MS                  (20)
#define CNT_PER_SEC                    (1000 / SLEEP_TIME_MS)

int cmd_handler(void *unused, struct osdp_cmd *p)
{
	printk("App received command %d\n", p->id);
	return 0;
}

int main(void)
{
	int ret, led_state;
	uint32_t cnt = 0;

	if (!gpio_is_ready_dt(&led0)) {
		printk("LED0 GPIO port %s is not ready\n", led0.port->name);
		return 0;
	}

	ret = gpio_pin_configure_dt(&led0, GPIO_OUTPUT_ACTIVE);
	if (ret < 0) {
		printk("Failed to configure gpio port %s pin %d\n",
		       led0.port->name, led0.pin);
		return 0;
	}

	osdp_pd_set_command_callback(cmd_handler, NULL);

	led_state = 0;
	while (1) {
		if ((cnt & 0x7f) == 0x7f) {
			/* show a sign of life */
			led_state = !led_state;
		}
		gpio_pin_set(led0.port, led0.pin, led_state);
		k_msleep(SLEEP_TIME_MS);
		cnt++;
	}
	return 0;
}
```
