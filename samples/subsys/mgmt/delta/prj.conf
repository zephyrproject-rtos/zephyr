## CMakeLists.txt
```
# SPDX-License-Identifier: Apache-2.0

cmake_minimum_required(VERSION 3.20.0)

find_package(Zephyr REQUIRED HINTS $ENV{ZEPHYR_BASE})
project(dfota)

target_sources(app PRIVATE src/main.c)
target_sources_ifdef(CONFIG_DELTA_UPDATE app PRIVATE src/delta_apply.c)

# flash_patch target: convert a patch binary to Intel HEX at the
# devicetree-resolved patch_partition address and flash it.
dt_nodelabel(patch_path NODELABEL "patch_partition")
if(DEFINED patch_path)
  dt_reg_addr(patch_offset PATH ${patch_path})

  math(EXPR PATCH_FLASH_ADDR
       "${CONFIG_FLASH_BASE_ADDRESS} + ${patch_offset}"
       OUTPUT_FORMAT HEXADECIMAL)

  set(PATCH_FILE ${CMAKE_CURRENT_SOURCE_DIR}/firmwares/patch.bin
      CACHE FILEPATH "Path to the delta patch binary to flash")

  find_program(WEST west REQUIRED)

  add_custom_target(flash_patch
      COMMAND ${CMAKE_OBJCOPY} -I binary -O ihex
              --change-addresses ${PATCH_FLASH_ADDR}
              ${PATCH_FILE}
              ${PROJECT_BINARY_DIR}/patch.hex
      COMMAND ${WEST} flash --hex-file ${PROJECT_BINARY_DIR}/patch.hex
      COMMENT "Flashing delta patch to patch_partition at ${PATCH_FLASH_ADDR}"
      USES_TERMINAL
  )
endif()
```

## sample.yaml
```
sample:
  description: Delta Firmware Over The Air (DFOTA) update sample demonstrating
    how to apply binary delta patches to update firmware efficiently.
  name: dfota
common:
  sysbuild: true
  tags:
    - dfu
    - delta
  depends_on:
    - flash
  modules:
    - heatshrink
tests:
  sample.subsys.mgmt.delta:
    tags:
      - dfu
      - delta
    platform_allow:
      - nrf7002dk/nrf5340/cpuapp
```

## prj.conf
```kconfig
# Logging
CONFIG_LOG=y
CONFIG_LOG_MODE_DEFERRED=y

CONFIG_MAIN_STACK_SIZE=8192

# Flash / MCUboot
CONFIG_FLASH=y
CONFIG_FLASH_MAP=y
CONFIG_STREAM_FLASH=y
CONFIG_MCUBOOT_IMG_MANAGER=y
CONFIG_IMG_MANAGER=y
CONFIG_BOOTLOADER_MCUBOOT=y
CONFIG_REBOOT=y
CONFIG_IMG_BLOCK_BUF_SIZE=512

# Delta firmware update
CONFIG_DELTA_UPDATE=y
CONFIG_DELTA_UPDATE_LOG_LEVEL_DBG=y
CONFIG_BSDIFF_HS_ALGO=y
CONFIG_HEATSHRINK=y
CONFIG_HEATSHRINK_DYNAMIC_ALLOC=y
```

## src/main.c
```c
/*
 * Copyright (c) 2026 Clovis Corde
 *
 * SPDX-License-Identifier: Apache-2.0
 */

#include <zephyr/kernel.h>
#include <zephyr/logging/log.h>

#if !defined(CONFIG_DELTA_SAMPLE_TARGET_MODE)
#include <zephyr/mgmt/delta/delta.h>
#include "delta_apply.h"
#endif

LOG_MODULE_REGISTER(delta_sample, LOG_LEVEL_INF);

#if !defined(CONFIG_DELTA_SAMPLE_TARGET_MODE)
static struct delta_ctx ctx;
#endif

int main(void)
{
#if defined(CONFIG_DELTA_SAMPLE_TARGET_MODE)
	LOG_INF("DFOTA target firmware");
	return 0;
#else
	int ret;

	LOG_INF("Delta sample");

	ret = delta_apply(&ctx);
	if (ret != 0) {
		LOG_ERR("Error while applying delta update: %d", ret);
	}

	return ret;
#endif
}
```

## src/delta_apply.c
```c
/*
 * Copyright (c) 2026 Clovis Corde
 *
 * SPDX-License-Identifier: Apache-2.0
 */

#include <zephyr/kernel.h>
#include <zephyr/logging/log.h>
#include <zephyr/logging/log_ctrl.h>
#include <zephyr/dfu/mcuboot.h>
#include <zephyr/sys/reboot.h>
#include <zephyr/mgmt/delta/delta.h>
#include <zephyr/mgmt/delta/delta_bsdiff.h>

LOG_MODULE_REGISTER(delta_apply, CONFIG_DELTA_UPDATE_LOG_LEVEL);

/**
 * @brief Initialize the delta context.
 *
 * @param ctx Pointer to the delta context structure.
 * @return 0 on success, negative error code on failure.
 */
static int delta_apply_init(struct delta_ctx *ctx)
{
	int ret;

	if (ctx == NULL) {
		return -EINVAL;
	}

	/* The patch is stored in flash in this example */
	ctx->memory.patch_storage = DELTA_PATCH_STORAGE_FLASH;

	ret = flash_img_init(&ctx->memory.flash.img_ctx);
	if (ret != 0) {
		LOG_ERR("flash_img_init failed, ret: %d", ret);
		return ret;
	}

	/* Set the backend algorithm */
	ctx->backend = &delta_backend_bsdiff_api;

	ret = delta_mem_seek(&ctx->memory,
			     boot_get_image_start_offset(PARTITION_ID(slot0_partition)), 0, 0);
	if (ret != 0) {
		LOG_ERR("delta api seek offset failed, ret = %d", ret);
		return ret;
	}

	return 0;
}

/**
 * @brief Apply the patch using the delta algorithm defined in backend and
 *        write the magic to define the new firmware as a bootable image.
 *
 * @param ctx Pointer to the delta context structure.
 * @return 0 on success, negative error code on failure.
 */
int delta_apply(struct delta_ctx *ctx)
{
	int ret;

	if (ctx == NULL) {
		return -EINVAL;
	}

	ret = delta_apply_init(ctx);
	if (ret != 0) {
		LOG_ERR("The delta API initialization failed, ret = %d", ret);
		return ret;
	}

	/* Validate the header of the delta patch  */
	if (!ctx->backend->validate_header(ctx)) {
		LOG_ERR("Validate header patch failed");
		return -EINVAL;
	}

	/* Apply the patch using a delta algorithm */
	ret = ctx->backend->patch(ctx);
	if (ret != 0) {
		LOG_ERR("Apply patch failed");
		return ret;
	}

	ret = boot_request_upgrade(BOOT_UPGRADE_TEST);
	if (ret != 0) {
		LOG_ERR("Boot request error: %d", ret);
		return ret;
	}

	LOG_INF("The new FW was successfully written, now rebooting...");

	/* Flush the logs before reboot */
	LOG_PANIC();

	sys_reboot(SYS_REBOOT_COLD);

	return ret;
}
```

## src/delta_apply.h
```c
/*
 * Copyright (c) 2026 Clovis Corde
 *
 * SPDX-License-Identifier: Apache-2.0
 */

#ifndef DELTA_APPLY_H_
#define DELTA_APPLY_H_

#include <zephyr/mgmt/delta/delta.h>

/**
 * @brief Initialize the delta API and apply the patch using the configured backend.
 *
 * Reboots the device after writing the new firmware.
 *
 * @param ctx Pointer to delta context structure.
 * @return 0 on success, negative error code on failure.
 */
int delta_apply(struct delta_ctx *ctx);

#endif /* DELTA_APPLY_H_ */
```
