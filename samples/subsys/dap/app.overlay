/*
 * Copyright (c) 2023 Nordic Semiconductor ASA
 *
 * SPDX-License-Identifier: Apache-2.0
 */

/ {
	dp0 {
		compatible = "zephyr,swdp-gpio";
		status = "okay";

		clk-gpios = <&arduino_header 10 GPIO_ACTIVE_HIGH>;	/* D4 */
		noe-gpios = <&arduino_header 9 GPIO_ACTIVE_HIGH>;	/* D3 */
		dio-gpios = <&arduino_header 8 GPIO_PULL_UP>;		/* D2 */
		port-write-cycles = <2>;
	};
};
