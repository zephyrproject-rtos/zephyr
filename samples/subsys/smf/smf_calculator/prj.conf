## CMakeLists.txt
```
# SPDX-License-Identifier: Apache-2.0

set(CMAKE_CXX_FLAGS "-fstack-usage")
cmake_minimum_required(VERSION 3.28.0)

find_package(Zephyr REQUIRED HINTS $ENV{ZEPHYR_BASE})
project(smf_calculator_demo)

target_sources(app PRIVATE src/main.c)
target_sources(app PRIVATE src/smf_console_cmds.c)
target_sources(app PRIVATE src/smf_calculator_thread.c)
```

## sample.yaml
```
sample:
  description: SMF Calculator GUI Application
  name: smf_calculator
tests:
  sample.smf.smf_calculator:
    filter: dt_chosen_enabled("zephyr,display")
    # Sample takes ~300k on disco_l475_iot1 board, add 50k just in case.
    # Ram usage is 70k on disco_l475_iot1 board with adafruit_2_8_tft_touch_v2.
    # Can be reduced by changing CONFIG_LV_Z_VDB_SIZE,
    # CONFIG_LV_Z_MEM_POOL_SIZE and CONFIG_MAIN_STACK_SIZE.
    min_flash: 350
    min_ram: 75
    harness: none
    tags:
      - samples
      - display
      - gui
      - lvgl
      - smf
    modules:
      - lvgl
    integration_platforms:
      - native_sim/native/64
    platform_allow:
      - native_sim/native/64
      - disco_l475_iot1
    extra_args:
      - platform:disco_l475_iot1:SHIELD=adafruit_2_8_tft_touch_v2
```

## prj.conf
```kconfig
CONFIG_DEBUG=y
CONFIG_LOG=y
CONFIG_SHELL=y

# Needed for boards that enable RTT backends for logging
# e.g. nrf52840dk/nrf52840 and any others that enable it
CONFIG_LOG_BACKEND_RTT=n

# Enable the state machine framework
CONFIG_SMF=y
CONFIG_SMF_ANCESTOR_SUPPORT=y
CONFIG_SMF_INITIAL_TRANSITION=y

# Enable floating point support
CONFIG_REQUIRES_FLOAT_PRINTF=y

# Enable thread awareness for debugging tools supporting it
CONFIG_DEBUG_THREAD_INFO=y

# enable to use thread names
CONFIG_THREAD_NAME=y

# Display Options
CONFIG_DISPLAY=y
CONFIG_DISPLAY_LOG_LEVEL_ERR=y

# LVGL Options
CONFIG_LVGL=y
CONFIG_LV_Z_MEM_POOL_SIZE=16384
CONFIG_LV_Z_SHELL=y
# Percentage of screen size for a video buffer
# LVGL defaults sets this too high for resource-constrained boards.
# 14% ~= 32KB RAM on adafruit_2_8_tft_touch_v2
CONFIG_LV_Z_VDB_SIZE=14

# extra large in case you want to enable LV_USE_REFR_DEBUG
CONFIG_MAIN_STACK_SIZE=4096
```

## src/main.c
```c
/*
 * Copyright (c) 2024 Glenn Andrews
 *
 * SPDX-License-Identifier: Apache-2.0
 */

#include "main.h"
#include <zephyr/kernel.h>
#include "smf_calculator_thread.h"
#include <zephyr/drivers/display.h>
#include <lvgl.h>
#include <stdio.h>
#include <string.h>
#include <lvgl_input_device.h>
#include <zephyr/logging/log.h>

#define LOG_LEVEL CONFIG_LOG_DEFAULT_LEVEL
LOG_MODULE_REGISTER(main_app);

K_MSGQ_DEFINE(output_msgq, CALCULATOR_STRING_LENGTH, 2, 1);

#define CALCULATOR_BUTTON_LABEL_LENGTH 4
struct calculator_button {
	char label[CALCULATOR_BUTTON_LABEL_LENGTH];
	struct calculator_event event;
};

/**
 * Important: this enum MUST be in the order of the buttons on the screen
 * otherwise the mapping from button index to function will break
 */
enum calculator_ui_buttons {
	BUTTON_CANCEL_ENTRY = 0,
	BUTTON_CANCEL,
	BUTTON_7,
	BUTTON_8,
	BUTTON_9,
	BUTTON_DIVIDE,
	BUTTON_4,
	BUTTON_5,
	BUTTON_6,
	BUTTON_MULTIPLY,
	BUTTON_1,
	BUTTON_2,
	BUTTON_3,
	BUTTON_SUBTRACT,
	BUTTON_0,
	BUTTON_DECIMAL_POINT,
	BUTTON_EQUALS,
	BUTTON_ADD,
};

struct calculator_button buttons[] = {
	[BUTTON_CANCEL_ENTRY] = {.label = "CE",
				 .event = {.event_id = CANCEL_ENTRY, .operand = 'E'}},
	[BUTTON_CANCEL] = {.label = "C", .event = {.event_id = CANCEL_BUTTON, .operand = 'C'}},
	[BUTTON_ADD] = {.label = "+", .event = {.event_id = OPERATOR, .operand = '+'}},
	[BUTTON_SUBTRACT] = {.label = "-", .event = {.event_id = OPERATOR, .operand = '-'}},
	[BUTTON_MULTIPLY] = {.label = "*", .event = {.event_id = OPERATOR, .operand = '*'}},
	[BUTTON_DIVIDE] = {.label = "/", .event = {.event_id = OPERATOR, .operand = '/'}},
	[BUTTON_DECIMAL_POINT] = {.label = ".",
				  .event = {.event_id = DECIMAL_POINT, .operand = '.'}},
	[BUTTON_EQUALS] = {.label = "=", .event = {.event_id = EQUALS, .operand = '='}},
	[BUTTON_0] = {.label = "0", .event = {.event_id = DIGIT_0, .operand = '0'}},
	[BUTTON_1] = {.label = "1", .event = {.event_id = DIGIT_1_9, .operand = '1'}},
	[BUTTON_2] = {.label = "2", .event = {.event_id = DIGIT_1_9, .operand = '2'}},
	[BUTTON_3] = {.label = "3", .event = {.event_id = DIGIT_1_9, .operand = '3'}},
	[BUTTON_4] = {.label = "4", .event = {.event_id = DIGIT_1_9, .operand = '4'}},
	[BUTTON_5] = {.label = "5", .event = {.event_id = DIGIT_1_9, .operand = '5'}},
	[BUTTON_6] = {.label = "6", .event = {.event_id = DIGIT_1_9, .operand = '6'}},
	[BUTTON_7] = {.label = "7", .event = {.event_id = DIGIT_1_9, .operand = '7'}},
	[BUTTON_8] = {.label = "8", .event = {.event_id = DIGIT_1_9, .operand = '8'}},
	[BUTTON_9] = {.label = "9", .event = {.event_id = DIGIT_1_9, .operand = '9'}},
};

/* Where the result is printed */
static lv_obj_t *result_label;

/**
 * LVGL v8.4 is not thread safe, so use a msgq to pass updates back
 * to the thread that calls lv_task_handler()
 */
void update_display(const char *output)
{
	while (k_msgq_put(&output_msgq, output, K_NO_WAIT) != 0) {
		k_msgq_purge(&output_msgq);
	}
}

static void lv_btn_matrix_click_callback(lv_event_t *e)
{
	lv_event_code_t code = lv_event_get_code(e);
	lv_obj_t *obj = lv_event_get_target(e);

	if (code == LV_EVENT_PRESSED) {
		uint32_t id;
		int rc;

		id = lv_btnmatrix_get_selected_btn(obj);
		if (id >= ARRAY_SIZE(buttons)) {
			LOG_ERR("Invalid button: %d", id);
			return;
		}

		rc = post_calculator_event(&buttons[id].event, K_FOREVER);
		if (rc != 0) {
			LOG_ERR("could not post to msgq: %d", rc);
		}
	}
}

static int setup_display(void)
{
	const struct device *display_dev = DEVICE_DT_GET(DT_CHOSEN(zephyr_display));
	int ret;

	if (!device_is_ready(display_dev)) {
		LOG_ERR("Device not ready, aborting setup");
		return -ENODEV;
	}

	static const char *const btnm_map[] = {buttons[BUTTON_CANCEL_ENTRY].label,
					       buttons[BUTTON_CANCEL].label,
					       "\n",
					       buttons[BUTTON_7].label,
					       buttons[BUTTON_8].label,
					       buttons[BUTTON_9].label,
					       buttons[BUTTON_DIVIDE].label,
					       "\n",
					       buttons[BUTTON_4].label,
					       buttons[BUTTON_5].label,
					       buttons[BUTTON_6].label,
					       buttons[BUTTON_MULTIPLY].label,
					       "\n",
					       buttons[BUTTON_1].label,
					       buttons[BUTTON_2].label,
					       buttons[BUTTON_3].label,
					       buttons[BUTTON_SUBTRACT].label,
					       "\n",
					       buttons[BUTTON_0].label,
					       buttons[BUTTON_DECIMAL_POINT].label,
					       buttons[BUTTON_EQUALS].label,
					       buttons[BUTTON_ADD].label,
					       "\n",
					       ""};

	lv_obj_t *btn_matrix = lv_btnmatrix_create(lv_scr_act());

	lv_btnmatrix_set_map(btn_matrix, (const char **)btnm_map);
	lv_obj_align(btn_matrix, LV_ALIGN_BOTTOM_MID, 0, 0);
	lv_obj_set_size(btn_matrix, lv_pct(CALC_BTN_WIDTH_PCT), lv_pct(CALC_BTN_HEIGHT_PCT));
	lv_obj_add_event_cb(btn_matrix, lv_btn_matrix_click_callback, LV_EVENT_ALL, NULL);

	result_label = lv_label_create(lv_scr_act());
	lv_obj_set_width(result_label, lv_pct(CALC_RESULT_WIDTH_PCT));
	lv_obj_set_style_text_align(result_label, LV_TEXT_ALIGN_RIGHT, 0);
	lv_obj_align(result_label, LV_ALIGN_TOP_MID, 0, lv_pct(CALC_RESULT_OFFSET_PCT));

	static lv_style_t style_shadow;

	lv_style_init(&style_shadow);
	lv_style_set_shadow_width(&style_shadow, 5);
	lv_style_set_shadow_spread(&style_shadow, 2);
	lv_style_set_shadow_color(&style_shadow, lv_palette_main(LV_PALETTE_GREY));
	lv_obj_add_style(result_label, &style_shadow, 0);
	update_display("0");

	lv_task_handler();
	ret = display_blanking_off(display_dev);
	if (ret < 0 && ret != -ENOSYS) {
		LOG_ERR("Failed to turn blanking off (error %d)", ret);
		return ret;
	}

	return 0;
}

int main(void)
{
	printk("SMF Desk Calculator Demo\n");

	int rc = setup_display();

	if (rc != 0) {
		return rc;
	}

	while (1) {
		char output[CALCULATOR_STRING_LENGTH];

		if (k_msgq_get(&output_msgq, output, K_MSEC(50)) == 0) {
			lv_label_set_text(result_label, output);
		}

		lv_task_handler();
	}
	return 0;
}
```

## src/main.h
```c
/*
 * Copyright (c) 2024 Glenn Andrews
 *
 * SPDX-License-Identifier: Apache-2.0
 */

/* Constants for control sizes as a percentage of screen size. */
#define CALC_BTN_WIDTH_PCT     90
#define CALC_BTN_HEIGHT_PCT    80
#define CALC_RESULT_WIDTH_PCT  70
#define CALC_RESULT_OFFSET_PCT 10

void update_display(const char *output);
```

## src/smf_calculator_thread.c
```c
/*
 * Copyright (c) 2024 Glenn Andrews
 *
 * SPDX-License-Identifier: Apache-2.0
 */

#include <zephyr/kernel.h>
#include <zephyr/smf.h>
#include <stdbool.h>
#include "smf_calculator_thread.h"
#include <zephyr/logging/log.h>
#include <string.h>
#include <stdlib.h>
#include "main.h"
#include <stdio.h>

LOG_MODULE_REGISTER(smf_thread, LOG_LEVEL_DBG);

K_MSGQ_DEFINE(event_msgq, sizeof(struct calculator_event), 8, 1);

/* In theory can still overflow. A double can be hundreds of characters long */
#define RESULT_STRING_LENGTH 64

enum display_mode {
	DISPLAY_OPERAND_1,
	DISPLAY_OPERAND_2,
	DISPLAY_RESULT,
	DISPLAY_ERROR,
};

struct operand {
	char string[CALCULATOR_STRING_LENGTH];
	int index;
};

/* User defined object */
struct s_object {
	/* This must be first */
	struct smf_ctx ctx;

	/* Other state specific data add here */
	struct calculator_event event;

	struct operand operand_1;
	struct operand operand_2;
	char operator_btn;
	struct operand result;
} s_obj;

static enum display_mode current_display_mode = DISPLAY_OPERAND_1;

static void set_display_mode(enum display_mode mode)
{
	current_display_mode = mode;
}

static void setup_operand(struct operand *op)
{
	/* indexes start at 1 because position 0 is the sign */
	op->index = 1;
	op->string[0] = ' '; /* space for sign */
	op->string[1] = '0'; /* A 0 indicator to be overwritten */
	op->string[2] = 0x00;
}

static int insert(struct operand *op, char digit)
{
	if (op->index >= (CALCULATOR_STRING_LENGTH - 1)) {
		/* Can't store an extra operand */
		return -ENOBUFS;
	}
	op->string[op->index++] = digit;
	op->string[op->index] = 0x00;

	return 0;
}

static void negate(struct operand *op)
{
	if (op->string[0] == ' ') {
		op->string[0] = '-';
	} else {
		op->string[0] = ' ';
	}
}

/**
 * @brief copies one operand struct to another
 * Assumes src operand is well-formed
 */
static void copy_operand(struct operand *dest, struct operand *src)
{
	strncpy(dest->string, src->string, CALCULATOR_STRING_LENGTH);
	dest->index = src->index;
}

static int calculate_result(struct s_object *s)
{
	double operand_1 = strtod(s->operand_1.string, NULL);
	double operand_2 = strtod(s->operand_2.string, NULL);
	double result;
	char result_string[RESULT_STRING_LENGTH];

	switch (s->operator_btn) {
	case '+':
		result = operand_1 + operand_2;
		break;
	case '-':
		result = operand_1 - operand_2;
		break;
	case '*':
		result = operand_1 * operand_2;
		break;
	case '/':
		if (operand_2 != 0.0) {
			result = operand_1 / operand_2;
		} else {
			/* division by zero */
			return -1;
		}
		break;
	default:
		/* unknown operator */
		return -1;
	}

	snprintf(result_string, RESULT_STRING_LENGTH, "% f", result);

	/* Strip off trailing zeroes from result */
	for (int i = strlen(result_string) - 1; i >= 0; i--) {
		if (result_string[i] != '0') {
			/* was it .000? */
			if (result_string[i] == '.') {
				result_string[i] = 0x00;
			} else {
				result_string[i + 1] = 0x00;
			}
			break;
		}
	}

	/* copy to the result operand */
	strncpy(s->result.string, result_string, CALCULATOR_STRING_LENGTH - 1);
	s->result.string[CALCULATOR_STRING_LENGTH - 1] = 0x00;
	s->result.index = strlen(s->result.string);

	return 0;
}

/* copy result into operand_1 and clear operand_2 to allow chaining calculations */
static void chain_calculations(struct s_object *s)
{
	copy_operand(&s->operand_1, &s->result);
	setup_operand(&s->operand_2);
}

/* Declaration of possible states */
enum demo_states {
	STATE_ON,
	STATE_READY,
	STATE_RESULT,
	STATE_BEGIN,
	STATE_NEGATED_1,
	STATE_OPERAND_1,
	STATE_ZERO_1,
	STATE_INT_1,
	STATE_FRAC_1,
	STATE_NEGATED_2,
	STATE_OPERAND_2,
	STATE_ZERO_2,
	STATE_INT_2,
	STATE_FRAC_2,
	STATE_OP_ENTERED,
	STATE_OP_CHAINED,
	STATE_OP_NORMAL,
	STATE_ERROR,
};

/* Forward declaration of state table */
static const struct smf_state calculator_states[];

static void on_entry(void *obj)
{
	struct s_object *s = (struct s_object *)obj;

	LOG_DBG("");

	setup_operand(&s->operand_1);
	setup_operand(&s->operand_2);
	setup_operand(&s->result);
	s->operator_btn = 0x00;
}

static enum smf_state_result on_run(void *obj)
{
	struct s_object *s = (struct s_object *)obj;

	LOG_DBG("");

	switch (s->event.event_id) {
	case CANCEL_BUTTON:
		smf_set_state(&s->ctx, &calculator_states[STATE_ON]);
		break;
	default:
		/* Let parent state handle it: shuts up compiler warning */
		break;
	}
	return SMF_EVENT_PROPAGATE;
}

static enum smf_state_result ready_run(void *obj)
{
	struct s_object *s = (struct s_object *)obj;

	LOG_DBG("");

	switch (s->event.event_id) {
	case DECIMAL_POINT:
		insert(&s->operand_1, s->event.operand);
		smf_set_state(&s->ctx, &calculator_states[STATE_FRAC_1]);
		break;
	case DIGIT_1_9:
		insert(&s->operand_1, s->event.operand);
		smf_set_state(&s->ctx, &calculator_states[STATE_INT_1]);
		break;
	case DIGIT_0:
		/* Don't insert the leading zero */
		smf_set_state(&s->ctx, &calculator_states[STATE_ZERO_1]);
		break;
	case OPERATOR:
		s->operator_btn = s->event.operand;
		smf_set_state(&s->ctx, &calculator_states[STATE_OP_CHAINED]);
		break;
	default:
		/* Let parent state handle it: shuts up compiler warning */
		break;
	}
	return SMF_EVENT_PROPAGATE;
}

static void result_entry(void *obj)
{
	LOG_DBG("");
	set_display_mode(DISPLAY_RESULT);
}

static enum smf_state_result result_run(void *obj)
{
	LOG_DBG("");
	/* Ready state handles the exits from this state */
	return SMF_EVENT_PROPAGATE;
}

static void begin_entry(void *obj)
{
	LOG_DBG("");
	set_display_mode(DISPLAY_OPERAND_1);
}

static enum smf_state_result begin_run(void *obj)
{
	struct s_object *s = (struct s_object *)obj;

	LOG_DBG("");

	switch (s->event.event_id) {
	case OPERATOR:
		/* We only care about negative */
		if (s->event.operand == '-') {
			smf_set_state(&s->ctx, &calculator_states[STATE_NEGATED_1]);
		}
		break;
	default:
		/* Let parent state handle it: shuts up compiler warning */
		break;
	}
	return SMF_EVENT_PROPAGATE;
}

static void negated_1_entry(void *obj)
{
	struct s_object *s = (struct s_object *)obj;

	LOG_DBG("");

	negate(&s->operand_1);
}

static enum smf_state_result negated_1_run(void *obj)
{
	struct s_object *s = (struct s_object *)obj;

	LOG_DBG("");

	switch (s->event.event_id) {
	case DECIMAL_POINT:
		insert(&s->operand_1, s->event.operand);
		smf_set_state(&s->ctx, &calculator_states[STATE_FRAC_1]);
		break;
	case DIGIT_1_9:
		insert(&s->operand_1, s->event.operand);
		smf_set_state(&s->ctx, &calculator_states[STATE_INT_1]);
		break;
	case DIGIT_0:
		/* Don't need to insert leading zeroes */
		smf_set_state(&s->ctx, &calculator_states[STATE_ZERO_1]);
		break;
	case OPERATOR:
		/* We only care about ignoring the negative key */
		if (s->event.operand == '-') {
			return SMF_EVENT_HANDLED;
		}
		break;
	case CANCEL_ENTRY:
		setup_operand(&s->operand_1);
		smf_set_state(&s->ctx, &calculator_states[STATE_BEGIN]);
		break;
	default:
		/* Let parent state handle it: shuts up compiler warning */
		break;
	}
	return SMF_EVENT_PROPAGATE;
}

static void operand_1_entry(void *obj)
{
	LOG_DBG("");
	set_display_mode(DISPLAY_OPERAND_1);
}

static enum smf_state_result operand_1_run(void *obj)
{
	struct s_object *s = (struct s_object *)obj;

	LOG_DBG("");

	switch (s->event.event_id) {
	case OPERATOR:
		s->operator_btn = s->event.operand;
		smf_set_state(&s->ctx, &calculator_states[STATE_OP_ENTERED]);
		break;
	case CANCEL_ENTRY:
		setup_operand(&s->operand_1);
		smf_set_state(&s->ctx, &calculator_states[STATE_READY]);
		break;
	default:
		/* Let parent state handle it: shuts up compiler warning */
		break;
	}
	return SMF_EVENT_PROPAGATE;
}

static enum smf_state_result zero_1_run(void *obj)
{
	struct s_object *s = (struct s_object *)obj;

	LOG_DBG("");

	switch (s->event.event_id) {
	case DIGIT_0:
		/* We ignore leading zeroes */
		return SMF_EVENT_HANDLED;
	case DIGIT_1_9:
		insert(&s->operand_1, s->event.operand);
		smf_set_state(&s->ctx, &calculator_states[STATE_INT_1]);
		break;
	case DECIMAL_POINT:
		insert(&s->operand_1, s->event.operand);
		smf_set_state(&s->ctx, &calculator_states[STATE_FRAC_1]);
		break;
	default:
		/* Let parent state handle it: shuts up compiler warning */
		break;
	}
	return SMF_EVENT_PROPAGATE;
}

static enum smf_state_result int_1_run(void *obj)
{
	struct s_object *s = (struct s_object *)obj;

	LOG_DBG("");

	switch (s->event.event_id) {
	case DIGIT_0:
	case DIGIT_1_9:
		insert(&s->operand_1, s->event.operand);
		return SMF_EVENT_HANDLED;
	case DECIMAL_POINT:
		insert(&s->operand_1, s->event.operand);
		smf_set_state(&s->ctx, &calculator_states[STATE_FRAC_1]);
		break;
	default:
		/* Let parent state handle it: shuts up compiler warning */
		break;
	}
	return SMF_EVENT_PROPAGATE;
}

static enum smf_state_result frac_1_run(void *obj)
{
	struct s_object *s = (struct s_object *)obj;

	LOG_DBG("");

	switch (s->event.event_id) {
	case DIGIT_0:
	case DIGIT_1_9:
		insert(&s->operand_1, s->event.operand);
		return SMF_EVENT_HANDLED;
	case DECIMAL_POINT:
		/* Ignore further decimal points */
		return SMF_EVENT_HANDLED;
	default:
		/* Let parent state handle it: shuts up compiler warning */
		break;
	}
	return SMF_EVENT_PROPAGATE;
}

static void negated_2_entry(void *obj)
{
	struct s_object *s = (struct s_object *)obj;

	LOG_DBG("");

	negate(&s->operand_2);
}

static enum smf_state_result negated_2_run(void *obj)
{
	struct s_object *s = (struct s_object *)obj;

	LOG_DBG("");

	switch (s->event.event_id) {
	case DECIMAL_POINT:
		insert(&s->operand_2, s->event.operand);
		smf_set_state(&s->ctx, &calculator_states[STATE_FRAC_2]);
		break;
	case DIGIT_1_9:
		insert(&s->operand_2, s->event.operand);
		smf_set_state(&s->ctx, &calculator_states[STATE_INT_2]);
		break;
	case DIGIT_0:
		/* Don't insert the leading zero */
		smf_set_state(&s->ctx, &calculator_states[STATE_ZERO_2]);
		break;
	case OPERATOR:
		/* We only care about ignoring the negative key */
		if (s->event.operand == '-') {
			return SMF_EVENT_HANDLED;
		}
		break;
	case CANCEL_ENTRY:
		setup_operand(&s->operand_2);
		smf_set_state(&s->ctx, &calculator_states[STATE_OP_ENTERED]);
		break;
	default:
		/* Let parent state handle it: shuts up compiler warning */
		break;
	}
	return SMF_EVENT_PROPAGATE;
}

static void operand_2_entry(void *obj)
{
	LOG_DBG("");
	set_display_mode(DISPLAY_OPERAND_2);
}

static enum smf_state_result operand_2_run(void *obj)
{
	struct s_object *s = (struct s_object *)obj;

	LOG_DBG("");

	switch (s->event.event_id) {
	case CANCEL_ENTRY:
		setup_operand(&s->operand_2);
		smf_set_state(&s->ctx, &calculator_states[STATE_OP_ENTERED]);
		break;
	case OPERATOR:
		if (calculate_result(s) == 0) {
			/* move result into operand_1 to allow chaining */
			chain_calculations(s);
			/* Copy in new operand */
			s->operator_btn = s->event.operand;
			smf_set_state(&s->ctx, &calculator_states[STATE_OP_CHAINED]);
		} else {
			smf_set_state(&s->ctx, &calculator_states[STATE_ERROR]);
		}
		break;
	case EQUALS:
		if (calculate_result(s) == 0) {
			/* move result into operand_1 to allow chaining */
			chain_calculations(s);
			smf_set_state(&s->ctx, &calculator_states[STATE_RESULT]);
		} else {
			smf_set_state(&s->ctx, &calculator_states[STATE_ERROR]);
		}
		break;
	default:
		/* Let parent state handle it: shuts up compiler warning */
		break;
	}
	return SMF_EVENT_PROPAGATE;
}

static enum smf_state_result zero_2_run(void *obj)
{
	struct s_object *s = (struct s_object *)obj;

	LOG_DBG("");

	switch (s->event.event_id) {
	case DIGIT_0:
		/* We ignore leading zeroes */
		return SMF_EVENT_HANDLED;
	case DIGIT_1_9:
		insert(&s->operand_2, s->event.operand);
		smf_set_state(&s->ctx, &calculator_states[STATE_INT_2]);
		break;
	case DECIMAL_POINT:
		insert(&s->operand_2, s->event.operand);
		smf_set_state(&s->ctx, &calculator_states[STATE_FRAC_2]);
		break;
	default:
		/* Let parent state handle it: shuts up compiler warning */
		break;
	}
	return SMF_EVENT_PROPAGATE;
}

static enum smf_state_result int_2_run(void *obj)
{
	struct s_object *s = (struct s_object *)obj;

	LOG_DBG("");

	switch (s->event.event_id) {
	case DIGIT_0:
	case DIGIT_1_9:
		insert(&s->operand_2, s->event.operand);
		return SMF_EVENT_HANDLED;
	case DECIMAL_POINT:
		insert(&s->operand_2, s->event.operand);
		smf_set_state(&s->ctx, &calculator_states[STATE_FRAC_2]);
		break;
	default:
		/* Let parent state handle it: shuts up compiler warning */
		break;
	}
	return SMF_EVENT_PROPAGATE;
}

static enum smf_state_result frac_2_run(void *obj)
{
	struct s_object *s = (struct s_object *)obj;

	LOG_DBG("");

	switch (s->event.event_id) {
	case DIGIT_0:
	case DIGIT_1_9:
		insert(&s->operand_2, s->event.operand);
		return SMF_EVENT_HANDLED;
	case DECIMAL_POINT:
		/* Ignore further decimal points */
		return SMF_EVENT_HANDLED;
	default:
		/* Let parent state handle it: shuts up compiler warning */
		break;
	}
	return SMF_EVENT_PROPAGATE;
}

static enum smf_state_result op_entered_run(void *obj)
{
	struct s_object *s = (struct s_object *)obj;

	LOG_DBG("");

	switch (s->event.event_id) {
	case DIGIT_0:
		/* Don't insert the leading zero */
		smf_set_state(&s->ctx, &calculator_states[STATE_ZERO_2]);
		break;
	case DIGIT_1_9:
		insert(&s->operand_2, s->event.operand);
		smf_set_state(&s->ctx, &calculator_states[STATE_INT_2]);
		break;
	case DECIMAL_POINT:
		insert(&s->operand_2, s->event.operand);
		smf_set_state(&s->ctx, &calculator_states[STATE_FRAC_2]);
		break;
	case OPERATOR:
		/* We only care about negative */
		if (s->event.operand == '-') {
			smf_set_state(&s->ctx, &calculator_states[STATE_NEGATED_2]);
		}
		break;
	default:
		/* Let parent state handle it: shuts up compiler warning */
		break;
	}
	return SMF_EVENT_PROPAGATE;
}

static void op_chained_entry(void *obj)
{
	LOG_DBG("");
	set_display_mode(DISPLAY_OPERAND_1);
}

static void op_normal_entry(void *obj)
{
	LOG_DBG("");
	set_display_mode(DISPLAY_OPERAND_2);
}

static void error_entry(void *obj)
{
	LOG_DBG("");
	set_display_mode(DISPLAY_ERROR);
}

/* State storage: handler functions, parent states and initial transition states */
/* clang-format off */
static const struct smf_state calculator_states[] = {
	[STATE_ON] =         SMF_CREATE_STATE(on_entry, on_run, NULL,
						NULL, &calculator_states[STATE_READY]),
	[STATE_READY] =      SMF_CREATE_STATE(NULL, ready_run, NULL,
						&calculator_states[STATE_ON],
						&calculator_states[STATE_BEGIN]),
	[STATE_RESULT] =     SMF_CREATE_STATE(result_entry, result_run,
						NULL, &calculator_states[STATE_READY], NULL),
	[STATE_BEGIN] =      SMF_CREATE_STATE(begin_entry, begin_run, NULL,
						&calculator_states[STATE_READY], NULL),
	[STATE_NEGATED_1] =  SMF_CREATE_STATE(negated_1_entry, negated_1_run, NULL,
						&calculator_states[STATE_ON], NULL),
	[STATE_OPERAND_1] =  SMF_CREATE_STATE(operand_1_entry, operand_1_run, NULL,
						&calculator_states[STATE_ON], NULL),
	[STATE_ZERO_1] =     SMF_CREATE_STATE(NULL, zero_1_run, NULL,
						&calculator_states[STATE_OPERAND_1], NULL),
	[STATE_INT_1] =      SMF_CREATE_STATE(NULL, int_1_run, NULL,
						&calculator_states[STATE_OPERAND_1], NULL),
	[STATE_FRAC_1] =     SMF_CREATE_STATE(NULL, frac_1_run, NULL,
						&calculator_states[STATE_OPERAND_1], NULL),
	[STATE_NEGATED_2] =  SMF_CREATE_STATE(negated_2_entry, negated_2_run, NULL,
						&calculator_states[STATE_ON], NULL),
	[STATE_OPERAND_2] =  SMF_CREATE_STATE(operand_2_entry, operand_2_run, NULL,
						&calculator_states[STATE_ON], NULL),
	[STATE_ZERO_2] =     SMF_CREATE_STATE(NULL, zero_2_run, NULL,
						&calculator_states[STATE_OPERAND_2], NULL),
	[STATE_INT_2] =      SMF_CREATE_STATE(NULL, int_2_run, NULL,
						&calculator_states[STATE_OPERAND_2], NULL),
	[STATE_FRAC_2] =     SMF_CREATE_STATE(NULL, frac_2_run, NULL,
						&calculator_states[STATE_OPERAND_2], NULL),
	[STATE_OP_ENTERED] = SMF_CREATE_STATE(NULL, op_entered_run, NULL,
						&calculator_states[STATE_ON],
						&calculator_states[STATE_OP_NORMAL]),
	[STATE_OP_CHAINED] = SMF_CREATE_STATE(op_chained_entry, NULL, NULL,
						&calculator_states[STATE_OP_ENTERED], NULL),
	[STATE_OP_NORMAL] =  SMF_CREATE_STATE(op_normal_entry, NULL, NULL,
						&calculator_states[STATE_OP_ENTERED], NULL),
	[STATE_ERROR] =      SMF_CREATE_STATE(error_entry, NULL, NULL,
						&calculator_states[STATE_ON], NULL),
};
/* clang-format on */

int post_calculator_event(struct calculator_event *event, k_timeout_t timeout)
{
	return k_msgq_put(&event_msgq, event, timeout);
}

static void output_display(void)
{
	char *output;

	switch (current_display_mode) {
	case DISPLAY_OPERAND_1:
		output = s_obj.operand_1.string;
		break;
	case DISPLAY_OPERAND_2:
		output = s_obj.operand_2.string;
		break;
	case DISPLAY_RESULT:
		output = s_obj.result.string;
		break;
	case DISPLAY_ERROR:
		output = "ERROR";
		break;
	default:
		output = "";
	}
	update_display(output);
}

static void smf_calculator_thread(void *arg1, void *arg2, void *arg3)
{
	smf_set_initial(SMF_CTX(&s_obj), &calculator_states[STATE_ON]);
	while (1) {
		int rc;

		rc = k_msgq_get(&event_msgq, &s_obj.event, K_FOREVER);
		if (rc != 0) {
			continue;
		}
		/* run state machine with given message */

		LOG_INF("Received %c from GUI", s_obj.event.operand);
		int ret = smf_run_state(SMF_CTX(&s_obj));

		if (ret) {
			/* State machine was terminated if a non-zero value is returned */
			break;
		}

		output_display();
		LOG_INF("op1=%s, op=%c op2=%s res=%s", s_obj.operand_1.string, s_obj.operator_btn,
			s_obj.operand_2.string, s_obj.result.string);
	}
}

K_THREAD_DEFINE(smf_calculator, SMF_THREAD_STACK_SIZE, smf_calculator_thread, NULL, NULL, NULL,
		SMF_THREAD_PRIORITY, 0, 0);
```

## src/smf_calculator_thread.h
```c
/*
 * Copyright (c) 2024 Glenn Andrews
 *
 * SPDX-License-Identifier: Apache-2.0
 */

#ifndef SMF_CALCULATOR_THREAD_H_
#define SMF_CALCULATOR_THREAD_H_

#include <zephyr/kernel.h>

#define SMF_THREAD_STACK_SIZE 1024
#define SMF_THREAD_PRIORITY   7

#define CALCULATOR_MAX_DIGITS 15

/* Add one byte for '-' sign, one for trailing '\0' */
#define CALCULATOR_STRING_LENGTH (CALCULATOR_MAX_DIGITS + 2)

enum calculator_events {
	DIGIT_0,
	DIGIT_1_9,
	DECIMAL_POINT,
	OPERATOR,
	EQUALS,
	CANCEL_ENTRY,
	CANCEL_BUTTON,
};

struct calculator_event {
	enum calculator_events event_id;
	char operand;
};

/* event queue to post messages to */
extern struct smf_event_queue smf_thread_event_queue;

int post_calculator_event(struct calculator_event *event, k_timeout_t timeout);

#endif /* SMF_CALCULATOR_THREAD_H_ */
```

## src/smf_console_cmds.c
```c
/*
 * Copyright (c) 2023 Glenn Andrews
 *
 * SPDX-License-Identifier: Apache-2.0
 */

#include <zephyr/kernel.h>
#include <zephyr/shell/shell.h>
#include "smf_calculator_thread.h"
#include <stdlib.h>

static int cmd_smf_key(const struct shell *sh, size_t argc, char **argv)
{
	struct calculator_event event;
	char c = argv[1][0];

	event.operand = c;

	if ((c >= '1') && (c <= '9')) {
		event.event_id = DIGIT_1_9;
	} else if (c == '0') {
		event.event_id = DIGIT_0;
	} else if (c == '.') {
		event.event_id = DECIMAL_POINT;
	} else if ((c == '+') || (c == '-') || (c == '*') || (c == '/')) {
		event.event_id = OPERATOR;
	} else if (c == '=') {
		event.event_id = EQUALS;
	} else if ((c == 'C') || (c == 'c')) {
		event.event_id = CANCEL_BUTTON;
	} else if ((c == 'E') || (c == 'e')) {
		event.event_id = CANCEL_ENTRY;
	} else {
		shell_error(sh, "Invalid argument %s", argv[1]);
		return -1;
	}

	int rc = post_calculator_event(&event, K_FOREVER);

	if (rc != 0) {
		shell_error(sh, "error posting key: %d", rc);
		return rc;
	}

	shell_print(sh, "Key %c posted", c);
	return 0;
}

SHELL_CMD_ARG_REGISTER(key, NULL,
		       "Send keypress to calculator\r\n"
		       "Valid keys 0-9, +-*/, '.', '=', 'E' (cancel entry) and C (clear)",
		       cmd_smf_key, 2, 0);
```
