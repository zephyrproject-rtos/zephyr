## CMakeLists.txt
```
# Copyright (c) 2025 Sean Kyer
#
# SPDX-License-Identifier: Apache-2.0

cmake_minimum_required(VERSION 3.28.0)

find_package(Zephyr REQUIRED HINTS $ENV{ZEPHYR_BASE})
project(cpu_freq_pressure_sample)

target_sources(app PRIVATE src/main.c)
```

## sample.yaml
```
sample:
  description: CPU frequency scaling pressure policy sample
  name: CPU Freq Pressure Sample
common:
  tags: cpu_freq
  harness: console
  harness_config:
    type: multi_line
    regex:
      - "^.*<inf> cpu_freq_pressure_sample: Mode 1: Low only"
      - "^.*<dbg> cpu_freq_policy_pressure: thread_eval_cb: Evaluating thread: 0x[0-9a-fA-F]+ \
         with prio: [0-9]+ status: [0-9]+"
      - "^.*<dbg> cpu_freq_policy_pressure: thread_eval_cb: Evaluating thread: 0x[0-9a-fA-F]+ \
         with prio: [0-9]+ status: [0-9]+"
      - "^.*<dbg> cpu_freq_policy_pressure: thread_eval_cb: Evaluating thread: 0x[0-9a-fA-F]+ \
         with prio: [0-9]+ status: [0-9]+"
      - "^.*<dbg> cpu_freq_policy_pressure: thread_eval_cb: Evaluating thread: 0x[0-9a-fA-F]+ \
         with prio: [0-9]+ status: [0-9]+"
      - "^.*<dbg> cpu_freq_policy_pressure: thread_eval_cb: Evaluating thread: 0x[0-9a-fA-F]+ \
         with prio: [0-9]+ status: [0-9]+"
      - "^.*<dbg> cpu_freq_policy_pressure: get_normalized_sys_pressure: System pressure is: \
         [0-9]+% \\(raw: [0-9]+ / max: [0-9]+\\)"
      - "^.*<dbg> cpu_freq_policy_pressure: cpu_freq_policy_select_pstate: CPU[0-9]+ Pressure: \
         [0-9]+%"
      - "^.*<dbg> cpu_freq_policy_pressure: cpu_freq_policy_select_pstate: Pressure Policy: \
         Selected P-state [0-9]+ with load_threshold=[0-9]+%"

tests:
  sample.cpu_freq_pressure:
    integration_platforms:
      - native_sim
      - native_sim/native/64
      - frdm_mcxn236
    platform_allow:
      - native_sim
      - native_sim/native/64
      - frdm_mcxn236
```

## prj.conf
```kconfig
# Copyright (c) 2025 Analog Devices, Inc.
#
# SPDX-License-Identifier: Apache-2.0

CONFIG_LOG=y
CONFIG_LOG_MODE_IMMEDIATE=y

# CPU Frequency Subsystem Configuration
CONFIG_CPU_FREQ=y
CONFIG_CPU_FREQ_LOG_LEVEL_DBG=y
CONFIG_CPU_FREQ_INTERVAL_MS=500
CONFIG_CPU_FREQ_POLICY_PRESSURE=y
CONFIG_CPU_FREQ_POLICY_PRESSURE_LOWEST_PRIO=10
```

## src/main.c
```c
/*
 * Copyright (c) 2025 Sean Kyer
 *
 * SPDX-License-Identifier: Apache-2.0
 */

#include <stdio.h>
#include <zephyr/kernel.h>
#include <zephyr/logging/log.h>

LOG_MODULE_REGISTER(cpu_freq_pressure_sample, LOG_LEVEL_INF);

#define SAMPLE_SLEEP_MS 1500

#define STACK_SIZE 1024
#define LOW_PRIO 10
#define MED_PRIO 5
#define HIGH_PRIO 1

K_THREAD_STACK_DEFINE(low_stack, STACK_SIZE);
K_THREAD_STACK_DEFINE(med_stack, STACK_SIZE);
K_THREAD_STACK_DEFINE(high_stack, STACK_SIZE);

struct k_thread low_thread_data;
struct k_thread med_thread_data;
struct k_thread high_thread_data;

static void thread_fn(void *arg1, void *arg2, void *arg3)
{
	(void)arg1;
	(void)arg2;
	(void)arg3;

	while (1) {
		k_busy_wait(10000000);
	}

	k_yield();
}

int main(void)
{
	LOG_INF("Starting CPU Freq Pressure Policy Sample!");

	/* Create threads with varying priorities and switch between them
	 * to increase/decrease pressure in the queue
	 */
	k_thread_create(&low_thread_data, low_stack, STACK_SIZE,
			thread_fn, NULL, NULL, NULL,
			LOW_PRIO, 0, K_NO_WAIT);

	k_thread_create(&med_thread_data, med_stack, STACK_SIZE,
			thread_fn, NULL, NULL, NULL,
			MED_PRIO, 0, K_NO_WAIT);

	k_thread_create(&high_thread_data, high_stack, STACK_SIZE,
			thread_fn, NULL, NULL, NULL,
			HIGH_PRIO, 0, K_NO_WAIT);

	static int mode;

	mode = 0;

	while (1) {
		mode = (mode % 3) + 1;

		switch (mode) {
		case 1:
			k_thread_resume(&low_thread_data);
			k_thread_suspend(&med_thread_data);
			k_thread_suspend(&high_thread_data);
			LOG_INF("Mode 1: Low only");
			break;
		case 2:
			k_thread_resume(&low_thread_data);
			k_thread_resume(&med_thread_data);
			k_thread_suspend(&high_thread_data);
			LOG_INF("Mode 2: Low + Medium");
			break;
		case 3:
			k_thread_resume(&low_thread_data);
			k_thread_resume(&med_thread_data);
			k_thread_resume(&high_thread_data);
			LOG_INF("Mode 3: Low + Medium + High");
			break;
		default:
			LOG_ERROR("Unknown mode!");
			return -1;
		}

		k_msleep(SAMPLE_SLEEP_MS);
	}
}
```
