## CMakeLists.txt
```
#
# Copyright (c) 2021 Nordic Semiconductor
#
# SPDX-License-Identifier: Apache-2.0
#

cmake_minimum_required(VERSION 3.20.0)

find_package(Zephyr REQUIRED HINTS $ENV{ZEPHYR_BASE})
project("Application Event Manager sample")

# Include application application event headers
zephyr_library_include_directories(src/events)

# Application sources
# NORDIC SDK APP START
target_sources(app PRIVATE src/main.c)

target_sources(app PRIVATE
		src/events/ack_event.c
		src/events/config_event.c
		src/events/control_event.c
		src/events/measurement_event.c
)

target_sources(app PRIVATE
		src/modules/controller.c
		src/modules/sensor_simulated.c
		src/modules/stats.c
)
# NORDIC SDK APP END
```

## sample.yaml
```
sample:
  description: Sample showing Application Event Manager usage
  name: Application Event Manager sample
common:
  harness: console
  integration_platforms:
    - qemu_cortex_m3
    - nrf52dk_nrf52832
    - nrf52840dk_nrf52840
    - nrf9160dk_nrf9160_ns
    - nrf21540dk_nrf52840
  harness_config:
    type: multi_line
    ordered: false
    regex:
      - "config_event"
      - "measurement_event"
      - "control_event"
      - "ack_event"
      - "Average value3: 45"
tests:
  samples.app_event_manager:
    build_only: false
```

## prj.conf
```kconfig
#
# Copyright (c) 2021 Nordic Semiconductor ASA
#
# SPDX-License-Identifier: Apache-2.0
#
# Enabling assert
CONFIG_ASSERT=y

# Logger configuration
CONFIG_LOG=y
CONFIG_LOG_DEFAULT_LEVEL=2

# Configuration required by Application Event Manager
CONFIG_APP_EVENT_MANAGER=y
CONFIG_HEAP_MEM_POOL_SIZE=2048
```

## src/main.c
```c
/*
 * Copyright (c) 2021 Nordic Semiconductor ASA
 *
 * SPDX-License-Identifier: Apache-2.0
 */

#include <app_event_manager/app_event_manager.h>
#include <config_event.h>
#include <logging/log.h>

#define MODULE main
LOG_MODULE_REGISTER(MODULE);

#define INIT_VALUE1 3

void main(void)
{
	if (app_event_manager_init()) {
		LOG_ERR("Application Event Manager not initialized");
	} else {
		struct config_event *event = new_config_event();

		event->init_value1 = INIT_VALUE1;
		APP_EVENT_SUBMIT(event);
	}
}
```
