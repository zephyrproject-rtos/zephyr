## samples/subsys/mp/jpeg_dec/boards/native_sim_64.conf
```kconfig
# Flash-backed FAT volume (disk-name "SD") for native_sim
CONFIG_FLASH_SIMULATOR=y
CONFIG_DISK_DRIVER_FLASH=y
```

## samples/subsys/mp/jpeg_dec/sample.yaml
```yaml
sample:
  name: MJPEG file decode pipeline

tests:
  sample.mp.mjpeg.decode:
    tags:
      - mp
      - video
      - filesystem
    platform_allow:
      - native_sim/native/64
      - mimxrt700_evk/mimxrt798s/cm33_cpu0
      - mimxrt1170_evk@B/mimxrt1176/cm7
    integration_platforms:
      - native_sim/native/64
      - mimxrt700_evk/mimxrt798s/cm33_cpu0
      - mimxrt1170_evk@B/mimxrt1176/cm7
    harness: console
    harness_config:
      type: one_line
      regex:
        - "EOS message from element"
```

## samples/subsys/mp/jpeg_enc/Kconfig
```kconfig
# Copyright 2026 Meta Platforms, Inc.
# SPDX-License-Identifier: Apache-2.0

mainmenu "MJPEG encode (round-trip) pipeline"

menu "Pipeline configuration"

config FILE_INPUT_PATH
	string "Input MJPEG file path"
	default "/SD:/test.mjpeg"
	help
	  Absolute path to the MJPEG input file.

config FILE_OUTPUT_PATH
	string "Output MJPEG file path"
	default "/SD:/test_out.mjpeg"
	help
	  Absolute path to the re-encoded MJPEG output file.

config JPEG_IMAGE_WIDTH
	int "Width of the JPEG image"
	default 320

config JPEG_IMAGE_HEIGHT
	int "Height of the JPEG image"
	default 240

config MJPEG_NUM_FRAMES
	int "Number of frames in the generated test MJPEG file"
	default 150
	help
	  Number of video frames to generate in the test MJPEG file.
	  The file is produced at build time using GStreamer CLI.

config JPEG_ENC_QUALITY
	int "JPEG encoder quality (JPEGE_Q_*: 0=BEST, 1=HIGH, 2=MED, 3=LOW)"
	range 0 3
	default 0
	help
	  Compression quality passed to the encoder via PROP_ZJPEG_ENC_QUALITY.
	  Maps to the bitbank JPEGENC 4-level enum: 0=JPEGE_Q_BEST, 1=JPEGE_Q_HIGH,
	  2=JPEGE_Q_MED, 3=JPEGE_Q_LOW.

config JPEG_ENC_SUBSAMPLE
	int "JPEG encoder chroma subsampling (JPEGE_SUBSAMPLE_*: 0=444, 1=420)"
	range 0 1
	default 1
	help
	  Chroma subsampling passed to the encoder via PROP_ZJPEG_ENC_SUBSAMPLE.
	  0=JPEGE_SUBSAMPLE_444, 1=JPEGE_SUBSAMPLE_420.

endmenu

source "Kconfig.zephyr"
```

## samples/subsys/mp/jpeg_enc/sample.yaml
```yaml
sample:
  name: MJPEG file encode (round-trip) pipeline

tests:
  sample.mp.mjpeg.encode:
    tags:
      - mp
      - video
      - filesystem
    platform_allow:
      - native_sim/native/64
    integration_platforms:
      - native_sim/native/64
    harness: console
    harness_config:
      type: one_line
      regex:
        - "EOS message from element"
```

## samples/subsys/mp/net_stream/boards/native_sim_64_loopback.conf
```kconfig
# Self-test configuration: uses Zephyr loopback (no TAP/root needed)
CONFIG_FLASH_SIMULATOR=y
CONFIG_DISK_DRIVER_FLASH=y

# Loopback-only networking - no TAP interface required
CONFIG_NET_LOOPBACK=y
CONFIG_NET_CONFIG_SETTINGS=y
CONFIG_NET_CONFIG_NEED_IPV4=y
CONFIG_NET_CONFIG_MY_IPV4_ADDR="127.0.0.1"

# Self-test client thread
CONFIG_SAMPLE_NET_STREAM_SELFTEST=y
CONFIG_SAMPLE_NET_STREAM_SELFTEST_ADDR="127.0.0.1"

# Larger heap for JPEG frame buffers
CONFIG_HEAP_MEM_POOL_SIZE=524288
CONFIG_MAIN_STACK_SIZE=8192
```

## samples/subsys/mp/tee_dec/Kconfig
```kconfig
# Copyright 2026 NXP
# SPDX-License-Identifier: Apache-2.0

mainmenu "MJPEG tee pipeline (decode + filesink)"

menu "Pipeline configuration"

config FILE_INPUT_PATH
	string "Input MJPEG file path"
	default "/SD:/test.mjpeg"
	help
	  Absolute path to the MJPEG input file.

config FILE_OUTPUT_PATH
	string "Output raw file path (filesink branch)"
	default "/SD:/tee_out.mjpeg"
	help
	  Absolute path where the tee filesink branch writes raw JPEG frames.

config JPEG_IMAGE_WIDTH
	int "Width of the JPEG image"
	default 320

config JPEG_IMAGE_HEIGHT
	int "Height of the JPEG image"
	default 240

config MJPEG_NUM_FRAMES
	int "Number of frames in the generated test MJPEG file"
	default 150
	help
	  Number of video frames to generate in the test MJPEG file.

endmenu

source "Kconfig.zephyr"
```

## samples/subsys/mp/tee_dec/boards/native_sim_64.conf
```kconfig
# Flash-backed FAT volume (disk-name "SD") for native_sim
CONFIG_FLASH_SIMULATOR=y
CONFIG_DISK_DRIVER_FLASH=y

# Bind the native PTY UART to stdin/stdout so the shell reads keystrokes typed
# on the launching terminal (otherwise the shell sits on a separate PTY and the
# p/s/r/q commands never receive input).
CONFIG_UART_NATIVE_PTY_0_ON_STDINOUT=y

# Log directly to stdout via the native backend, which is active from boot so
# the boot banner and early log lines (before the shell is up) are printed.
# Disable the shell log backend so those same lines are not printed a second
# time once the shell starts.
CONFIG_LOG_BACKEND_NATIVE_POSIX=y
CONFIG_SHELL_LOG_BACKEND=n
```

## samples/subsys/mp/tee_dec/sample.yaml
```yaml
sample:
  name: MediaPipe tee_dec sample

tests:
  sample.mp.tee_dec:
    tags:
      - mp
      - tee_dec
    platform_allow:
      - native_sim/native/64
    integration_platforms:
      - native_sim/native/64
    harness: console
    harness_config:
      type: one_line
      regex:
        - "End of stream"
```

## samples/subsys/mpipe/dmic_i2s/Kconfig
```kconfig
# Copyright 2026 NXP
# SPDX-License-Identifier: Apache-2.0

source "Kconfig.zephyr"

config USE_I2S_TARGET_CODEC_CONTROLLER
	bool "I2S BCK is generated by a selected codec device"
	help
	  If selected, the I2S selected peripheral will be configured to consume
	  (receive) the I2S BCK and WS signals and the codec will be configured
	  to generate those. If not selected, the I2S peripheral will generate
	  them and the codec will be expected to consume them.
```

## samples/subsys/nsettings/sample.yaml
```yaml
sample:
  name: Settings Sample

tests:
  test:
    tags: settings
    depends_on: nsettings
```

## samples/subsys/nvs/sample.yaml
```yaml
sample:
  name: NVS Sample

tests:
  sample.nvs.basic:
    tags: nvs
    depends_on: nvs
    platform_exclude: qemu_x86
    integration_platforms:
      - nrf52dk_nrf52832
    harness: console
    harness_config:
      type: multi_line
      regex:
        - "Id: 1, Address: 192.168.1.1"
        - "Id: 2, Key: ff fe fd fc fb fa f9 f8"
        - "Id: 3, Reboot_counter: (.*)"
        - "Id: 4, Data: DATA"
        - "Id: 5, Longarray: 0 1 2 3 4 5 6 7 8 9 a b c d e f 10 11 12 13 14 15 16 17 18 19 1a 1b \
           1c 1d 1e 1f 20 21 22 23 24 25 26 27 28 29 2a 2b 2c 2d 2e 2f 30 31 32 33 34 35 36 37 38 \
           39 3a 3b 3c 3d 3e 3f 40 41 42 43 44 45 46 47 48 49 4a 4b 4c 4d 4e 4f 50 51 52 53 54 55 \
           56 57 58 59 5a 5b 5c 5d 5e 5f 60 61 62 63 64 65 66 67 68 69 6a 6b 6c 6d 6e 6f 70 71 72 \
           73 74 75 76 77 78 79 7a 7b 7c 7d 7e 7f"
```

## samples/subsys/pm/device_pm/sample.yaml
```yaml
sample:
  name: Device Idle Power Management
tests:
  sample.power.ospm.dev_idle_pm:
    platform_allow:
      - nrf52840dk/nrf52840
      - nrf52dk/nrf52832
      - qemu_x86
      - mps2/an385
    integration_platforms:
      - qemu_x86
    tags: power
    harness: console
    harness_config:
      type: multi_line
      regex:
        - "parent suspending\\.\\."
        - "child suspending\\.\\."
        - "Device PM sample app start"
        - "parent resuming\\.\\."
        - "child resuming\\.\\."
        - "Dummy device resumed"
        - "child suspending\\.\\."
        - "parent suspending\\.\\."
        - "Device PM sample app complete"
```

## samples/subsys/pm/event_device/boards/nrf54h20dk_nrf54h20_cpuapp.conf
```kconfig
# Copyright (c) 2025 Nordic Semiconductor ASA
# SPDX-License-Identifier: Apache-2.0

# PM is required for the CPU to enter inactive state
# allowing for LRCCONF CONSTLAT to have measurable
# impact on current consumption.
CONFIG_PM=y
```

## samples/subsys/pm/event_device/boards/nrf54l15dk_nrf54l15_cpuapp.conf
```kconfig
# Copyright (c) 2025 Nordic Semiconductor ASA
# SPDX-License-Identifier: Apache-2.0

# The RRAM event device is a flash device. This selection
# includes the device driver for it.
CONFIG_FLASH=y
```

## samples/subsys/pm/event_device/sample.yaml
```yaml
# Copyright (c) 2025 Nordic Semiconductor ASA
# SPDX-License-Identifier: Apache-2.0

sample:
  name: PM event device sample
tests:
  sample.subsys.pm.event_device:
    tags:
      - pm_event_device
    platform_allow:
      - nrf54h20dk/nrf54h20/cpuapp
      - nrf54l15dk/nrf54l15/cpuapp
      - nrf5340dk/nrf5340/cpuapp
      - nrf5340dk/nrf5340/cpunet
      - nrf52840dk/nrf52840
```

## samples/subsys/pm/event_domain/boards/nrf54l15dk_nrf54l15_cpuapp.conf
```kconfig
# Copyright (c) 2025 Nordic Semiconductor ASA
# SPDX-License-Identifier: Apache-2.0

# RRAM is an event device
CONFIG_FLASH=y
```

## samples/subsys/pm/event_domain/sample.yaml
```yaml
# Copyright (c) 2025 Nordic Semiconductor ASA
# SPDX-License-Identifier: Apache-2.0

sample:
  name: PM event domain sample
tests:
  sample.subsys.pm.event_domain:
    tags:
      - pm_event_device
      - pm_event_domain
    platform_allow:
      - b_u585i_iot02a
      - nrf54h20dk/nrf54h20/cpuapp
      - nrf54l15dk/nrf54l15/cpuapp
      - nrf5340dk/nrf5340/cpuapp
      - nrf52840dk/nrf52840
```

## samples/subsys/pm/event_domain_toggle/boards/b_u585i_iot02a.conf
```kconfig
# Copyright (c) 2025 Nordic Semiconductor ASA
# SPDX-License-Identifier: Apache-2.0

CONFIG_PM=y
CONFIG_PM_DEVICE=y
CONFIG_PM_DEVICE_RUNTIME=y
```

## samples/subsys/pm/event_domain_toggle/boards/nrf54h20dk_nrf54h20_cpuapp.conf
```kconfig
# Copyright (c) 2025 Nordic Semiconductor ASA
# SPDX-License-Identifier: Apache-2.0

CONFIG_PM=y
CONFIG_PM_S2RAM=y
CONFIG_PM_S2RAM_CUSTOM_MARKING=y
```

## samples/subsys/pm/latency/Kconfig
```kconfig
# Copyright (c) 2022 Nordic Semiconductor ASA
# SPDX-License-Identifier: Apache-2.0

menu "Zephyr"
source "Kconfig.zephyr"
endmenu

module = APP
module-str = Application
source "subsys/logging/Kconfig.template.log_config"


config APP_PROVIDE_PM_HOOKS
	bool "Application provides PM hooks"
	default y
	select HAS_PM
```

## samples/subsys/pm/latency/sample.yaml
```yaml
sample:
  name: Demonstrate usage of the PM policy latency APIs
tests:
  sample.pm.latency:
    platform_allow: native_posix
    integration_platforms:
      - native_posix
    tags: pm
    harness: console
    harness_config:
      type: multi_line
      regex:
        - "<inf> app: Sleeping for 1.1 seconds, we should enter RUNTIME_IDLE"
        - "<inf> soc_pm: Entering RUNTIME_IDLE{0}"
        - "<inf> app: Sleeping for 1.2 seconds, we should enter SUSPEND_TO_IDLE"
        - "<inf> soc_pm: Entering SUSPEND_TO_IDLE{0}"
        - "<inf> app: Sleeping for 1.3 seconds, we should enter STANDBY"
        - "<inf> soc_pm: Entering STANDBY{0}"
        - "<inf> app: Setting latency constraint: 30ms"
        - "<inf> app: Sleeping for 1.1 seconds, we should enter RUNTIME_IDLE"
        - "<inf> soc_pm: Entering RUNTIME_IDLE{0}"
        - "<inf> app: Sleeping for 1.2 seconds, we should enter SUSPEND_TO_IDLE"
        - "<inf> soc_pm: Entering SUSPEND_TO_IDLE{0}"
        - "<inf> app: Sleeping for 1.3 seconds, we should enter SUSPEND_TO_IDLE"
        - "<inf> soc_pm: Entering SUSPEND_TO_IDLE{0}"
        - "<inf> app: Opening test device"
        - "<inf> dev_test: Adding latency constraint: 20ms"
        - "<inf> app: Latency constraint changed: 20ms"
        - "<inf> app: Sleeping for 1.1 seconds, we should enter RUNTIME_IDLE"
        - "<inf> soc_pm: Entering RUNTIME_IDLE{0}"
        - "<inf> app: Sleeping for 1.2 seconds, we should enter RUNTIME_IDLE"
        - "<inf> soc_pm: Entering RUNTIME_IDLE{0}"
        - "<inf> app: Sleeping for 1.3 seconds, we should enter RUNTIME_IDLE"
        - "<inf> soc_pm: Entering RUNTIME_IDLE{0}"
        - "<inf> app: Updating latency constraint: 10ms"
        - "<inf> app: Latency constraint changed: 10ms"
        - "<inf> dev_test: Latency constraint changed: 10ms"
        - "<inf> app: Sleeping for 1.1 seconds, we should stay ACTIVE"
        - "<inf> app: Sleeping for 1.2 seconds, we should stay ACTIVE"
        - "<inf> app: Sleeping for 1.3 seconds, we should stay ACTIVE"
        - "<inf> app: Updating latency constraint: 30ms"
        - "<inf> app: Latency constraint changed: 20ms"
        - "<inf> dev_test: Latency constraint changed: 20ms"
        - "<inf> app: Closing test device"
        - "<inf> dev_test: Removing latency constraint"
        - "<inf> app: Latency constraint changed: 30ms"
        - "<inf> dev_test: Latency constraint changed: 30ms"
        - "<inf> app: Sleeping for 1.1 seconds, we should enter RUNTIME_IDLE"
        - "<inf> soc_pm: Entering RUNTIME_IDLE{0}"
        - "<inf> app: Sleeping for 1.2 seconds, we should enter SUSPEND_TO_IDLE"
        - "<inf> soc_pm: Entering SUSPEND_TO_IDLE{0}"
        - "<inf> app: Sleeping for 1.3 seconds, we should enter SUSPEND_TO_IDLE"
        - "<inf> soc_pm: Entering SUSPEND_TO_IDLE{0}"
        - "<inf> app: Removing latency constraint"
        - "<inf> app: Latency constraint changed: none"
        - "<inf> app: Finished, we should now enter STANDBY"
        - "<inf> soc_pm: Entering STANDBY{0}"
```

## samples/subsys/pm/pm_sleep/Kconfig
```kconfig
# Copyright (c) 2026 Rithic Chellaram Hariharan
# SPDX-License-Identifier: Apache-2.0

menu "Zephyr"
source "Kconfig.zephyr"
endmenu

config APP_SIM_PM_BACKEND
	bool "Provide a simulated power-management backend"
	default y if BOARD_NATIVE_SIM
	select HAS_PM
	help
	  Emulation targets such as native_sim do not implement the SoC
	  pm_state_set() hook required by the power-management subsystem.
	  Enable this option to provide a trivial simulated backend (and a
	  custom policy that only enters explicitly requested states) so the
	  sample can demonstrate pm_light_sleep() and pm_deep_sleep().

	  On real hardware the SoC supplies the backend, so this option is
	  disabled by default for any board other than native_sim.
```

## samples/subsys/pm/pm_sleep/boards/esp32_devkitc_procpu.conf
```kconfig
# Espressif light sleep wakes from the RTC timer, which needs device PM and the
# counter driver.
CONFIG_PM_DEVICE=y
CONFIG_COUNTER=y
```

## samples/subsys/pm/pm_sleep/boards/frdm_mcxn236.conf
```kconfig
# MCXN low-power modes gate the main clocks; use the LPTMR as the wake-up timer.
CONFIG_PM_PREWAKEUP_CONV_MODE_CEIL=y
CONFIG_COUNTER=y
CONFIG_COUNTER_MCUX_LPTMR_ALARM=y
```
