## CMakeLists.txt
```
# Copyright 2026 NXP
# SPDX-License-Identifier: Apache-2.0

cmake_minimum_required(VERSION 3.20.0)

find_package(Zephyr REQUIRED HINTS $ENV{ZEPHYR_BASE})
project(mp_ipc_loopback)

target_sources(app PRIVATE src/main.c src/backend.c src/mp_test_sink.c)
```

## prj.conf
```kconfig
# Copyright 2026 NXP
# SPDX-License-Identifier: Apache-2.0

CONFIG_MP=y
CONFIG_IPC_SERVICE=y
CONFIG_MP_PLUGIN_IPC=y

# Disable cache management for QEMU loopback simulation to avoid arch-specific linker issues
CONFIG_CACHE_MANAGEMENT=n

# MediaPipe Subsystem Config
CONFIG_MP_THREADS_NUM=2
CONFIG_MP_NET_BUF_POOL_COUNT=8
CONFIG_MP_FAKE_SRC=y
CONFIG_MP_FAKE_SRC_BUF_SZ=128

# Logging Configuration
CONFIG_LOG=y
CONFIG_LOG_DEFAULT_LEVEL=3
CONFIG_MP_LOG_LEVEL_DBG=y

# Heap and buffer allocations
CONFIG_HEAP_MEM_POOL_SIZE=16384
CONFIG_NET_BUF=y
```

## boards/qemu_cortex_a53.overlay
```dts
/*
 * Copyright 2026 NXP
 *
 * SPDX-License-Identifier: Apache-2.0
 */

/ {
	ipc0: ipc0 {
		compatible = "ipc-service-backend";
		status = "okay";
	};
};
```

## src/main.c
```c
/*
 * Copyright 2026 NXP
 *
 * SPDX-License-Identifier: Apache-2.0
 */

#include <zephyr/kernel.h>
#include <zephyr/logging/log.h>
#include <zephyr/net_buf.h>

#include <zephyr/mp/core/mp.h>
#include <zephyr/mp/core/mp_pipeline.h>
#include <zephyr/mp/core/mp_bin.h>
#include <zephyr/mp/core/mp_element.h>
#include <zephyr/mp/core/mp_pad.h>
#include <zephyr/mp/core/mp_fake_src.h>
#include <zephyr/mp/ipc/mp_ipc.h>
#include <zephyr/mp/ipc/mp_ipc_protocol.h>

#include "mp_test_sink.h"

LOG_MODULE_REGISTER(mp_ipc_loopback_app, LOG_LEVEL_INF);

#define PIPE_A_ID    0
#define FAKE_SRC_ID  1
#define IPC_SINK_ID  2

#define PIPE_B_ID    3
#define IPC_SRC_ID   4
#define TEST_SINK_ID 5

static struct mp_pipeline pipeline_a;
static struct mp_fake_src fake_src;
static struct mp_ipc_sink ipc_sink;

static struct mp_pipeline pipeline_b;
static struct mp_ipc_src ipc_src;
static struct mp_test_sink test_sink;

int main(void)
{
	int ret;

	LOG_INF("--- Starting Approach 1: Single-Binary Loopback Simulation ---");
	LOG_INF("Topology: [fake_src] -> [ipc_sink] ===== (IPC Loopback) =====> [ipc_src] -> [test_sink]");

	/* 1. Build the pipelines and elements using standard MP_ELEMENT_INIT */
	MP_ELEMENT_INIT(&pipeline_a, mp_pipeline_init, PIPE_A_ID);
	MP_ELEMENT_INIT(&fake_src, mp_fake_src_init, FAKE_SRC_ID);
	MP_ELEMENT_INIT(&ipc_sink, mp_ipc_sink_init, IPC_SINK_ID);

	MP_ELEMENT_INIT(&pipeline_b, mp_pipeline_init, PIPE_B_ID);
	MP_ELEMENT_INIT(&ipc_src, mp_ipc_src_init, IPC_SRC_ID);
	MP_ELEMENT_INIT(&test_sink, mp_test_sink_init, TEST_SINK_ID);

	/* 2. Link elements together using upstream-compliant mp_element_link */
	ret = mp_element_link((struct mp_element *)&fake_src, (struct mp_element *)&ipc_sink, NULL);
	if (ret < 0) {
		LOG_ERR("Failed to link elements on Pipeline A (%d)", ret);
		return ret;
	}

	ret = mp_element_link((struct mp_element *)&ipc_src, (struct mp_element *)&test_sink, NULL);
	if (ret < 0) {
		LOG_ERR("Failed to link elements on Pipeline B (%d)", ret);
		return ret;
	}

	/* 3. Add elements to respective bins */
	ret = mp_bin_add((struct mp_bin *)&pipeline_a, (struct mp_element *)&fake_src, (struct mp_element *)&ipc_sink, NULL);
	if (ret < 0) {
		LOG_ERR("Failed to add elements to Pipeline A (%d)", ret);
		return ret;
	}

	ret = mp_bin_add((struct mp_bin *)&pipeline_b, (struct mp_element *)&ipc_src, (struct mp_element *)&test_sink, NULL);
	if (ret < 0) {
		LOG_ERR("Failed to add elements to Pipeline B (%d)", ret);
		return ret;
	}

	/* 4. Start Pipeline B (Slave / Receiver Side) */
	LOG_INF("Starting Pipeline B...");
	if (mp_element_set_state((struct mp_element *)&pipeline_b, MP_STATE_PLAYING) != MP_STATE_CHANGE_SUCCESS) {
		LOG_ERR("Failed to start Pipeline B");
		return -EIO;
	}

	/* 5. Start Pipeline A (Master / Sender Side) */
	LOG_INF("Starting Pipeline A...");
	if (mp_element_set_state((struct mp_element *)&pipeline_a, MP_STATE_PLAYING) != MP_STATE_CHANGE_SUCCESS) {
		LOG_ERR("Failed to start Pipeline A");
		return -EIO;
	}

	/* 6. Wait for EOS message on Pipeline B's Bus (notifying that processing is complete) */
	LOG_INF("Pipeline is playing. Waiting for EOS / complete message on Bus...");
	struct mp_bus *bus = mp_element_get_bus((struct mp_element *)&pipeline_b);
	struct mp_message msg;

	mp_bus_pop_msg(bus, MP_MESSAGE_ERROR | MP_MESSAGE_EOS, &msg);

	switch (msg.type) {
	case MP_MESSAGE_ERROR:
		LOG_ERR("ERROR message from element %d", msg.origin->object.id);
		break;
	case MP_MESSAGE_EOS:
		LOG_INF("EOS message from element %d (SUCCESS: Frame transfer completed)", msg.origin->object.id);
		break;
	default:
		LOG_ERR("Unexpected message from element %d", msg.origin->object.id);
		break;
	}

	/* Stop/Deinit both pipelines */
	LOG_INF("Stopping pipelines...");
	(void)mp_element_set_state((struct mp_element *)&pipeline_a, MP_STATE_READY);
	(void)mp_element_set_state((struct mp_element *)&pipeline_b, MP_STATE_READY);

	LOG_INF("--- Approach 1 Completed Successfully ---");
	return 0;
}
```

## src/backend.c
```c
/*
 * Copyright 2026 NXP
 *
 * SPDX-License-Identifier: Apache-2.0
 */

#include <zephyr/ipc/ipc_service_backend.h>
#include <zephyr/logging/log.h>
#include <zephyr/kernel.h>
#include <zephyr/device.h>

#define DT_DRV_COMPAT ipc_service_backend

LOG_MODULE_REGISTER(loopback_backend, LOG_LEVEL_INF);

struct backend_data_t {
	const struct ipc_ept_cfg *ept_cfgs[2];
	int ept_count;
};

static int loopback_send(const struct device *instance, void *token,
			 const void *p_data, size_t len)
{
	struct backend_data_t *data = instance->data;

	/* Route the message to the other registered endpoint */
	for (int i = 0; i < 2; i++) {
		if (data->ept_cfgs[i] && data->ept_cfgs[i] != token) {
			if (data->ept_cfgs[i]->cb.received) {
				data->ept_cfgs[i]->cb.received(p_data, len, data->ept_cfgs[i]->priv);
			}
			return 0;
		}
	}

	return -ENOTCONN;
}

static int loopback_register_ept(const struct device *instance,
				 void **token,
				 const struct ipc_ept_cfg *cfg)
{
	struct backend_data_t *data = instance->data;

	if (data->ept_count >= 2) {
		return -ENOMEM;
	}

	data->ept_cfgs[data->ept_count] = cfg;
	*token = (void *)cfg;
	data->ept_count++;

	LOG_INF("Registered endpoint %s on loopback backend", cfg->name);

	/* When both sink and src endpoints are registered, trigger the bound callback on both */
	if (data->ept_count == 2) {
		LOG_INF("Both endpoints registered. Binding connection...");
		if (data->ept_cfgs[0]->cb.bound) {
			data->ept_cfgs[0]->cb.bound(data->ept_cfgs[0]->priv);
		}
		if (data->ept_cfgs[1]->cb.bound) {
			data->ept_cfgs[1]->cb.bound(data->ept_cfgs[1]->priv);
		}
	}

	return 0;
}

static int loopback_deregister_ept(const struct device *instance, void *token)
{
	struct backend_data_t *data = instance->data;

	for (int i = 0; i < 2; i++) {
		if (data->ept_cfgs[i] == token) {
			data->ept_cfgs[i] = NULL;
			data->ept_count--;
			return 0;
		}
	}

	return -ENOENT;
}

static const struct ipc_service_backend backend_ops = {
	.send = loopback_send,
	.register_endpoint = loopback_register_ept,
	.deregister_endpoint = loopback_deregister_ept,
};

#define DEFINE_BACKEND_DEVICE(i) \
	static struct backend_data_t backend_data_##i = { \
		.ept_count = 0, \
	}; \
	DEVICE_DT_INST_DEFINE(i, \
			      NULL, \
			      NULL, \
			      &backend_data_##i, \
			      NULL, \
			      POST_KERNEL, \
			      CONFIG_IPC_SERVICE_REG_BACKEND_PRIORITY, \
			      &backend_ops);

DT_INST_FOREACH_STATUS_OKAY(DEFINE_BACKEND_DEVICE)
```

## src/mp_test_sink.c
```c
/*
 * Copyright 2026 NXP
 *
 * SPDX-License-Identifier: Apache-2.0
 */

#include <zephyr/kernel.h>
#include <zephyr/logging/log.h>
#include <zephyr/net_buf.h>

#include <zephyr/mp/core/mp_bus.h>
#include <zephyr/mp/core/mp_message.h>
#include <zephyr/mp/core/mp_element.h>
#include <zephyr/mp/core/mp_caps.h>
#include <zephyr/mp/core/mp_dispatch.h>

#include "mp_test_sink.h"

LOG_MODULE_DECLARE(mp_ipc_loopback_app, LOG_LEVEL_INF);

static int mp_test_sink_chainfn(struct mp_pad *pad, struct net_buf *buf, struct net_buf **out_buf)
{
	struct mp_test_sink *self = (struct mp_test_sink *)pad->object.container;
	struct mp_buffer_meta *meta = mp_buffer_get_meta(buf);

	self->frame_count++;
	LOG_INF("[Pipeline B: mp_test_sink] Received Frame %d: size=%u, timestamp=%u", 
		self->frame_count, buf->len, meta->timestamp);

	/* When we receive 3 frames, post an EOS message to Pipeline B's bus */
	if (self->frame_count >= 3) {
		struct mp_bus *bus = mp_element_get_bus((struct mp_element *)self);
		if (bus) {
			struct mp_message eos_msg;
			MP_MESSAGE_INIT(&eos_msg, (struct mp_element *)self, MP_MESSAGE_EOS);
			mp_bus_post(bus, &eos_msg);
		}
	}

	if (out_buf) {
		*out_buf = NULL;
	}
	return 0;
}

static int mp_test_sink_queryfn(struct mp_pad *pad, struct mp_dispatch *query)
{
	if (query->type == MP_DISPATCH_CAPS) {
		struct mp_caps *caps = mp_caps_new_any();
		mp_dispatch_set_caps(query, caps);
		mp_caps_unref(caps);
		return 0;
	} else if (query->type == MP_DISPATCH_BUFFER_CONFIG) {
		return 0;
	}
	return -ENOTSUP;
}

void mp_test_sink_init(struct mp_element *self)
{
	struct mp_test_sink *tsink = (struct mp_test_sink *)self;
	mp_sink_init(self);
	tsink->base.sinkpad.chainfn = mp_test_sink_chainfn;
	tsink->base.sinkpad.queryfn = mp_test_sink_queryfn;
	tsink->frame_count = 0;
}
```
