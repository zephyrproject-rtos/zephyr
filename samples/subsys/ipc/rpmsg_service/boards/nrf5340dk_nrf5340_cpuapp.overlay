/*
 * Copyright (c) 2022 Nordic Semiconductor ASA
 *
 * SPDX-License-Identifier: Apache-2.0
 */

/ {
	soc {
		peripheral@50000000 {
			/delete-node/ ipc@2a000;

			ipc: ipc@2a000 {
				compatible = "nordic,nrf-ipc";
				reg = <0x2a000 0x1000>;
				interrupts = <42 NRF_DEFAULT_IRQ_PRIORITY>;
				status = "okay";
				label = "IPC";
			};
		};
	};
};
