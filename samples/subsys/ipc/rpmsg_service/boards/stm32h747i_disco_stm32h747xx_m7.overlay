/*
 * Copyright (c) 2024 Celina Sophie Kalus <hello@celinakalus.de>
 *
 * SPDX-License-Identifier: Apache-2.0
 */

/ {
	chosen {
		zephyr,ipc_shm = &sram4;
		zephyr,ipc = &mailbox;
	};
};

&mailbox {
	status = "okay";
};
