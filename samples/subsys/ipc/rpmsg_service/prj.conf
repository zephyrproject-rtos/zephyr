## CMakeLists.txt
```
cmake_minimum_required(VERSION 3.28.0)
# Copyright (c) 2019 Linaro Limited
# Copyright (c) 2018-2021 Nordic Semiconductor ASA
# Copyright (c) 2023 Arm Limited
#
# SPDX-License-Identifier: Apache-2.0
#

set(REMOTE_ZEPHYR_DIR ${CMAKE_CURRENT_BINARY_DIR}/../rpmsg_service_remote/zephyr)

find_package(Zephyr REQUIRED HINTS $ENV{ZEPHYR_BASE})
project(rpmsg_service)

message(STATUS "${BOARD} compile as Master in this sample")

enable_language(C ASM)

target_sources(app PRIVATE src/main.c)
```

## Kconfig
```
# Copyright (c) 2025 Espressif Systems (Shanghai) Co., Ltd.
# SPDX-License-Identifier: Apache-2.0

source "Kconfig.zephyr"

config RPMSG_SERVICE_DEMO_CYCLES
	int "Number of demo message cycles"
	default 1000
	range 10 10000

config MAIN_APP_TASK_STACK_SIZE
	int "Main application task size"
	default 1024
```

## Kconfig.sysbuild
```
# Copyright (c) 2023 Arm Limited
#
# SPDX-License-Identifier: Apache-2.0

source "share/sysbuild/Kconfig"

config RPMSG_REMOTE_BOARD
	string
	default "mps2/an521/cpu1" if $(BOARD) = "mps2"
	default "v2m_musca_b1/musca_b1/ns" if $(BOARD) = "v2m_musca_b1"
	default "stm32h747i_disco/stm32h747xx/m4" if $(BOARD) = "stm32h747i_disco"
	default "esp32_devkitc/esp32/appcpu" if $(BOARD) = "esp32_devkitc"
	default "esp32s3_devkitc/esp32s3/appcpu" if $(BOARD) = "esp32s3_devkitc"
```

## sample.yaml
```
sample:
  name: IPC Service example integration (rpmsg backend)
tests:
  sample.ipc.rpmsg_service:
    platform_allow:
      - mps2/an521/cpu0
      - v2m_musca_b1/musca_b1
    integration_platforms:
      - mps2/an521/cpu0
      - v2m_musca_b1/musca_b1
    tags:
      - ipc
      - openamp
    sysbuild: true
    harness: remote
```

## prj.conf
```kconfig
CONFIG_PRINTK=y
CONFIG_IPM=y
CONFIG_TIMESLICE_SIZE=1
CONFIG_MAIN_STACK_SIZE=2048
CONFIG_HEAP_MEM_POOL_SIZE=4096
CONFIG_RPMSG_SERVICE=y
CONFIG_RPMSG_SERVICE_MODE_MASTER=y
CONFIG_OPENAMP_SLAVE=n
```

## boards/esp32.conf
```kconfig
CONFIG_ESP32_NETWORK_CORE=y
```

## boards/nrf5340dk_nrf5340_cpuapp.conf
```kconfig
CONFIG_BOARD_ENABLE_CPUNET=y
```

## boards/esp32s3_devkitm.overlay
```dts
/*
 * Copyright (c) 2023 Felipe Neves <ryukokki.felipe@gmail.com>
 *
 * SPDX-License-Identifier: Apache-2.0
 */

/ {
	chosen {
		/*
		 * shared memory reserved for the inter-processor communication
		 */
		zephyr,ipc_shm = &shm0;
		zephyr,ipc = &ipm0;
	};
};

&ipm0 {
	status = "okay";
};
```

## boards/nrf5340dk_nrf5340_cpuapp.overlay
```dts
/*
 * Copyright (c) 2022 Nordic Semiconductor ASA
 *
 * SPDX-License-Identifier: Apache-2.0
 */

/ {
	soc {
		peripheral@50000000 {
			/delete-node/ ipc@2a000;

			ipc: ipc@2a000 {
				compatible = "nordic,nrf-ipc";
				reg = <0x2a000 0x1000>;
				interrupts = <42 NRF_DEFAULT_IRQ_PRIORITY>;
				status = "okay";
				label = "IPC";
			};
		};
	};
};
```

## boards/stm32h747i_disco_m7.overlay
```dts
/*
 * Copyright (c) 2023 Celina Sophie Kalus <hello@celinakalus.de>
 *
 * SPDX-License-Identifier: Apache-2.0
 */

/ {
	chosen {
		zephyr,ipc_shm = &sram4;
		zephyr,ipc = &mailbox;
	};
};

&mailbox {
	status = "okay";
};
```

## boards/stm32h747i_disco_stm32h747xx_m7.overlay
```dts
/*
 * Copyright (c) 2024 Celina Sophie Kalus <hello@celinakalus.de>
 *
 * SPDX-License-Identifier: Apache-2.0
 */

/ {
	chosen {
		zephyr,ipc_shm = &sram4;
		zephyr,ipc = &mailbox;
	};
};

&mailbox {
	status = "okay";
};
```

## socs/esp32_procpu.overlay
```dts
/*
 * Copyright (c) 2025 Espressif Systems (Shanghai) Co., Ltd.
 *
 * SPDX-License-Identifier: Apache-2.0
 */

/ {
	chosen {
		zephyr,ipc_shm = &shm0;
		zephyr,ipc = &ipm0;
	};
};

&ipm0 {
	status = "okay";
};
```

## src/main.c
```c
/*
 * Copyright (c) 2018, NXP
 * Copyright (c) 2018-2019, Linaro Limited
 * Copyright (c) 2018-2021, Nordic Semiconductor ASA
 *
 * SPDX-License-Identifier: Apache-2.0
 */

#include <zephyr/kernel.h>
#include <zephyr/drivers/ipm.h>
#include <zephyr/sys/printk.h>
#include <zephyr/device.h>
#include <stdio.h>
#include <stdlib.h>
#include <string.h>
#include <zephyr/init.h>

#include <zephyr/ipc/rpmsg_service.h>

K_THREAD_STACK_DEFINE(thread_stack, CONFIG_MAIN_APP_TASK_STACK_SIZE);
static struct k_thread thread_data;

static volatile unsigned int received_data;

static K_SEM_DEFINE(data_rx_sem, 0, 1);

int endpoint_cb(struct rpmsg_endpoint *ept, void *data, size_t len, uint32_t src, void *priv)
{
	received_data = *((unsigned int *)data);

	k_sem_give(&data_rx_sem);

	return RPMSG_SUCCESS;
}

static int ep_id;
struct rpmsg_endpoint my_ept;
struct rpmsg_endpoint *ep = &my_ept;

static unsigned int receive_message(void)
{
	k_sem_take(&data_rx_sem, K_FOREVER);
	return received_data;
}

static int send_message(unsigned int message)
{
	return rpmsg_service_send(ep_id, &message, sizeof(message));
}

void app_task(void *arg1, void *arg2, void *arg3)
{
	ARG_UNUSED(arg1);
	ARG_UNUSED(arg2);
	ARG_UNUSED(arg3);

	int status = 0;
	unsigned int message = 0U;

	printk("\r\nRPMsg Service [master] demo started\r\n");

	/* Since we are using name service, we need to wait for a response
	 * from NS setup and than we need to process it
	 */
	while (!rpmsg_service_endpoint_is_bound(ep_id)) {
		k_sleep(K_MSEC(1));
	}

	while (message < CONFIG_RPMSG_SERVICE_DEMO_CYCLES) {
		status = send_message(message);
		if (status < 0) {
			printk("send_message(%d) failed with status %d\n", message, status);
			break;
		}

		message = receive_message();
		printk("Master core received a message: %d\n", message);

		message++;
	}

	printk("RPMsg Service demo ended.\n");
}

int main(void)
{
	printk("Starting application thread!\n");
	k_thread_create(&thread_data, thread_stack, CONFIG_MAIN_APP_TASK_STACK_SIZE, app_task,
			NULL, NULL, NULL, K_PRIO_COOP(7), 0, K_NO_WAIT);

#if defined(CONFIG_SOC_AN521) || defined(CONFIG_SOC_MUSCA_B1)
	wakeup_cpu1();
	k_msleep(500);
#endif /* #if defined(CONFIG_SOC_AN521) */
	return 0;
}

/* Make sure we register endpoint before RPMsg Service is initialized. */
int register_endpoint(void)
{
	int status;

	status = rpmsg_service_register_endpoint("demo", endpoint_cb);

	if (status < 0) {
		printk("rpmsg_create_ept failed %d\n", status);
		return status;
	}

	ep_id = status;

	return 0;
}

SYS_INIT(register_endpoint, POST_KERNEL, CONFIG_RPMSG_SERVICE_EP_REG_PRIORITY);
```
