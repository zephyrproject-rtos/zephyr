/*
 * Copyright (c) 2025 Espressif Systems (Shanghai) Co., Ltd.
 *
 * SPDX-License-Identifier: Apache-2.0
 */

/ {
	chosen {
		zephyr,ipc_shm = &shm0;
		zephyr,ipc = &ipm0;
	};
};

&ipm0 {
	status = "okay";
};
