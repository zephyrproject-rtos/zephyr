## samples/subsys/ipc/rpmsg_service/sample.yaml
```yaml
sample:
  description: This app provides an example of how to integrate RPMsg Service with
    Zephyr.
  name: RPMsg Service example integration
tests:
  sample.ipc.rpmsg_service:
    platform_allow:
      - mps2_an521
      - v2m_musca_b1
    integration_platforms:
      - mps2_an521
    tags: ipm
    harness: console
    harness_config:
      type: multi_line
      regex:
        - "Master core received a message: 1"
        - "Master core received a message: 99"
        - "RPMsg Service demo ended."
```

## samples/subsys/kvss/nvs/Kconfig
```kconfig
# Copyright 2025 NXP
# SPDX-License-Identifier: Apache-2.0

mainmenu "NVS Sample Configuration"

config NVS_SAMPLE_MAX_REBOOT
	int "Maximum reboot counter value"
	default 5
	range 1 1000
	help
	  Maximum number of reboots to perform before resetting the counter.

config NVS_SAMPLE_REBOOT_COUNTDOWN
	int "Reboot countdown value (in iterations)"
	default 5
	range 1 60
	help
	  Number of countdown iterations to wait before rebooting the device.
	  Each iteration takes NVS_SAMPLE_SLEEP_TIME milliseconds.

config NVS_SAMPLE_SLEEP_TIME
	int "Sleep time between reboot countdown iterations (in milliseconds)"
	default 100
	range 10 10000
	help
	  Duration in milliseconds to sleep between reboot countdown iterations.

source "Kconfig.zephyr"
```

## samples/subsys/kvss/nvs/boards/siwx917_rb4338a.conf
```kconfig
CONFIG_SYSTEM_WORKQUEUE_STACK_SIZE=4096
CONFIG_MAIN_STACK_SIZE=4096
CONFIG_NVS_INIT_BAD_MEMORY_REGION=y
```

## samples/subsys/kvss/zms/Kconfig
```kconfig
# Copyright 2025 NXP
# SPDX-License-Identifier: Apache-2.0

mainmenu "ZMS sample configuration"

config MAX_ITERATIONS
	int "The number of iterations that the sample writes the all set of data."
	default 300
	range 1 300

config DELETE_ITERATION
	int "The number of iterations after the sample delete all set of data and verify that it has been deleted."
	default 10
	range 1 MAX_ITERATIONS

source "Kconfig.zephyr"
```

## samples/subsys/kvss/zms/boards/frdm_mcxn236.conf
```kconfig
# Copyright 2025 NXP
# SPDX-License-Identifier: Apache-2.0

CONFIG_ZMS_CUSTOMIZE_BLOCK_SIZE=y
CONFIG_ZMS_CUSTOM_BLOCK_SIZE=128
CONFIG_MAIN_STACK_SIZE=2048
```

## samples/subsys/kvss/zms/zms_provisioning/Kconfig
```kconfig
#
# Copyright (c) 2026 Nordic Semiconductor ASA
#
# SPDX-License-Identifier: Apache-2.0
#
menu "ZMS Provisioning Sample Options"

config SAMPLE_ZMS_PROVISIONING_MERGE_WITH_APP_HEX
	bool "Merge application hex with provisioning data"
	default n
	help
	  When enabled, the provisioning script merges the generated provisioning
	  data into the application hex file and emits a single merged hex output.

	  When disabled, the build generates only the provisioning data hex file in
	  addition to the normal application zephyr.hex output.

endmenu

source "Kconfig.zephyr"
```

## samples/subsys/kvss/zms/zms_provisioning/sample.yaml
```yaml
# Copyright (c) 2026 Nordic Semiconductor ASA
# SPDX-License-Identifier: Apache-2.0

sample:
  name: ZMS Provisioning Sample

common:
  tags:
    - zms
    - kvss
  platform_allow:
    - nrf54h20dk/nrf54h20/cpuapp
  integration_platforms:
    - nrf54h20dk/nrf54h20/cpuapp

tests:
  sample.zms.provisioning:
    build_only: true

  sample.zms.provisioning.merge:
    build_only: true
    extra_configs:
      - CONFIG_SAMPLE_ZMS_PROVISIONING_MERGE_WITH_APP_HEX=y
```

## samples/subsys/libmp/audio_example/Kconfig
```kconfig
# Copyright 2024-2025 NXP
# SPDX-License-Identifier: Apache-2.0

source "Kconfig.zephyr"

config CODEC_MASTER
	bool "Configure the selected codec device as a master device."
	default true

config I2S_MASTER
	bool "Configure the selected I2S peripheral as a master device."
	default false
```

## samples/subsys/libmp/audio_example/boards/mimxrt685_evk_mimxrt685s_cm33.conf
```kconfig
#
# Copyright 2025 NXP
#
# SPDX-License-Identifier: Apache-2.0
#

CONFIG_I3C=y
CONFIG_AUDIO=y
CONFIG_AUDIO_CODEC=y
CONFIG_CODEC_MASTER=y
CONFIG_I2S_MASTER=n
```

## samples/subsys/llext/edk/app/sample.yaml
```yaml
common:
  tags: llext edk
  arch_allow:
    - arm
  filter: CONFIG_ARCH_HAS_USERSPACE
sample:
  description: EDK sample application
  name: EDK sample application
tests:
  sample.edk.app:
    build_only: true
    tags: edk llext
```

## samples/subsys/llext/fs_loader/Kconfig
```kconfig
#
# Copyright (c) 2024 Schneider Electric
#
# SPDX-License-Identifier: Apache-2.0
#

config APP_WIPE_STORAGE
	bool "Option to clear the flash area before mounting"
	help
	  Use this to force an existing file system to be created.

config CONFIG_LLEXT_PIC
	bool "Build LL extension with PIC enabled"
	help
	  Use this to force building LL extension in Position Independant Code.

source "Kconfig.zephyr"
```

## samples/subsys/llext/fs_loader/sample.yaml
```yaml
sample:
  description: Loadable extensions with filesystem sample
  name: Extension loader filesystem
tests:
  sample.llext.filesystem:
    tags: llext
    harness: keyboard
    arch_allow: arm
    depends_on:
      - usb_device
      - filesystem
```

## samples/subsys/llext/modules/Kconfig
```kconfig
# SPDX-License-Identifier: Apache-2.0
# Copyright (c) 2024 Intel Corporation.

mainmenu "LLEXT functionality test"

source "Kconfig.zephyr"

config HELLO_WORLD_MODE
	tristate "Include the hello_world function"
	default y
	help
	  This enables building the hello_world function, implemented in
	  hello_world_ext.c, either as an llext module or as a built-in part of
	  Zephyr.

	  If you select 'm', the hello_world function will be built as an llext
	  "module". If you select 'y', the hello_world function will be directly
	  linked in the Zephyr image.

	  Note that additional architecture-specific configuration may be
	  required if you select 'm'. Please review this sample's documentation
	  and sample.yaml for more information.
```

## samples/subsys/llext/modules/sample.yaml
```yaml
common:
  tags: llext
  platform_allow:
    - qemu_cortex_a9          # ARM Cortex-A9 (ARMv7-A ISA)
    - qemu_cortex_r5          # ARM Cortex-R5 (ARMv7-R ISA)
    - qemu_cortex_a53         # ARM Cortex-A53 (ARMv8-A ISA)
    - mps2/an385              # ARM Cortex-M3 (ARMv7-M ISA)
    - mps2/an521/cpu0         # ARM Cortex-M33 (ARMv8-M ISA)
    - qemu_xtensa/dc233c
  integration_platforms:
    - qemu_xtensa/dc233c
    - mps2/an385
    - qemu_cortex_a53
  harness: console

sample:
  name: CONFIG_MODULES test
  description: Call code directly and from extensions

tests:
  sample.llext.modules.module_build:
    extra_configs:
      - CONFIG_HELLO_WORLD_MODE=m
      # Disabling MPU is the most compatible option. If the target supports
      # CONFIG_USERSPACE, that should be preferred as it has many additional
      # security benefits.
      - arch:arm:CONFIG_ARM_MPU=n
      - arch:arm:CONFIG_ARM_AARCH32_MMU=n
    harness_config:
      type: one_line
      regex:
        - "Hello, world, from an llext!"
  sample.llext.modules.builtin_build:
    harness_config:
      type: one_line
      regex:
        - "Hello, world, from the main binary!"
```

## samples/subsys/llext/shell_loader/sample.yaml
```yaml
common:
  tags:
    - shell
    - llext
  arch_allow:
    - arm
    - xtensa
  filter: not CONFIG_MPU and not CONFIG_MMU and not CONFIG_SOC_SERIES_S32ZE
    and not CONFIG_SOC_SERIES_RZA2M
  platform_exclude:
    # platforms with active issues
    - apollo4p_evb            # See #73443
    - apollo4p_blue_kxr_evb   # See #73443
    - numaker_pfm_m487        # See #63167
    - s32z2xxdc2/s32z270/rtu0 # See commit 18a0660
    - s32z2xxdc2/s32z270/rtu1 # See commit 18a0660
    # platforms that are always skipped by the runtime filter
    - qemu_arc/qemu_arc_em
    - qemu_arc/qemu_arc_hs
    - qemu_arc/qemu_arc_hs/xip
    - qemu_arc/qemu_arc_hs5x
    - qemu_arc/qemu_arc_hs6x
    - qemu_cortex_m0
    - qemu_xtensa/dc233c/mmu
    - rza2m_evk

sample:
  description: Loadable extensions with shell sample
  name: Extension loader shell

tests:
  sample.llext.shell:
    harness: keyboard
    extra_configs:
      - arch:arm:CONFIG_ARM_MPU=n
      - arch:arm:CONFIG_ARM_AARCH32_MMU=n
```

## samples/subsys/logging/ble_backend/sample.yaml
```yaml
sample:
  description: A simple application that demonstrates the use of the logging ble backend.
  name: logger backend ble
tests:
  sample.logging.ble_backend.nrf52833:
    harness: bluetooth
    platform_allow:
      - qemu_cortex_m3/ti_lm3s6965
      - qemu_x86/atom
    integration_platforms:
      - qemu_cortex_m3/ti_lm3s6965
    tags: bluetooth
```

## samples/subsys/logging/can/boards/native_sim.conf
```kconfig
# Copyright (c) 2025 Paul Wedeck <paulwedeck@gmail.com>
# SPDX-License-Identifier: Apache-2.0

# For POSIX, the default is immediate mode but this leads
# to one CAN frame per character. While this is not wrong,
# deferred mode better showcases this feature.
CONFIG_LOG_MODE_DEFERRED=y
```

## samples/subsys/logging/can/sample.yaml
```yaml
sample:
  description: This application showcases various features of the CAN logging backend.
  name: logger can sample
tests:
  sample.logger.can:
    tags: logging can
    depends_on: can
    filter: dt_chosen_enabled("zephyr,canbus")
    integration_platforms:
      - native_sim
    harness: console
    harness_config:
      type: one_line
      regex:
        - "<inf> sample_main: example message 9"
```

## samples/subsys/logging/dictionary/sample.yaml
```yaml
sample:
  description: Dictionary-based Logging Sample Application
  name: logging_dictionary
tests:
  sample.logger.basic.dictionary:
    build_only: true
    tags: logging
    integration_platforms:
      - qemu_x86
      - qemu_x86_64
      - qemu_cortex_a53
      - qemu_cortex_a53_smp
  sample.logger.basic.dictionary.fpu:
    build_only: true
    tags: logging
    filter: CONFIG_CPU_HAS_FPU
    extra_configs:
      - CONFIG_FPU=y
    integration_platforms:
      - qemu_x86
      - qemu_x86_64
      - qemu_cortex_a53
      - qemu_cortex_a53_smp
  sample.logger.basic.dictionary.fpu.long_double:
    build_only: true
    tags: logging
    filter: CONFIG_CPU_HAS_FPU
    extra_configs:
      - CONFIG_FPU=y
      - CONFIG_CBPRINTF_PACKAGE_LONGDOUBLE=y
    integration_platforms:
      - qemu_x86
      - qemu_x86_64
      - qemu_cortex_a53
      - qemu_cortex_a53_smp
  sample.logger.basic.dictionary.uart_async_frontend:
    build_only: true
    tags: logging
    platform_allow: nrf52840dk_nrf52840
    integration_platforms:
      - nrf52840dk_nrf52840
    extra_configs:
      - CONFIG_LOG_BACKEND_UART=n
      - CONFIG_LOG_BACKEND_RTT=n
      - CONFIG_UART_ASYNC_API=y
      - CONFIG_UART_INTERRUPT_DRIVEN=n
      - CONFIG_LOG_FRONTEND=y
      - CONFIG_LOG_FRONTEND_ONLY=y
      - CONFIG_LOG_FRONTEND_DICT_UART=y
  sample.logger.basic.dictionary.uart_int_frontend:
    build_only: true
    tags: logging
    filter: CONFIG_SERIAL_SUPPORT_INTERRUPT and CONFIG_UART_CONSOLE
    integration_platforms:
      - qemu_x86
      - qemu_x86_64
      - qemu_cortex_a53
      - qemu_cortex_a53_smp
    extra_configs:
      - CONFIG_LOG_BACKEND_UART=n
      - CONFIG_LOG_BACKEND_RTT=n
      - CONFIG_UART_INTERRUPT_DRIVEN=y
      - CONFIG_UART_ASYNC_API=n
      - CONFIG_LOG_FRONTEND=y
      - CONFIG_LOG_FRONTEND_ONLY=y
      - CONFIG_LOG_FRONTEND_DICT_UART=y
```

## samples/subsys/logging/kernel_event_logger/sample.yaml
```yaml
sample:
  description: A simple application that demonstrate
    use of kernel event logging feature.
  name: Kernel event logger Sample
tests:
  test:
    tags: apps logging events
    harness: console
    harness_config:
      type: multi_line
      ordered: false
      regex:
        - "thread = (.*), is moved to = REDAY_Q ,at time = (\\d+)"
        - "tid of context switched thread = (.*) at time = (\\d+)"
        - "thread = (.*), is moved to = EXIT_STATE ,at time = (\\d+)"
        - "thread = (.*), is moved to = PEND_STATE ,at time = (\\d+)"
```

## samples/subsys/logging/logger/Kconfig
```kconfig
# Kconfig - Config options for logger sample app
#
# Copyright (c) 2018 Nordic Semiconductor ASA
#
# SPDX-License-Identifier: Apache-2.0
#

mainmenu "Logger sample application"

menu "Application configuration"

module = SAMPLE_MODULE
module-str = Sample module
source "subsys/logging/Kconfig.template.log_config"

endmenu

source "$(ZEPHYR_BASE)/Kconfig.zephyr"
```
