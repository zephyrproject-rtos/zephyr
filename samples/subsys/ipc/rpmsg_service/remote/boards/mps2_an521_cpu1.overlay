/*
 * Copyright (c) 2022 Nordic Semiconductor ASA
 *
 * SPDX-License-Identifier: Apache-2.0
 */

/ {
	chosen {
		/*
		 * shared memory reserved for the inter-processor communication
		 */
		zephyr,ipc_shm = &sramx;
		zephyr,ipc = &mhu0;
	};

	sramx: memory@281F8000 {
		compatible = "mmio-sram";
		reg = <0x281F8000 0x8000>;
	};
};
