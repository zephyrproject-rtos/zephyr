/*
 * Copyright (c) 2023 Felipe Neves <ryukokki.felipe@gmail.com>
 *
 * SPDX-License-Identifier: Apache-2.0
 */

 / {
	chosen {
		/*
		 * shared memory reserved for the inter-processor communication
		 */
		zephyr,ipc_shm = &shm0;
		zephyr,ipc = &ipm0;
	};
};

&ipm0 {
	status = "okay";
};
