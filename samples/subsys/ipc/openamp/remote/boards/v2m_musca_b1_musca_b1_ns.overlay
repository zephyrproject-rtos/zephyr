/*
 * Copyright (c) 2019 Linaro Limited
 *
 * SPDX-License-Identifier: Apache-2.0
 */

/ {
	chosen {
		/*
		 * shared memory reserved for the inter-processor communication
		 */
		zephyr,ipc_shm = &sramx;
		zephyr,ipc = &mhu0;
	};

	sramx: memory@20060000 {
		compatible = "mmio-sram";
		reg = <0x20060000 0x8000>;
	};
};
