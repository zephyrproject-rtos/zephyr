/*
 * Copyright (c) 2021 BrainCo Inc.
 *
 * SPDX-License-Identifier: Apache-2.0
 */

/ {
	chosen {
		/* Shared memory reserved for the inter-processor communication */
		zephyr,ipc_shm = &sram4;
		zephyr,ipc = &mailbox;
	};
};

&mailbox {
    status = "okay";
};
