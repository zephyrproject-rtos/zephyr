/*
 * Copyright (c) 2022 NXP
 *
 * SPDX-License-Identifier: Apache-2.0
 */

/ {
	chosen {
		zephyr,ipc_shm = &ocram2_overlay;
	};

	/* OpenAMP fails with full 512K OCRAM2 memory region as shared memory.
	 * Define a subset of the OCRAM2 region for demo to use
	 * Note that shared memory must have specific MPU attributes set.
	 */
	ocram2_overlay: memory@202c0000{
		compatible = "zephyr,memory-region", "mmio-sram";
		reg = <0x202c0000 DT_SIZE_K(16)>;
		zephyr,memory-region="OCRAM2_OVERLAY";
		zephyr,memory-region-mpu = "IO";
	};
};
