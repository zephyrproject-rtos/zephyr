/*
 * Copyright 2025 NXP
 *
 * SPDX-License-Identifier: Apache-2.0
 */

#include <zephyr/dt-bindings/memory-attr/memory-attr-arm.h>

/ {
	chosen {
		zephyr,ipc_shm = &sram1;
		zephyr,ipc = &mailbox_a;
	};

	mailbox_a: ipm-mbox {
		compatible = "zephyr,mbox-ipm";
		mboxes = <&mbox1_a 1>, <&mbox1_a 0>;
		mbox-names = "tx", "rx";
	};
};
