## samples/subsys/ipc/openamp_performance/Kconfig
```kconfig
# Private config options for openamp sample app

# Copyright (c) 2021 Carlo Caione <ccaione@baylibre.com>
# SPDX-License-Identifier: Apache-2.0

# Workaround for not being able to have commas in macro arguments
DT_CHOSEN_Z_IPC_TX := zephyr,ipc_tx
DT_CHOSEN_Z_IPC_RX := zephyr,ipc_rx

config OPENAMP_IPC_DEV_TX_NAME
	string
	default "$(dt_chosen_label,$(DT_CHOSEN_Z_IPC_TX))" if !IPM_NRFX
	default "IPM_1" if (IPM_NRFX && OPENAMP_MASTER)
	default "IPM_0" if (IPM_NRFX && OPENAMP_SLAVE)
	help
	  This option specifies the device name for the IPC device to be used (TX)

config OPENAMP_IPC_DEV_RX_NAME
	string
	default "$(dt_chosen_label,$(DT_CHOSEN_Z_IPC_RX))" if !IPM_NRFX
	default "IPM_0" if (IPM_NRFX && OPENAMP_MASTER)
	default "IPM_1" if (IPM_NRFX && OPENAMP_SLAVE)
	help
	  This option specifies the device name for the IPC device to be used (RX)

source "Kconfig.zephyr"
```

## samples/subsys/ipc/openamp_performance/boards/nrf5340dk_nrf5340_cpuapp.conf
```kconfig
CONFIG_BOARD_ENABLE_CPUNET=y

CONFIG_IPM=y
CONFIG_IPM_NRFX=y

CONFIG_IPM_MSG_CH_0_ENABLE=y
CONFIG_IPM_MSG_CH_1_ENABLE=y

CONFIG_IPM_MSG_CH_0_RX=y
CONFIG_IPM_MSG_CH_1_TX=y
```

## samples/subsys/ipc/openamp_performance/remote/boards/nrf5340dk_nrf5340_cpunet.conf
```kconfig
CONFIG_IPM=y
CONFIG_IPM_NRFX=y

CONFIG_IPM_MSG_CH_0_ENABLE=y
CONFIG_IPM_MSG_CH_1_ENABLE=y

CONFIG_IPM_MSG_CH_0_TX=y
CONFIG_IPM_MSG_CH_1_RX=y
```

## samples/subsys/ipc/openamp_performance/remote/sample.yaml
```yaml
sample:
    description: This app provides an example of how to test OpenAMP
      performance with Zephyr.
    name: OpenAMP performance example integration (remote)
tests:
    sample.subsys.ipc.openamp_performance_remote:
        platform_allow: nrf5340dk_nrf5340_cpunet
        integration_platforms:
          - nrf5340dk_nrf5340_cpunet
        tags: ipm
        harness: remote
```

## samples/subsys/ipc/openamp_performance/sample.yaml
```yaml
sample:
    description: This app provides an example of how to test OpenAMP
      performance with Zephyr.
    name: OpenAMP performance example integration
tests:
    sample.subsys.ipc.openamp_performance:
        build_only: true
        platform_allow: nrf5340dk_nrf5340_cpuapp
        integration_platforms:
          - nrf5340dk_nrf5340_cpuapp
        tags: ipm
```

## samples/subsys/ipc/openamp_rsc_table/Kconfig
```kconfig
# Private config options for openamp sample app

# Copyright (c) 2020 STMicroelectronics
# SPDX-License-Identifier: Apache-2.0

# Workaround for not being able to have commas in macro arguments
DT_CHOSEN_Z_IPC := zephyr,ipc

config OPENAMP_IPC_DEV_NAME
	string
	default "$(dt_chosen_label,$(DT_CHOSEN_Z_IPC))"
	help
	  This option specifies the device name for the IPC device to be used

config OPENAMP_IPC_NOTIFY_CHAN
	int "Mailbox channel to use to notify the host"
	default 0

source "Kconfig.zephyr"
```

## samples/subsys/ipc/openamp_rsc_table/boards/colibri_imx7d_mcimx7d_m4.conf
```kconfig
CONFIG_IPM=y
CONFIG_IPM_IMX_MAX_DATA_SIZE_4=y
CONFIG_OPENAMP_WITH_DCACHE=y
CONFIG_SOC_RESET_HOOK=n
CONFIG_OPENAMP=y
CONFIG_OPENAMP_RSC_TABLE_NUM_RPMSG_BUFF=32
CONFIG_OPENAMP_RSC_TABLE=y
CONFIG_OPENAMP_MASTER=n


CONFIG_ROMSTART_RELOCATION_ROM=y
CONFIG_BUILD_OUTPUT_BIN=n
```

## samples/subsys/ipc/openamp_rsc_table/boards/imx8mp_evk_mimx8ml8_adsp.conf
```kconfig
CONFIG_LOG_PRINTK=n
CONFIG_IPM_IMX_MAX_DATA_SIZE_16=n
CONFIG_IPM_IMX_MAX_DATA_SIZE_4=y
CONFIG_OPENAMP_WITH_DCACHE=y
CONFIG_IPM_IMX_FW_READY_REPLY=y
```

## samples/subsys/ipc/openamp_rsc_table/boards/imx8mp_evk_mimx8ml8_m7.conf
```kconfig
CONFIG_LOG_PRINTK=n
CONFIG_IPM_IMX_MAX_DATA_SIZE_16=n
CONFIG_IPM_IMX_MAX_DATA_SIZE_4=y
CONFIG_OPENAMP_WITH_DCACHE=y
CONFIG_IPM_IMX_FW_READY_REPLY=y
CONFIG_LOG=y
CONFIG_LOG_BACKEND_UART=y
CONFIG_LOG_DEFAULT_LEVEL=0
CONFIG_LOG_MODE_MINIMAL=y
CONFIG_OPENAMP_RSC_TABLE_IPM_RX_ID=1
CONFIG_OPENAMP_RSC_TABLE_IPM_TX_ID=0
```

## samples/subsys/ipc/openamp_rsc_table/boards/imx8ulp_evk_mimx8ud7_adsp.conf
```kconfig
CONFIG_LOG_PRINTK=n
CONFIG_OPENAMP_WITH_DCACHE=y

CONFIG_MBOX=y
CONFIG_MBOX_INIT_PRIORITY=3

CONFIG_IPM_MBOX=y

#vendor-specific resource table
CONFIG_OPENAMP_VENDOR_RSC_TABLE=y
CONFIG_OPENAMP_VENDOR_RSC_TABLE_FILE="nxp_resource_table.c"

#address translation support
CONFIG_OPENAMP_VENDOR_ADDR_TRANSLATION=y
CONFIG_OPENAMP_VENDOR_ADDR_TRANSLATION_FILE="nxp_addr_translation.h"
```

## samples/subsys/ipc/openamp_rsc_table/boards/imx93_evk_mimx9352_m33.conf
```kconfig
CONFIG_CLOCK_CONTROL=y
CONFIG_CONSOLE=y
CONFIG_UART_CONSOLE=y
CONFIG_LOG=y
CONFIG_LOG_MODE_MINIMAL=y
CONFIG_IPM_MBOX=y
CONFIG_MBOX_INIT_PRIORITY=0
CONFIG_OPENAMP_COPY_RSC_TABLE=y
```

## samples/subsys/ipc/openamp_rsc_table/boards/imx95_evk_mimx9596_m7.conf
```kconfig
CONFIG_CLOCK_CONTROL=y
CONFIG_LOG=y
CONFIG_CONSOLE=y
CONFIG_OPENAMP_WITH_DCACHE=y
CONFIG_UART_CONSOLE=y
CONFIG_ARM_SCMI=y
CONFIG_IPM_MBOX=y
CONFIG_MBOX_NXP_IMX_MU=y
CONFIG_MBOX_INIT_PRIORITY=0
CONFIG_LOG_MODE_MINIMAL=y
CONFIG_LOG_DEFAULT_LEVEL=0
CONFIG_OPENAMP_COPY_RSC_TABLE=y
```

## samples/subsys/ipc/openamp_rsc_table/boards/stm32mp157c_dk2.conf
```kconfig
# SPDX-FileCopyrightText: Copyright The Zephyr Project Contributors
# SPDX-License-Identifier: Apache-2.0

CONFIG_SOC_RESET_HOOK=n
```

## samples/subsys/ipc/openamp_rsc_table/sample.yaml
```yaml
sample:
  description: This app provides an example of how to integrate OpenAMP
    with Zephyr including a resource table.
  name: OpenAMP with resource table example integration
tests:
  sample.subsys.ipc.openamp_rs_table:
    build_only: true
    platform_allow:
      - stm32mp157c_dk2
      - imx8mp_evk/mimx8ml8/adsp
    integration_platforms:
      - stm32mp157c_dk2
      - imx8mp_evk/mimx8ml8/adsp
    tags:
      - ipm
      - openamp
```

## samples/subsys/ipc/rpmsg_lite/remote/sample.yaml
```yaml
sample:
    description: TBD
    name: TBD
tests:
    test:
        build_only: true
        filter: CONFIG_SOC_MCUX
        tags: samples ipm
```

## samples/subsys/ipc/rpmsg_lite/sample.yaml
```yaml
sample:
    description: Sample app that sends messages between the two cores on
        the lpcxpresso54114 using the RPMsg-Lite library.
    name: RPMsg-Lite Sample
tests:
    test:
        build_only: true
        platform_whitelist: lpcxpresso54114_m4
        tags: samples ipm
```

## samples/subsys/ipc/rpmsg_multi_instance/sample.yaml
```yaml
sample:
    description: This app provides an example of how to integrate
        RPMsg Multiple Instance with Zephyr.
    name: RPMsg Multiple Instance example integration
tests:
    sample.ipc.rpmsg_multiple_instance.nrf:
        platform_allow: nrf5340dk_nrf5340_cpuapp
        integration_platforms:
          - nrf5340dk_nrf5340_cpuapp
        tags: ipm
        build_only: true
```

## samples/subsys/ipc/rpmsg_service/Kconfig
```kconfig
# Copyright (c) 2025 Espressif Systems (Shanghai) Co., Ltd.
# SPDX-License-Identifier: Apache-2.0

source "Kconfig.zephyr"

config RPMSG_SERVICE_DEMO_CYCLES
	int "Number of demo message cycles"
	default 1000
	range 10 10000

config MAIN_APP_TASK_STACK_SIZE
	int "Main application task size"
	default 1024
```

## samples/subsys/ipc/rpmsg_service/Kconfig.sysbuild
```kconfig
# Copyright (c) 2023 Arm Limited
#
# SPDX-License-Identifier: Apache-2.0

source "share/sysbuild/Kconfig"

config RPMSG_REMOTE_BOARD
	string
	default "mps2/an521/cpu1" if $(BOARD) = "mps2"
	default "v2m_musca_b1/musca_b1/ns" if $(BOARD) = "v2m_musca_b1"
	default "stm32h747i_disco/stm32h747xx/m4" if $(BOARD) = "stm32h747i_disco"
	default "esp32_devkitc/esp32/appcpu" if $(BOARD) = "esp32_devkitc"
	default "esp32s3_devkitc/esp32s3/appcpu" if $(BOARD) = "esp32s3_devkitc"
```

## samples/subsys/ipc/rpmsg_service/remote/Kconfig
```kconfig
# Copyright (c) 2025 Espressif Systems (Shanghai) Co., Ltd.
# SPDX-License-Identifier: Apache-2.0

source "samples/subsys/ipc/rpmsg_service/Kconfig"

config APP_REMOTE_TASK_STACK_SIZE
	int "Remote application task size"
	default 2048 if SOC_SERIES_ESP32
	default 1024
```

## samples/subsys/ipc/rpmsg_service/remote/sample.yaml
```yaml
sample:
  description: This app provides an example of how to integrate
    RPMsg Service with Zephyr.
  name: RPMsg Service example integration (remote)
common:
  harness: remote
tests:
  sample.ipc.rpmsg_service.remote:
    platform_allow: mps2_an521_remote v2m_musca_b1_ns
    integration_platforms:
      - v2m_musca_b1_ns
    tags: ipm
```
