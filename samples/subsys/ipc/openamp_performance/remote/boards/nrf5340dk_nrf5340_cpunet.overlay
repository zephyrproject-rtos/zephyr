/*
 * Copyright (c) 2022 Nordic Semiconductor ASA
 *
 * SPDX-License-Identifier: Apache-2.0
 */

/ {
	soc {
		/delete-node/ ipc@41012000;

		ipc: ipc@41012000 {
			compatible = "nordic,nrf-ipc";
			reg = <0x41012000 0x1000>;
			interrupts = <18 NRF_DEFAULT_IRQ_PRIORITY>;
			status = "okay";
			label = "IPC";
		};
	};
};
