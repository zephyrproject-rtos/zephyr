## CMakeLists.txt
```
# Copyright (c) 2017, NXP
#
# SPDX-License-Identifier: Apache-2.0
#

cmake_minimum_required(VERSION 3.20.0)

set(REMOTE_ZEPHYR_DIR ${CMAKE_CURRENT_BINARY_DIR}/ipm_mcux_remote-prefix/src/ipm_mcux_remote-build/zephyr)

find_package(Zephyr REQUIRED HINTS $ENV{ZEPHYR_BASE})
project(ipm_mcux)

enable_language(C ASM)

target_sources(app PRIVATE src/main_master.c)

if(CONFIG_BOARD_SUPPORT_REMOTE_ENDPOINT)

  include(ExternalProject)

  ExternalProject_Add(
    ipm_mcux_remote
    SOURCE_DIR ${APPLICATION_SOURCE_DIR}/remote
    INSTALL_COMMAND ""      # This particular build system has no install command
    CMAKE_CACHE_ARGS -DBOARD:STRING=${BOARD_REMOTE}
    CMAKE_CACHE_ARGS -DDTC_OVERLAY_FILE:STRING=${DTC_OVERLAY_FILE}
    BUILD_BYPRODUCTS "${REMOTE_ZEPHYR_DIR}/${KERNEL_BIN_NAME}"
    BUILD_ALWAYS True
  )

  add_dependencies(second_core_inc_target ipm_mcux_remote)

  target_include_directories(app PRIVATE ${CMAKE_CURRENT_SOURCE_DIR})

endif()
```

## sample.yaml
```
sample:
    description: Sample app that sends messages between the two cores on
        the lpcxpresso54114 using a mailbox.
    name: IPM MCUX Mailbox Sample
tests:
    sample.ipc.ipm.ipm_mcux:
        platform_allow: lpcxpresso54114_m4 lpcxpresso55s69_cpu0
        tags: ipm
        harness: console
        harness_config:
          type: multi_line
          regex:
            - "Hello World from MASTER! (.*)"
            - "Received: 1"
            - "Received: 20"
```

## prj.conf
```kconfig
CONFIG_PRINTK=y
CONFIG_IPM=y
CONFIG_IPM_MCUX=y
CONFIG_SECOND_CORE_MCUX=y
CONFIG_SECOND_IMAGE_MCUX="${ZEPHYR_BINARY_DIR}/../ipm_mcux_remote-prefix/src/ipm_mcux_remote-build/zephyr/${KERNEL_BIN_NAME}"
CONFIG_TIMESLICE_SIZE=1
CONFIG_MAIN_STACK_SIZE=2048
CONFIG_BOARD_SUPPORT_REMOTE_ENDPOINT=y
```

## src/main_master.c
```c
/*
 * Copyright (c) 2018, NXP
 *
 * SPDX-License-Identifier: Apache-2.0
 */

#include <zephyr.h>
#include <sys/printk.h>
#include <device.h>
#include <drivers/ipm.h>

int gcounter;

void ping_ipm_callback(const struct device *dev, void *context,
		       uint32_t id, volatile void *data)
{
	struct ipm_msg msg;

	gcounter = *(int *)data;
	/* Show current ping-pong counter value */
	printk("Received: %d\n", gcounter);
	/* Increment on our side */
	gcounter++;
	if (gcounter < 100) {
		msg.data = &gcounter;
		msg.size = 4;
		msg.id = 0;

		/* Send back to the other core */
		ipm_send(dev, 1, 0, &msg);
	}
}

void main(void)
{
	int first_message = 1; /* do not start from 0,
				* zero value can't be sent via mailbox register
				*/
	const struct device *ipm;
	struct ipm_msg msg;

	printk("Hello World from MASTER! %s\n", CONFIG_ARCH);

	/* Get IPM device handle */
	ipm = DEVICE_DT_GET_ANY(nxp_lpc_mailbox);
	if (!(ipm && device_is_ready(ipm))) {
		printk("Could not get IPM device handle!\n");
		while (1) {
		}
	}

	/* Register application callback with no context */
	ipm_register_callback(ipm, ping_ipm_callback, 0, NULL);
	/* Enable the IPM device */
	ipm_set_enabled(ipm, 1);

	msg.data = &first_message;
	msg.size = 4;
	msg.id = 0;

	/* Send initial message with 4 bytes length*/
	ipm_send(ipm, 1, 0, &msg);
	while (1) {
	}
}
```
