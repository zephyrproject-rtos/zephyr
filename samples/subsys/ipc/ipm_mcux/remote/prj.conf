## CMakeLists.txt
```
# Copyright (c) 2017, NXP
#
# SPDX-License-Identifier: Apache-2.0
#

cmake_minimum_required(VERSION 3.20.0)

find_package(Zephyr REQUIRED HINTS $ENV{ZEPHYR_BASE})
project(ipm_mcux_remote)

target_sources(app PRIVATE src/main_remote.c)
target_include_directories(app PRIVATE ${CMAKE_CURRENT_SOURCE_DIR}/..)
```

## prj.conf
```kconfig
CONFIG_KERNEL_BIN_NAME="core1_image"
CONFIG_STDOUT_CONSOLE=n
CONFIG_PRINTK=n
CONFIG_IPM=y
CONFIG_IPM_MCUX=y
CONFIG_PLATFORM_SPECIFIC_INIT=n
```

## src/main_remote.c
```c
/*
 * Copyright (c) 2018, NXP
 *
 * SPDX-License-Identifier: Apache-2.0
 */

#include <zephyr.h>
#include <sys/printk.h>
#include <device.h>
#include <drivers/ipm.h>

void ping_ipm_callback(const struct device *dev, void *context,
		       uint32_t id, volatile void *data)
{
	struct ipm_msg msg;

	msg.data = data;
	msg.size = 4;
	msg.id = 0;

	ipm_send(dev, 1, 0, &msg);
}



void main(void)
{
	const struct device *ipm;

	ipm = DEVICE_DT_GET_ANY(nxp_lpc_mailbox);
	if (!(ipm && device_is_ready(ipm))) {
		while (1) {
		}
	}
	ipm_register_callback(ipm, ping_ipm_callback, 0, NULL);
	ipm_set_enabled(ipm, 1);
	while (1) {
	}
}
```
