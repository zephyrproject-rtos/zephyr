## samples/subsys/ipc/ipc_service/static_vrings/sample.yaml
```yaml
sample:
  name: IPC Service example integration (OpenAMP static_vrings backend)
tests:
  sample.ipc.static_vrings:
    filter: dt_compat_enabled("zephyr,ipc-openamp-static-vrings")
    integration_platforms:
      - nrf5340dk/nrf5340/cpuapp
      - nrf5340bsim/nrf5340/cpuapp
    tags: ipc
    sysbuild: true
    harness: console
    harness_config:
      type: multi_line
      ordered: false
      regex:
        - "IPC-service HOST \\[INST 0 - ENDP A\\] demo started"
        - "IPC-service HOST \\[INST 0 - ENDP B\\] demo started"
        - "IPC-service HOST \\[INST 1\\] demo started"
        - "IPC-service HOST \\[INST 0 - ENDP A\\] demo ended\\."
        - "IPC-service HOST \\[INST 0 - ENDP B\\] demo ended\\."
        - "IPC-service HOST \\[INST 1\\] demo ended\\."
```

## samples/subsys/ipc/ipc_service/static_vrings_mi/sample.yaml
```yaml
sample:
    description: This app provides an example of how to integrate
        IPC Service with Zephyr (static_vrings_mi backend)
    name: IPC Service example integration (static_vrings_mi backend)
tests:
    sample.ipc.static_vrings_mi.nrf:
        platform_allow: nrf5340dk_nrf5340_cpuapp bl5340_dvk_cpuapp
        integration_platforms:
          - nrf5340dk_nrf5340_cpuapp bl5340_dvk_cpuapp
        tags: ipc
        build_only: true
```

## samples/subsys/ipc/ipm_echo/sample.yaml
```yaml
sample:
    description: the sample echoes data over IPM
    name: echo IPM sample
tests:
    sample.subsys.ipc.ipm_echo:
        build_only: true
        platform_whitelist: up_squared_adsp
        tags: samples ipm
```

## samples/subsys/ipc/ipm_imx/sample.yaml
```yaml
sample:
    description: the sample reads the received data from the Messaging Unit
        using the IPM and transmits it back unchanged
    name: i.MX IPM sample
tests:
    sample.subsys.ipc.ipm_imx:
        build_only: true
        filter: CONFIG_SOC_FAMILY_IMX
        platform_whitelist: udoo_neo_full_m4 colibri_imx7d_m4 warp7_m4
        tags: samples ipm
```

## samples/subsys/ipc/ipm_mailbox/ap/sample.yaml
```yaml
sample:
  description: IPM Mailbox
  name: IPM Mailbox
tests:
  sample.subsys.ipc.ipm_mailbox.ap:
    tags: ipm
    platform_whitelist: quark_se_c1000_devboard
```

## samples/subsys/ipc/ipm_mailbox/sensor/sample.yaml
```yaml
sample:
  description: IPM Mailbox
  name: IPM Mailbox
tests:
  sample.subsys.ipc.ipm_mailbox.sensor:
    tags: ipm
    platform_whitelist: quark_se_c1000_ss_devboard
```

## samples/subsys/ipc/ipm_mcux/sample.yaml
```yaml
sample:
    description: Sample app that sends messages between the two cores on
        the lpcxpresso54114 using a mailbox.
    name: IPM MCUX Mailbox Sample
tests:
    sample.ipc.ipm.ipm_mcux:
        platform_allow: lpcxpresso54114_m4
        tags: ipm
        harness: console
        harness_config:
          type: multi_line
          regex:
            - "Hello World from MASTER! (.*)"
            - "Received: 1"
            - "Received: 20"
```

## samples/subsys/ipc/ipm_mhu_dual_core/sample.yaml
```yaml
sample:
  description: MHU dual core sample
    application
  name: ipm_mhu_dual_core
tests:
  sample.ipc.ipm.ipm_mhu_dual_core:
    tags: ipm
    platform_allow: v2m_musca v2m_musca_nonsecure v2m_musca_b1 v2m_musca_b1_nonsecure
```

## samples/subsys/ipc/ipm_psoc6/sample.yaml
```yaml
sample:
    description: Sample app that sends messages between the two cores on
        the cy8ckit_062_wifi_bt using a mailbox. Server part running on
        the cy8ckit_062_wifi_bt_m0.
    name: IPM PSoC6 Mailbox Sample
tests:
    test:
        platform_whitelist: cy8ckit_062_wifi_bt_m0
        tags: ipm
```

## samples/subsys/ipc/openamp/Kconfig
```kconfig
# Private config options for openamp sample app

# Copyright (c) 2020 Linaro Limited
# SPDX-License-Identifier: Apache-2.0

# Workaround for not being able to have commas in macro arguments
DT_CHOSEN_Z_IPC_SHM := zephyr,ipc_shm
DT_CHOSEN_Z_IPC := zephyr,ipc

config OPENAMP_IPC_SHM_BASE_ADDRESS
	hex
	default "$(dt_chosen_reg_addr_hex,$(DT_CHOSEN_Z_IPC_SHM))"
	help
	  This option specifies base address of the memory region to
	  be used for the OpenAMP IPC shared memory

config OPENAMP_IPC_SHM_SIZE
	hex
	default "$(dt_chosen_reg_size_hex,$(DT_CHOSEN_Z_IPC_SHM))"
	help
	  This option specifies size of the memory region to be used
	  for the OpenAMP IPC shared memory

config OPENAMP_IPC_DEV_NAME
	string
	default "$(dt_chosen_label,$(DT_CHOSEN_Z_IPC))"
	help
	  This option specifies the device name for the IPC device to be used

source "Kconfig.zephyr"
```

## samples/subsys/ipc/openamp/Kconfig.sysbuild
```kconfig
# Copyright 2022-2025 NXP
#
# SPDX-License-Identifier: Apache-2.0

source "share/sysbuild/Kconfig"

config OPENAMP_REMOTE_BOARD
string
	default "lpcxpresso54114/lpc54114/m0" if $(BOARD) = "lpcxpresso54114"
	default "lpcxpresso55s69/lpc55s69/cpu1" if $(BOARD) = "lpcxpresso55s69"
	default "mps2/an521/cpu1" if $(BOARD) = "mps2"
	default "v2m_musca_b1/musca_b1/ns" if $(BOARD) = "v2m_musca_b1"
	default "mimxrt1170_evk/mimxrt1176/cm4" if $(BOARD) = "mimxrt1170_evk"
	default "mimxrt1160_evk/mimxrt1166/cm4" if $(BOARD) = "mimxrt1160_evk"
	default "mimxrt1170_evkb/mimxrt1176/cm4" if $(BOARD) = "mimxrt1170_evkb"
	default "frdm_mcxn947/mcxn947/cpu1" if $(BOARD) = "frdm_mcxn947"
	default "mcx_n9xx_evk/mcxn947/cpu1" if $(BOARD) = "mcx_n9xx_evk"
	default "mimxrt1180_evk/mimxrt1189/cm7" if $(BOARD) = "mimxrt1180_evk"
	default "esp32s3_devkitc/esp32s3/appcpu" if $(BOARD) = "esp32s3_devkitc"
	default "esp32_devkitc/esp32/appcpu" if $(BOARD) = "esp32_devkitc"
```

## samples/subsys/ipc/openamp/boards/lpcxpresso54114_m4.conf
```kconfig
CONFIG_IPM_MCUX=y
CONFIG_SECOND_CORE_MCUX=y
CONFIG_SECOND_IMAGE_MCUX="${ZEPHYR_BINARY_DIR}/../openamp_remote-prefix/src/openamp_remote-build/zephyr/${KERNEL_BIN_NAME}"
```

## samples/subsys/ipc/openamp/boards/mimxrt1180_evk_mimxrt1189_cm33.conf
```kconfig
CONFIG_SECOND_CORE_MCUX=y
CONFIG_INCLUDE_REMOTE_DIR=y
CONFIG_IPM=y
CONFIG_IPM_MBOX=y
CONFIG_MBOX=y
```

## samples/subsys/ipc/openamp/boards/mimxrt700_evk_mimxrt798s_cm33_cpu0.conf
```kconfig
#
# Copyright 2025 NXP
#
# SPDX-License-Identifier: Apache-2.0
#

CONFIG_INCLUDE_REMOTE_DIR=y
CONFIG_SECOND_CORE_MCUX=y
```

## samples/subsys/ipc/openamp/boards/stm32h747i_disco_m7.conf
```kconfig
CONFIG_IPM_STM32_HSEM=y
# Disable the memory cache, write to memory directly.
CONFIG_NOCACHE_MEMORY=y
```

## samples/subsys/ipc/openamp/remote/boards/mimxrt1170_evk_mimxrt1176_cm4_B.conf
```kconfig
#
# Copyright 2023, NXP
#
# SPDX-License-Identifier: Apache-2.0
#
CONFIG_BUILD_OUTPUT_INFO_HEADER=y
CONFIG_BUILD_OUTPUT_HEX=y
CONFIG_SECOND_CORE_MCUX=y
```

## samples/subsys/ipc/openamp/remote/boards/mimxrt1180_evk_mimxrt1189_cm7.conf
```kconfig
CONFIG_BUILD_OUTPUT_HEX=y
CONFIG_SECOND_CORE_MCUX=y
CONFIG_IPM=y
CONFIG_IPM_MBOX=y
CONFIG_MBOX=y
```

## samples/subsys/ipc/openamp/remote/sample.yaml
```yaml
sample:
  description: This app provides an example of how to integrate OpenAMP with Zephyr.
  name: OpenAMP example integration (remote)
tests:
  sample.ipc.openamp.remote:
    platform_allow:
      - lpcxpresso54114/lpc54114/m0
      - lpcxpresso55s69/lpc55s69/cpu1
    integration_platforms:
      - lpcxpresso54114/lpc54114/m0
    tags: ipm
    harness: remote
```

## samples/subsys/ipc/openamp/remote_echo/boards/udoo_neo_full_m4.conf
```kconfig
CONFIG_HEAP_MEM_POOL_SIZE=16384
CONFIG_IPM_IMX=y
CONFIG_IPM_IMX_MAX_DATA_SIZE_4=y
```

## samples/subsys/ipc/openamp/remote_echo/sample.yaml
```yaml
sample:
    description: This app provides an example of how to integrate OpenAMP
        with Zephyr.
    name: OpenAMP remote echo example
tests:
    test:
        build_only: true
        filter: CONFIG_SOC_FAMILY_IMX
        platform_whitelist: colibri_imx7d_m4 warp7_m4 udoo_neo_full_m4
        tags: samples ipm
```

## samples/subsys/ipc/openamp/sample.yaml
```yaml
sample:
  description: This app provides an example of how to integrate OpenAMP with Zephyr.
  name: OpenAMP example integration
tests:
  sample.ipc.openamp:
    filter: dt_chosen_enabled("zephyr,ipc") and dt_chosen_enabled("zephyr,ipc_shm")
      and not (CONFIG_SOC_ESP32_APPCPU or CONFIG_SOC_ESP32S3_APPCPU)
    integration_platforms:
      - mps2/an521/cpu0
    tags:
      - ipm
      - openamp
    harness: console
    sysbuild: true
    harness_config:
      type: multi_line
      regex:
        - "Master core received a message: 1"
        - "Master core received a message: 99"
        - "OpenAMP demo ended."
```
