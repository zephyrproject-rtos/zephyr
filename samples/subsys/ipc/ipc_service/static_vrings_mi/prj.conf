## CMakeLists.txt
```
# Copyright (c) 2021 Nordic Semiconductor ASA
#
# SPDX-License-Identifier: Apache-2.0
#

cmake_minimum_required(VERSION 3.20.0)

set(REMOTE_ZEPHYR_DIR ${CMAKE_CURRENT_BINARY_DIR}/ipc_service_remote-prefix/src/ipc_service_remote-build/zephyr)

if("${BOARD}" STREQUAL "nrf5340dk_nrf5340_cpuapp")
  set(BOARD_REMOTE "nrf5340dk_nrf5340_cpunet")
elseif("${BOARD}" STREQUAL "bl5340_dvk_cpuapp")
  set(BOARD_REMOTE "bl5340_dvk_cpunet")
else()
  message(FATAL_ERROR "${BOARD} is not supported for this sample")
endif()

message(STATUS "${BOARD} compile as Master in this sample")

find_package(Zephyr REQUIRED HINTS $ENV{ZEPHYR_BASE})
project(ipc_service)

enable_language(C ASM)

target_sources(app PRIVATE src/main.c)

include(ExternalProject)

ExternalProject_Add(
  ipc_service_remote
  SOURCE_DIR ${APPLICATION_SOURCE_DIR}/remote
  INSTALL_COMMAND ""      # This particular build system has no install command
  CMAKE_CACHE_ARGS -DBOARD:STRING=${BOARD_REMOTE}
  CMAKE_CACHE_ARGS -DDTC_OVERLAY_FILE:STRING=${DTC_OVERLAY_FILE}
  BUILD_BYPRODUCTS "${REMOTE_ZEPHYR_DIR}/${KERNEL_BIN_NAME}"
  # NB: Do we need to pass on more CMake variables?
  BUILD_ALWAYS True
)
```

## sample.yaml
```
sample:
    description: This app provides an example of how to integrate
        IPC Service with Zephyr (static_vrings_mi backend)
    name: IPC Service example integration (static_vrings_mi backend)
tests:
    sample.ipc.static_vrings_mi.nrf:
        platform_allow: nrf5340dk_nrf5340_cpuapp bl5340_dvk_cpuapp
        integration_platforms:
          - nrf5340dk_nrf5340_cpuapp
          - bl5340_dvk_cpuapp
        tags: ipc
        build_only: true
```

## prj.conf
```kconfig
CONFIG_PRINTK=y
CONFIG_IPM=y
CONFIG_TIMESLICE_SIZE=1
CONFIG_MAIN_STACK_SIZE=2048
CONFIG_HEAP_MEM_POOL_SIZE=4096

# Configuration IPC Service
CONFIG_IPC_SERVICE=y
CONFIG_IPC_SERVICE_BACKEND_RPMSG_MI_MASTER=y
CONFIG_IPC_SERVICE_BACKEND_RPMSG_MI=y

# Configuration backend for IPC Service
CONFIG_OPENAMP=y
CONFIG_OPENAMP_SLAVE=n

CONFIG_IPC_SERVICE_BACKEND_RPMSG_MI_NUM_INSTANCES=2

CONFIG_LOG=y
CONFIG_IPC_SERVICE_LOG_LEVEL_INF=y
```

## boards/nrf5340dk_nrf5340_cpuapp.conf
```kconfig
CONFIG_BOARD_ENABLE_CPUNET=y

# Backend configuration for IPC Service
CONFIG_IPM=y
CONFIG_IPM_NRFX=y

# Enable all needed IPM channels
CONFIG_IPM_MSG_CH_0_ENABLE=y
CONFIG_IPM_MSG_CH_1_ENABLE=y
CONFIG_IPM_MSG_CH_2_ENABLE=y
CONFIG_IPM_MSG_CH_3_ENABLE=y

# Configure all RX channels
CONFIG_IPM_MSG_CH_0_RX=y
CONFIG_IPM_MSG_CH_2_RX=y

# Configure all TX channels
CONFIG_IPM_MSG_CH_1_TX=y
CONFIG_IPM_MSG_CH_3_TX=y

CONFIG_IPC_SERVICE_BACKEND_RPMSG_MI_0_IPM_TX_NAME="IPM_1"
CONFIG_IPC_SERVICE_BACKEND_RPMSG_MI_0_IPM_RX_NAME="IPM_0"
CONFIG_IPC_SERVICE_BACKEND_RPMSG_MI_1_IPM_TX_NAME="IPM_3"
CONFIG_IPC_SERVICE_BACKEND_RPMSG_MI_1_IPM_RX_NAME="IPM_2"
```

## src/main.c
```c
/*
 * Copyright (c) 2021 Nordic Semiconductor ASA
 *
 * SPDX-License-Identifier: Apache-2.0
 */

#include <zephyr.h>
#include <drivers/ipm.h>
#include <sys/printk.h>
#include <device.h>
#include <stdio.h>
#include <stdlib.h>
#include <string.h>
#include <init.h>

#include <ipc/ipc_service.h>

#define MI_BACKEND_DRIVER_NAME "MI_BACKEND"

#define APP_TASK_STACK_SIZE  1024

K_THREAD_STACK_DEFINE(thread_stack_1, APP_TASK_STACK_SIZE);
K_THREAD_STACK_DEFINE(thread_stack_2, APP_TASK_STACK_SIZE);

static struct k_thread thread_data_1;
static struct k_thread thread_data_2;

static volatile uint8_t received_data_1;
static volatile uint8_t received_data_2;

static K_SEM_DEFINE(bound_ept1_sem, 0, 1);
static K_SEM_DEFINE(bound_ept2_sem, 0, 1);

static K_SEM_DEFINE(data_rx1_sem, 0, 1);
static K_SEM_DEFINE(data_rx2_sem, 0, 1);

static struct ipc_ept ept_1;
static struct ipc_ept ept_2;

static void ept_bound_1(void *priv)
{
	k_sem_give(&bound_ept1_sem);
}

static void ept_recv_1(const void *data, size_t len, void *priv)
{
	received_data_1 = *((uint8_t *) data);
	k_sem_give(&data_rx1_sem);
}

static void ept_error_1(const char *message, void *priv)
{
	printk("Endpoint [1] error: %s", message);
}

static void ept_bound_2(void *priv)
{
	k_sem_give(&bound_ept2_sem);
}

static void ept_recv_2(const void *data, size_t len, void *priv)
{
	received_data_2 = *((uint8_t *) data);
	k_sem_give(&data_rx2_sem);
}

static void ept_error_2(const char *message, void *priv)
{
	printk("Endpoint [2] error: %s", message);
}

void app_task_1(void *arg1, void *arg2, void *arg3)
{
	ARG_UNUSED(arg1);
	ARG_UNUSED(arg2);
	ARG_UNUSED(arg3);

	const struct device *ipc_instance;
	int status = 0;
	uint8_t message = 0U;

	printk("\r\nIPC Service [master 1] demo started\r\n");

	ipc_instance = device_get_binding(MI_BACKEND_DRIVER_NAME);

	static struct ipc_ept_cfg ept_cfg = {
		.name = "ep_1",
		.prio = 0,
		.priv = NULL,
		.cb = {
			.bound    = ept_bound_1,
			.received = ept_recv_1,
			.error    = ept_error_1,
		},
	};

	status = ipc_service_register_endpoint(ipc_instance, &ept_1, &ept_cfg);
	if (status < 0) {
		printk("ipc_service_register_endpoint failed %d\n", status);
		return;
	}

	k_sem_take(&bound_ept1_sem, K_FOREVER);

	while (message < 100) {
		status = ipc_service_send(&ept_1, &message, sizeof(message));
		if (status < 0) {
			printk("send_message(%d) failed with status %d\n",
			       message, status);
			break;
		}

		k_sem_take(&data_rx1_sem, K_FOREVER);
		message = received_data_1;

		printk("Master [1] received a message: %d\n", message);
		message++;
	}

	printk("IPC Service [master 1] demo ended.\n");
}

void app_task_2(void *arg1, void *arg2, void *arg3)
{
	ARG_UNUSED(arg1);
	ARG_UNUSED(arg2);
	ARG_UNUSED(arg3);

	const struct device *ipc_instance;
	int status = 0;
	uint8_t message = 0U;

	printk("\r\nIPC Service [master 2] demo started\r\n");

	ipc_instance = device_get_binding(MI_BACKEND_DRIVER_NAME);

	static struct ipc_ept_cfg ept_cfg = {
		.name = "ep_2",
		.prio = 0,
		.priv = NULL,
		.cb = {
			.bound    = ept_bound_2,
			.received = ept_recv_2,
			.error    = ept_error_2,
		},
	};

	status = ipc_service_register_endpoint(ipc_instance, &ept_2, &ept_cfg);

	if (status < 0) {
		printk("ipc_service_register_endpoint failed %d\n", status);
		return;
	}

	k_sem_take(&bound_ept2_sem, K_FOREVER);

	while (message < 100) {
		status = ipc_service_send(&ept_2, &message, sizeof(message));
		if (status < 0) {
			printk("send_message(%d) failed with status %d\n",
			       message, status);
			break;
		}

		k_sem_take(&data_rx2_sem, K_FOREVER);
		message = received_data_2;

		printk("Master [2] received a message: %d\n", message);
		message++;
	}

	printk("IPC Service [master 2] demo ended.\n");
}

void main(void)
{
	k_thread_create(&thread_data_1, thread_stack_1, APP_TASK_STACK_SIZE,
			(k_thread_entry_t)app_task_1,
			NULL, NULL, NULL, K_PRIO_COOP(7), 0, K_NO_WAIT);

	k_thread_create(&thread_data_2, thread_stack_2, APP_TASK_STACK_SIZE,
			(k_thread_entry_t)app_task_2,
			NULL, NULL, NULL, K_PRIO_COOP(7), 0, K_NO_WAIT);
}
```
