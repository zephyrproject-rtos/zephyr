## samples/subsys/ipc/ipc_service/icmsg/remote/boards/nrf54lv10dk_nrf54lv10a_cpuflpr.conf
```kconfig
CONFIG_LOG=y
CONFIG_LOG_MODE_MINIMAL=y
CONFIG_ASSERT=n
CONFIG_LOG_BACKEND_UART=n

CONFIG_BOOT_BANNER=n
CONFIG_EARLY_CONSOLE=y
CONFIG_HEAP_MEM_POOL_SIZE=1024

CONFIG_SIZE_OPTIMIZATIONS=y
```

## samples/subsys/ipc/ipc_service/icmsg/remote/boards/stm32h747i_disco_stm32h747xx_m4.conf
```kconfig
# SPDX-FileCopyrightText: Copyright The Zephyr Project Contributors
# SPDX-License-Identifier: Apache-2.0

CONFIG_CONSOLE=y
CONFIG_UART_CONSOLE=y
CONFIG_LOG_BACKEND_UART=y
```

## samples/subsys/ipc/ipc_service/icmsg/remote/sample.yaml
```yaml
sample:
  name: IPC Service example integration (icmsg backend) (remote)
tests:
  sample.ipc.icmsg_remote:
    platform_allow: nrf5340dk_nrf5340_cpunet
    integration_platforms:
      - nrf5340dk_nrf5340_cpunet
    tags: ipc
    harness: remote
```

## samples/subsys/ipc/ipc_service/icmsg/sample.yaml
```yaml
sample:
  name: IPC Service example integration (icmsg backend)
common:
  timeout: 30
  sysbuild: true
  tags: ipc
  harness: pytest
tests:
  sample.ipc.icmsg:
    platform_allow:
      - nrf5340dk/nrf5340/cpuapp
      - nrf5340bsim/nrf5340/cpuapp
    integration_platforms:
      - nrf5340dk/nrf5340/cpuapp
      - nrf5340bsim/nrf5340/cpuapp

  sample.ipc.rp2350_cpu0:
    platform_allow:
      - rpi_pico2/rp2350a/m33/cpu0
    integration_platforms:
      - rpi_pico2/rp2350a/m33/cpu0
    extra_args:
      # When the remote CPU does not have a console configured, the sample would hang
      - remote_CONFIG_LOG=n

  sample.ipc.rp2350:
    platform_allow:
      - rpi_pico2/rp2350a/m33
    integration_platforms:
      - rpi_pico2/rp2350a/m33
    extra_args:
      - icmsg_SNIPPET=rp2xxx-cpu1
      # When the remote CPU does not have a console configured, the sample would hang
      - remote_CONFIG_LOG=n

  sample.ipc.icbmsg.rp2350:
    platform_allow:
      - rpi_pico2/rp2350a/m33
    integration_platforms:
      - rpi_pico2/rp2350a/m33
    extra_args:
      - icmsg_SNIPPET=rp2xxx-cpu1
      - icmsg_EXTRA_DTC_OVERLAY_FILE="boards/rpi_pico2_rp2350a_m33_icbmsg.overlay"
      - remote_EXTRA_DTC_OVERLAY_FILE="boards/rpi_pico2_rp2350a_m33_cpu1_icbmsg.overlay"
      # When the remote CPU does not have a console configured, the sample would hang
      - remote_CONFIG_LOG=n

  sample.ipc.icmsg.nrf54l:
    platform_allow:
      - nrf54l15dk/nrf54l15/cpuapp
      - nrf54lm20dk/nrf54lm20a/cpuapp
    integration_platforms:
      - nrf54l15dk/nrf54l15/cpuapp
    extra_args: icmsg_SNIPPET=nordic-flpr

  sample.ipc.icmsg.nrf54l_no_multithreading:
    platform_allow:
      - nrf54l15dk/nrf54l15/cpuapp
      - nrf54lm20dk/nrf54lm20a/cpuapp
    integration_platforms:
      - nrf54l15dk/nrf54l15/cpuapp
    extra_args:
      - icmsg_SNIPPET=nordic-flpr
      - icmsg_CONFIG_MULTITHREADING=n
      - icmsg_CONFIG_LOG_MODE_MINIMAL=y
      - remote_CONFIG_MULTITHREADING=n
      - remote_CONFIG_LOG_MODE_MINIMAL=y

  sample.ipc.icmsg.nrf54l_remote_no_multithreading:
    platform_allow:
      - nrf54l15dk/nrf54l15/cpuapp
      - nrf54lm20dk/nrf54lm20a/cpuapp
    integration_platforms:
      - nrf54l15dk/nrf54l15/cpuapp
    extra_args:
      - icmsg_SNIPPET=nordic-flpr
      - remote_CONFIG_MULTITHREADING=n
      - remote_CONFIG_LOG_MODE_MINIMAL=y

  sample.ipc.icbmsg.nrf54l:
    platform_allow:
      - nrf54l15dk/nrf54l15/cpuapp
      - nrf54lm20dk/nrf54lm20a/cpuapp
    integration_platforms:
      - nrf54l15dk/nrf54l15/cpuapp
    extra_args:
      - icmsg_SNIPPET=nordic-flpr
      - icmsg_CONFIG_IPC_SERVICE_BACKEND_ICBMSG_NUM_EP=1
      - icmsg_EXTRA_DTC_OVERLAY_FILE="boards/nrf54l_cpuapp_icbmsg.overlay"
      - remote_CONFIG_IPC_SERVICE_BACKEND_ICBMSG_NUM_EP=1
      - remote_EXTRA_DTC_OVERLAY_FILE="boards/nrf54l_cpuflpr_icbmsg.overlay"

  sample.ipc.icbmsg.nrf54l_no_multithreading:
    platform_allow:
      - nrf54l15dk/nrf54l15/cpuapp
      - nrf54lm20dk/nrf54lm20a/cpuapp
    integration_platforms:
      - nrf54l15dk/nrf54l15/cpuapp
    extra_args:
      - icmsg_SNIPPET=nordic-flpr
      - icmsg_CONFIG_IPC_SERVICE_BACKEND_ICBMSG_NUM_EP=1
      - icmsg_EXTRA_DTC_OVERLAY_FILE="boards/nrf54l_cpuapp_icbmsg.overlay"
      - icmsg_CONFIG_MULTITHREADING=n
      - icmsg_CONFIG_LOG_MODE_MINIMAL=y
      - remote_CONFIG_IPC_SERVICE_BACKEND_ICBMSG_NUM_EP=1
      - remote_EXTRA_DTC_OVERLAY_FILE="boards/nrf54l_cpuflpr_icbmsg.overlay"
      - remote_CONFIG_MULTITHREADING=n
      - remote_CONFIG_LOG_MODE_MINIMAL=y

  sample.ipc.icbmsg.nrf54l_remote_no_multithreading:
    platform_allow:
      - nrf54l15dk/nrf54l15/cpuapp
      - nrf54lm20dk/nrf54lm20a/cpuapp
    integration_platforms:
      - nrf54l15dk/nrf54l15/cpuapp
    extra_args:
      - icmsg_SNIPPET=nordic-flpr
      - icmsg_CONFIG_IPC_SERVICE_BACKEND_ICBMSG_NUM_EP=1
      - icmsg_EXTRA_DTC_OVERLAY_FILE="boards/nrf54l_cpuapp_icbmsg.overlay"
      - remote_CONFIG_IPC_SERVICE_BACKEND_ICBMSG_NUM_EP=1
      - remote_EXTRA_DTC_OVERLAY_FILE="boards/nrf54l_cpuflpr_icbmsg.overlay"
      - remote_CONFIG_MULTITHREADING=n
      - remote_CONFIG_LOG_MODE_MINIMAL=y

  sample.ipc.icmsg.nrf7120:
    platform_allow:
      - nrf7120dk/nrf7120/cpuapp
    integration_platforms:
      - nrf7120dk/nrf7120/cpuapp
    extra_args: icmsg_SNIPPET=nordic-flpr

  sample.ipc.icbmsg.nrf7120:
    platform_allow:
      - nrf7120dk/nrf7120/cpuapp
    integration_platforms:
      - nrf7120dk/nrf7120/cpuapp
    extra_args:
      - icmsg_SNIPPET=nordic-flpr
      - icmsg_CONFIG_IPC_SERVICE_BACKEND_ICBMSG_NUM_EP=1
      - icmsg_EXTRA_DTC_OVERLAY_FILE="boards/nrf7120dk_nrf7120_cpuapp_icbmsg.overlay"
      - remote_CONFIG_IPC_SERVICE_BACKEND_ICBMSG_NUM_EP=1
      - remote_EXTRA_DTC_OVERLAY_FILE="boards/nrf7120dk_nrf7120_cpuflpr_icbmsg.overlay"
```

## samples/subsys/ipc/ipc_service/icmsg_me/remote/sample.yaml
```yaml
sample:
  name: IPC Service example integration (icmsg multi endpoint follower backend) (remote)
tests:
  sample.ipc.icmsg_me_follower:
    platform_allow: nrf5340dk_nrf5340_cpunet
    integration_platforms:
      - nrf5340dk_nrf5340_cpunet
    tags: ipc
    harness: remote
```

## samples/subsys/ipc/ipc_service/icmsg_me/sample.yaml
```yaml
sample:
  name: IPC Service example integration (icmsg multi endpoint backend)
tests:
  sample.ipc.icmsg_me:
    platform_allow: nrf5340dk_nrf5340_cpuapp
    integration_platforms:
      - nrf5340dk_nrf5340_cpuapp
    tags: ipc
    harness: remote
```

## samples/subsys/ipc/ipc_service/multi_endpoint/Kconfig.sysbuild
```kconfig
# Copyright 2023 Nordic Semiconductor ASA
#
# SPDX-License-Identifier: Apache-2.0

source "share/sysbuild/Kconfig"

config NET_CORE_BOARD
string
	default "$(BOARD)/nrf5340/cpunet" if $(BOARD) = "nrf5340dk"
	default "$(BOARD)/nrf5340/cpunet" if $(BOARD) = "nrf5340bsim"
	default "$(BOARD)/nrf54h20/cpurad" if $(BOARD) = "nrf54h20dk"
```

## samples/subsys/ipc/ipc_service/multi_endpoint/sample.yaml
```yaml
sample:
  name: IPC Service example integration (icmsg multi endpoint backend)
common:
  harness: console
  harness_config:
    type: multi_line
    ordered: false
    regex:
      - "IPC-service HOST \\[INST 0 - ENDP A\\] demo started"
      - "IPC-service HOST \\[INST 0 - ENDP B\\] demo started"
      - "IPC-service HOST \\[INST 1\\] demo started"
      - "IPC-service HOST \\[INST 0 - ENDP A\\] demo ended\\."
      - "IPC-service HOST \\[INST 0 - ENDP B\\] demo ended\\."
      - "IPC-service HOST \\[INST 1\\] demo ended\\."
tests:
  sample.ipc.multi_endpoint:
    platform_allow:
      - nrf5340dk/nrf5340/cpuapp
      - nrf5340bsim/nrf5340/cpuapp
      - nrf54h20dk/nrf54h20/cpuapp
    integration_platforms:
      - nrf5340dk/nrf5340/cpuapp
      - nrf5340bsim/nrf5340/cpuapp
      - nrf54h20dk/nrf54h20/cpuapp
    tags: ipc
    sysbuild: true
  sample.ipc.multi_endpoint.icbmsg:
    platform_allow:
      - nrf5340dk/nrf5340/cpuapp
      - nrf5340bsim/nrf5340/cpuapp
    integration_platforms:
      - nrf5340dk/nrf5340/cpuapp
      - nrf5340bsim/nrf5340/cpuapp
    tags: ipc
    sysbuild: true
    extra_args:
      - DTC_OVERLAY_FILE=boards/nrf5340dk_nrf5340_cpuapp_icbmsg.overlay
      - remote_DTC_OVERLAY_FILE=boards/nrf5340dk_nrf5340_cpunet_icbmsg.overlay
```

## samples/subsys/ipc/ipc_service/rpmsg_lite/Kconfig
```kconfig
# Copyright 2026 NXP
#
# SPDX-License-Identifier: Apache-2.0

source "Kconfig.zephyr"

config SAMPLE_IPC_RPMSG_LITE_STACK_SIZE
	int "Stack size for the sample IPC worker threads"
	default 4096
	help
	  Stack size in bytes for the per-instance demo threads in
	  the host image.

config SAMPLE_INCLUDE_REMOTE_DIR
	bool "Include remote core header directory"
	help
	  Include remote build header files. Can be used if primary image
	  needs to be aware of size or base address of secondary image
```

## samples/subsys/ipc/ipc_service/rpmsg_lite/Kconfig.sysbuild
```kconfig
# Copyright 2026 NXP
#
# SPDX-License-Identifier: Apache-2.0

source "share/sysbuild/Kconfig"

config REMOTE_BOARD
string
	default "mimxrt1170_evkb/mimxrt1176/cm4" if $(BOARD) = "mimxrt1170_evkb"
	default "mimxrt1170_evk/mimxrt1176/cm4" if $(BOARD) = "mimxrt1170_evk"
	default "mimxrt1160_evk/mimxrt1166/cm4" if $(BOARD) = "mimxrt1160_evk"
	default "lpcxpresso55s69/lpc55s69/cpu1" if $(BOARD) = "lpcxpresso55s69"
	default "mimxrt700_evk/mimxrt798s/cm33_cpu1" if $(BOARD) = "mimxrt700_evk"
```

## samples/subsys/ipc/ipc_service/rpmsg_lite/boards/mimxrt1170_evk_mimxrt1176_cm7.conf
```kconfig
#
# Copyright 2026 NXP
#
# SPDX-License-Identifier: Apache-2.0
#

CONFIG_MBOX_NXP_IMX_MU=y
CONFIG_SECOND_CORE_MCUX=y
CONFIG_SAMPLE_INCLUDE_REMOTE_DIR=y
```

## samples/subsys/ipc/ipc_service/rpmsg_lite/remote/Kconfig
```kconfig
# Copyright 2026 NXP
#
# SPDX-License-Identifier: Apache-2.0

source "Kconfig.zephyr"

config SAMPLE_IPC_RPMSG_LITE_STACK_SIZE
	int "Stack size for the sample IPC worker threads"
	default 4096
	help
	  Stack size in bytes for the per-instance demo threads in
	  the remote image.
```

## samples/subsys/ipc/ipc_service/sample.yaml
```yaml
sample:
    description: This app provides an example of how to integrate
        IPC Service with Zephyr.
    name: IPC Service example integration
tests:
    sample.ipc.rpmsg_service.nrf:
        platform_allow: nrf5340dk_nrf5340_cpuapp
        integration_platforms:
          - nrf5340dk_nrf5340_cpuapp
        tags: ipm
        build_only: true
```

## samples/subsys/ipc/ipc_service/static_vrings/Kconfig
```kconfig
# Copyright 2024 NXP
#
# SPDX-License-Identifier: Apache-2.0

source "Kconfig.zephyr"

config INCLUDE_REMOTE_DIR
	bool "Include remote core header directory"
	help
	  Include remote build header files. Can be used if primary image
	  needs to be aware of size or base address of secondary image
```

## samples/subsys/ipc/ipc_service/static_vrings/Kconfig.sysbuild
```kconfig
# Copyright 2023 Nordic Semiconductor ASA
# Copyright 2024-2025 NXP
#
# SPDX-License-Identifier: Apache-2.0

source "share/sysbuild/Kconfig"

config NET_CORE_BOARD
string
	default "nrf5340dk/nrf5340/cpunet" if $(BOARD) = "nrf5340dk"
	default "nrf5340bsim/nrf5340/cpunet" if $(BOARD) = "nrf5340bsim"
	default "lpcxpresso55s69/lpc55s69/cpu1" if $(BOARD) = "lpcxpresso55s69"
	default "mimxrt1160_evk/mimxrt1166/cm4" if $(BOARD) = "mimxrt1160_evk"
	default "mimxrt1170_evk/mimxrt1176/cm4" if $(BOARD) = "mimxrt1170_evk"
	default "mimxrt1170_evkb/mimxrt1176/cm4" if $(BOARD) = "mimxrt1170_evkb"
	default "mimxrt700_evk/mimxrt798s/cm33_cpu1" if $(BOARD) = "mimxrt700_evk"
	default "frdm_mcxn947/mcxn947/cpu1" if $(BOARD) = "frdm_mcxn947"
	default "mcx_n9xx_evk/mcxn947/cpu1" if $(BOARD) = "mcx_n9xx_evk"
	default "mimxrt1180_evk/mimxrt1189/cm7" if $(BOARD) = "mimxrt1180_evk"
	default "ek_ra8p1/r7ka8p1kflcac/cm33" if $(BOARD) = "ek_ra8p1"
```

## samples/subsys/ipc/ipc_service/static_vrings/boards/mimxrt700_evk_mimxrt798s_cm33_cpu0.conf
```kconfig
#
# Copyright 2025 NXP
#
# SPDX-License-Identifier: Apache-2.0
#

CONFIG_SECOND_CORE_MCUX=y
CONFIG_INCLUDE_REMOTE_DIR=y
CONFIG_DCACHE=n
```

## samples/subsys/ipc/ipc_service/static_vrings/remote/boards/mimxrt700_evk_mimxrt798s_cm33_cpu1.conf
```kconfig
#
# Copyright 2025 NXP
#
# SPDX-License-Identifier: Apache-2.0
#

CONFIG_BUILD_OUTPUT_HEX=y
CONFIG_SECOND_CORE_MCUX=y
```

## samples/subsys/ipc/ipc_service/static_vrings/remote/sample.yaml
```yaml
sample:
    name: IPC Service example integration (OpenAMP static_vrings backend) (remote)
tests:
    sample.ipc.static_vrings_remote:
        platform_allow: nrf5340dk_nrf5340_cpunet
        integration_platforms:
          - nrf5340dk_nrf5340_cpunet
        tags: ipc
        harness: remote
```
