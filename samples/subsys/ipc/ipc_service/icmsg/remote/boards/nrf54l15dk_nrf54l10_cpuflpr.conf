## samples/subsys/ipc/ipc_service/icmsg/remote/boards/nrf54l15dk_nrf54l10_cpuflpr.conf
```kconfig
# SPDX-FileCopyrightText: Copyright The Zephyr Project Contributors
# SPDX-License-Identifier: Apache-2.0

CONFIG_LOG=n
CONFIG_LOG_MODE_MINIMAL=y
CONFIG_ASSERT=n
```

## samples/subsys/ipc/openamp_rsc_table/boards/imx952_evk_mimx9529_m7.conf
```kconfig
CONFIG_LOG=y
CONFIG_SHELL_BACKEND_RPMSG=n
CONFIG_PRINTK=y
CONFIG_OPENAMP_WITH_DCACHE=y
CONFIG_IPM_MBOX=y
CONFIG_MBOX_NXP_IMX_MU=y
CONFIG_LOG_MODE_MINIMAL=y
CONFIG_LOG_DEFAULT_LEVEL=3
CONFIG_OPENAMP_COPY_RSC_TABLE=y
```

## samples/subsys/ipc/openamp_rsc_table/boards/scobc_v1_versal_rpu.conf
```kconfig
# Copyright (c) 2026 Space Cubics Inc.
# SPDX-License-Identifier: Apache-2.0

CONFIG_SOC_VERSAL_RPU_REMOTEPROC=y
CONFIG_SOC_VERSAL_RPU_REMOTEPROC_DATA_LMA=y
```

## samples/subsys/logging/fcb_backend/sample.yaml
```yaml
sample:
  name: Log backend FCB Sample
tests:
  sample.loggin.fcb:
    tags:
      - LED
      - gpio
      - flash
      - logging
      - shell
    depends_on: gpio, external flash 
    integration_platforms:
      - nrf52840dk
      - nrf9151dk
```

## samples/subsys/logging/multidomain/remote/boards/nrf54l15dk_nrf54l15_cpuflpr.conf
```kconfig
CONFIG_PRINTK=n
CONFIG_CONSOLE=n
CONFIG_UART_CONSOLE=n
CONFIG_SERIAL=n
CONFIG_GPIO=n
CONFIG_CBPRINTF_CONVERT_CHECK_PTR=n
CONFIG_BOOT_BANNER=n
CONFIG_ASSERT=n
```

## samples/subsys/mgmt/bmc/Kconfig
```kconfig
# SPDX-FileCopyrightText: Copyright The Zephyr Project Contributors
# SPDX-License-Identifier: Apache-2.0

mainmenu "BMC sample"

config BMC_SAMPLE_WEB
	bool "Serve the product dashboard"
	default y
	depends on BMC_HTTP
	help
	  Attach the dashboard, its branding and the /webui/features endpoint
	  to the BMC HTTP services.

config BMC_SAMPLE_GENERATE_CERTS
	bool "Generate a self-signed TLS certificate at build time"
	default y
	depends on BMC_HTTPS
	select TLS_CREDENTIALS
	help
	  Run the scripts under certs/ to produce a throwaway server
	  certificate and register it under CONFIG_BMC_HTTPS_SEC_TAG. Requires
	  openssl and bash on the build host.

source "Kconfig.zephyr"
```

## samples/subsys/mgmt/fota_http/Kconfig
```kconfig
# Copyright (c) 2026 Espressif Systems (Shanghai) Co., Ltd.
# SPDX-License-Identifier: Apache-2.0

mainmenu "FOTA HTTP sample"

config SAMPLE_FOTA_HTTP_AUTO_URL
	string "Image URL to download once the network is up"
	default ""
	help
	  When set, the sample waits for the connection manager to report
	  the network as connected, then downloads this image on the
	  library thread and prints the progress on the console. The image
	  is only stored. 'fota apply' is still needed to boot it. Leave
	  empty to drive everything from the shell.

source "Kconfig.zephyr"
```

## samples/subsys/micro_core/uart/Kconfig
```kconfig
# SPDX-FileCopyrightText: Copyright The Zephyr Project Contributors
# SPDX-License-Identifier: Apache-2.0

mainmenu "Micro Core UART sample"

source "Kconfig.zephyr"

config MC_SAMPLE_SENDER
	bool "Send sample payloads"
	help
	  Select the sender role. Leave disabled on the receiver board.
```

## samples/subsys/mp/net_stream/Kconfig
```kconfig
# Copyright 2026 NXP
# SPDX-License-Identifier: Apache-2.0

mainmenu "MediaPipe network streaming sample"

config SAMPLE_NET_STREAM_PORT
	int "TCP port the sink listens on"
	range 1 65535
	default 5000
	help
	  Port passed to the tcpsink element through MP_PROP_NET_SINK_PORT.

config SAMPLE_NET_STREAM_SELFTEST
	bool "Build the self-test client"
	help
	  Generate the input file at startup and run a client thread that
	  connects to the sink, counts the JPEG frames it receives, and logs
	  PASS or FAIL. Lets the sample run without an external player.

config SAMPLE_NET_STREAM_SELFTEST_ADDR
	string "Address the self-test client connects to"
	default "127.0.0.1"
	depends on SAMPLE_NET_STREAM_SELFTEST
	help
	  IPv4 address of the sink, as seen by the self-test client.

source "Kconfig.zephyr"
```

## samples/subsys/mp/net_stream/sample.yaml
```yaml
sample:
  name: MediaPipe network streaming sample

tests:
  sample.mp.net_stream:
    tags:
      - mp
      - networking
    platform_allow:
      - native_sim/native/64
    integration_platforms:
      - native_sim/native/64
    extra_args:
      - EXTRA_CONF_FILE=loopback.conf
    harness: console
    harness_config:
      type: one_line
      regex:
        - "\\[selftest\\] PASS: received 3 frames"
```

## samples/subsys/mpipe/audio_loopback/Kconfig
```kconfig
# Copyright 2026 NXP
# SPDX-License-Identifier: Apache-2.0

source "Kconfig.zephyr"

choice SAMPLE_AUDIO_SOURCE
	prompt "Capture source the pipeline reads from"
	default SAMPLE_AUDIO_SOURCE_DMIC

config SAMPLE_AUDIO_SOURCE_DMIC
	bool "Digital microphone"

config SAMPLE_AUDIO_SOURCE_I2S
	bool "I2S receiver"

endchoice

config SAMPLE_AUDIO_GAIN_PERCENT
	int "Gain applied by the pipeline (percent)"
	default 90
	range 0 1000

config USE_I2S_TARGET_CODEC_CONTROLLER
	bool "I2S BCK is generated by a selected codec device"
	help
	  If selected, the I2S selected peripheral will be configured to consume
	  (receive) the I2S BCK and WS signals and the codec will be configured
	  to generate those. If not selected, the I2S peripheral will generate
	  them and the codec will be expected to consume them.
```
