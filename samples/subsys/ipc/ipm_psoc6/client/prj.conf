## CMakeLists.txt
```
cmake_minimum_required(VERSION 3.8.2)
#
# Copyright (c) 2018, Cypress Semiconductor
#
# SPDX-License-Identifier: Apache-2.0
#

set(BOARD cy8ckit_062_wifi_bt_m4)

include($ENV{ZEPHYR_BASE}/cmake/app/boilerplate.cmake NO_POLICY_SCOPE)
project(ipm_psoc6_client)

if(NOT ("${BOARD}" STREQUAL "cy8ckit_062_wifi_bt_m4"))
  message(FATAL_ERROR "${BOARD} was specified, but this sample only supports cy8ckit_062_wifi_bt_m4")
endif()

target_include_directories(app PRIVATE $ENV{ZEPHYR_BASE}/drivers)
target_sources(app PRIVATE src/main_client.c)
```

## prj.conf
```kconfig
CONFIG_PRINTK=y
CONFIG_IPM=y
CONFIG_IPM_PSOC6=y
CONFIG_TIMESLICE_SIZE=1
CONFIG_MAIN_STACK_SIZE=2048
```

## src/main_client.c
```c
/*
 * Copyright (c) 2018, Cypress Semiconductor
 *
 * SPDX-License-Identifier: Apache-2.0
 */

#include "cy_sysint.h"
#include <misc/printk.h>
#include <zephyr.h>
#include <ipm.h>

#define SLEEP_TIME 2000

#define COUNTER_MAX_VAL 10

void message_ipm_callback(void *context, u32_t id, volatile void *data)
{
	struct device *ipm = (struct device *)context;
	u32_t *data32 = (u32_t *)data;
	int ipm_error;

	printk("Received counter value: %u\n", *data32);
	*data32 = *data32 + 1;

	if (*data32 < COUNTER_MAX_VAL) {
		printk("Sending next message: %u\n", *data32);
		ipm_error = ipm_send(ipm, 1, 0, data32, 4);

		if (ipm_error != 0) {
			printk("ipm_send returned error %i\n", ipm_error);
		}
	} else {
		printk("The last message cycle finished\n");
	}
}

void main(void)
{
	struct device *ipm;
	int ipm_error;
	u32_t counter = 0;

	ipm = device_get_binding(DT_CYPRESS_PSOC6_MAILBOX_PSOC6_IPM0_LABEL);
	ipm_register_callback(ipm, message_ipm_callback, ipm);

	printk("PSoC6 IPM Client example has started\n");
	printk("Sending first message \" %u \" from %u messages via IPM\n",
		counter, COUNTER_MAX_VAL);
	ipm_error = ipm_send(ipm, 1, 0, &counter, 4);
	if (ipm_error != 0) {
		printk("ipm_send returned error %i\n", ipm_error);
	}

	while (1) {
		k_sleep(SLEEP_TIME);
	}
}
```
