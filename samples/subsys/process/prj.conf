## CMakeLists.txt
```
# Copyright (c) 2025 Nordic Semiconductor ASA
# SPDX-License-Identifier: Apache-2.0

cmake_minimum_required(VERSION 3.20.0)

find_package(Zephyr REQUIRED HINTS $ENV{ZEPHYR_BASE})
project(subprocess_sample)

target_sources(app PRIVATE
  src/builtin.c
  src/ext.c
  src/llext.c
  src/main.c
)

set(ext_name ext)
set(ext_src src/${ext_name}.c)
set(ext_bin ${PROJECT_BINARY_DIR}/llext/${ext_name}.llext)
set(ext_inc ${ZEPHYR_BINARY_DIR}/include/generated/${ext_name}_ext.inc)
add_llext_target(
  ${ext_name}
  OUTPUT  ${ext_bin}
  SOURCES ${ext_src}
)
generate_inc_file_for_target(app ${ext_bin} ${ext_inc})
```

## sample.yaml
```
sample:
  description: Subprocess start and stop with userspace
  name: Subprocess
tests:
  sample.subprocess.userspace:
    platform_allow:
      - nrf54l15/nrf54l15/cpuapp
    harness: console
    harness_config:
      type: multi_line
      ordered: true
      regex:
        - "starting subprocesses from user mode"
        - "hello from ext"
        - "hello from builtin"
        - "starting subprocesses from supervisor mode"
        - "hello from ext"
        - "hello from builtin"
```

## prj.conf
```kconfig
# Copyright (c) 2025 Nordic Semiconductor ASA
# SPDX-License-Identifier: Apache-2.0

CONFIG_PROCESS=y
CONFIG_LLEXT=y
CONFIG_MAIN_STACK_SIZE=8192
CONFIG_LLEXT_HEAP_SIZE=32
CONFIG_USERSPACE=y
```

## src/main.c
```c
/*
 * Copyright (c) 2025 Nordic Semiconductor ASA
 *
 * SPDX-License-Identifier: Apache-2.0
 */

#include <zephyr/process/process.h>

static void entry(void *p1, void *p2, void *p3)
{
	struct k_process *process;
	const char *args[] = {"test0", "test1", "test2"};

	ARG_UNUSED(p1);
	ARG_UNUSED(p2);
	ARG_UNUSED(p3);

	printk("starting subprocesses from %s thread\n",
	       k_is_user_context() ? "user" : "supervisor");

	process = k_process_get("ext");
	k_process_start(process, ARRAY_SIZE(args), args, NULL, NULL);
	process = k_process_get("builtin");
	k_process_start(process, ARRAY_SIZE(args), args, NULL, NULL);
	k_msleep(2000);
}

int main(void)
{
	struct k_process *process;

	/* Run subprocesses as supervisor thread */
	entry(NULL, NULL, NULL);

	/* Grant access to subprocesses to this thread before entering user mode */
	process = k_process_get("ext");
	k_object_access_grant(process, k_current_get());
	process = k_process_get("builtin");
	k_object_access_grant(process, k_current_get());

	/* Run subprocesses as user thread */
	k_thread_user_mode_enter(entry, NULL, NULL, NULL);

	/* We never get here */
	return 0;
}
```

## src/builtin.c
```c
/*
 * Copyright (c) 2025 Nordic Semiconductor ASA
 *
 * SPDX-License-Identifier: Apache-2.0
 */

#include <zephyr/process/builtin.h>
#include <zephyr/kernel.h>

static int entry(size_t argc, const char **argv, struct k_pipe *input, struct k_pipe *output)
{
	printk("enter builtin\n");

	k_sleep(K_SECONDS(1));

	for (size_t i = 0; i < argc; i++) {
		printk("arg%u: %s\n", i, argv[i]);
	}

	printk("exit builtin\n");
	return 0;
}

static struct k_process_builtin builtin;

static int register_builtin(void)
{
	struct k_process *process = k_process_builtin_init(&builtin, "builtin", entry);
	return k_process_register(process);
}

SYS_INIT(register_builtin, POST_KERNEL, 0);
```

## src/ext.c
```c
/*
 * Copyright (c) 2025 Nordic Semiconductor ASA
 *
 * SPDX-License-Identifier: Apache-2.0
 */

#include <zephyr/llext/llext.h>
#include <zephyr/kernel.h>

int entry(size_t argc, const char **argv, struct k_pipe *input, struct k_pipe *output)
{
	printk("enter ext\n");

	k_sleep(K_MSEC(500));

	for (size_t i = 0; i < argc; i++) {
		printk("arg%u: %s\n", i, argv[i]);
	}

	printk("exit ext\n");
	return 0;
}

EXPORT_SYMBOL(entry);
```

## src/llext.c
```c
/*
 * Copyright (c) 2025 Nordic Semiconductor ASA
 *
 * SPDX-License-Identifier: Apache-2.0
 */

#include <zephyr/process/llext.h>
#include <zephyr/kernel.h>

const uint8_t ext[] = {
#include <ext_ext.inc>
};

static struct llext_buf_loader buf_loader = LLEXT_BUF_LOADER(ext, sizeof(ext));
static struct llext_load_param load_param = LLEXT_LOAD_PARAM_DEFAULT;
static struct k_process_llext llext;

static int register_llext(void)
{
	struct k_process *process = k_process_llext_init(&llext,
							 "ext",
							 &buf_loader.loader,
							 &load_param);
	return k_process_register(process);
}

SYS_INIT(register_llext, POST_KERNEL, 0);
```
