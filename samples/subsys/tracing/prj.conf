## CMakeLists.txt
```
# SPDX-License-Identifier: Apache-2.0

cmake_minimum_required(VERSION 3.20.0)

if(BOARD MATCHES "qemu_.*")
  list(APPEND QEMU_EXTRA_FLAGS -serial file:channel0_0)
endif()

find_package(Zephyr REQUIRED HINTS $ENV{ZEPHYR_BASE})
project(tracing_tests)

include(${ZEPHYR_BASE}/samples/subsys/usb/common/common.cmake)
target_sources(app PRIVATE src/main.c)
target_sources_ifdef(CONFIG_TRACING_GPIO app PRIVATE src/gpio_main.c)
target_sources_ifdef(CONFIG_TRACING_USER app PRIVATE src/tracing_user.c)
```

## sample.yaml
```
common:
  tags:
    - tracing
    - debug
  harness: console
  harness_config:
    type: multi_line
    regex:
      - "thread_a: Hello World from (.*)!"
      - "thread_b: Hello World from (.*)!"
tests:
  sample.tracing.user:
    extra_args: CONF_FILE="prj_user.conf"
    integration_platforms:
      - qemu_x86
    platform_exclude:
      - mr_canhubk3
    harness_config:
      type: multi_line
      regex:
        - "thread_a: Hello World from (.*)!"
        - "thread_b: Hello World from (.*)!"
        - "sys_trace_.*_user.*"
  sample.tracing.format.sysview:
    platform_allow:
      - nrf52840dk/nrf52840
      - mimxrt1050_evk/mimxrt1052/hyperflash
      - mimxrt1064_evk
    integration_platforms:
      - nrf52840dk/nrf52840
    extra_args: SNIPPET="rtt-tracing"
  sample.tracing.osawareness.openocd:
    arch_exclude:
      - posix
      - xtensa
    platform_exclude: qemu_x86_64
    integration_platforms:
      - qemu_x86
  sample.tracing.transport.uart:
    platform_allow:
      - qemu_x86
      - qemu_x86_64
    integration_platforms:
      - qemu_x86
    extra_args: CONF_FILE="prj_uart.conf"
    filter: dt_chosen_enabled("zephyr,tracing-uart")
  sample.tracing.transport.uart.ctf:
    platform_allow:
      - qemu_x86
      - qemu_x86_64
    integration_platforms:
      - qemu_x86
    extra_args: CONF_FILE="prj_uart_ctf.conf"
    filter: dt_chosen_enabled("zephyr,tracing-uart")
  sample.tracing.transport.usb.ctf:
    integration_platforms:
      - frdm_k64f
    depends_on: usbd
    extra_args: CONF_FILE="prj_usb_ctf.conf"
  sample.tracing.transport.native:
    platform_allow:
      - native_sim
    integration_platforms:
      - native_sim
  sample.tracing.transport.native.ctf:
    platform_allow:
      - native_sim
    integration_platforms:
      - native_sim
    extra_args: CONF_FILE="prj_native_ctf.conf"
  sample.tracing.percepio:
    platform_allow: frdm_k64f
    extra_args: CONF_FILE="prj_percepio.conf"
    modules:
      - percepio
  sample.tracing.gpio:
    depends_on: gpio
    harness_config:
      type: multi_line
      regex:
        - "port: gpio_emul, pin: [01] flags: (.*)"
        - "port: gpio_emul, pin: [01] ret: 0"
        - "port: gpio_emul, pins: [01]"
        - "port: gpio_emul, ret: 0"
        - "Interrupt detected!"
        - "thread_a: Hello World from (.*)!"
        - "thread_b: Hello World from (.*)!"
        - "sys_trace_.*_user.*"
    extra_args:
      - CONF_FILE="prj_gpio.conf"
      - EXTRA_DTC_OVERLAY_FILE="gpio.overlay"
    integration_platforms:
      - native_sim
```

## prj.conf
```kconfig
# enable to use thread names
CONFIG_THREAD_NAME=y
CONFIG_MP_MAX_NUM_CPUS=1

# Debugging
CONFIG_DEBUG_OPTIMIZATIONS=n
CONFIG_DEBUG_THREAD_INFO=y
```

## prj_gpio.conf
```kconfig
CONFIG_GPIO=y
CONFIG_GPIO_GET_CONFIG=y
CONFIG_TRACING=y
CONFIG_TRACING_GPIO=y
CONFIG_TRACING_THREAD=n
CONFIG_TRACING_USER=y
CONFIG_TRACING_TEST=n
CONFIG_TRACING_CTF=n
CONFIG_SEGGER_SYSTEMVIEW=n
```

## prj_native_ctf.conf
```kconfig
CONFIG_TRACING=y
CONFIG_TRACING_CTF=y
CONFIG_TRACING_SYNC=y
CONFIG_TRACING_BACKEND_POSIX=y
CONFIG_TRACING_PACKET_MAX_SIZE=64
```

## prj_percepio.conf
```kconfig
# enable to use thread names
CONFIG_THREAD_NAME=y
CONFIG_MP_MAX_NUM_CPUS=1
CONFIG_DEBUG_THREAD_INFO=y
CONFIG_PERCEPIO_TRACERECORDER=y
CONFIG_TRACING=y
```

## prj_ram.conf
```kconfig
CONFIG_TRACING=y
CONFIG_TRACING_CTF=y
CONFIG_TRACING_BACKEND_RAM=y
CONFIG_TRACING_BUFFER_SIZE=4096
CONFIG_RAM_TRACING_BUFFER_SIZE=16384
```

## prj_sysview.conf
```kconfig
CONFIG_TRACING=y
CONFIG_SEGGER_SYSTEMVIEW=y
CONFIG_IDLE_STACK_SIZE=2048
CONFIG_SEGGER_SYSTEMVIEW_BOOT_ENABLE=n
CONFIG_SEGGER_SYSVIEW_POST_MORTEM_MODE=n
```

## prj_uart.conf
```kconfig
CONFIG_IDLE_STACK_SIZE=4096
CONFIG_TRACING=y
CONFIG_TRACING_TEST=y
CONFIG_TRACING_BACKEND_UART=y
CONFIG_TRACING_BUFFER_SIZE=4096
```

## app.overlay
```dts
/*
 * Copyright (c) 2024 Tenstorrent AI ULC
 *
 * SPDX-License-Identifier: Apache-2.0
 */

/ {
    gpio_emul: gpio_emul {
		status = "okay";
		compatible = "zephyr,gpio-emul";
		rising-edge;
		falling-edge;
		high-level;
		low-level;
		gpio-controller;
		#gpio-cells = < 0x2 >;
		phandle = < 0x1 >;
	};
};
```

## gpio.overlay
```dts
/*
 * Copyright (c) 2024 Tenstorrent AI ULC
 *
 * SPDX-License-Identifier: Apache-2.0
 */

/ {
	gpio_emul: gpio_emul {
		status = "okay";
		compatible = "zephyr,gpio-emul";
		rising-edge;
		falling-edge;
		high-level;
		low-level;
		gpio-controller;
		#gpio-cells = <0x2>;
		phandle = <0x1>;
	};
};
```

## boards/qemu_x86_64.overlay
```dts
/* SPDX-License-Identifier: Apache-2.0 */

/ {
	chosen {
		zephyr,tracing-uart = &uart1;
	};
};
```

## src/main.c
```c
/*
 * Copyright (c) 2019 Intel Corporation
 * Copyright (c) 2012-2014 Wind River Systems, Inc.
 *
 * SPDX-License-Identifier: Apache-2.0
 */

#include <zephyr/kernel.h>
#include <zephyr/sys/printk.h>
#include <zephyr/logging/log.h>
#include <sample_usbd.h>
#include <zephyr/tracing/tracing.h>

/*
 * The hello world demo has two threads that utilize semaphores and sleeping
 * to take turns printing a greeting message at a controlled rate. The demo
 * shows both the static and dynamic approaches for spawning a thread; a real
 * world application would likely use the static approach for both threads.
 */


/* size of stack area used by each thread */
#define STACKSIZE (2048)

/* scheduling priority used by each thread */
#define PRIORITY 7

/* delay between greetings (in ms) */
#define SLEEPTIME 500

static uint32_t counter;

/*
 * @param my_name      thread identification string
 * @param my_sem       thread's own semaphore
 * @param other_sem    other thread's semaphore
 */
void helloLoop(const char *my_name,
	       struct k_sem *my_sem, struct k_sem *other_sem)
{
	const char *tname;

	while (1) {
		/* take my semaphore */
		k_sem_take(my_sem, K_FOREVER);

		/*
		 * Demonstrate dynamic tracing state: disable tracing after 5 iterations so
		 * uninteresting events do not fill the buffer, then re-enable it at 10 to
		 * capture the next critical section.
		 */
		if (counter == 5U) {
			printk("Disabling tracing\n");
			sys_trace_set_state(false);
		} else if (counter == 10U) {
			sys_trace_set_state(true);
			printk("Re-enabling tracing\n");
		}

		/* Provide a named trace, with the counter value */
		sys_trace_named_event("counter_value", counter, 0);
		counter++;

		/* say "hello" */
		tname = k_thread_name_get(k_current_get());
		if (tname == NULL) {
			printk("%s: Hello World from %s!\n",
				my_name, CONFIG_BOARD);
		} else {
			printk("%s: Hello World from %s!\n",
				tname, CONFIG_BOARD);
		}

		/* wait a while, then let other thread have a turn */
		k_msleep(SLEEPTIME);
		k_sem_give(other_sem);
	}
}

/* define semaphores */

K_SEM_DEFINE(threadA_sem, 1, 1);	/* starts off "available" */
K_SEM_DEFINE(threadB_sem, 0, 1);	/* starts off "not available" */


/* threadB is a dynamic thread that is spawned by threadA */

void threadB(void *dummy1, void *dummy2, void *dummy3)
{
	ARG_UNUSED(dummy1);
	ARG_UNUSED(dummy2);
	ARG_UNUSED(dummy3);

	/* invoke routine to ping-pong hello messages with threadA */
	helloLoop(__func__, &threadB_sem, &threadA_sem);
}

K_THREAD_STACK_DEFINE(threadB_stack_area, STACKSIZE);
static struct k_thread threadB_data;

/* threadA is a static thread that is spawned automatically */

void threadA(void *dummy1, void *dummy2, void *dummy3)
{
	ARG_UNUSED(dummy1);
	ARG_UNUSED(dummy2);
	ARG_UNUSED(dummy3);

#if defined(CONFIG_USB_DEVICE_STACK_NEXT)
	struct usbd_context *sample_usbd = sample_usbd_init_device(NULL);

	if (sample_usbd == NULL) {
		printk("Failed to initialize USB device");
		return;
	}

	if (usbd_enable(sample_usbd)) {
		printk("usb backend enable failed");
		return;
	}
#endif /* CONFIG_USB_DEVICE_STACK_NEXT */

	/* spawn threadB */
	k_tid_t tid = k_thread_create(&threadB_data, threadB_stack_area,
			STACKSIZE, threadB, NULL, NULL, NULL,
			PRIORITY, 0, K_NO_WAIT);

	k_thread_name_set(tid, "thread_b");

	/* invoke routine to ping-pong hello messages with threadB */
	helloLoop(__func__, &threadA_sem, &threadB_sem);
}

K_THREAD_DEFINE(thread_a, STACKSIZE, threadA, NULL, NULL, NULL,
		PRIORITY, 0, 0);
```

## src/gpio_main.c
```c
/*
 * Copyright (c) 2024 Tenstorrent AI ULC
 *
 * SPDX-License-Identifier: Apache-2.0
 */

#include <zephyr/kernel.h>
#include <zephyr/sys/printk.h>
#include <zephyr/logging/log.h>
#include <zephyr/drivers/gpio.h>
#include <zephyr/drivers/gpio/gpio_emul.h>

/* size of stack area used by each thread */
#define STACKSIZE (2048)

/* scheduling priority used by each thread */
#define PRIORITY 7

void test_handler(const struct device *port, struct gpio_callback *cb, gpio_port_pins_t pins)
{
	printk("Interrupt detected!\n");
}

void gpio_sample(void)
{
	const struct device *dev = DEVICE_DT_GET(DT_NODELABEL(gpio_emul));

	if (!device_is_ready(dev)) {
		printk("%s: device not ready.\n", dev->name);
		return;
	}

	/* Configure pin 0 as output and toggle */
	gpio_pin_configure(dev, 0, GPIO_OUTPUT);
	gpio_pin_set(dev, 0, 1);
	gpio_pin_set(dev, 0, 0);

	/* Configure pin 1 as input */
	gpio_pin_configure(dev, 1, GPIO_INPUT);

	/* Read pin 1 */
	gpio_emul_input_set(dev, 1, 1);
	gpio_pin_get(dev, 1);
	gpio_emul_input_set(dev, 1, 0);
	gpio_pin_get(dev, 1);

	/* Setup pin 1 for interrupt */
	gpio_pin_interrupt_configure(dev, 1, GPIO_INT_EDGE_RISING);
	static struct gpio_callback gpio_cb;

	gpio_init_callback(&gpio_cb, test_handler, BIT(1));
	gpio_add_callback(dev, &gpio_cb);

	/* Trigger interrupt */
	gpio_emul_input_set(dev, 1, 1);

	/* Remove interrupt */
	gpio_remove_callback(dev, &gpio_cb);
}

static void gpio_thread(void *dummy1, void *dummy2, void *dummy3)
{
	ARG_UNUSED(dummy1);
	ARG_UNUSED(dummy2);
	ARG_UNUSED(dummy3);

	gpio_sample();
}

K_THREAD_DEFINE(thread_gpio, STACKSIZE, gpio_thread, NULL, NULL, NULL, PRIORITY, 0, 0);
```

## src/tracing_string_format_test.c
```c
/*
 * Copyright (c) 2019 Intel Corporation
 *
 * SPDX-License-Identifier: Apache-2.0
 */

#include <zephyr.h>
#include <tracing_test.h>
#include <tracing/tracing_format.h>

void sys_trace_thread_switched_out(void)
{
	struct k_thread *thread;

	thread = k_current_get();
	TRACING_STRING("%s: %p\n", __func__, thread);
}

void sys_trace_thread_switched_in(void)
{
	struct k_thread *thread;

	thread = k_current_get();
	TRACING_STRING("%s: %p\n", __func__, thread);
}

void sys_trace_thread_priority_set(struct k_thread *thread)
{
	TRACING_STRING("%s: %p\n", __func__, thread);
}

void sys_trace_thread_create(struct k_thread *thread)
{
	TRACING_STRING("%s: %p\n", __func__, thread);
}

void sys_trace_thread_abort(struct k_thread *thread)
{
	TRACING_STRING("%s: %p\n", __func__, thread);
}

void sys_trace_thread_suspend(struct k_thread *thread)
{
	TRACING_STRING("%s: %p\n", __func__, thread);
}

void sys_trace_thread_resume(struct k_thread *thread)
{
	TRACING_STRING("%s: %p\n", __func__, thread);
}

void sys_trace_thread_ready(struct k_thread *thread)
{
	TRACING_STRING("%s: %p\n", __func__, thread);
}

void sys_trace_thread_pend(struct k_thread *thread)
{
	TRACING_STRING("%s: %p\n", __func__, thread);
}

void sys_trace_thread_info(struct k_thread *thread)
{
	TRACING_STRING("%s: %p\n", __func__, thread);
}

void sys_trace_thread_name_set(struct k_thread *thread)
{
	TRACING_STRING("%s: %p\n", __func__, thread);
}

void sys_trace_isr_enter(void)
{
	TRACING_STRING("%s\n", __func__);
}

void sys_trace_isr_exit(void)
{
	TRACING_STRING("%s\n", __func__);
}

void sys_trace_isr_exit_to_scheduler(void)
{
	TRACING_STRING("%s\n", __func__);
}

void sys_trace_idle(void)
{
	TRACING_STRING("%s\n", __func__);
}

void sys_trace_void(unsigned int id)
{
	TRACING_STRING("%s: %d\n", __func__, id);
}

void sys_trace_end_call(unsigned int id)
{
	TRACING_STRING("%s: %d\n", __func__, id);
}

void sys_trace_semaphore_init(struct k_sem *sem)
{
	TRACING_STRING("%s: %p\n", __func__, sem);
}

void sys_trace_semaphore_take(struct k_sem *sem)
{
	TRACING_STRING("%s: %p\n", __func__, sem);
}

void sys_trace_semaphore_give(struct k_sem *sem)
{
	TRACING_STRING("%s: %p\n", __func__, sem);
}

void sys_trace_mutex_init(struct k_mutex *mutex)
{
	TRACING_STRING("%s: %p\n", __func__, mutex);
}

void sys_trace_mutex_lock(struct k_mutex *mutex)
{
	TRACING_STRING("%s: %p\n", __func__, mutex);
}

void sys_trace_mutex_unlock(struct k_mutex *mutex)
{
	TRACING_STRING("%s: %p\n", __func__, mutex);
}
```

## src/tracing_user.c
```c
/*
 * Copyright (c) 2020 Lexmark International, Inc.
 *
 * SPDX-License-Identifier: Apache-2.0
 */

#include <tracing_user.h>
#include <zephyr/kernel.h>
#include <zephyr/device.h>

static int nested_interrupts[CONFIG_MP_MAX_NUM_CPUS];

void sys_trace_thread_switched_in_user(void)
{
	unsigned int key = irq_lock();

	__ASSERT_NO_MSG(nested_interrupts[_current_cpu->id] == 0);
	/* Can't use k_current_get as thread base and z_tls_current might be incorrect */
	printk("%s: %p\n", __func__, k_sched_current_thread_query());

	irq_unlock(key);
}

void sys_trace_thread_switched_out_user(void)
{
	unsigned int key = irq_lock();

	__ASSERT_NO_MSG(nested_interrupts[_current_cpu->id] == 0);
	/* Can't use k_current_get as thread base and z_tls_current might be incorrect */
	printk("%s: %p\n", __func__, k_sched_current_thread_query());

	irq_unlock(key);
}

void sys_trace_isr_enter_user(void)
{
	unsigned int key = irq_lock();
	_cpu_t *curr_cpu = _current_cpu;

	printk("%s: %d\n", __func__, nested_interrupts[curr_cpu->id]);
	nested_interrupts[curr_cpu->id]++;

	irq_unlock(key);
}

void sys_trace_isr_exit_user(void)
{
	unsigned int key = irq_lock();
	_cpu_t *curr_cpu = _current_cpu;

	nested_interrupts[curr_cpu->id]--;
	printk("%s: %d\n", __func__, nested_interrupts[curr_cpu->id]);

	irq_unlock(key);
}

void sys_trace_k_thread_sleep_enter_user(k_timeout_t timeout)
{
	printk("%s: thread=%p timeout=%lld ticks\n", __func__,
	       k_sched_current_thread_query(), (long long)timeout.ticks);
}

void sys_trace_k_thread_sleep_exit_user(k_timeout_t timeout, int32_t ret)
{
	printk("%s: thread=%p ret=%d ms\n", __func__,
	       k_sched_current_thread_query(), ret);
}

void sys_trace_idle_user(void)
{
	printk("%s\n", __func__);
}

void sys_trace_gpio_pin_configure_enter_user(const struct device *port, gpio_pin_t pin,
					     gpio_flags_t flags)
{
	printk("port: %s, pin: %d flags: %d\n", port->name, pin, flags);
}

void sys_trace_gpio_pin_configure_exit_user(const struct device *port, gpio_pin_t pin, int ret)
{
	printk("port: %s, pin: %d ret: %d\n", port->name, pin, ret);
}

void sys_trace_gpio_port_set_bits_raw_enter_user(const struct device *port, gpio_port_pins_t pins)
{
	printk("port: %s, pins: %d\n", port->name, pins);
}

void sys_trace_gpio_port_set_bits_raw_exit_user(const struct device *port, int ret)
{
	printk("port: %s, ret: %d\n", port->name, ret);
}

void sys_trace_gpio_port_clear_bits_raw_enter_user(const struct device *port, gpio_port_pins_t pins)
{
	printk("port: %s, pins: %d\n", port->name, pins);
}

void sys_trace_gpio_port_clear_bits_raw_exit_user(const struct device *port, int ret)
{
	printk("port: %s, pins: %d\n", port->name, ret);
}

void sys_trace_gpio_pin_interrupt_configure_enter_user(const struct device *port, gpio_pin_t pin,
						       gpio_flags_t flags)
{
	printk("port: %s, pin: %d flags: %d\n", port->name, pin, flags);
}

void sys_trace_gpio_pin_interrupt_configure_exit_user(const struct device *port, gpio_pin_t pin,
						      int ret)
{
	printk("port: %s, pin: %d ret: %d\n", port->name, pin, ret);
}
```
