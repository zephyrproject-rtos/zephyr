## CMakeLists.txt
```
# SPDX-License-Identifier: Apache-2.0

cmake_minimum_required(VERSION 3.28.0)

if(BOARD MATCHES "qemu_.*")
  list(APPEND QEMU_EXTRA_FLAGS -serial file:channel0_0)
endif()

find_package(Zephyr REQUIRED HINTS $ENV{ZEPHYR_BASE})
project(tracing_tests)

include(${ZEPHYR_BASE}/samples/subsys/usb/common/common.cmake)
target_sources(app PRIVATE src/main.c)
target_sources_ifdef(CONFIG_TRACING_GPIO app PRIVATE src/gpio_main.c)
target_sources_ifdef(CONFIG_TRACING_USER app PRIVATE src/tracing_user.c)
```

## Kconfig
```
# Copyright (c) 2024 Nordic Semiconductor ASA
# SPDX-License-Identifier: Apache-2.0

# Source common USB sample options used to initialize new experimental USB
# device stack. The scope of these options is limited to USB samples in project
# tree, you cannot use them in your own application.
source "samples/subsys/usb/common/Kconfig.sample_usbd"

source "Kconfig.zephyr"
```

## prj.conf
```kconfig
# Baseline tracing configuration shared by every build of this sample.
#
# Out of the box this enables tracing with the Common Trace Format (CTF) and the
# RAM backend, which needs no dedicated transport or devicetree setup and so
# builds and runs on any board. The captured CTF stream lives in the
# "ram_tracing" buffer and is retrieved with a debugger (see the README).
#
# To stream the trace over a transport, or to use a different format, add one of
# the prj_*.conf overlays on top of this baseline, for example:
#
#   west build -b <board> samples/subsys/tracing -- -DEXTRA_CONF_FILE=prj_uart.conf
#
# The overlays only contain the options that differ from this baseline.

# enable to use thread names
CONFIG_THREAD_NAME=y
CONFIG_MP_MAX_NUM_CPUS=1
CONFIG_DEBUG_THREAD_INFO=y

CONFIG_TRACING=y
CONFIG_TRACING_CTF=y
CONFIG_TRACING_BUFFER_SIZE=4096
CONFIG_TRACING_BACKEND_SEMIHOST=y
CONFIG_TRACING_SYNC=y
CONFIG_DEBUG_OPTIMIZATIONS=n
CONFIG_SEMIHOST=y
```

## prj_gpio.conf
```kconfig
# Overlay: "user" format focused on the GPIO tracing hooks.
# Applied on top of prj.conf with EXTRA_CONF_FILE=prj_gpio.conf. Selecting the
# user format here overrides the CTF format from the baseline. Thread tracing is
# turned off to keep the GPIO events easy to read on the console.
CONFIG_GPIO=y
CONFIG_GPIO_GET_CONFIG=y
CONFIG_TRACING_USER=y
CONFIG_TRACING_GPIO=y
CONFIG_TRACING_THREAD=n
```

## prj_native_ctf.conf
```kconfig
# Overlay: CTF written to a file by the native (POSIX) backend.
# Applied on top of prj.conf with EXTRA_CONF_FILE=prj_native_ctf.conf.
CONFIG_TRACING_SYNC=y
CONFIG_TRACING_BACKEND_POSIX=y
CONFIG_TRACING_PACKET_MAX_SIZE=64
```

## prj_percepio.conf
```kconfig
# Overlay: Percepio Tracealyzer recorder (requires the percepio module).
# Applied on top of prj.conf with EXTRA_CONF_FILE=prj_percepio.conf. Selecting
# the Percepio recorder here overrides the CTF format from the baseline.
CONFIG_PERCEPIO_TRACERECORDER=y
```

## prj_ram.conf
```kconfig
# Overlay: CTF stream buffered in RAM, dumped with a debugger.
# Applied on top of prj.conf with EXTRA_CONF_FILE=prj_ram.conf.
CONFIG_TRACING_BACKEND_RAM=y
CONFIG_SEMIHOST=n
```

## prj_uart.conf
```kconfig
# Overlay: "test" format streamed over a dedicated UART.
# Applied on top of prj.conf with EXTRA_CONF_FILE=prj_uart.conf.
CONFIG_IDLE_STACK_SIZE=4096
CONFIG_TRACING_TEST=y
CONFIG_TRACING_BACKEND_UART=y
```

## prj_uart_ctf.conf
```kconfig
# Overlay: CTF stream over a dedicated UART (CTF comes from the baseline).
# Applied on top of prj.conf with EXTRA_CONF_FILE=prj_uart_ctf.conf.
CONFIG_TRACING_BACKEND_UART=y
```

## gpio.overlay
```dts
/*
 * Copyright (c) 2024 Tenstorrent AI ULC
 *
 * SPDX-License-Identifier: Apache-2.0
 */

/ {
	gpio_emul: gpio_emul {
		compatible = "zephyr,gpio-emul";
		rising-edge;
		falling-edge;
		high-level;
		low-level;
		gpio-controller;
		#gpio-cells = <0x2>;
		phandle = <0x1>;
		status = "okay";
	};
};
```

## src/main.c
```c
/*
 * Copyright (c) 2019 Intel Corporation
 * Copyright (c) 2012-2014 Wind River Systems, Inc.
 *
 * SPDX-License-Identifier: Apache-2.0
 */

#include <zephyr/kernel.h>
#include <zephyr/sys/printk.h>
#include <zephyr/logging/log.h>
#include <sample_usbd.h>
#include <zephyr/tracing/tracing.h>

/*
 * Tracing demonstration.
 *
 * This sample exercises a representative cross-section of the kernel so that,
 * regardless of which tracing format and backend are selected at build time, a
 * rich and continuous stream of trace events is produced for visualization on
 * the host:
 *
 *   - Two threads (one static, one dynamic) ping-pong "Hello World" greetings,
 *     synchronising with a pair of semaphores. This keeps generating thread
 *     switch, sleep and semaphore give/take events for as long as the sample
 *     runs.
 *   - On start-up, a one-shot workload drives a mutex, the system work queue
 *     and a kernel timer so that those objects' lifecycle events also appear in
 *     the trace.
 *   - sys_trace_named_event() is used throughout to emit custom, application
 *     defined events (a short name plus two 32-bit arguments). Named events are
 *     the primary way to annotate a trace from application code. Note that some
 *     backends truncate the name (CTF keeps the first 19 characters).
 *
 * The README lists the supported formats (CTF, SystemView, Percepio and the
 * "test" and "user" formats) and backends (UART, USB, POSIX/native, RAM, ...)
 * and explains how to capture and decode the output for each.
 */

/* size of stack area used by each thread */
#define STACKSIZE 2048

/* scheduling priority used by each thread */
#define PRIORITY 7

/* delay between greetings (in ms) */
#define SLEEPTIME 500

static uint32_t counter;

/*
 * Objects exercised once at start-up by run_tracing_workload(). Each kernel
 * primitive emits its own sys_port_trace_* events automatically; defining a
 * spread of object types here means more of those event families show up in
 * the captured trace.
 */

K_MUTEX_DEFINE(demo_mutex);

K_SEM_DEFINE(work_done, 0, 1);

static void demo_work_handler(struct k_work *work)
{
	ARG_UNUSED(work);

	/* Runs in the system work queue thread context. */
	sys_trace_named_event("work_run", 0, 0);
	k_sem_give(&work_done);
}
K_WORK_DEFINE(demo_work, demo_work_handler);

static void demo_timer_handler(struct k_timer *timer)
{
	ARG_UNUSED(timer);

	/* Runs in the system clock (timer) interrupt context. */
	sys_trace_named_event("timer_fired", 0, 0);
}
K_TIMER_DEFINE(demo_timer, demo_timer_handler, NULL);

/*
 * Drive a handful of kernel primitives once at start-up. The named events
 * bracket each phase so the activity is easy to locate in the captured trace,
 * while the underlying mutex/work/timer calls generate the corresponding
 * kernel object trace events.
 */
static void run_tracing_workload(void)
{
	sys_trace_named_event("workload_start", 0, 0);

	/* Mutex: lock then unlock. */
	k_mutex_lock(&demo_mutex, K_FOREVER);
	sys_trace_named_event("mutex_locked", 0, 0);
	k_mutex_unlock(&demo_mutex);

	/* System work queue: submit a work item and wait for it to run. */
	k_work_submit(&demo_work);
	k_sem_take(&work_done, K_FOREVER);

	/* Timer: arm a one-shot timer and wait for it to expire. */
	k_timer_start(&demo_timer, K_MSEC(10), K_NO_WAIT);
	k_timer_status_sync(&demo_timer);

	sys_trace_named_event("workload_done", 0, 0);
}

/*
 * @param my_name      thread identification string
 * @param my_sem       thread's own semaphore
 * @param other_sem    other thread's semaphore
 */
void helloLoop(const char *my_name,
	       struct k_sem *my_sem, struct k_sem *other_sem)
{
	const char *tname;

	while (1) {
		/* take my semaphore */
		k_sem_take(my_sem, K_FOREVER);

		/* Emit a named event carrying the running counter value. */
		sys_trace_named_event("counter_value", counter, 0);
		counter++;

		/* say "hello" */
		tname = k_thread_name_get(k_current_get());
		if (tname == NULL) {
			printk("%s: Hello World from %s!\n",
				my_name, CONFIG_BOARD);
		} else {
			printk("%s: Hello World from %s!\n",
				tname, CONFIG_BOARD);
		}

		/* wait a while, then let other thread have a turn */
		k_msleep(SLEEPTIME);
		k_sem_give(other_sem);
	}
}

/* define semaphores */

K_SEM_DEFINE(threadA_sem, 1, 1);	/* starts off "available" */
K_SEM_DEFINE(threadB_sem, 0, 1);	/* starts off "not available" */


/* threadB is a dynamic thread that is spawned by threadA */

void threadB(void *dummy1, void *dummy2, void *dummy3)
{
	ARG_UNUSED(dummy1);
	ARG_UNUSED(dummy2);
	ARG_UNUSED(dummy3);

	/* invoke routine to ping-pong hello messages with threadA */
	helloLoop(__func__, &threadB_sem, &threadA_sem);
}

K_THREAD_STACK_DEFINE(threadB_stack_area, STACKSIZE);
static struct k_thread threadB_data;

/* threadA is a static thread that is spawned automatically */

void threadA(void *dummy1, void *dummy2, void *dummy3)
{
	ARG_UNUSED(dummy1);
	ARG_UNUSED(dummy2);
	ARG_UNUSED(dummy3);

#if defined(CONFIG_USB_DEVICE_STACK_NEXT)
	struct usbd_context *sample_usbd = sample_usbd_init_device(NULL);

	if (sample_usbd == NULL) {
		printk("Failed to initialize USB device");
		return;
	}

	if (usbd_enable(sample_usbd)) {
		printk("usb backend enable failed");
		return;
	}
#endif /* CONFIG_USB_DEVICE_STACK_NEXT */

	/* exercise a spread of kernel primitives once, for the trace */
	run_tracing_workload();

	/* spawn threadB */
	k_tid_t tid = k_thread_create(&threadB_data, threadB_stack_area,
			STACKSIZE, threadB, NULL, NULL, NULL,
			PRIORITY, 0, K_NO_WAIT);

	k_thread_name_set(tid, "thread_b");

	/* invoke routine to ping-pong hello messages with threadB */
	helloLoop(__func__, &threadA_sem, &threadB_sem);
}

K_THREAD_DEFINE(thread_a, STACKSIZE, threadA, NULL, NULL, NULL,
		PRIORITY, 0, 0);
```

## src/tracing_user.c
```c
/*
 * Copyright (c) 2020 Lexmark International, Inc.
 *
 * SPDX-License-Identifier: Apache-2.0
 */

#include <tracing_user.h>
#include <zephyr/kernel.h>
#include <zephyr/device.h>

static int nested_interrupts[CONFIG_MP_MAX_NUM_CPUS];

/*
 * Thread lifecycle hooks. These weak functions are called by the kernel when a
 * thread is created, named, suspended, resumed or aborted. An application using
 * the "user" tracing format implements them to record or forward the events
 * however it wants; here we simply print them.
 */
void sys_trace_thread_create_user(struct k_thread *thread)
{
	printk("%s: %p\n", __func__, thread);
}

void sys_trace_thread_name_set_user(struct k_thread *thread)
{
	printk("%s: %p (%s)\n", __func__, thread, k_thread_name_get(thread));
}

void sys_trace_thread_suspend_user(struct k_thread *thread)
{
	printk("%s: %p\n", __func__, thread);
}

void sys_trace_thread_resume_user(struct k_thread *thread)
{
	printk("%s: %p\n", __func__, thread);
}

void sys_trace_thread_abort_user(struct k_thread *thread)
{
	printk("%s: %p\n", __func__, thread);
}

void sys_trace_thread_switched_in_user(void)
{
	unsigned int key = irq_lock();

	__ASSERT_NO_MSG(nested_interrupts[_current_cpu->id] == 0);
	/* Can't use k_current_get as thread base and z_tls_current might be incorrect */
	printk("%s: %p\n", __func__, k_sched_current_thread_query());

	irq_unlock(key);
}

void sys_trace_thread_switched_out_user(void)
{
	unsigned int key = irq_lock();

	__ASSERT_NO_MSG(nested_interrupts[_current_cpu->id] == 0);
	/* Can't use k_current_get as thread base and z_tls_current might be incorrect */
	printk("%s: %p\n", __func__, k_sched_current_thread_query());

	irq_unlock(key);
}

void sys_trace_isr_enter_user(void)
{
	unsigned int key = irq_lock();
	_cpu_t *curr_cpu = _current_cpu;

	printk("%s: %d\n", __func__, nested_interrupts[curr_cpu->id]);
	nested_interrupts[curr_cpu->id]++;

	irq_unlock(key);
}

void sys_trace_isr_exit_user(void)
{
	unsigned int key = irq_lock();
	_cpu_t *curr_cpu = _current_cpu;

	nested_interrupts[curr_cpu->id]--;
	printk("%s: %d\n", __func__, nested_interrupts[curr_cpu->id]);

	irq_unlock(key);
}

void sys_trace_k_thread_sleep_enter_user(k_timeout_t timeout)
{
	printk("%s: thread=%p timeout=%lld ticks\n", __func__,
	       k_sched_current_thread_query(), (long long)timeout.ticks);
}

void sys_trace_k_thread_sleep_exit_user(k_timeout_t timeout, int32_t ret)
{
	printk("%s: thread=%p ret=%d ms\n", __func__,
	       k_sched_current_thread_query(), ret);
}

void sys_trace_idle_user(void)
{
	printk("%s\n", __func__);
}

void sys_trace_gpio_pin_configure_enter_user(const struct device *port, gpio_pin_t pin,
					     gpio_flags_t flags)
{
	printk("port: %s, pin: %d flags: %d\n", port->name, pin, flags);
}

void sys_trace_gpio_pin_configure_exit_user(const struct device *port, gpio_pin_t pin, int ret)
{
	printk("port: %s, pin: %d ret: %d\n", port->name, pin, ret);
}

void sys_trace_gpio_port_set_bits_raw_enter_user(const struct device *port, gpio_port_pins_t pins)
{
	printk("port: %s, pins: %d\n", port->name, pins);
}

void sys_trace_gpio_port_set_bits_raw_exit_user(const struct device *port, int ret)
{
	printk("port: %s, ret: %d\n", port->name, ret);
}

void sys_trace_gpio_port_clear_bits_raw_enter_user(const struct device *port, gpio_port_pins_t pins)
{
	printk("port: %s, pins: %d\n", port->name, pins);
}

void sys_trace_gpio_port_clear_bits_raw_exit_user(const struct device *port, int ret)
{
	printk("port: %s, pins: %d\n", port->name, ret);
}

void sys_trace_gpio_pin_interrupt_configure_enter_user(const struct device *port, gpio_pin_t pin,
						       gpio_flags_t flags)
{
	printk("port: %s, pin: %d flags: %d\n", port->name, pin, flags);
}

void sys_trace_gpio_pin_interrupt_configure_exit_user(const struct device *port, gpio_pin_t pin,
						      int ret)
{
	printk("port: %s, pin: %d ret: %d\n", port->name, pin, ret);
}
```
