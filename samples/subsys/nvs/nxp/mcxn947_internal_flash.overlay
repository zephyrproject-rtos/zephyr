/*
 * Copyright 2025 NXP
 *
 * SPDX-License-Identifier: Apache-2.0
 */

/* The MCXN947 boards place the storage_partition in external flash.  For this
 * testcase, move the storage_partition to internal flash
 */

/delete-node/ &storage_partition;

&flash {
	partitions {
		storage_partition: partition@100000 {
			label = "storage";
			reg = <0x100000 DT_SIZE_M(1)>;
		};
	};
};
