/*
 * Copyright (c) 2023 STMicroelectronics
 *
 * SPDX-License-Identifier: Apache-2.0
 */

/delete-node/ &storage_partition;

&flash0 {
	partitions {
		/* Set 6KB of storage at the end of 128KB flash */
		storage_partition: partition@1e800 {
			label = "storage";
			reg = <0x0001e800 DT_SIZE_K(6)>;
		};
	};
};
