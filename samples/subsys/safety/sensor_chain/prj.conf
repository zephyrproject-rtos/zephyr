## CMakeLists.txt
```
# SPDX-License-Identifier: Apache-2.0

cmake_minimum_required(VERSION 3.20.0)

find_package(Zephyr REQUIRED HINTS $ENV{ZEPHYR_BASE})
project(safety_test_sensor_chain)

target_sources(app PRIVATE
  src/main.c
  src/safe_state.c
  src/tests_platform.c
  src/tests_sensor.c
)
```

## Kconfig
```
# Copyright (c) 2026 Aerlync Labs Inc.
# SPDX-License-Identifier: Apache-2.0

menu "Safety test sensor chain sample"

choice SAMPLE_SAFE_STATE_ACTION
	prompt "What the safe-state handler returns after a critical failure"
	default SAMPLE_SAFE_STATE_ACTION_CONTINUE
	help
	  The sample overrides safety_test_safe_state(), so the subsystem's own
	  SAFETY_TEST_DEFAULT_ACTION_* choice does not apply here. This is what
	  the override returns.

config SAMPLE_SAFE_STATE_ACTION_CONTINUE
	bool "Continue"
	help
	  Log the failure and carry on. With CONFIG_SAFETY_TEST_STRICT_CRITICAL
	  set the subsystem refuses this and halts instead, which is the pairing
	  that shows what strict mode is for: one source tree, two behaviours,
	  selected by configuration alone.

config SAMPLE_SAFE_STATE_ACTION_RESET
	bool "Reboot"
	select REBOOT
	help
	  Cold reboot. Two reasons to prefer this over halting. The board stays
	  recoverable, which matters on targets where a halted core cannot be
	  restarted with the RESET button. And the subsystem does not clear its
	  __noinit failure record on this path, so the next boot can report what
	  went wrong, which halting cannot do if you have to pull the power.

	  Expect a boot loop if the failure is still present after the reboot.

config SAMPLE_SAFE_STATE_ACTION_HALT
	bool "Halt"
	help
	  Stop the CPU where it stands. Most faithful to a production safe state,
	  but on some boards a halted target needs a power cycle rather than a
	  press of RESET.

endchoice

config SAMPLE_TEMP_MIN_MC
	int "Lower plausibility bound, millidegrees Celsius"
	default 10000
	help
	  A reading below this fails sensor_plausible. The default assumes an
	  indoor bench.

config SAMPLE_TEMP_MAX_MC
	int "Upper plausibility bound, millidegrees Celsius"
	default 35000
	help
	  A reading above this fails sensor_plausible. Sustained finger contact
	  on the package is enough to cross the default.

config SAMPLE_CLOCK_TOLERANCE_PCT
	int "clock_xcheck tolerance, percent"
	default 10
	range 1 50
	help
	  How far the LPTMR's measured rate may sit from its nominal rate before
	  clock_xcheck fails. The default is a placeholder that avoids false
	  failures; set it from the FRO16K accuracy figure in the datasheet
	  before relying on this test.

config SAMPLE_CLOCK_WINDOW_MS
	int "clock_xcheck measurement window, milliseconds"
	default 10
	range 1 1000
	help
	  Longer windows reduce quantization error. 10 ms yields roughly 160
	  LPTMR ticks, so one tick is about 0.6%.

config SAMPLE_IMAGE_CRC
	hex "Expected CRC-32 of the text region"
	default 0
	help
	  Supplied by the second pass of the two-pass build; see the README.
	  Left at 0, flash_integrity reports -ENODATA rather than a false
	  mismatch, so a single-pass build fails honestly instead of silently.

config SAMPLE_RUNTIME_PERIOD_MS
	int "Runtime loop period, milliseconds"
	default 2000

endmenu

source "Kconfig.zephyr"
```

## prj.conf
```kconfig
CONFIG_SAFETY_TEST=y
CONFIG_SAFETY_TEST_EARLY_TESTS=y
CONFIG_SAFETY_TEST_STRICT_CRITICAL=n

CONFIG_SENSOR=y
CONFIG_COUNTER=y
CONFIG_GPIO=y

# flash_integrity (src/tests_platform.c) calls crc32_ieee().
CONFIG_CRC=y

# Force the software CRC. The board sets /chosen zephyr,crc, which makes
# CRC_HW_HANDLER default y, and subsys/crc/crc_hardware.c then provides strong
# crc32_ieee() symbols that override the __weak software ones. Those route
# through the CRC peripheral, a POST_KERNEL device -- but flash_integrity runs
# at PRE_KERNEL_1, before it exists.
CONFIG_CRC_HW_HANDLER=n

CONFIG_LOG=y
CONFIG_PRINTK=y
```

## strict.conf
```kconfig
# Refuse SAFETY_TEST_ACTION_CONTINUE for critical tests, so warming the sensor
# halts the board instead of logging and carrying on.
CONFIG_SAFETY_TEST_STRICT_CRITICAL=y
```

## boards/frdm_mcxa156.overlay
```dts
/*
 * Copyright (c) 2026 Aerlync Labs Inc.
 *
 * SPDX-License-Identifier: Apache-2.0
 */

/ {
	aliases {
		clock-ref = &lptmr0;
	};
};
```

## src/main.c
```c
/*
 * Copyright (c) 2026 Aerlync Labs Inc.
 *
 * SPDX-License-Identifier: Apache-2.0
 */

#include <errno.h>

#include <zephyr/kernel.h>
#include <zephyr/drivers/gpio.h>
#include <zephyr/safety/safety_test.h>
#include <zephyr/sys/printk.h>
#include <zephyr/sys/util.h>

#include "sample_common.h"

/* Every category, so the sweep visits every registered test. */
#define ALL_CATEGORIES (BIT(SAFETY_TEST_CAT_COUNT) - 1U)

static const struct gpio_dt_spec ok_led = GPIO_DT_SPEC_GET(DT_ALIAS(led1), gpios);
static const struct gpio_dt_spec beat_led = GPIO_DT_SPEC_GET(DT_ALIAS(led2), gpios);

static const char *result_str(enum safety_test_result result)
{
	switch (result) {
	case SAFETY_TEST_RESULT_PASS:
		return "PASS";
	case SAFETY_TEST_RESULT_FAIL:
		return "FAIL";
	case SAFETY_TEST_RESULT_SKIP:
		return "SKIP";
	default:
		return "NOT-RUN";
	}
}

static const char *level_str(enum safety_test_init_level level)
{
	switch (level) {
	case SAFETY_TEST_LEVEL_EARLY:
		return "EARLY";
	case SAFETY_TEST_LEVEL_PRE_KERNEL_1:
		return "PRE_KERNEL_1";
	case SAFETY_TEST_LEVEL_PRE_KERNEL_2:
		return "PRE_KERNEL_2";
	case SAFETY_TEST_LEVEL_POST_KERNEL:
		return "POST_KERNEL";
	default:
		return "APPLICATION";
	}
}

static bool print_one(const struct safety_test *test, void *user_data)
{
	ARG_UNUSED(user_data);

	printk("  %-18s %-13s %-8s %7u us%s\n", test->name, level_str(test->init_level),
	       result_str(test->result->result), test->result->duration_us,
	       test->result->over_budget ? "  OVER-BUDGET" : "");

	return true;
}

static void report_boot(void)
{
	struct safety_test_summary summary;
	bool passed = false;
	int ret;

	/*
	 * ram_march leaves the block zeroed, so the count is already 0 after a
	 * normal boot. Reset anyway: the block is __noinit and holds garbage if
	 * the march was configured out.
	 */
	sample_history_reset();

	printk("\nsafety_test sensor chain sample\n");
	printk("boot results:\n");
	safety_test_foreach(print_one, NULL);

	ret = safety_test_get_summary(&summary);
	if (ret == 0) {
		printk("boot summary: %u total, %u passed, %u failed, %u skipped, %u not run\n",
		       summary.global.total, summary.global.passed, summary.global.failed,
		       summary.global.skipped, summary.global.not_run);
	}

	ret = safety_test_boot_passed(&passed);
	if (ret == -ENOENT) {
		printk("boot chain: NONE (no critical boot test registered)\n");
	} else if (ret == 0) {
		printk("boot chain: %s\n", passed ? "PASS" : "FAIL");
	} else {
		printk("boot chain: error %d\n", ret);
	}

	if (gpio_is_ready_dt(&ok_led)) {
		(void)gpio_pin_configure_dt(&ok_led,
					    passed ? GPIO_OUTPUT_ACTIVE : GPIO_OUTPUT_INACTIVE);
	}

	if (gpio_is_ready_dt(&beat_led)) {
		(void)gpio_pin_configure_dt(&beat_led, GPIO_OUTPUT_INACTIVE);
	}
}

int main(void)
{
	uint32_t cycle = 0U;

	report_boot();

	while (1) {
		struct safety_test_stats stats;

		cycle++;

		if (gpio_is_ready_dt(&beat_led)) {
			(void)gpio_pin_toggle_dt(&beat_led);
		}

		(void)safety_test_run_category(ALL_CATEGORIES, &stats);

		sample_history_append(sample_sensor_last_mc());

		printk("cycle %u: %u visited, %u passed, %u failed, %u skipped, "
		       "%u over budget, temp %d mC, history %u%s\n",
		       cycle, stats.total, stats.passed, stats.failed, stats.skipped,
		       stats.over_budget, sample_sensor_last_mc(), sample_history_count(),
		       sample_fault_latched() ? ", FAULT LATCHED" : "");

		k_msleep(CONFIG_SAMPLE_RUNTIME_PERIOD_MS);
	}

	return 0;
}
```

## src/safe_state.c
```c
/*
 * Copyright (c) 2026 Aerlync Labs Inc.
 *
 * SPDX-License-Identifier: Apache-2.0
 */

#include <zephyr/kernel.h>
#include <zephyr/drivers/gpio.h>
#include <zephyr/logging/log.h>
#include <zephyr/safety/safety_test.h>
#include <zephyr/sys/atomic.h>

#include "sample_common.h"

LOG_MODULE_REGISTER(sample_safe_state, LOG_LEVEL_INF);

static const struct gpio_dt_spec fault_led = GPIO_DT_SPEC_GET(DT_ALIAS(led0), gpios);
static atomic_t fault_flag;

bool sample_fault_latched(void)
{
	return atomic_get(&fault_flag) != 0;
}

static void light_fault_led(void)
{
	/*
	 * A boot-level failure can arrive before the GPIO driver exists, so the
	 * LED is best effort. Driving it unconditionally would fault inside the
	 * failure path, which is the worst place to fault.
	 */
	if (gpio_is_ready_dt(&fault_led)) {
		(void)gpio_pin_configure_dt(&fault_led, GPIO_OUTPUT_ACTIVE);
	}
}

static void on_failure(const struct safety_test_context *ctx,
		       const struct safety_test_result_record *rec)
{
	atomic_set(&fault_flag, 1);

	/* What a hook may do depends on the level the test ran at. */
	switch (ctx->init_level) {
	case SAFETY_TEST_LEVEL_EARLY:
	case SAFETY_TEST_LEVEL_PRE_KERNEL_1:
		/* No system timer, so no logging. The flag above is all we get. */
		break;
	case SAFETY_TEST_LEVEL_PRE_KERNEL_2:
		/* Logging works from here, but no driver has initialised yet. */
		LOG_ERR("test '%s' failed with %d after %u us", ctx->test->name,
			rec->error_code, rec->duration_us);
		break;
	default:
		LOG_ERR("test '%s' failed with %d after %u us", ctx->test->name,
			rec->error_code, rec->duration_us);
		light_fault_led();
		break;
	}
}

SAFETY_TEST_FAILURE_HOOK_DEFINE(sample_fault_hook, on_failure);

static enum safety_test_action configured_action(void)
{
	if (IS_ENABLED(CONFIG_SAMPLE_SAFE_STATE_ACTION_RESET)) {
		return SAFETY_TEST_ACTION_RESET;
	}

	if (IS_ENABLED(CONFIG_SAMPLE_SAFE_STATE_ACTION_HALT)) {
		return SAFETY_TEST_ACTION_HALT;
	}

	return SAFETY_TEST_ACTION_CONTINUE;
}

static const char *action_name(enum safety_test_action action)
{
	switch (action) {
	case SAFETY_TEST_ACTION_RESET:
		return "RESET";
	case SAFETY_TEST_ACTION_CONTINUE:
		return "CONTINUE";
	default:
		return "HALT";
	}
}

enum safety_test_action safety_test_safe_state(const struct safety_test_context *ctx,
					       const struct safety_test_result_record *rec)
{
	enum safety_test_action action = configured_action();

	ARG_UNUSED(rec);

	light_fault_led();

	/*
	 * What the board actually does is not decided here alone. With
	 * CONFIG_SAFETY_TEST_STRICT_CRITICAL set the subsystem refuses a
	 * CONTINUE and halts instead, so the same source produces two
	 * behaviours from configuration alone.
	 */
	if (safety_test_can_log(ctx->init_level)) {
		LOG_ERR("safe state reached for '%s', returning %s", ctx->test->name,
			action_name(action));
	}

	return action;
}
```

## src/sample_common.h
```c
/*
 * Copyright (c) 2026 Aerlync Labs Inc.
 *
 * SPDX-License-Identifier: Apache-2.0
 */

#ifndef SAFETY_TEST_SENSOR_CHAIN_SAMPLE_COMMON_H_
#define SAFETY_TEST_SENSOR_CHAIN_SAMPLE_COMMON_H_

#include <stdbool.h>
#include <stdint.h>

/** True once any test has failed. Set by the failure hook, never cleared. */
bool sample_fault_latched(void);

/** Temperature samples held in the scratch block. */
#define SAMPLE_HISTORY_LEN 16U

/** Record a reading, in millidegrees Celsius. */
void sample_history_append(int32_t temp_mc);

/** Readings recorded since the last reset. */
uint32_t sample_history_count(void);

/** Discard recorded readings. */
void sample_history_reset(void);

/** Most recent temperature in millidegrees Celsius, or 0 before the first read. */
int32_t sample_sensor_last_mc(void);

#endif /* SAFETY_TEST_SENSOR_CHAIN_SAMPLE_COMMON_H_ */
```

## src/tests_platform.c
```c
/*
 * Copyright (c) 2026 Aerlync Labs Inc.
 *
 * SPDX-License-Identifier: Apache-2.0
 */

#include <errno.h>
#include <stdint.h>

#include <zephyr/device.h>
#include <zephyr/drivers/counter.h>
#include <zephyr/kernel.h>
#include <zephyr/linker/linker-defs.h>
#include <zephyr/safety/safety_test.h>
#include <zephyr/sys/clock.h>
#include <zephyr/sys/crc.h>
#include <zephyr/toolchain.h>

#include "sample_common.h"

/*
 * Operands are volatile so the compiler cannot fold these expressions into
 * their answers at build time, which would leave the test checking nothing.
 */
static int cpu_core_run(const struct safety_test_context *ctx)
{
	volatile uint32_t a = 0xA5A5A5A5U;
	volatile uint32_t b = 0x5A5A5A5AU;
	volatile uint32_t m = 0x00010001U;
	volatile int32_t s = -12345;

	ARG_UNUSED(ctx);

	if ((a | b) != 0xFFFFFFFFU) {
		return -EIO;
	}

	if ((a & b) != 0U) {
		return -EIO;
	}

	if ((a ^ b) != 0xFFFFFFFFU) {
		return -EIO;
	}

	if ((uint32_t)~a != 0x5A5A5A5AU) {
		return -EIO;
	}

	if ((a + b) != 0xFFFFFFFFU) {
		return -EIO;
	}

	if ((b - a) != 0xB4B4B4B5U) {
		return -EIO;
	}

	if ((a >> 4) != 0x0A5A5A5AU) {
		return -EIO;
	}

	if ((a << 4) != 0x5A5A5A50U) {
		return -EIO;
	}

	if ((m * m) != 0x00020001U) {
		return -EIO;
	}

	if ((a / 3U) != 0x37373737U) {
		return -EIO;
	}

	if ((s / 100) != -123) {
		return -EIO;
	}

	if ((s % 100) != -45) {
		return -EIO;
	}

	return 0;
}

SAFETY_TEST_DEFINE(cpu_core, SAFETY_TEST_CAT_CPU, SAFETY_TEST_LEVEL_EARLY, 10,
		   SAFETY_TEST_FLAG_BOOT_OK | SAFETY_TEST_FLAG_RUNTIME_OK |
			   SAFETY_TEST_FLAG_CRITICAL,
		   cpu_core_run, "CPU data path check");

#define SAMPLE_SCRATCH_WORDS 256U

struct sample_scratch {
	int32_t history_mc[SAMPLE_HISTORY_LEN];
	uint32_t history_count;
	uint32_t filler[SAMPLE_SCRATCH_WORDS - SAMPLE_HISTORY_LEN - 1U];
};

/*
 * __noinit so the march is not fighting the C runtime over the same memory, and
 * so it can run at PRE_KERNEL_2 without destroying initialised data.
 */
static __noinit struct sample_scratch scratch;

BUILD_ASSERT(sizeof(scratch) == SAMPLE_SCRATCH_WORDS * sizeof(uint32_t),
	     "scratch block must be a whole number of words");

void sample_history_append(int32_t temp_mc)
{
	scratch.history_mc[scratch.history_count % SAMPLE_HISTORY_LEN] = temp_mc;
	scratch.history_count++;
}

uint32_t sample_history_count(void)
{
	return scratch.history_count;
}

void sample_history_reset(void)
{
	scratch.history_count = 0U;
}

/*
 * March C-: w0 / r0w1 / r1w0 up, r0w1 / r1w0 down, r0 up. Detects stuck-at,
 * transition and coupling faults. The pointer is volatile so the read-backs
 * survive optimisation; without it the compiler removes the entire test.
 */
static int march_c_minus(volatile uint32_t *base, size_t words)
{
	size_t i;

	for (i = 0U; i < words; i++) {
		base[i] = 0U;
	}

	for (i = 0U; i < words; i++) {
		if (base[i] != 0U) {
			return -EIO;
		}
		base[i] = UINT32_MAX;
	}

	for (i = 0U; i < words; i++) {
		if (base[i] != UINT32_MAX) {
			return -EIO;
		}
		base[i] = 0U;
	}

	for (i = words; i-- > 0U;) {
		if (base[i] != 0U) {
			return -EIO;
		}
		base[i] = UINT32_MAX;
	}

	for (i = words; i-- > 0U;) {
		if (base[i] != UINT32_MAX) {
			return -EIO;
		}
		base[i] = 0U;
	}

	for (i = 0U; i < words; i++) {
		if (base[i] != 0U) {
			return -EIO;
		}
	}

	return 0;
}

/*
 * The region comes from user_data rather than being hard coded, so one test
 * function can cover several regions: each is another registration, not another
 * copy of the march.
 */
struct ram_region {
	volatile uint32_t *base;
	size_t words;
};

static const struct ram_region scratch_region = {
	.base = (volatile uint32_t *)&scratch,
	.words = SAMPLE_SCRATCH_WORDS,
};

static int ram_march_run(const struct safety_test_context *ctx)
{
	const struct ram_region *region = ctx->user_data;

	return march_c_minus(region->base, region->words);
}

SAFETY_TEST_DEFINE_EX(ram_march, SAFETY_TEST_CAT_RAM, SAFETY_TEST_LEVEL_PRE_KERNEL_2, 10,
		      SAFETY_TEST_FLAG_BOOT_OK | SAFETY_TEST_FLAG_RUNTIME_OK |
			      SAFETY_TEST_FLAG_DESTRUCTIVE,
		      ram_march_run, "March C- over the sample's scratch RAM",
		      &scratch_region, 2000);
/*
 * Expected CRC-32 of the text region, supplied by the second build pass (see
 * README). It lives in .rodata, which sits outside the region it describes, so
 * writing the value back cannot change the bytes being checked (that is what
 * makes the two passes converge with no iteration and no binary patching).
 */
static volatile const uint32_t sample_text_crc = CONFIG_SAMPLE_IMAGE_CRC;

static int flash_integrity_run(const struct safety_test_context *ctx)
{
	const uint8_t *start = (const uint8_t *)__text_region_start;
	const uint8_t *end = (const uint8_t *)__text_region_end;
	uint32_t crc;

	ARG_UNUSED(ctx);

	/* First pass: nothing to compare against yet. Distinct from a mismatch. */
	if (sample_text_crc == 0U) {
		return -ENODATA;
	}

	/*
	 * One contiguous span. The image is XIP, so this is a plain memory read
	 * needing no flash driver, which is what makes PRE_KERNEL_1 viable.
	 */
	crc = crc32_ieee(start, (size_t)(end - start));

	if (crc != sample_text_crc) {
		return -EILSEQ;
	}

	return 0;
}

SAFETY_TEST_DEFINE(flash_integrity, SAFETY_TEST_CAT_FLASH, SAFETY_TEST_LEVEL_PRE_KERNEL_1, 10,
		   SAFETY_TEST_FLAG_BOOT_OK | SAFETY_TEST_FLAG_RUNTIME_OK,
		   flash_integrity_run, "CRC-32 over the text region");

static const struct device *const clock_ref = DEVICE_DT_GET(DT_ALIAS(clock_ref));

/*
 * The POST_KERNEL sweep runs at CONFIG_SAFETY_TEST_INIT_PRIORITY; the counter
 * driver initialises at CONFIG_COUNTER_INIT_PRIORITY. The whole test depends on
 * the second happening first, so break the build if anyone changes either.
 */
BUILD_ASSERT(CONFIG_SAFETY_TEST_INIT_PRIORITY > CONFIG_COUNTER_INIT_PRIORITY,
	     "the safety sweep must run after the counter driver initialises");

/*
 * Compares the counter's own oscillator against the main clock.
 *
 * The reference is not precise, so this catches gross faults only and is not
 * frequency calibration.
 */
static int clock_xcheck_run(const struct safety_test_context *ctx)
{
	uint32_t t0, t1, ticks, top, nominal_hz, observed_hz, delta;
	uint64_t c0, c1, elapsed_us;
	int ret;

	ARG_UNUSED(ctx);

	if (!device_is_ready(clock_ref)) {
		return -ENODEV;
	}

	if (!counter_is_counting_up(clock_ref)) {
		return -ENOTSUP;
	}

	ret = counter_start(clock_ref);
	if (ret < 0 && ret != -EALREADY) {
		return ret;
	}

	ret = counter_get_value(clock_ref, &t0);
	if (ret < 0) {
		return ret;
	}
	c0 = k_cycle_get_64();

	k_msleep(CONFIG_SAMPLE_CLOCK_WINDOW_MS);

	ret = counter_get_value(clock_ref, &t1);
	if (ret < 0) {
		return ret;
	}
	c1 = k_cycle_get_64();

	elapsed_us = k_cyc_to_us_floor64(c1 - c0);
	if (elapsed_us == 0U) {
		return -EIO;
	}

	top = counter_get_top_value(clock_ref);
	ticks = (t1 >= t0) ? (t1 - t0) : (top - t0 + t1 + 1U);
	if (ticks == 0U) {
		/* A reference that never moved is exactly what this test is for. */
		return -ENOTCONN;
	}

	nominal_hz = counter_get_frequency(clock_ref);
	if (nominal_hz == 0U) {
		return -EIO;
	}

	observed_hz = (uint32_t)(((uint64_t)ticks * USEC_PER_SEC) / elapsed_us);
	delta = (observed_hz > nominal_hz) ? (observed_hz - nominal_hz)
					  : (nominal_hz - observed_hz);

	if ((uint64_t)delta * 100U >
	    (uint64_t)nominal_hz * (uint64_t)CONFIG_SAMPLE_CLOCK_TOLERANCE_PCT) {
		return -ERANGE;
	}

	return 0;
}

/*
 * No duration budget: this test sleeps for its measurement window on purpose,
 * so any budget would flag the thing it is supposed to do.
 */
SAFETY_TEST_DEFINE(clock_xcheck, SAFETY_TEST_CAT_CLOCK, SAFETY_TEST_LEVEL_POST_KERNEL, 10,
		   SAFETY_TEST_FLAG_BOOT_OK | SAFETY_TEST_FLAG_RUNTIME_OK |
			   SAFETY_TEST_FLAG_CRITICAL,
		   clock_xcheck_run, "LPTMR cross-check against the system clock");
```

## src/tests_sensor.c
```c
/*
 * Copyright (c) 2026 Aerlync Labs Inc.
 *
 * SPDX-License-Identifier: Apache-2.0
 */

#include <errno.h>
#include <stdint.h>

#include <zephyr/device.h>
#include <zephyr/drivers/sensor.h>
#include <zephyr/kernel.h>
#include <zephyr/safety/safety_test.h>

#include "sample_common.h"

static const struct device *const temp_dev = DEVICE_DT_GET(DT_ALIAS(ambient_temp0));

/*
 * This is the assumption the whole chain rests on: the POST_KERNEL sweep runs
 * at CONFIG_SAFETY_TEST_INIT_PRIORITY (99), the sensor initialises at
 * CONFIG_SENSOR_INIT_PRIORITY (90). Break the build if either is changed,
 * rather than failing mysteriously on the bench.
 */
BUILD_ASSERT(CONFIG_SAFETY_TEST_INIT_PRIORITY > CONFIG_SENSOR_INIT_PRIORITY,
	     "the safety sweep must run after the sensor initialises");

static int32_t last_mc;

int32_t sample_sensor_last_mc(void)
{
	return last_mc;
}

static int read_temperature(int32_t *out)
{
	struct sensor_value val;
	int ret;

	/*
	 * Guard every path into the driver, not just the first test to run. A
	 * failed init leaves the sensor's bus handle NULL and the driver
	 * dereferences it unchecked, so an unguarded fetch faults.
	 */
	if (!device_is_ready(temp_dev)) {
		return -ENODEV;
	}

	ret = sensor_sample_fetch_chan(temp_dev, SENSOR_CHAN_AMBIENT_TEMP);
	if (ret < 0) {
		return ret;
	}

	ret = sensor_channel_get(temp_dev, SENSOR_CHAN_AMBIENT_TEMP, &val);
	if (ret < 0) {
		return ret;
	}

	/* val1 is whole degrees, val2 is millionths. */
	*out = (val.val1 * 1000) + (val.val2 / 1000);

	return 0;
}

static int sensor_comm_run(const struct safety_test_context *ctx)
{
	int ret;

	ARG_UNUSED(ctx);

	ret = read_temperature(&last_mc);
	if (ret < 0) {
		return ret;
	}

	return 0;
}

static int sensor_plausible_run(const struct safety_test_context *ctx)
{
	int ret;

	ARG_UNUSED(ctx);

	ret = read_temperature(&last_mc);
	if (ret < 0) {
		return ret;
	}

	if (last_mc < CONFIG_SAMPLE_TEMP_MIN_MC || last_mc > CONFIG_SAMPLE_TEMP_MAX_MC) {
		return -ERANGE;
	}

	return 0;
}

/*
 * Priority 20 puts this after clock_xcheck within the POST_KERNEL sweep, so a
 * bus fault caused by a wrong clock is attributed to the clock.
 */
SAFETY_TEST_DEFINE(sensor_comm, SAFETY_TEST_CAT_COMM, SAFETY_TEST_LEVEL_POST_KERNEL, 20,
		   SAFETY_TEST_FLAG_BOOT_OK | SAFETY_TEST_FLAG_RUNTIME_OK |
			   SAFETY_TEST_FLAG_CRITICAL,
		   sensor_comm_run, "P3T1755 responds on the I3C bus");

SAFETY_TEST_DEFINE(sensor_plausible, SAFETY_TEST_CAT_OTHER, SAFETY_TEST_LEVEL_APPLICATION, 10,
		   SAFETY_TEST_FLAG_BOOT_OK | SAFETY_TEST_FLAG_RUNTIME_OK |
			   SAFETY_TEST_FLAG_CRITICAL,
		   sensor_plausible_run, "Temperature within its plausibility band");
```
