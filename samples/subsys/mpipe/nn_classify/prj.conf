## CMakeLists.txt
```
# Copyright 2026 NXP
#
# SPDX-License-Identifier: Apache-2.0

cmake_minimum_required(VERSION 3.20.0)
find_package(Zephyr REQUIRED HINTS $ENV{ZEPHYR_BASE})
project(nn_classify_pipeline)

file(GLOB app_sources src/*.c)
target_sources(app PRIVATE ${app_sources})

if(CONFIG_MPIPE_NN_BACKEND_TFLM)
  # The model: stock person detection from the tflite-micro module.
  # Override with -DNN_MODEL=<path>.
  if(NOT DEFINED NN_MODEL)
    set(NN_MODEL
      ${ZEPHYR_TFLITE_MICRO_MODULE_DIR}/tensorflow/lite/micro/models/person_detect.tflite)
  endif()

  generate_inc_file_for_target(app ${NN_MODEL}
    ${ZEPHYR_BINARY_DIR}/include/generated/nn_model.inc)
endif()
```

## Kconfig
```
# Copyright 2026 NXP
#
# SPDX-License-Identifier: Apache-2.0

mainmenu "Live classification pipeline sample"

menu "Live classification pipeline configuration"

config VIDEO_SOURCE_CROP_LEFT
	int "Crop area left value"
	default 0

config VIDEO_SOURCE_CROP_TOP
	int "Crop area top value"
	default 0

config VIDEO_SOURCE_CROP_WIDTH
	int "Crop area width value"
	default 0
	help
	  If set to 0, the crop is not applied.

config VIDEO_SOURCE_CROP_HEIGHT
	int "Crop area height value"
	default 0
	help
	  If set to 0, the crop is not applied.

config VIDEO_FRAME_HEIGHT
	int "Height of the video frame"
	default 0
	help
	  If set to 0, the default height is used.

config VIDEO_FRAME_WIDTH
	int "Width of the video frame"
	default 0
	help
	  If set to 0, the default width is used.

config VIDEO_PIXEL_FORMAT
	string "Pixel format of the video frame"
	help
	  If not set, the default pixel format is used.

config VIDEO_CTRL_HFLIP
	int "Mirror the video frame horizontally"
	range 0 1
	default 0

config VIDEO_CTRL_VFLIP
	int "Mirror the video frame vertically"
	range 0 1
	default 0

config VIDEO_ROTATION_ANGLE
	int "Rotate the video frame by a specified angle"
	range 0 270
	default 0
	help
	  Specify one of {0, 90, 180, 270} degrees.

config PROP_NUM_BUFS
	int "Number of buffers the source provides before stopping"
	default 0
	help
	  If not set or set to 0, the source will run forever.

config SAMPLE_NN_ARENA_SIZE
	int "Tensor arena size in bytes"
	default 140000
	help
	  Working memory handed to the inference backend; 136 KiB fits the
	  stock person detection model.

config SAMPLE_NN_INPUT_SHIFT
	bool "Shift the input samples by the model's zero point"
	default y
	help
	  Store each input sample as (pixel + SAMPLE_NN_INPUT_ZERO_POINT),
	  the affine mapping of a model trained on pixels scaled to -1..1,
	  such as the stock person detection model. Disabled, the converter
	  stores the raw pixel bytes.

config SAMPLE_NN_INPUT_ZERO_POINT
	int "Zero point added to each input sample"
	depends on SAMPLE_NN_INPUT_SHIFT
	default -128

endmenu

source "Kconfig.zephyr"
```

## prj.conf
```kconfig
CONFIG_LOG=y

CONFIG_MPIPE=y
CONFIG_MPIPE_BASE=y
CONFIG_MPIPE_BASE_CAPS_FILTER=y
CONFIG_MPIPE_BASE_QUEUE=y
CONFIG_MPIPE_BASE_TEE=y
CONFIG_MPIPE_BASE_APP_SINK=y
CONFIG_MPIPE_VID=y
CONFIG_MPIPE_DISP=y
CONFIG_MPIPE_PLAYER=y
CONFIG_MPIPE_NN=y
CONFIG_MPIPE_NN_CONVERTER=y
CONFIG_MPIPE_NN_RUNNER=y
CONFIG_MPIPE_NN_DECODER=y
CONFIG_MPIPE_THREADS_NUM=3
# Eleven elements with a hardware video transform
CONFIG_MPIPE_BIN_MAX_CHILDREN=16
# The camera pool and the transform pool both wrap driver buffers in net_bufs
# drawn from the shared header pool, and the inference branch holds one for the
# duration of an inference
CONFIG_MPIPE_NET_BUF_POOL_COUNT=8

# The bus carries end-of-stream and errors, never data: it needs neither
# zbus priority boost nor zbus logging of its own.
CONFIG_ZBUS_PRIORITY_BOOST=n
CONFIG_ZBUS_LOG_LEVEL_ERR=y
```

## overlay-tflm.conf
```kconfig
CONFIG_CPP=y
CONFIG_STD_CPP17=y
CONFIG_TENSORFLOW_LITE_MICRO=y
CONFIG_MPIPE_NN_BACKEND_TFLM=y
CONFIG_MAIN_STACK_SIZE=4096
CONFIG_MPIPE_THREAD_STACK_SIZE=8192
CONFIG_MPIPE_PLAYER_WORKER_STACK_SIZE=8192
```

## boards/mimxrt1170_evk_mimxrt1176_cm7.conf
```kconfig
# The camera's own queue, the frame held in queue_d, the one kept on screen, the
# PXP's input and output, slack: eight 1280x720 BGRX32 frames of 3.7 MB plus the
# heap's own overhead
CONFIG_VIDEO_BUFFER_POOL_NUM_MAX=8
CONFIG_VIDEO_BUFFER_POOL_HEAP_SIZE=29556736
CONFIG_VIDEO_ROTATION_ANGLE=270
CONFIG_VIDEO_FRAME_WIDTH=1280
CONFIG_VIDEO_FRAME_HEIGHT=720

# Optimized int8 kernels for the Cortex-M7
CONFIG_TENSORFLOW_LITE_MICRO_CMSIS_NN_KERNELS=y

# Eleven elements negotiate on the player worker, and the queue thread runs
# the inference chain
CONFIG_MPIPE_PLAYER_WORKER_STACK_SIZE=8192
CONFIG_MPIPE_THREAD_STACK_SIZE=8192
```

## boards/native_sim_native_64.conf
```kconfig
CONFIG_VIDEO_FRAME_WIDTH=320
CONFIG_VIDEO_FRAME_HEIGHT=240
CONFIG_PROP_NUM_BUFS=10

# The generator's one, two held in queue_d, one kept on screen, slack
CONFIG_VIDEO_BUFFER_POOL_NUM_MAX=6

# The shell reads the p/s/r/q commands from the launching terminal
CONFIG_UART_NATIVE_PTY_0_ON_STDINOUT=y

# Log to stdout from boot, and not a second time through the shell backend
CONFIG_LOG_BACKEND_NATIVE_POSIX=y
CONFIG_SHELL_LOG_BACKEND=n

# Threads on native_sim run on host stacks, so this size only reserves memory
CONFIG_MPIPE_PLAYER_WORKER_STACK_SIZE=64
```

## src/main.c
```c
/*
 * Copyright 2026 NXP
 *
 * SPDX-License-Identifier: Apache-2.0
 */

/*
 * Live classification: the camera stream is shown while a neural network
 * classifies the frames on a second branch of the pipeline.
 *
 *   vid_src -> caps_filter -> tee -> queue_d -> [vid_trans] -> disp_sink
 *                                -> queue_nn -> nn_converter -> nn_runner
 *                                               -> nn_decoder -> app_sink
 */

#include <string.h>

#include <zephyr/drivers/video.h>
#include <zephyr/video/controls.h>
#include <zephyr/logging/log.h>
#include <zephyr/mpipe/mpipe.h>
#include <zephyr/mpipe/base/mpipe_app_sink.h>
#include <zephyr/mpipe/base/mpipe_caps_filter.h>
#include <zephyr/mpipe/base/mpipe_queue.h>
#include <zephyr/mpipe/base/mpipe_tee.h>
#include <zephyr/mpipe/disp/mpipe_disp_sink.h>
#include <zephyr/mpipe/vid/mpipe_vid_src.h>
#include <zephyr/mpipe/utils/mpipe_player.h>
#include <zephyr/mpipe/nn/mpipe_nn_converter.h>
#include <zephyr/mpipe/nn/mpipe_nn_decoder.h>
#include <zephyr/mpipe/nn/mpipe_nn_runner.h>
#if DT_HAS_CHOSEN(zephyr_videotrans)
#include <zephyr/mpipe/vid/mpipe_vid_transform.h>
#endif
#if !defined(CONFIG_MPIPE_NN_BACKEND_TFLM)
#include <zephyr/mpipe/nn/mpipe_nn_backend_fake.h>
#endif
#include <zephyr/sys/util_macro.h>

LOG_MODULE_REGISTER(main, CONFIG_LOG_DEFAULT_LEVEL);

/* Element IDs (values are arbitrary; only uniqueness within the pipeline matters) */
enum {
	PIPE_ID,
	VID_SRC_ID,
	CAPS_FILTER_ID,
	TEE_ID,
	QUEUE_D_ID,
	VID_TRANS_ID,
	DISP_SINK_ID,
	QUEUE_NN_ID,
	NN_CONVERTER_ID,
	NN_RUNNER_ID,
	NN_DECODER_ID,
	APP_SINK_ID,
};

static struct mpipe pipe;
static struct mpipe_vid_src vid_src;
static struct mpipe_caps_filter caps_filter;
static struct mpipe_tee tee;
static struct mpipe_queue queue_d;
static struct mpipe_queue queue_nn;
#if DT_HAS_CHOSEN(zephyr_videotrans)
static struct mpipe_vid_transform vid_trans;
#endif
static struct mpipe_disp_sink disp_sink;
static struct mpipe_nn_converter nn_converter;
static struct mpipe_nn_runner nn_runner;
static struct mpipe_nn_decoder nn_decoder;
static struct mpipe_app_sink app_sink;
static struct mpipe_player player;

#if defined(CONFIG_MPIPE_NN_BACKEND_TFLM)

static const uint8_t model_data[] __aligned(16) = {
#include "nn_model.inc"
};

static uint8_t arena[CONFIG_SAMPLE_NN_ARENA_SIZE] __aligned(16);

/* Class order of the person detection model */
static const char *const labels[] = {"no person", "person"};

#else /* fake backend */

static const struct mpipe_nn_fake_model fake_model_cfg = {
	.in_w = 96,
	.in_h = 96,
	.channels = 1,
	.type = MPIPE_NN_TENSOR_TYPE_INT8,
	.num_classes = 2,
};

static uint8_t arena[64];

static const char *const labels[] = {"class 0", "class 1"};

#endif /* CONFIG_MPIPE_NN_BACKEND_TFLM */

/* Runs in the inference branch thread: report the classification of one frame */
static void results_cb(const struct net_buf *buf, void *user_data)
{
	const struct mpipe_nn_results *res =
		(const struct mpipe_nn_results *)(const void *)buf->data;

	ARG_UNUSED(user_data);

	if (mpipe_buffer_get_meta(buf)->bytes_used < sizeof(*res) || res->count == 0U) {
		return;
	}

	LOG_INF("Frame %u: %s (score %d%%)", res->seq,
		(res->cls[0].class_id < ARRAY_SIZE(labels)) ? labels[res->cls[0].class_id] : "?",
		(int)(res->cls[0].score * 100.0f));
}

int main(void)
{
	static const struct mpipe_app_sink_cb cb = {.fn = results_cb, .user_data = NULL};
#if defined(CONFIG_MPIPE_NN_BACKEND_TFLM)
	static const struct mpipe_nn_model model = {.data = model_data, .size = sizeof(model_data)};
#else
	static const struct mpipe_nn_model model = {.data = (const uint8_t *)&fake_model_cfg,
						    .size = sizeof(fake_model_cfg)};
#endif
	static const struct mpipe_nn_arena arena_desc = {.data = arena, .size = sizeof(arena)};
	static const uint8_t nn_queue_size = 1;
	static const enum mpipe_base_queue_leak nn_queue_leak = MPIPE_BASE_QUEUE_LEAK_OLDEST;
	static const uint8_t display_queue_size = 1;
	static const int nn_thread_priority = K_LOWEST_APPLICATION_THREAD_PRIO;
	int ret;

	ret = mpipe_pipeline_init(&pipe, PIPE_ID);
	if (ret < 0) {
		goto err;
	}
	ret = mpipe_vid_src_init(&vid_src, VID_SRC_ID);
	if (ret < 0) {
		goto err;
	}
	ret = mpipe_caps_filter_init(&caps_filter, CAPS_FILTER_ID);
	if (ret < 0) {
		goto err;
	}
	ret = mpipe_tee_init(&tee, TEE_ID);
	if (ret < 0) {
		goto err;
	}
	ret = mpipe_queue_init(&queue_d, QUEUE_D_ID);
	if (ret < 0) {
		goto err;
	}
	ret = mpipe_queue_init(&queue_nn, QUEUE_NN_ID);
	if (ret < 0) {
		goto err;
	}
	ret = mpipe_disp_sink_init(&disp_sink, DISP_SINK_ID);
	if (ret < 0) {
		goto err;
	}
	ret = mpipe_nn_converter_init(&nn_converter, NN_CONVERTER_ID);
	if (ret < 0) {
		goto err;
	}
	ret = mpipe_nn_runner_init(&nn_runner, NN_RUNNER_ID);
	if (ret < 0) {
		goto err;
	}
	ret = mpipe_nn_decoder_init(&nn_decoder, NN_DECODER_ID);
	if (ret < 0) {
		goto err;
	}
	ret = mpipe_app_sink_init(&app_sink, APP_SINK_ID);
	if (ret < 0) {
		goto err;
	}

	struct video_rect __maybe_unused crop = {
		CONFIG_VIDEO_SOURCE_CROP_LEFT, CONFIG_VIDEO_SOURCE_CROP_TOP,
		CONFIG_VIDEO_SOURCE_CROP_WIDTH, CONFIG_VIDEO_SOURCE_CROP_HEIGHT};

	/* clang-format off */
	ret = mpipe_object_set_properties((struct mpipe_object *)&vid_src,
		COND_CODE_0(CONFIG_PROP_NUM_BUFS, (),
			    (MPIPE_PROP_SRC_NUM_BUFS, CONFIG_PROP_NUM_BUFS,))
		COND_CODE_0(CONFIG_VIDEO_SOURCE_CROP_WIDTH, (), (MPIPE_PROP_VID_CROP, &crop,))
		IF_ENABLED(CONFIG_VIDEO_CTRL_HFLIP, (VIDEO_CID_HFLIP, CONFIG_VIDEO_CTRL_HFLIP,))
		IF_ENABLED(CONFIG_VIDEO_CTRL_VFLIP, (VIDEO_CID_VFLIP, CONFIG_VIDEO_CTRL_VFLIP,))
		MPIPE_PROP_LIST_END);
	/* clang-format on */
	if (ret < 0) {
		goto err;
	}

	/* clang-format off */
	struct mpipe_structure caps;
	struct mpipe_value pixfmt;

	ret = mpipe_structure_init_fields(&caps, MPIPE_MEDIA_VIDEO,
		COND_CODE_0(CONFIG_VIDEO_FRAME_WIDTH,
			(), (MPIPE_CAPS_IMAGE_WIDTH, MPIPE_TYPE_UINT, CONFIG_VIDEO_FRAME_WIDTH,))
		COND_CODE_0(CONFIG_VIDEO_FRAME_HEIGHT,
			(), (MPIPE_CAPS_IMAGE_HEIGHT, MPIPE_TYPE_UINT, CONFIG_VIDEO_FRAME_HEIGHT,))
		MPIPE_CAPS_END);
	/* clang-format on */
	if (ret != 0) {
		goto err;
	}

	if (strcmp(CONFIG_VIDEO_PIXEL_FORMAT, "") != 0) {
		ret = mpipe_value_set(&pixfmt, MPIPE_TYPE_UINT,
				      VIDEO_FOURCC_FROM_STR(CONFIG_VIDEO_PIXEL_FORMAT));
		if (ret < 0) {
			goto err;
		}

		ret = mpipe_structure_append_value(&caps, MPIPE_CAPS_PIXEL_FORMAT, &pixfmt);
		if (ret < 0) {
			goto err;
		}
	}

	ret = mpipe_object_set_properties((struct mpipe_object *)&caps_filter,
					  MPIPE_PROP_BASE_CAPS_FILTER_CAPS, &caps,
					  MPIPE_PROP_LIST_END);
	if (ret < 0) {
		goto err;
	}

	/*
	 * The inference branch queue: one slot dropping the oldest, its thread at the
	 * lowest application priority, so a slow model never starves capture or display
	 */
	struct mpipe_object *queue_nn_obj = (struct mpipe_object *)&queue_nn;

	ret = mpipe_object_set_properties(queue_nn_obj, MPIPE_PROP_BASE_QUEUE_SIZE, &nn_queue_size,
					  MPIPE_PROP_BASE_QUEUE_LEAK, &nn_queue_leak,
					  MPIPE_PROP_BASE_QUEUE_THREAD_PRIORITY,
					  &nn_thread_priority, MPIPE_PROP_LIST_END);
	if (ret < 0) {
		goto err;
	}

	/* The display branch queue: one slot, so the camera pool stays within the CSI's four */
	ret = mpipe_object_set_properties((struct mpipe_object *)&queue_d,
					  MPIPE_PROP_BASE_QUEUE_SIZE, &display_queue_size,
					  MPIPE_PROP_LIST_END);
	if (ret < 0) {
		goto err;
	}

#ifdef CONFIG_SAMPLE_NN_INPUT_SHIFT
	static const int32_t zero_point = CONFIG_SAMPLE_NN_INPUT_ZERO_POINT;

	ret = mpipe_object_set_properties((struct mpipe_object *)&nn_converter,
					  MPIPE_PROP_NN_CONVERTER_ZERO_POINT, &zero_point,
					  MPIPE_PROP_LIST_END);
	if (ret < 0) {
		goto err;
	}
#endif

	ret = mpipe_object_set_properties((struct mpipe_object *)&nn_runner, MPIPE_PROP_NN_MODEL,
					  &model, MPIPE_PROP_NN_ARENA, &arena_desc,
					  MPIPE_PROP_LIST_END);
	if (ret < 0) {
		goto err;
	}

	ret = mpipe_object_set_properties((struct mpipe_object *)&app_sink,
					  MPIPE_PROP_BASE_APP_SINK_CB, &cb, MPIPE_PROP_LIST_END);
	if (ret < 0) {
		goto err;
	}

#if DT_HAS_CHOSEN(zephyr_videotrans)
	ret = mpipe_vid_transform_init(&vid_trans, VID_TRANS_ID);
	if (ret < 0) {
		goto err;
	}

	/* clang-format off */
	ret = mpipe_object_set_properties((struct mpipe_object *)&vid_trans,
		COND_CODE_0(CONFIG_VIDEO_ROTATION_ANGLE,
			(), (VIDEO_CID_ROTATE, CONFIG_VIDEO_ROTATION_ANGLE,)) MPIPE_PROP_LIST_END);
	/* clang-format on */
	if (ret < 0) {
		goto err;
	}
#endif

	/* clang-format off */
	/* Add elements to the pipeline - order does not matter */
	ret = mpipe_bin_add((struct mpipe_bin *)&pipe,
			(struct mpipe_element *)&vid_src,
			(struct mpipe_element *)&caps_filter,
			(struct mpipe_element *)&tee,
			(struct mpipe_element *)&queue_d,
			IF_ENABLED(DT_HAS_CHOSEN(zephyr_videotrans),
				   ((struct mpipe_element *)&vid_trans,))
			(struct mpipe_element *)&disp_sink,
			(struct mpipe_element *)&queue_nn,
			(struct mpipe_element *)&nn_converter,
			(struct mpipe_element *)&nn_runner,
			(struct mpipe_element *)&nn_decoder,
			(struct mpipe_element *)&app_sink, NULL);
	if (ret < 0) {
		LOG_ERR("Failed to add elements (%d)", ret);
		goto err;
	}

	/* Branch 1: camera to display */
	ret = mpipe_element_link((struct mpipe_element *)&vid_src,
			(struct mpipe_element *)&caps_filter,
			(struct mpipe_element *)&tee,
			(struct mpipe_element *)&queue_d,
			IF_ENABLED(DT_HAS_CHOSEN(zephyr_videotrans),
				   ((struct mpipe_element *)&vid_trans,))
			(struct mpipe_element *)&disp_sink, NULL);
	if (ret < 0) {
		LOG_ERR("Failed to link branch 1 (%d)", ret);
		goto err;
	}

	/* Branch 2: tee (2nd src pad) to the classifier */
	ret = mpipe_element_link((struct mpipe_element *)&tee,
			(struct mpipe_element *)&queue_nn,
			(struct mpipe_element *)&nn_converter,
			(struct mpipe_element *)&nn_runner,
			(struct mpipe_element *)&nn_decoder,
			(struct mpipe_element *)&app_sink, NULL);
	if (ret < 0) {
		LOG_ERR("Failed to link branch 2 (%d)", ret);
		goto err;
	}
	/* clang-format on */

	LOG_INF("Pipeline linked.");

	ret = mpipe_player_init(&player, &pipe);
	if (ret != 0) {
		LOG_ERR("Failed to init player (%d)", ret);
		goto err;
	}

	(void)mpipe_player_play(&player);
	(void)mpipe_player_wait_quit(&player);
	(void)mpipe_player_deinit(&player);

	LOG_INF("Done.");

	return 0;

err:
	LOG_ERR("Aborting sample");
	return 0;
}
```
