## samples/subsys/mpipe/net_stream/Kconfig
```kconfig
# Copyright 2026 NXP
# SPDX-License-Identifier: Apache-2.0

mainmenu "Multimedia Pipeline network streaming sample"

config SAMPLE_NET_STREAM_SELFTEST
	bool "Run a self-test client instead of waiting for a player"
	help
	  Write the input file at startup and start a client thread that
	  connects to the sink, counts the JPEG frames it receives and logs
	  PASS or FAIL.

source "Kconfig.zephyr"
```

## samples/subsys/mpipe/nn_classify/Kconfig
```kconfig
# Copyright 2026 NXP
#
# SPDX-License-Identifier: Apache-2.0

mainmenu "Live classification pipeline sample"

menu "Live classification pipeline configuration"

config VIDEO_SOURCE_CROP_LEFT
	int "Crop area left value"
	default 0

config VIDEO_SOURCE_CROP_TOP
	int "Crop area top value"
	default 0

config VIDEO_SOURCE_CROP_WIDTH
	int "Crop area width value"
	default 0
	help
	  If set to 0, the crop is not applied.

config VIDEO_SOURCE_CROP_HEIGHT
	int "Crop area height value"
	default 0
	help
	  If set to 0, the crop is not applied.

config VIDEO_FRAME_HEIGHT
	int "Height of the video frame"
	default 0
	help
	  If set to 0, the default height is used.

config VIDEO_FRAME_WIDTH
	int "Width of the video frame"
	default 0
	help
	  If set to 0, the default width is used.

config VIDEO_PIXEL_FORMAT
	string "Pixel format of the video frame"
	help
	  If not set, the default pixel format is used.

config VIDEO_CTRL_HFLIP
	int "Mirror the video frame horizontally"
	range 0 1
	default 0

config VIDEO_CTRL_VFLIP
	int "Mirror the video frame vertically"
	range 0 1
	default 0

config VIDEO_ROTATION_ANGLE
	int "Rotate the video frame by a specified angle"
	range 0 270
	default 0
	help
	  Specify one of {0, 90, 180, 270} degrees.

config PROP_NUM_BUFS
	int "Number of buffers the source provides before stopping"
	default 0
	help
	  If not set or set to 0, the source will run forever.

config SAMPLE_NN_ARENA_SIZE
	int "Tensor arena size in bytes"
	default 140000
	help
	  Working memory handed to the inference backend; 136 KiB fits the
	  stock person detection model.

config SAMPLE_NN_INPUT_SHIFT
	bool "Shift the input samples by the model's zero point"
	default y
	help
	  Store each input sample as (pixel + SAMPLE_NN_INPUT_ZERO_POINT),
	  the affine mapping of a model trained on pixels scaled to -1..1,
	  such as the stock person detection model. Disabled, the converter
	  stores the raw pixel bytes.

config SAMPLE_NN_INPUT_ZERO_POINT
	int "Zero point added to each input sample"
	depends on SAMPLE_NN_INPUT_SHIFT
	default -128

endmenu

source "Kconfig.zephyr"
```

## samples/subsys/mpipe/nn_detect/Kconfig
```kconfig
# Copyright 2026 NXP
#
# SPDX-License-Identifier: Apache-2.0

mainmenu "Live detection pipeline sample"

menu "Live detection pipeline configuration"

config VIDEO_SOURCE_CROP_LEFT
	int "Crop area left value"
	default 0

config VIDEO_SOURCE_CROP_TOP
	int "Crop area top value"
	default 0

config VIDEO_SOURCE_CROP_WIDTH
	int "Crop area width value"
	default 0
	help
	  If set to 0, the crop is not applied.

config VIDEO_SOURCE_CROP_HEIGHT
	int "Crop area height value"
	default 0
	help
	  If set to 0, the crop is not applied.

config VIDEO_FRAME_HEIGHT
	int "Height of the video frame"
	default 0
	help
	  If set to 0, the default height is used.

config VIDEO_FRAME_WIDTH
	int "Width of the video frame"
	default 0
	help
	  If set to 0, the default width is used.

config VIDEO_PIXEL_FORMAT
	string "Pixel format of the video frame"
	help
	  If not set, the default pixel format is used.

config VIDEO_CTRL_HFLIP
	int "Mirror the video frame horizontally"
	range 0 1
	default 0

config VIDEO_CTRL_VFLIP
	int "Mirror the video frame vertically"
	range 0 1
	default 0

config VIDEO_ROTATION_ANGLE
	int "Rotate the video frame by a specified angle"
	range 0 270
	default 0
	help
	  Specify one of {0, 90, 180, 270} degrees.

config PROP_NUM_BUFS
	int "Number of buffers the source provides before stopping"
	default 0
	help
	  If not set or set to 0, the source will run forever.

config SAMPLE_NN_ARENA_SIZE
	int "Tensor arena size in bytes"
	default 320000
	help
	  Working memory handed to the inference backend, which logs how much
	  a model uses at load. The 128x128 Ultraface model needs 310 KB on
	  the CPU, the 320x240 one 1.3 MB, or 1.2 MB on the Neutron NPU.

config SAMPLE_NN_NPU_REGION_NAME
	string "Memory region for the model and its arena on an NPU"
	default "SRAM1"
	depends on TFLM_NXP_NEUTRON
	help
	  Name of a zephyr,memory-region devicetree node the Neutron NPU can
	  reach: the model is copied there at start-up and the arena placed
	  there, both being read by the NPU in place.

config SAMPLE_NN_SCORE_THRESHOLD
	int "Detection score threshold in percent"
	range 1 100
	default 50
	help
	  Boxes scoring below this are not reported. Lower it to see what a
	  model produces on a scene it is unsure about.

config SAMPLE_NN_INPUT_SHIFT
	bool "Shift the input samples by the model's zero point"
	default y
	help
	  Store each input sample as (pixel + SAMPLE_NN_INPUT_ZERO_POINT),
	  the input zero point of a model quantized from pixels scaled to
	  -1..1, the Ultraface models among them. Disabled, the converter
	  stores the raw pixel bytes.

config SAMPLE_NN_INPUT_ZERO_POINT
	int "Zero point added to each input sample"
	depends on SAMPLE_NN_INPUT_SHIFT
	default -128

endmenu

source "Kconfig.zephyr"
```

## samples/subsys/pm/poweroff/boards/siwx917_rb4338a.conf
```kconfig
CONFIG_WIFI=y
CONFIG_NETWORKING=y
CONFIG_BT=y
CONFIG_BT_SILABS_SIWX91X=y
CONFIG_WUC=y
```

## samples/subsys/pm/poweroff/sample.yaml
```yaml
# SPDX-FileCopyrightText: Copyright (c) 2026 Silicon Laboratories Inc.
# SPDX-License-Identifier: Apache-2.0

sample:
  description: perform soc Power off and wake it using an RTC alarm or GPIO
  name: Soc power off with RTC and GPIO wakeup

common:
  tags:
    - power
    - rtc
    - poweroff
    - gpio
  platform_allow:
    - siwx917_rb4338a
  filter: >
    dt_alias_exists("button") and
    dt_alias_exists("rtc")
  depends_on:
    - gpio
    - rtc

tests:
  sample.subsys.pm.poweroff:
    build_only: true
    integration_platforms:
      - siwx917_rb4338a
```

## samples/subsys/rc/receive/Kconfig
```kconfig
# SPDX-FileCopyrightText: Copyright (c) 2026 Linumiz
# SPDX-License-Identifier: Apache-2.0

mainmenu "Remote control receive sample"

config SAMPLE_RC_RAW
	bool "Print raw words"
	help
	  Print the raw pulse and space words received by the rc device.

config SAMPLE_RC_SELFTEST
	bool "Send one NEC frame at start"
	depends on RC_TX
	help
	  Send one NEC frame through the rc device at start, for a loopback
	  device that stores transmitted words as received words.

source "Kconfig.zephyr"
```

## samples/subsys/rc/receive/boards/native_sim.conf
```kconfig
# SPDX-FileCopyrightText: Copyright (c) 2026 Linumiz
# SPDX-License-Identifier: Apache-2.0

CONFIG_SAMPLE_RC_SELFTEST=y
CONFIG_RC_LOOPBACK_TX_WORDS=68
```

## samples/subsys/safety/sensor_chain/Kconfig
```kconfig
# Copyright (c) 2026 Aerlync Labs Inc.
# SPDX-License-Identifier: Apache-2.0

menu "Safety test sensor chain sample"

choice SAMPLE_SAFE_STATE_ACTION
	prompt "What the safe-state handler returns after a critical failure"
	default SAMPLE_SAFE_STATE_ACTION_CONTINUE
	help
	  The sample overrides safety_test_safe_state(), so the subsystem's own
	  SAFETY_TEST_DEFAULT_ACTION_* choice does not apply here. This is what
	  the override returns.

config SAMPLE_SAFE_STATE_ACTION_CONTINUE
	bool "Continue"
	help
	  Log the failure and carry on. With CONFIG_SAFETY_TEST_STRICT_CRITICAL
	  set the subsystem refuses this and halts instead, which is the pairing
	  that shows what strict mode is for: one source tree, two behaviours,
	  selected by configuration alone.

config SAMPLE_SAFE_STATE_ACTION_RESET
	bool "Reboot"
	select REBOOT
	help
	  Cold reboot. Two reasons to prefer this over halting. The board stays
	  recoverable, which matters on targets where a halted core cannot be
	  restarted with the RESET button. And the subsystem does not clear its
	  __noinit failure record on this path, so the next boot can report what
	  went wrong, which halting cannot do if you have to pull the power.

	  Expect a boot loop if the failure is still present after the reboot.

config SAMPLE_SAFE_STATE_ACTION_HALT
	bool "Halt"
	help
	  Stop the CPU where it stands. Most faithful to a production safe state,
	  but on some boards a halted target needs a power cycle rather than a
	  press of RESET.

endchoice

config SAMPLE_TEMP_MIN_MC
	int "Lower plausibility bound, millidegrees Celsius"
	default 10000
	help
	  A reading below this fails sensor_plausible. The default assumes an
	  indoor bench.

config SAMPLE_TEMP_MAX_MC
	int "Upper plausibility bound, millidegrees Celsius"
	default 35000
	help
	  A reading above this fails sensor_plausible. Sustained finger contact
	  on the package is enough to cross the default.

config SAMPLE_CLOCK_TOLERANCE_PCT
	int "clock_xcheck tolerance, percent"
	default 10
	range 1 50
	help
	  How far the LPTMR's measured rate may sit from its nominal rate before
	  clock_xcheck fails. The default is a placeholder that avoids false
	  failures; set it from the FRO16K accuracy figure in the datasheet
	  before relying on this test.

config SAMPLE_CLOCK_WINDOW_MS
	int "clock_xcheck measurement window, milliseconds"
	default 10
	range 1 1000
	help
	  Longer windows reduce quantization error. 10 ms yields roughly 160
	  LPTMR ticks, so one tick is about 0.6%.

config SAMPLE_IMAGE_CRC
	hex "Expected CRC-32 of the text region"
	default 0
	help
	  Supplied by the second pass of the two-pass build; see the README.
	  Left at 0, flash_integrity reports -ENODATA rather than a false
	  mismatch, so a single-pass build fails honestly instead of silently.

config SAMPLE_RUNTIME_PERIOD_MS
	int "Runtime loop period, milliseconds"
	default 2000

endmenu

source "Kconfig.zephyr"
```

## samples/subsys/scsi/test/sample.yaml
```yaml
sample:
  description: SCSI mid-layer initiator flow with an in-tree mock transport
  name: SCSI mid-layer (mock)
common:
  tags:
    - scsi
    - disk
  harness: console
  harness_config:
    type: multi_line
    ordered: true
    regex:
      - "SCSI mid-layer sample"
      - "CDB builders OK"
      - "FAT volume LBA 4096 sectors 8192"
tests:
  sample.subsys.scsi.test:
    platform_allow:
      - native_sim
      - native_sim/native/64
    integration_platforms:
      - native_sim
```

## samples/subsys/usb/ccid/sample.yaml
```yaml
sample:
  name: USB CCID reader backend
  description: Demonstrate a transport-independent CCID backend with a simulated T=0 card.
tests:
  sample.usb.ccid:
    depends_on: usbd
    tags: usb
    integration_platforms:
      - nrf54lm20dk/nrf54lm20a/cpuapp
      - native_sim/native/64
    build_only: true
```

## samples/subsys/usb/host_hid_boot/Kconfig
```kconfig
# Copyright (c) 2026 Antmicro <www.antmicro.com>
config SAMPLE_COLORED_OUTPUT
	bool "Highlight input event values in shell output"
	depends on SHELL_VT100_COLORS
	default y
	help
	  Highlight input event values in green in the shell output.

source "Kconfig.zephyr"
```

## samples/subsys/usb/host_mass/Kconfig
```kconfig
# SPDX-FileCopyrightText: Copyright 2026 NXP
# SPDX-License-Identifier: Apache-2.0

menu "MSC sample options"

config APP_HOST_MASS_USE_FILESYSTEM
	bool "Enable file system access on USB mass storage device"
	imply FILE_SYSTEM
	imply FAT_FILESYSTEM_ELM
	help
	  When enabled, the application will mount a FAT file system on the
	  connected USB mass storage device and demonstrate basic file
	  operations (mount, list directory, create/read a test file).
	  When disabled, only raw sector-level disk access is performed.

if APP_HOST_MASS_USE_FILESYSTEM

config FS_FATFS_CUSTOM_MOUNT_POINT_COUNT
	default 1

config FS_FATFS_CUSTOM_MOUNT_POINTS
	default "usbh_msc_0"

endif # APP_HOST_MASS_USE_FILESYSTEM

endmenu

source "samples/subsys/usb/common/Kconfig.sample_usbd"

source "Kconfig.zephyr"
```
