## CMakeLists.txt
```
cmake_minimum_required(VERSION 3.20.0)
find_package(Zephyr REQUIRED HINTS $ENV{ZEPHYR_BASE})
project(dmic_i2s)

file(GLOB app_sources src/*.c)
target_sources(app PRIVATE ${app_sources})
```

## Kconfig
```
# Copyright 2026 NXP
# SPDX-License-Identifier: Apache-2.0

source "Kconfig.zephyr"

config USE_I2S_TARGET_CODEC_CONTROLLER
	bool "I2S BCK is generated by a selected codec device"
	help
	  If selected, the I2S selected peripheral will be configured to consume
	  (receive) the I2S BCK and WS signals and the codec will be configured
	  to generate those. If not selected, the I2S peripheral will generate
	  them and the codec will be expected to consume them.
```

## prj.conf
```kconfig
CONFIG_LOG=y

CONFIG_MPIPE=y
CONFIG_MPIPE_BASE=y
CONFIG_MPIPE_BASE_CAPS_FILTER=y
CONFIG_MPIPE_AUD=y
CONFIG_ZBUS_MSG_SUBSCRIBER=y

CONFIG_AUDIO_DMIC=y
CONFIG_AUDIO_CODEC=y

CONFIG_I2S=y

CONFIG_SHELL=y
CONFIG_DEVICE_SHELL=y

CONFIG_MAIN_STACK_SIZE=4096

# The bus carries end-of-stream and errors, never data: it needs neither
# zbus priority boost nor zbus logging of its own.
CONFIG_ZBUS_PRIORITY_BOOST=n
CONFIG_ZBUS_LOG_LEVEL_ERR=y
```

## boards/mcx_n5xx_evk_mcxn547_cpu0.conf
```kconfig
# Copyright 2026 NXP
#
# SPDX-License-Identifier: Apache-2.0

CONFIG_I3C=y
CONFIG_AUDIO_CODEC=y

CONFIG_MPIPE_AUD_BUFFER_POOL_SZ_MAX=4096

CONFIG_DMA_TCD_QUEUE_SIZE=4
CONFIG_AUDIO_CODEC_DA7212=y
```

## boards/mimxrt1170_evk_mimxrt1176_cm7.conf
```kconfig
#
# Copyright 2026 NXP
#
# SPDX-License-Identifier: Apache-2.0
#

CONFIG_I3C=y
CONFIG_AUDIO_CODEC=y

CONFIG_AUDIO_CODEC_WM8962=y

CONFIG_MPIPE_AUD_BUFFER_POOL_SZ_MAX=4096
CONFIG_MPIPE_AUD_BUFFER_POOL_NUM_MAX=10


CONFIG_DMA_TCD_QUEUE_SIZE=4
```

## boards/mimxrt595_evk_mimxrt595s_cm33.conf
```kconfig
#
# Copyright 2026 NXP
#
# SPDX-License-Identifier: Apache-2.0
#

CONFIG_I3C=y
CONFIG_AUDIO_CODEC=y

# The DMIC holds CONFIG_DMIC_MCUX_DMA_BUFFERS=2 blocks for its DMA ring, a full
# CONFIG_DMIC_MCUX_QUEUE_SIZE=8 receive queue alongside them and one more while it
# rotates. The I2S sink primes three, and one more is in transit on the pipeline
# thread - 15 in all.
CONFIG_MPIPE_AUD_BUFFER_POOL_SZ_MAX=4096
CONFIG_MPIPE_AUD_BUFFER_POOL_NUM_MAX=15

CONFIG_USE_I2S_TARGET_CODEC_CONTROLLER=y

# The I2S codec sink primes AUD_I2S_SINK_START_PRIME (3) writes into the I2S TX
# queue before issuing I2S_TRIGGER_START. The TX in_queue must therefore be able
# to hold at least that many buffers, otherwise the priming writes block on a
# full queue, START never fires, and the shared buffer pool drains.
CONFIG_I2S_MCUX_FLEXCOMM_TX_BLOCK_COUNT=4
```

## boards/mimxrt685_evk_mimxrt685s_cm33.conf
```kconfig
#
# Copyright 2025 NXP
#
# SPDX-License-Identifier: Apache-2.0
#

CONFIG_I3C=y
CONFIG_AUDIO_CODEC=y

# The DMIC holds CONFIG_DMIC_MCUX_DMA_BUFFERS=2 blocks for its DMA ring, a full
# CONFIG_DMIC_MCUX_QUEUE_SIZE=8 receive queue alongside them and one more while it
# rotates. The I2S sink primes three, and one more is in transit on the pipeline
# thread - 15 in all.
CONFIG_MPIPE_AUD_BUFFER_POOL_SZ_MAX=4096
CONFIG_MPIPE_AUD_BUFFER_POOL_NUM_MAX=15

CONFIG_USE_I2S_TARGET_CODEC_CONTROLLER=y

# The I2S codec sink primes AUD_I2S_SINK_START_PRIME (3) writes into the I2S TX
# queue before issuing I2S_TRIGGER_START. The TX in_queue must therefore be able
# to hold at least that many buffers, otherwise the priming writes block on a
# full queue, START never fires, and the shared buffer pool drains.
CONFIG_I2S_MCUX_FLEXCOMM_TX_BLOCK_COUNT=4
```

## boards/native_sim_native_64.conf
```kconfig
#
# Copyright 2026 NXP
#
# SPDX-License-Identifier: Apache-2.0
#

CONFIG_AUDIO_CODEC=y
CONFIG_AUDIO_CODEC_DUMMY=y
CONFIG_AUDIO_DMIC=y
CONFIG_AUDIO_DMIC_NATIVE_SIM=y
CONFIG_I2S=y
CONFIG_I2S_NATIVE_SIM=y

# Both emulated devices queue eight blocks (CONFIG_AUDIO_DMIC_NATIVE_SIM_QUEUE_SIZE=8):
# the microphone holds its queue plus the one it is filling, the I2S sink holds its queue,
# and one more is in transit on the pipeline thread - 18 in all.
CONFIG_MPIPE_AUD_BUFFER_POOL_NUM_MAX=18
CONFIG_MPIPE_AUD_BUFFER_POOL_SZ_MAX=4096

CONFIG_I2S_NATIVE_SIM_TX_FILE_PATH="build/native_sim_audio_pipeline_tx.pcm"
```

## src/main.c
```c
/*
 * Copyright 2025 NXP
 *
 * SPDX-License-Identifier: Apache-2.0
 */

#include <zephyr/kernel.h>
#include <zephyr/zbus/zbus.h>
#include <zephyr/logging/log.h>

#include <zephyr/mpipe/mpipe.h>
#include <zephyr/mpipe/mpipe_message.h>
#include <zephyr/mpipe/aud/mpipe_aud.h>
#include <zephyr/mpipe/aud/mpipe_aud_src.h>
#include <zephyr/mpipe/aud/mpipe_aud_i2s_codec_sink.h>
#include <zephyr/mpipe/aud/mpipe_aud_gain.h>
#include <zephyr/mpipe/aud/mpipe_aud_dmic_src.h>
#include <zephyr/mpipe/aud/mpipe_aud_buffer_pool.h>
#include <zephyr/mpipe/base/mpipe_caps_filter.h>

LOG_MODULE_REGISTER(main);

#define LOG_LEVEL LOG_LEVEL_DBG

/* Element IDs (values are arbitrary; only uniqueness within the pipeline matters) */
enum {
	PIPE_ID,
	DMIC_SRC_ID,
	CAPS_FILTER_ID,
	AUD_GAIN_ID,
	I2S_SINK_ID,
};

/*
 * WORKAROUND: Direct memory slab management in application code
 *
 * TODO: Normally, applications should not set this because they do not
 * need to know about the memory slab audio buffers implementation.
 *
 * The __nocache attribute ensures this memory is not cached, which is
 * required for DMA operations used by audio hardware.
 */
__nocache struct k_mem_slab mem_slab;

ZBUS_MSG_SUBSCRIBER_DEFINE(main_sub);

static struct mpipe pipe;

static struct mpipe_aud_dmic_src source;
static struct mpipe_aud_gain gain;
static struct mpipe_aud_i2s_codec_sink sink;
static struct mpipe_caps_filter caps_filter;

int main(void)
{
	int gain_val = 90; /* Set gain to 90% (0.9x amplification) */
	struct zbus_channel *bus = NULL;
	int ret = 0;

	ret = mpipe_pipeline_init(&pipe, PIPE_ID);
	if (ret < 0) {
		goto err;
	}
	ret = mpipe_aud_dmic_src_init(&source, DMIC_SRC_ID);
	if (ret < 0) {
		goto err;
	}
	ret = mpipe_aud_gain_init(&gain, AUD_GAIN_ID);
	if (ret < 0) {
		goto err;
	}
	ret = mpipe_aud_i2s_codec_sink_init(&sink, I2S_SINK_ID);
	if (ret < 0) {
		goto err;
	}

	ret = mpipe_object_set_properties((struct mpipe_object *)&source,
					  MPIPE_PROP_AUD_SRC_SLAB_PTR, &mem_slab,
					  MPIPE_PROP_LIST_END);
	if (ret < 0) {
		LOG_ERR("Failed to set properties for source element");
		goto err;
	}

	ret = mpipe_object_set_properties(
		(struct mpipe_object *)&sink, MPIPE_PROP_AUD_SINK_SLAB_PTR, &mem_slab,
#if (defined(CONFIG_USE_I2S_TARGET_CODEC_CONTROLLER) && CONFIG_USE_I2S_TARGET_CODEC_CONTROLLER == 1)
		MPIPE_PROP_AUD_SINK_CLK_ROLE, MPIPE_AUD_I2S_TARGET_CODEC_CONTROLLER,
#endif
		MPIPE_PROP_LIST_END);
	if (ret < 0) {
		LOG_ERR("Failed to set properties for sink element");
		goto err;
	}

	ret = mpipe_object_set_properties((struct mpipe_object *)&gain,
					  MPIPE_PROP_AUD_TRANSFORM_GAIN, &gain_val,
					  MPIPE_PROP_LIST_END);
	if (ret < 0) {
		LOG_ERR("Failed to set properties for gain element");
		goto err;
	}

	/* Caps filter element */
	ret = mpipe_caps_filter_init(&caps_filter, CAPS_FILTER_ID);
	if (ret < 0) {
		goto err;
	}

	uint32_t frame_interval = 10000; /* 10ms */
	struct mpipe_structure caps;

	ret = mpipe_structure_init_fields(
		&caps, MPIPE_MEDIA_AUDIO_PCM, MPIPE_CAPS_FRAME_INTERVAL, MPIPE_TYPE_UINT,
		frame_interval, MPIPE_CAPS_NUM_CHANNELS, MPIPE_TYPE_UINT, 2, MPIPE_CAPS_END);

	if (ret != 0) {
		LOG_ERR("Failed to create a caps");
		goto err;
	}

	ret = mpipe_object_set_properties((struct mpipe_object *)&caps_filter,
					  MPIPE_PROP_BASE_CAPS_FILTER_CAPS, &caps,
					  MPIPE_PROP_LIST_END);
	if (ret < 0) {
		LOG_ERR("Failed to set properties for caps filter element");
		goto err;
	}

	/* clang-format off */
	/* Add elements to the pipeline - order does not matter */
	ret = mpipe_bin_add((struct mpipe_bin *)&pipe,
			(struct mpipe_element *)&source,
			IF_ENABLED(CONFIG_MPIPE_BASE_CAPS_FILTER,
				   ((struct mpipe_element *)&caps_filter,))
			(struct mpipe_element *)&gain,
			(struct mpipe_element *)&sink, NULL);
	if (ret < 0) {
		LOG_ERR("Failed to add elements (%d)", ret);
		goto err;
	}

	/* Link elements together - order does matter */
	ret = mpipe_element_link((struct mpipe_element *)&source,
			IF_ENABLED(CONFIG_MPIPE_BASE_CAPS_FILTER,
				   ((struct mpipe_element *)&caps_filter,))
			(struct mpipe_element *)&gain,
			(struct mpipe_element *)&sink, NULL);
	if (ret < 0) {
		LOG_ERR("Failed to link elements (%d)", ret);
		goto err;
	}
	/* clang-format on */

	bus = mpipe_element_get_bus_chan((struct mpipe_element *)&pipe);

	ret = zbus_chan_add_obs(bus, &main_sub, K_FOREVER);
	if (ret != 0) {
		LOG_ERR("Failed to attach observer to pipeline channel (%d)", ret);
		goto err;
	}

	/* Start playing */
	if (mpipe_element_set_state((struct mpipe_element *)&pipe, MPIPE_STATE_PLAYING) !=
	    MPIPE_STATE_CHANGE_SUCCESS) {
		LOG_ERR("Failed to start pipeline");
		goto err_set_state;
	}

	/* Handle message from the pipeline */
	const struct zbus_channel *chan;
	struct mpipe_message msg;

	/* Wait until an Error or an EOS */
	int sub_ret;

	do {
		sub_ret = zbus_sub_wait_msg(&main_sub, &chan, &msg, K_FOREVER);
		if (sub_ret != 0) {
			LOG_ERR("zbus_sub_wait_msg failed (%d)", sub_ret);
			goto err_set_state;
		}
	} while ((msg.type & (MPIPE_MESSAGE_ERROR | MPIPE_MESSAGE_EOS)) == 0);

	int origin_id = (msg.origin != NULL) ? msg.origin->object.id : -1;

	switch (msg.type) {
	case MPIPE_MESSAGE_ERROR:
		LOG_ERR("ERROR message from element %d", origin_id);
		break;
	case MPIPE_MESSAGE_EOS:
		LOG_INF("EOS message from element %d", origin_id);
		break;
	default:
		LOG_ERR("Unexpected message from element %d", origin_id);
		break;
	}

	(void)zbus_chan_rm_obs(bus, &main_sub, K_FOREVER);

	/* Stop/Deinit the pipeline */
	(void)mpipe_element_set_state((struct mpipe_element *)&pipe, MPIPE_STATE_READY);

	return 0;

err_set_state:
	zbus_chan_rm_obs(bus, &main_sub, K_FOREVER);
err:
	LOG_ERR("Aborting sample");
	return ret != 0 ? ret : -EIO;
}
```
