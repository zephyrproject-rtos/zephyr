## CMakeLists.txt
```
cmake_minimum_required(VERSION 3.20.0)

find_package(Zephyr REQUIRED HINTS $ENV{ZEPHYR_BASE})

project(lvgl_anim)

# ───────────────────────── Video → LVGL frame generation ─────────────────────────
#
# Reads display width/height and pixel-format from the DTS chosen node so the
# generated frames always match the board's display configuration.
#
# Kconfig variables consumed here:
#   CONFIG_LVGL_ANIMATION_VIDEO_PATH       Path to the source video file
#   CONFIG_LVGL_ANIMATION_FRAME_COUNT      Number of frames to extract
#   CONFIG_LVGL_ANIMATION_FIT              Fit mode: crop | letterbox | stretch
#   CONFIG_LVGL_ANIMATION_PREFIX           C variable name prefix (default: frame)
#
# DTS properties read via dt_chosen / dt_prop:
#   /chosen zephyr,display  → width, height, pixel-format
#
# ────────────────────────────────────────────────────────────────────────────────

dt_chosen(DISPLAY_NODE PROPERTY "zephyr,display")
dt_prop(DISPLAY_WIDTH  PATH "${DISPLAY_NODE}" PROPERTY "width")
dt_prop(DISPLAY_HEIGHT PATH "${DISPLAY_NODE}" PROPERTY "height")
dt_prop(DISPLAY_PIXEL_FORMAT PATH "${DISPLAY_NODE}" PROPERTY "pixel-format")

if(DISPLAY_PIXEL_FORMAT STREQUAL "1")
    set(LVGL_COLOR_FORMAT "rgb888")
elseif(DISPLAY_PIXEL_FORMAT STREQUAL "8")
    set(LVGL_COLOR_FORMAT "argb8888")
elseif(DISPLAY_PIXEL_FORMAT STREQUAL "16")
    set(LVGL_COLOR_FORMAT "rgb565")
else()
    message(WARNING "Unknown pixel-format '${DISPLAY_PIXEL_FORMAT}', default rgb565")
    set(LVGL_COLOR_FORMAT "rgb565")
endif()

message(STATUS "Display: ${DISPLAY_WIDTH}x${DISPLAY_HEIGHT}  format=${LVGL_COLOR_FORMAT}")

if(NOT EXISTS "${CONFIG_LVGL_ANIMATION_VIDEO_PATH}")
    message(FATAL_ERROR "Video file not found: '${CONFIG_LVGL_ANIMATION_VIDEO_PATH}'")
endif()

set(LVGL_IMG_DIR "${ZEPHYR_BINARY_DIR}/include/generated/img")
set(LVGL_STAMP "${ZEPHYR_BINARY_DIR}/include/generated/lvgl_frames.stamp")
set(LVGL_SCRIPT "${CMAKE_CURRENT_SOURCE_DIR}/script/video_to_lvgl_frames.py")

set(LVGL_SCRIPT_ARGS
    "${CONFIG_LVGL_ANIMATION_VIDEO_PATH}"
    --width   "${DISPLAY_WIDTH}"
    --height  "${DISPLAY_HEIGHT}"
    --frames  "${CONFIG_LVGL_ANIMATION_FRAME_COUNT}"
    --format  "${LVGL_COLOR_FORMAT}"
    --fit     "${CONFIG_LVGL_ANIMATION_FIT}"
    --out     "${LVGL_IMG_DIR}"
    --prefix  "${CONFIG_LVGL_ANIMATION_PREFIX}"
)

add_custom_command(
    OUTPUT  "${LVGL_STAMP}"
    COMMAND ${CMAKE_COMMAND} -E echo
            "-- Generating LVGL frames: ${DISPLAY_WIDTH}x${DISPLAY_HEIGHT} ${LVGL_COLOR_FORMAT}"
    COMMAND echo "y" | ${Python3_EXECUTABLE} "${LVGL_SCRIPT}" ${LVGL_SCRIPT_ARGS}
    COMMAND ${CMAKE_COMMAND} -E touch "${LVGL_STAMP}"
    DEPENDS
        "${CONFIG_LVGL_ANIMATION_VIDEO_PATH}"
        "${LVGL_SCRIPT}"
        "${CMAKE_CURRENT_SOURCE_DIR}/CMakeLists.txt"
    COMMENT "Generating LVGL frame headers from ${CONFIG_LVGL_ANIMATION_VIDEO_PATH}"
    VERBATIM
)

add_custom_target(lvgl_frames_gen ALL
    DEPENDS "${LVGL_STAMP}"
)

add_dependencies(app lvgl_frames_gen)

target_sources(app PRIVATE src/main.c)
```

## Kconfig
```
# Copyright (c) 2026 Muhammad Waleed Badar
# SPDX-License-Identifier: Apache-2.0

mainmenu "LVGL Animation Sample"

config LVGL_ANIMATION_VIDEO_PATH
	string "Absolute path to the source video file"
	default ""
	help
	  Full path to the video file passed to video_to_lvgl_frames.py.
	  Example: CONFIG_LVGL_ANIMATION_VIDEO_PATH="/home/user/clips/intro.mp4"

config LVGL_ANIMATION_FRAME_COUNT
	int "Number of frames to extract from the video"
	default 10
	help
	  Evenly-spaced frames extracted from the source video.
	  More frames = smoother animation, more flash usage.

config LVGL_ANIMATION_FIT
	string "Fit mode for video scaling"
	default "crop"
	help
	  How to handle aspect-ratio mismatch between video and display:
	    crop       - scale to fill, center-crop the overflow (default)
	    letterbox  - scale to fit, pad remainder with black bars
	    stretch    - scale to fill exactly, ignoring aspect ratio

config LVGL_ANIMATION_PREFIX
	string "C variable name prefix for generated frame symbols"
	default "frame"
	help
	  Each frame is named <prefix>_001, <prefix>_002, etc.
	  Change this if you have multiple animations in one project.

source "Kconfig.zephyr"
```

## prj.conf
```kconfig
CONFIG_HEAP_MEM_POOL_SIZE=16384
CONFIG_MAIN_STACK_SIZE=4096

CONFIG_DISPLAY=y

CONFIG_LVGL=y
CONFIG_LV_Z_MEM_POOL_SIZE=16384

CONFIG_LVGL_ANIMATION_VIDEO_PATH=""
CONFIG_LVGL_ANIMATION_FRAME_COUNT=10

CONFIG_LOG=y
```

## src/main.c
```c
/*
 * Copyright (c) 2026 Muhammad Waleed Badar
 *
 * SPDX-License-Identifier: Apache-2.0
 */

/* Generated at build time using video_to_lvgl_frames.py */
#include "img/lvgl_anim_frames.h"

#include <zephyr/kernel.h>
#include <zephyr/device.h>
#include <zephyr/drivers/display.h>

#include <lvgl.h>

#include <zephyr/logging/log.h>
LOG_MODULE_REGISTER(lvgl_anim);

static void frame_set_cb(void *var, int frame_idx)
{
	lv_image_set_src((lv_obj_t *)var, lvgl_anim_frames[(uint32_t)frame_idx]);
}

int main(void)
{
	const struct device *display_dev = DEVICE_DT_GET(DT_CHOSEN(zephyr_display));
	static lv_obj_t *g_img;
	static lv_anim_t g_anim;

	if (!device_is_ready(display_dev)) {
		return -ENODEV;
	}

	display_blanking_off(display_dev);

	g_img = lv_image_create(lv_screen_active());
	lv_image_set_src(g_img, lvgl_anim_frames[0]);

	lv_anim_init(&g_anim);
	lv_anim_set_var(&g_anim, g_img);
	lv_anim_set_exec_cb(&g_anim, frame_set_cb);
	lv_anim_set_values(&g_anim, 0, LVGL_ANIMATION_FRAME_COUNT - 1);
	lv_anim_set_duration(&g_anim, LVGL_ANIMATION_DURATION_MS);
	lv_anim_set_repeat_count(&g_anim, LV_ANIM_REPEAT_INFINITE);
	lv_anim_set_path_cb(&g_anim, lv_anim_path_step);
	lv_anim_start(&g_anim);

	while (1) {
		lv_timer_handler();
		k_msleep(LVGL_ANIMATION_DURATION_MS / LVGL_ANIMATION_FRAME_COUNT);
	}

	return 0;
}
```
