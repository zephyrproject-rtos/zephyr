## CMakeLists.txt
```
# SPDX-License-Identifier: Apache-2.0

cmake_minimum_required(VERSION 3.28.0)

find_package(Zephyr REQUIRED HINTS $ENV{ZEPHYR_BASE})
include(${ZEPHYR_BASE}/cmake/cfb.cmake NO_POLICY_SCOPE)
project(cfb_custom_font)

target_sources(app PRIVATE src/main.c)

set(gen_dir ${ZEPHYR_BINARY_DIR}/include/generated/)
generate_cfb_font_for_target(app fonts/dice.png ${gen_dir}/cfb_font_dice.h 32 32 --first 49 --last 54)
```

## Kconfig
```
# Copyright (c) 2024 TOKITA Hiroshi
# SPDX-License-Identifier: Apache-2.0

mainmenu "CFB Custom Font Sample Application"

config CFB_CUSTOM_FONT_SAMPLE_TRANSFER_BUFFER_SIZE
	int "Buffer size for image transfer"
	default 0

source "Kconfig.zephyr"
```

## sample.yaml
```
common:
  harness: display
  tags: display
sample:
  description: Compact Framebuffer subsystem font example
  name: CFB custom font sample
tests:
  sample.display.cfb_custom_font.ssd16xx:
    platform_allow: reel_board
```

## prj.conf
```kconfig
CONFIG_HEAP_MEM_POOL_SIZE=16384

CONFIG_DISPLAY=y

CONFIG_CHARACTER_FRAMEBUFFER=y
CONFIG_CHARACTER_FRAMEBUFFER_USE_DEFAULT_FONTS=n
```

## boards/longan_nano.conf
```kconfig
CONFIG_HEAP_MEM_POOL_SIZE=4096
CONFIG_CFB_SAMPLE_TRANSFER_BUFFER_SIZE=6400
CONFIG_CFB_SAMPLE_COMMAND_BUFFER_SIZE=128
```

## boards/native_sim.conf
```kconfig
CONFIG_HEAP_MEM_POOL_SIZE=1244160
CONFIG_SDL_DISPLAY_DEFAULT_PIXEL_FORMAT_MONO01=y
```

## boards/native_sim_64.conf
```kconfig
CONFIG_SDL_DISPLAY_DEFAULT_PIXEL_FORMAT_MONO01=y
```

## src/main.c
```c
/*
 * Copyright (c) 2018 Henrik Brix Andersen <henrik@brixandersen.dk>
 *
 * SPDX-License-Identifier: Apache-2.0
 */

#include <zephyr/kernel.h>
#include <zephyr/device.h>
#include <zephyr/display/cfb.h>
#include <zephyr/sys/printk.h>

#include "cfb_font_dice.h"

int main(void)
{
	const struct device *const dev = DEVICE_DT_GET(DT_CHOSEN(zephyr_display));
	struct cfb_display *disp;
	struct cfb_framebuffer *fb;
	int err;

	if (!device_is_ready(dev)) {
		printk("Display device not ready\n");
	}

	if (display_set_pixel_format(dev, PIXEL_FORMAT_MONO10) != 0) {
		if (display_set_pixel_format(dev, PIXEL_FORMAT_MONO01) != 0) {
			printk("Failed to set required pixel format");
			return 0;
		}
	}

	err = display_blanking_off(dev);
	if (err == -ENOSYS) {
		printk("Display blanking off not available");
	} else if (err) {
		printk("Failed to turn off display blanking\n");
		return 0;
	}

	disp = cfb_display_alloc(dev);
	if (!disp) {
		printk("Could not allocate framebuffer\n");
		return 0;
	}

	fb = cfb_display_get_framebuffer(disp);

	err = cfb_framebuffer_clear(fb, true);
	if (err) {
		printk("Could not clear framebuffer (err %d)\n", err);
	}

	err = cfb_print(fb, "123456", 0, 0);
	if (err) {
		printk("Could not display custom font (err %d)\n", err);
	}

	err = cfb_framebuffer_finalize(fb);
	if (err) {
		printk("Could not finalize framebuffer (err %d)\n", err);
	}
	return 0;
}
```
