## CMakeLists.txt
```
# Copyright 2025 NXP
#
# SPDX-License-Identifier: Apache-2.0
#

cmake_minimum_required(VERSION 3.20.0)

find_package(Zephyr REQUIRED HINTS $ENV{ZEPHYR_BASE})
project(gui_guider)

FILE(GLOB_RECURSE app_sources src/*.c)
target_include_directories(app PRIVATE src/generated src/custom src/generated/guider_customer_fonts src/generated/guider_fonts src/generated/images)
target_sources(app PRIVATE ${app_sources})
```

## sample.yaml
```
sample:
  description: GUI Guider sample application
  name: gui guider sample
common:
  tags:
    - display
    - gui
    - gui_guider
    - samples
  modules:
    - lvgl
tests:
  sample.display.gui_guider.gui:
    filter: dt_chosen_enabled("zephyr,display")
    # flash usage varies depending on the platform, but ~200K are the bare
    # minimum, give some room by adding 50K more. RAM usage depends largerly on
    # the display buffer, but a minimum is also required for the system itself.
    # ~25K seem to be sufficient for most cases, rounded to 32K.
    min_flash: 250
    min_ram: 32
    harness: none
    integration_platforms:
      - native_sim/native/64
  sample.display.gui_guider.rk055hdmipi4m:
    tags: shield
    # This sample is intended to test the RT1170 and RT595, which require
    # a display shield to work with LVGL
    min_flash: 250
    # The minimum RAM needed for this display is actually around 8MB,
    # but the RT595 uses external PSRAM for the display buffer
    min_ram: 32
    harness: none
    extra_args: SHIELD="rk055hdmipi4ma0"
    platform_allow:
      - mimxrt1170_evk/mimxrt1176/cm7
      - mimxrt595_evk/mimxrt595s/cm33
    integration_platforms:
      - mimxrt1170_evk/mimxrt1176/cm7
    harness_config:
      fixture: fixture_display_rk055hdmipi4m
  sample.subsys.display.gui_guider.rk043fn66hs_ctg:
    tags: shield
    platform_allow:
      - mimxrt1064_evk
      - mimxrt1060_evk/mimxrt1062/qspi
      - mimxrt1050_evk/mimxrt1052/hyperflash
      - mimxrt1040_evk
    integration_platforms:
      - mimxrt1040_evk
    harness: console
    extra_args: SHIELD=rk043fn66hs_ctg
    harness_config:
      fixture: fixture_display_rk043fn66hs_ctg
  sample.subsys.display.gui_guider.rk043fn02h_ct:
    tags: shield
    platform_allow:
      - mimxrt1064_evk
      - mimxrt1060_evk@C/mimxrt1062/qspi
      - mimxrt1050_evk/mimxrt1052/hyperflash
      - mimxrt1040_evk
    integration_platforms:
      - mimxrt1040_evk
    harness: console
    extra_args: SHIELD=rk043fn02h_ct
    harness_config:
      fixture: fixture_display_rk043fn02h_ct
```

## prj.conf
```kconfig
CONFIG_LV_Z_MEM_POOL_SIZE=65536
CONFIG_MAIN_STACK_SIZE=4096

CONFIG_DISPLAY=y

CONFIG_LOG=y

CONFIG_LVGL=y
CONFIG_LV_USE_LOG=y
```

## src/main.c
```c
/*
 * Copyright 2025 NXP
 *
 * SPDX-License-Identifier: Apache-2.0
 */

#include <zephyr/device.h>
#include <zephyr/drivers/display.h>
#include <lvgl.h>
#include <stdio.h>
#include <string.h>
#include <zephyr/kernel.h>

#include "../generated/gui_guider.h"
#include "../generated/events_init.h"

#define LOG_LEVEL CONFIG_LOG_DEFAULT_LEVEL
#include <zephyr/logging/log.h>
LOG_MODULE_REGISTER(app);

lv_ui guider_ui;

int main(void)
{
	const struct device *display_dev;

	display_dev = DEVICE_DT_GET(DT_CHOSEN(zephyr_display));
	if (!device_is_ready(display_dev)) {
		LOG_ERR("Device not ready, aborting test");
		return 0;
	}

	setup_ui(&guider_ui);
	events_init(&guider_ui);

	lv_timer_handler();
	display_blanking_off(display_dev);

	while (1) {
		uint32_t sleep_ms = lv_timer_handler();

		k_msleep(MIN(sleep_ms, INT32_MAX));
	}

	return 0;
}
```
