## CMakeLists.txt
```
# SPDX-FileCopyrightText: 2026 Muhammad Waleed Badar
# SPDX-License-Identifier: Apache-2.0

cmake_minimum_required(VERSION 3.28.0)

find_package(Zephyr REQUIRED HINTS $ENV{ZEPHYR_BASE})
project(terminal)

target_sources(app PRIVATE src/main.c)
```

## prj.conf
```kconfig
CONFIG_DISPLAY=y
CONFIG_DISPLAY_CONSOLE=y
CONFIG_SERIAL=y
CONFIG_EMUL=y
CONFIG_INPUT=y
CONFIG_LOG=y
CONFIG_LOG_MODE_DEFERRED=y
CONFIG_SHELL=y
CONFIG_HEAP_MEM_POOL_SIZE=4096
```

## lvgl.conf
```kconfig
CONFIG_LVGL=y
CONFIG_DISPLAY_CONSOLE_RENDERER_LVGL=y
CONFIG_LV_FONT_DEFAULT_UNSCII_8=y
CONFIG_LV_Z_MEM_POOL_SIZE=16384
CONFIG_SHELL_DEFAULT_TERMINAL_WIDTH=40
CONFIG_SHELL_DEFAULT_TERMINAL_HEIGHT=26
```

## boards/native_sim.conf
```kconfig
CONFIG_LOG_BACKEND_NATIVE_POSIX=n
```

## boards/native_sim_native_64.conf
```kconfig
CONFIG_LOG_BACKEND_NATIVE_POSIX=n
CONFIG_SHELL_DEFAULT_TERMINAL_WIDTH=32
CONFIG_SHELL_DEFAULT_TERMINAL_HEIGHT=15
```

## app.overlay
```dts
/*
 * SPDX-FileCopyrightText: 2026 Muhammad Waleed Badar
 * SPDX-License-Identifier: Apache-2.0
 */

/ {
	uart_console: uart_console {
		compatible = "zephyr,uart-emul";
		tx-fifo-size = <1024>;
	};

	chosen {
		zephyr,console = &uart_console;
		zephyr,shell-uart = &uart_console;
	};
};
```

## boards/native_sim.overlay
```dts
/*
 * SPDX-FileCopyrightText: 2026 Muhammad Waleed Badar
 * SPDX-License-Identifier: Apache-2.0
 */

#include "../app.overlay"

/ {
	uart_kbd {
		compatible = "zephyr,uart-emul-bridge";
		uart = <&uart0>;
		emul = <&uart_console>;
		direction = "forward";
	};
};
```

## boards/native_sim_native_64.overlay
```dts
/*
 * SPDX-FileCopyrightText: 2026 Muhammad Waleed Badar
 * SPDX-License-Identifier: Apache-2.0
 */

#include "native_sim.overlay"
```

## boards/uedx32480035e_wb_a_esp32s3_procpu.overlay
```dts
/*
 * SPDX-FileCopyrightText: 2026 Muhammad Waleed Badar
 * SPDX-License-Identifier: Apache-2.0
 */

#include "../app.overlay"

/ {
	uart_kbd {
		compatible = "zephyr,uart-emul-bridge";
		uart = <&usb_serial>;
		emul = <&uart_console>;
		direction = "forward";
	};
};
```

## src/main.c
```c
/*
 * SPDX-FileCopyrightText: 2026 Muhammad Waleed Badar
 * SPDX-License-Identifier: Apache-2.0
 */

#include <zephyr/kernel.h>

int main(void)
{
	printk("Press any key!\n");

	return 0;
}
```
