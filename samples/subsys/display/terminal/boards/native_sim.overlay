/*
 * SPDX-FileCopyrightText: 2026 Muhammad Waleed Badar
 * SPDX-License-Identifier: Apache-2.0
 */

#include "../app.overlay"

/ {
	uart_kbd {
		compatible = "zephyr,uart-emul-bridge";
		uart = <&uart0>;
		emul = <&uart_console>;
		direction = "forward";
	};
};
