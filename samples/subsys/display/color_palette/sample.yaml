## samples/subsys/display/color_palette/sample.yaml
```yaml
sample:
  description: Display color palette bands using indexed color formats
  name: color_palette
common:
  tags:
    - display
tests:
  sample.subsys.display.color_palette:
    filter: dt_compat_enabled("zephyr,panel-color-palette") and
            dt_chosen_enabled("zephyr,display")
    harness: none
    integration_platforms:
      - native_sim/native/64
    platform_allow:
      - native_sim/native/64
      - reterminal_e1002/esp32s3/procpu
      - inkplate_6color/esp32/procpu
```

## samples/subsys/display/grove_display/sample.yaml
```yaml
sample:
  name: Grove LCD Sample
tests:
  sample.display.grove_display:
    tags: drivers
    harness: grove
    depends_on: i2c
    filter: dt_proplabel_enabled("I2C_0")
```

## samples/subsys/display/gui_guider/sample.yaml
```yaml
sample:
  description: GUI Guider sample application
  name: gui guider sample
common:
  tags:
    - display
    - gui
    - gui_guider
    - samples
  modules:
    - lvgl
tests:
  sample.display.gui_guider.gui:
    filter: dt_chosen_enabled("zephyr,display")
    # flash usage varies depending on the platform, but ~200K are the bare
    # minimum, give some room by adding 50K more. RAM usage depends largerly on
    # the display buffer, but a minimum is also required for the system itself.
    # ~25K seem to be sufficient for most cases, rounded to 32K.
    min_flash: 250
    min_ram: 32
    harness: none
    integration_platforms:
      - native_sim/native/64
  sample.display.gui_guider.rk055hdmipi4m:
    tags: shield
    # This sample is intended to test the RT1170 and RT595, which require
    # a display shield to work with LVGL
    min_flash: 250
    # The minimum RAM needed for this display is actually around 8MB,
    # but the RT595 uses external PSRAM for the display buffer
    min_ram: 32
    harness: none
    extra_args: SHIELD="rk055hdmipi4ma0"
    platform_allow:
      - mimxrt1170_evk/mimxrt1176/cm7
      - mimxrt595_evk/mimxrt595s/cm33
    integration_platforms:
      - mimxrt1170_evk/mimxrt1176/cm7
    harness_config:
      fixture: fixture_display_rk055hdmipi4m
  sample.subsys.display.gui_guider.rk043fn66hs_ctg:
    tags: shield
    platform_allow:
      - mimxrt1064_evk
      - mimxrt1060_evk/mimxrt1062/qspi
      - mimxrt1050_evk/mimxrt1052/hyperflash
      - mimxrt1040_evk
    integration_platforms:
      - mimxrt1040_evk
    harness: console
    extra_args: SHIELD=rk043fn66hs_ctg
    harness_config:
      fixture: fixture_display_rk043fn66hs_ctg
  sample.subsys.display.gui_guider.rk043fn02h_ct:
    tags: shield
    platform_allow:
      - mimxrt1064_evk
      - mimxrt1060_evk@C/mimxrt1062/qspi
      - mimxrt1050_evk/mimxrt1052/hyperflash
      - mimxrt1040_evk
    integration_platforms:
      - mimxrt1040_evk
    harness: console
    extra_args: SHIELD=rk043fn02h_ct
    harness_config:
      fixture: fixture_display_rk043fn02h_ct
```

## samples/subsys/display/lvgl/Kconfig
```kconfig
# Copyright (c) 2023 Nordic Semiconductor ASA
# SPDX-License-Identifier: Apache-2.0

source "Kconfig.zephyr"

mainmenu "LVGL Sample"

config RESET_COUNTER_SW0
	bool "Reset counter when sw0 is pressed"
	depends on $(dt_alias_enabled,sw0)
	select GPIO
	default y
```

## samples/subsys/display/lvgl/boards/esp32h2_devkitm.conf
```kconfig
CONFIG_LV_USE_THEME_DEFAULT=y
CONFIG_LV_Z_VDB_SIZE=64
CONFIG_LV_DPI_DEF=116
CONFIG_LV_Z_BITS_PER_PIXEL=1
CONFIG_LV_COLOR_DEPTH_1=y
```

## samples/subsys/display/lvgl/boards/esp32s3_box3_procpu.conf
```kconfig
# ESP32-S3-BOX-3 specific config for lvgl sample
CONFIG_SPI=y
CONFIG_GPIO=y
CONFIG_I2C=y
CONFIG_REGULATOR=y

CONFIG_LV_Z_MEM_POOL_SIZE=65536
CONFIG_LV_COLOR_DEPTH_16=y
CONFIG_LV_COLOR_16_SWAP=y

CONFIG_HEAP_MEM_POOL_SIZE=131072
CONFIG_MAIN_STACK_SIZE=8192
```

## samples/subsys/display/lvgl/boards/hsdk.conf
```kconfig
CONFIG_ILI9340=y

CONFIG_LVGL=y
CONFIG_LVGL_HOR_RES_MAX=320
CONFIG_LVGL_VER_RES_MAX=240
CONFIG_LVGL_DPI=100
```

## samples/subsys/display/lvgl/boards/kit_pse84_ai_pse846gps2dbzc4a_m55.conf
```kconfig
# Copyright (c) 2026 Infineon Technologies AG,
# or an affiliate of Infineon Technologies AG.
#
# SPDX-License-Identifier: Apache-2.0

CONFIG_MAIN_STACK_SIZE=8192
CONFIG_INPUT_THREAD_STACK_SIZE=2048
CONFIG_INPUT_FT5336_PERIOD_MS=50

CONFIG_LV_USE_DRAW_VG_LITE=y
CONFIG_LV_Z_VGLITE_HEAP_SIZE=1310720
CONFIG_SYS_HEAP_AUTO=y

CONFIG_LV_Z_VDB_SIZE=100
CONFIG_LV_Z_FULL_REFRESH=y
CONFIG_LV_Z_DOUBLE_VDB=y
CONFIG_LV_Z_VDB_ZEPHYR_REGION=y
CONFIG_LV_Z_VDB_ZEPHYR_REGION_NAME=".cy_gpu_buf"
CONFIG_LV_Z_VDB_ALIGN=64

CONFIG_LV_Z_MEM_POOL_SIZE=32768
CONFIG_LV_Z_MEMORY_POOL_ZEPHYR_REGION=y
CONFIG_LV_Z_MEMORY_POOL_ZEPHYR_REGION_NAME=".cy_gpu_buf"

CONFIG_LV_ATTRIBUTE_MEM_ALIGN_SIZE=64
CONFIG_LV_DRAW_BUF_STRIDE_ALIGN=1
CONFIG_LV_DRAW_BUF_ALIGN=64
```

## samples/subsys/display/lvgl/boards/mimxrt1060_evk.conf
```kconfig
# Copyright 2023 NXP
# SPDX-License-Identifier: Apache-2.0

# Enable PXP DMA engine and set rotation angle to 0 degrees.
# This allows us to verify the DMA driver functions without altering
# the output image
CONFIG_DMA=y
CONFIG_MCUX_ELCDIF_PXP=y
```

## samples/subsys/display/lvgl/boards/mimxrt1060_evk_mimxrt1062_qspi_C.conf
```kconfig
# Copyright 2025 NXP
# SPDX-License-Identifier: Apache-2.0

CONFIG_DMA=y
CONFIG_MCUX_ELCDIF_PXP=y
CONFIG_MAIN_STACK_SIZE=20480
```

## samples/subsys/display/lvgl/boards/mini_stm32h743.conf
```kconfig
# Copyright (c) Charles Dias <charlesdias.cd@outlook.com>
# SPDX-License-Identifier: Apache-2.0

# Enable SPI driver for ST7735R
CONFIG_ST7735R=y
```

## samples/subsys/display/lvgl/boards/native_posix.conf
```kconfig
CONFIG_LV_COLOR_DEPTH_32=y
CONFIG_GPIO=y
CONFIG_KSCAN=y
CONFIG_INPUT=y
CONFIG_LV_Z_POINTER_KSCAN=y
```

## samples/subsys/display/lvgl/boards/qemu_riscv64.conf
```kconfig
# qemu_riscv64 hits a main-thread stack overflow during LVGL redraw with the
# sample defaults. Local validation showed 5 KiB is enough, while the default
# 4 KiB stack overflows during redraw.
CONFIG_LV_COLOR_DEPTH_32=y
CONFIG_MAIN_STACK_SIZE=5120

# Disable the shell on this target to avoid extra stack and console pressure
# while bringing up the ramfb-based LVGL sample under QEMU.
CONFIG_SHELL=n
```

## samples/subsys/display/lvgl/boards/stm32f429i_disc1.conf
```kconfig
CONFIG_KSCAN=y

CONFIG_LV_Z_POINTER_KSCAN=y
CONFIG_LV_Z_POINTER_KSCAN_DEV_NAME="STMPE811"
CONFIG_LV_Z_POINTER_KSCAN_SWAP_XY=y
CONFIG_LV_Z_POINTER_KSCAN_MSGQ_COUNT=30
```

## samples/subsys/display/lvgl/boards/stm32f469i_disco.conf
```kconfig
# Copyright (c) Philippe Peurichard <p.peurichard@gmail.com>
# SPDX-License-Identifier: Apache-2.0

# Enable Input driver for touch screen
CONFIG_INPUT=y
```

## samples/subsys/display/lvgl/sample.yaml
```yaml
sample:
  description: LVGL sample application
  name: lvgl
common:
  tags:
    - display
    - gui
    - lvgl
    - samples
  modules:
    - lvgl
tests:
  sample.display.lvgl.gui:
    filter: dt_chosen_enabled("zephyr,display")
    # flash usage varies depending on the platform, but ~200K are the bare
    # minimum, give some room by adding 50K more. RAM usage depends largerly on
    # the display buffer, but a minimum is also required for the system itself.
    # ~25K seem to be sufficient for most cases, rounded to 32K.
    min_flash: 250
    min_ram: 32
    harness: none
    integration_platforms:
      - native_sim/native/64
  sample.display.lvgl.rk055hdmipi4m:
    tags: shield
    # This sample is intended to test the RT1170 and RT595, which require
    # a display shield to work with LVGL
    min_flash: 250
    # The minimum RAM needed for this display is actually around 8MB,
    # but the RT595 uses external PSRAM for the display buffer
    min_ram: 32
    harness: none
    extra_args: SHIELD="rk055hdmipi4ma0"
    platform_allow:
      - mimxrt1170_evk/mimxrt1176/cm7
      - mimxrt595_evk/mimxrt595s/cm33
    integration_platforms:
      - mimxrt1170_evk/mimxrt1176/cm7
    harness_config:
      fixture: fixture_display_rk055hdmipi4m
  sample.subsys.display.lvgl.st_b_lcd40_dsi1_mb1166:
    tags: shield
    filter: dt_compat_enabled("orisetech,otm8009a")
    platform_allow: stm32h747i_disco/stm32h747xx/m7
    extra_args: SHIELD=st_b_lcd40_dsi1_mb1166
    harness: console
    harness_config:
      fixture: fixture_display
  sample.subsys.display.lvgl.st_b_lcd40_dsi1_mb1166_a09:
    tags: shield
    filter: dt_compat_enabled("frida,nt35510")
    platform_allow: stm32h747i_disco/stm32h747xx/m7
    extra_args: SHIELD=st_b_lcd40_dsi1_mb1166_a09
    harness: console
    harness_config:
      fixture: fixture_display
  sample.subsys.display.lvgl.rk043fn66hs_ctg:
    tags: shield
    platform_allow:
      - mimxrt1064_evk
      - mimxrt1060_evk/mimxrt1062/qspi
      - mimxrt1050_evk/mimxrt1052/hyperflash
      - mimxrt1040_evk
    integration_platforms:
      - mimxrt1040_evk
    harness: console
    extra_args: SHIELD=rk043fn66hs_ctg
    harness_config:
      fixture: fixture_display_rk043fn66hs_ctg
  sample.subsys.display.lvgl.rk043fn02h_ct:
    tags: shield
    platform_allow:
      - mimxrt1064_evk
      - mimxrt1060_evk@C/mimxrt1062/qspi
      - mimxrt1050_evk/mimxrt1052/hyperflash
      - mimxrt1040_evk
    integration_platforms:
      - mimxrt1040_evk
    harness: console
    extra_args: SHIELD=rk043fn02h_ct
    harness_config:
      fixture: fixture_display_rk043fn02h_ct
  sample.subsys.display.lvgl.renesas_ra_glcdc:
    tags:
      - shield
    filter: dt_compat_enabled("renesas,ra-glcdc")
    extra_args:
      - platform:ek_ra8d1/r7fa8d1bhecbd:SHIELD=rtkmipilcdb00000be
      - platform:ek_ra8d1/r7fa8d1bhecbd:SHIELD="rtk7eka6m3b00001bu;ek_ra8d1_rtk7eka6m3b00001bu"
    harness_config:
      fixture: fixture_display
  sample.subsys.display.lvgl.seeed_xiao_round_display:
    tags: shield
    min_flash: 320
    min_ram: 64
    depends_on:
      - xiao_adc
      - xiao_gpio
      - xiao_i2c
      - xiao_spi
    integration_platforms:
      - xiao_ble
      - xiao_esp32s3/esp32s3/procpu
    extra_args: SHIELD=seeed_xiao_round_display
    harness: console
    harness_config:
      fixture: fixture_seeed_xiao_round_display
```

## samples/subsys/display/lvgl_anim/Kconfig
```kconfig
# Copyright (c) 2026 Muhammad Waleed Badar
# SPDX-License-Identifier: Apache-2.0

mainmenu "LVGL Animation Sample"

config LVGL_ANIMATION_VIDEO_PATH
	string "Absolute path to the source video file"
	default ""
	help
	  Full path to the video file passed to video_to_lvgl_frames.py.
	  Example: CONFIG_LVGL_ANIMATION_VIDEO_PATH="/home/user/clips/intro.mp4"

config LVGL_ANIMATION_FRAME_COUNT
	int "Number of frames to extract from the video"
	default 10
	help
	  Evenly-spaced frames extracted from the source video.
	  More frames = smoother animation, more flash usage.

config LVGL_ANIMATION_FIT
	string "Fit mode for video scaling"
	default "crop"
	help
	  How to handle aspect-ratio mismatch between video and display:
	    crop       - scale to fill, center-crop the overflow (default)
	    letterbox  - scale to fit, pad remainder with black bars
	    stretch    - scale to fill exactly, ignoring aspect ratio

config LVGL_ANIMATION_PREFIX
	string "C variable name prefix for generated frame symbols"
	default "frame"
	help
	  Each frame is named <prefix>_001, <prefix>_002, etc.
	  Change this if you have multiple animations in one project.

source "Kconfig.zephyr"
```

## samples/subsys/ebpf/cpu_profiler/sample.yaml
```yaml
# SPDX-FileCopyrightText: Copyright 2026 NXP
# SPDX-License-Identifier: Apache-2.0

sample:
  name: eBPF CPU Profiler
  description: >
    Real-time CPU utilisation monitor with a 6-bucket idle-duration
    histogram built entirely from eBPF bytecode running on the idle
    enter/exit tracepoints.

common:
  platform_allow:
    - native_sim
    - qemu_cortex_m3
    - qemu_x86
  tags: ebpf

tests:
  sample.ebpf.cpu_profiler:
    integration_platforms:
      - frdm_mcxn236
    platform_allow:
      - frdm_mcxn236
    harness: console
    harness_config:
      type: one_line
      regex:
        - "eBPF programs detached\\. Profiling complete\\."
    tags: ebpf
```
