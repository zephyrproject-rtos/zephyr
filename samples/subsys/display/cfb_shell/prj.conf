## CMakeLists.txt
```
# SPDX-License-Identifier: Apache-2.0

cmake_minimum_required(VERSION 3.28.0)

find_package(Zephyr REQUIRED HINTS $ENV{ZEPHYR_BASE})
project(cfb)

FILE(GLOB app_sources src/*.c)
target_sources(app PRIVATE ${app_sources})
```

## sample.yaml
```
common:
  harness: display
  tags: display
sample:
  description: Compact Framebuffer subsystem shell test
  name: CFB shell sample
tests:
  sample.display.cfb_shell.ssd1306:
    platform_allow: frdm_k64f
    extra_args: SHIELD=ssd1306_128x32
    tags: shield
  sample.display.cfb_shell.ssd16xx:
    platform_allow: reel_board
```

## prj.conf
```kconfig
CONFIG_BOOT_BANNER=n
CONFIG_HEAP_MEM_POOL_SIZE=16384
CONFIG_DISPLAY=y
CONFIG_CHARACTER_FRAMEBUFFER=y
CONFIG_SHELL=y
CONFIG_CHARACTER_FRAMEBUFFER_SHELL=y
```

## boards/reel_board.conf
```kconfig
CONFIG_SPI=y
CONFIG_SSD16XX=y
```

## src/main.c
```c
/*
 * Copyright (c) 2018 Diego Sueiro
 *
 * SPDX-License-Identifier: Apache-2.0
 */

#include <logging/log.h>

LOG_MODULE_REGISTER(app);
```
