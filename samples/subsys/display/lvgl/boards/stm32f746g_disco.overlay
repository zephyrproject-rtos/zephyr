/*
 * Copyright (c) 2023, Fabian Blatz <fabianblatz@gmail.com>
 *
 * SPDX-License-Identifier: Apache-2.0
 */

/ {
	lvgl_pointer_input {
		compatible = "zephyr,lvgl-pointer-input";
		input = <&ft5336>;
	};
};
