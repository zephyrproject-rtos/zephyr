
/ {

	arduino_header: connector {
		compatible = "arduino-header-r3";
		#gpio-cells = <2>;
		gpio-map-mask = <0xffffffff 0xffffffc0>;
		gpio-map-pass-thru = <0 0x3f>;
		gpio-map = 
				<0 0 &gpio0 14 0>,	/* A0 */
				<1 0 &gpio0 13 0>,	/* A1 */
				<2 0 &gpio0 12 0>,	/* A2 */
				<3 0 &gpio0 11 0>,	/* A3 */
				<4 0 &gpio0 1 0>,	/* A4 */
				<5 0 &gpio0 2 0>,	/* A5 */
				<6 0 &gpio1 6 0>,	/* D0 *//* O38 */
				<7 0 &gpio1 5 0>,	/* D1 *//* O37 */
				<8 0 &gpio1 4 0>,	/* D2 *//* O36 */
				<9 0 &gpio0 8 0>,	/* D3 */
				<10 0 &gpio0 15 0>,	/* D4 */
				<11 0 &gpio1 16 0>,	/* D5 *//* O48 */
				<12 0 &gpio0 17 0>,	/* D6 */
				<13 0 &gpio0 18 0>,	/* D7 */
				<14 0 &gpio0 4 0>,	/* D8 */
				<15 0 &gpio0 5 0>,	/* D9 */
				<16 0 &gpio0 6 0>,	/* D10 */
				<17 0 &gpio0 7 0>,	/* D11 */
				<18 0 &gpio1 15 0>,	/* D12 *//* O47 */
				<19 0 &gpio0 16 0>,	/* D13 */
				<20 0 &gpio0 21 0>,	/* D14 */
				<21 0 &gpio1 3 0>;	/* D15 *//* O35 */
	};
	
/*
	chosen { 
		zephyr,console = &usb_serial;
    	zephyr,shell-uart = &usb_serial;
	};
	*/	
};

/*
&usb_serial {
	status = "okay";
};
*/

/*
&ili9844 {
	reset-gpios = <
};
*/


