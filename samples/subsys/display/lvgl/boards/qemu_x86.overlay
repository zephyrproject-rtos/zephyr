/*
 * Copyright (c) 2026 Carlo Caione <ccaione@baylibre.com>
 *
 * SPDX-License-Identifier: Apache-2.0
 */

#include <zephyr/dt-bindings/input/input-event-codes.h>
#include <zephyr/dt-bindings/lvgl/lvgl.h>

/ {
	lvgl_keypad_input {
		compatible = "zephyr,lvgl-keypad-input";
		input = <&input0>;
		input-codes = <INPUT_KEY_LEFT INPUT_KEY_RIGHT INPUT_KEY_ENTER>;
		lvgl-codes = <LV_KEY_LEFT LV_KEY_RIGHT LV_KEY_ENTER>;
	};
};

/* Use a smaller framebuffer to keep software rendering responsive under TCG. */
&ramfb0 {
	width = <480>;
	height = <272>;
};
