/*
 * Copyright (c) 2026 Nordic Semiconductor ASA
 *
 * SPDX-License-Identifier: Apache-2.0
 */

/ {
	chosen {
		zephyr,code-partition = &boot_partition;
	};

	ffatdisk0 {
		compatible = "zephyr,ffat-disk";
		disk-name = "UF2";
		sector-size = <512>;
		sector-count = <32768>;
		sector-per-cluster = <1>;
	};
};
