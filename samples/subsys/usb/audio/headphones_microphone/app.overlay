/*
 * Copyright (c) 2019 Nordic Semiconductor ASA
 *
 * SPDX-License-Identifier: Apache-2.0
 */

&zephyr_udc0 {
	hp_0 {
		compatible = "usb-audio-hp";
		feature-mute;
		channel-l;
		channel-r;

		feature-volume;
		volume-max = <0x0500>;
		volume-min = <0xBA00>;
		volume-res = <0x100>;
	};
	mic_0 {
		compatible = "usb-audio-mic";
		feature-mute;
		channel-l;
		channel-r;
	};
};
