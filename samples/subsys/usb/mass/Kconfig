## samples/subsys/usb/mass/Kconfig
```kconfig
# Copyright (c) 2019-2020 Nordic Semiconductor ASA
# SPDX-License-Identifier: Apache-2.0

config APP_WIPE_STORAGE
	bool "Option to clear the flash area before mounting"
	help
	  Use this to force an existing file system to be created.

choice
	prompt "Storage and file system type used by the application"
	default APP_MSC_STORAGE_NONE
	help
	  Specify the type of storage and file system.

config APP_MSC_STORAGE_NONE
	bool "Use RAM disk as block device"

config APP_MSC_STORAGE_RAM
	bool "Use RAM disk and FAT file system"
	imply FILE_SYSTEM
	imply FAT_FILESYSTEM_ELM

config APP_MSC_STORAGE_FLASH_FATFS
	bool "Use FLASH disk and FAT file system"
	imply DISK_DRIVER_FLASH
	imply FILE_SYSTEM
	imply FAT_FILESYSTEM_ELM

config APP_MSC_STORAGE_FLASH_LITTLEFS
	bool "Use FLASH disk and LittleFS"
	imply DISK_DRIVER_FLASH
	imply FILE_SYSTEM
	imply FILE_SYSTEM_LITTLEFS

config APP_MSC_STORAGE_SDCARD
	bool "Use SDHC and FAT file system"
	imply DISK_DRIVER_SDMMC
	imply FILE_SYSTEM
	imply FAT_FILESYSTEM_ELM

endchoice

config MASS_STORAGE_DISK_NAME
	default "NAND" if DISK_DRIVER_FLASH
	default "RAM" if DISK_DRIVER_RAM
	default "SD" if DISK_DRIVER_SDMMC

if DISK_DRIVER_FLASH

config FLASH_MAP
	default y

config FLASH_PAGE_LAYOUT
	default y

config FLASH_LOG_LEVEL
	default 3

if NORDIC_QSPI_NOR

config NORDIC_QSPI_NOR_FLASH_LAYOUT_PAGE_SIZE
	default 4096

endif # NORDIC_QSPI_NOR

endif # DISK_DRIVER_FLASH

source "Kconfig.zephyr"
```

## samples/subsys/usb/mass/boards/adafruit_feather_nrf52840.conf
```kconfig
# qspi NOR driver
CONFIG_NORDIC_QSPI_NOR=y
CONFIG_NORDIC_QSPI_NOR_FLASH_LAYOUT_PAGE_SIZE=4096

# flash
CONFIG_FLASH_MAP=y
CONFIG_FLASH_PAGE_LAYOUT=y

# mass storage
CONFIG_MASS_STORAGE_DISK_NAME="NAND"

# disk
CONFIG_DISK_ACCESS_FLASH=y
CONFIG_DISK_FLASH_DEV_NAME="GD25Q16"
CONFIG_DISK_FLASH_START=0x0
CONFIG_DISK_VOLUME_SIZE=0x200000
CONFIG_DISK_FLASH_MAX_RW_SIZE=4096
CONFIG_DISK_FLASH_ERASE_ALIGNMENT=0x1000
CONFIG_DISK_ERASE_BLOCK_SIZE=0x1000

# file system
CONFIG_FILE_SYSTEM=y
CONFIG_FAT_FILESYSTEM_ELM=y
```

## samples/subsys/usb/mass/boards/apollo510_evb.conf
```kconfig
# Copyright (c) 2025 Ambiq Micro Inc. <www.ambiq.com>
# SPDX-License-Identifier: Apache-2.0
CONFIG_MMC_DDR50=y
CONFIG_MMC_CARD_8BIT_WIDTH=y
```

## samples/subsys/usb/mass/boards/nrf52840dk_nrf52840.conf
```kconfig
# Storage is on MX25R64
CONFIG_NORDIC_QSPI_NOR=y
CONFIG_NORDIC_QSPI_NOR_FLASH_LAYOUT_PAGE_SIZE=4096

# Must match the registered name for the selected disk access variant:
# "RAM" via DISK_RAM_VOLUME_NAME for DISK_ACCESS_RAM
# "NAND" via DISK_FLASH_VOLUME_NAME for DISK_ACCESS_FLASH
CONFIG_MASS_STORAGE_DISK_NAME="NAND"

CONFIG_FILE_SYSTEM=y
CONFIG_FILE_SYSTEM_LITTLEFS=y
CONFIG_FLASH_LOG_LEVEL_INF=y

CONFIG_FLASH_MAP=y
CONFIG_FLASH_PAGE_LAYOUT=y

CONFIG_DISK_ACCESS_FLASH=y
CONFIG_DISK_FLASH_DEV_NAME="MX25R64"
CONFIG_DISK_FLASH_START=0x0
CONFIG_DISK_VOLUME_SIZE=0x10000
CONFIG_DISK_FLASH_MAX_RW_SIZE=4096
CONFIG_DISK_FLASH_ERASE_ALIGNMENT=0x1000
CONFIG_DISK_ERASE_BLOCK_SIZE=0x1000
```

## samples/subsys/usb/mass/boards/sensortile_box_pro.conf
```kconfig
#
# Copyright (c) 2022 O.S.Systems
#
# SPDX-License-Identifier: Apache-2.0
#
CONFIG_MAIN_STACK_SIZE=2048
CONFIG_COMMON_LIBC_MALLOC_ARENA_SIZE=8192

CONFIG_DISK_ACCESS=y
CONFIG_DISK_DRIVERS=y
CONFIG_DISK_DRIVER_SDMMC=y

CONFIG_FILE_SYSTEM=y
CONFIG_FAT_FILESYSTEM_ELM=y

CONFIG_APP_MSC_STORAGE_SDCARD=y
```

## samples/subsys/usb/mass/boards/stm32l562e_dk_ns.conf
```kconfig
#
# Copyright (c) 2022 O.S.Systems
#
# SPDX-License-Identifier: Apache-2.0
#
CONFIG_MAIN_STACK_SIZE=2048
CONFIG_MINIMAL_LIBC_MALLOC_ARENA_SIZE=8192

CONFIG_DISK_ACCESS=y
CONFIG_DISK_DRIVERS=y
CONFIG_DISK_DRIVER_SDMMC=y

CONFIG_FILE_SYSTEM=y
CONFIG_FAT_FILESYSTEM_ELM=y

CONFIG_APP_MSC_STORAGE_SDCARD=y
CONFIG_SDMMC_STM32_HWFC=y

CONFIG_BUILD_WITH_TFM=y
CONFIG_TFM_PROFILE_TYPE_LARGE=y
```

## samples/subsys/usb/mass/sample.yaml
```yaml
sample:
  name: Mass Storage
tests:
  sample.usbd.mass_ram_none:
    min_ram: 128
    depends_on: usbd
    integration_platforms:
      - nrf52840dk/nrf52840
      - nrf54h20dk/nrf54h20/cpuapp
      - frdm_k64f
      - stm32f723e_disco
      - nucleo_f413zh
      - mimxrt685_evk/mimxrt685s/cm33
      - mimxrt1060_evk/mimxrt1062/qspi
      - max32690evkit/max32690/m4
    extra_args:
      - EXTRA_DTC_OVERLAY_FILE="ramdisk.overlay"
    tags:
      - usb
    harness: console
    harness_config:
      type: multi_line
      ordered: true
      regex:
        - "No file system selected"
        - "The device is put in USB mass storage mode"
  sample.usbd.mass_ram_fat:
    min_ram: 128
    depends_on: usbd
    integration_platforms:
      - nrf52840dk/nrf52840
      - nrf54h20dk/nrf54h20/cpuapp
      - frdm_k64f
      - stm32f723e_disco
      - nucleo_f413zh
      - mimxrt685_evk/mimxrt685s/cm33
      - mimxrt1060_evk/mimxrt1062/qspi
    extra_args:
      - EXTRA_DTC_OVERLAY_FILE="ramdisk.overlay"
    extra_configs:
      - CONFIG_APP_MSC_STORAGE_RAM=y
    tags:
      - usb
    harness: console
    harness_config:
      type: multi_line
      ordered: true
      regex:
        - "End of files"
        - "The device is put in USB mass storage mode"
  sample.usbd.mass_flash_fatfs:
    min_ram: 32
    modules:
      - fatfs
    depends_on: usbd
    filter: dt_compat_enabled("nordic,qspi-nor")
    platform_allow:
      - nrf52840dk/nrf52840
      - nrf5340dk/nrf5340/cpuapp
      - adafruit_feather_nrf52840/nrf52840/sense
    integration_platforms:
      - nrf52840dk/nrf52840
    extra_configs:
      - CONFIG_APP_MSC_STORAGE_FLASH_FATFS=y
    tags:
      - usb
    harness: console
    harness_config:
      type: multi_line
      ordered: true
      regex:
        - "End of files"
        - "The device is put in USB mass storage mode"
  sample.usbd.mass_sdhc_fatfs:
    min_ram: 32
    filter: dt_compat_enabled("zephyr,sdmmc-disk")
    modules:
      - fatfs
    depends_on:
      - usbd
      - sdhc
    extra_configs:
      - CONFIG_APP_MSC_STORAGE_SDCARD=y
    tags:
      - usb
    harness: console
    harness_config:
      fixture: fixture_sdcard
      type: multi_line
      ordered: true
      regex:
        - "End of files"
        - "The device is put in USB mass storage mode"
  sample.usbd.mass_flash_littlefs:
    modules:
      - littlefs
    min_ram: 32
    depends_on: usbd
    filter: dt_compat_enabled("nordic,qspi-nor")
    platform_allow:
      - nrf52840dk/nrf52840
      - nrf5340dk/nrf5340/cpuapp
      - adafruit_feather_nrf52840/nrf52840/sense
    integration_platforms:
      - nrf52840dk/nrf52840
    extra_configs:
      - CONFIG_APP_MSC_STORAGE_FLASH_LITTLEFS=y
    tags:
      - usb
    harness: console
    harness_config:
      type: multi_line
      ordered: true
      regex:
        - "End of files"
        - "The device is put in USB mass storage mode"
```

## samples/subsys/usb/midi/Kconfig
```kconfig
# Copyright (c) 2024 Titouan Christophe
# SPDX-License-Identifier: Apache-2.0

# Source common USB sample options used to initialize new experimental USB
# device stack. The scope of these options is limited to USB samples in project
# tree, you cannot use them in your own application.
source "samples/subsys/usb/common/Kconfig.sample_usbd"

source "Kconfig.zephyr"
```

## samples/subsys/usb/midi/sample.yaml
```yaml
sample:
  name: USB MIDI 2.0 device class sample
tests:
  sample.usb_device_next.midi:
    depends_on: usbd
    tags: usb
    harness: console
    harness_config:
      type: one_line
      regex:
        - "USB device support enabled"
```

## samples/subsys/usb/printer/Kconfig
```kconfig
# Copyright (c) 2024 Nordic Semiconductor ASA
# SPDX-License-Identifier: Apache-2.0

source "Kconfig.zephyr"

config USB_PRINTER_SAMPLE_DEVICE_ID
	string "IEEE 1284 Device ID string"
	default "MFG:Zephyr;MDL:USB-Printer;CMD:PJL,PCL;CLS:PRINTER;DES:Zephyr USB Printer Sample;VER:1.0;"
	help
	  IEEE 1284 Device ID string reported by the printer.

config USB_PRINTER_SAMPLE_RING_BUF_SIZE
	int "Size of receive ring buffer"
	default 1024
	range 256 4096
	help
	  Size of the ring buffer used for receiving print data.

config USB_PRINTER_SAMPLE_PCL_SUPPORT
	bool "Enable PCL command support"
	default y
	help
	  Enable support for PCL printer commands.

config USB_PRINTER_SAMPLE_PJL_SUPPORT
	bool "Enable PJL job control"
	default y
	depends on USB_PRINTER_SAMPLE_PCL_SUPPORT
	help
	  Enable support for PJL job control commands.

config USB_PRINTER_SAMPLE_TEST_PAGE
	bool "Enable test page support"
	default y
	help
	  Enable built-in test page generation.

config USB_PRINTER_SAMPLE_SIMULATED_ERRORS
	bool "Enable error simulation"
	default y
	help
	  Enable simulated paper out errors for testing.

config USB_PRINTER_SAMPLE_JOB_QUEUE_SIZE
	int "Maximum number of queued print jobs"
	default 5
	range 1 20
	help
	  Maximum number of print jobs that can be queued.
	  Each job requires memory for tracking status.

config USB_PRINTER_SAMPLE_PJL_BUFFER_SIZE
	int "Size of PJL response buffer"
	default 256
	range 128 1024
	depends on USB_PRINTER_SAMPLE_PJL_SUPPORT
	help
	  Size of buffer used for PJL response generation.
```

## samples/subsys/usb/printer/boards/rpi_pico.conf
```kconfig
# Increase USB buffer sizes for Pico
CONFIG_USB_DEVICE_BULK_EP_MPS=64
CONFIG_USB_PRINTER_SAMPLE_RING_BUF_SIZE=2048

# Optimize memory usage
CONFIG_HEAP_MEM_POOL_SIZE=2048
CONFIG_MAIN_STACK_SIZE=2048
CONFIG_USB_DEVICE_STACK_NEXT=y

# Enable USB logging for debugging
CONFIG_USB_DRIVER_LOG_LEVEL_INF=y
CONFIG_USB_DEVICE_LOG_LEVEL_INF=y
```

## samples/subsys/usb/shell/boards/qemu_cortex_m3.conf
```kconfig
# Copyright (c) 2022 Nordic Semiconductor ASA
# SPDX-License-Identifier: Apache-2.0

CONFIG_UHC_DRIVER=y
CONFIG_USB_HOST_STACK=y
```

## samples/subsys/usb/shell/sample.yaml
```yaml
sample:
  name: USB support shell sample
tests:
  sample.usbd.shell:
    depends_on:
      - usbd
    tags:
      - usb
    extra_args:
      - FILE_SUFFIX=device
    integration_platforms:
      - nrf52840dk/nrf52840
      - nrf54h20dk/nrf54h20/cpuapp
      - frdm_k64f
      - mimxrt685_evk/mimxrt685s/cm33
      - mimxrt1060_evk/mimxrt1062/qspi
    harness: keyboard
  sample.usbh.shell:
    depends_on:
      - usbh
    tags:
      - usb
    extra_args:
      - FILE_SUFFIX=host
    platform_allow:
      - rd_rw612_bga
    build_only: true
  sample.usbh.shell.shield:
    depends_on:
      - usbd
    tags:
      - usb
      - shield
    extra_args:
      - FILE_SUFFIX=device_and_host
      - SHIELD="sparkfun_max3421e"
    platform_allow:
      - nrf52840dk/nrf52840
      - frdm_k64f
    build_only: true
  sample.usbh.shell.virtual:
    tags:
      - usb
    extra_args:
      - FILE_SUFFIX=device_and_host
      - EXTRA_DTC_OVERLAY_FILE="virtual.overlay"
    platform_allow:
      - native_sim/native/64
    build_only: true
```

## samples/subsys/usb/testusb/sample.yaml
```yaml
sample:
  name: USB device loopback sample
tests:
  sample.usbd.loopback:
    depends_on: usbd
    build_only: true
    tags: usb
```

## samples/subsys/usb/uac2_explicit_feedback/Kconfig
```kconfig
# Copyright (c) 2023-2024 Nordic Semiconductor ASA
# SPDX-License-Identifier: Apache-2.0

menu "UAC2 external feedback sample options"

config APP_USE_I2S_LRCLK_EDGES_COUNTER
	bool "Measure I2S LRCLK edges directly"
	help
	  Use this to use I2S LRCLK edge counting for calculating feedback.
	  On nRF53 this option requires externally connecting I2S LRCLK back to
	  separate GPIOTE input pin (P1.09).
endmenu

# Source common USB sample options used to initialize new experimental USB
# device stack. The scope of these options is limited to USB samples in project
# tree, you cannot use them in your own application.
source "samples/subsys/usb/common/Kconfig.sample_usbd"

source "Kconfig.zephyr"
```

## samples/subsys/usb/uac2_explicit_feedback/boards/nrf54h20dk_nrf54h20_cpuapp.conf
```kconfig
# Enable timer for asynchronous feedback
CONFIG_NRFX_GPPI=y
CONFIG_NRFX_TIMER131=y
CONFIG_NRFX_GPIOTE130=y
```

## samples/subsys/usb/uac2_explicit_feedback/sample.yaml
```yaml
sample:
  name: USB Audio 2 asynchronous explicit feedback sample
tests:
  sample.subsys.usb.uac2_explicit_feedback:
    depends_on:
      - usbd
      - i2s
    tags:
      - usb
      - i2s
    extra_configs:
      - CONFIG_CLOCK_CONTROL_NRF=n
    platform_allow:
      - nrf5340dk/nrf5340/cpuapp
      - nrf54h20dk/nrf54h20/cpuapp
    harness: TBD

  sample.subsys.usb.uac2_explicit_feedback.legacy:
    depends_on:
      - usbd
      - i2s
    tags:
      - usb
      - i2s
    extra_configs:
      - CONFIG_CLOCK_CONTROL_NRF=y
      - CONFIG_DEPRECATION_TEST=y
    platform_allow:
      - nrf5340dk/nrf5340/cpuapp
      - nrf54h20dk/nrf54h20/cpuapp
    harness: TBD
```

## samples/subsys/usb/uac2_implicit_feedback/boards/nrf54h20dk_nrf54h20_cpuapp.conf
```kconfig
# Enable timer for asynchronous feedback
CONFIG_NRFX_GPPI=y
CONFIG_NRFX_TIMER131=y
```

## samples/subsys/usb/uac2_implicit_feedback/sample.yaml
```yaml
sample:
  name: USB Audio 2 asynchronous implicit feedback sample
tests:
  sample.subsys.usb.uac2_implicit_feedback:
    depends_on:
      - usbd
      - i2s
    tags:
      - usb
      - i2s
    platform_allow:
      - nrf5340dk/nrf5340/cpuapp
      - nrf54h20dk/nrf54h20/cpuapp
    harness: TBD
```

## samples/subsys/usb/usbd-dfu/sample.yaml
```yaml
sample:
  name: USB DFU sample
common:
  min_ram: 128
  depends_on:
    - usbd
  integration_platforms:
    - nrf52840dk/nrf52840
    - frdm_k64f
    - nucleo_f413zh
    - mimxrt1060_evk
tests:
  sample.usbd.dfu:
    tags: usb
```

## samples/subsys/usb/usbd/sample.yaml
```yaml
sample:
  name: USBD loopback sample
tests:
  sample.usb.loopback:
    depends_on: usb_device
    tags: usb
    harness: button
```

## samples/subsys/usb/userial/quectel/sample.yaml
```yaml
sample:
  description: quectel usb serial example
  name: usbh quectel driver
common:
  tags: introduction
  integration_platforms:
    - native_sim
  harness: console
  harness_config:
    type: one_line
    regex:
      - ""
tests:
  sample.basic.helloworld:
    tags: introduction
```

## samples/subsys/usb/uvc/Kconfig
```kconfig
# Copyright The Zephyr Project Contributors
# SPDX-License-Identifier: Apache-2.0

# Source common USB sample options used to initialize new experimental USB
# device stack. The scope of these options is limited to USB samples in project
# tree, you cannot use them in your own application.
source "samples/subsys/usb/common/Kconfig.sample_usbd"

menu "UVC specific configuration"

config VIDEO_MAX_RANGE_RESOLUTIONS
	int "Maximum number of intermediate resolutions"
	default 5
	help
	   Control the maximum number of resolution that will be advertised
	   to the USB client in case of the video capture supports a range
	   of resolutions.

endmenu

source "Kconfig.zephyr"
```
