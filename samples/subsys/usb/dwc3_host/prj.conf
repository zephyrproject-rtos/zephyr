## CMakeLists.txt
```
# SPDX-FileCopyrightText: Copyright The Zephyr Project Contributors
# SPDX-License-Identifier: Apache-2.0

cmake_minimum_required(VERSION 3.20.0)

find_package(Zephyr REQUIRED HINTS $ENV{ZEPHYR_BASE})
project(usb_dwc3_host)

target_sources(app PRIVATE src/main.c)
```

## prj.conf
```kconfig
CONFIG_USB_HOST_STACK=y
CONFIG_UHC_DRIVER=y
CONFIG_UHC_DWC3=y
CONFIG_MAIN_STACK_SIZE=4096
```

## boards/versal_apu.overlay
```dts
/*
 * SPDX-FileCopyrightText: Copyright The Zephyr Project Contributors
 * SPDX-License-Identifier: Apache-2.0
 */

#include <zephyr/dt-bindings/interrupt-controller/arm-gic.h>

&soc {
	zephyr_uhc0: usb_host@fe200000 {
		compatible = "snps,dwc3";
		reg = <0x00 0xfe200000 0x00 0x10000>,
		      <0x00 0xff9d0000 0x00 0x100>;
		reg-names = "core", "usb2_wrapper";
		interrupts = <GIC_SPI 22 IRQ_TYPE_LEVEL IRQ_DEFAULT_PRIORITY>;
		zephyr,maximum-speed = "high-speed";
		status = "okay";
	};
};
```

## src/main.c
```c
/*
 * SPDX-FileCopyrightText: Copyright The Zephyr Project Contributors
 *
 * SPDX-License-Identifier: Apache-2.0
 */

#include <zephyr/device.h>
#include <zephyr/kernel.h>

int main(void)
{
	const struct device *uhc = DEVICE_DT_GET(DT_NODELABEL(zephyr_uhc0));

	printk("DWC3 xHCI host sample\n");

	if (!device_is_ready(uhc)) {
		printk("UHC device not ready\n");
		return 1;
	}

	printk("DWC3 UHC device ready\n");

	return 0;
}
```
