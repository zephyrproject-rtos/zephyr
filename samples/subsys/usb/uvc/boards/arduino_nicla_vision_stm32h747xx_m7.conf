## samples/subsys/usb/uvc/boards/arduino_nicla_vision_stm32h747xx_m7.conf
```kconfig
# SPDX-FileCopyrightText: Copyright The Zephyr Project Contributors
# SPDX-License-Identifier: Apache-2.0

# Enough two 320x240 YUYV frames
CONFIG_VIDEO_BUFFER_POOL_HEAP_SIZE=327680
```

## samples/subsys/usb/uvc/boards/mini_stm32h743.conf
```kconfig
# Switch the log back-end from to CDC-ACM to UART
CONFIG_USBD_CDC_ACM_CLASS=n
CONFIG_UART_CONSOLE=y
CONFIG_SERIAL=y
```

## samples/subsys/usb/uvc/boards/nrf52840dongle.conf
```kconfig
# Switch from CDC ACM to UART
CONFIG_USB_DEVICE_STACK=n
CONFIG_USBD_CDC_ACM_CLASS=n
CONFIG_UART_CONSOLE=y
CONFIG_SERIAL=y
```

## samples/subsys/usb/uvc/boards/stm32n6570_dk_stm32n657xx_fsbl.conf
```kconfig
# Enough for 2592x1944 YUYV frames
CONFIG_VIDEO_BUFFER_POOL_SZ_MAX=10100000
CONFIG_MAIN_STACK_SIZE=2048
```

## samples/subsys/usb/uvc/sample.yaml
```yaml
sample:
  name: USB Video sample
common:
  harness: console
  harness_config:
    type: one_line
    regex:
      - "Waiting the host to select the video format"
tests:
  sample.subsys.usb.uvc:
    depends_on:
      - usbd
    tags: usb video
    extra_args: SNIPPET=video-sw-generator
    integration_platforms:
      - nrf52840dk/nrf52840
      - nrf54h20dk/nrf54h20/cpuapp
      - frdm_k64f
      - stm32f723e_disco
      - nucleo_f413zh
      - mimxrt685_evk/mimxrt685s/cm33
      - mimxrt1060_evk/mimxrt1062/qspi
  sample.subsys.usb.uvc.camera:
    depends_on:
      - usbd
    tags: usb video
    filter: dt_chosen_enabled("zephyr,camera")
    integration_platforms:
      - arduino_nicla_vision/stm32h747xx/m7
  sample.subsys.usb.uvc.encoder.h264:
    depends_on:
      - usbd
    tags: usb video
    extra_configs:
      - CONFIG_VIDEO_ENCODER_H264=y
    extra_args:
      - platform:stm32n6570_dk/stm32n657xx/sb:EXTRA_DTC_OVERLAY_FILE="app_h264enc.overlay"
      - platform:stm32n6570_dk/stm32n657xx/sb:SHIELD=st_b_cams_imx_mb1854
    filter: dt_chosen_enabled("zephyr,camera")
    integration_platforms:
      - stm32n6570_dk/stm32n657xx/sb
  sample.subsys.usb.uvc.encoder.jpeg:
    depends_on:
      - usbd
    tags: usb video
    extra_configs:
      - CONFIG_VIDEO_ENCODER_JPEG=y
    extra_args:
      - platform:stm32n6570_dk/stm32n657xx/sb:EXTRA_DTC_OVERLAY_FILE="app_jpegenc.overlay"
      - platform:stm32n6570_dk/stm32n657xx/sb:SHIELD=st_b_cams_imx_mb1854
    filter: dt_chosen_enabled("zephyr,camera")
    integration_platforms:
      - stm32n6570_dk/stm32n657xx/sb
```

## samples/subsys/usb/webusb-next/sample.yaml
```yaml
sample:
  name: WebUSB
tests:
  sample.usb.webusb-next:
    depends_on: usbd
    tags: usb
    integration_platforms:
      - nrf52840dk/nrf52840
      - nrf54h20dk/nrf54h20/cpuapp
      - frdm_k64f
      - stm32f723e_disco
      - nucleo_f413zh
      - mimxrt685_evk/mimxrt685s/cm33
      - mimxrt1060_evk/mimxrt1062/qspi
      - max32690evkit/max32690/m4
    harness: TBD
```

## samples/subsys/usb/webusb/sample.yaml
```yaml
sample:
  name: Web USB
tests:
  sample.usb.webusb:
    depends_on: usb_device
    tags: usb
    harness: TBD
```

## samples/subsys/usb_c/sink/boards/nucleo_h563zi.conf
```kconfig
#
# Copyright (c) 2026 ARS Embedded Systems LLC
#
# SPDX-License-Identifier: Apache-2.0
#

# GPIO driver is needed for the board's GPIO hogs
CONFIG_GPIO=y
```

## samples/subsys/usb_c/sink/sample.yaml
```yaml
sample:
  name: USB-C SINK
tests:
  sample.usbc.sink:
    depends_on: tcpc
    tags: usbc
    platform_allow: b_g474e_dpow1/stm32g474xx
    integration_platforms:
      - b_g474e_dpow1/stm32g474xx
    harness: console
    harness_config:
      type: one_line
      regex:
        - "Unattached.SNK"
```

## samples/subsys/usb_c/source/sample.yaml
```yaml
sample:
  name: USB-C SOURCE
tests:
  sample.usbc.source:
    depends_on: tcpc
    tags: usbc
    platform_allow: stm32g081b_eval/stm32g081xx
    harness: console
    harness_config:
      type: one_line
      regex:
        - "Unattached.SRC"
```

## samples/subsys/uuid/sample.yaml
```yaml
sample:
  name: UUID
tests:
  sample.subsys.uuid:
    tags: uuid
    platform_allow:
      - qemu_x86
      - native_sim
      - native_sim/native/64
    integration_platforms:
      - native_sim
    filter: CONFIG_ENTROPY_HAS_DRIVER
    harness: console
    harness_config:
      type: one_line
      regex:
        - "UUID sample completed successfully"
```

## samples/subsys/video/capture/boards/mimxrt1060_evkb.conf
```kconfig
# Leverage PXP to mirror image by flipping
CONFIG_DMA=y
CONFIG_MCUX_ELCDIF_PXP=y
CONFIG_MCUX_ELCDIF_PXP_FLIP_HORIZONTAL=y
```

## samples/subsys/video/capture/sample.yaml
```yaml
sample:
  name: Video capture
tests:
  sample.video.capture:
    build_only: true
    tags:
      - video
      - shield
      - samples
    extra_args:
      - platform:mimxrt1064_evk:SHIELD="dvp_fpc24_mt9m114;rk043fn66hs_ctg"
      - platform:mimxrt1170_evk/mimxrt1176/cm7:SHIELD="nxp_btb44_ov5640;rk055hdmipi4ma0"
    platform_allow:
      - mimxrt1064_evk
      - mimxrt1170_evk/mimxrt1176/cm7
      - mm_swiftio
    depends_on: video
    integration_platforms:
      - mimxrt1064_evk
      - mimxrt1170_evk/mimxrt1176/cm7
```

## samples/subsys/video/capture_to_lvgl/Kconfig
```kconfig
# VIDEO resolution settings

# Copyright (c) 2024 Charles Dias <charlesdias.cd@outlook.com>
# SPDX-License-Identifier: Apache-2.0

source "Kconfig.zephyr"

config VIDEO_WIDTH
	int "Define the width of the video"
	default 160

config VIDEO_HEIGHT
	int "Define the height of the video"
	default 120
```

## samples/subsys/video/capture_to_lvgl/boards/mini_stm32h743.conf
```kconfig
#
# Copyright (c) 2024 Charles Dias <charlesdias.cd@outlook.com>
#
# SPDX-License-Identifier: Apache-2.0
#

CONFIG_LOG_BUFFER_SIZE=2048

CONFIG_VIDEO_BUFFER_POOL_HEAP_SIZE=204800
CONFIG_VIDEO_WIDTH=160
CONFIG_VIDEO_HEIGHT=120
```

## samples/subsys/video/capture_to_lvgl/boards/stm32h7b3i_dk.conf
```kconfig
#
# Copyright (c) 2025 Charles Dias <charlesdias.cd@outlook.com>
#
# SPDX-License-Identifier: Apache-2.0
#

CONFIG_LOG_BUFFER_SIZE=2048

CONFIG_VIDEO_WIDTH=480
CONFIG_VIDEO_HEIGHT=272
CONFIG_VIDEO_BUFFER_POOL_HEAP_SIZE=524288
```

## samples/subsys/video/capture_to_lvgl/sample.yaml
```yaml
sample:
  name: Video capture to LVGL
tests:
  sample.video.capture_to_lvgl:
    build_only: true
    tags:
      - video
    platform_allow:
      - mini_stm32h743
    depends_on: video
```

## samples/subsys/video/tcpserversink/sample.yaml
```yaml
sample:
  name: Video TCP server sink
tests:
  sample.video.tcpserversink:
    build_only: true
    tags: video net socket
    platform_allow: mimxrt1064_evk
    depends_on: video netif
    integration_platforms:
      - mimxrt1064_evk
```

## samples/subsys/zbus/async_listeners/sample.yaml
```yaml
sample:
  name: Async Listeners
tests:
  sample.zbus.async_listeners:
    harness: console
    harness_config:
      type: multi_line
      ordered: false
      regex:
        - "^.*?I: Output                       \\| Thread Context"
        - "^.*?I: ============================================="
        - "^.*?I: From listener -> Evt=0       \\| main"
        - "^.*?I: From async listener -> Evt=0 \\| sysworkq"
        - "^.*?I: From async listener -> Evt=0 \\| My work queue"
        - "^.*?I: From listener -> Evt=1       \\| main"
        - "^.*?I: From async listener -> Evt=1 \\| sysworkq"
        - "^.*?I: From async listener -> Evt=1 \\| My work queue"
        - "^.*?I: From listener -> Evt=2       \\| main"
        - "^.*?I: From async listener -> Evt=2 \\| sysworkq"
        - "^.*?I: From async listener -> Evt=2 \\| My work queue"
        - "^.*?I: From listener -> Evt=3       \\| main"
        - "^.*?I: From async listener -> Evt=3 \\| sysworkq"
        - "^.*?I: From async listener -> Evt=3 \\| My work queue"
        - "^.*?I: From listener -> Evt=10       \\| main"
        - "^.*?I: From async listener -> Evt=10 \\| sysworkq"
        - "^.*?I: From async listener -> Evt=10 \\| My work queue"
        - "^.*?I: From listener -> Evt=11       \\| main"
        - "^.*?I: From async listener -> Evt=11 \\| sysworkq"
        - "^.*?I: From async listener -> Evt=11 \\| My work queue"
        - "^.*?I: From listener -> Evt=12       \\| main"
        - "^.*?I: From async listener -> Evt=12 \\| sysworkq"
        - "^.*?I: From async listener -> Evt=12 \\| My work queue"
        - "^.*?I: From listener -> Evt=13       \\| main"
        - "^.*?I: From async listener -> Evt=13 \\| sysworkq"
        - "^.*?I: From async listener -> Evt=13 \\| My work queue"
    platform_exclude:
      - qemu_leon3
    tags: zbus
    integration_platforms:
      - qemu_x86
```
