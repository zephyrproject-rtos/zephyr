/*
 * Copyright (c) 2025 tinyVision.ai Inc.
 *
 * SPDX-License-Identifier: Apache-2.0
 */

#include "../app.overlay"

&ov7670 {
	status = "disabled";
};

&smartdma {
	status = "disabled";
};

&video_sdma {
	status = "disabled";
};
