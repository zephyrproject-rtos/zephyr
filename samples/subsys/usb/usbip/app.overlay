/*
 * Copyright (c) 2022 YuLong Yao<feilongphone@gmail.com>
 *
 * SPDX-License-Identifier: Apache-2.0
 */

/ {
	chosen {
		zephyr,console = &cdc_acm_uart0;
	};

	usbip: usbip {
		compatible = "zephyr,usbip-udc";
		status = "okay";
		label = "USBIP";

		cdc_acm_uart0: cdc_acm_uart0 {
			compatible = "zephyr,cdc-acm-uart";
			label = "CDC_ACM_0";
		};
	};
};
