/*
 * Copyright (c) 2021 Nordic Semiconductor ASA
 *
 * SPDX-License-Identifier: Apache-2.0
 */

&zephyr_udc0 {
	cdc_acm_uart0 {
		compatible = "zephyr,cdc-acm-uart";
		tx-fifo-size = <512>;
		rx-fifo-size = <512>;
	};

	cdc_acm_uart1 {
		compatible = "zephyr,cdc-acm-uart";
		tx-fifo-size = <512>;
		rx-fifo-size = <512>;
	};
};
