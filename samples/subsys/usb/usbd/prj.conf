## CMakeLists.txt
```
# SPDX-License-Identifier: Apache-2.0

cmake_minimum_required(VERSION 3.13.1)
find_package(Zephyr REQUIRED HINTS $ENV{ZEPHYR_BASE})
project(usbd-loopback)

FILE(GLOB app_sources src/*.c)
target_sources(app PRIVATE ${app_sources})
```

## sample.yaml
```
sample:
  name: USBD loopback sample
tests:
  sample.usb.loopback:
    depends_on: usb_device
    tags: usb
    harness: button
```

## prj.conf
```kconfig
CONFIG_LOG=y

#USB related configs
CONFIG_USB=y
CONFIG_USB_DEVICE_STACK=y
CONFIG_USBD_DEVICE_STACK=y
CONFIG_USBD_LOG_LEVEL_WRN=y
CONFIG_USBD_DEVICE_PRODUCT="Zephyr testusb sample"

CONFIG_USB_DRIVER_LOG_LEVEL_WRN=y

CONFIG_SHELL=y
CONFIG_USBD_SHELL=y
CONFIG_USBD_LOOPBACK_CLASS=y
CONFIG_NET_BUF_USER_DATA_SIZE=8
```

## src/main.c
```c
/*
 * Copyright (c) 2020 Phytec Messtechnik GmbH
 *
 * SPDX-License-Identifier: Apache-2.0
 */

#include <zephyr.h>
#include <logging/log.h>
#include <usb/usbd.h>
LOG_MODULE_REGISTER(main);

void main(void)
{
	struct device *dev;
	int ret = 0;

	dev = device_get_binding("USBD_CLASS_LB_0");

	usbd_cctx_register(dev);

	ret = usbd_enable(NULL);
	if (ret != 0) {
		LOG_ERR("Failed to enable USB device stack");
		return;
	}
}
```
