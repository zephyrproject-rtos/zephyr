## samples/subsys/usb/dfu/Kconfig
```kconfig
# Copyright (c) 2023 Nordic Semiconductor ASA
# SPDX-License-Identifier: Apache-2.0

menu "USB DFU sample options"

config APP_USB_DFU_USE_FLASH_BACKEND
	select FLASH
	select FLASH_MAP
	select STREAM_FLASH
	select IMG_MANAGER
	select IMG_ERASE_PROGRESSIVELY
	bool "Option to clear the flash area before mounting"
	help
	  Use this to force an existing file system to be created.

if APP_USB_DFU_USE_FLASH_BACKEND

config USBD_DFU_FLASH
	default y

config USBD_DFU_FLASH_SLOT0
	default n

config USBD_DFU_FLASH_SLOT1
	default y

endif

endmenu

# Source common USB sample options used to initialize new experimental USB
# device stack. The scope of these options is limited to USB samples in project
# tree, you cannot use them in your own application.
source "samples/subsys/usb/common/Kconfig.sample_usbd"

source "Kconfig.zephyr"
```

## samples/subsys/usb/dfu/sample.yaml
```yaml
sample:
  name: USB DFU sample

common:
  build_only: true
  arch_exclude: posix
  platform_exclude:
    - mimxrt1010_evk
    - mimxrt1020_evk
    - mimxrt1015_evk
    - mimxrt1060_evk@A/mimxrt1062/qspi
    - mimxrt1060_evk@B/mimxrt1062/qspi
    - mimxrt1060_evk@C/mimxrt1062/qspi
    - sam4l_ek
    - same54_xpro
    - samr21_xpro
    - mimxrt1050_evk/mimxrt1052/hyperflash
    - mimxrt1050_evk/mimxrt1052/qspi
    - mimxrt1060_evk/mimxrt1062/hyperflash
    - mimxrt1180_evk/mimxrt1189/cm7
    - nucleo_f207zg
    - teensy40
    - teensy41
    - b_u585i_iot02a
    - frdm_kl25z
    - frdm_mcxc242
    - frdm_mcxc444
    - frdm_mcxa156
    - lpcxpresso55s69/lpc55s69/cpu0
    - stm32l562e_dk/stm32l562xx/ns
  depends_on: usb_device
  filter: dt_label_with_parent_compat_enabled("slot0_partition", "fixed-partitions")
    and dt_label_with_parent_compat_enabled("slot1_partition", "fixed-partitions")
    and dt_chosen_enabled("zephyr,flash-controller") and CONFIG_FLASH_HAS_DRIVER_ENABLED
  integration_platforms:
    - nrf52840dk/nrf52840
    - frdm_k64f
tests:
  sample.usb.dfu:
    tags: usb
  sample.usb.dfu.permanent.download:
    tags: usb
    extra_args: EXTRA_CONF_FILE=overlay-permanent-download.conf
```

## samples/subsys/usb/fastboot/Kconfig
```kconfig
# Copyright (c) 2026 juno <baidxi404629@gmail.com>
# SPDX-License-Identifier: Apache-2.0

# Source common USB sample options
source "samples/subsys/usb/common/Kconfig.sample_usbd"

source "Kconfig.zephyr"
```

## samples/subsys/usb/fastboot/sample.yaml
```yaml
sample:
  name: USB Fastboot
tests:
  sample.usb_device_next.fastboot:
    depends_on: usbd
    tags: usb fastboot
    platform_allow: art_pi
    integration_platforms:
      - art_pi
    harness: console
    harness_config:
      type: one_line
      regex:
        - "Fastboot sample started"
```

## samples/subsys/usb/ffat/sample.yaml
```yaml
sample:
  name: USB FFAT sample
common:
  depends_on:
    - usbd
  integration_platforms:
    - nrf52840dk/nrf52840
    - nrf54h20dk/nrf54h20/cpuapp
    - frdm_k64f
    - nucleo_f413zh
    - mimxrt1060_evk
tests:
  sample.usbd.ffat:
    tags: usb filesystem
```

## samples/subsys/usb/hid-cdc/Kconfig
```kconfig
# Copyright (c) 2019 Nordic Semiconductor ASA
# SPDX-License-Identifier: Apache-2.0

config USB_DEVICE_PID
	default USB_PID_HID_CDC_SAMPLE

source "Kconfig.zephyr"
```

## samples/subsys/usb/hid-cdc/sample.yaml
```yaml
sample:
  name: USB HID CDC ACM sample
tests:
  sample.usb.hid-cdc:
    depends_on: usb_device
    platform_allow:
      - nrf52840dk/nrf52840
      - nrf52840dongle/nrf52840
    integration_platforms:
      - nrf52840dk/nrf52840
    harness: button
    tags: usb
```

## samples/subsys/usb/hid-keyboard/Kconfig
```kconfig
# Copyright (c) 2023 Nordic Semiconductor ASA
# SPDX-License-Identifier: Apache-2.0

config SAMPLE_USBD_REMOTE_WAKEUP
	default y

# Source common USB sample options used to initialize new experimental USB
# device stack. The scope of these options is limited to USB samples in project
# tree, you cannot use them in your own application.
source "samples/subsys/usb/common/Kconfig.sample_usbd"

source "Kconfig.zephyr"
```

## samples/subsys/usb/hid-keyboard/sample.yaml
```yaml
sample:
  name: USB HID keyboard sample
common:
  filter: dt_alias_exists("sw0") and dt_alias_exists("led0")
  depends_on:
    - usbd
    - gpio
  tags: usb
  timeout: 15
  harness: console
  harness_config:
    type: one_line
    regex:
      - "HID keyboard sample is initialized"
  integration_platforms:
    - nrf52840dk/nrf52840
    - nrf54h20dk/nrf54h20/cpuapp
    - frdm_k64f
    - stm32f723e_disco
    - nucleo_f413zh
    - mimxrt685_evk/mimxrt685s/cm33
    - mimxrt1060_evk/mimxrt1062/qspi
    - samd21_xpro
    - same54_xpro
tests:
  sample.usbd.hid-keyboard: {}
  sample.usbd.hid-keyboard.out-report:
    extra_args:
      - EXTRA_DTC_OVERLAY_FILE="out_report.overlay"
  sample.usbd.hid-keyboard.large-report:
    extra_args:
      - EXTRA_DTC_OVERLAY_FILE="large_in_report.overlay"
  sample.usbd.hid-keyboard.large-out-report:
    extra_args:
      - EXTRA_DTC_OVERLAY_FILE="large_out_report.overlay"
```

## samples/subsys/usb/hid-mouse/Kconfig
```kconfig
# Copyright (c) 2019 Nordic Semiconductor ASA
# SPDX-License-Identifier: Apache-2.0

config USB_DEVICE_PID
	default USB_PID_HID_MOUSE_SAMPLE

config USB_DEVICE_REMOTE_WAKEUP
	default y if NRFX_USBD

source "Kconfig.zephyr"
```

## samples/subsys/usb/hid-mouse/sample.yaml
```yaml
sample:
  name: USB HID mouse sample
common:
  harness: button
  filter: dt_alias_exists("sw0") and dt_alias_exists("led0")
  depends_on:
    - gpio
  tags: usb
tests:
  sample.usb.hid-mouse:
    depends_on:
      - usb_device
    platform_exclude:
      - frdm_mcxn947/mcxn947/cpu0
  sample.usb_device_next.hid-mouse:
    depends_on:
      - usbd
    timeout: 15
    harness: console
    harness_config:
      type: multi_line
      regex:
        - "HS bNumConfigurations 1"
        - "FS bNumConfigurations 1"
        - "Actual device speed 2"
        - "s-in-status finished"
    integration_platforms:
      - nrf52840dk/nrf52840
      - nrf54h20dk/nrf54h20/cpuapp
      - nrf54lm20dk/nrf54lm20a/cpuapp
      - frdm_k64f
      - stm32f723e_disco
      - nucleo_f413zh
      - mimxrt1060_evk/mimxrt1062/qspi
      - max32690evkit/max32690/m4
    extra_args:
      - CONF_FILE="usbd_next_prj.conf"
      - EXTRA_DTC_OVERLAY_FILE="usbd_next.overlay"
```

## samples/subsys/usb/hid/sample.yaml
```yaml
sample:
  name: USB HID sample
tests:
  sample.usb.hid:
    depends_on: usb_device
    tags: usb
    arch_exclude: posix
    harness: console
    harness_config:
      type: multi_line
      regex:
        - "main: HID Device: dev"
        - "main: Starting application"
  sample.usb.hid_composite:
    depends_on: usb_device
    extra_configs:
      - CONFIG_USB_COMPOSITE_DEVICE=y
    tags: usb
    arch_exclude: posix
    harness: console
    harness_config:
      type: multi_line
      regex:
        - "main: HID Device: dev"
        - "main: Starting application"
  sample.usb.hid.buildonly:
    depends_on: usb_device
    tags: usb
    platform_allow: native_posix native_posix_64
    build_only: true
    integration_platforms:
      - native_posix
```

## samples/subsys/usb/host_uvc/Kconfig
```kconfig
# SPDX-FileCopyrightText: Copyright 2025 - 2026 NXP
# SPDX-License-Identifier: Apache-2.0

mainmenu "USB host uvc sample application"

menu "Video capture configuration"

config APP_VIDEO_FRAME_HEIGHT
	int "Height of the video frame"
	default 240
	help
	  Height of the video frame.

config APP_VIDEO_FRAME_WIDTH
	int "Width of the video frame"
	default 320
	help
	  Width of the video frame.

config APP_VIDEO_TARGET_FPS
	int "Target frame rate for video capture"
	default 15
	help
	  Target frame rate (FPS) for video capture.

config APP_VIDEO_PIXEL_FORMAT
	string "Pixel format of the video frame"
	default "YUYV"
	help
	  Pixel format of the video frame.

endmenu

source "Kconfig.zephyr"
```

## samples/subsys/usb/host_uvc/boards/rd_rw612_bga.conf
```kconfig
CONFIG_UHC_DRIVER=y
CONFIG_USB_HOST_STACK=y
CONFIG_USBH_VIDEO_CLASS=y

CONFIG_MAIN_STACK_SIZE=10240
CONFIG_HEAP_MEM_POOL_SIZE=16384

CONFIG_USBH_USB_DEVICE_HEAP=8912

CONFIG_UHC_BUF_POOL_SIZE=4096
CONFIG_UHC_XFER_COUNT=32
CONFIG_UHC_BUF_COUNT=32

CONFIG_VIDEO_BUFFER_POOL_HEAP_SIZE=716800
CONFIG_VIDEO_BUFFER_POOL_NUM_MAX=6
CONFIG_VIDEO_BUFFER_POOL_ALIGN=32
```

## samples/subsys/usb/host_uvc/sample.yaml
```yaml
sample:
  name: USB host video sample
tests:
  sample.subsys.usb.host.uvc.camera:
    tags:
      - video
      - usbh
      - samples
    extra_configs:
      - CONFIG_FPU=y
    platform_allow:
      - rd_rw612_bga/rw612
    integration_platforms:
      - rd_rw612_bga/rw612
```

## samples/subsys/usb/legacy/audio_headphones_microphone/sample.yaml
```yaml
sample:
  name: USB audio Headphones Microphone sample
tests:
  sample.usb.legacy.audio.headphones_microphone:
    depends_on: usb_device
    tags: usb
    build_only: true
    integration_platforms:
      - nrf52840dk/nrf52840
      - nrf5340dk/nrf5340/cpuapp
```

## samples/subsys/usb/legacy/cdc_acm/sample.yaml
```yaml
sample:
  name: CDC ACM USB
tests:
  sample.usb.cdc-acm:
    depends_on: usb_device
    tags: usb
    arch_exclude: posix
    harness: console
    harness_config:
      type: one_line
      regex:
        - "Wait for DTR"
  sample.usb.cdc-acm.buildonly:
    depends_on: usb_device
    tags: usb
    arch_allow: posix
    build_only: true
    integration_platforms:
      - native_sim
```

## samples/subsys/usb/legacy/console/sample.yaml
```yaml
sample:
  name: Console over USB
tests:
  sample.usb.legacy.console:
    depends_on:
      - usb_device
    tags: usb
    build_only: true
```

## samples/subsys/usb/legacy/dfu/sample.yaml
```yaml
sample:
  name: USB DFU sample

common:
  build_only: true
  arch_exclude: posix
  depends_on: usb_device
  platform_allow:
    - nrf52840dk/nrf52840
    - frdm_k64f
tests:
  sample.usb.legacy.dfu:
    tags: usb
  sample.usb.legacy.dfu.permanent.download:
    tags: usb
    extra_args: EXTRA_CONF_FILE=overlay-permanent-download.conf
```

## samples/subsys/usb/legacy/hci_usb/sample.yaml
```yaml
sample:
  name: Bluetooth over USB sample
tests:
  sample.usb.bluetooth.hci_usb.legacy:
    depends_on:
      - usb_device
      - ble
    build_only: true
    tags:
      - usb
      - bluetooth
```

## samples/subsys/usb/legacy/hid-mouse/sample.yaml
```yaml
sample:
  name: USB HID mouse sample
common:
  harness: button
  filter: dt_alias_exists("sw0") and dt_alias_exists("led0")
  depends_on:
    - gpio
tests:
  sample.usb.legacy.hid-mouse:
    depends_on:
      - usb_device
    build_only: true
    platform_exclude:
      - frdm_mcxn947/mcxn947/cpu0
    tags: usb
```

## samples/subsys/usb/legacy/mass/sample.yaml
```yaml
sample:
  name: Mass Storage
tests:
  sample.usb.legacy.mass_ram_none:
    min_ram: 128
    depends_on: usb_device
    build_only: true
    arch_exclude: posix
    tags:
      - usb
```

## samples/subsys/usb/legacy/netusb/sample.yaml
```yaml
common:
  tags:
    - net
    - zperf
    - usb
  min_ram: 192
  depends_on: usb_device
  platform_exclude:
    - native_sim
    - native_sim/native/64
sample:
  description: Network performance measurement tool for legacy netusb
  name: zperf
tests:
  sample.net.zperf.netusb_ecm:
    harness: net
  sample.net.zperf.netusb_eem:
    harness: net
    extra_configs:
      - CONFIG_USB_DEVICE_NETWORK_ECM=n
      - CONFIG_USB_DEVICE_NETWORK_EEM=y
  sample.net.zperf.netusb_rndis:
    harness: net
    extra_configs:
      - CONFIG_USB_DEVICE_NETWORK_ECM=n
      - CONFIG_USB_DEVICE_NETWORK_RNDIS=y
```

## samples/subsys/usb/legacy/webusb/sample.yaml
```yaml
sample:
  name: Web USB
tests:
  sample.usb.webusb:
    depends_on: usb_device
    tags: usb
    platform_exclude:
      - native_posix
      - native_posix/native/64
    harness: TBD
```
