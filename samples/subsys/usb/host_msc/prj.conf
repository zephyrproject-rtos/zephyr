## CMakeLists.txt
```
# SPDX-License-Identifier: Apache-2.0

cmake_minimum_required(VERSION 3.20.0)

find_package(Zephyr REQUIRED HINTS $ENV{ZEPHYR_BASE})
project(usb_host_msc)

target_sources(app PRIVATE
  src/main.c
  src/usb_host_dump.c
)

if(CONFIG_USB_HOST_MSC_SAMPLE_FAT_FILE_DEMO)
  target_sources(app PRIVATE
    src/msc_fat_file_demo.c
  )
endif()

if(CONFIG_USB_HOST_MSC_SAMPLE_FS_SHELL)
  target_sources(app PRIVATE
    src/msc_multi_mount.c
  )
endif()

if(CONFIG_USB_HOST_MSC_SAMPLE_LARGE_FILE_WRITE)
  target_sources(app PRIVATE src/msc_large_file_write.c)
endif()
```

## Kconfig
```
#
# SPDX-License-Identifier: Apache-2.0
#

mainmenu "USB host MSC sample options"

menu "USB MSC FatFs (disk_access)"

config USB_HOST_MSC_SAMPLE_FAT_FILE_DEMO
	bool "USB MSC disk_access backend for FatFs"
	default n
	depends on FAT_FILESYSTEM_ELM
	select USBH_MSC_DISK
	help
	  After MSC storage bring-up, a disk_access volume is registered by the
	  USB host stack (CONFIG_USBH_MSC_DISK). Use FAT_AUTO_DEMO for an
	  automatic smoke test, or FS_SHELL for the interactive fs shell.

config USB_HOST_MSC_SAMPLE_FAT_AUTO_DEMO
	bool "Run automatic FS demo after MSC storage bringup"
	default y if !USB_HOST_MSC_SAMPLE_FS_SHELL
	default n
	depends on USB_HOST_MSC_SAMPLE_FAT_FILE_DEMO
	help
	  When y: call usb_host_msc_sample_fat_file_demo() after LUN0 disk bind.
	  When n: only bind disk_access (shell or app mounts FatFs).

config USB_HOST_MSC_SAMPLE_FS_SHELL
	bool "Interactive Zephyr fs shell on UART (mount/ls/cat/write/...)"
	default n
	depends on USB_HOST_MSC_SAMPLE_FAT_FILE_DEMO
	select SHELL
	select SHELL_BACKEND_SERIAL
	select FILE_SYSTEM_SHELL
	select USBH_SHELL
	help
	  Typical sequence (one stick):
	    msc mount USB
	    msc write /USB:/hello.txt hello world
	    fs ls /USB:
	    fs cat /USB:/hello.txt

	  With several MSC devices use ``msc mount`` for each volume (``USB``,
	  ``USB1``, …). Use ``msc write`` for plain text; ``fs write`` expects
	  hex bytes only.

config USB_HOST_MSC_SAMPLE_TIMER_SELFTEST
	bool "Run k_timer/k_poll self-test at boot"
	default n
	help
	  Exercises k_sleep, k_poll, and k_timer before USB host bring-up.

config USB_HOST_MSC_SAMPLE_QUIET
	bool "Quiet USB host (no trace logs or redundant descriptor dump)"
	default y if USB_HOST_MSC_SAMPLE_FS_SHELL
	default n
	help
	  Skips main() trace logs after enumeration. Pair with USBH/UHC log
	  level WRN in board conf.

config USB_HOST_MSC_SAMPLE_FAT_MKFS_ON_FAIL
	bool "Format stick with mkfs when mount fails (destructive)"
	default n
	depends on USB_HOST_MSC_SAMPLE_FAT_FILE_DEMO
	select FS_FATFS_MKFS
	help
	  When n (default): mount failure is fatal — safe for PC-formatted sticks.

config USB_HOST_MSC_SAMPLE_FAT_READBACK_VERIFY
	bool "After write, fs_read demo file and memcmp expected content"
	default y
	depends on USB_HOST_MSC_SAMPLE_FAT_FILE_DEMO

config USB_HOST_MSC_SAMPLE_FAT_RELIST_AFTER_WRITE
	bool "List root directory again after writing demo file"
	default y
	depends on USB_HOST_MSC_SAMPLE_FAT_FILE_DEMO

config USB_HOST_MSC_SAMPLE_FAT_FILE_CONTENT
	string "Text written to the demo file for FS validation"
	default "Zephyr USB host MSC sample"
	depends on USB_HOST_MSC_SAMPLE_FAT_FILE_DEMO

config USB_HOST_MSC_SAMPLE_DISK_NAME
	string "disk_access / FatFs volume name (legacy, use USBH_MSC_DISK_NAME)"
	default "USB"
	depends on USB_HOST_MSC_SAMPLE_FAT_FILE_DEMO && !USBH_MSC_DISK
	help
	  Used only when CONFIG_USBH_MSC_DISK is disabled. When USBH_MSC_DISK is
	  enabled, CONFIG_USBH_MSC_DISK_NAME is used instead.

config USB_HOST_MSC_SAMPLE_LARGE_FILE_WRITE
	bool "Write a large text file to USB MSC after bring-up"
	default n
	depends on USB_HOST_MSC_SAMPLE_FAT_FILE_DEMO
	help
	  After MSC storage bring-up, mount FAT and write a multi-megabyte
	  text file to stress bulk READ/WRITE and FatFs. Incompatible with
	  USB_HOST_MSC_SAMPLE_FAT_AUTO_DEMO (enable one automatic demo).

config USB_HOST_MSC_SAMPLE_LARGE_FILE_SIZE_MB
	int "Large text file size (MiB)"
	default 10
	range 1 128
	depends on USB_HOST_MSC_SAMPLE_LARGE_FILE_WRITE
	help
	  Size of the generated text file in mebibytes (default 10 MiB).

config USB_HOST_MSC_SAMPLE_LARGE_FILE_CHUNK_SIZE
	int "Large file write chunk size (bytes)"
	default 4096
	range 512 65536
	depends on USB_HOST_MSC_SAMPLE_LARGE_FILE_WRITE
	help
	  Buffer size for each fs_write() call while generating the file.

config USB_HOST_MSC_SAMPLE_LARGE_FILE_NAME
	string "Large text file name on the FAT volume"
	default "large10m.txt"
	depends on USB_HOST_MSC_SAMPLE_LARGE_FILE_WRITE

endmenu

source "Kconfig.zephyr"
```

## prj.conf
```kconfig
# SPDX-License-Identifier: Apache-2.0
#
# USB host MSC sample. Board options in boards/*.conf.
#
# From zephyr/:
#   west build -p always -b versal_apu samples/subsys/usb/host_msc -- \
#     -DDTC_OVERLAY_FILE=boards/versal_apu.overlay
#   west flash --runner xsdb --pdi /path/to/your.pdi

CONFIG_POLL=y
CONFIG_THREAD_NAME=y

CONFIG_PRINTK=y
CONFIG_CONSOLE=y

CONFIG_LOG=y
CONFIG_LOG_MODE_IMMEDIATE=y
CONFIG_LOG_DEFAULT_LEVEL=3
CONFIG_LOG_MAX_LEVEL=3
CONFIG_LOG_OVERRIDE_LEVEL=0
CONFIG_KERNEL_LOG_LEVEL_INF=y

CONFIG_MAIN_STACK_SIZE=2048
CONFIG_SYSTEM_WORKQUEUE_STACK_SIZE=2048
```

## boards/versal_apu.conf
```kconfig
# Merged when building usb_host_msc for in-tree board versal_apu.
#
# Build (from zephyr/):
#   west build -p always -b versal_apu samples/subsys/usb/host_msc -- \
#     -DDTC_OVERLAY_FILE=boards/versal_apu.overlay
#
# Flash (PDI from your Vivado/Vitis design — not bundled with the board):
#   west flash --runner xsdb --pdi /path/to/your.pdi
#
# Plug USB stick, wait for "USB MSC ready", then:
#   msc mount USB
#   msc mount USB1    (second stick — both stay mounted)
#   fs ls /USB:
#   fs ls /USB1:

CONFIG_MAIN_STACK_SIZE=16384
CONFIG_SYSTEM_WORKQUEUE_STACK_SIZE=8192
CONFIG_HEAP_MEM_POOL_SIZE=16384

CONFIG_USB_HOST_STACK=y
CONFIG_USBH_USB2_ENUM_SCHEME=y
CONFIG_USBH_HUB=y
CONFIG_USBH_MSC=y
CONFIG_USBH_MSC_CLASS=y
CONFIG_USBH_MSC_STRICT_PROBE=y
# Sample main() drives MSC bringup after CONFIGURED (same as verified lab flow).
CONFIG_USBH_MSC_AUTO_BRINGUP=n
CONFIG_USBH_USB_DEVICE_HEAP=8192

CONFIG_UHC_DRIVER=y
CONFIG_UHC_BUF_POOL_SIZE=8192
CONFIG_UHC_DWC3=y

CONFIG_USBH_USB_DEVICE_MAX=4
CONFIG_USBH_MSC_LUN_SLOTS=4

CONFIG_DISK_ACCESS=y
CONFIG_DISK_DRIVERS=y
CONFIG_SCSI=y
CONFIG_DISK_DRIVER_SCSI=y
CONFIG_FILE_SYSTEM=y
CONFIG_FAT_FILESYSTEM_ELM=y
CONFIG_FS_FATFS_CUSTOM_MOUNT_POINT_COUNT=4
CONFIG_FS_FATFS_CUSTOM_MOUNT_POINTS="USB,USB1,USB2,USB3"
CONFIG_FS_FATFS_NUM_FILES=4
CONFIG_FS_FATFS_NUM_DIRS=4
CONFIG_FS_FATFS_MAX_SS=512
CONFIG_FS_FATFS_MOUNT_MKFS=n
CONFIG_FS_FATFS_LFN=y
CONFIG_FS_FATFS_LFN_MODE_BSS=y

CONFIG_USBH_MSC_DISK=y
CONFIG_USBH_MSC_DISK_NAME="USB"
CONFIG_USBH_MSC_DISK_AUTO_ATTACH=y
CONFIG_USBH_MSC_DISK_PARTITION=y

CONFIG_USB_HOST_MSC_SAMPLE_FAT_FILE_DEMO=y
CONFIG_USB_HOST_MSC_SAMPLE_FS_SHELL=y
CONFIG_USB_HOST_MSC_SAMPLE_FAT_AUTO_DEMO=n
CONFIG_USB_HOST_MSC_SAMPLE_FAT_MKFS_ON_FAIL=n
CONFIG_USB_HOST_MSC_SAMPLE_FAT_READBACK_VERIFY=n
CONFIG_USB_HOST_MSC_SAMPLE_FAT_RELIST_AFTER_WRITE=n
CONFIG_USB_HOST_MSC_SAMPLE_QUIET=n
CONFIG_USB_HOST_MSC_SAMPLE_TIMER_SELFTEST=n

CONFIG_USBH_SHELL=y
CONFIG_USBH_LOG_LEVEL_INF=y
CONFIG_UHC_DRIVER_LOG_LEVEL_INF=y
CONFIG_USBH_MSC_LOG_PROBE=y
CONFIG_USBH_MSC_FLOW_LOG=y

CONFIG_NET_BUF_ALIGNMENT=64
CONFIG_SHELL_STACK_SIZE=16384
CONFIG_SHELL_CMD_BUFF_SIZE=256
CONFIG_SHELL_ARGC_MAX=12
CONFIG_SHELL_HISTORY=y
CONFIG_SHELL_HISTORY_BUFFER=512

CONFIG_FILE_SYSTEM_SHELL_MOUNT_COMMAND=y
CONFIG_FILE_SYSTEM_SHELL_LS_SIZE=y
```

## boards/versal_apu.overlay
```dts
/*
 * DWC3 xHCI USB host for in-tree versal_apu (&soc DTS).
 * Same content as boards/amd/versal_apu/usb_host.overlay — kept here so Twister
 * picks it up as boards/versal_apu.overlay relative to the sample app.
 *
 * SPDX-FileCopyrightText: Copyright (c) 2026 Advanced Micro Devices, Inc.
 * SPDX-License-Identifier: Apache-2.0
 */

#include <zephyr/dt-bindings/interrupt-controller/arm-gic.h>

&soc {
	zephyr_uhc0: usb_host@fe200000 {
		compatible = "snps,dwc3";
		reg = <0x00 0xfe200000 0x00 0x10000>,
		      <0x00 0xff9d0000 0x00 0x100>;
		reg-names = "core", "usb2_wrapper";
		interrupts = <GIC_SPI 22 IRQ_TYPE_LEVEL IRQ_DEFAULT_PRIORITY>;
		/* Versal PS USB is USB 2.0 HS host only (maximum-speed = "high-speed") */
		zephyr,maximum-speed = "high-speed";
		status = "okay";
	};
};
```

## src/main.c
```c
/*
 * Copyright (c) 2026 Advanced Micro Devices, Inc.
 *
 * SPDX-License-Identifier: Apache-2.0
 */

#include <stdio.h>

#include <zephyr/devicetree.h>
#include <zephyr/kernel.h>
#include <zephyr/logging/log.h>
#include <zephyr/sys/util.h>
#include <zephyr/sys/time_units.h>

LOG_MODULE_REGISTER(usb_host_msc_sample, LOG_LEVEL_INF);

#if !IS_ENABLED(CONFIG_USB_HOST_MSC_SAMPLE_QUIET)
#define SAMPLE_TRACE(...) LOG_INF(__VA_ARGS__)
#else
#define SAMPLE_TRACE(...)
#endif

#if DT_HAS_COMPAT_STATUS_OKAY(snps_dwc3)
#include <errno.h>
#include <stdio.h>
#include <zephyr/device.h>
#include <zephyr/drivers/usb/uhc.h>
#include <zephyr/usb/usbh.h>
#include <zephyr/usb/usbh_hcd.h>
#include <zephyr/usb/usbh_msc.h>
#if IS_ENABLED(CONFIG_USBH_MSC_DISK)
#include <zephyr/usb/usb_msc_disk.h>
#endif
#if IS_ENABLED(CONFIG_USB_HOST_MSC_SAMPLE_FS_SHELL)
#include "msc_multi_mount.h"
#endif
#include "usb_host_dump.h"

static K_SEM_DEFINE(usbh_cfg_done_sem, 0, CONFIG_USBH_USB_DEVICE_MAX);

void usbh_device_configured_notify(struct usb_device *udev)
{
	ARG_UNUSED(udev);

	k_sem_give(&usbh_cfg_done_sem);
}

void usbh_device_removed_notify(struct usb_device *udev)
{
#if IS_ENABLED(CONFIG_USB_HOST_MSC_SAMPLE_FS_SHELL)
	msc_fs_unmount_udev(udev);
#endif

#if IS_ENABLED(CONFIG_USBH_MSC_DISK) && !IS_ENABLED(CONFIG_USBH_MSC_AUTO_BRINGUP)
	usb_msc_disk_device_removed(udev);
#endif

	k_sem_give(&usbh_cfg_done_sem);

#if IS_ENABLED(CONFIG_USB_HOST_MSC_SAMPLE_FS_SHELL)
	LOG_INF("USB device removed — replug MSC device(s), then msc mount USB (or USB1 …)");
#elif IS_ENABLED(CONFIG_USB_HOST_MSC_SAMPLE_FAT_FILE_DEMO)
	LOG_INF("USB device removed — replug MSC device(s), then fs mount fat /%s:",
		CONFIG_USBH_MSC_DISK_NAME);
	LOG_INF("  (or /USB1: …)");
#else
	LOG_INF("USB device removed — replug MSC device(s) to enumerate again");
#endif
}

USBH_CONTROLLER_DEFINE(uhs_ctx, DEVICE_DT_GET(DT_NODELABEL(zephyr_uhc0)));

static int usb_host_bringup(void)
{
	int err;

	err = usbh_init(&uhs_ctx);
	if (err != 0 && err != -EALREADY) {
		LOG_ERR("usbh_init failed: %d", err);
		return err;
	}

	err = usbh_enable(&uhs_ctx);
	if (err != 0) {
		LOG_ERR("usbh_enable failed: %d", err);
		return err;
	}

	err = uhc_sof_enable(uhs_ctx.dev);
	if (err != 0) {
		LOG_ERR("uhc_sof_enable failed: %d", err);
		return err;
	}

	return 0;
}

static void usb_host_msc_log_ready_volumes(struct usb_device *udev)
{
#if IS_ENABLED(CONFIG_USBH_MSC_DISK)
	char disk_name[16];

	for (uint8_t lun = 0U; lun < CONFIG_USBH_MSC_LUN_SLOTS; lun++) {
		if (usb_msc_disk_get_volume_name(udev, lun, disk_name, sizeof(disk_name)) >= 0) {
#if IS_ENABLED(CONFIG_USB_HOST_MSC_SAMPLE_FS_SHELL)
			LOG_INF("USB MSC ready - msc mount %s  (then fs ls /%s:)", disk_name,
				disk_name);
#else
			LOG_INF("USB MSC ready - fs mount fat /%s:", disk_name);
#endif
		}
	}
#else
	ARG_UNUSED(udev);
#endif
}

static bool usb_host_msc_needs_bringup(struct usb_device *udev)
{
#if IS_ENABLED(CONFIG_USBH_MSC_DISK)
	char disk_name[16];
#endif

	if (udev == NULL || udev->addr == 0U || udev->state != USB_STATE_CONFIGURED) {
		return false;
	}

	if (!usbh_device_still_connected(udev)) {
		return false;
	}

	if (!usbh_msc_device_has_storage(udev)) {
		return false;
	}

#if IS_ENABLED(CONFIG_USBH_MSC_DISK)
	if (usb_msc_disk_get_volume_name(udev, 0, disk_name, sizeof(disk_name)) >= 0) {
		return false;
	}
#endif

	return true;
}

static bool usb_host_msc_device_is_hub(const struct usb_device *udev)
{
	if (udev == NULL || udev->state != USB_STATE_CONFIGURED || udev->addr == 0U) {
		return false;
	}

	return udev->dev_desc.bDeviceClass == USB_BCC_HUB;
}

static bool usb_host_msc_any_hub_configured(void)
{
	struct usb_device *udev;

	SYS_DLIST_FOR_EACH_CONTAINER(&uhs_ctx.udevs, udev, node) {
		if (usb_host_msc_device_is_hub(udev)) {
			return true;
		}
	}

	return false;
}

static bool usb_host_msc_any_needs_bringup(void)
{
	struct usb_device *udev;

	SYS_DLIST_FOR_EACH_CONTAINER(&uhs_ctx.udevs, udev, node) {
		if (usb_host_msc_needs_bringup(udev)) {
			return true;
		}
	}

	return false;
}

/*
 * After a hub (re)connect, downstream MSC devices often configure on hub work
 * queue after power-good — wait briefly for further CONFIGURED notifications.
 */
static bool usb_host_msc_wait_hub_downstream(uint32_t budget_ms)
{
	uint32_t elapsed_ms = 0U;

	while (elapsed_ms < budget_ms) {
		if (usb_host_msc_any_needs_bringup()) {
			return true;
		}

		if (k_sem_take(&usbh_cfg_done_sem, K_NO_WAIT) == 0) {
			while (k_sem_take(&usbh_cfg_done_sem, K_NO_WAIT) == 0) {
				/* coalesce */
			}

			return true;
		}

		if (!usb_host_msc_any_hub_configured()) {
			return false;
		}

		k_msleep(50);
		elapsed_ms += 50U;
	}

	return usb_host_msc_any_needs_bringup();
}

static void usb_host_msc_try_bringup(struct usb_device *udev)
{
	int err;

	SAMPLE_TRACE("main: CONFIGURED addr=%u", udev->addr);

#if IS_ENABLED(CONFIG_USB_HOST_MSC_SAMPLE_FS_SHELL)
	msc_fs_unmount_udev(udev);
#endif

#if !IS_ENABLED(CONFIG_USB_HOST_MSC_SAMPLE_QUIET)
	LOG_INF("USB device: VID=0x%04x PID=0x%04x configs=%u", udev->dev_desc.idVendor,
		udev->dev_desc.idProduct, udev->dev_desc.bNumConfigurations);

	usb_host_dump_cfg_interfaces(udev);
	usb_host_try_print_msc_capacity(udev);
#endif

#if !IS_ENABLED(CONFIG_USBH_MSC_AUTO_BRINGUP)
	for (int steady = 0; steady < 50 && !usbh_post_configure_steady(udev); steady++) {
		k_msleep(10);
	}

	err = usb_host_msc_storage_bringup(udev, uhs_ctx.dev);
	if ((err == -ETIMEDOUT || err == -EALREADY) && usbh_device_still_connected(udev)) {
		LOG_WRN("main: MSC bringup err=%d — retry after detach/settle", err);
		usb_msc_disk_device_removed(udev);
		k_msleep(200);
		err = usb_host_msc_storage_bringup(udev, uhs_ctx.dev);
	}
#else
	err = usbh_device_still_connected(udev) ? 0 : -ENODEV;
#endif
	if (err == 0 && !usbh_device_still_connected(udev)) {
		LOG_WRN("main: device disconnected during MSC bringup");
		err = -ENODEV;
	}
	if (err == 0) {
#if IS_ENABLED(CONFIG_USB_HOST_MSC_SAMPLE_FAT_FILE_DEMO) &&                                        \
	IS_ENABLED(CONFIG_USB_HOST_MSC_SAMPLE_FAT_AUTO_DEMO)
		int fat_err = usb_host_msc_sample_fat_file_demo();

		if (fat_err == 0) {
			LOG_INF("main: simple FS ok (FS_VALIDATE passed)");
		} else {
			LOG_WRN("main: simple FS failed (err=%d)", fat_err);
		}
#elif IS_ENABLED(CONFIG_USB_HOST_MSC_SAMPLE_FAT_FILE_DEMO) && IS_ENABLED(CONFIG_FILE_SYSTEM)
		usb_host_msc_log_ready_volumes(udev);
#elif IS_ENABLED(CONFIG_USB_HOST_MSC_SAMPLE_LARGE_FILE_WRITE)
		int large_err = usb_host_msc_sample_write_large_text_file();

		if (large_err == 0) {
			LOG_INF("main: large file write ok");
		} else {
			LOG_WRN("main: large file write failed (err=%d)", large_err);
		}
		usb_host_msc_log_ready_volumes(udev);
#elif IS_ENABLED(CONFIG_USB_HOST_MSC_SAMPLE_FS_SHELL) && IS_ENABLED(CONFIG_USBH_MSC_DISK)
		usb_host_msc_log_ready_volumes(udev);
#elif IS_ENABLED(CONFIG_USB_HOST_MSC_SAMPLE_FAT_FILE_DEMO)
		LOG_INF("main: FatFs disk bound (auto demo disabled)");
#endif
	} else {
		LOG_WRN("main: MSC storage bringup failed (err=%d)", err);
	}
}

static void usb_host_msc_scan_all(void)
{
	struct usb_device *udev;

	/*
	 * Hub-tree replug can configure several MSC devices while bringup runs;
	 * rescan until none pending or pass limit (avoid spinning on hard errors).
	 */
	for (int pass = 0; pass < 8; pass++) {
		bool pending = false;

		SYS_DLIST_FOR_EACH_CONTAINER(&uhs_ctx.udevs, udev, node) {
			if (!usb_host_msc_needs_bringup(udev)) {
				if (udev->state == USB_STATE_CONFIGURED && udev->addr != 0U &&
				    !usbh_msc_device_has_storage(udev)) {
					SAMPLE_TRACE("main: addr=%u has no MSC interface — skip",
						     udev->addr);
				}
				continue;
			}

			usb_host_msc_try_bringup(udev);
		}

		while (k_sem_take(&usbh_cfg_done_sem, K_NO_WAIT) == 0) {
			/* coalesce notifications that arrived during bringup */
		}

		SYS_DLIST_FOR_EACH_CONTAINER(&uhs_ctx.udevs, udev, node) {
			if (usb_host_msc_needs_bringup(udev)) {
				pending = true;
				break;
			}
		}

		if (!pending) {
			break;
		}
	}
}

static void run_usb_host_enumeration(void)
{
	if (usb_host_bringup() != 0) {
		return;
	}

	SAMPLE_TRACE("USB host ready — plug a device; MSC runs after CONFIGURED");

	for (;;) {
		(void)k_sem_take(&usbh_cfg_done_sem, K_FOREVER);

		while (k_sem_take(&usbh_cfg_done_sem, K_NO_WAIT) == 0) {
			/* coalesce concurrent configure notifications */
		}

		usb_host_msc_scan_all();

		if (usb_host_msc_any_hub_configured() && usb_host_msc_wait_hub_downstream(1500U)) {
			usb_host_msc_scan_all();
		}
	}
}
#endif /* snps_dwc3 */

int main(void)
{
	printf("USB host MSC sample: %s\n", CONFIG_BOARD_TARGET);

	if (IS_ENABLED(CONFIG_THREAD_NAME)) {
		k_thread_name_set(k_current_get(), "main");
	}

#if DT_HAS_COMPAT_STATUS_OKAY(snps_dwc3)
	run_usb_host_enumeration();
#else
	LOG_INF("No snps,dwc3 in devicetree — add a usb_host.overlay. USB skipped");
#endif

	return 0;
}
```

## src/msc_fat_file_demo.c
```c
/*
 * Copyright (c) 2026 Advanced Micro Devices, Inc.
 *
 * SPDX-License-Identifier: Apache-2.0
 *
 * Simple FatFs on USB MSC: mount PC-formatted stick, list root, write nava.txt.
 */

#include "usb_host_dump.h"

#include <errno.h>
#include <stdio.h>
#include <string.h>

#include <ff.h>
#include <zephyr/fs/fs.h>
#include <zephyr/kernel.h>
#include <zephyr/logging/log.h>
#include <zephyr/storage/disk_access.h>

LOG_MODULE_REGISTER(msc_fat_file_demo, LOG_LEVEL_INF);

#if IS_ENABLED(CONFIG_USBH_MSC_DISK)
#define MSC_FAT_DISK_NAME CONFIG_USBH_MSC_DISK_NAME
#else
#define MSC_FAT_DISK_NAME CONFIG_USB_HOST_MSC_SAMPLE_DISK_NAME
#endif

#define MSC_FAT_DEMO_FILE_NAME     "nava.txt"
#define MSC_FAT_DEMO_FILE_CONTENT  CONFIG_USB_HOST_MSC_SAMPLE_FAT_FILE_CONTENT
#define MSC_FAT_DEMO_MOUNT_POINT   "/" MSC_FAT_DISK_NAME ":"
#define MSC_FAT_DEMO_ROOT_LIST_MAX 16

static FATFS fat_fs;
static struct fs_mount_t fat_mp = {
	.type = FS_FATFS,
	.fs_data = &fat_fs,
};

static int msc_fat_list_root(const char *mount_point)
{
	struct fs_dir_t dir;
	struct fs_dirent ent;
	unsigned int count = 0;
	int ret;

	fs_dir_t_init(&dir);
	ret = fs_opendir(&dir, mount_point);
	if (ret != 0) {
		LOG_ERR("msc_fat: fs_opendir %s failed: %d", mount_point, ret);
		return ret;
	}

	LOG_INF("msc_fat: root listing %s", mount_point);
	while (count < MSC_FAT_DEMO_ROOT_LIST_MAX) {
		ret = fs_readdir(&dir, &ent);
		if (ret != 0) {
			LOG_ERR("msc_fat: fs_readdir failed: %d", ret);
			(void)fs_closedir(&dir);
			return ret;
		}
		if (ent.name[0] == '\0') {
			break;
		}

		LOG_INF("msc_fat:   %s %s (%zu B)",
			(ent.type == FS_DIR_ENTRY_DIR) ? "[DIR]" : "[FILE]", ent.name, ent.size);
		count++;
	}

	if (count >= MSC_FAT_DEMO_ROOT_LIST_MAX) {
		LOG_INF("msc_fat:   … (capped at %u entries)", MSC_FAT_DEMO_ROOT_LIST_MAX);
	}

	ret = fs_closedir(&dir);
	if (ret != 0) {
		LOG_WRN("msc_fat: fs_closedir failed: %d", ret);
	}

	return 0;
}

int usb_host_msc_sample_fat_mount_volume(void)
{
	int ret;

	ret = disk_access_ioctl(MSC_FAT_DISK_NAME, DISK_IOCTL_CTRL_INIT, NULL);
	if (ret != 0) {
		LOG_ERR("msc_fat: disk init failed: %d", ret);
		return ret;
	}

	fat_mp.mnt_point = MSC_FAT_DEMO_MOUNT_POINT;
	ret = fs_mount(&fat_mp);
	if (ret == 0) {
		return 0;
	}

	LOG_WRN("msc_fat: fs_mount %s failed: %d", MSC_FAT_DEMO_MOUNT_POINT, ret);

#if IS_ENABLED(CONFIG_USB_HOST_MSC_SAMPLE_FAT_MKFS_ON_FAIL)
	{
		static MKFS_PARM mkfs_cfg = {
			.fmt = FM_FAT32 | FM_SFD,
			.n_fat = 1,
			.align = 0,
			.n_root = CONFIG_FS_FATFS_MAX_ROOT_ENTRIES,
			.au_size = 0,
		};
		char disk_id[16];

		LOG_WRN("msc_fat: mkfs requested — formatting volume (destructive)");

		ret = snprintf(disk_id, sizeof(disk_id), "%s:", MSC_FAT_DISK_NAME);
		if (ret < 0 || ret >= (int)sizeof(disk_id)) {
			return -ENOMEM;
		}

		ret = fs_mkfs(FS_FATFS, (uintptr_t)disk_id, &mkfs_cfg, 0);
		if (ret != 0) {
			LOG_ERR("msc_fat: fs_mkfs failed: %d", ret);
			return ret;
		}

		ret = fs_mount(&fat_mp);
		if (ret != 0) {
			LOG_ERR("msc_fat: fs_mount after mkfs failed: %d", ret);
			return ret;
		}

		LOG_INF("msc_fat: mkfs + mount %s ok", MSC_FAT_DEMO_MOUNT_POINT);
		return 0;
	}
#else
	LOG_ERR("msc_fat: no mount (use PC-formatted FAT stick or enable "
		"USB_HOST_MSC_SAMPLE_FAT_MKFS_ON_FAIL)");
	return ret;
#endif
}

#if IS_ENABLED(CONFIG_USB_HOST_MSC_SAMPLE_FAT_READBACK_VERIFY)
static int msc_fat_readback_verify(const char *path)
{
	struct fs_file_t file;
	char buf[64];
	ssize_t nread;
	int ret;

	fs_file_t_init(&file);
	ret = fs_open(&file, path, FS_O_READ);
	if (ret != 0) {
		LOG_ERR("msc_fat: readback fs_open %s failed: %d", path, ret);
		return ret;
	}

	nread = fs_read(&file, buf, sizeof(buf) - 1U);
	ret = fs_close(&file);
	if (ret != 0) {
		LOG_ERR("msc_fat: readback fs_close failed: %d", ret);
		return ret;
	}
	if (nread < 0) {
		LOG_ERR("msc_fat: readback fs_read failed: %zd", nread);
		return (int)nread;
	}

	buf[(size_t)nread] = '\0';
	if ((size_t)nread != strlen(MSC_FAT_DEMO_FILE_CONTENT) ||
	    memcmp(buf, MSC_FAT_DEMO_FILE_CONTENT, (size_t)nread) != 0) {
		LOG_ERR("msc_fat: readback mismatch (got %zd bytes): \"%s\"", nread, buf);
		return -EIO;
	}

	LOG_INF("msc_fat: readback verify OK (%zd bytes): \"%s\"", nread, buf);
	return 0;
}
#endif

int usb_host_msc_sample_fat_file_demo(void)
{
	struct fs_file_t file;
	char path[64];
	int ret;
	ssize_t written;

	fs_file_t_init(&file);

	ret = usb_host_msc_sample_fat_mount_volume();
	if (ret != 0) {
		return ret;
	}

	LOG_INF("msc_fat: mounted %s", MSC_FAT_DEMO_MOUNT_POINT);

	ret = msc_fat_list_root(MSC_FAT_DEMO_MOUNT_POINT);
	if (ret != 0) {
		(void)fs_unmount(&fat_mp);
		return ret;
	}

	ret = snprintf(path, sizeof(path), "%s/%s", MSC_FAT_DEMO_MOUNT_POINT,
		       MSC_FAT_DEMO_FILE_NAME);
	if (ret < 0 || ret >= (int)sizeof(path)) {
		(void)fs_unmount(&fat_mp);
		return -ENOMEM;
	}

	ret = fs_open(&file, path, FS_O_CREATE | FS_O_WRITE);
	if (ret != 0) {
		LOG_ERR("msc_fat: fs_open %s failed: %d", path, ret);
		(void)fs_unmount(&fat_mp);
		return ret;
	}

	written = fs_write(&file, MSC_FAT_DEMO_FILE_CONTENT, strlen(MSC_FAT_DEMO_FILE_CONTENT));
	if (written < 0) {
		LOG_ERR("msc_fat: fs_write failed: %zd", written);
		(void)fs_close(&file);
		(void)fs_unmount(&fat_mp);
		return (int)written;
	}

	ret = fs_close(&file);
	if (ret != 0) {
		LOG_ERR("msc_fat: fs_close failed: %d", ret);
		(void)fs_unmount(&fat_mp);
		return ret;
	}

	LOG_INF("msc_fat: wrote %s (%zu bytes): \"%s\"", MSC_FAT_DEMO_FILE_NAME,
		strlen(MSC_FAT_DEMO_FILE_CONTENT), MSC_FAT_DEMO_FILE_CONTENT);

#if IS_ENABLED(CONFIG_USB_HOST_MSC_SAMPLE_FAT_READBACK_VERIFY)
	ret = msc_fat_readback_verify(path);
	if (ret != 0) {
		(void)fs_unmount(&fat_mp);
		return ret;
	}
#endif

#if IS_ENABLED(CONFIG_USB_HOST_MSC_SAMPLE_FAT_RELIST_AFTER_WRITE)
	ret = msc_fat_list_root(MSC_FAT_DEMO_MOUNT_POINT);
	if (ret != 0) {
		(void)fs_unmount(&fat_mp);
		return ret;
	}
#endif

	(void)disk_access_ioctl(MSC_FAT_DISK_NAME, DISK_IOCTL_CTRL_SYNC, NULL);

	ret = fs_unmount(&fat_mp);
	if (ret != 0) {
		LOG_WRN("msc_fat: fs_unmount failed: %d", ret);
		return ret;
	}

	LOG_INF("msc_fat: FS_VALIDATE OK");

	return 0;
}

int usb_host_msc_sample_fat_unmount_volume(void)
{
	return fs_unmount(&fat_mp);
}

const char *usb_host_msc_sample_fat_mount_point(void)
{
	return MSC_FAT_DEMO_MOUNT_POINT;
}
```

## src/msc_large_file_write.c
```c
/*
 * Copyright (c) 2026 Advanced Micro Devices, Inc.
 *
 * SPDX-License-Identifier: Apache-2.0
 *
 * Write a large repeating text file to a FAT volume on USB MSC.
 */

#include "usb_host_dump.h"

#include <errno.h>
#include <stdio.h>
#include <string.h>

#include <zephyr/fs/fs.h>
#include <zephyr/kernel.h>
#include <zephyr/logging/log.h>
#include <zephyr/storage/disk_access.h>
#include <zephyr/sys/util.h>

LOG_MODULE_REGISTER(msc_large_file, LOG_LEVEL_INF);

#if IS_ENABLED(CONFIG_USBH_MSC_DISK)
#define MSC_FAT_DISK_NAME CONFIG_USBH_MSC_DISK_NAME
#else
#define MSC_FAT_DISK_NAME CONFIG_USB_HOST_MSC_SAMPLE_DISK_NAME
#endif

#define MSC_LARGE_FILE_SIZE_BYTES                                                                  \
	((uint32_t)CONFIG_USB_HOST_MSC_SAMPLE_LARGE_FILE_SIZE_MB * 1024U * 1024U)

#define MSC_LARGE_FILE_PROGRESS_BYTES (1024U * 1024U)

static int msc_large_file_fill_chunk(uint8_t *buf, size_t buflen, uint32_t byte_offset)
{
	size_t pos = 0U;

	while (pos < buflen) {
		int n = snprintf((char *)&buf[pos], buflen - pos, "USB MSC large file offset=%u\n",
				 byte_offset + (uint32_t)pos);

		if (n <= 0) {
			return -EIO;
		}

		if ((size_t)n >= buflen - pos) {
			/* Line truncated: pad remainder with a fixed pattern. */
			memset(&buf[pos], 'X', buflen - pos);
			pos = buflen;
			break;
		}

		pos += (size_t)n;
	}

	return 0;
}

int usb_host_msc_sample_write_large_text_file(void)
{
	struct fs_file_t file;
	char path[80];
	uint8_t chunk[CONFIG_USB_HOST_MSC_SAMPLE_LARGE_FILE_CHUNK_SIZE];
	uint32_t total = MSC_LARGE_FILE_SIZE_BYTES;
	uint32_t written_total = 0U;
	uint32_t next_progress = MSC_LARGE_FILE_PROGRESS_BYTES;
	int64_t start_ms;
	int ret;

	if (total == 0U) {
		return -EINVAL;
	}

	ret = usb_host_msc_sample_fat_mount_volume();
	if (ret != 0) {
		return ret;
	}

	ret = snprintf(path, sizeof(path), "%s/%s", usb_host_msc_sample_fat_mount_point(),
		       CONFIG_USB_HOST_MSC_SAMPLE_LARGE_FILE_NAME);
	if (ret < 0 || ret >= (int)sizeof(path)) {
		ret = -ENOMEM;
		goto unmount;
	}

	fs_file_t_init(&file);
	ret = fs_open(&file, path, FS_O_CREATE | FS_O_WRITE);
	if (ret != 0) {
		LOG_ERR("msc_large: fs_open %s failed: %d", path, ret);
		goto unmount;
	}

	LOG_INF("msc_large: writing %u bytes (%u MiB) to %s", total,
		(unsigned int)CONFIG_USB_HOST_MSC_SAMPLE_LARGE_FILE_SIZE_MB, path);

	start_ms = k_uptime_get();

	while (written_total < total) {
		uint32_t chunk_len = MIN((uint32_t)sizeof(chunk), total - written_total);
		ssize_t nwrite;

		ret = msc_large_file_fill_chunk(chunk, chunk_len, written_total);
		if (ret != 0) {
			goto close_file;
		}

		nwrite = fs_write(&file, chunk, chunk_len);
		if (nwrite < 0) {
			LOG_ERR("msc_large: fs_write failed at %u: %zd", written_total, nwrite);
			ret = (int)nwrite;
			goto close_file;
		}

		written_total += (uint32_t)nwrite;

		if (written_total >= next_progress) {
			LOG_INF("msc_large: %u / %u bytes written", written_total, total);
			next_progress += MSC_LARGE_FILE_PROGRESS_BYTES;
		}
	}

	ret = fs_sync(&file);
	if (ret != 0) {
		LOG_ERR("msc_large: fs_sync failed: %d", ret);
		goto close_file;
	}

	ret = fs_close(&file);
	if (ret != 0) {
		LOG_ERR("msc_large: fs_close failed: %d", ret);
		goto unmount;
	}

	{
		struct fs_dirent ent;

		ret = fs_stat(path, &ent);
		if (ret != 0) {
			LOG_ERR("msc_large: fs_stat failed: %d", ret);
			goto unmount;
		}

		if (ent.type != FS_DIR_ENTRY_FILE || ent.size != total) {
			LOG_ERR("msc_large: size mismatch (got %zu, want %u)", ent.size, total);
			ret = -EIO;
			goto unmount;
		}
	}

	(void)disk_access_ioctl(MSC_FAT_DISK_NAME, DISK_IOCTL_CTRL_SYNC, NULL);

	LOG_INF("msc_large: done — %u bytes in %lld ms", written_total,
		(long long)(k_uptime_get() - start_ms));

	ret = usb_host_msc_sample_fat_unmount_volume();
	if (ret != 0) {
		LOG_WRN("msc_large: fs_unmount failed: %d", ret);
	}

	return 0;

close_file:
	(void)fs_close(&file);
unmount:
	(void)usb_host_msc_sample_fat_unmount_volume();
	return ret;
}
```

## src/msc_multi_mount.c
```c
/*
 * Copyright (c) 2026 Advanced Micro Devices, Inc.
 *
 * SPDX-License-Identifier: Apache-2.0
 *
 * Independent FatFs mounts for multiple USB MSC volumes. The stock ``fs mount fat``
 * shell command tracks only one FAT mount; use ``msc mount USB`` / ``msc mount USB1``
 * here so each stick can stay mounted concurrently.
 */

#include "msc_multi_mount.h"

#include <errno.h>
#include <stdio.h>
#include <string.h>

#include <ff.h>
#include <zephyr/fs/fs.h>
#include <zephyr/kernel.h>
#include <zephyr/logging/log.h>
#include <zephyr/shell/shell.h>
#include <zephyr/storage/disk_access.h>
#include <zephyr/sys/util.h>
#include <zephyr/usb/usb_msc_disk.h>

LOG_MODULE_REGISTER(msc_multi_mount, LOG_LEVEL_INF);

#ifndef CONFIG_USBH_MSC_LUN_SLOTS
#define MSC_FS_VOL_SLOTS 4
#else
#define MSC_FS_VOL_SLOTS CONFIG_USBH_MSC_LUN_SLOTS
#endif

struct msc_fs_vol {
	bool mounted;
	char disk_name[16];
	char mnt_point[20];
	FATFS fat_fs;
	struct fs_mount_t mp;
};

static struct msc_fs_vol msc_vols[MSC_FS_VOL_SLOTS];

static struct msc_fs_vol *msc_fs_find_disk(const char *disk_name)
{
	for (size_t i = 0U; i < ARRAY_SIZE(msc_vols); i++) {
		if (msc_vols[i].mounted &&
		    strncmp(msc_vols[i].disk_name, disk_name, sizeof(msc_vols[i].disk_name)) == 0) {
			return &msc_vols[i];
		}
	}

	return NULL;
}

static struct msc_fs_vol *msc_fs_find_free(void)
{
	for (size_t i = 0U; i < ARRAY_SIZE(msc_vols); i++) {
		if (!msc_vols[i].mounted) {
			return &msc_vols[i];
		}
	}

	return NULL;
}

static int msc_fs_disk_init(const char *disk_name)
{
	int err;

	err = disk_access_ioctl(disk_name, DISK_IOCTL_CTRL_INIT, NULL);
	if (err != 0) {
		LOG_ERR("Disk \"%s\" init failed: %d", disk_name, err);
	}

	return err;
}

static void msc_fs_vol_clear(struct msc_fs_vol *vol)
{
	int err;

	if (vol == NULL || !vol->mounted) {
		if (vol != NULL) {
			(void)memset(vol, 0, sizeof(*vol));
		}
		return;
	}

	err = fs_unmount_path(vol->mnt_point);
	if (err != 0) {
		LOG_WRN("MSC FAT unmount %s failed: %d (dropping slot)", vol->mnt_point, err);
	} else {
		LOG_INF("MSC FAT unmounted %s", vol->mnt_point);
	}

	(void)memset(vol, 0, sizeof(*vol));
}

int msc_fs_mount_disk(const char *disk_name)
{
	struct msc_fs_vol *vol;
	struct fs_dirent ent;
	int err;

	if (disk_name == NULL || disk_name[0] == '\0') {
		return -EINVAL;
	}

	vol = msc_fs_find_disk(disk_name);
	if (vol != NULL) {
		if (fs_stat(vol->mnt_point, &ent) == 0) {
			return -EALREADY;
		}

		LOG_WRN("MSC FAT stale mount on %s — remounting", vol->mnt_point);
		msc_fs_vol_clear(vol);
	}

	vol = msc_fs_find_free();
	if (vol == NULL) {
		return -ENOMEM;
	}

	err = msc_fs_disk_init(disk_name);
	if (err != 0) {
		return err;
	}

	(void)strncpy(vol->disk_name, disk_name, sizeof(vol->disk_name) - 1U);
	vol->disk_name[sizeof(vol->disk_name) - 1U] = '\0';
	(void)snprintk(vol->mnt_point, sizeof(vol->mnt_point), "/%s:", disk_name);

	vol->mp.type = FS_FATFS;
	vol->mp.fs_data = &vol->fat_fs;
	vol->mp.mnt_point = vol->mnt_point;
	vol->mp.storage_dev = vol->disk_name;

	err = fs_mount(&vol->mp);
	if (err != 0) {
		(void)memset(vol, 0, sizeof(*vol));
		return err;
	}

	vol->mounted = true;
	LOG_INF("MSC FAT mounted at %s", vol->mnt_point);

	return 0;
}

int msc_fs_unmount_disk(const char *disk_name)
{
	struct msc_fs_vol *vol;

	if (disk_name == NULL || disk_name[0] == '\0') {
		return -EINVAL;
	}

	vol = msc_fs_find_disk(disk_name);
	if (vol == NULL) {
		return -ENOENT;
	}

	msc_fs_vol_clear(vol);

	return 0;
}

void msc_fs_unmount_udev(struct usb_device *udev)
{
	char disk_name[16];

	if (udev == NULL) {
		return;
	}

	for (uint8_t lun = 0U; lun < 16U; lun++) {
		if (usb_msc_disk_get_volume_name(udev, lun, disk_name, sizeof(disk_name)) >= 0) {
			(void)msc_fs_unmount_disk(disk_name);
		}
	}
}

static void msc_fs_strip_disk_name(const char *arg, char *disk_name, size_t buflen)
{
	const char *start = arg;

	if (arg == NULL || disk_name == NULL || buflen == 0U) {
		return;
	}

	if (start[0] == '/') {
		start++;
	}

	(void)strncpy(disk_name, start, buflen - 1U);
	disk_name[buflen - 1U] = '\0';

	char *colon = strchr(disk_name, ':');

	if (colon != NULL) {
		*colon = '\0';
	}
}

static int cmd_msc_mount(const struct shell *sh, size_t argc, char **argv)
{
	char disk_name[16];
	int err;

	ARG_UNUSED(argc);

	msc_fs_strip_disk_name(argv[1], disk_name, sizeof(disk_name));
	err = msc_fs_mount_disk(disk_name);
	if (err == -EALREADY) {
		shell_print(sh, "/%s: already mounted", disk_name);
		return 0;
	}
	if (err != 0) {
		shell_error(sh, "msc mount %s failed: %d", disk_name, err);
		return err;
	}

	shell_print(sh, "Mounted /%s: — use fs ls /%s:", disk_name, disk_name);
	return 0;
}

static int cmd_msc_umount(const struct shell *sh, size_t argc, char **argv)
{
	char disk_name[16];
	int err;

	ARG_UNUSED(argc);

	msc_fs_strip_disk_name(argv[1], disk_name, sizeof(disk_name));
	err = msc_fs_unmount_disk(disk_name);
	if (err == -ENOENT) {
		shell_warn(sh, "/%s: not mounted", disk_name);
		return 0;
	}
	if (err != 0) {
		shell_error(sh, "msc umount %s failed: %d", disk_name, err);
		return err;
	}

	shell_print(sh, "Unmounted /%s:", disk_name);
	return 0;
}

static int cmd_msc_mounts(const struct shell *sh, size_t argc, char **argv)
{
	unsigned int count = 0U;

	ARG_UNUSED(argc);
	ARG_UNUSED(argv);

	for (size_t i = 0U; i < ARRAY_SIZE(msc_vols); i++) {
		if (msc_vols[i].mounted) {
			shell_print(sh, "  %s", msc_vols[i].mnt_point);
			count++;
		}
	}

	if (count == 0U) {
		shell_print(sh, "No MSC FAT volumes mounted (try: msc mount USB)");
	}

	return 0;
}

static int cmd_msc_write(const struct shell *sh, size_t argc, char **argv)
{
	struct fs_file_t file;
	char text[256];
	size_t len = 0U;
	int err;

	if (argc < 3) {
		shell_error(sh, "Usage: msc write <path> <text...>");
		return -EINVAL;
	}

	for (int i = 2; i < (int)argc; i++) {
		if (i > 2 && len + 1U < sizeof(text)) {
			text[len++] = ' ';
		}

		const size_t arg_len = strlen(argv[i]);
		const size_t copy = MIN(arg_len, sizeof(text) - len - 1U);

		if (copy == 0U) {
			break;
		}

		memcpy(text + len, argv[i], copy);
		len += copy;
	}
	text[len] = '\0';

	fs_file_t_init(&file);
	err = fs_open(&file, argv[1], FS_O_CREATE | FS_O_WRITE | FS_O_TRUNC);
	if (err != 0) {
		shell_error(sh, "msc write: open %s failed: %d (is volume mounted?)", argv[1], err);
		return err;
	}

	err = fs_write(&file, text, len);
	if (err < 0) {
		shell_error(sh, "msc write: write failed: %d", err);
		(void)fs_close(&file);
		return err;
	}

	for (int pass = 0; pass < 5; pass++) {
		err = fs_sync(&file);
		if (err == 0) {
			break;
		}
		if (err != -EIO && err != -EAGAIN) {
			break;
		}
		k_msleep(50 * (pass + 1));
	}

	err = fs_close(&file);
	if (err != 0) {
		shell_warn(sh, "msc write: close failed: %d — data may still be readable", err);
		shell_print(sh, "Wrote %u bytes to %s (close incomplete)", (unsigned int)len,
			    argv[1]);
		return 0;
	}

	shell_print(sh, "Wrote %u bytes to %s", (unsigned int)len, argv[1]);
	return 0;
}

SHELL_STATIC_SUBCMD_SET_CREATE(
	msc_subcmds,
	SHELL_CMD_ARG(mount, NULL, "Mount MSC volume <USB|USB1|/USB:>", cmd_msc_mount, 2, 0),
	SHELL_CMD_ARG(umount, NULL, "Unmount MSC volume <USB|USB1|/USB:>", cmd_msc_umount, 2, 0),
	SHELL_CMD(mounts, NULL, "List MSC FAT mount points", cmd_msc_mounts),
	SHELL_CMD_ARG(write, NULL, "Write text file <path> <text...>", cmd_msc_write, 3, 255),
	SHELL_SUBCMD_SET_END);

SHELL_CMD_REGISTER(msc, &msc_subcmds, "USB MSC multi-volume FatFs mount", NULL);
```

## src/msc_multi_mount.h
```c
/*
 * Copyright (c) 2026 Advanced Micro Devices, Inc.
 *
 * SPDX-License-Identifier: Apache-2.0
 */

#ifndef USB_HOST_MSC_MULTI_MOUNT_H_
#define USB_HOST_MSC_MULTI_MOUNT_H_

#include <zephyr/drivers/usb/uhc.h>

/**
 * @brief Mount one MSC disk_access volume at /\<disk\>:
 *
 * @param disk_name disk_access name (e.g. ``USB``, ``USB1``)
 * @return 0 on success, negative errno on failure
 */
int msc_fs_mount_disk(const char *disk_name);

/**
 * @brief Unmount /\<disk\>: if mounted by this helper
 *
 * @param disk_name disk_access name without colon
 * @return 0 on success, -ENOENT when not mounted, other negative errno on failure
 */
int msc_fs_unmount_disk(const char *disk_name);

/** @brief Unmount every MSC volume attached to @a udev */
void msc_fs_unmount_udev(struct usb_device *udev);

#endif /* USB_HOST_MSC_MULTI_MOUNT_H_ */
```

## src/usb_host_dump.c
```c
/*
 * Copyright (c) 2026 Advanced Micro Devices, Inc.
 *
 * SPDX-License-Identifier: Apache-2.0
 */

#include "usb_host_dump.h"

#include <errno.h>
#include <string.h>

#include <zephyr/device.h>
#include <zephyr/logging/log.h>
#include <zephyr/usb/usb_ch9.h>
#include <zephyr/usb/usbh.h>
#include <zephyr/usb/usbh_msc.h>

LOG_MODULE_REGISTER(usb_host_dump, LOG_LEVEL_INF);

void usb_host_dump_cfg_interfaces(struct usb_device *udev)
{
	if (udev->cfg_desc == NULL) {
		LOG_INF("usb_host_dump: no configuration descriptor");
		return;
	}

	if (udev->state != USB_STATE_CONFIGURED) {
		LOG_INF("usb_host_dump: device not configured (state=%d)", udev->state);
	}

	const uint8_t *raw = udev->cfg_desc;
	const struct usb_cfg_descriptor *cfg = (const void *)raw;
	const uint16_t total = cfg->wTotalLength;

	LOG_INF("Configuration[%u]: interfaces (parsed from cfg_desc, %u bytes)",
		cfg->bConfigurationValue, total);

	for (uint16_t off = 0U; off + 2U <= total;) {
		const uint8_t len = raw[off];
		const uint8_t type = raw[off + 1U];

		if (len < 2U || off + len > total) {
			break;
		}

		if (type == USB_DESC_INTERFACE && len >= sizeof(struct usb_if_descriptor)) {
			const struct usb_if_descriptor *ifd = (const void *)(raw + off);

			LOG_INF("  if %u alt %u: class 0x%02x sub 0x%02x proto 0x%02x "
				"(%u endpoint(s))",
				ifd->bInterfaceNumber, ifd->bAlternateSetting, ifd->bInterfaceClass,
				ifd->bInterfaceSubClass, ifd->bInterfaceProtocol,
				ifd->bNumEndpoints);
		}

		off += len;
	}
}

void usb_host_try_print_msc_capacity(struct usb_device *udev)
{
	struct usbh_msc_iface msc;
	int ret;

	if (udev->cfg_desc == NULL || udev->state != USB_STATE_CONFIGURED) {
		return;
	}

	ret = usbh_msc_find_bulk_interface(udev, &msc);
	if (ret != 0) {
		return;
	}

	LOG_INF("MSC probe: if%u alt%u sub 0x%02x proto 0x%02x bulk IN=0x%02x OUT=0x%02x "
		"mps %u/%u BBB=%d",
		msc.iface_num, msc.alt_setting, msc.subclass, msc.protocol, msc.ep_in_addr,
		msc.ep_out_addr, msc.mps_in, msc.mps_out, msc.bulk_only ? 1 : 0);
}

int usb_host_msc_storage_bringup(struct usb_device *udev, const struct device *uhc_dev)
{
	return usbh_msc_storage_bringup(udev, uhc_dev, NULL);
}
```

## src/usb_host_dump.h
```c
/*
 * Copyright (c) 2026 Advanced Micro Devices, Inc.
 *
 * SPDX-License-Identifier: Apache-2.0
 */

/**
 * @file
 * @brief USB host MSC sample enumeration dump and MSC bring-up helpers
 */

#ifndef USB_HOST_DUMP_H_
#define USB_HOST_DUMP_H_

#include <stddef.h>
#include <stdint.h>

#include <zephyr/usb/usbh_msc.h>

/**
 * @brief Log configuration descriptor interfaces and endpoints after enumeration.
 *
 * @param udev USB device with valid @c cfg_desc
 */
void usb_host_dump_cfg_interfaces(struct usb_device *udev);

/**
 * @brief Attempt MSC capacity logging when a configured device is present.
 *
 * No-op unless the device is configured and MSC descriptors are available.
 *
 * @param udev USB device to inspect
 */
void usb_host_try_print_msc_capacity(struct usb_device *udev);

/**
 * @brief MSC storage bring-up via host stack (SCSI probe + optional LUN0 scsi_disk).
 *
 * Wrapper around @ref usbh_msc_storage_bringup() with default LUN0 attach when
 * @kconfig:option:`CONFIG_USBH_MSC_DISK_AUTO_ATTACH` is enabled.
 *
 * @param udev USB device
 * @param uhc_dev Host controller device for BOT recovery
 *
 * @retval 0 Bring-up succeeded
 * @retval negative errno from host stack bring-up
 */
int usb_host_msc_storage_bringup(struct usb_device *udev, const struct device *uhc_dev);

#if IS_ENABLED(CONFIG_USB_HOST_MSC_SAMPLE_FAT_FILE_DEMO)
/**
 * @brief Mount FAT on USB MSC, list root directory, and write a demo file.
 *
 * Requires prior disk access registration during storage bring-up.
 *
 * @retval 0 Demo completed
 * @retval negative errno from mount, directory listing, or file I/O
 */
int usb_host_msc_sample_fat_file_demo(void);

/**
 * @brief Mount the USB MSC FAT volume registered via disk_access.
 *
 * @retval 0 Volume mounted
 * @retval negative errno from disk init or fs_mount
 */
int usb_host_msc_sample_fat_mount_volume(void);

/**
 * @brief Unmount the USB MSC FAT volume.
 *
 * @retval 0 Volume unmounted
 * @retval negative errno from fs_unmount
 */
int usb_host_msc_sample_fat_unmount_volume(void);

/**
 * @brief Mount point string (e.g. "/USB:").
 */
const char *usb_host_msc_sample_fat_mount_point(void);
#endif

#if IS_ENABLED(CONFIG_USB_HOST_MSC_SAMPLE_LARGE_FILE_WRITE)
/**
 * @brief Create and write a large text file on the USB MSC FAT volume.
 *
 * Mounts FAT, writes CONFIG_USB_HOST_MSC_SAMPLE_LARGE_FILE_SIZE_MB megabytes,
 * verifies size with fs_stat, syncs, and unmounts.
 *
 * @retval 0 Write completed
 * @retval negative errno from mount or file I/O
 */
int usb_host_msc_sample_write_large_text_file(void);
#endif

#endif /* USB_HOST_DUMP_H_ */
```
