## samples/subsys/usb/host_msc/Kconfig
```kconfig
#
# SPDX-License-Identifier: Apache-2.0
#

mainmenu "USB host MSC sample options"

menu "USB MSC FatFs (disk_access)"

config USB_HOST_MSC_SAMPLE_FAT_FILE_DEMO
	bool "USB MSC disk_access backend for FatFs"
	default n
	depends on FAT_FILESYSTEM_ELM
	select USBH_MSC_DISK
	help
	  After MSC storage bring-up, a disk_access volume is registered by the
	  USB host stack (CONFIG_USBH_MSC_DISK). Use FAT_AUTO_DEMO for an
	  automatic smoke test, or FS_SHELL for the interactive fs shell.

config USB_HOST_MSC_SAMPLE_FAT_AUTO_DEMO
	bool "Run automatic FS demo after MSC storage bringup"
	default y if !USB_HOST_MSC_SAMPLE_FS_SHELL
	default n
	depends on USB_HOST_MSC_SAMPLE_FAT_FILE_DEMO
	help
	  When y: call usb_host_msc_sample_fat_file_demo() after LUN0 disk bind.
	  When n: only bind disk_access (shell or app mounts FatFs).

config USB_HOST_MSC_SAMPLE_FS_SHELL
	bool "Interactive Zephyr fs shell on UART (mount/ls/cat/write/...)"
	default n
	depends on USB_HOST_MSC_SAMPLE_FAT_FILE_DEMO
	select SHELL
	select SHELL_BACKEND_SERIAL
	select FILE_SYSTEM_SHELL
	select USBH_SHELL
	help
	  Typical sequence:
	    fs mount fat /USB:
	    fs ls /USB:
	    fs write -s -p /USB:/hello.txt hello

config USB_HOST_MSC_SAMPLE_TIMER_SELFTEST
	bool "Run k_timer/k_poll self-test at boot"
	default n
	help
	  Exercises k_sleep, k_poll, and k_timer before USB host bring-up.

config USB_HOST_MSC_SAMPLE_QUIET
	bool "Quiet USB host (no trace logs or redundant descriptor dump)"
	default y if USB_HOST_MSC_SAMPLE_FS_SHELL
	default n
	help
	  Skips main() trace logs after enumeration. Pair with USBH/UHC log
	  level WRN in board conf.

config USB_HOST_MSC_SAMPLE_FAT_MKFS_ON_FAIL
	bool "Format stick with mkfs when mount fails (destructive)"
	default n
	depends on USB_HOST_MSC_SAMPLE_FAT_FILE_DEMO
	select FS_FATFS_MKFS
	help
	  When n (default): mount failure is fatal — safe for PC-formatted sticks.

config USB_HOST_MSC_SAMPLE_FAT_READBACK_VERIFY
	bool "After write, fs_read demo file and memcmp expected content"
	default y
	depends on USB_HOST_MSC_SAMPLE_FAT_FILE_DEMO

config USB_HOST_MSC_SAMPLE_FAT_RELIST_AFTER_WRITE
	bool "List root directory again after writing demo file"
	default y
	depends on USB_HOST_MSC_SAMPLE_FAT_FILE_DEMO

config USB_HOST_MSC_SAMPLE_FAT_FILE_CONTENT
	string "Text written to the demo file for FS validation"
	default "NAVA KISHORE"
	depends on USB_HOST_MSC_SAMPLE_FAT_FILE_DEMO

config USB_HOST_MSC_SAMPLE_DISK_NAME
	string "disk_access / FatFs volume name (legacy, use USBH_MSC_DISK_NAME)"
	default "USB"
	depends on USB_HOST_MSC_SAMPLE_FAT_FILE_DEMO && !USBH_MSC_DISK
	help
	  Used only when CONFIG_USBH_MSC_DISK is disabled. When USBH_MSC_DISK is
	  enabled, CONFIG_USBH_MSC_DISK_NAME is used instead.

config USB_HOST_MSC_SAMPLE_LARGE_FILE_WRITE
	bool "Write a large text file to USB MSC after bring-up"
	default n
	depends on USB_HOST_MSC_SAMPLE_FAT_FILE_DEMO
	help
	  After MSC storage bring-up, mount FAT and write a multi-megabyte
	  text file to stress bulk READ/WRITE and FatFs. Incompatible with
	  USB_HOST_MSC_SAMPLE_FAT_AUTO_DEMO (enable one automatic demo).

config USB_HOST_MSC_SAMPLE_LARGE_FILE_SIZE_MB
	int "Large text file size (MiB)"
	default 10
	range 1 128
	depends on USB_HOST_MSC_SAMPLE_LARGE_FILE_WRITE
	help
	  Size of the generated text file in mebibytes (default 10 MiB).

config USB_HOST_MSC_SAMPLE_LARGE_FILE_CHUNK_SIZE
	int "Large file write chunk size (bytes)"
	default 4096
	range 512 65536
	depends on USB_HOST_MSC_SAMPLE_LARGE_FILE_WRITE
	help
	  Buffer size for each fs_write() call while generating the file.

config USB_HOST_MSC_SAMPLE_LARGE_FILE_NAME
	string "Large text file name on the FAT volume"
	default "large10m.txt"
	depends on USB_HOST_MSC_SAMPLE_LARGE_FILE_WRITE

endmenu

source "Kconfig.zephyr"
```

## samples/subsys/usb/uf2/Kconfig
```kconfig
# Copyright (c) 2026 Nordic Semiconductor ASA
# SPDX-License-Identifier: Apache-2.0

source "$(ZEPHYR_BASE)/samples/subsys/usb/uf2/Kconfig.family"

menu "UF2 sample options"

config APP_UF2_FAMILY_ID
	string "UF2 device family ID"
	default APP_UF2_FAMILY_ID_DEFAULT if APP_UF2_FAMILY_ID_DEFAULT != ""
	default BUILD_OUTPUT_UF2_FAMILY_ID
	help
	  Only blocks of UF2 files with this family ID are programmed. This can
	  be either a hex value, e.g. 0x68ed2b88, or a well-known family name
	  string. The default is the ID from Kconfig.family if the board has one,
	  otherwise the family ID of the SoC if it is known to the UF2 family
	  list. The IDs in Kconfig.family are not registered, they are local to
	  this sample.

config APP_UF2_AUTO_REBOOT
	bool "Restart when the image is complete"
	default y
	help
	  Detach from the USB bus and restart after the last block of the UF2
	  file has been programmed, which starts the new application. The
	  restart waits until the host marks the volume clean, one second at most.
	  If disabled, the bootloader stays in UF2 mode and the user has to reset
	  the board to start the application.

endmenu

# Source common USB sample options used to initialize new experimental USB
# device stack. The scope of these options is limited to USB samples in project
# tree, you cannot use them in your own application.
source "samples/subsys/usb/common/Kconfig.sample_usbd"

source "Kconfig.zephyr"
```

## samples/subsys/usb/uf2/Kconfig.sysbuild
```kconfig
# Copyright (c) 2026 Nordic Semiconductor ASA
# SPDX-License-Identifier: Apache-2.0

config APP_UF2_APPLICATION
	string "Application built and flashed together with the bootloader"
	default "$(ZEPHYR_BASE)/samples/hello_world"
	help
	  Source directory of an application that is linked into the slot0
	  partition, it is built for the same board and flashed after the
	  bootloader. Leave it empty to build the bootloader only.

source "$(ZEPHYR_BASE)/samples/subsys/usb/uf2/Kconfig.family"

config APP_UF2_FAMILY_ID
	string "UF2 device family ID of the application"
	default APP_UF2_FAMILY_ID_DEFAULT
	help
	  Family ID for the UF2 file of the application, it must match the
	  one of the bootloader. The default is the ID from Kconfig.family if
	  the board has one. If it is empty, the family ID of the SoC is used,
	  if it is known to the UF2 family list.

source "$(ZEPHYR_BASE)/share/sysbuild/Kconfig"
```

## samples/subsys/video/capture/boards/aipi_eyes_s2.conf
```kconfig
CONFIG_VIDEO_BUFFER_POOL_HEAP_SIZE=3841024
CONFIG_VIDEO_BUFFER_POOL_ZEPHYR_REGION=y
CONFIG_VIDEO_BUFFER_POOL_ZEPHYR_REGION_NAME="PSRAM"
CONFIG_VIDEO_FRAME_WIDTH=1600
CONFIG_VIDEO_FRAME_HEIGHT=1200
CONFIG_VIDEO_PIXEL_FORMAT="RGBP"

# Assuming display is not attached
CONFIG_SHELL=y
CONFIG_VIDEO_SHELL=y
```

## samples/subsys/video/capture/boards/esp32p4x_function_ev_board_esp32p4_hpcore.conf
```kconfig
CONFIG_VIDEO_FRAME_WIDTH=1024
CONFIG_VIDEO_FRAME_HEIGHT=600
CONFIG_VIDEO_PIXEL_FORMAT="RGBP"
```

## samples/subsys/video/capture/boards/esp32s3_eye_procpu.conf
```kconfig
CONFIG_VIDEO_BUFFER_POOL_HEAP_SIZE=230800
CONFIG_SOC_FAMILY_ESPRESSIF_SPIRAM=y
CONFIG_SOC_FAMILY_ESPRESSIF_SPIRAM_MODE_OCT=y
CONFIG_VIDEO_BUFFER_POOL_ALIGN=32
CONFIG_VIDEO_FRAME_HEIGHT=240
CONFIG_VIDEO_FRAME_WIDTH=240
CONFIG_VIDEO_PIXEL_FORMAT="RGBP"
CONFIG_VIDEO_CTRL_VFLIP=y
```

## samples/subsys/video/capture/boards/mimxrt1160_evk_mimxrt1166_cm7.conf
```kconfig
CONFIG_VIDEO_BUFFER_POOL_HEAP_SIZE=7373600
CONFIG_VIDEO_FRAME_WIDTH=1280
CONFIG_VIDEO_FRAME_HEIGHT=720
CONFIG_VIDEO_PIXEL_FORMAT="XR24"
CONFIG_DMA=y
```

## samples/subsys/video/capture/sysbuild/boards/stm32h7s78_dk_stm32h7s7xx_ext_flash_app.conf
```kconfig
#
# SPDX-FileCopyrightText: Copyright 2026 Panoramix Labs
# SPDX-License-Identifier: Apache-2.0
#

CONFIG_LOG_BUFFER_SIZE=2048

CONFIG_VIDEO_PIXEL_FORMAT="RGBP"
CONFIG_VIDEO_FRAME_WIDTH=640
CONFIG_VIDEO_FRAME_HEIGHT=480
CONFIG_VIDEO_STM32_DCMIPP_SENSOR_WIDTH=640
;;;asdg
asdf
CONFIG_VIDEO_STM32_DCMIPP_SENSOR_HEIGHT=480
CONFIG_VIDEO_BUFFER_POOL_HEAP_SIZE=614800
```

## samples/subsys/video/tcpserversink/boards/aipi_cam_d200.conf
```kconfig
CONFIG_VIDEO_BUFFER_POOL_HEAP_SIZE=3841024
CONFIG_VIDEO_CAPTURE_N_BUFFERING=1
CONFIG_VIDEO_BUFFER_POOL_ZEPHYR_REGION=y
CONFIG_VIDEO_BUFFER_POOL_ZEPHYR_REGION_NAME="PSRAM"
CONFIG_VIDEO_FRAME_WIDTH=1600
CONFIG_VIDEO_FRAME_HEIGHT=1200
CONFIG_VIDEO_PIXEL_FORMAT="RGBP"
CONFIG_VIDEO_SHELL=y

CONFIG_FLASH=n

CONFIG_SHELL=y
CONFIG_SHELL_STACK_SIZE=10240

CONFIG_LOG_BUFFER_SIZE=10240

CONFIG_WIFI=y
CONFIG_NET_L2_WIFI_SHELL=y
# Needed as wifi functions eats-up a lot of stack
CONFIG_WIFI_CREDENTIALS=y
CONFIG_WIFI_CREDENTIALS_STATIC=y
CONFIG_WIFI_CREDENTIALS_SHELL=y
CONFIG_WIFI_CREDENTIALS_STATIC_TYPE_SAE=y
CONFIG_WIFI_CREDENTIALS_STATIC_SSID="box"
CONFIG_WIFI_BFLB_WIFI6_TASK_STACK_SIZE=10240

CONFIG_NET_PKT_TX_COUNT=16
CONFIG_NET_BUF_TX_COUNT=32
```

## samples/subsys/zbus/proxy_agent_ipc/boards/nrf5340dk_nrf5340_cpuapp.conf
```kconfig
#
# Copyright (c) 2026 Nordic Semiconductor ASA
#
# SPDX-License-Identifier: Apache-2.0
#

CONFIG_SOC_NRF53_CPUNET_ENABLE=y
```

## samples/sysbuild/with_mcuboot/boards/frdm_rw612.conf
```kconfig
# Copyright 2026 NXP
# SPDX-License-Identifier: Apache-2.0

CONFIG_NETWORKING=y
CONFIG_NET_L2_ETHERNET=y
CONFIG_ETH_DRIVER=y
```

## samples/tfm_integration/tfm_fwu/Kconfig.sysbuild
```kconfig
# SPDX-FileCopyrightText: Copyright The Zephyr Project Contributors
# SPDX-License-Identifier: Apache-2.0

source "share/sysbuild/Kconfig"

config SAMPLE_TFM_FWU_COMPONENT_ID
	int "PSA FWU component ID to update"
	default 1
	help
	  The PSA Firmware Update component ID that the application
	  operates on.

config SAMPLE_TFM_MCUBOOT_SIGNATURE_TYPE
	string "The signature type used to sign the secure and non-secure firmware images."
	default "EC-P256"
	help
	  The signature type used for TF-M MCUboot.

config SAMPLE_TFM_MCUBOOT_ENCRYPTION
	bool "Image encryption in BL2"
	help
	  Build the swapped application as an encrypted image.

if SAMPLE_TFM_MCUBOOT_ENCRYPTION

choice SAMPLE_TFM_MCUBOOT_ENCRYPTION_KEY_WRAP_SCHEME
	prompt "Image encryption key-wrapping scheme"
	default SAMPLE_TFM_MCUBOOT_ENCRYPTION_RSA_OAEP
	help
	  Selects the algorithm that wraps the per-image AES key.

config SAMPLE_TFM_MCUBOOT_ENCRYPTION_RSA_OAEP
	bool "RSA-OAEP"

endchoice

config SAMPLE_TFM_MCUBOOT_ENCRYPTION_KEY_LEN
	int "Image encryption AES key length"
	default 128
	help
	  Length in bits of the AES key used to encrypt the image payload.
	  Valid values are 128 and 256.

endif # SAMPLE_TFM_MCUBOOT_ENCRYPTION
```

## samples/tfm_integration/tfm_fwu/swapped_app/Kconfig
```kconfig
# SPDX-FileCopyrightText: Copyright The Zephyr Project Contributors
# SPDX-License-Identifier: Apache-2.0

config SAMPLE_TFM_FWU_COMPONENT_ID
	int "PSA FWU component ID to update"

source "Kconfig.zephyr"
```

## snippets/nxp/nxp-ot/boards/mcxw72.conf
```kconfig
# Copyright 2026 NXP
# SPDX-License-Identifier: Apache-2.0

CONFIG_HEAP_MEM_POOL_SIZE=4096
CONFIG_IEEE802154_CSL_ENDPOINT=y
CONFIG_OPENTHREAD_CSL_RECEIVER=y
CONFIG_SECURE_STORAGE_ITS_TRANSFORM_AEAD_KEY_PROVIDER_ENTRY_UID_HASH=y
CONFIG_SHELL_STACK_SIZE=4096
```

## snippets/nxp/nxp-ot/boards/rw612.conf
```kconfig
# Copyright 2026 NXP
# SPDX-License-Identifier: Apache-2.0

CONFIG_HDLC_RCP_IF=y
CONFIG_MBEDTLS_PSA_CRYPTO_LEGACY_RNG=y
CONFIG_NXP_FW_LOADER=y
CONFIG_NXP_RF_IMU=y
CONFIG_SHELL_STACK_SIZE=5120
```
