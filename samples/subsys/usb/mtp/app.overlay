/*
 * Copyright (c) 2025 Mohamed ElShahawi (extremegtx@hotmail.com)
 *
 * SPDX-License-Identifier: Apache-2.0
 */

/ {
	ramdisk0 {
		compatible = "zephyr,ram-disk";
		disk-name = "RAM";
		sector-size = <512>;
		sector-count = <128>;
	};

	fstab {
		compatible = "zephyr,fstab";

		ffs1: ffs1 {
			compatible = "zephyr,fstab,fatfs";
			automount;
			disk-access;
			mount-point = "/RAM:";
		};
	};
};
