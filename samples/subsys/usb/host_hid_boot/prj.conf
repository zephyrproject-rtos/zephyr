## CMakeLists.txt
```
# Copyright (c) 2026 Antmicro <www.antmicro.com>
# SPDX-License-Identifier: Apache-2.0

cmake_minimum_required(VERSION 3.20.0)
find_package(Zephyr REQUIRED HINTS $ENV{ZEPHYR_BASE})
project(host-hid-boot)

file(GLOB app_sources src/*.c)
target_sources(app PRIVATE ${app_sources})
```

## Kconfig
```
# Copyright (c) 2026 Antmicro <www.antmicro.com>
config SAMPLE_COLORED_OUTPUT
	bool "Highlight input event values in shell output"
	depends on SHELL_VT100_COLORS
	default y
	help
	  Highlight input event values in green in the shell output.

source "Kconfig.zephyr"
```

## prj.conf
```kconfig
# Copyright (c) 2026 Antmicro <www.antmicro.com>

CONFIG_SAMPLE_COLORED_OUTPUT=y

CONFIG_SHELL=y
CONFIG_SHELL_BACKEND_SERIAL=y
CONFIG_SHELL_PROMPT_UART=""
CONFIG_SHELL_ECHO_STATUS=n
CONFIG_SHELL_VT100_COLORS=y

CONFIG_USB_HOST_STACK=y
CONFIG_USBH_STACK_SIZE=2048

CONFIG_INPUT=y
CONFIG_INPUT_MODE_THREAD=y

CONFIG_ASSERT=y
CONFIG_ASSERT_LEVEL=2

CONFIG_USBH_HID_BOOT_CLASS=y
CONFIG_USBH_HID_BOOT_INSTANCES_COUNT=1
```

## src/main.c
```c
/*
 * Copyright (c) 2026 Antmicro <www.antmicro.com>
 *
 * SPDX-License-Identifier: Apache-2.0
 */

#include <zephyr/kernel.h>
#include <zephyr/logging/log.h>
#include <zephyr/input/input.h>
#include <zephyr/shell/shell_uart.h>
#include <zephyr/sys/printk.h>
#include <zephyr/usb/usbh.h>

#include "keys.h"

#define INT32_DECIMAL_STRING_SIZE 12

LOG_MODULE_REGISTER(main, LOG_LEVEL_DBG);

USBH_CONTROLLER_DEFINE(uhs_ctx, DEVICE_DT_GET(DT_NODELABEL(zephyr_uhc0)));

static const struct device *usbh_hid_dev;
static const struct shell *sh;

#ifdef CONFIG_SAMPLE_COLORED_OUTPUT
static const enum shell_vt100_color highlight_color = SHELL_VT100_COLOR_GREEN;
#else
static const enum shell_vt100_color highlight_color = SHELL_VT100_COLOR_DEFAULT;
#endif

static void print_highlighted(const char *s1, const char *s2_highlight, const char *s3,
			      const char *s4_highlight)
{
	shell_fprintf(sh, SHELL_NORMAL, "%s", s1);
	shell_fprintf(sh, highlight_color, "%s", s2_highlight);
	shell_fprintf(sh, SHELL_NORMAL, "%s", s3);
	shell_fprintf(sh, highlight_color, "%s\n", s4_highlight);
}

static const char *input_to_name(uint16_t key_code)
{
	if (key_code >= ARRAY_SIZE(input_to_name_map)) {
		return 0;
	}
	return input_to_name_map[key_code];
}

static void mouse_evt_handler(struct input_event *evt)
{
	const char *btn_name, *axis;
	char delta[INT32_DECIMAL_STRING_SIZE];

	switch (evt->code) {
	case INPUT_BTN_LEFT:
	case INPUT_BTN_MIDDLE:
	case INPUT_BTN_RIGHT:
		btn_name = input_to_name(evt->code);

		print_highlighted("", btn_name, " button ", evt->value ? "pressed" : "let go");
		break;
	case INPUT_REL_X:
	case INPUT_REL_Y: {
		axis = evt->code == INPUT_REL_X ? "X" : "Y";
		snprintk(delta, sizeof(delta), "%d", evt->value);

		print_highlighted("Mouse moved in ", axis, " axis by ", delta);
		break;
	}
	}
}

static void kbd_evt_handler(struct input_event *evt)
{
	const char *name = input_to_name(evt->code);

	if (name) {
		print_highlighted("Key ", name, " was ", evt->value ? "pressed" : "released");
	}
}

static void input_cb(struct input_event *evt, void *user_data)
{
	ARG_UNUSED(user_data);

	/* Check if the event is from the desired device */
	if (evt->dev != usbh_hid_dev) {
		return;
	}

	if (evt->type == INPUT_EV_REL || evt->code == INPUT_BTN_LEFT ||
	    evt->code == INPUT_BTN_MIDDLE || evt->code == INPUT_BTN_RIGHT) {
		mouse_evt_handler(evt);
	} else {
		kbd_evt_handler(evt);
	}
}
INPUT_CALLBACK_DEFINE(NULL, input_cb, NULL);

static void shell_bypass_cb(const struct shell *sh, uint8_t *data, size_t len, void *user_data)
{
	ARG_UNUSED(sh);
	ARG_UNUSED(data);
	ARG_UNUSED(len);
	ARG_UNUSED(user_data);
}

int main(void)
{
	int err;

	sh = shell_backend_uart_get_ptr();
	shell_set_bypass(sh, shell_bypass_cb, NULL);

	/*
	 * HID Boot devices are named:
	 * usbh_hid_boot_0,
	 * usbh_hid_boot_1,
	 * ...,
	 * usbh_hid_boot_(CONFIG_USBH_HID_BOOT_INSTANCES_COUNT-1)
	 */
	usbh_hid_dev = device_get_binding("usbh_hid_boot_0");

	err = usbh_init(&uhs_ctx);
	if (err == -EALREADY) {
		LOG_ERR("host: USB host already initialized");
	} else if (err) {
		LOG_ERR("host: Failed to initialize %d", err);
	} else {
		LOG_INF("host: USB host initialized");
	}

	return 0;
}
```

## src/keys.h
```c
/*
 * Copyright (c) 2026 Antmicro <www.antmicro.com>
 *
 * SPDX-License-Identifier: Apache-2.0
 */

#include <zephyr/input/input.h>

const char *const input_to_name_map[] = {
	[INPUT_BTN_LEFT] = "Left",
	[INPUT_BTN_MIDDLE] = "Middle",
	[INPUT_BTN_RIGHT] = "Right",

	[INPUT_KEY_A] = "A",
	[INPUT_KEY_B] = "B",
	[INPUT_KEY_C] = "C",
	[INPUT_KEY_D] = "D",
	[INPUT_KEY_E] = "E",
	[INPUT_KEY_F] = "F",
	[INPUT_KEY_G] = "G",
	[INPUT_KEY_H] = "H",
	[INPUT_KEY_I] = "I",
	[INPUT_KEY_J] = "J",
	[INPUT_KEY_K] = "K",
	[INPUT_KEY_L] = "L",
	[INPUT_KEY_M] = "M",
	[INPUT_KEY_N] = "N",
	[INPUT_KEY_O] = "O",
	[INPUT_KEY_P] = "P",
	[INPUT_KEY_Q] = "Q",
	[INPUT_KEY_R] = "R",
	[INPUT_KEY_S] = "S",
	[INPUT_KEY_T] = "T",
	[INPUT_KEY_U] = "U",
	[INPUT_KEY_V] = "V",
	[INPUT_KEY_W] = "W",
	[INPUT_KEY_X] = "X",
	[INPUT_KEY_Y] = "Y",
	[INPUT_KEY_Z] = "Z",

	[INPUT_KEY_1] = "1",
	[INPUT_KEY_2] = "2",
	[INPUT_KEY_3] = "3",
	[INPUT_KEY_4] = "4",
	[INPUT_KEY_5] = "5",
	[INPUT_KEY_6] = "6",
	[INPUT_KEY_7] = "7",
	[INPUT_KEY_8] = "8",
	[INPUT_KEY_9] = "9",
	[INPUT_KEY_0] = "0",

	[INPUT_KEY_ENTER] = "ENTER",
	[INPUT_KEY_ESC] = "ESC",
	[INPUT_KEY_BACKSPACE] = "BACKSPACE",
	[INPUT_KEY_TAB] = "TAB",

	[INPUT_KEY_SPACE] = "SPACE",
	[INPUT_KEY_MINUS] = "MINUS",
	[INPUT_KEY_EQUAL] = "EQUAL",
	[INPUT_KEY_LEFTBRACE] = "LEFTBRACE",
	[INPUT_KEY_RIGHTBRACE] = "RIGHTBRACE",
	[INPUT_KEY_BACKSLASH] = "BACKSLASH",
	[INPUT_KEY_SEMICOLON] = "SEMICOLON",
	[INPUT_KEY_APOSTROPHE] = "APOSTROPHE",
	[INPUT_KEY_GRAVE] = "GRAVE",
	[INPUT_KEY_COMMA] = "COMMA",
	[INPUT_KEY_DOT] = "DOT",
	[INPUT_KEY_SLASH] = "SLASH",
	[INPUT_KEY_CAPSLOCK] = "CAPSLOCK",

	[INPUT_KEY_F1] = "F1",
	[INPUT_KEY_F2] = "F2",
	[INPUT_KEY_F3] = "F3",
	[INPUT_KEY_F4] = "F4",
	[INPUT_KEY_F5] = "F5",
	[INPUT_KEY_F6] = "F6",
	[INPUT_KEY_F7] = "F7",
	[INPUT_KEY_F8] = "F8",
	[INPUT_KEY_F9] = "F9",
	[INPUT_KEY_F10] = "F10",
	[INPUT_KEY_F11] = "F11",
	[INPUT_KEY_F12] = "F12",

	[INPUT_KEY_SYSRQ] = "SYSRQ",
	[INPUT_KEY_SCROLLLOCK] = "SCROLLLOCK",
	[INPUT_KEY_PAUSE] = "PAUSE",
	[INPUT_KEY_INSERT] = "INSERT",
	[INPUT_KEY_HOME] = "HOME",
	[INPUT_KEY_PAGEUP] = "PAGEUP",
	[INPUT_KEY_DELETE] = "DELETE",
	[INPUT_KEY_END] = "END",
	[INPUT_KEY_PAGEDOWN] = "PAGEDOWN",

	[INPUT_KEY_RIGHT] = "RIGHT",
	[INPUT_KEY_LEFT] = "LEFT",
	[INPUT_KEY_DOWN] = "DOWN",
	[INPUT_KEY_UP] = "UP",

	[INPUT_KEY_NUMLOCK] = "NUMLOCK",
	[INPUT_KEY_KPSLASH] = "KEYPAD_SLASH",
	[INPUT_KEY_KPASTERISK] = "KEYPAD_ASTERISK",
	[INPUT_KEY_KPMINUS] = "KEYPAD_MINUS",
	[INPUT_KEY_KPPLUS] = "KEYPAD_PLUS",
	[INPUT_KEY_KPENTER] = "KEYPAD_ENTER",
	[INPUT_KEY_KP1] = "KEYPAD_1",
	[INPUT_KEY_KP2] = "KEYPAD_2",
	[INPUT_KEY_KP3] = "KEYPAD_3",
	[INPUT_KEY_KP4] = "KEYPAD_4",
	[INPUT_KEY_KP5] = "KEYPAD_5",
	[INPUT_KEY_KP6] = "KEYPAD_6",
	[INPUT_KEY_KP7] = "KEYPAD_7",
	[INPUT_KEY_KP8] = "KEYPAD_8",
	[INPUT_KEY_KP9] = "KEYPAD_9",
	[INPUT_KEY_KP0] = "KEYPAD_0",
	[INPUT_KEY_KPDOT] = "KEYPAD_DOT",
	[INPUT_KEY_MENU] = "Application/Menu Key",

	[INPUT_KEY_LEFTCTRL] = "Left Ctrl",
	[INPUT_KEY_LEFTSHIFT] = "Left Shift",
	[INPUT_KEY_LEFTALT] = "Left Alt",
	[INPUT_KEY_LEFTMETA] = "Left Meta",
	[INPUT_KEY_RIGHTCTRL] = "Right Ctrl",
	[INPUT_KEY_RIGHTSHIFT] = "Right Shift",
	[INPUT_KEY_RIGHTALT] = "Right Alt",
	[INPUT_KEY_RIGHTMETA] = "Right Meta",
};
```
