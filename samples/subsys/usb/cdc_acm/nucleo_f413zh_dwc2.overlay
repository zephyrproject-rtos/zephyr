/*
 * Copyright (c) 2023 Nordic Semiconductor ASA
 *
 * SPDX-License-Identifier: Apache-2.0
 */

/delete-node/ &zephyr_udc0;

/ {
	soc {
		dwc2_fsotg0: usb@50000000 {
			compatible = "st,stm32f4-fsotg", "snps,dwc2";
			reg = <0x50000000 0x40000>;
			interrupts = <67 0>;
			interrupt-names = "fsotg";
			clocks = <&rcc STM32_CLOCK_BUS_AHB2 0x00000080>,
				 <&rcc STM32_SRC_PLL_Q NO_SEL>;
			status = "disabled";
		};
	};
};

zephyr_udc0: &dwc2_fsotg0 {
	pinctrl-0 = <&usb_otg_fs_dm_pa11 &usb_otg_fs_dp_pa12>;
	pinctrl-names = "default";
	status = "okay";
	cdc_acm_uart0 {
		compatible = "zephyr,cdc-acm-uart";
	};
};
