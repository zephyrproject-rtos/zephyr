/*
 * Copyright (c) 2023 Nordic Semiconductor ASA
 *
 * SPDX-License-Identifier: Apache-2.0
 */

/ {
	hid_dev_0: hid_dev_0 {
		compatible = "zephyr,hid-device";
		label = "HID0";
		protocol-code = "keyboard";
		in-report-size = <64>;
		in-polling-period-us = <1000>;
	};
};
