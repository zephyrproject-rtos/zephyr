/*
 * Copyright (c) 2023 Nordic Semiconductor ASA
 *
 * SPDX-License-Identifier: Apache-2.0
 */

#include "app.overlay"

/ {
	hid_dev_0: hid_dev_0 {
		compatible = "zephyr,hid-device";
		out-report-size = <64>;
		out-polling-period-us = <16000>;
	};
};
