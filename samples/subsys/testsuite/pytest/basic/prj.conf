## prj.conf
```kconfig
CONFIG_ZTEST=y
CONFIG_ZTEST_NEW_API=y
CONFIG_IDLE_STACK_SIZE=4096
```

## src/main.c
```c
/*
 * Copyright (c) 2020 Intel Corporation
 *
 * SPDX-License-Identifier: Apache-2.0
 */
#include <zephyr/ztest.h>

ZTEST_SUITE(test_pytest, NULL, NULL, NULL, NULL, NULL);

ZTEST(test_pytest, test_pytest)
{
	TC_PRINT("Hello world\n");
}
```
