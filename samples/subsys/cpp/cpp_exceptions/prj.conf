## CMakeLists.txt
```
# SPDX-License-Identifier: Apache-2.0

cmake_minimum_required(VERSION 3.20.0)
find_package(Zephyr REQUIRED HINTS $ENV{ZEPHYR_BASE})
project(cpp_exceptions)

target_sources(app PRIVATE src/main.cpp)
```

## sample.yaml
```
sample:
  name: Exceptions (C++)
tests:
  sample.cpp.synchronization:
    tags: cpp
    toolchain_exclude: issm xcc
    arch_exclude: posix
    integration_platforms:
      - qemu_x86
    harness: console
    harness_config:
      type: one_line
      regex:
        - "Exception caught: foobar"
```

## prj.conf
```kconfig
CONFIG_CPLUSPLUS=y
CONFIG_LIB_CPLUSPLUS=y
CONFIG_STD_CPP17=y
CONFIG_NEWLIB_LIBC=y
CONFIG_NEWLIB_LIBC_NANO=n
```

## src/main.cpp
```c
/*
 * Copyright (c) 2022 Huawei
 *
 * SPDX-License-Identifier: Apache-2.0
 */

/**
 * @file C++ exceptions demo.
 */

#include <iostream>
#include <stdexcept>
#include <string>

namespace {

class my_exception : public std::runtime_error
{
public:

	explicit my_exception(const std::string& what)
		: std::runtime_error(what)
	{
	}
};

} /* namespace */

int main(void)
{
	try {
		throw my_exception("foobar");
	} catch (const std::runtime_error& err) {
		std::cout << "Exception caught: " << err.what() << std::endl;
	}

	return 0;
}
```
