## CMakeLists.txt
```
# SPDX-License-Identifier: Apache-2.0

cmake_minimum_required(VERSION 3.20.0)

macro(app_set_runner_args)
  board_runner_args(dfu-util "--dfuse-modifiers=force:mass-erase")
  board_runner_args(pyocd "--erase")
  board_runner_args(nrfjprog "--erase")
  board_runner_args(stm32cubeprogrammer "--erase")
endmacro()

find_package(Zephyr REQUIRED HINTS $ENV{ZEPHYR_BASE})
project(fcb)


target_sources(app PRIVATE src/main.c)
```

## Kconfig
```
# Copyright 2025 Tomas Jurena
# SPDX-License-Identifier: Apache-2.0

mainmenu "FCB Sample Configuration"
menu "Sample configuration"
config FCB_SECTOR_CNT
	int "Number of FCB sectors"
	default 2
	help
		"Minimum value is 2 but any number larger than this can be used.
		The number have impact on memory footprint as this is then used for a pool
		where details about sectors are stored."
endmenu
menu "Zephyr"
source "Kconfig.zephyr"
endmenu
```

## sample.yaml
```
sample:
  name: FCB Sample

common:
  tags: fcb
  filter: dt_label_with_parent_compat_enabled("storage_partition", "fixed-partitions")
  harness: console
  harness_config:
    type: multi_line
    regex:
      - "Booted 0 times"
      - "Saving boot_cnt 1 to FCB"
      - "New boot_cnt value written to flash"
      - "Rebooting in 1 second"

tests:
  sample.fcb.basic:
    platform_allow:
      - stm32f4_disco/stm32f407xx
    integration_platforms:
      - stm32f4_disco/stm32f407xx
```

## prj.conf
```kconfig
CONFIG_FLASH=y

CONFIG_FLASH_MAP=y
CONFIG_FCB=y
CONFIG_REBOOT=y
```

## boards/stm32c0116_dk.overlay
```dts
/*
 * Copyright (c) 2025 Tomas Jurena
 *
 * SPDX-License-Identifier: Apache-2.0
 */

&flash0 {
	partitions {
		compatible = "fixed-partitions";
		#address-cells = <1>;
		#size-cells = <1>;

		fcb: partition@7000 {
			label = "FCB";
			reg = <0x00007000 DT_SIZE_K(4)>;
		};
	};
};
```

## boards/stm32f4_disco.overlay
```dts
/*
 * Copyright (c) 2025 Tomas Jurena
 *
 * SPDX-License-Identifier: Apache-2.0
 */

&flash0 {
	partitions {
		compatible = "fixed-partitions";
		#address-cells = <1>;
		#size-cells = <1>;

		storage_partition: partition@20000 {
			label = "FCB";
			reg = <0x00020000 DT_SIZE_K(256)>;
		};
	};
};
```

## src/main.c
```c
/*
 * FCB sample demonstrates how to use the FCB subsystem to store an integer value in FLASH
 * memory. The sample first retrieve information about sectors which will be used, then
 * initialize the FCB instance, tries to load the last value from memory, increments the
 * loaded/default value, and stores it in the FLASH, and restarts after 1 second.
 *
 * Copyright (c) 2025 Tomas Jurena
 *
 * SPDX-License-Identifier: Apache-2.0
 */

#include <zephyr/kernel.h>
#include <zephyr/sys/reboot.h>
#include <zephyr/device.h>
#include <string.h>
#include <zephyr/drivers/flash.h>
#include <zephyr/storage/flash_map.h>
#include <zephyr/fs/fcb.h>

#define FCB_FLASH_AREA    storage_partition
#define FCB_FLASH_AREA_ID FIXED_PARTITION_ID(FCB_FLASH_AREA)

BUILD_ASSERT(FIXED_PARTITION_EXISTS(FCB_FLASH_AREA),
	     "Board does not have fixed partition 'storage_partition'\n");

static int inc_boot_cnt(struct fcb *fcbp, uint32_t boot_cnt)
{
	uint8_t data[MAX(fcbp->f_align, sizeof(boot_cnt))];
	struct fcb_entry loc;
	int rc;

	printk("Saving boot_cnt %u to FCB\n", boot_cnt);
	memset(data, fcbp->f_erase_value, sizeof(data));
	memcpy(data, &boot_cnt, sizeof(boot_cnt));

	rc = fcb_append(fcbp, sizeof(data), &loc);
	if (rc) {
		fcb_rotate(fcbp);
		rc = fcb_append(fcbp, sizeof(data), &loc);
		if (rc) {
			printk("Cannot set new default state\n");
			return rc;
		}
	}

	rc = flash_area_write(fcbp->fap, FCB_ENTRY_FA_DATA_OFF(loc), data, sizeof(data));
	if (rc) {
		printk("Flash write error\n");
		return rc;
	}

	rc = fcb_append_finish(fcbp, &loc);
	if (rc) {
		printk("Append finnish failed\n");
		return rc;
	}

	printk("New boot_cnt value written to flash\n");
	return rc;
}

int main(void)
{
	const struct device *flash_device = FIXED_PARTITION_DEVICE(FCB_FLASH_AREA);
	uint32_t n_sectors = CONFIG_FCB_SECTOR_CNT, boot_cnt = 0;
	struct flash_sector sectors[CONFIG_FCB_SECTOR_CNT] = {0};
	struct fcb_entry entry = {0};
	struct fcb fcb_inst = {0};
	int rc = 0;

	if (!device_is_ready(flash_device)) {
		printk("Flash device %s is not ready\n", flash_device->name);
		return 0;
	}

	rc = flash_area_get_sectors(FCB_FLASH_AREA_ID, &n_sectors, sectors);
	if (rc) {
		printk("Failed to retrieved the number of sectors (%d)\n", rc);
		return rc;
	}

	fcb_inst.f_sectors = sectors;
	fcb_inst.f_sector_cnt = n_sectors;

	rc = fcb_init(FCB_FLASH_AREA_ID, &fcb_inst);
	if (rc != 0) {
		printk("FCB initialization failure! rc: %d\n", rc);
		return rc;
	}

	rc = fcb_offset_last_n(&fcb_inst, 1, &entry);
	if (rc == 0) {
		rc = flash_area_read(fcb_inst.fap, FCB_ENTRY_FA_DATA_OFF(entry), &boot_cnt,
				     sizeof(boot_cnt));
		if (rc) {
			printk("Unable to read last state\n");
			return rc;
		}
	}

	printk("Booted %u times\n", boot_cnt);

	boot_cnt++;
	inc_boot_cnt(&fcb_inst, boot_cnt);

	printk("Rebooting in 1 second\n");
	k_sleep(K_SECONDS(1));
	sys_reboot(0);
}
```
