/*
 * SPDX-FileCopyrightText: Copyright (c) 2026 Linumiz
 * SPDX-License-Identifier: Apache-2.0
 */

/ {
	aliases {
		rc0 = &rc_loopback0;
	};

	rc_loopback0: rc-loopback {
		compatible = "zephyr,rc-loopback";
		tx-echo;
	};
};
