## CMakeLists.txt
```
# SPDX-License-Identifier: Apache-2.0

cmake_minimum_required(VERSION 3.28.0)
find_package(Zephyr REQUIRED HINTS $ENV{ZEPHYR_BASE})
project(cmsis_rtos_v1_synchronization)

target_include_directories(app PRIVATE ${ZEPHYR_BASE}/include/zephyr/portability)
target_sources(app PRIVATE src/main.c)
```

## sample.yaml
```
sample:
  name: CMSIS_RTOS_V1 Synchronization
tests:
  sample.portability.cmsis_rtos_v1.timer_synchronization:
    platform_key:
      - arch
      - simulation
    integration_platforms:
      - native_sim
    tags: cmsis_rtos
    min_ram: 32
    min_flash: 34
    harness: console
    harness_config:
      type: multi_line
      ordered: true
      regex:
        - "Wrote to message queue: (.*)"
        - "Read from message queue: (.*)"
        - "Sample execution successful"
```

## prj.conf
```kconfig
CONFIG_ASSERT=y
CONFIG_CMSIS_RTOS_V1=y
CONFIG_NUM_PREEMPT_PRIORITIES=56
CONFIG_HEAP_MEM_POOL_SIZE=256
CONFIG_THREAD_NAME=y
CONFIG_THREAD_STACK_INFO=y
CONFIG_THREAD_MONITOR=y
CONFIG_INIT_STACKS=y
CONFIG_POLL=y
CONFIG_SCHED_SCALABLE=y
CONFIG_THREAD_CUSTOM_DATA=y
```

## src/main.c
```c
/*
 * Copyright (c) 2018 Intel Corporation
 *
 * SPDX-License-Identifier: Apache-2.0
 */

/**
 * @file Synchronization demo using CMSIS RTOS V1 APIs.
 */

#include <zephyr/kernel.h>
#include <cmsis_os.h>

/* specify delay between greetings (in ms); compute equivalent in ticks */
#define TIMER_TICKS  50
#define STACKSIZE  512
#define MSGLEN 12
#define Q_LEN 1
#define INITIAL_DATA_VALUE 5

uint32_t data;

void read_msg_callback(void const *arg);

osTimerDef(myTimer, read_msg_callback);

osMessageQDef(messageq, Q_LEN, uint32_t);
osMessageQId message_id;

void read_msg_callback(void const *arg)
{
	osEvent evt;
	uint32_t read_msg = 0U;

	evt = osMessageGet(message_id, 0);
	read_msg = evt.value.v;
	if (read_msg == 0U) {
		printk("\n**Error reading message from message queue**\n");
	} else {
		printk("Read from message queue: %d\n\n", read_msg);
	}
}

int send_msg_thread(void)
{
	osStatus status;

	status = osMessagePut(message_id, data, osWaitForever);
	if (status != osOK) {
		printk("\n**Error sending message to message queue**\n");
		return 1;
	}
	printk("Wrote to message queue: %d\n", data);
	return 0;
}

int main(void)
{
	osTimerId timer_id;
	uint32_t counter = 10U;

	data = INITIAL_DATA_VALUE;
	timer_id = osTimerCreate(osTimer(myTimer), osTimerPeriodic, NULL);

	message_id = osMessageCreate(osMessageQ(messageq), NULL);

	/* Send first message */
	if (send_msg_thread()) {
		/* Writing to message queue failed */
		goto exit;
	}
	osTimerStart(timer_id, TIMER_TICKS);

	while (--counter) {
		data++;
		if (send_msg_thread()) {
			/* Writing to message queue failed */
			break;
		}
	}
	osDelay(TIMER_TICKS);

	osTimerStop(timer_id);

exit:
	osTimerDelete(timer_id);

	if (counter == 0U) {
		printk("Sample execution successful\n");
	} else {
		printk("Error in execution\n");
	}
	return 0;
}
```
