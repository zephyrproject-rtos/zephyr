## samples/subsys/zbus/benchmark/Kconfig
```kconfig
# Copyright (c) 2022 Rodrigo Peixoto <rodrigopex@gmail.com>
# SPDX-License-Identifier: Apache-2.0

config BM_MESSAGE_SIZE
	int "Message size"
	default 256

config BM_ONE_TO
	int "Number of consumers"
	default 8

choice BM_OBSERVER_TYPE
	bool "Observer type to be used in the benchmark"

config BM_LISTENERS
	bool "Synchronous using listeners"

config BM_SUBSCRIBERS
	bool "Asynchronous using subscribers"

config BM_MSG_SUBSCRIBERS
	bool "Asynchronous using message subscribers"
	select ZBUS_MSG_SUBSCRIBER

endchoice

config BM_FAIRPLAY
	bool "Force a comparison with same actions"
	help
	  Forces a message copy on the listeners and subscribers to behave equivalent to
	  message subscribers.

source "Kconfig.zephyr"
```

## samples/subsys/zbus/benchmark/sample.yaml
```yaml
sample:
  name: Zbus Benchmark
tests:
  sample.zbus.benchmark_async:
    tags: zbus
    min_ram: 16
    filter: CONFIG_SYS_CLOCK_EXISTS and not (CONFIG_ARCH_POSIX and not CONFIG_BOARD_NATIVE_SIM)
    harness: console
    harness_config:
      type: multi_line
      ordered: true
      regex:
        - "I: Benchmark 1 to 8 using LISTENERS to transmit with message size: 256 bytes"
        - "I: Bytes sent = 262144, received = 262144"
        - "I: Average data rate: (\\d+).(\\d+)MB/s"
        - "I: Duration: (\\d+).(\\d+)s"
        - "@(.*)"
    extra_configs:
      - CONFIG_BM_ONE_TO=8
      - CONFIG_BM_MESSAGE_SIZE=256
      - CONFIG_BM_LISTENERS=y
      - arch:nios2:CONFIG_SYS_CLOCK_TICKS_PER_SEC=1000
      - CONFIG_IDLE_STACK_SIZE=1024
    integration_platforms:
      - qemu_x86
  sample.zbus.benchmark_async_msg_sub:
    tags: zbus
    min_ram: 16
    filter: CONFIG_SYS_CLOCK_EXISTS and not (CONFIG_ARCH_POSIX and not CONFIG_BOARD_NATIVE_SIM)
    harness: console
    harness_config:
      type: multi_line
      ordered: true
      regex:
        - "I: Benchmark 1 to 8 using MSG_SUBSCRIBERS to transmit with message size: 256 bytes"
        - "I: Bytes sent = 262144, received = 262144"
        - "I: Average data rate: (\\d+).(\\d+)MB/s"
        - "I: Duration: (\\d+).(\\d+)s"
        - "@(.*)"
    extra_configs:
      - CONFIG_BM_ONE_TO=8
      - CONFIG_BM_MESSAGE_SIZE=256
      - CONFIG_BM_MSG_SUBSCRIBERS=y
      - arch:nios2:CONFIG_SYS_CLOCK_TICKS_PER_SEC=1000
      - CONFIG_IDLE_STACK_SIZE=1024
    integration_platforms:
      - qemu_x86
  sample.zbus.benchmark_sync:
    tags: zbus
    min_ram: 16
    filter: CONFIG_SYS_CLOCK_EXISTS and not (CONFIG_ARCH_POSIX and not CONFIG_BOARD_NATIVE_SIM)
    harness: console
    harness_config:
      type: multi_line
      ordered: true
      regex:
        - "I: Benchmark 1 to 8 using SUBSCRIBERS to transmit with message size: 256 bytes"
        - "I: Bytes sent = 262144, received = 262144"
        - "I: Average data rate: (\\d+).(\\d+)MB/s"
        - "I: Duration: (\\d+).(\\d+)s"
        - "@(.*)"
    extra_configs:
      - CONFIG_BM_ONE_TO=8
      - CONFIG_BM_MESSAGE_SIZE=256
      - CONFIG_BM_SUBSCRIBERS=y
      - arch:nios2:CONFIG_SYS_CLOCK_TICKS_PER_SEC=1000
      - CONFIG_IDLE_STACK_SIZE=1024
    integration_platforms:
      - qemu_x86
```

## samples/subsys/zbus/confirmed_channel/sample.yaml
```yaml
sample:
  name: Confirmed message
tests:
  sample.zbus.confirmed_message:
    harness: console
    harness_config:
      type: multi_line
      ordered: false
      regex:
        - "I: From listener -> Confirmed message payload = 0"
        - "I: From bar_sub1 subscriber -> Confirmed message payload = 0"
        - "I: From bar_sub2 subscriber -> Confirmed message payload = 0"
        - "I: From bar_sub3 subscriber -> Confirmed message payload = 0"
        - "I: From listener -> Confirmed message payload = 1"
        - "I: From bar_sub1 subscriber -> Confirmed message payload = 1"
        - "I: From bar_sub2 subscriber -> Confirmed message payload = 1"
        - "I: From bar_sub3 subscriber -> Confirmed message payload = 1"
        - "I: From listener -> Confirmed message payload = 2"
        - "I: From bar_sub1 subscriber -> Confirmed message payload = 2"
        - "I: From bar_sub2 subscriber -> Confirmed message payload = 2"
        - "I: From bar_sub3 subscriber -> Confirmed message payload = 2"
    platform_exclude: qemu_leon3
    tags: zbus
```

## samples/subsys/zbus/dyn_channel/sample.yaml
```yaml
sample:
  name: Dynamic channel
common:
  tags: zbus
  harness: console
  harness_config:
    type: multi_line
    ordered: true
    regex:
      - "W: size=01"
      - "W: Content"
      - "W: 00                      |."
      - "W: size=02"
      - "W: Content"
      - "W: 01 01                   |.."
      - "W: size=03"
      - "W: Content"
      - "W: 00 00 00                |..."
      - "W: size=04"
      - "W: Content"
      - "W: 03 03 03 03             |...."
      - "W: size=05"
      - "W: Content"
      - "W: 00 00 00 00 00          |....."
      - "W: size=06"
      - "W: Content"
      - "W: 05 05 05 05 05 05       |......"
      - "W: size=07"
      - "W: Content"
      - "W: 00 00 00 00 00 00 00    |......."
      - "W: size=08"
      - "W: Content"
      - "W: 07 07 07 07 07 07 07 07 |........"
      - "W: size=09"
      - "W: Content"
      - "W: 00 00 00 00 00 00 00 00 |........"
      - "W: 00                      |."
      - "W: size=10"
      - "W: Content"
      - "W: 09 09 09 09 09 09 09 09 |........"
      - "W: 09 09                   |.."
      - "W: size=11"
      - "W: Content"
      - "W: 00 00 00 00 00 00 00 00 |........"
      - "W: 00 00 00                |..."
      - "W: size=12"
      - "W: Content"
      - "W: 0b 0b 0b 0b 0b 0b 0b 0b |........"
      - "W: 0b 0b 0b 0b             |...."
      - "W: size=13"
      - "W: Content"
      - "W: 00 00 00 00 00 00 00 00 |........"
      - "W: 00 00 00 00 00          |....."
      - "W: size=14"
      - "W: Content"
      - "W: 0d 0d 0d 0d 0d 0d 0d 0d |........"
      - "W: 0d 0d 0d 0d 0d 0d       |......"
      - "W: size=15"
      - "W: Content"
      - "W: 00 00 00 00 00 00 00 00 |........"
      - "W: 00 00 00 00 00 00 00    |......."
      - "W: size=16"
      - "W: Content"
      - "W: 0f 0f 0f 0f 0f 0f 0f 0f |........"
      - "W: 0f 0f 0f 0f 0f 0f 0f 0f |........"
tests:
  sample.zbus.dyn_channel:
    tags: zbus
    integration_platforms:
      - qemu_x86
      - mps2/an521/cpu0
```

## samples/subsys/zbus/hello_world/sample.yaml
```yaml
sample:
  name: Hello World
tests:
  sample.zbus.hello_world:
    harness: console
    harness_config:
      type: multi_line
      ordered: false
      regex:
        - "I: Sensor sample started raw reading, version 0.1-2!"
        - "I: Channel list:"
        - "I: 0 - Channel acc_data_chan:"
        - "I:       Message size: 12"
        - "I:       Observers:"
        - "I:       - foo_lis"
        - "I:       - bar_sub"
        - "I: 1 - Channel simple_chan:"
        - "I: 2 - Channel version_chan:"
        - "I:       Message size: 4"
        - "I: Observers list:"
        - "I: 0 - Subscriber bar_sub"
        - "I: 1 - Listener foo_lis"
        - "I: From subscriber -> Acc x=1, y=1, z=1"
        - "I: From listener -> Acc x=1, y=1, z=1"
        - "I: From subscriber -> Acc x=2, y=2, z=2"
        - "I: From listener -> Acc x=2, y=2, z=2"
        - "I: Pub a valid value to a channel with validator successfully."
        - "I: Pub an invalid value to a channel with validator successfully."
    platform_exclude: qemu_leon3
    tags: zbus
    integration_platforms:
      - qemu_x86
```

## samples/subsys/zbus/ipc_forwarder/Kconfig.sysbuild
```kconfig
#
# Copyright (c) 2025 Nordic Semiconductor ASA
#
# SPDX-License-Identifier: Apache-2.0
#

source "share/sysbuild/Kconfig"

choice
	prompt "Remote board target"
	default REMOTE_BOARD_NRF54H20_CPURAD if BOARD = "nrf54h20dk"
	default REMOTE_BOARD_NRF5340_CPUNET if BOARD = "nrf5340dk"
	default REMOTE_BOARD_NRF5340_CPUNET_SIM if BOARD = "nrf5340bsim"

config REMOTE_BOARD_NRF54H20_CPURAD
	bool "nrf54h20dk/nrf54h20/cpurad"

config REMOTE_BOARD_NRF54H20_CPUPPR
	bool "nrf54h20dk/nrf54h20/cpuppr"

config REMOTE_BOARD_NRF54H20_CPUPPR_XIP
	bool "nrf54h20dk/nrf54h20/cpuppr/xip"

## Do not fit on nRF54H20_CPUFLPR without XIP

config REMOTE_BOARD_NRF54H20_CPUFLPR_XIP
	bool "nrf54h20dk/nrf54h20/cpuflpr/xip"

config REMOTE_BOARD_NRF5340_CPUNET
	bool "nrf5340dk/nrf5340/cpunet"

config REMOTE_BOARD_NRF5340_CPUNET_SIM
	bool "nrf5340bsim/nrf5340/cpunet"
	help
	  Use this option to run the sample on nRF5340 CPU network simulator target.
	  This option is useful for development and testing without requiring physical hardware.

endchoice

config REMOTE_BOARD
	string "The board used for remote target"
	default "nrf54h20dk/nrf54h20/cpurad" if REMOTE_BOARD_NRF54H20_CPURAD
	default "nrf54h20dk/nrf54h20/cpuppr" if REMOTE_BOARD_NRF54H20_CPUPPR
	default "nrf54h20dk/nrf54h20/cpuppr/xip" if REMOTE_BOARD_NRF54H20_CPUPPR_XIP
	default "nrf54h20dk/nrf54h20/cpuflpr/xip" if REMOTE_BOARD_NRF54H20_CPUFLPR_XIP
	default "nrf5340dk/nrf5340/cpunet" if REMOTE_BOARD_NRF5340_CPUNET
	default "nrf5340bsim/nrf5340/cpunet" if REMOTE_BOARD_NRF5340_CPUNET_SIM
```

## samples/subsys/zbus/ipc_forwarder/sample.yaml
```yaml
sample:
  name: IPC Forwarder
  description: Sample application demonstrating Zbus IPC forwarder functionality.
tests:
  sample.zbus.ipc_forwarder.nrf54h20_cpuapp_cpurad:
    sysbuild: true
    platform_allow:
      - nrf54h20dk/nrf54h20/cpuapp
    extra_args:
      - SNIPPET=nordic-log-stm
      - SB_CONFIG_REMOTE_BOARD_NRF54H20_CPURAD=y
    timeout: 30
    harness: console
    harness_config:
      type: multi_line
      ordered: false
      regex:
        - ".* app/main: Channel request_channel is a master channel"
        - ".* app/main: Channel response_channel is a shadow channel"
        - ".* rad/main: Channel request_channel is a shadow channel"
        - ".* rad/main: Channel response_channel is a master channel"
        - ".* app/main: Published on channel request_channel. Request ID=1, Min=-1, Max=1"
        - ".* rad/main: Received message on channel request_channel"
        - ".* rad/main: Request ID: 1, Min: -1, Max: 1"
        - ".* rad/main: Sending response: ID=1, Value=.*"
        - ".* rad/main: Response published on channel response_channel"
        - ".* app/main: Received message on channel response_channel"
        - ".* app/main: Response ID: 1, Value: .*"

  sample.zbus.ipc_forwarder.nrf54h20_cpuapp_cpuppr:
    sysbuild: true
    platform_allow:
      - nrf54h20dk/nrf54h20/cpuapp
    extra_args:
      - SNIPPET=nordic-log-stm
      - SB_CONFIG_REMOTE_BOARD_NRF54H20_CPUPPR=y
    timeout: 30
    harness: console
    harness_config:
      type: multi_line
      ordered: false
      regex:
        - ".* app/main: Channel request_channel is a master channel"
        - ".* app/main: Channel response_channel is a shadow channel"
        - ".* ppr/main: Channel request_channel is a shadow channel"
        - ".* ppr/main: Channel response_channel is a master channel"
        - ".* app/main: Published on channel request_channel. Request ID=1, Min=-1, Max=1"
        - ".* ppr/main: Received message on channel request_channel"
        - ".* ppr/main: Request ID: 1, Min: -1, Max: 1"
        - ".* ppr/main: Sending response: ID=1, Value=.*"
        - ".* ppr/main: Response published on channel response_channel"
        - ".* app/main: Received message on channel response_channel"
        - ".* app/main: Response ID: 1, Value: .*"

  sample.zbus.ipc_forwarder.nrf54h20_cpuapp_cpuppr_xip:
    sysbuild: true
    platform_allow:
      - nrf54h20dk/nrf54h20/cpuapp
    extra_args:
      - SNIPPET=nordic-log-stm
      - SB_CONFIG_REMOTE_BOARD_NRF54H20_CPUPPR_XIP=y
    timeout: 30
    harness: console
    harness_config:
      type: multi_line
      ordered: false
      regex:
        - ".* app/main: Channel request_channel is a master channel"
        - ".* app/main: Channel response_channel is a shadow channel"
        - ".* ppr/main: Channel request_channel is a shadow channel"
        - ".* ppr/main: Channel response_channel is a master channel"
        - ".* app/main: Published on channel request_channel. Request ID=1, Min=-1, Max=1"
        - ".* ppr/main: Received message on channel request_channel"
        - ".* ppr/main: Request ID: 1, Min: -1, Max: 1"
        - ".* ppr/main: Sending response: ID=1, Value=.*"
        - ".* ppr/main: Response published on channel response_channel"
        - ".* app/main: Received message on channel response_channel"
        - ".* app/main: Response ID: 1, Value: .*"

  sample.zbus.ipc_forwarder.nrf54h20_cpuapp_cpuflpr_xip:
    sysbuild: true
    platform_allow:
      - nrf54h20dk/nrf54h20/cpuapp
    extra_args:
      - SNIPPET=nordic-log-stm
      - SB_CONFIG_REMOTE_BOARD_NRF54H20_CPUFLPR_XIP=y
    timeout: 30
    harness: console
    harness_config:
      type: multi_line
      ordered: false
      regex:
        - ".* app/main: Channel request_channel is a master channel"
        - ".* app/main: Channel response_channel is a shadow channel"
        - ".* flpr/main: Channel request_channel is a shadow channel"
        - ".* flpr/main: Channel response_channel is a master channel"
        - ".* app/main: Published on channel request_channel. Request ID=1, Min=-1, Max=1"
        - ".* flpr/main: Received message on channel request_channel"
        - ".* flpr/main: Request ID: 1, Min: -1, Max: 1"
        - ".* flpr/main: Sending response: ID=1, Value=.*"
        - ".* flpr/main: Response published on channel response_channel"
        - ".* app/main: Received message on channel response_channel"
        - ".* app/main: Response ID: 1, Value: .*"

  sample.zbus.ipc_forwarder.nrf5340_cpuapp_cpunet:
    sysbuild: true
    platform_allow:
      - nrf5340dk/nrf5340/cpuapp
      - nrf5340bsim/nrf5340/cpuapp
    integration_platforms:
      - nrf5340bsim/nrf5340/cpuapp
    tags: ipc
    timeout: 30
    harness: console
    harness_config:
      type: multi_line
      ordered: false
      regex:
        - ".* main: Channel request_channel is a master channel"
        - ".* main: Channel response_channel is a shadow channel"
        - ".* main: Published on channel request_channel. Request ID=1, Min=-1, Max=1"
        - ".* main: Received message on channel response_channel"
        - ".* main: Response ID: 1, Value: .*"
```

## samples/subsys/zbus/msg_subscriber/Kconfig
```kconfig
# Copyright (c) 2023 Rodrigo Peixoto <rodrigopex@gmail.com>
# SPDX-License-Identifier: Apache-2.0

config ZBUS_MSG_SUBSCRIBER_SAMPLE
	bool "Force selection of heap listener configurations"
	default y
	select SYS_HEAP_LISTENER
	select SYS_HEAP_RUNTIME_STATS

config ZBUS_MSG_SUBSCRIBER_SAMPLE_ISOLATED_BUF_POOL_SIZE
	int "Set size of the isolated pool"
	default 32
	depends on ZBUS_MSG_SUBSCRIBER_NET_BUF_POOL_ISOLATION

source "Kconfig.zephyr"
```
