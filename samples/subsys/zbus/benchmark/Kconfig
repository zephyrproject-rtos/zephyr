## samples/subsys/zbus/proxy_agent/ipc/Kconfig.sysbuild
```kconfig
#
# Copyright (c) 2025 Nordic Semiconductor ASA
#
# SPDX-License-Identifier: Apache-2.0
#

source "share/sysbuild/Kconfig"

choice
	prompt "Remote board target"
	default REMOTE_BOARD_NRF54H20_CPURAD if BOARD = "nrf54h20dk"
	default REMOTE_BOARD_NRF54LM20A_CPUFLPR if BOARD = "nrf54lm20dk"
	default REMOTE_BOARD_NRF54L15_CPUFLPR if BOARD = "nrf54l15dk"
	default REMOTE_BOARD_NRF5340_CPUNET if BOARD = "nrf5340dk"

config REMOTE_BOARD_NRF54H20_CPURAD
	bool "nrf54h20dk/nrf54h20/cpurad"

config REMOTE_BOARD_NRF54LM20A_CPUFLPR
	bool "nrf54lm20dk/nrf54lm20a/cpuflpr"

config REMOTE_BOARD_NRF54L15_CPUFLPR
	bool "nrf54l15dk/nrf54l15/cpuflpr"

config REMOTE_BOARD_NRF5340_CPUNET
	bool "nrf5340dk/nrf5340/cpunet"

endchoice

config REMOTE_BOARD
	string "The board used for remote target"
	default "nrf54h20dk/nrf54h20/cpurad" if REMOTE_BOARD_NRF54H20_CPURAD
	default "nrf54l15dk/nrf54l15/cpuflpr" if REMOTE_BOARD_NRF54L15_CPUFLPR
	default "nrf54lm20dk/nrf54lm20a/cpuflpr" if REMOTE_BOARD_NRF54LM20A_CPUFLPR
	default "nrf5340dk/nrf5340/cpunet" if REMOTE_BOARD_NRF5340_CPUNET
```

## samples/subsys/zbus/proxy_agent/ipc/sample.yaml
```yaml
sample:
  name: IPC Forwarder
  description: Sample application demonstrating Zbus IPC forwarder functionality.
tests:
  sample.zbus.proxy_agent_ipc.nrf54h20_cpuapp_cpurad:
    sysbuild: true
    platform_allow:
      - nrf54h20dk/nrf54h20/cpuapp
    extra_args:
      - ipc_CONFIG_SOC_NRF54H20_CPURAD_ENABLE=y

  sample.zbus.proxy_agent_ipc.nrf54lm20_cpuapp_cpuflpr:
    sysbuild: true
    platform_allow:
      - nrf54lm20dk/nrf54lm20a/cpuapp
    extra_args:
      - ipc_SNIPPET=nordic-flpr

  sample.zbus.proxy_agent_ipc.nrf54l15_cpuapp_cpuflpr:
    sysbuild: true
    platform_allow:
      - nrf54l15dk/nrf54l15/cpuapp
    extra_args:
      - ipc_SNIPPET=nordic-flpr

  sample.zbus.proxy_agent_ipc.nrf5340_cpuapp_cpunet:
    sysbuild: true
    platform_allow:
      - nrf5340dk/nrf5340/cpuapp
```

## samples/subsys/zbus/proxy_agent_ipc/remote/boards/nrf5340dk_nrf5340_cpunet.conf
```kconfig
#
# Copyright (c) 2026 Nordic Semiconductor ASA
#
# SPDX-License-Identifier: Apache-2.0
#

CONFIG_HEAP_MEM_POOL_SIZE=4096

CONFIG_OPENAMP=y
CONFIG_OPENAMP_MASTER=n
```

## samples/subsys/zbus/proxy_agent_uart/sample.yaml
```yaml
sample:
  name: UART Forwarder
  description: Sample application demonstrating zbus proxy forwarding over a dedicated UART link.
tests:
  sample.zbus.proxy_agent_uart.nrf54l15_cpuapp:
    build_only: true
    platform_allow:
      - nrf54l15dk/nrf54l15/cpuapp
```

## samples/subsys/zbus/remote_mock/boards/native_posix_native.conf
```kconfig
CONFIG_UART_NATIVE_POSIX_PORT_1_ENABLE=y
CONFIG_NATIVE_POSIX_SLOWDOWN_TO_REAL_TIME=y
```

## samples/subsys/zbus/remote_mock/boards/native_sim_native.conf
```kconfig
CONFIG_UART_NATIVE_POSIX_PORT_1_ENABLE=y
CONFIG_NATIVE_SIM_SLOWDOWN_TO_REAL_TIME=y
```

## samples/subsys/zbus/remote_mock/sample.yaml
```yaml
sample:
  name: Remote mock
tests:
  sample.zbus.remote_mock:
    build_only: true
    tags: zbus
    platform_allow:
      - native_sim
      - hifive1@B
    integration_platforms:
      - native_sim
```

## samples/subsys/zbus/runtime_obs_registration/sample.yaml
```yaml
sample:
  name: Runtime observer registration
tests:
  sample.zbus.runtime_os_registration:
    min_ram: 16
    integration_platforms:
      - qemu_x86
    arch_exclude: nios2
    harness: console
    harness_config:
      type: multi_line
      ordered: false
      regex:
        - "I: System started"
        - "I: Activating filter"
        - "I: Deactivating filter"
        - "I: Bypass filter"
        - "I: Disable bypass filter"
        - "I:  >-- Raw data fetched"
        - "I:  -|- Filtering data"
        - "I:  --> Consuming data: Acc x=0, y=0, z=0"
        - "I:  --> Consuming data: Acc x=2, y=2, z=2"
        - "I:  --> Consuming data: Acc x=4, y=4, z=4"
        - "I:  --> Consuming data: Acc x=6, y=6, z=6"
        - "I:  --> Consuming data: Acc x=7, y=7, z=7"
        - "I:  --> Consuming data: Acc x=8, y=8, z=8"
        - "I:  --> Consuming data: Acc x=9, y=9, z=9"
        - "I:  --> Consuming data: Acc x=10, y=10, z=10"
    tags: zbus
```

## samples/subsys/zbus/uart_bridge/boards/hifive1_fe310_B.conf
```kconfig
CONFIG_UART_INTERRUPT_DRIVEN=y
CONFIG_UART_SIFIVE_PORT_1=y
CONFIG_UART_SIFIVE_PORT_1_TXCNT_IRQ=1
CONFIG_UART_SIFIVE_PORT_1_RXCNT_IRQ=1
```

## samples/subsys/zbus/uart_bridge/sample.yaml
```yaml
sample:
  name: UART bridge
common:
  tags: zbus
  harness: console
  harness_config:
    type: multi_line
    ordered: false
    regex:
      - "D: Core sending start measurement with status 0"
      - "D: Peripheral sending sensor data"
      - "D: Bridge Started"
      - "D: Bridge send start_measurement"
      - "D: Bridge send sensor_data"
      - "D: Core sending start measurement with status 1"

tests:
  sample.zbus.uart_bridge_build:
    tags: zbus
    filter: dt_nodelabel_enabled("uart1")
    integration_platforms:
      - qemu_x86
```

## samples/subsys/zvm/boards/qemu_max_smp.conf
```kconfig
# Copyright 2024-2025 HNU-ESNL: Guoqi Xie, Chenglai Xiong, Xingyu Hu and etc.
# Copyright 2024-2025 openEuler SIG-Zephyr
# SPDX-License-Identifier: Apache-2.0

# hypervisor need 1024M of virtual space.
CONFIG_KERNEL_VM_SIZE=0x80000000

# virtual device.
CONFIG_ENABLE_VM_VGICV3=y
CONFIG_ENABLE_VM_VSERIAL=y

CONFIG_ARM64_SET_VMPIDR_EL2=y
CONFIG_ARM64_SET_VPIDR_EL2=y

# PSCI is supported
CONFIG_PM_CPU_OPS_PSCI=y
CONFIG_MP_MAX_NUM_CPUS=4

# Enable serial port
CONFIG_UART_PL011=y
```

## samples/subsys/zvm/dts/bindings/linux-vm.yaml
```yaml
description: linux virtual machine space

compatible: "linux-vm"

properties:
  dtb_address:
    type: int
    description: |
      Base address of the VM device tree file.
    required: true

  dtb_size:
    type: int
    description: |
      Size of the VM device tree file.
    required: true

  vcpu_num:
    type: int
    description: |
      Number of virtual CPUs for each Linux VM (supports SMP).
    required: true

  rootfs_address:
    type: int
    description: |
      Base address of the VM root filesystem.
    required: true
```

## samples/subsys/zvm/dts/bindings/vm-dram.yaml
```yaml
description: Virtual Machine DRAM

compatible: "vm-dram"

properties:
  reg:
    type: array
    required: true
    description: |
      Memory regions for the VM.

  label:
    type: string
    required: true
    description: |
      Human-readable name for the VM DRAM.

  memmap_type:
    type: string
    required: true
    description: |
      Type of memory mapping for the VM domain.

  vm_reg_base:
    type: int
    required: true
    description: |
      Guest VM's physical memory base, equivalent to the common `memory reg base` in the DTS.

  vm_reg_size:
    type: int
    required: true
    description: |
      Guest VM's physical memory size, equivalent to the common `memory reg size` in the DTS.

  address_type:
    type: string
    required: true
    description: |
      Type of virtual address for the VM.
```

## samples/subsys/zvm/dts/bindings/zephyr-vm.yaml
```yaml
description: Zephyr Virtual Machine Space

compatible: "zephyr-vm"

properties:
  dtb_address:
    type: int
    description: |
      Base address of the VM device tree file.
    required: true

  dtb_size:
    type: int
    description: |
      Size of the VM device tree file.
    required: true

  vcpu_num:
    type: int
    description: |
      Number of virtual CPUs for each Zephyr VM (supports SMP).
    required: true
```

## samples/synchronization/sample.yaml
```yaml
sample:
  description: A simple application that demonstrates
    basic sanity of the kernel.
  name: Synchronization Sample
tests:
  sample.kernel.synchronization:
    tags: synchronization
    build_on_all: true
    harness: console
    harness_config:
      type: multi_line
      regex:
        - "thread_a: Hello World from (.*)!"
        - "thread_b: Hello World from (.*)!"
```
