## CMakeLists.txt
```
# SPDX-License-Identifier: Apache-2.0
cmake_minimum_required(VERSION 3.28.0)

find_package(Zephyr REQUIRED HINTS $ENV{ZEPHYR_BASE})
project(benchmark)

set(app_sources src/benchmark.c)

if(CONFIG_BM_LISTENERS)
  list(APPEND app_sources src/lis.c)

elseif(CONFIG_BM_SUBSCRIBERS)
  list(APPEND app_sources src/sub.c)

elseif(CONFIG_BM_MSG_SUBSCRIBERS)
  list(APPEND app_sources src/msg_sub.c)

elseif(CONFIG_BM_ASYNC_LISTENERS)
  list(APPEND app_sources src/async_lis.c)

endif()

target_sources(app PRIVATE ${app_sources})
```

## Kconfig
```
# Copyright (c) 2022 Rodrigo Peixoto <rodrigopex@gmail.com>
# SPDX-License-Identifier: Apache-2.0

config BM_MESSAGE_SIZE
	int "Message size"
	default 256

config BM_ONE_TO
	int "Number of consumers"
	default 8

choice BM_OBSERVER_TYPE
	bool "Observer type to be used in the benchmark"

config BM_LISTENERS
	bool "Synchronous using listeners"

config BM_SUBSCRIBERS
	bool "Asynchronous using subscribers"

config BM_MSG_SUBSCRIBERS
	bool "Asynchronous using message subscribers"
	select ZBUS_MSG_SUBSCRIBER

config BM_ASYNC_LISTENERS
	bool "Asynchronous using async listeners"
	select ZBUS_ASYNC_LISTENER

endchoice

config BM_FAIRPLAY
	bool "Force a comparison with same actions"
	help
	  Forces a message copy on the listeners and subscribers to behave equivalent to
	  message subscribers.

source "Kconfig.zephyr"
```

## sample.yaml
```
sample:
  name: Zbus Benchmark
tests:
  sample.zbus.benchmark_async:
    tags: zbus
    min_ram: 16
    filter: CONFIG_SYS_CLOCK_EXISTS and not (CONFIG_ARCH_POSIX and not CONFIG_BOARD_NATIVE_SIM)
    harness: console
    harness_config:
      type: multi_line
      ordered: true
      regex:
        - "I: Benchmark 1 to 8 using LISTENERS to transmit with message size: 256 bytes"
        - "I: Bytes sent = 262144, received = 262144"
        - "I: Average data rate: (\\d+).(\\d+)MB/s"
        - "I: Duration: (\\d+).(\\d+)s"
        - "@(.*)"
    extra_configs:
      - CONFIG_BM_ONE_TO=8
      - CONFIG_BM_MESSAGE_SIZE=256
      - CONFIG_BM_LISTENERS=y
      - CONFIG_IDLE_STACK_SIZE=1024
    integration_platforms:
      - qemu_x86
  sample.zbus.benchmark_async_msg_sub:
    tags: zbus
    min_ram: 16
    filter: CONFIG_SYS_CLOCK_EXISTS and not (CONFIG_ARCH_POSIX and not CONFIG_BOARD_NATIVE_SIM)
    harness: console
    harness_config:
      type: multi_line
      ordered: true
      regex:
        - "I: Benchmark 1 to 8 using MSG_SUBSCRIBERS to transmit with message size: 256 bytes"
        - "I: Bytes sent = 262144, received = 262144"
        - "I: Average data rate: (\\d+).(\\d+)MB/s"
        - "I: Duration: (\\d+).(\\d+)s"
        - "@(.*)"
    extra_configs:
      - CONFIG_BM_ONE_TO=8
      - CONFIG_BM_MESSAGE_SIZE=256
      - CONFIG_BM_MSG_SUBSCRIBERS=y
      - CONFIG_IDLE_STACK_SIZE=1024
    integration_platforms:
      - qemu_x86
  sample.zbus.benchmark_sync:
    tags: zbus
    min_ram: 16
    filter: >-
      CONFIG_SYS_CLOCK_EXISTS and
      not (CONFIG_ARCH_POSIX and not CONFIG_BOARD_NATIVE_SIM) and
      not CONFIG_SMP
    harness: console
    harness_config:
      type: multi_line
      ordered: true
      regex:
        - "I: Benchmark 1 to 8 using SUBSCRIBERS to transmit with message size: 256 bytes"
        - "I: Bytes sent = 262144, received = 262144"
        - "I: Average data rate: (\\d+).(\\d+)MB/s"
        - "I: Duration: (\\d+).(\\d+)s"
        - "@(.*)"
    extra_configs:
      - CONFIG_BM_ONE_TO=8
      - CONFIG_BM_MESSAGE_SIZE=256
      - CONFIG_BM_SUBSCRIBERS=y
      - CONFIG_IDLE_STACK_SIZE=1024
    integration_platforms:
      - qemu_x86
```

## prj.conf
```kconfig
CONFIG_LOG=y
CONFIG_BOOT_BANNER=n
CONFIG_LOG_MODE_MINIMAL=y
CONFIG_ASSERT=n
CONFIG_ZBUS=y
CONFIG_ZBUS_LOG_LEVEL_INF=y
CONFIG_HEAP_MEM_POOL_SIZE=1024
```

## src/async_lis.c
```c
/*
 * Copyright (c) 2026 Rodrigo Peixoto <rodrigopex@gmail.com>
 * SPDX-License-Identifier: Apache-2.0
 */
#include "messages.h"

#include <zephyr/kernel.h>
#include <zephyr/sys/util_macro.h>
#include <zephyr/sys/atomic.h>
#include <zephyr/zbus/zbus.h>

extern atomic_t count;

static void s_cb(const struct zbus_channel *chan, const void *msg);

ZBUS_CHAN_DECLARE(bm_channel);

#define SFY(i, _) s##i

#define CONSUMERS_NAME_LIST LISTIFY(CONFIG_BM_ONE_TO, SFY, (, /* separator */))

#define CREATE_OBSERVER(s) ZBUS_ASYNC_LISTENER_DEFINE(s, s_cb)

#define CREATE_OBSERVATIONS(s) ZBUS_CHAN_ADD_OBS(bm_channel, s, 3)

/* clang-format off */
FOR_EACH(CREATE_OBSERVER, (;), CONSUMERS_NAME_LIST);

FOR_EACH(CREATE_OBSERVATIONS, (;), CONSUMERS_NAME_LIST);
/* clang-format on */

static void s_cb(const struct zbus_channel *chan, const void *msg)
{
	ARG_UNUSED(chan);

	const struct bm_msg *msg_received = msg;

	atomic_add(&count, *((uint16_t *)msg_received->bytes));
}
```

## src/benchmark.c
```c
/*
 * Copyright (c) 2022 Rodrigo Peixoto <rodrigopex@gmail.com>
 * SPDX-License-Identifier: Apache-2.0
 */
#include "messages.h"

#include <zephyr/fatal.h>
#include <zephyr/kernel.h>
#include <zephyr/logging/log.h>
#include <zephyr/sys/util_macro.h>
#include <zephyr/sys/atomic.h>
#include <zephyr/zbus/zbus.h>

#if defined(CONFIG_BOARD_NATIVE_SIM)
#include "native_rtc.h"
#define GET_ARCH_TIME_NS() (native_rtc_gettime_us(RTC_CLOCK_PSEUDOHOSTREALTIME) * NSEC_PER_USEC)
#elif defined(CONFIG_ARCH_POSIX)
#error "This sample cannot be built for other POSIX arch boards than native_sim"
#else
#define GET_ARCH_TIME_NS() (k_cyc_to_ns_near64(sys_clock_cycle_get_32()))
#endif

LOG_MODULE_DECLARE(zbus, CONFIG_ZBUS_LOG_LEVEL);

#define CONSUMER_STACK_SIZE (CONFIG_IDLE_STACK_SIZE + CONFIG_BM_MESSAGE_SIZE)
#define PRODUCER_STACK_SIZE (CONFIG_MAIN_STACK_SIZE + CONFIG_BM_MESSAGE_SIZE)

ZBUS_CHAN_DEFINE(bm_channel,    /* Name */
		 struct bm_msg, /* Message type */

		 NULL,                 /* Validator */
		 NULL,                 /* User data */
		 ZBUS_OBSERVERS_EMPTY, /* observers */
		 ZBUS_MSG_INIT(0)      /* Initial value {0} */
);

#define BYTES_TO_BE_SENT (256LLU * 1024LLU)
atomic_t count;

static void producer_thread(void)
{
	LOG_INF("Benchmark 1 to %d using %s to transmit with message size: %u bytes",
		CONFIG_BM_ONE_TO,
		IS_ENABLED(CONFIG_BM_LISTENERS)
			? "LISTENERS"
			: (IS_ENABLED(CONFIG_BM_SUBSCRIBERS)
				   ? "SUBSCRIBERS"
				   : (IS_ENABLED(CONFIG_BM_MSG_SUBSCRIBERS) ? "MSG_SUBSCRIBERS"
									    : "ASYNC_LISTENERS")),
		CONFIG_BM_MESSAGE_SIZE);

	struct bm_msg msg = {{0}};

	uint16_t message_size = CONFIG_BM_MESSAGE_SIZE;

	memcpy(msg.bytes, &message_size, sizeof(message_size));

	uint64_t start_ns = GET_ARCH_TIME_NS();

	for (uint64_t internal_count = BYTES_TO_BE_SENT / CONFIG_BM_ONE_TO; internal_count > 0;
	     internal_count -= CONFIG_BM_MESSAGE_SIZE) {
		zbus_chan_pub(&bm_channel, &msg, K_FOREVER);
	}

	uint64_t end_ns = GET_ARCH_TIME_NS();

	uint64_t duration_ns = end_ns - start_ns;

	if (duration_ns == 0) {
		LOG_ERR("Something wrong. Duration is zero!\n");
		k_oops();
	}
	uint64_t i = ((BYTES_TO_BE_SENT * NSEC_PER_SEC) / MB(1)) / duration_ns;
	uint64_t f = ((BYTES_TO_BE_SENT * NSEC_PER_SEC * 100) / MB(1) / duration_ns) % 100;

	LOG_INF("Bytes sent = %llu, received = %lu", BYTES_TO_BE_SENT, atomic_get(&count));
	LOG_INF("Average data rate: %llu.%lluMB/s", i, f);
	LOG_INF("Duration: %llu.%09llus", duration_ns / NSEC_PER_SEC, duration_ns % NSEC_PER_SEC);

	printk("\n@%llu\n", duration_ns / 1000);
}

K_THREAD_DEFINE(producer_thread_id, PRODUCER_STACK_SIZE * 2, producer_thread, NULL, NULL, NULL, 5,
		0, 0);
```

## src/lis.c
```c
/*
 * Copyright (c) 2023 Rodrigo Peixoto <rodrigopex@gmail.com>
 * SPDX-License-Identifier: Apache-2.0
 */
#include "messages.h"

#include <zephyr/kernel.h>
#include <zephyr/sys/util_macro.h>
#include <zephyr/sys/atomic.h>
#include <zephyr/zbus/zbus.h>

#define CONSUMER_STACK_SIZE (CONFIG_IDLE_STACK_SIZE + CONFIG_BM_MESSAGE_SIZE)

extern atomic_t count;

static void s_cb(const struct zbus_channel *chan);

ZBUS_CHAN_DECLARE(bm_channel);

#define SFY(i, _) s##i

#define CONSUMERS_NAME_LIST LISTIFY(CONFIG_BM_ONE_TO, SFY, (, /* separator */))

#define CREATE_OBSERVER(s) ZBUS_LISTENER_DEFINE(s, s_cb)

#define CREATE_OBSERVATIONS(s) ZBUS_CHAN_ADD_OBS(bm_channel, s, 3)

/* clang-format off */
FOR_EACH(CREATE_OBSERVER, (;), CONSUMERS_NAME_LIST);

FOR_EACH(CREATE_OBSERVATIONS, (;), CONSUMERS_NAME_LIST);
/* clang-format on */

static void s_cb(const struct zbus_channel *chan)
{

	if (IS_ENABLED(CONFIG_BM_FAIRPLAY)) {
		struct bm_msg msg_received;

		memcpy(zbus_chan_msg(chan), &msg_received, chan->message_size);

		atomic_add(&count, *((uint16_t *)msg_received.bytes));
	} else {
		const struct bm_msg *msg_received = zbus_chan_const_msg(chan);

		atomic_add(&count, *((uint16_t *)msg_received->bytes));
	}
}
```

## src/messages.h
```c
/*
 * Copyright (c) 2022 Rodrigo Peixoto <rodrigopex@gmail.com>
 * SPDX-License-Identifier: Apache-2.0
 */
#ifndef _MESSAGES_H_
#define _MESSAGES_H_
#include <stddef.h>
#include <stdint.h>

struct bm_msg {
	uint8_t bytes[CONFIG_BM_MESSAGE_SIZE];
};

#endif /* _MESSAGES_H_ */
```

## src/msg_sub.c
```c
/*
 * Copyright (c) 2023 Rodrigo Peixoto <rodrigopex@gmail.com>
 * SPDX-License-Identifier: Apache-2.0
 */
#include "messages.h"

#include <zephyr/kernel.h>
#include <zephyr/sys/util_macro.h>
#include <zephyr/sys/atomic.h>
#include <zephyr/zbus/zbus.h>

#define CONSUMER_STACK_SIZE (CONFIG_IDLE_STACK_SIZE + CONFIG_BM_MESSAGE_SIZE)

extern atomic_t count;

ZBUS_CHAN_DECLARE(bm_channel);

#define SFY(i, _) s##i

#define CONSUMERS_NAME_LIST LISTIFY(CONFIG_BM_ONE_TO, SFY, (, /* separator */))

#define CREATE_OBSERVER(s) ZBUS_MSG_SUBSCRIBER_DEFINE(s)

#define CREATE_OBSERVATIONS(s) ZBUS_CHAN_ADD_OBS(bm_channel, s, 3)

/* clang-format off */
FOR_EACH(CREATE_OBSERVER, (;), CONSUMERS_NAME_LIST);

FOR_EACH(CREATE_OBSERVATIONS, (;), CONSUMERS_NAME_LIST);
/* clang-format on */

static int msg_sub_thread(void *msub_ref, void *ptr2, void *ptr3)
{
	ARG_UNUSED(ptr2);
	ARG_UNUSED(ptr3);

	const struct zbus_channel *chan;
	struct bm_msg msg_received;
	struct zbus_observer *msub = msub_ref;

	while (1) {
		if (zbus_sub_wait_msg(msub, &chan, &msg_received, K_FOREVER) == 0) {
			atomic_add(&count, *((uint16_t *)msg_received.bytes));
		} else {
			k_oops();
		}
	}

	return -EFAULT;
}

#define CREATE_THREADS(name)                                                                       \
	K_THREAD_DEFINE(name##_msub_id, CONSUMER_STACK_SIZE, msg_sub_thread, &name, NULL, NULL, 3, \
			0, 0);
/* clang-format off */
FOR_EACH(CREATE_THREADS, (;), CONSUMERS_NAME_LIST);
/* clang-format on */
```

## src/sub.c
```c
/*
 * Copyright (c) 2023 Rodrigo Peixoto <rodrigopex@gmail.com>
 * SPDX-License-Identifier: Apache-2.0
 */
#include "messages.h"

#include <zephyr/kernel.h>
#include <zephyr/sys/util_macro.h>
#include <zephyr/sys/atomic.h>
#include <zephyr/zbus/zbus.h>

#define CONSUMER_STACK_SIZE (CONFIG_IDLE_STACK_SIZE + CONFIG_BM_MESSAGE_SIZE)

extern atomic_t count;

ZBUS_CHAN_DECLARE(bm_channel);

#define SFY(i, _) s##i

#define CONSUMERS_NAME_LIST LISTIFY(CONFIG_BM_ONE_TO, SFY, (, /* separator */))

#define CREATE_OBSERVER(s) ZBUS_SUBSCRIBER_DEFINE(s, 4)

#define CREATE_OBSERVATIONS(s) ZBUS_CHAN_ADD_OBS(bm_channel, s, 3)

/* clang-format off */
FOR_EACH(CREATE_OBSERVER, (;), CONSUMERS_NAME_LIST);

FOR_EACH(CREATE_OBSERVATIONS, (;), CONSUMERS_NAME_LIST);
/* clang-format on */

static int sub_thread(void *sub_ref, void *ptr2, void *ptr3)
{
	ARG_UNUSED(ptr2);
	ARG_UNUSED(ptr3);

	const struct zbus_channel *chan;
	struct zbus_observer *sub = sub_ref;

	while (1) {
		if (zbus_sub_wait(sub, &chan, K_FOREVER) == 0) {
			if (zbus_chan_claim(chan, K_FOREVER) != 0) {
				k_oops();
			}

			if (IS_ENABLED(CONFIG_BM_FAIRPLAY)) {
				struct bm_msg message;

				memcpy(zbus_chan_msg(chan), &message, chan->message_size);

				atomic_add(&count, *((uint16_t *)message.bytes));
			} else {
				const struct bm_msg *msg_received = zbus_chan_const_msg(chan);

				atomic_add(&count, *((uint16_t *)msg_received->bytes));
			}

			zbus_chan_finish(chan);
		} else {
			k_oops();
		}
	}
	return -EFAULT;
}

#define CREATE_THREADS(name)                                                                       \
	K_THREAD_DEFINE(name##_sub_id, CONSUMER_STACK_SIZE, sub_thread, &name, NULL, NULL, 3, 0, 0);

/* clang-format off */
FOR_EACH(CREATE_THREADS, (;), CONSUMERS_NAME_LIST);
/* clang-format on */
```
