## CMakeLists.txt
```
# SPDX-License-Identifier: Apache-2.0
cmake_minimum_required(VERSION 3.28.0)

find_package(Zephyr REQUIRED HINTS $ENV{ZEPHYR_BASE})
project(runtime_obs_registration)

FILE(GLOB app_sources src/*.c)
target_sources(app PRIVATE ${app_sources})
```

## sample.yaml
```
sample:
  name: Runtime observer registration
tests:
  sample.zbus.runtime_os_registration:
    min_ram: 16
    integration_platforms:
      - qemu_x86
    arch_exclude: nios2
    harness: console
    harness_config:
      type: multi_line
      ordered: false
      regex:
        - ".*I: System started, runtime observers statically allocated"
        - ".*I: Activating filter"
        - ".*I: Deactivating filter"
        - ".*I: Bypass filter"
        - ".*I: Disable bypass filter"
        - ".*I:  >-- Raw data fetched"
        - ".*I:  -|- Filtering data"
        - ".*I:  --> Consuming data: Acc x=0, y=0, z=0"
        - ".*I:  --> Consuming data: Acc x=2, y=2, z=2"
        - ".*I:  --> Consuming data: Acc x=4, y=4, z=4"
        - ".*I:  --> Consuming data: Acc x=6, y=6, z=6"
        - ".*I:  --> Consuming data: Acc x=7, y=7, z=7"
        - ".*I:  --> Consuming data: Acc x=8, y=8, z=8"
        - ".*I:  --> Consuming data: Acc x=9, y=9, z=9"
        - ".*I:  --> Consuming data: Acc x=10, y=10, z=10"
    tags: zbus
    extra_configs:
      - CONFIG_ZBUS_PREFER_DYNAMIC_ALLOCATION=n
  sample.zbus.runtime_os_registration_dynamic_alloc:
    min_ram: 16
    integration_platforms:
      - qemu_x86
    arch_exclude: nios2
    harness: console
    harness_config:
      type: multi_line
      ordered: false
      regex:
        - ".*I: System started, runtime observers dynamically allocated"
        - ".*I: Activating filter"
        - ".*I: Deactivating filter"
        - ".*I: Bypass filter"
        - ".*I: Disable bypass filter"
        - ".*I:  >-- Raw data fetched"
        - ".*I:  -|- Filtering data"
        - ".*I:  --> Consuming data: Acc x=0, y=0, z=0"
        - ".*I:  --> Consuming data: Acc x=2, y=2, z=2"
        - ".*I:  --> Consuming data: Acc x=4, y=4, z=4"
        - ".*I:  --> Consuming data: Acc x=6, y=6, z=6"
        - ".*I:  --> Consuming data: Acc x=7, y=7, z=7"
        - ".*I:  --> Consuming data: Acc x=8, y=8, z=8"
        - ".*I:  --> Consuming data: Acc x=9, y=9, z=9"
        - ".*I:  --> Consuming data: Acc x=10, y=10, z=10"
    tags: zbus
    extra_configs:
      - CONFIG_HEAP_MEM_POOL_SIZE=1024
```

## prj.conf
```kconfig
CONFIG_LOG=y
CONFIG_ASSERT=y
CONFIG_LOG_MODE_MINIMAL=y
CONFIG_BOOT_BANNER=n
CONFIG_ZBUS=y
CONFIG_ZBUS_LOG_LEVEL_INF=y
CONFIG_ZBUS_RUNTIME_OBSERVERS=y
CONFIG_MP_MAX_NUM_CPUS=1
```

## src/main.c
```c
/*
 * Copyright (c) 2022 Rodrigo Peixoto <rodrigopex@gmail.com>
 * SPDX-License-Identifier: Apache-2.0
 */

#include "messages.h"

#include <stdint.h>

#include <zephyr/kernel.h>
#include <zephyr/logging/log.h>
#include <zephyr/zbus/zbus.h>
LOG_MODULE_DECLARE(zbus, CONFIG_ZBUS_LOG_LEVEL);

ZBUS_CHAN_DEFINE(processed_data_chan, struct sensor_msg, NULL, NULL, ZBUS_OBSERVERS(consumer_sub),
		 ZBUS_MSG_INIT(.x = 0, .y = 0, .z = 0));

ZBUS_CHAN_DECLARE(raw_data_chan, state_chan);

static void filter_callback(const struct zbus_channel *chan)
{
	const struct sensor_msg *msg = zbus_chan_const_msg(chan);
	struct sensor_msg proc_msg = {0};

	if (0 == (msg->x % 2)) {
		proc_msg.x = msg->x;
	}
	if (0 == (msg->y % 2)) {
		proc_msg.y = msg->y;
	}
	if (0 == (msg->z % 2)) {
		proc_msg.z = msg->z;
	}
	LOG_INF(" -|- Filtering data");
	zbus_chan_pub(&processed_data_chan, &proc_msg, K_MSEC(200));
}

ZBUS_LISTENER_DEFINE(filter_lis, filter_callback);

ZBUS_SUBSCRIBER_DEFINE(state_change_sub, 5);

int main(void)
{
	LOG_INF("System started, runtime observers %s allocated",
		IS_ENABLED(CONFIG_ZBUS_RUNTIME_OBSERVERS_NODE_ALLOC_DYNAMIC) ? "dynamically"
									     : "statically");

	const struct zbus_channel *chan;

	while (1) {
		LOG_INF("Activating filter");
		zbus_chan_add_obs(&raw_data_chan, &filter_lis, K_MSEC(200));

		zbus_sub_wait(&state_change_sub, &chan, K_FOREVER);

		LOG_INF("Deactivating filter");
		zbus_chan_rm_obs(&raw_data_chan, &filter_lis, K_MSEC(200));

		LOG_INF("Bypass filter");
		zbus_chan_add_obs(&raw_data_chan, &consumer_sub, K_MSEC(200));

		zbus_sub_wait(&state_change_sub, &chan, K_FOREVER);

		LOG_INF("Disable bypass filter");
		zbus_chan_rm_obs(&raw_data_chan, &consumer_sub, K_MSEC(200));

		zbus_sub_wait(&state_change_sub, &chan, K_FOREVER);
	}
	return 0;
}
```

## src/consumer.c
```c
/*
 * Copyright (c) 2022 Rodrigo Peixoto <rodrigopex@gmail.com>
 * SPDX-License-Identifier: Apache-2.0
 */
#include "messages.h"

#include <zephyr/logging/log.h>
#include <zephyr/zbus/zbus.h>
LOG_MODULE_DECLARE(zbus, CONFIG_ZBUS_LOG_LEVEL);

ZBUS_SUBSCRIBER_DEFINE(consumer_sub, 4);

static void consumer_subscriber_thread(void)
{
	const struct zbus_channel *chan;

	while (!zbus_sub_wait(&consumer_sub, &chan, K_FOREVER)) {
		struct sensor_msg acc;

		zbus_chan_read(chan, &acc, K_MSEC(500));
		LOG_INF(" --> Consuming data: Acc x=%d, y=%d, z=%d", acc.x, acc.y, acc.z);
	}
}

K_THREAD_DEFINE(consumer_thread_id, 1024, consumer_subscriber_thread, NULL, NULL, NULL, 3, 0, 0);
```

## src/messages.h
```c
/*
 * Copyright (c) 2022 Rodrigo Peixoto <rodrigopex@gmail.com>
 * SPDX-License-Identifier: Apache-2.0
 */

#ifndef _MESSAGES_H_
#define _MESSAGES_H_

#include <stdint.h>

struct sensor_msg {
	int x;
	int y;
	int z;
};

#endif /* _MESSAGES_H_ */
```

## src/producer.c
```c
/*
 * Copyright (c) 2022 Rodrigo Peixoto <rodrigopex@gmail.com>
 * SPDX-License-Identifier: Apache-2.0
 */
#include "messages.h"

#include <zephyr/logging/log.h>
#include <zephyr/zbus/zbus.h>
LOG_MODULE_DECLARE(zbus, CONFIG_ZBUS_LOG_LEVEL);

ZBUS_CHAN_DEFINE(raw_data_chan, struct sensor_msg, NULL, NULL, ZBUS_OBSERVERS_EMPTY,
		 ZBUS_MSG_INIT(.x = 0, .y = 0, .z = 0));

ZBUS_CHAN_DEFINE(state_chan, bool, NULL, NULL, ZBUS_OBSERVERS(state_change_sub), false);

static void producer_thread(void)
{
	struct sensor_msg acc = {0};
	uint32_t count = 0;

	while (1) {
		if (count == 5) {
			bool change_state = true;

			zbus_chan_pub(&state_chan, &change_state, K_MSEC(200));
			count = 0;
		}

		++acc.x;
		++acc.y;
		++acc.z;

		LOG_INF(" >-- Raw data fetched");

		zbus_chan_pub(&raw_data_chan, &acc, K_MSEC(200));

		k_msleep(500);

		++count;
	}
}

K_THREAD_DEFINE(produce_thread_id, 1024, producer_thread, NULL, NULL, NULL, 3, 0, 0);
```
