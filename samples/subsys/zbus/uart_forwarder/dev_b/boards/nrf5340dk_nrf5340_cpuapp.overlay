/*
 * Copyright (c) 2025 Nordic Semiconductor ASA
 *
 * SPDX-License-Identifier: Apache-2.0
 */

/ {
	aliases {
		zbus-uart = &uart1;
	};
};

&uart1 {
	status = "okay";
	current-speed = <1000000>;
	/delete-property/ hw-flow-control;
};
