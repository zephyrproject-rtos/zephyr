/*
 * Copyright (c) 2025 Nordic Semiconductor ASA
 *
 * SPDX-License-Identifier: Apache-2.0
 */

/ {
	ipc_proxy_agent: ipc-proxy {
		compatible = "zephyr,zbus-proxy-agent-ipc";
		status = "okay";
		ipc-device = <&ipc0>;
	};
};
