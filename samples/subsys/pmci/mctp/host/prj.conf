## CMakeLists.txt
```
cmake_minimum_required(VERSION 3.28.0)

find_package(Zephyr REQUIRED HINTS $ENV{ZEPHYR_BASE})
project(mctp_host)

target_sources(app PRIVATE src/main.c)
```

## sample.yaml
```
sample:
  name: MCTP Uart Host Endpoint
common:
  tags:
    - pmci
    - mctp
tests:
  sample.pmci.mctp.uart_host:
    platform_allow:
      - nrf52840dk/nrf52840
    harness: console
    harness_config:
      type: multi_line
      regex:
        - "(.*)MCTP Host EID: (.*) on (.*)"
        - "received message (.*) for endpoint (.*)"
```

## prj.conf
```kconfig
# nothing here
CONFIG_SERIAL=y
CONFIG_UART_ASYNC_API=y
CONFIG_MCTP=y
CONFIG_MCTP_UART=y
CONFIG_LOG=y
CONFIG_LOG_BUFFER_SIZE=4096
```

## boards/npcx4m8f_evb.conf
```kconfig
CONFIG_UART_NPCX_USE_MDMA=y
```

## boards/npcx4m8f_evb.overlay
```dts
&uart2 {
	current-speed = <115200>;
	pinctrl-0 = <&uart2_sin_gp75 &uart2_sout_gp86>;
	pinctrl-names = "default";
	status = "okay";
};

arduino_serial: &uart2 {};
```

## src/main.c
```c
/*
 * Copyright (c) 2024 Intel Corporation
 *
 * SPDX-License-Identifier: Apache-2.0
 */

#include <stdio.h>
#include <assert.h>
#include <zephyr/types.h>
#include <zephyr/kernel.h>
#include <libmctp.h>
#include <zephyr/pmci/mctp/mctp_uart.h>

#include <zephyr/logging/log.h>
LOG_MODULE_REGISTER(mctp_host);

#define LOCAL_HELLO_EID 20

#define REMOTE_HELLO_EID 10

K_SEM_DEFINE(mctp_rx, 0, 1);

static void rx_message(uint8_t eid, bool tag_owner, uint8_t msg_tag, void *data, void *msg,
		       size_t len)
{
	LOG_INF("received message \"%s\" from endpoint %d, msg_tag %d, len %zu", (char *)msg, eid,
		msg_tag, len);
	k_sem_give(&mctp_rx);
}

MCTP_UART_DT_DEFINE(mctp_host, DEVICE_DT_GET(DT_NODELABEL(arduino_serial)));

int main(void)
{
	int rc;
	struct mctp *mctp_ctx;

	LOG_INF("MCTP Host EID:%d on %s\n", LOCAL_HELLO_EID, CONFIG_BOARD_TARGET);

	mctp_ctx = mctp_init();
	__ASSERT_NO_MSG(mctp_ctx != NULL);
	mctp_register_bus(mctp_ctx, &mctp_host.binding, LOCAL_HELLO_EID);
	mctp_set_rx_all(mctp_ctx, rx_message, NULL);
	mctp_uart_start_rx(&mctp_host);

	/* MCTP poll loop, send "hello" and get "world" back */
	while (true) {
		k_sleep(K_MSEC(1000));
		LOG_INF("Sending message \"hello\" to endpoint %d", REMOTE_HELLO_EID);
		rc = mctp_message_tx(mctp_ctx, REMOTE_HELLO_EID, false, 0, "hello",
				     sizeof("hello"));
		if (rc != 0) {
			LOG_WRN("Failed to send message, errno %d", rc);
			k_msleep(1000);
		} else {
			k_sem_take(&mctp_rx, K_MSEC(10));
		}
		rc = 0;
	}

	return 0;
}
```
