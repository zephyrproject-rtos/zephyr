/*
 * Copyright (c) 2026 Tenstorrent AI ULC
 *
 * SPDX-License-Identifier: Apache-2.0
 */

&i3c1 {
	pinctrl-0 = <&i3c1_scl_pb2 &i3c1_sda_pc1>;
	pinctrl-names = "default";
	status = "okay";
	i3c-scl-hz = <1000000>;
	i2c-scl-hz = <400000>;
	target-mode;
	mipi-instance = <0x8>;
};

/ {
	mctp_i3c: mctp_i3c {
		compatible = "zephyr,mctp-i3c-target";
		i3c = <&i3c1>;
		endpoint-id = <11>;
	};
};
