## CMakeLists.txt
```
cmake_minimum_required(VERSION 3.28.0)

find_package(Zephyr REQUIRED HINTS $ENV{ZEPHYR_BASE})

project(mctp_endpoint)

target_sources(app PRIVATE src/main.c)
```

## prj.conf
```kconfig
CONFIG_SERIAL=y
CONFIG_UART_ASYNC_API=y
CONFIG_MCTP=y
CONFIG_MCTP_UART=y
CONFIG_LOG=y
CONFIG_LOG_BUFFER_SIZE=4096
CONFIG_ISR_STACK_SIZE=4096
```

## boards/npcx4m8f_evb.overlay
```dts
&uart2 {
	status = "okay";
	current-speed = <115200>;
	pinctrl-0 = <&uart2_sin_gp75 &uart2_sout_gp86>;
	pinctrl-names = "default";
};

arduino_serial: &uart2 {};
```

## boards/nrf52840dk_nrf52840.overlay
```dts
&arduino_serial {
	status = "okay";
};
```

## src/main.c
```c
/*
 * Copyright (c) 2024 Intel Corporation
 *
 * SPDX-License-Identifier: Apache-2.0
 */

#include <stdio.h>
#include <assert.h>
#include <zephyr/kernel.h>
#include <zephyr/types.h>
#include <zephyr/pmci/mctp/mctp_uart.h>
#include <libmctp.h>

#include <zephyr/logging/log.h>
LOG_MODULE_REGISTER(mctp_endpoint);

static struct mctp *mctp_ctx;

#define LOCAL_HELLO_EID 10

#define REMOTE_HELLO_EID 20

K_SEM_DEFINE(mctp_rx, 0, 1);

static void rx_message_handler(struct k_work *work)
{
	ARG_UNUSED(work);

	mctp_message_tx(mctp_ctx, REMOTE_HELLO_EID, false, 0, "world", sizeof("world"));

	k_sem_give(&mctp_rx);
}
K_WORK_DEFINE(rx_message_work, rx_message_handler);

static void rx_message(uint8_t eid, bool tag_owner, uint8_t msg_tag, void *data, void *msg,
		       size_t len)
{
	switch (eid) {
	case REMOTE_HELLO_EID:
		LOG_INF("got mctp message \"%s\" from eid %d, replying with \"world\"", (char *)msg,
			eid);
		k_work_submit(&rx_message_work);
		break;
	default:
		LOG_INF("Unknown endpoint %d", eid);
		break;
	}
}

MCTP_UART_DT_DEFINE(mctp_endpoint, DEVICE_DT_GET(DT_NODELABEL(arduino_serial)));

int main(void)
{
	LOG_INF("MCTP Endpoint EID:%d on %s\n", LOCAL_HELLO_EID, CONFIG_BOARD_TARGET);

	mctp_ctx = mctp_init();
	__ASSERT_NO_MSG(mctp_ctx != NULL);
	mctp_register_bus(mctp_ctx, &mctp_endpoint.binding, LOCAL_HELLO_EID);
	mctp_set_rx_all(mctp_ctx, rx_message, NULL);

	/* MCTP poll loop */
	mctp_uart_start_rx(&mctp_endpoint);
	while (true) {
		k_sem_take(&mctp_rx, K_FOREVER);
	}

	LOG_INF("exiting");
	return 0;
}
```
