/*
 * Copyright (c) 2025 Intel Corporation
 *
 * SPDX-License-Identifier: Apache-2.0
 */

/ {
	/* SDA J18.2 */
	/* SCL J18.1 */
	/* GPIO J17.2 */
	mctp_i2c: mctp_i2c {
		compatible = "zephyr,mctp-i2c-gpio-target";
		i2c = <&i2c0_0>;
		i2c-addr = <70>;
		endpoint-id = <11>;
		endpoint-gpios = <&gpio4 3 GPIO_ACTIVE_HIGH>;
	};
};
