/*
 * Copyright (c) 2020 Jacek Ozimek <jacek.ozmk@gmail.com>
 *
 * SPDX-License-Identifier: Apache-2.0
 */

&feather_i2c {
	frammb85rs64v: frammb85rs64v@76 {
		/* 0x76 - SDO <-> GND */
		/* 0x77 - SDO <-> VCC */
		compatible = "fujitsu,frammb85rs64v";
		reg = <0x76>;
		label = "FRAM_SENSOR";
	};
};
