## CMakeLists.txt
```
# SPDX-License-Identifier: Apache-2.0

cmake_minimum_required(VERSION 3.28.0)

find_package(Zephyr REQUIRED HINTS $ENV{ZEPHYR_BASE})
project(mcux_lpcmp)

FILE(GLOB app_sources src/*.c)
target_sources(app PRIVATE ${app_sources})
```

## Kconfig
```
#
# Copyright NXP 2025
#
# SPDX-License-Identifier: Apache-2.0
#

config LPCMP_POSITIVE_PORT
	int "The LPCMP positive input port"
	default 0 if $(dt_node_str_prop_equals,$(dt_nodelabel_path,lpcmp0),positive-mux-input,IN0)
	default 1 if $(dt_node_str_prop_equals,$(dt_nodelabel_path,lpcmp0),positive-mux-input,IN1)
	default 2 if $(dt_node_str_prop_equals,$(dt_nodelabel_path,lpcmp0),positive-mux-input,IN2)
	default 3 if $(dt_node_str_prop_equals,$(dt_nodelabel_path,lpcmp0),positive-mux-input,IN3)
	default 4 if $(dt_node_str_prop_equals,$(dt_nodelabel_path,lpcmp0),positive-mux-input,IN4)
	default 5 if $(dt_node_str_prop_equals,$(dt_nodelabel_path,lpcmp0),positive-mux-input,IN5)
	default 7 if $(dt_node_str_prop_equals,$(dt_nodelabel_path,lpcmp0),positive-mux-input,DAC)
	help
	  Specifies positive input port.

config LPCMP_NEGATIVE_PORT
	int "The LPCMP negative input port"
	default 0 if $(dt_node_str_prop_equals,$(dt_nodelabel_path,lpcmp0),negative-mux-input,IN0)
	default 1 if $(dt_node_str_prop_equals,$(dt_nodelabel_path,lpcmp0),negative-mux-input,IN1)
	default 2 if $(dt_node_str_prop_equals,$(dt_nodelabel_path,lpcmp0),negative-mux-input,IN2)
	default 3 if $(dt_node_str_prop_equals,$(dt_nodelabel_path,lpcmp0),negative-mux-input,IN3)
	default 4 if $(dt_node_str_prop_equals,$(dt_nodelabel_path,lpcmp0),negative-mux-input,IN4)
	default 5 if $(dt_node_str_prop_equals,$(dt_nodelabel_path,lpcmp0),negative-mux-input,IN5)
	default 7 if $(dt_node_str_prop_equals,$(dt_nodelabel_path,lpcmp0),negative-mux-input,DAC)
	help
	  Specifies negative input port.

source "Kconfig.zephyr"
```

## sample.yaml
```
sample:
  description: Demonstration of the NXP MCUX LPCMP driver
  name: NXP MCUX LPCMP sample
common:
  platform_allow:
    - frdm_mcxn947/mcxn947/cpu0
    - mcx_n9xx_evk/mcxn947/cpu0
    - frdm_mcxn236
    - frdm_mcxa156
    - frdm_mcxa153
    - frdm_mcxa346
    - frdm_mcxa266
    - frdm_mcxa366
  integration_platforms:
    - frdm_mcxn947/mcxn947/cpu0
    - frdm_mcxn236
    - frdm_mcxa346
    - frdm_mcxa266
    - frdm_mcxa366
  tags:
    - drivers
    - sensor
tests:
  sample.sensor.mcux_lpcmp:
    harness: console
    harness_config:
      type: one_line
      ordered: true
      regex:
        - "LPCMP input [a-z]* threshold"
  sample.sensor.mcux_lpcmp.no_trigger:
    build_only: true
    extra_configs:
      - CONFIG_MCUX_LPCMP_TRIGGER=n
```

## prj.conf
```kconfig
CONFIG_SENSOR=y
CONFIG_MCUX_LPCMP_TRIGGER=y
CONFIG_MCUX_LPCMP=y
CONFIG_COMPARATOR_NXP_LPCMP=n

# The mcux_lpcmp sensor driver is deprecated in favor of the comparator API
# (CONFIG_COMPARATOR_NXP_LPCMP). Both the driver and this sample are scheduled
# for removal in Zephyr 4.6, keep this sample buildable until then.
CONFIG_WARN_DEPRECATED=n
```

## boards/frdm_mcxa166.conf
```kconfig
CONFIG_LPCMP_POSOTIVE_PORT=1
```

## boards/frdm_mcxa346.conf
```kconfig
CONFIG_LPCMP_POSITIVE_PORT=1
```

## boards/frdm_mcxa153.overlay
```dts
/*
 * Copyright 2025 NXP
 *
 * SPDX-License-Identifier: Apache-2.0
 */

&lpcmp0 {
	/delete-property/ clocks;
	#io-channel-cells = <2>;
	function-clock = "CMP_CLOCK";
	pinctrl-0 = <&pinmux_lpcmp0>;
	pinctrl-names = "default";
	positive-mux-input = "IN0";
	negative-mux-input = "DAC";
	status = "okay";
};
```

## boards/frdm_mcxa156.overlay
```dts
/*
 * Copyright 2024 NXP
 *
 * SPDX-License-Identifier: Apache-2.0
 */

&lpcmp0 {
	/delete-property/ clocks;
	#io-channel-cells = <2>;
	function-clock = "CMP_CLOCK";
	pinctrl-0 = <&pinmux_lpcmp0>;
	pinctrl-names = "default";
	positive-mux-input = "IN0";
	negative-mux-input = "DAC";
	status = "okay";
};
```

## boards/frdm_mcxa166.overlay
```dts
/*
 * Copyright 2025 NXP
 *
 * SPDX-License-Identifier: Apache-2.0
 */

&lpcmp0 {
	function-clock = "CMP_CLOCK";
};
```

## boards/frdm_mcxa266.overlay
```dts
/*
 * Copyright 2025 NXP
 *
 * SPDX-License-Identifier: Apache-2.0
 */

&lpcmp0 {
	status = "okay";
	function-clock = "CMP_CLOCK";
};
```

## boards/frdm_mcxa346.overlay
```dts
/*
 * Copyright 2025 NXP
 *
 * SPDX-License-Identifier: Apache-2.0
 */

&lpcmp0 {
	/delete-property/ clocks;
	#io-channel-cells = <2>;
	function-clock = "CMP_CLOCK";
	pinctrl-0 = <&pinmux_lpcmp0>;
	pinctrl-names = "default";
	status = "okay";
	positive-mux-input = "IN1";
	negative-mux-input = "DAC";
};
```

## boards/frdm_mcxa366.overlay
```dts
/*
 * Copyright 2025 NXP
 *
 * SPDX-License-Identifier: Apache-2.0
 */

&lpcmp0 {
	/delete-property/ clocks;
	#io-channel-cells = <2>;
	function-clock = "CMP_CLOCK";
	pinctrl-0 = <&pinmux_lpcmp0>;
	pinctrl-names = "default";
	positive-mux-input = "IN1";
	negative-mux-input = "DAC";
	status = "okay";
};
```

## src/main.c
```c
/*
 * Copyright (c) 2020 Vestas Wind Systems A/S
 * Copyright NXP 2024
 *
 * SPDX-License-Identifier: Apache-2.0
 */

#include <zephyr/device.h>
#include <zephyr/drivers/sensor.h>
#include <zephyr/drivers/sensor/mcux_lpcmp.h>
#include <zephyr/kernel.h>
#include <stdio.h>

struct lpcmp_attr {
	int16_t attr;
	int32_t val;
};

static const struct lpcmp_attr attrs[] = {
	{.attr = SENSOR_ATTR_MCUX_LPCMP_POSITIVE_MUX_INPUT, .val = CONFIG_LPCMP_POSITIVE_PORT},
	{.attr = SENSOR_ATTR_MCUX_LPCMP_NEGATIVE_MUX_INPUT, .val = CONFIG_LPCMP_NEGATIVE_PORT},

	{.attr = SENSOR_ATTR_MCUX_LPCMP_DAC_ENABLE, .val = 1},
	{.attr = SENSOR_ATTR_MCUX_LPCMP_DAC_HIGH_POWER_MODE_ENABLE, .val = 0},
	{.attr = SENSOR_ATTR_MCUX_LPCMP_DAC_REFERENCE_VOLTAGE_SOURCE, .val = 0},
	{.attr = SENSOR_ATTR_MCUX_LPCMP_DAC_OUTPUT_VOLTAGE, .val = (0xFF >> 1)},

	{.attr = SENSOR_ATTR_MCUX_LPCMP_SAMPLE_ENABLE, .val = 0},
	{.attr = SENSOR_ATTR_MCUX_LPCMP_FILTER_COUNT, .val = 7},
	{.attr = SENSOR_ATTR_MCUX_LPCMP_FILTER_PERIOD, .val = (0xFF >> 1)},

	{.attr = SENSOR_ATTR_MCUX_LPCMP_COUTA_WINDOW_ENABLE, .val = 0},
	{.attr = SENSOR_ATTR_MCUX_LPCMP_COUTA_WINDOW_SIGNAL_INVERT_ENABLE, .val = 0},
	{.attr = SENSOR_ATTR_MCUX_LPCMP_COUTA_SIGNAL, .val = 0},
	{.attr = SENSOR_ATTR_MCUX_LPCMP_COUT_EVENT_TO_CLOSE_WINDOW, .val = 0},
};

#ifdef CONFIG_MCUX_LPCMP_TRIGGER
static const int16_t triggers[] = {
	SENSOR_TRIG_MCUX_LPCMP_OUTPUT_RISING,
	SENSOR_TRIG_MCUX_LPCMP_OUTPUT_FALLING,
};
#endif /* CONFIG_MCUX_LPCMP_TRIGGER */

static void lpcmp_input_handler(bool above_threshold)
{
	if (above_threshold) {
		printf("LPCMP input above threshold\n");
	} else {
		printf("LPCMP input below threshold\n");
	}
}

#ifdef CONFIG_MCUX_LPCMP_TRIGGER
static void lpcmp_trigger_handler(const struct device *dev, const struct sensor_trigger *trigger)
{
	ARG_UNUSED(dev);

	lpcmp_input_handler((int16_t)trigger->type == SENSOR_TRIG_MCUX_LPCMP_OUTPUT_RISING);
}
#endif /* CONFIG_MCUX_LPCMP_TRIGGER */

int main(void)
{
#ifdef CONFIG_MCUX_LPCMP_TRIGGER
	struct sensor_trigger trigger[ARRAY_SIZE(triggers)] = {
		[0] = {
				.chan = SENSOR_CHAN_MCUX_LPCMP_OUTPUT,
				.type = triggers[0],
			},
		[1] = {
				.chan = SENSOR_CHAN_MCUX_LPCMP_OUTPUT,
				.type = triggers[1],
			}
		};
#endif /* CONFIG_MCUX_LPCMP_TRIGGER */
	const struct device *const lpcmp = DEVICE_DT_GET(DT_NODELABEL(lpcmp0));
	struct sensor_value val;
	int err;

	if (!device_is_ready(lpcmp)) {
		printf("LPCMP device not ready\n");
		return 0;
	}

	/* Set LPCMP attributes */
	val.val2 = 0;
	for (uint8_t i = 0; i < ARRAY_SIZE(attrs); i++) {
		val.val1 = attrs[i].val;
		err = sensor_attr_set(lpcmp, SENSOR_CHAN_MCUX_LPCMP_OUTPUT, attrs[i].attr, &val);
		if (err) {
			printf("failed to set attribute %d (err %d)\n", i, err);
			return 0;
		}
	}

	/* Delay for analog components (DAC, CMP, ...) to settle */
	k_sleep(K_MSEC(1));

#ifdef CONFIG_MCUX_LPCMP_TRIGGER
	/* Set LPCMP triggers */
	for (uint8_t i = 0; i < ARRAY_SIZE(triggers); i++) {
		err = sensor_trigger_set(lpcmp, &trigger[i], lpcmp_trigger_handler);
		if (err) {
			printf("failed to set trigger %d (err %d)\n", i, err);
			return 0;
		}
	}

	/* Await trigger */
	while (true) {
		k_sleep(K_MSEC(1));
	}
#else  /* !CONFIG_MCUX_LPCMP_TRIGGER */
	err = sensor_sample_fetch(lpcmp);
	if (err) {
		printf("failed to fetch sample (err %d)\n", err);
		return 0;
	}

	err = sensor_channel_get(lpcmp, SENSOR_CHAN_MCUX_LPCMP_OUTPUT, &val);
	if (err) {
		printf("failed to get channel (err %d)\n", err);
		return 0;
	}

	lpcmp_input_handler(val.val1 == 1);
#endif /* CONFIG_MCUX_LPCMP_TRIGGER */

	return 0;
}
```
