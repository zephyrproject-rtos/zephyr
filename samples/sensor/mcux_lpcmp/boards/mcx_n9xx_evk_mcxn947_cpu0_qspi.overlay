/*
 * Copyright 2025 NXP
 *
 * SPDX-License-Identifier: Apache-2.0
 */

/*
 * Sample requires node labeled lpcmp0, map to lpcmp2
 * Apply input voltage to LPCMP on header J1-pin 14 (P1_2)
 */
/delete-node/ &lpcmp0;

lpcmp0: &lpcmp2 {
	#io-channel-cells = <2>;
	function-clock = "CMP_CLOCK";
	pinctrl-0 = <&pinmux_lpcmp0>;
	pinctrl-names = "default";
	status = "okay";
	positive-mux-input = "IN0";
	negative-mux-input = "DAC";
};
