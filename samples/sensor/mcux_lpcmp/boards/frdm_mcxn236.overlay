/*
 * Copyright 2024 NXP
 *
 * SPDX-License-Identifier: Apache-2.0
 */

&lpcmp0 {
	/delete-property/ compatible;
	/delete-property/ clocks;
	#io-channel-cells = <2>;
	compatible = "nxp,sensor-lpcmp";
	function-clock = "CMP_CLOCK";
	pinctrl-0 = <&pinmux_lpcmp0>;
	pinctrl-names = "default";
	status = "okay";
};
