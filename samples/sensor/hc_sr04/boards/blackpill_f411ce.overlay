/*
 * Copyright (c) 2026, Javad Rahimipetroudi <javad321javad@gmail.com>
 *
 * SPDX-License-Identifier: Apache-2.0
 */

/ {
	hc_sr04: hc_sr04 {
		compatible = "hc-sr04";
		trigger-gpios = <&gpioa 4 GPIO_ACTIVE_HIGH>;
		echo-gpios = <&gpioa 5 GPIO_ACTIVE_HIGH>;
		status = "okay";
	};
};
