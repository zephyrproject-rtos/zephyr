## samples/sensor/thermometer/boards/max32655evkit_max32655_m4.conf
```kconfig
# Copyright (c) 2024 Analog Devices, Inc.
# SPDX-License-Identifier: Apache-2.0
CONFIG_LOG=y
CONFIG_SENSOR_LOG_LEVEL_DBG=y
CONFIG_SAMPLES_SENSOR_THERMOMETER_ALERT=n
```

## samples/sensor/thermometer/sample.yaml
```yaml
sample:
  name: Temperature Sensor
common:
  filter: dt_alias_exists("ambient-temp0")
  harness: console
tests:
  sample.sensor.thermometer:
    tags: sensors
    harness_config:
      fixture: sensor_ambient_temp
      type: multi_line
      regex:
        - "Thermometer Example (.*)"
        - "Temperature device is 0x[0-9|a-z]+, name is [a-z|0-9]+@[a-z|0-9]+"
        - "Temperature is [0-9|.]+°C"
    integration_platforms:
      - nrf52840dk/nrf52840   # mcp9700a
      - frdm_k22f             # tcn75a
      - robokit1              # ntc_thermistor
      - adi_eval_adin1110ebz  # adt7420
    extra_args:
      - platform:mimxrt1180_evk/mimxrt1189/cm33:SHIELD=p3t1755dp_ard_i2c
      - platform:mimxrt1180_evk/mimxrt1189/cm7:SHIELD=p3t1755dp_ard_i2c
      - platform:frdm_mcxn236/mcxn236:SHIELD=p3t1755dp_ard_i2c
      - platform:mimxrt700_evk/mimxrt798s/cm33_cpu0:SHIELD=p3t1755dp_ard_i2c
  sample.sensor.thermometer_i3c:
    tags: sensors
    harness_config:
      fixture: sensor_ambient_temp_i3c
      type: multi_line
      regex:
        - "Thermometer Example (.*)"
        - "Temperature device is 0x[0-9|a-z]+, name is [a-z|0-9]+@[a-z|0-9]+"
        - "Temperature is [0-9|.]+°C"
    integration_platforms:
      - frdm_mcxn947/mcxn947/cpu0 # p3t1755
    depends_on:
      - i3c
    filter: dt_alias_exists("ambient-temp0")
    extra_args:
      - platform:mimxrt1180_evk/mimxrt1189/cm33:SHIELD=p3t1755dp_ard_i3c
      - platform:mimxrt1180_evk/mimxrt1189/cm7:SHIELD=p3t1755dp_ard_i3c
      - platform:frdm_mcxn236/mcxn236:SHIELD=p3t1755dp_ard_i3c
```

## samples/sensor/ti_hdc/sample.yaml
```yaml
sample:
  name: TI HDC Humidity/Temperature Sensor
tests:
  sample.sensor.ti_hdc:
    harness: sensor
    platform_allow:
      - reel_board/nrf52840
      - nucleo_l496zg/stm32l496xx
    integration_platforms:
      - reel_board/nrf52840
    tags: sensors
    depends_on: i2c
```

## samples/sensor/tmp100/Kconfig
```kconfig
menu "Zephyr"
source "Kconfig.zephyr"
endmenu

module = TMP100
module-str = TMP100
source "subsys/logging/Kconfig.template.log_config"
############################################
# The below line is the important addition #
############################################
rsource "../../../drivers/sensor/tmp100/Kconfig"
```

## samples/sensor/tmp100/sample.yaml
```yaml
sample:
  name: TMP100 Sensor Sample
tests:
  sample.sensor.tmp100:
    harness: console
    tags: sensors
    depends_on: i2c
    filter: dt_compat_enabled("ti,tmp100")
    harness_config:
        type: one_line
        regex:
            - "temp is (.*)"
        fixture: fixture_i2c_tmp100
```

## samples/sensor/tmp1075/sample.yaml
```yaml
sample:
  name: TMP 1075 Temperature Sensor Sample
tests:
  sample.sensor.tmp1075:
    harness: console
    tags: sensors
    depends_on:
      - i2c
      - gpio
    filter: dt_compat_enabled("ti,tmp1075")
    harness_config:
      type: multi_line
      regex:
        - "Temperature: *.*C"
```

## samples/sensor/tmp108/Kconfig
```kconfig
#
#  Copyright (c) 2021 Jimmy Johnson <catch22@fastmail.net>
#
# SPDX-License-Identifier: Apache-2.0
#

mainmenu "TMP108 sample application"

config APP_REPORT_TEMP_ALERTS
	bool "Report over and under temperature alerts"
	default n

config APP_ENABLE_ONE_SHOT
	bool "One shot low power mode"
	default n
	help
		One shot requires a callback to be invoked after the tmp108 has
		woken up and taken a temperature reading, calling sample_fetch
		starts this process. Set this to enable 1 shot mode example.

config APP_TEMP_ALERT_HIGH_THRESH
	int "RH [%] high threshold for alert trigger in celsius"
	range 0 50
	default 26
	help
		Set this to enable alerts for high temperatures
		although this will work with one shot enabled,
		it requires continuous monitoring mode to be enabled
		to work in real time.
		See spec sheet for more details.

config APP_TEMP_ALERT_LOW_THRESH
	int "RH [%] low threshold for alert trigger in celsius"
	range 0 50
	default 18
	help
		Set this to enable alerts for low temperatures
		although this will work with one shot enabled,
		it requires continuous monitoring mode to be enabled
		to work in real time.
		See spec sheet for more details.

source "Kconfig.zephyr"
```

## samples/sensor/tmp108/sample.yaml
```yaml
sample:
  name: TMP 108 Temperature Sensor Sample
tests:
  sample.sensor.tmp108:
    harness: console
    tags: sensors
    depends_on:
      - i2c
      - gpio
    filter: dt_compat_enabled("ti,tmp108")
    harness_config:
      type: multi_line
      regex:
        - "temperature is *.*C"
```

## samples/sensor/tmp112/sample.yaml
```yaml
sample:
  name: TMP112 Sensor Sample
tests:
  sample.sensor.tmp112:
    harness: console
    tags: sensors
    depends_on: i2c
    platform_allow:
      - frdm_k64f
    harness_config:
      type: one_line
      regex:
        - "temp is (.*)"
      fixture: fixture_i2c_tmp112
```

## samples/sensor/tmp116/sample.yaml
```yaml
sample:
  name: TI TMP116 Sensor Sample
tests:
  sample.sensor.tmp116:
    harness: console
    platform_allow: nucleo_f401re/stm32f401xe
    integration_platforms:
      - nucleo_f401re/stm32f401xe
    tags: sensors
    depends_on: i2c
    harness_config:
      type: one_line
      regex:
        - "temp is (.*) oC"
      fixture: fixture_i2c_tmp116
```

## samples/sensor/tmp11x/sample.yaml
```yaml
sample:
  name: TI TMP11X Sensor Sample
tests:
  sample.sensor.tmp11x:
    harness: console
    platform_allow: nucleo_f401re
    integration_platforms:
      - nucleo_f401re
    tags: sensors
    depends_on: i2c
    harness_config:
      type: one_line
      regex:
        - "temp is (.*) oC"
      fixture: fixture_i2c_tmp11x
```

## samples/sensor/tofsense/sample.yaml
```yaml
sample:
  name: Sample for Nooploop TOFSense Time Of Flight sensor
tests:
  sample.sensor.tofsense:
    depends_on:
      - uart
    tags:
      - sensors
    filter: dt_alias_exists("tof")
    harness: console
    harness_config:
      type: multi_line
      regex:
        - "distance is .*"
```

## samples/sensor/vcnl4040/sample.yaml
```yaml
sample:
  name: VCNL4040 Sensor Sample
tests:
  sample.sensor.vcnl4040:
    harness: sensor
    platform_allow: adafruit_feather_stm32f405
    integration_platforms:
      - adafruit_feather_stm32f405
    tags: sensors
    filter: dt_compat_enabled("vishay,vcnl4040")
```

## samples/sensor/veaa_x_3/Kconfig
```kconfig
#
#  Copyright (c) 2024 Vitrolife A/S
#
# SPDX-License-Identifier: Apache-2.0
#

mainmenu "VEAA sample application"

config SAMPLE_USE_SHELL
	bool "Use sensor shell and disable loop"
	default n
	select SHELL
	select SENSOR_SHELL

config SAMPLE_LOOP_INTERVAL
	int "Sample loop delay in milliseconds"
	default 200

config SAMPLE_LOOP_INCREMENT
	int "Sample kPa increment per loop"
	default 1

source "Kconfig.zephyr"
```

## samples/sensor/veaa_x_3/sample.yaml
```yaml
sample:
  name: VEAA-X-3 sensor sample
tests:
  sample.sensor.veaa_x_3:
    harness: sensor
    tags: sensors
    filter: dt_compat_enabled("festo,veaa-x-3")
    depends_on:
      - adc
      - dac
```

## samples/sensor/veml7700/sample.yaml
```yaml
sample:
  name: veml7700 ambient light sensor
common:
  harness: console
  integration_platforms:
    - b_u585i_iot02a
  filter: dt_compat_enabled("vishay,veml7700")
  tags: sensors
  depends_on:
    - i2c
    - veml7700
  harness_config:
    type: multi_line
    ordered: true
    regex:
      - "Observation:(.*)"
tests:
  sample.sensor.veml7700:
    extra_configs:
  sample.sensor.veml7700.trigger:
    extra_configs:
    platform_exclude:
      - b_u585i_iot02a
```

## samples/sensor/vl53l0x/sample.yaml
```yaml
sample:
  name: Sample for MEMS sensors VL53L0X
tests:
  sample.sensor.vl53l0x:
    build_only: true
    depends_on:
      - i2c
      - vl53l0x
    tags: sensors
    integration_platforms:
      - b_l4s5i_iot01a
```

## samples/sensor/vl53l1x/sample.yaml
```yaml
sample:
  name: Sample for MEMS sensors VL53L1X
tests:
  sample.sensor.vl53l1x:
    build_only: true
    depends_on: i2c vl53l1x
    tags: sensors
```

## samples/sensor/vl6180x/sample.yaml
```yaml
sample:
  name: Sample for MEMS sensors VL6180X
tests:
  sample.sensor.vl6180x:
    build_only: true
    depends_on: i2c vl6180x
    tags: sensors
```

## samples/sensor/wsen_hids/sample.yaml
```yaml
sample:
  name: WSEN-HIDS Sensor Sample
tests:
  sample.sensor.wsen-hids:
    harness: sensor
    tags: sensors
    depends_on: i2c
    filter: dt_compat_enabled("we,wsen-hids")
```

## samples/sensor/wsen_itds/sample.yaml
```yaml
sample:
  name: WSEN-ITDS Sensor Sample
tests:
  sample.sensor.wsen-itds:
    harness: sensor
    tags: sensors
    depends_on:
      - i2c
      - gpio
    filter: dt_compat_enabled("we,wsen-itds")
```

## samples/sensor/wsen_pads/sample.yaml
```yaml
sample:
  name: WSEN-PADS Sensor Sample
tests:
  sample.sensor.wsen-pads:
    harness: sensor
    tags: sensors
    depends_on: i2c pads
    filter: dt_compat_enabled("we,wsen-pads")
```

## samples/sensor/wsen_pdus/sample.yaml
```yaml
sample:
  name: WSEN-PDUS Sensor Sample
tests:
  sample.sensor.wsen-pdus:
    harness: sensor
    tags: sensors
    depends_on: i2c pdus
    filter: dt_compat_enabled("we,wsen-pdus")
```

## samples/sensor/wsen_tids/sample.yaml
```yaml
sample:
  name: WSEN-TIDS Sensor Sample
tests:
  sample.sensor.wsen-tids:
    harness: sensor
    tags: sensors
    depends_on: i2c tids
    filter: dt_compat_enabled("we,wsen-tids")
```

## samples/shields/lmp90100_evb/rtd/sample.yaml
```yaml
sample:
  description: Demonstration of the LMP90100 EVB with RTD sensor
  name: LMP90100 EVB RTD
tests:
  sample.shields.lmp90100_evb.rtd:
    platform_allow: frdm_k64f
    harness: shield
    tags: shield
    depends_on: arduino_spi
```
