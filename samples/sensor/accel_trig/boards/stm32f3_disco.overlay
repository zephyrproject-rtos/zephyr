/*
 * Copyright (c) 2024, Pierrick Curt.
 *
 * SPDX-License-Identifier: Apache-2.0
 */

#include <zephyr/dt-bindings/sensor/lis2dw12.h>

/ {
	aliases {
		accel0 = &lis2dw12_accel;
	};
};

&i2c2 {
	pinctrl-0 = <&i2c2_scl_pa9 &i2c2_sda_pa10>;
	pinctrl-names = "default";
	status = "okay";
	clock-frequency = <I2C_BITRATE_FAST>;

	lis2dw12_accel: lis2dw12@19 {
		compatible = "st,lis2dw12";
		reg = <0x19>;
		odr = <400>;
		tap-mode = <LIS2DW12_DT_SINGLE_DOUBLE_TAP>;
		tap-threshold = <12>, <12>, <12>;
		power-mode = <LIS2DW12_DT_HP_MODE>;
		tap-shock = <0x03>;
		tap-quiet = <0x03>;
		tap-latency = <0x03>;
		irq-gpios = <&gpioe 6 GPIO_ACTIVE_HIGH>;
	};
};
