/*
 * Copyright (c) 2022 Würth Elektronik eiSos GmbH & Co. KG
 *
 * SPDX-License-Identifier: Apache-2.0
 */

&i2c0 {
	pads@5d {
		compatible = "we,wsen-pads";
		reg = <0x5d>;
		label = "PADS";
		drdy-gpios = <&gpio0 24 GPIO_ACTIVE_HIGH>;
	};
};

// &spi1 {
// 	cs-gpios = <&gpio0 25 GPIO_ACTIVE_LOW>;

// 	itds@0 {
// 		compatible = "we,wsen-pads";
// 		reg = <0x0>;
// 		spi-max-frequency = <8000000>;
// 		label = "PADS";
// 		drdy-gpios = <&gpio0 24 GPIO_ACTIVE_HIGH>;
// 	};
// };