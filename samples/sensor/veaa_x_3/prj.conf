## CMakeLists.txt
```
# SPDX-License-Identifier: Apache-2.0

cmake_minimum_required(VERSION 3.28.0)

find_package(Zephyr REQUIRED HINTS $ENV{ZEPHYR_BASE})
project(app)

target_sources(app PRIVATE src/main.c)
```

## Kconfig
```
#
#  Copyright (c) 2025 Prevas A/S
#
# SPDX-License-Identifier: Apache-2.0
#

mainmenu "VEAA sample application"

config SAMPLE_USE_SHELL
	bool "Use sensor shell and disable loop"
	select SHELL
	select SENSOR_SHELL

config SAMPLE_LOOP_INTERVAL
	int "Sample loop delay in milliseconds"
	default 200

config SAMPLE_LOOP_INCREMENT
	int "Sample kPa increment per loop"
	default 1

source "Kconfig.zephyr"
```

## sample.yaml
```
sample:
  name: VEAA-X-3 sensor sample
tests:
  sample.sensor.veaa_x_3:
    harness: sensor
    tags: sensors
    filter: dt_compat_enabled("festo,veaa-x-3")
    depends_on:
      - adc
      - dac
    integration_platforms:
      - nucleo_h563zi
```

## prj.conf
```kconfig
CONFIG_ADC=y
CONFIG_DAC=y
CONFIG_SENSOR=y
CONFIG_LOG=y
```

## boards/nucleo_h563zi.overlay
```dts
/*
 * SPDX-License-Identifier: Apache-2.0
 *
 * Copyright (c) 2025 Prevas A/S
 */

/* spi1 sck conflicts with dac1 channel 3 */
/delete-node/ &spi1;

/ {
	test_veaa_x_3: test_veaa_x_3 {
		compatible = "festo,veaa-x-3";
		io-channels = <&adc1 3>;
		dac = <&dac1>;
		dac-channel-id = <2>;
		dac-resolution = <12>;
		pressure-range-type = "D2";
		status = "okay";
	};
};

&adc1 {
	#address-cells = <1>;
	#size-cells = <0>;

	channel@3 {
		reg = <3>;
		zephyr,gain = "ADC_GAIN_1";
		zephyr,reference = "ADC_REF_INTERNAL";
		zephyr,acquisition-time = <ADC_ACQ_TIME_DEFAULT>;
		zephyr,resolution = <12>;
	};
};
```

## src/main.c
```c
/*
 * Copyright (c) 2025 Prevas A/S
 *
 * SPDX-License-Identifier: Apache-2.0
 */

#include <zephyr/device.h>
#include <zephyr/kernel.h>
#include <zephyr/sys/printk.h>
#include <zephyr/drivers/sensor.h>
#include <zephyr/drivers/sensor/veaa_x_3.h>

static const struct device *const dev = DEVICE_DT_GET_ONE(festo_veaa_x_3);

int main(void)
{
	int rc;
	struct sensor_value range, setpoint, pressure;

	printk("Testing %s\n", dev->name);

	if (!device_is_ready(dev)) {
		printk("%s not ready\n", dev->name);
		return -ENODEV;
	}

	rc = sensor_attr_get(dev, SENSOR_CHAN_PRESS,
			     (enum sensor_attribute)SENSOR_ATTR_VEAA_X_3_RANGE, &range);
	if (rc != 0) {
		printk("get range failed: %d\n", rc);
		return rc;
	}
	printk("Valve range: %u to %u kPa\n", range.val1, range.val2);

	if (IS_ENABLED(CONFIG_SAMPLE_USE_SHELL)) {
		printk("Loop is disabled. Use the `sensor` command to test %s", dev->name);
		return 0;
	}

	setpoint.val1 = range.val1;
	while (1) {
		rc = sensor_attr_set(dev, SENSOR_CHAN_PRESS,
				     (enum sensor_attribute)SENSOR_ATTR_VEAA_X_3_SETPOINT,
				     &setpoint);
		if (rc != 0) {
			printk("Set setpoint to %u failed: %d\n", setpoint.val1, rc);
		}

		/* Sleep before get to allow DAC and ADC to stabilize */
		k_msleep(CONFIG_SAMPLE_LOOP_INTERVAL);

		rc = sensor_sample_fetch(dev);
		if (rc != 0) {
			printk("Fetch sample failed: %d", rc);
		}

		rc = sensor_channel_get(dev, SENSOR_CHAN_PRESS, &pressure);
		if (rc != 0) {
			printk("Get sample failed: %d", rc);
		}

		printk("Setpoint: %4u kPa, actual: %4u kPa\n", setpoint.val1, pressure.val1);

		setpoint.val1 += CONFIG_SAMPLE_LOOP_INCREMENT;
		if (setpoint.val1 > range.val2) {
			setpoint.val1 = range.val1;
		}
	}

	return 0;
}
```
