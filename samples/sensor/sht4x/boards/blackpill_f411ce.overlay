/*
 * Copyright (c) 2025 Antmicro <www.antmicro.com>
 *
 * SPDX-License-Identifier: Apache-2.0
 */

&i2c1 {
	clock-frequency = <I2C_BITRATE_FAST>;
	status = "okay";

	sht4x@44 {
		compatible = "sensirion,sht4x";
		reg = <0x44>;
		repeatability = <2>;
		status = "okay";
	};
};
