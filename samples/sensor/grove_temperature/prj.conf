## CMakeLists.txt
```
# SPDX-License-Identifier: Apache-2.0

cmake_minimum_required(VERSION 3.28.0)
find_package(Zephyr REQUIRED HINTS $ENV{ZEPHYR_BASE})
project(grove_temperature)

FILE(GLOB app_sources src/*.c)
target_sources(app PRIVATE ${app_sources})
```

## sample.yaml
```
common:
  filter: CONFIG_FULL_LIBC_SUPPORTED
sample:
  name: Grove Temperature Sensor
tests:
  sample.sensor.grove_temperature:
    min_flash: 33
    tags:
      - drivers
      - sensor
      - grove
      - temperature
    platform_allow: nrf52dk/nrf52832
    integration_platforms:
      - nrf52dk/nrf52832
    harness: grove
    depends_on: adc
```

## prj.conf
```kconfig
CONFIG_ADC=y
CONFIG_SENSOR=y
CONFIG_GROVE_SENSORS=y
CONFIG_GROVE_TEMPERATURE_SENSOR=y
CONFIG_NEWLIB_LIBC=y
CONFIG_NEWLIB_LIBC_FLOAT_PRINTF=y
CONFIG_CBPRINTF_FP_SUPPORT=y
```

## boards/nrf52_pca10040.overlay
```dts
/*
 * Copyright (c) 2019 Nordic Semiconductor ASA
 *
 * SPDX-License-Identifier: Apache-2.0
 */

/ {
	ntc {
		label = "GTS";
		compatible = "grove,temperature";
		io-channels = <&arduino_adc 0>;
	};
};
```

## boards/nrf52dk_nrf52832.overlay
```dts
/*
 * Copyright (c) 2019 Nordic Semiconductor ASA
 *
 * SPDX-License-Identifier: Apache-2.0
 */

/ {
	ntc {
		compatible = "seeed,grove-temperature";
		io-channels = <&arduino_adc 0>;
	};
};
```

## src/main.c
```c
/*
 * Copyright (c) 2016 Intel Corporation
 *
 * SPDX-License-Identifier: Apache-2.0
 */

#include <zephyr/kernel.h>
#include <zephyr/init.h>
#include <stdio.h>
#include <zephyr/drivers/sensor.h>

#ifdef CONFIG_GROVE_LCD_RGB
#include <zephyr/drivers/misc/grove_lcd/grove_lcd.h>
#include <string.h>
#endif

#define SLEEP_TIME	K_MSEC(1000)

int main(void)
{
	const struct device *const dev = DEVICE_DT_GET_ONE(seeed_grove_temperature);
	struct sensor_value temp;
	int read;

	if (!device_is_ready(dev)) {
		printk("sensor: device not ready.\n");
		return 0;
	}

#ifdef CONFIG_GROVE_LCD_RGB
	const struct device *glcd = DEVICE_DT_GET_ANY(seeed_grove_lcd_rgb);

	if (!device_is_ready(glcd)) {
		printf("Failed to get Grove LCD\n");
		return 0;
	}

	/* configure LCD */
	glcd_function_set(glcd, GLCD_FS_ROWS_2 | GLCD_FS_DOT_SIZE_LITTLE |
			  GLCD_FS_8BIT_MODE);
	glcd_display_state_set(glcd, GLCD_DS_DISPLAY_ON);
#endif

	while (1) {

		read = sensor_sample_fetch(dev);
		if (read) {
			printk("sample fetch error\n");
			continue;
		}
		sensor_channel_get(dev, SENSOR_CHAN_AMBIENT_TEMP, &temp);
#ifdef CONFIG_GROVE_LCD_RGB
		char row[16];

		/* clear LCD */
		(void)memset(row, ' ', sizeof(row));
		glcd_cursor_pos_set(glcd, 0, 0);
		glcd_print(glcd, row, sizeof(row));
		glcd_cursor_pos_set(glcd, 0, 1);
		glcd_print(glcd, row, sizeof(row));

		/* display temperature on LCD */
		glcd_cursor_pos_set(glcd, 0, 0);
#ifdef CONFIG_REQUIRES_FLOAT_PRINTF
		sprintf(row, "T:%.2f%cC",
			sensor_value_to_double(&temp),
			223 /* degree symbol */);
#else
		sprintf(row, "T:%d%cC", temp.val1,
			223 /* degree symbol */);
#endif
		glcd_print(glcd, row, strlen(row));

#endif

#ifdef CONFIG_REQUIRES_FLOAT_PRINTF
		printf("Temperature: %.2f C\n", sensor_value_to_double(&temp));
#else
		printk("Temperature: %d\n", temp.val1);
#endif
		k_sleep(SLEEP_TIME);
	}
}
```
