/*
 * Copyright (c) 2019 Nordic Semiconductor ASA
 *
 * SPDX-License-Identifier: Apache-2.0
 */

/ {
	ntc {
		label = "GTS";
		compatible = "grove,temperature";
		io-channels = <&arduino_adc 0>;
	};
};
