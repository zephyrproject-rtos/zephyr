## CMakeLists.txt
```
# SPDX-License-Identifier: Apache-2.0

cmake_minimum_required(VERSION 3.28.0)

find_package(Zephyr REQUIRED HINTS $ENV{ZEPHYR_BASE})
project(mcux_acmp)

FILE(GLOB app_sources src/*.c)
target_sources(app PRIVATE ${app_sources})
```

## sample.yaml
```
sample:
  description: Demonstration of the NXP MCUX ACMP sensor driver
  name: NXP MCUX ACMP sample
common:
  platform_allow:
    - twr_ke18f
    - frdm_ke17z
    - frdm_ke17z512
    - mimxrt1170_evk/mimxrt1176/cm7
    - mimxrt1170_evk/mimxrt1176/cm4
    - mimxrt1180_evk/mimxrt1189/cm33
    - mimxrt1180_evk/mimxrt1189/cm7
    - mimxrt700_evk/mimxrt798s/cm33_cpu0
    - mimxrt700_evk/mimxrt798s/cm33_cpu1
  integration_platforms:
    - twr_ke18f
  tags:
    - drivers
    - sensor
tests:
  sample.sensor.mcux_acmp:
    harness: console
    harness_config:
      type: multi_line
      ordered: true
      regex:
        - "Adjust ACMP input voltage by turning the potentiometer"
        - "ACMP input [a-z]* threshold"
  sample.sensor.mcux_acmp.no_trigger:
    build_only: true
    extra_configs:
      - CONFIG_SENSOR_MCUX_ACMP_TRIGGER=n
```

## prj.conf
```kconfig
CONFIG_SENSOR=y
CONFIG_SENSOR_MCUX_ACMP_TRIGGER=y
```

## boards/frdm_imxrt1152.overlay
```dts
/*
 * SPDX-FileCopyrightText: Copyright 2026 NXP
 *
 * SPDX-License-Identifier: Apache-2.0
 */

/* ACMP3 IN1 is GPIO_AD_28 on J11-12 (Arduino D13) */
&pinctrl {
	acmp3_default: acmp3_default {
		group0 {
			pinmux = <&iomuxc_gpio_ad_28_acmp3_in1>;
			drive-strength = "high";
		};
	};
};

&acmp3 {
	pinctrl-0 = <&acmp3_default>;
	pinctrl-names = "default";
	status = "okay";
};
```

## boards/frdm_ke15z.overlay
```dts
/*
 * Copyright 2026 NXP
 *
 * SPDX-License-Identifier: Apache-2.0
 */

&pinctrl {
	acmp0_default: acmp0_default {
		group0 {
			pinmux = <ACMP0_IN4_PTC3>;
			drive-strength = "low";
			slew-rate = "slow";
		};
	};
};

&cmp0 {
	status = "okay";
	pinctrl-0 = <&acmp0_default>;
	pinctrl-names = "default";
};
```

## boards/frdm_ke17z.overlay
```dts
/*
 * Copyright 2024 NXP
 *
 * SPDX-License-Identifier: Apache-2.0
 */

&pinctrl {
	acmp0_default: acmp0_default {
		group0 {
			pinmux = <ACMP0_IN4_PTC3>;
			drive-strength = "low";
			slew-rate = "slow";
		};
	};
};

&cmp0 {
	pinctrl-0 = <&acmp0_default>;
	pinctrl-names = "default";
	status = "okay";
};
```

## boards/mimxrt1170_evk_mimxrt1176_cm7.overlay
```dts
/*
 * Copyright 2022 NXP
 *
 * SPDX-License-Identifier: Apache-2.0
 */

&pinctrl {
	acmp1_default: acmp1_default {
		group0 {
			pinmux = <&iomuxc_gpio_ad_01_acmp1_in2>;
			drive-strength = "high";
			bias-pull-up;
			slew-rate = "fast";
		};
	};
};

&acmp1 {
	pinctrl-0 = <&acmp1_default>;
	pinctrl-names = "default";
	status = "okay";
};
```

## boards/mimxrt1180_evk_mimxrt1189_cm7.overlay
```dts
/*
 * Copyright 2024 NXP
 *
 * SPDX-License-Identifier: Apache-2.0
 */

&pinctrl {
	acmp1_default: acmp1_default {
		group0 {
			pinmux = <&iomuxc_gpio_ad_01_acmp1_in2>;
			drive-strength = "high";
			bias-pull-up;
			slew-rate = "fast";
		};
	};
};

&acmp1 {
	pinctrl-0 = <&acmp1_default>;
	pinctrl-names = "default";
	status = "okay";
};
```

## boards/twr_ke18f.overlay
```dts
/*
 * Copyright (c) 2020 Vestas Wind Systems A/S
 *
 * SPDX-License-Identifier: Apache-2.0
 */

&pinctrl {
	cmp2_default: cmp2_default {
		group0 {
			pinmux = <ADC0_SE12_PTC14>;
			drive-strength = "low";
			slew-rate = "slow";
		};
	};
};

&cmp2 {
	pinctrl-0 = <&cmp2_default>;
	pinctrl-names = "default";
	status = "okay";
};
```

## src/main.c
```c
/*
 * Copyright (c) 2020 Vestas Wind Systems A/S
 *
 * SPDX-License-Identifier: Apache-2.0
 */

#include <zephyr/device.h>
#include <zephyr/drivers/sensor.h>
#include <zephyr/drivers/sensor/mcux_acmp.h>
#include <zephyr/kernel.h>

#include <stdio.h>

#ifdef CONFIG_BOARD_TWR_KE18F
#define ACMP_NODE  DT_NODELABEL(cmp2)
#define ACMP_POSITIVE 5
#define ACMP_NEGATIVE 5
#define ACMP_DAC_VREF 0
#elif (defined(CONFIG_BOARD_MIMXRT1170_EVK) || defined(CONFIG_BOARD_MIMXRT1180_EVK))
#define ACMP_NODE  DT_NODELABEL(acmp1)
#define ACMP_POSITIVE 2
#define ACMP_NEGATIVE 7
/* Select Vin2. Vin1 is not used and tied to ground on this chip. Vin2 is from VDDA_1P8_IN. */
#define ACMP_DAC_VREF 1
#elif defined(CONFIG_BOARD_FRDM_IMXRT1152)
#define ACMP_NODE  DT_NODELABEL(acmp3)
#define ACMP_POSITIVE 1
#define ACMP_NEGATIVE 7
/* Select Vin2. Vin1 is not used and tied to ground on this chip. Vin2 is from VDDA_1P8_IN. */
#define ACMP_DAC_VREF 1
#elif (defined(CONFIG_BOARD_FRDM_KE17Z) || defined(CONFIG_BOARD_FRDM_KE17Z512))
#define ACMP_NODE  DT_NODELABEL(cmp0)
#define ACMP_POSITIVE 4
#define ACMP_NEGATIVE 4
#define ACMP_DAC_VREF 0
#elif (defined(CONFIG_BOARD_MIMXRT700_EVK))
#define ACMP_NODE  DT_NODELABEL(acmp)
#define ACMP_POSITIVE 1
#define ACMP_NEGATIVE 7
#define ACMP_DAC_VREF 1
#else
#error Unsupported board
#endif

#define ACMP_DAC_VALUE 128

struct acmp_attr {
	int16_t attr;
	int32_t val;
};

static const struct acmp_attr attrs[] = {
#if MCUX_ACMP_HAS_INPSEL
	/* Positive input port set to MUX */
	{ .attr = SENSOR_ATTR_MCUX_ACMP_POSITIVE_PORT_INPUT, .val = 1 },
#endif
	/* Positive input channel */
	{ .attr = SENSOR_ATTR_MCUX_ACMP_POSITIVE_MUX_INPUT,
	  .val = ACMP_POSITIVE },
#if MCUX_ACMP_HAS_INNSEL
	/* Negative input port set to DAC */
	{ .attr = SENSOR_ATTR_MCUX_ACMP_NEGATIVE_PORT_INPUT, .val = 0 },
#endif
	/* Negative input channel */
	{ .attr = SENSOR_ATTR_MCUX_ACMP_NEGATIVE_MUX_INPUT,
	  .val = ACMP_NEGATIVE },
	/* DAC voltage reference */
	{ .attr = SENSOR_ATTR_MCUX_ACMP_DAC_VOLTAGE_REFERENCE,
	  .val = ACMP_DAC_VREF },
	/* DAC value */
	{ .attr = SENSOR_ATTR_MCUX_ACMP_DAC_VALUE, .val = ACMP_DAC_VALUE },
#if MCUX_ACMP_HAS_HYSTCTR
	/* Hysteresis level */
	{ .attr = SENSOR_ATTR_MCUX_ACMP_HYSTERESIS_LEVEL, .val = 3 },
#endif
#if MCUX_ACMP_HAS_DISCRETE_MODE
	/* Discrete mode */
	{ .attr = SENSOR_ATTR_MCUX_ACMP_POSITIVE_DISCRETE_MODE, .val = 1 },
#endif
#if MCUX_ACMP_HAS_OFFSET
	/* Offset level */
	{ .attr = SENSOR_ATTR_MCUX_ACMP_OFFSET_LEVEL, .val = 0 },
#endif
};

static const int16_t triggers[] = {
	SENSOR_TRIG_MCUX_ACMP_OUTPUT_RISING,
	SENSOR_TRIG_MCUX_ACMP_OUTPUT_FALLING,
};

static void acmp_input_handler(bool above_threshold)
{
	if (above_threshold) {
		printf("ACMP input above threshold\n");
	} else {
		printf("ACMP input below threshold\n");
	}
}

static void acmp_trigger_handler(const struct device *dev,
				 const struct sensor_trigger *trigger)
{
	ARG_UNUSED(dev);

	acmp_input_handler((int16_t)trigger->type ==
			   SENSOR_TRIG_MCUX_ACMP_OUTPUT_RISING);
}

int main(void)
{
	struct sensor_trigger trigger[ARRAY_SIZE(triggers)] = {
		[0] = {
				.chan = SENSOR_CHAN_MCUX_ACMP_OUTPUT,
				.type = triggers[0],
			},
		[1] = {
			.chan = SENSOR_CHAN_MCUX_ACMP_OUTPUT,
			.type = triggers[1],
		}};

	const struct device *const acmp = DEVICE_DT_GET(ACMP_NODE);
	struct sensor_value val;
	int err;
	int i;

	if (!device_is_ready(acmp)) {
		printf("ACMP device not ready");
		return 0;
	}

	/* Set ACMP attributes */
	val.val2 = 0;
	for (i = 0; i < ARRAY_SIZE(attrs); i++) {
		val.val1 = attrs[i].val;
		err = sensor_attr_set(acmp, SENSOR_CHAN_MCUX_ACMP_OUTPUT,
				      attrs[i].attr, &val);
		if (err) {
			printf("failed to set attribute %d (err %d)", i, err);
			return 0;
		}
	}

	/* Delay for analog components (DAC, CMP, ...) to settle */
	k_sleep(K_MSEC(1));

	/* Set ACMP triggers */
	for (i = 0; i < ARRAY_SIZE(triggers); i++) {
		err = sensor_trigger_set(acmp, &trigger[i], acmp_trigger_handler);
		if (err) {
			printf("failed to set trigger %d (err %d)", i, err);
			return 0;
		}
	}

	printf("Adjust ACMP input voltage by turning the potentiometer\n");

	/* Read initial state */
	err = sensor_sample_fetch(acmp);
	if (err) {
		printf("failed to fetch sample (err %d)", err);
		return 0;
	}

	err = sensor_channel_get(acmp, SENSOR_CHAN_MCUX_ACMP_OUTPUT, &val);
	if (err) {
		printf("failed to get channel (err %d)", err);
		return 0;
	}

	acmp_input_handler(val.val1 == 1);

	/* Await trigger */
	while (true) {
		k_sleep(K_MSEC(1));
	}
	return 0;
}
```
