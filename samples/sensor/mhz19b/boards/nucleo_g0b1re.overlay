/*
 * Copyright (c) 2021, G-Technologies Sdn. Bhd.
 *
 * SPDX-License-Identifier: Apache-2.0
 */

&usart1 {
	current-speed = <9600>;
	mhz19b {
		compatible = "winsen,mhz19b";
		maximum-range = <10000>;
		abc-on;
		label = "MHZ19B_2";
	};
};
