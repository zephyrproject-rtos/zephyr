## CMakeLists.txt
```
# Copyright (c) 2025 Dipak Shetty <shetty.dipak@gmx.com>
# SPDX-License-Identifier: Apache-2.0

cmake_minimum_required(VERSION 3.20.0)

find_package(Zephyr REQUIRED HINTS $ENV{ZEPHYR_BASE})
project(light_sensor)

target_sources(app PRIVATE src/main.c)
```

## prj.conf
```kconfig
CONFIG_ADC=y
CONFIG_SENSOR=y

CONFIG_REQUIRES_FULL_LIBC=y
CONFIG_CBPRINTF_FP_SUPPORT=y
CONFIG_LOG=y
```

## boards/frdm_mcxw71.overlay
```dts
/*
 * Copyright (c) 2025 Dipak Shetty <shetty.dipak@gmx.com>
 *
 * SPDX-License-Identifier: Apache-2.0
 */

#include <zephyr/dt-bindings/adc/adc.h>
#include <zephyr/dt-bindings/adc/mcux-lpadc.h>

/ {
	light-sensor {
		compatible = "everlight,als-pt19";
		io-channels = <&adc0 2>;
		load-resistor = <15000>;
	};
};

&adc0 {
	#address-cells = <1>;
	#size-cells = <0>;

	channel@2 {
		reg = <0x2>;
		zephyr,gain = "ADC_GAIN_1";
		zephyr,reference = "ADC_REF_EXTERNAL0";
		zephyr,vref-mv = <3300>;
		zephyr,acquisition-time = <ADC_ACQ_TIME_DEFAULT>;
		zephyr,resolution = <12>;
		zephyr,input-positive = <MCUX_LPADC_CH2B>;
	};
};
```

## src/main.c
```c
/*
 * Copyright (c) 2025 Dipak Shetty <shetty.dipak@gmx.com>
 *
 * SPDX-License-Identifier: Apache-2.0
 */

#include <zephyr/drivers/sensor.h>
#include <zephyr/logging/log.h>

LOG_MODULE_REGISTER(als_pt19_sample, LOG_LEVEL_DBG);

#define SLEEP_TIME K_MSEC(1000)

int main(void)
{
	const struct device *const dev = DEVICE_DT_GET_ONE(everlight_als_pt19);

	if (!device_is_ready(dev)) {
		LOG_ERR("sensor: device not ready.");
		return 0;
	}

	while (1) {
		int read;
		struct sensor_value lux;

		read = sensor_sample_fetch(dev);
		if (read) {
			LOG_ERR("sample fetch error %d", read);
			continue;
		}

		sensor_channel_get(dev, SENSOR_CHAN_LIGHT, &lux);

		LOG_INF("Illuminance reading: %.3f", sensor_value_to_double(&lux));

		k_sleep(SLEEP_TIME);
	}
	return 0;
}
```
