/*
 * Copyright (c) 2018-2019 Peter Bigot Consulting, LLC
 *
 * SPDX-License-Identifier: Apache-2.0
 */

&i2c0 { /* SDA P0.26, SCL P0.27, ALERT P1.10 */
	sht3xd@44 {
		compatible = "sensirion,sht3xd";
		reg = <0x44>;
		alert-gpios = <&gpio1 10 GPIO_ACTIVE_HIGH>;
	};
};
