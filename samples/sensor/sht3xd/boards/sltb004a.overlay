/*
 * Copyright (c) 2018-2019 Peter Bigot Consulting, LLC
 *
 * SPDX-License-Identifier: Apache-2.0
 */

&i2c0 { /* SDA H16=PC10, SCL H15=PC11, ALERT H13=PF6 */
	sht3xd@44 {
		compatible = "sensirion,sht3xd";
		reg = <0x44>;
		alert-gpios = <&gpiof 6 GPIO_ACTIVE_HIGH>;
	};
};
