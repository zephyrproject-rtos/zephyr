/*
 * Copyright (c) 2022 Würth Elektronik eiSos GmbH & Co. KG
 *
 * SPDX-License-Identifier: Apache-2.0
 */

&i2c0 {
	tids@38 {
		compatible = "we,wsen-tids";
		reg = <0x38>;
		label = "TIDS";
		int-gpios = <&gpio0 24 GPIO_ACTIVE_LOW>;
	};
};
