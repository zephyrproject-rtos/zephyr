/*
 * Copyright (c) 2025 Analog Devices Inc.
 *
 * SPDX-License-Identifier: Apache-2.0
 */

&i2c1 {
	pinctrl-0 = <&i2c1_scl_pb8 &i2c1_sda_pb9>;
	pinctrl-names = "default";
	status = "okay";
	clock-frequency = <I2C_BITRATE_FAST>;

	max30210: max30210@40 {
		status = "okay";
    	compatible = "adi,max30210";
    	reg = <0x40>;
		interrupt-gpios = <&gpiod 15 0>;
		
  };
};
