/*
 * Copyright (c) 2025 Analog Devices Inc.
 *
 * SPDX-License-Identifier: Apache-2.0
 */

&i2c1a_sda_p2_17 {
	power-source = <MAX32_VSEL_VDDIOH>;
};

&i2c1a_scl_p2_18 {
	power-source = <MAX32_VSEL_VDDIOH>;
};

&i2c1 {
	pinctrl-0 = <&i2c1a_sda_p2_17 &i2c1a_scl_p2_18>;
	pinctrl-names = "default";
	status = "okay";

	max30210: max30210@40 {
		status = "okay";
    	compatible = "adi,max30210";
    	reg = <0x40>;
		
  };
};