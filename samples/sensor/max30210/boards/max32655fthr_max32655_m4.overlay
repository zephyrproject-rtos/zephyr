/*
 * Copyright (c) 2025 Analog Devices Inc.
 *
 * SPDX-License-Identifier: Apache-2.0
 */

&i2c2_scl_p0_30 {
	power-source = <MAX32_VSEL_VDDIOH>;
};

&i2c2_sda_p0_31 {
	power-source = <MAX32_VSEL_VDDIOH>;
};

&i2c2 {
	pinctrl-0 = <&i2c2_scl_p0_30 &i2c2_sda_p0_31>;
	pinctrl-names = "default";
	status = "okay";

	max30210: max30210@40 {
		status = "okay";
    	compatible = "adi,max30210";
    	reg = <0x40>;
		interrupt-gpios = <&gpio0 20 0>;
		
  };
};
