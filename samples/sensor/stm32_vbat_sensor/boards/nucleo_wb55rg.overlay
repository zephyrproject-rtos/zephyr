/*
 * Copyright (c) 2022 STMicroelectronics
 *
 * SPDX-License-Identifier: Apache-2.0
 *
 * Application overlay for creating voltage divider device instance
 */

#include <zephyr/dt-bindings/adc/adc.h>

/ {
	stm-vbat {
		compatible = "voltage-divider";
		io-channels = <&adc1 18>;
	        full-ohms = <3>;
	        output-ohms = <1>;
		status = "okay";
	};
};

&adc1 {
	has-vbat-channel;
	vref-mv = <3300>;

	#address-cells = <1>;
	#size-cells = <0>;

	channel@12 {
		reg = <18>;
		zephyr,gain = "ADC_GAIN_1";
		zephyr,reference = "ADC_REF_INTERNAL";
		zephyr,acquisition-time = <ADC_ACQ_TIME_MAX>;
		zephyr,resolution = <12>;
	};
};
