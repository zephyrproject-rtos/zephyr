## CMakeLists.txt
```
# SPDX-License-Identifier: Apache-2.0

cmake_minimum_required(VERSION 3.20.0)
find_package(Zephyr REQUIRED HINTS $ENV{ZEPHYR_BASE})
project(stm32_vbat_sensor)

FILE(GLOB app_sources src/*.c)
target_sources(app PRIVATE ${app_sources})
```

## sample.yaml
```
sample:
  description: Usage of STM32 Vbat internal sensor
  name: stm32_vbat_sensor
tests:
  sample.sensor.stm32_vbat_sensor:
    depends_on: adc
    tags: sensors
    platform_allow: nucleo_g071rb nucleo_wb55rg
    integration_platforms:
      - nucleo_g071rb
    timeout: 10
    harness: console
    harness_config:
      type: multi_line
      ordered: true
      regex:
        - "STM32 Vbat sensor test"
        - "Current Vbat voltage: 3(.*) V"
```

## prj.conf
```kconfig
CONFIG_SENSOR=y
CONFIG_ADC=y
CONFIG_STM32_VBAT=y
CONFIG_PRINTK=y
CONFIG_CBPRINTF_FP_SUPPORT=y
```

## boards/b_u585i_iot02a.overlay
```dts
/*
 * Copyright (c) 2022 STMicroelectronics
 *
 * SPDX-License-Identifier: Apache-2.0
 *
 * Application overlay for creating vbat sensor device instance
 */

/ {
	stm-vbat {
		compatible = "st,stm32-vbat";
		ratio = <4>;
		io-channels = <&adc4 14>;
		status = "okay";
	};
};
```

## boards/nucleo_g071rb.overlay
```dts
/*
 * Copyright (c) 2022 STMicroelectronics
 *
 * SPDX-License-Identifier: Apache-2.0
 *
 * Application overlay for creating vbat sensor device instance
 */

/ {
	stm-vbat {
		compatible = "st,stm32-vbat";
		ratio = <3>;
		io-channels = <&adc1 14>;
		status = "okay";
	};
};
```

## boards/nucleo_wb55rg.overlay
```dts
/*
 * Copyright (c) 2022 STMicroelectronics
 *
 * SPDX-License-Identifier: Apache-2.0
 *
 * Application overlay for creating vbat sensor device instance
 */

/ {
	stm-vbat {
		compatible = "st,stm32-vbat";
		ratio = <3>;
		io-channels = <&adc1 18>;
		status = "okay";
	};
};

&adc1 {
	vbat-channel = <18>;
	vref-mv = <3300>;
};
```

## src/main.c
```c
/*
 * Copyright (c) 2022 STMicroelectronics
 *
 * SPDX-License-Identifier: Apache-2.0
 */

#include <zephyr/kernel.h>
#include <zephyr/device.h>
#include <zephyr/drivers/sensor.h>
#include <zephyr/sys/printk.h>

int main(void)
{
	struct sensor_value val;
	int rc;
	const struct device *const dev = DEVICE_DT_GET_ONE(st_stm32_vbat);

	if (!device_is_ready(dev)) {
		printk("VBAT sensor is not ready\n");
		return 0;
	}

	printk("STM32 Vbat sensor test\n");

	/* fetch sensor samples */
	rc = sensor_sample_fetch(dev);
	if (rc) {
		printk("Failed to fetch sample (%d)\n", rc);
		return 0;
	}

	rc = sensor_channel_get(dev, SENSOR_CHAN_VOLTAGE, &val);
	if (rc) {
		printk("Failed to get data (%d)\n", rc);
		return 0;
	}

	printk("Current Vbat voltage: %.2f V\n", sensor_value_to_double(&val));
	return 0;
}
```
