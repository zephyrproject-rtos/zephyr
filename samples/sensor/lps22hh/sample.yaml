## samples/sensor/lps22hh/sample.yaml
```yaml
sample:
  name: LPS22HH Temperature and Pressure Monitor
tests:
  sample.sensor.lps22hh:
    harness: console
    tags: sensors
    depends_on:
      - i2c
      - lps22hh
    integration_platforms:
      - sensortile_box
    harness_config:
      type: multi_line
      ordered: true
      regex:
        - "Temperature: (.*)"
        - "Pressure: (.*)"
      fixture: fixture_i2c_lps22hh
```

## samples/sensor/lps22hh_i3c/sample.yaml
```yaml
sample:
  name: LPS22HH Temperature and Pressure Monitor (using I3C)
tests:
  sample.sensor.lps22hh.i3c:
    harness: console
    tags: sensors
    depends_on:
      - i3c
    platform_allow:
      - mimxrt685_evk/mimxrt685s/cm33
    build_only: true
    harness_config:
      type: multi_line
      ordered: true
      regex:
        - "Temperature: (.*)"
        - "Pressure: (.*)"
```

## samples/sensor/lsm303dlhc/sample.yaml
```yaml
sample:
  name: LSM303DLHC Magnetometer and Accelerometer data Monitor
tests:
  sample.sensor.lsm303dlhc:
    harness: sensor
    tags: samples sensor
    pre-filter: subsys_dt_compat_enabled("i2c")
    filter: dt_compat_enabled("st,lsm303dlhc-accel")
```

## samples/sensor/lsm6dsl/sample.yaml
```yaml
sample:
  name: LSM6DSL accelerometer and gyrometer sensor
tests:
  sample.sensor.lsm6dsl:
    harness: console
    tags: sensors
    pre-filter: subsys_dt_compat_enabled("spi") and subsys_dt_compat_enabled("i2c")
    filter: dt_compat_enabled("st,lsm6dsl")
    timeout: 15
    harness_config:
      type: multi_line
      ordered: true
      regex:
        - "accel x:[-.0-9]* ms/2 y:[-.0-9]* ms/2 z:[-.0-9]* ms/2"
        - "gyro x:[-.0-9]* dps y:[-.0-9]* dps z:[-.0-9]* dps"
        - "loop:[0-9]* trig_cnt:[0-9]*"
```

## samples/sensor/lsm6dso/sample.yaml
```yaml
sample:
  name: LSM6DSO accelerometer and gyrometer sensor
tests:
  sample.sensor.lsm6dso:
    harness: console
    tags: sensors
    timeout: 15
    filter: dt_compat_enabled("st,lsm6dso")
    harness_config:
      type: multi_line
      ordered: true
      regex:
        - "accel x:[-.0-9]* ms/2 y:[-.0-9]* ms/2 z:[-.0-9]* ms/2"
        - "gyro x:[-.0-9]* rad/s y:[-.0-9]* rad/s z:[-.0-9]* rad/s"
        - "trig_cnt:[0-9]*"
```

## samples/sensor/lsm6dso_i2c_on_i3c/boards/mimxrt685_evk_cm33.conf
```kconfig
# Requires GPIO lines for interrupts,
# so disable trigger mode and use polling mode for now.
CONFIG_LSM6DSO_TRIGGER_GLOBAL_THREAD=n
CONFIG_LSM6DSO_TRIGGER_NONE=y
```

## samples/sensor/lsm6dso_i2c_on_i3c/sample.yaml
```yaml
sample:
  name: LSM6DSO accelerometer and gyrometer sensor (I2C on I3C bus)
tests:
  sample.sensor.lsm6dso.i2c_on_i3c_bus:
    harness: console
    tags: sensors
    depends_on:
      - i3c
    platform_allow:
      - mimxrt685_evk/mimxrt685s/cm33
    timeout: 15
    build_only: true
    harness_config:
      type: multi_line
      ordered: true
      regex:
        - "accel x:[-.0-9]* ms/2 y:[-.0-9]* ms/2 z:[-.0-9]* ms/2"
        - "gyro x:[-.0-9]* dps y:[-.0-9]* dps z:[-.0-9]* dps"
        - "trig_cnt:[0-9]*"
```

## samples/sensor/lsm6dsr/sample.yaml
```yaml
sample:
  name: LSM6DSR accelerometer and gyrometer sensor
tests:
  sample.sensor.lsm6dsr:
    harness: console
    tags: sensors
    depends_on: lsm6dsr
    timeout: 15
    harness_config:
      type: multi_line
      ordered: true
      regex:
        - "accel x:[-.0-9]* ms/2 y:[-.0-9]* ms/2 z:[-.0-9]* ms/2"
        - "gyro x:[-.0-9]* dps y:[-.0-9]* dps z:[-.0-9]* dps"
        - "loop:[0-9]* trig_cnt:[0-9]*"
```

## samples/sensor/ltc4162/sample.yaml
```yaml
sample:
  description: Demonstration of the LTC4162 I2C battery Charger
  name: LTC4162 Sample
tests:
  sample.sensor.ltc4162:
    harness: console
    tags: sensors
    depends_on: i2c ltc4162
    harness_config:
        type: multi_line
        ordered: yes
        regex:
            - "Charger_status: (.*)"
            - "Charger_type: (.*)"
            - "Charger_health: (.*)"
            - "Input Voltage in Volt: (.*)"
            - "Input Current in Amps: (.*)"
            - "Constant current in Amps: (.*)"
            - "Constant current max in Amps: (.*)"
            - "Constant voltage in Volt: (.*)"
            - "Constant voltage max in Volt: (.*)"
            - "Input current limit in Amps: (.*)"
            - "Charger die temperature in Celsius: (.*)"
        fixture: fixture_i2c_ltc4162
```

## samples/sensor/ltr390/sample.yaml
```yaml
sample:
  name: LTR390 Sensor Sample
tests:
  sample.sensor.ltr390:
    harness: sensor
    tags: sensors
    depends_on: i2c
    filter: dt_compat_enabled("liteon,ltr390")
    platform_allow: nucleo_f411re
    integration_platforms:
      - nucleo_f411re
      - nrf52840dk_nrf52840
```

## samples/sensor/magn_polling/sample.yaml
```yaml
sample:
  name: Magnetometer Polling Sample
tests:
  sample.sensor.magn_polling:
    harness: sensor
    tags: sensors
    filter: dt_alias_exists("magn0")
    integration_platforms:
      - frdm_k64f               # fxos8700
      - thingy53/nrf5340/cpuapp # bmm150
      - sensortile_box          # lis2mdl
      - stm32f411e_disco        # lsm303agr_magn
      - stm32f3_disco           # lsm303dlhc_magn
  sample.sensor.magn_polling.shields:
    platform_allow:
      - adafruit_qt_py_rp2040/rp2040       # adafruit_lis2mdl shield
      - mikroe_clicker_ra4m1/r7fa4m1ab3cfm # mikroe_3d_hall_3_click shield
    extra_args:
      - platform:adafruit_qt_py_rp2040/rp2040:SHIELD="adafruit_lis2mdl"
      - platform:mikroe_clicker_ra4m1/r7fa4m1ab3cfm:SHIELD="mikroe_3d_hall_3_click"
```

## samples/sensor/magn_trig/boards/mimxrt1160_evk_mimxrt1166_cm7.conf
```kconfig
#
# check the fxos8700 dts for this board for addition settings
#

CONFIG_FXOS8700_TRIGGER_OWN_THREAD=y
```

## samples/sensor/magn_trig/sample.yaml
```yaml
sample:
  name: Magnetometer trigger sample
tests:
  sample.sensor.magn_trigger:
    harness: console
    tags: sensors
    filter: dt_alias_exists("magn0")
    harness_config:
      fixture: fixture_sensor_accel_int
      type: one_line
      regex:
        - "^\\s*[0-9A-Za-z_,+-.]*@[0-9A-Fa-f]* \\(x, y, z\\):    \
          \\(\\s*-?[0-9\\.]*,\\s*-?[0-9\\.]*,\\s*-?[0-9\\.]*\\)$"
    integration_platforms:
      - frdm_k64f                       # fxos8700
    platform_exclude:
      - sensortile_box
      - stm32f3_disco
      - stm32f411e_disco
```

## samples/sensor/max17262/sample.yaml
```yaml
sample:
  description: MAX17262 sensor sample
  name: MAX17262 sample
tests:
  sample.sensor.max17262:
    build_only: true
    depends_on: arduino_i2c
    harness: console
    tags: sensors
    platform_allow:
      - nrf52840dk/nrf52840
    harness_config:
      type: one_line
      regex:
        - "V: (.*) V; I: (.*) mA; T: (.*) °C"
      fixture: fixture_i2c_max17262
```

## samples/sensor/max1726x/sample.yaml
```yaml
sample:
  description: MAX1726X sensor sample
  name: MAX1726X sample
tests:
  sample.sensor.max1726x:
    build_only: true
    depends_on: arduino_i2c
    harness: console
    tags: sensors
    platform_allow: nrf52840dk_nrf52840
    harness_config:
        type: one_line
        regex:
            - "V: (.*) V; I: (.*) mA; T: (.*) °C"
        fixture: fixture_i2c_max1726x
```

## samples/sensor/max22190_sdp_120_pmod/sample.yaml
```yaml
sample:
  name: MAX22190 8 channel industrial input sensor
tests:
  sample.sensor.max22190:
    tags: sensors
    harness: console
    depends_on:
      - spi
      - gpio
    harness_config:
      type: multi_line
      ordered: true
      regex:
        - "IN_1=[LH]+ WB_1=[LH]+ IN_2=[LH]+ WB_2=[LH]+ IN_3=[LH]+ WB_3=[LH]+ IN_4=[LH]+ WB_4=[LH]+ \
           IN_5=[LH]+ WB_5=[LH]+ IN_6=[LH]+ WB_6=[LH]+ IN_7=[LH]+ WB_7=[LH]+ IN_8=[LH]+ WB_8=[LH]+"
      fixture: fixture_spi_max22190
    filter: dt_compat_enabled("adi,max22190")
```

## samples/sensor/max30101/sample.yaml
```yaml
sample:
  description: TBD
  name: TBD
tests:
  sample.sensor.max30101:
    harness: sensor
    tags: sensors
    platform_allow: hexiwear/mk64f12
    depends_on: i2c
    integration_platforms:
      - hexiwear/mk64f12
```

## samples/sensor/max3010x_interr/sample.yaml
```yaml
sample:
  name: MAX3010x Sensor Sample
tests:
  sample.sensor.max3010x:
    build_only: true
    platform_allow:
      - nrf54l15dk/nrf54l15/cpuapp
    tags:
      - sensors
      - heart rate
    depends_on:
      - i2c
```

## samples/sensor/max30208/sample.yaml
```yaml
sample:
  description: Demonstration of the MAX30208 sensor driver
  name: MAX30208 sample
tests:
  sample.sensor.max30208:
    harness: sensor
    tags: sensors
    depends_on: i2c
    filter: dt_compat_enabled("maxim,max30208")
```

## samples/sensor/max31855/sample.yaml
```yaml
sample:
  name: MAX31855 Sensor sample
tests:
  sample.sensor.max31855:
    harness: console
    tags: sensors
    depends_on: spi max31855
    harness_config:
        type: one_line
        regex:
            - "ambient temp: (.*) C; die temp: (.*) C"
```

## samples/sensor/max44009/sample.yaml
```yaml
sample:
  name: MAX44009 light sensor
  description: >
    This is a sample app to read an external MAX44009 light sensor via I2C
    interface
tests:
  sample.sensor.max44009:
    tags: sensors
    harness: console
    depends_on:
      - i2c
    platform_allow:
      - frdm_k64f
    harness_config:
      type: multi_line
      ordered: true
      regex:
        - "MAX44009 light sensor application"
        - "sensor: lum reading: (.*)"
      fixture: fixture_i2c_max44009
```

## samples/sensor/max6675/sample.yaml
```yaml
sample:
  name: MAX6675 K-thermocouple to digital converter
tests:
  sample.sensor.max6675:
    tags: sensors
    harness: console
    depends_on:
      - spi
    platform_allow:
      - nucleo_f030r8
    harness_config:
      type: multi_line
      ordered: true
      regex:
        - "Temperature: ([0-9\\.]+) C"
      fixture: fixture_spi_max6675
```

## samples/sensor/mcp9600/sample.yaml
```yaml
sample:
  name: MCP9600 Thermocouple Temperature Sensor
tests:
  sample.sensor.mcp9600:
    harness: sensor
    tags: sensors
    depends_on: i2c
    filter: dt_compat_enabled("microchip,mcp9600")
```
