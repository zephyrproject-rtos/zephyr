/*
 * Copyright (c) 2022 Würth Elektronik eiSos GmbH & Co. KG
 *
 * SPDX-License-Identifier: Apache-2.0
 */

&i2c0 {
	hids@5f {
		compatible = "we,wsen-hids";
		reg = <0x5f>;
		drdy-gpios = <&gpio0 24 GPIO_ACTIVE_HIGH>;
		odr = "1";
	};
};
