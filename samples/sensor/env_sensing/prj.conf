## CMakeLists.txt
```
# SPDX-License-Identifier: Apache-2.0

cmake_minimum_required(VERSION 3.13.1)

if(DEFINED SENSOR)
  set(DTC_OVERLAY_FILE sensor_overlay/${SENSOR}.overlay)
else()
  set(DTC_OVERLAY_FILE sensor_overlay/bme680.overlay)
endif()

find_package(Zephyr REQUIRED HINTS $ENV{ZEPHYR_BASE})
project(env_sensing)


FILE(GLOB app_sources src/main.c)

target_sources(app PRIVATE ${app_sources})
target_sources_ifdef(CONFIG_SAMPLE_DISPLAY_GROVE app PRIVATE src/grove_lcd.c)
target_sources_ifdef(CONFIG_SAMPLE_DISPLAY_LVGL app PRIVATE src/lvgl.c)
```

## Kconfig
```
# Copyright (c) 2021 Intel Corporation
# SPDX-License-Identifier: Apache-2.0

choice
	prompt "Select Display"
	default SAMPLE_DISPLAY_NONE

config SAMPLE_DISPLAY_NONE
	bool "No Display"

config SAMPLE_DISPLAY_GROVE
	bool "Grove LCD Display"
	select GROVE_LCD_RGB
	select DISPLAY

config SAMPLE_DISPLAY_LVGL
	bool "LVGL Display"
	select LVGL
	select DISPLAY
	select LVGL_USE_LABEL
	select LVGL_USE_CONT
	select LVGL_USE_BTN
	select LVGL_FONT_MONTSERRAT_14
	select LVGL_FONT_MONTSERRAT_16
	select LVGL_FONT_MONTSERRAT_18
	select LVGL_FONT_MONTSERRAT_22
	select LVGL_USE_IMG
	select LVGL_USE_LINEMETER
	select LVGL_USE_PAGE

endchoice


if LVGL
config HEAP_MEM_POOL_SIZE
	default 16384

config MAIN_STACK_SIZE
	default 2048

endif

if GROVE_LCD_RGB
config GROVE_LCD_RGB_I2C_MASTER_DEV_NAME
	default "I2C_0"

endif


config HAS_TEMPERATURE
	bool

config HAS_HUMIDITY
	bool

config HAS_PRESSURE
	bool

config HAS_GAS
	bool

config SAMPLE_SENSOR_TRIGGER
	bool "Enable Trigger"

choice
	prompt "Select Sensor"
	default SAMPLE_SENSOR_BME680

config SAMPLE_SENSOR_BME680
	bool "BME680"
	select BME680
	select HAS_TEMPERATURE
	select HAS_HUMIDITY
	select HAS_PRESSURE
	select HAS_GAS

config SAMPLE_SENSOR_TH02
	bool "TH02"
	select TH02
	select HAS_TEMPERATURE

config SAMPLE_SENSOR_SI7006
	bool "SI7006"
	select SI7006
	select HAS_TEMPERATURE
	select HAS_HUMIDITY

config SAMPLE_SENSOR_DHT
	bool "DHT"
	select DHT
	select GPIO
	select HAS_TEMPERATURE
	select HAS_HUMIDITY

config SAMPLE_SENSOR_LPS22HB
	bool "LPS22HB"
	select LPS22HB
	select HAS_TEMPERATURE
	select HAS_PRESSURE

config SAMPLE_SENSOR_LPS22HH
	bool "LPS22HH"
	select LPS22HH
	select HAS_TEMPERATURE
	select HAS_PRESSURE

config SAMPLE_SENSOR_MS5837
	bool "MS5837"
	select MS5837
	select HAS_TEMPERATURE
	select HAS_PRESSURE

config SAMPLE_SENSOR_HDC1080
	bool "HDC1080"
	select TI_HDC
	select HAS_TEMPERATURE
	select HAS_HUMIDITY

config SAMPLE_SENSOR_ENS210
	bool "ENS210"
	select ENS210
	select HAS_TEMPERATURE
	select HAS_HUMIDITY

config SAMPLE_SENSOR_DPS310
	bool "DPS310"
	select DPS310
	select HAS_TEMPERATURE

config SAMPLE_SENSOR_MCP9808
	bool "MCP9808"
	select MCP9808
	select HAS_TEMPERATURE
	select HAS_HUMIDITY

config SAMPLE_SENSOR_HTS221
	bool "HTS221"
	select HTS221
	select HAS_TEMPERATURE
	select HAS_HUMIDITY

config SAMPLE_SENSOR_BME280
	bool "BME 280"
	select BME280
	select HAS_TEMPERATURE
	select HAS_HUMIDITY
	select HAS_PRESSURE

config SAMPLE_SENSOR_TMP007
	bool "TMP007"
	select TMP007
	select HAS_TEMPERATURE

config SAMPLE_SENSOR_SHT3XD
	bool "SHT3XD"
	select SHT3XD
	select HAS_HUMIDITY
	select SHT3XD_TRIGGER if SAMPLE_SENSOR_TRIGGER

endchoice


source "Kconfig.zephyr"
```

## sample.yaml
```
sample:
  name: Environmnt Sensing Application
tests:
  sample.sensor.env_sensing:
    harness: console
    tags: sensors
    depends_on: arduino_i2c
    integration_platforms:
      - frdm_k64f
    harness_config:
        type: multi_line
        ordered: yes
        regex:
            - "Temperature: (.*)"
            - "Relative Humidity: (.*)"
```

## prj.conf
```kconfig
CONFIG_I2C=y
CONFIG_SENSOR=y
CONFIG_CBPRINTF_FP_SUPPORT=y
CONFIG_LVGL_USE_THEME_MATERIAL=y
```

## src/main.c
```c
/*
 * Copyright (c) 2017 Linaro Limited
 *
 * SPDX-License-Identifier: Apache-2.0
 */

#include <zephyr.h>
#include <device.h>
#include <drivers/sensor.h>
#include <stdio.h>
#include <sys/util.h>

#include "disp.h"

const struct device *display;
const struct device *sensor_dev;

#include <logging/log.h>
LOG_MODULE_REGISTER(main);


#if CONFIG_LOG
#define sensor_log(...) LOG_INF(__VA_ARGS__)
#else
#define sensor_log(fmt, ...) printk(fmt, ##__VA_ARGS__)
#endif

static void process_sample(void)
{
	struct sensor_value gas, temp, hum, press;

	if (sensor_sample_fetch(sensor_dev) < 0) {
		LOG_ERR("Sensor sample update error");
		return;
	}
#if CONFIG_HAS_TEMPERATURE
	if (sensor_channel_get(sensor_dev, SENSOR_CHAN_AMBIENT_TEMP, &temp) < 0) {
		LOG_ERR("Cannot read temperature channel");
		return;
	}
#endif
#if CONFIG_HAS_HUMIDITY
	if (sensor_channel_get(sensor_dev, SENSOR_CHAN_HUMIDITY, &hum) < 0) {
		LOG_ERR("Cannot read humidity channel");
		return;
	}
#endif
#if CONFIG_HAS_PRESSURE
	if (sensor_channel_get(sensor_dev, SENSOR_CHAN_PRESS, &press) < 0) {
		LOG_ERR("Cannot read pressure channel");
		return;
	}
#endif
#if CONFIG_HAS_GAS
	if (sensor_channel_get(sensor_dev, SENSOR_CHAN_GAS_RES, &gas) < 0) {
		LOG_ERR("Cannot read gas channel");
		return;
	}
#endif


#ifndef CONFIG_SAMPLE_DISPLAY_NONE
	update_display(temp, hum, press, gas);
#endif

	if (IS_ENABLED(CONFIG_HAS_TEMPERATURE)) {
		sensor_log("Temperature: %.1f C\n", sensor_value_to_double(&temp));
	}
	if (IS_ENABLED(CONFIG_HAS_HUMIDITY)) {
		sensor_log("Relative Humidity: %.1f%%\n", sensor_value_to_double(&hum));
	}
	if (IS_ENABLED(CONFIG_HAS_PRESSURE)) {
		sensor_log("Pressure: %.2f kPa", sensor_value_to_double(&press));
	}
	if (IS_ENABLED(CONFIG_HAS_GAS)) {
		sensor_log("Gas: %.2f", sensor_value_to_double(&gas));
	}
}

static void handler_(const struct device *dev,
			   struct sensor_trigger *trig)
{
	process_sample();
}


void main(void)
{

#if defined(CONFIG_HTS221)
	sensor_dev = DEVICE_DT_GET_ANY(st_hts221);
#elif defined(CONFIG_TH02)
	sensor_dev = DEVICE_DT_GET_ANY(hoperf_th02);
#elif defined(CONFIG_BME280)
	sensor_dev = DEVICE_DT_GET_ANY(bosch_bme280);
#elif defined(CONFIG_TMP007)
	sensor_dev = DEVICE_DT_GET_ANY(ti_tmp007);
#elif defined(CONFIG_SHT3XD)
	sensor_dev = DEVICE_DT_GET_ANY(sensirion_sht3xd);
#elif defined(CONFIG_BME680)
	sensor_dev = DEVICE_DT_GET_ANY(bosch_bme680);
#elif defined(CONFIG_MCP9808)
	sensor_dev = DEVICE_DT_GET_ANY(microchip_mcp9808);
#elif defined(CONFIG_DPS310)
	sensor_dev = DEVICE_DT_GET_ANY(infineon_dps310);
#elif defined(CONFIG_TI_HDC)
	sensor_dev = DEVICE_DT_GET_ANY(ti_hdc);
#elif defined(CONFIG_MAX6675)
	sensor_dev = DEVICE_DT_GET_ANY(maxim_max6675);
#elif defined(CONFIG_LPS22HB)
	sensor_dev = DEVICE_DT_GET_ANY(st_lps22hb_press);
#elif defined(CONFIG_LPS22HH)
	sensor_dev = DEVICE_DT_GET_ANY(st_lps22hh);
#elif defined(CONFIG_ENS210)
	sensor_dev = DEVICE_DT_GET_ANY(ams_ens210);
#elif defined(CONFIG_DHT)
	sensor_dev = DEVICE_DT_GET_ANY(aosong_dht);
#elif defined(CONFIG_SI7006)
	sensor_dev = DEVICE_DT_GET_ANY(silabs_si7006);
#else
#error Not defined
#endif

	if (sensor_dev == NULL) {
		LOG_ERR("Could not get sensor device");
		return;
	}
	if (!device_is_ready(sensor_dev)) {
		LOG_ERR("Device %s is not ready.", sensor_dev->name);
		return;
	}


#ifdef CONFIG_SAMPLE_SENSOR_TRIGGER
	rc = set_window_ucel(sensor_dev, TEMP_INITIAL_CEL * UCEL_PER_CEL);
	if (rc == 0) {
		trig.type = SENSOR_TRIG_THRESHOLD;
		trig.chan = SENSOR_CHAN_AMBIENT_TEMP;
		rc = sensor_trigger_set(dev, &trig, trigger_handler);
	}

	if (rc != 0) {
		printf("Trigger set failed: %d\n", rc);
		return;
	}
	printk("Trigger set got %d\n", rc);
#endif

#ifndef CONFIG_SAMPLE_DISPLAY_NONE
	init_display();
	reset_display();
#endif

	if (IS_ENABLED(CONFIG_SAMPLE_SENSOR_TRIGGER)) {
		struct sensor_trigger trig = {
			.type = SENSOR_TRIG_DATA_READY,
			.chan = SENSOR_CHAN_ALL,
		};
		if (sensor_trigger_set(sensor_dev, &trig, handler_) < 0) {
			LOG_ERR("Cannot configure trigger");
			return;
		}
	}

	while (!IS_ENABLED(CONFIG_SAMPLE_SENSOR_TRIGGER)) {
		process_sample();
		k_sleep(K_MSEC(2000));
	}
	k_sleep(K_FOREVER);
}
```

## src/disp.h
```c
/*
 * Copyright (c) 2021 Intel Corporation.
 *
 * SPDX-License-Identifier: Apache-2.0
 */

#ifndef ENV_DISPLAY_H_
#define ENV_DISPLAY_H_

void init_display(void);
void reset_display(void);
void update_display(struct sensor_value temp,
		struct sensor_value hum,
		struct sensor_value press,
		struct sensor_value gas);

#endif
```

## src/grove_lcd.c
```c
/*
 * Copyright (c) 2021 Intel Corporation.
 *
 * SPDX-License-Identifier: Apache-2.0
 */

#include <zephyr.h>
#include <device.h>

#include <display/grove_lcd.h>
#include <stdio.h>
#include <string.h>
#include <drivers/sensor.h>

#include "disp.h"

#include <logging/log.h>
LOG_MODULE_DECLARE(main);

extern const struct device *display;

void init_display(void)
{

	display = device_get_binding(GROVE_LCD_NAME);
	if (display == NULL) {
		LOG_ERR("Failed to get Grove LCD");
		return NULL;
	}

	/* configure LCD */
	glcd_function_set(display, GLCD_FS_ROWS_2 | GLCD_FS_DOT_SIZE_LITTLE |
			  GLCD_FS_8BIT_MODE);
	glcd_display_state_set(display, GLCD_DS_DISPLAY_ON);
}

void reset_display(void)
{
	char row[16];

	/* clear LCD */
	(void)memset(row, ' ', sizeof(row));
	glcd_cursor_pos_set(display, 0, 0);
	glcd_print(display, row, sizeof(row));
	glcd_cursor_pos_set(display, 0, 1);
	glcd_print(display, row, sizeof(row));
}


void update_display(struct sensor_value temp,
			struct sensor_value hum,
			struct sensor_value press,
			struct sensor_value gas)
{

	char row[16];

	glcd_cursor_pos_set(display, 0, 0);
#if CONFIG_HAS_TEMPERATURE
	snprintk(row, sizeof(row), "T: %.1f%cC", sensor_value_to_double(&temp),
		223 /* degree symbol */);
	glcd_print(display, row, strlen(row));
#endif
#if CONFIG_HAS_HUMIDITY
	glcd_cursor_pos_set(display, 0, 1);
	snprintk(row, sizeof(row), "H: %.1f%%",
		sensor_value_to_double(&hum));
	glcd_print(display, row, strlen(row));
#endif
}
```

## src/lvgl.c
```c
/*
 * Copyright (c) 2021 Intel Corporation.
 *
 * SPDX-License-Identifier: Apache-2.0
 */

#include <device.h>
#include <drivers/display.h>
#include <lvgl.h>
#include <stdio.h>
#include <string.h>
#include <zephyr.h>
#include "resources.h"
#include <drivers/sensor.h>

extern const struct device *display;
extern const struct device *sensor_dev;

#include <logging/log.h>
LOG_MODULE_DECLARE(main);

lv_obj_t *temp_value_label;
lv_obj_t *humid_value_label;
lv_obj_t *pres_value_label;
lv_obj_t *LogOutput;

lv_obj_t *city_label;
lv_obj_t *rain_meter;
lv_obj_t *rain_static;
lv_obj_t *temp_label;
lv_obj_t *pressure_label;
lv_obj_t *humidity_label;

void init_display(void)
{
	lv_obj_t *img1;
	const char *location;
	static lv_style_t large_style;

	display = device_get_binding(CONFIG_LVGL_DISPLAY_DEV_NAME);

	if (display == NULL) {
		LOG_ERR("Display device not found.");
		return;
	}

	lv_theme_t *th =
		lv_theme_material_init(LV_COLOR_BLACK, LV_COLOR_WHITE, LV_THEME_MATERIAL_FLAG_DARK,
				       &lv_font_montserrat_14, &lv_font_montserrat_16,
				       &lv_font_montserrat_18, &lv_font_montserrat_22);

	lv_theme_set_act(th);
	img1 = lv_img_create(lv_scr_act(), NULL);
	city_label = lv_label_create(lv_scr_act(), NULL);
	rain_meter = lv_linemeter_create(lv_scr_act(), NULL);
	rain_static = lv_label_create(lv_scr_act(), NULL);
	temp_label = lv_label_create(lv_scr_act(), NULL);
	pressure_label = lv_label_create(lv_scr_act(), NULL);
	humidity_label = lv_label_create(lv_scr_act(), NULL);
	temp_value_label = lv_label_create(lv_scr_act(), NULL);
	humid_value_label = lv_label_create(lv_scr_act(), NULL);
	pres_value_label = lv_label_create(lv_scr_act(), NULL);


	lv_style_init(&large_style);
	lv_style_set_text_font(&large_style, LV_STATE_DEFAULT, lv_theme_get_font_title());

	lv_img_set_src(img1, &cloudy);
	lv_obj_set_x(img1, 20);
	lv_obj_set_y(img1, 120);
	lv_obj_set_style_local_image_recolor_opa(img1, LV_IMG_PART_MAIN, LV_STATE_DEFAULT, 255);
	lv_obj_set_style_local_image_recolor(img1, LV_IMG_PART_MAIN, LV_STATE_DEFAULT,
					     LV_COLOR_WHITE);

	lv_obj_add_style(city_label, LV_LABEL_PART_MAIN, &large_style);
	lv_obj_set_x(city_label, 115);
	lv_obj_set_y(city_label, 10);
	lv_obj_set_height(city_label, 20);
	lv_obj_set_width(city_label, 50);
	lv_label_set_text(city_label, location);

	lv_obj_set_x(rain_meter, 15);
	lv_obj_set_y(rain_meter, 10);
	lv_obj_set_width(rain_meter, 75);
	lv_obj_set_height(rain_meter, 75);
	lv_linemeter_set_range(rain_meter, 0, 100);

	lv_obj_set_x(rain_static, 25);
	lv_obj_set_y(rain_static, 90);
	lv_obj_set_width(rain_static, 60);
	lv_obj_set_height(rain_static, 40);
	lv_label_set_text(rain_static, "% Rain");

	lv_obj_set_x(temp_label, 110);
	lv_obj_set_y(temp_label, 50);
	lv_label_set_text(temp_label, "Temp (C°)");

	lv_obj_set_x(pressure_label, 110);
	lv_obj_set_y(pressure_label, 100);
	lv_label_set_text(pressure_label, "Pressure (kPa)");

	lv_obj_set_x(humidity_label, 110);
	lv_obj_set_y(humidity_label, 150);
	lv_label_set_text(humidity_label, "Humidity (%)");

	lv_obj_add_style(temp_value_label, LV_LABEL_PART_MAIN, &large_style);
	lv_obj_set_x(temp_value_label, 240);
	lv_obj_set_y(temp_value_label, 50);

	lv_obj_add_style(pres_value_label, LV_LABEL_PART_MAIN, &large_style);
	lv_obj_set_x(pres_value_label, 240);
	lv_obj_set_y(pres_value_label, 100);

	lv_obj_add_style(humid_value_label, LV_LABEL_PART_MAIN, &large_style);
	lv_obj_set_x(humid_value_label, 240);
	lv_obj_set_y(humid_value_label, 150);

	LogOutput = lv_label_create(lv_scr_act(), NULL);
	lv_label_set_long_mode(LogOutput, LV_LABEL_LONG_CROP);
	lv_label_set_recolor(LogOutput, true);
	lv_label_set_align(LogOutput, LV_LABEL_ALIGN_LEFT);
	lv_obj_set_width(LogOutput, 280);
	lv_obj_align(LogOutput, NULL, LV_ALIGN_IN_TOP_LEFT, 20, 200);
	lv_obj_set_style_local_bg_opa(LogOutput, LV_PAGE_PART_BG, LV_STATE_DEFAULT, 64);

	lv_task_handler();
	display_blanking_off(display);
}

void reset_display(void)
{
}

void update_display(struct sensor_value temp, struct sensor_value hum, struct sensor_value press,
		    struct sensor_value gas)
{
	display_set_brightness(display, 0);

	lv_label_set_text_fmt(temp_value_label, "%.1f", sensor_value_to_double(&temp));
#if CONFIG_HAS_PRESSURE
	lv_label_set_text_fmt(pres_value_label, "%.1f", sensor_value_to_double(&press));
#else
	lv_label_set_text(pres_value_label, "N/A");
#endif
	lv_label_set_text_fmt(humid_value_label, "%.1f", sensor_value_to_double(&hum));

	lv_label_set_text_fmt(LogOutput, "Powered By: %s", sensor_dev->name);
	lv_label_set_text_fmt(city_label, "%s", "Montreal");

	lv_task_handler();
}
```

## src/resources.h
```c
/*
 * Copyright (c) 2021 Intel Corporation.
 *
 * SPDX-License-Identifier: Apache-2.0
 */

#ifndef LVGL_RESOURCES_H_
#define LVGL_RESOURCES_H_

#include <lvgl.h>

extern const char *location;

#ifndef LV_ATTRIBUTE_MEM_ALIGN
#define LV_ATTRIBUTE_MEM_ALIGN
#endif

#ifndef LV_ATTRIBUTE_IMG_CLOUDY
#define LV_ATTRIBUTE_IMG_CLOUDY
#endif

#ifndef LV_ATTRIBUTE_IMG_RAINY
#define LV_ATTRIBUTE_IMG_RAINY
#endif

#ifndef LV_ATTRIBUTE_IMG_FOGGY
#define LV_ATTRIBUTE_IMG_FOGGY
#endif

#ifndef LV_ATTRIBUTE_IMG_SUNNY
#define LV_ATTRIBUTE_IMG_SUNNY
#endif

const LV_ATTRIBUTE_MEM_ALIGN
	LV_ATTRIBUTE_LARGE_CONST LV_ATTRIBUTE_IMG_CLOUDY uint8_t cloudy_map[] = {
	0x00, 0x00, 0x00, 0x00, 0x00, 0x00, 0x00, 0x00, 0x00, 0x00, 0x00, 0x00, 0x00, 0x00, 0x00,
	0x00, 0x00, 0x00, 0x00, 0x00, 0x00, 0x00, 0x00, 0x00, 0x00, 0x00, 0x00, 0x00, 0x00, 0x00,
	0x00, 0x00, 0x00, 0x00, 0x00, 0x00, 0x00, 0x00, 0x00, 0x00, 0x00, 0x00, 0x00, 0x00, 0x00,
	0x00, 0x00, 0x00, 0x00, 0x00, 0x00, 0x00, 0x00, 0x00, 0x00, 0x00, 0x00, 0x00, 0x00, 0x00,
	0x00, 0x00, 0x00, 0x00, 0x00, 0x00, 0x00, 0x00, 0xff, 0x00, 0x00, 0x00, 0x00, 0x00, 0x00,
	0x0f, 0xff, 0xf0, 0x00, 0x00, 0x00, 0x00, 0x00, 0x3f, 0xff, 0xfc, 0x00, 0x00, 0x00, 0x00,
	0x00, 0x7f, 0xff, 0xfe, 0x00, 0x00, 0x00, 0x00, 0x01, 0xff, 0xff, 0xff, 0x80, 0x00, 0x00,
	0x00, 0x03, 0xff, 0xff, 0xff, 0xc0, 0x00, 0x00, 0x00, 0x07, 0xff, 0xff, 0xff, 0xe0, 0x00,
	0x00, 0x00, 0x0f, 0xff, 0xff, 0xff, 0xf0, 0x00, 0x00, 0x00, 0x0f, 0xff, 0xff, 0xff, 0xf0,
	0x00, 0x00, 0x00, 0x1f, 0xff, 0xff, 0xff, 0xf8, 0x00, 0x00, 0x00, 0x3f, 0xff, 0xff, 0xff,
	0xfc, 0x00, 0x00, 0x00, 0x3f, 0xff, 0xff, 0xff, 0xfc, 0x00, 0x00, 0x00, 0x7f, 0xff, 0xff,
	0xff, 0xfe, 0x00, 0x00, 0x00, 0x7f, 0xff, 0xff, 0xff, 0xfe, 0x00, 0x00, 0x00, 0x7f, 0xff,
	0xff, 0xff, 0xfe, 0x00, 0x00, 0x00, 0x7f, 0xff, 0xff, 0xff, 0xfe, 0x00, 0x00, 0x3f, 0xff,
	0xff, 0xff, 0xff, 0xff, 0x00, 0x00, 0xff, 0xff, 0xff, 0xff, 0xff, 0xff, 0x00, 0x03, 0xff,
	0xff, 0xff, 0xff, 0xff, 0xff, 0x00, 0x07, 0xff, 0xff, 0xff, 0xff, 0xff, 0xff, 0x00, 0x0f,
	0xff, 0xff, 0xff, 0xff, 0xff, 0xff, 0x00, 0x1f, 0xff, 0xff, 0xff, 0xff, 0xff, 0xff, 0xc0,
	0x3f, 0xff, 0xff, 0xff, 0xff, 0xff, 0xff, 0xe0, 0x3f, 0xff, 0xff, 0xff, 0xff, 0xff, 0xff,
	0xf0, 0x7f, 0xff, 0xff, 0xff, 0xff, 0xff, 0xff, 0xf8, 0x7f, 0xff, 0xff, 0xff, 0xff, 0xff,
	0xff, 0xfc, 0xff, 0xff, 0xff, 0xff, 0xff, 0xff, 0xff, 0xfe, 0xff, 0xff, 0xff, 0xff, 0xff,
	0xff, 0xff, 0xfe, 0xff, 0xff, 0xff, 0xff, 0xff, 0xff, 0xff, 0xfe, 0xff, 0xff, 0xff, 0xff,
	0xff, 0xff, 0xff, 0xff, 0xff, 0xff, 0xff, 0xff, 0xff, 0xff, 0xff, 0xff, 0xff, 0xff, 0xff,
	0xff, 0xff, 0xff, 0xff, 0xff, 0xff, 0xff, 0xff, 0xff, 0xff, 0xff, 0xff, 0xff, 0xff, 0xff,
	0xff, 0xff, 0xff, 0xff, 0xff, 0xff, 0x7f, 0xff, 0xff, 0xff, 0xff, 0xff, 0xff, 0xff, 0x7f,
	0xff, 0xff, 0xff, 0xff, 0xff, 0xff, 0xfe, 0x3f, 0xff, 0xff, 0xff, 0xff, 0xff, 0xff, 0xfe,
	0x3f, 0xff, 0xff, 0xff, 0xff, 0xff, 0xff, 0xfe, 0x1f, 0xff, 0xff, 0xff, 0xff, 0xff, 0xff,
	0xfc, 0x0f, 0xff, 0xff, 0xff, 0xff, 0xff, 0xff, 0xf8, 0x07, 0xff, 0xff, 0xff, 0xff, 0xff,
	0xff, 0xf0, 0x03, 0xff, 0xff, 0xff, 0xff, 0xff, 0xff, 0xe0, 0x00, 0xff, 0xff, 0xff, 0xff,
	0xff, 0xff, 0xc0, 0x00, 0x3f, 0xff, 0xff, 0xff, 0xff, 0xfe, 0x00, 0x00, 0x00, 0x00, 0x00,
	0x00, 0x00, 0x00, 0x00, 0x00, 0x00, 0x00, 0x00, 0x00, 0x00, 0x00, 0x00, 0x00, 0x00, 0x00,
	0x00, 0x00, 0x00, 0x00, 0x00, 0x00, 0x00, 0x00, 0x00, 0x00, 0x00, 0x00, 0x00, 0x00, 0x00,
	0x00, 0x00, 0x00, 0x00, 0x00, 0x00, 0x00, 0x00, 0x00, 0x00, 0x00, 0x00, 0x00, 0x00, 0x00,
	0x00, 0x00, 0x00, 0x00, 0x00, 0x00, 0x00, 0x00, 0x00, 0x00, 0x00, 0x00, 0x00, 0x00, 0x00,
	0x00, 0x00, 0x00, 0x00, 0x00, 0x00, 0x00, 0x00, 0x00, 0x00, 0x00, 0x00, 0x00, 0x00, 0x00,
	0x00, 0x00, 0x00, 0x00, 0x00, 0x00, 0x00, 0x00, 0x00, 0x00, 0x00, 0x00, 0x00, 0x00, 0x00,
	0x00, 0x00,
};

const lv_img_header_t cloudy_header = { LV_IMG_CF_ALPHA_1BIT, 0, 2, 64, 64 };

const lv_img_dsc_t cloudy = { cloudy_header, 512, cloudy_map };

LV_IMG_DECLARE(cloudy);

const LV_ATTRIBUTE_MEM_ALIGN LV_ATTRIBUTE_LARGE_CONST LV_ATTRIBUTE_IMG_RAINY uint8_t rainy_map[] = {
	0x00, 0x00, 0x00, 0x00, 0xff, 0x00, 0x00, 0x00, 0x00, 0x00, 0x00, 0x0f, 0xff, 0xf0, 0x00,
	0x00, 0x00, 0x00, 0x00, 0x3f, 0xff, 0xfc, 0x00, 0x00, 0x00, 0x00, 0x00, 0x7f, 0xff, 0xfe,
	0x00, 0x00, 0x00, 0x00, 0x01, 0xff, 0xff, 0xff, 0x80, 0x00, 0x00, 0x00, 0x03, 0xff, 0xff,
	0xff, 0xc0, 0x00, 0x00, 0x00, 0x07, 0xff, 0xff, 0xff, 0xe0, 0x00, 0x00, 0x00, 0x0f, 0xff,
	0xff, 0xff, 0xf0, 0x00, 0x00, 0x00, 0x0f, 0xff, 0xff, 0xff, 0xf0, 0x00, 0x00, 0x00, 0x1f,
	0xff, 0xff, 0xff, 0xf8, 0x00, 0x00, 0x00, 0x3f, 0xff, 0xff, 0xff, 0xfc, 0x00, 0x00, 0x00,
	0x3f, 0xff, 0xff, 0xff, 0xfc, 0x00, 0x00, 0x00, 0x7f, 0xff, 0xff, 0xff, 0xfe, 0x00, 0x00,
	0x00, 0x7f, 0xff, 0xff, 0xff, 0xfe, 0x00, 0x00, 0x00, 0x7f, 0xff, 0xff, 0xff, 0xfe, 0x00,
	0x00, 0x00, 0x7f, 0xff, 0xff, 0xff, 0xfe, 0x00, 0x00, 0x3f, 0xff, 0xff, 0xff, 0xff, 0xff,
	0x00, 0x00, 0xff, 0xff, 0xff, 0xff, 0xff, 0xff, 0x00, 0x03, 0xff, 0xff, 0xff, 0xff, 0xff,
	0xff, 0x00, 0x07, 0xff, 0xff, 0xff, 0xff, 0xff, 0xff, 0x00, 0x0f, 0xff, 0xff, 0xff, 0xff,
	0xff, 0xff, 0x00, 0x1f, 0xff, 0xff, 0xff, 0xff, 0xff, 0xff, 0xc0, 0x3f, 0xff, 0xff, 0xff,
	0xff, 0xff, 0xff, 0xe0, 0x3f, 0xff, 0xff, 0xff, 0xff, 0xff, 0xff, 0xf0, 0x7f, 0xff, 0xff,
	0xff, 0xff, 0xff, 0xff, 0xf8, 0x7f, 0xff, 0xff, 0xff, 0xff, 0xff, 0xff, 0xfc, 0xff, 0xff,
	0xff, 0xff, 0xff, 0xff, 0xff, 0xfe, 0xff, 0xff, 0xff, 0xff, 0xff, 0xff, 0xff, 0xfe, 0xff,
	0xff, 0xff, 0xff, 0xff, 0xff, 0xff, 0xfe, 0xff, 0xff, 0xff, 0xff, 0xff, 0xff, 0xff, 0xff,
	0xff, 0xff, 0xff, 0xff, 0xff, 0xff, 0xff, 0xff, 0xff, 0xff, 0xff, 0xff, 0xff, 0xff, 0xff,
	0xff, 0xff, 0xff, 0xff, 0xff, 0xff, 0xff, 0xff, 0xff, 0xff, 0xff, 0xff, 0xff, 0xff, 0xff,
	0xff, 0xff, 0x7f, 0xff, 0xff, 0xff, 0xff, 0xff, 0xff, 0xff, 0x7f, 0xff, 0xff, 0xff, 0xff,
	0xff, 0xff, 0xfe, 0x3f, 0xff, 0xff, 0xff, 0xff, 0xff, 0xff, 0xfe, 0x3f, 0xff, 0xff, 0xff,
	0xff, 0xff, 0xff, 0xfe, 0x1f, 0xff, 0xff, 0xff, 0xff, 0xff, 0xff, 0xfc, 0x0f, 0xff, 0xff,
	0xff, 0xff, 0xff, 0xff, 0xf8, 0x07, 0xff, 0xff, 0xff, 0xff, 0xff, 0xff, 0xf0, 0x03, 0xff,
	0xff, 0xff, 0xff, 0xff, 0xff, 0xe0, 0x00, 0xff, 0xff, 0xff, 0xff, 0xff, 0xff, 0xc0, 0x00,
	0x3f, 0xff, 0xff, 0xff, 0xff, 0xfe, 0x00, 0x00, 0x00, 0x00, 0x00, 0x00, 0x00, 0x00, 0x00,
	0x00, 0x00, 0x00, 0x00, 0x00, 0x00, 0x00, 0x00, 0x00, 0x00, 0x00, 0x00, 0x00, 0x00, 0x00,
	0x00, 0x00, 0x00, 0x00, 0x00, 0x00, 0x00, 0x00, 0x00, 0x00, 0x00, 0x00, 0xe0, 0x00, 0x0e,
	0x00, 0x00, 0x00, 0x00, 0x00, 0xf0, 0x00, 0x0f, 0x00, 0x00, 0x00, 0x00, 0x00, 0xf0, 0x00,
	0x0f, 0x00, 0x00, 0x00, 0x00, 0x00, 0xe0, 0x00, 0x0e, 0x00, 0x00, 0x00, 0x03, 0x80, 0x00,
	0x38, 0x00, 0x00, 0x00, 0x00, 0x03, 0xc0, 0x00, 0x3c, 0x00, 0x00, 0x00, 0x00, 0x03, 0xc0,
	0x00, 0x3c, 0x00, 0x00, 0x00, 0x00, 0x03, 0x80, 0x00, 0x38, 0x00, 0x00, 0x00, 0x00, 0x00,
	0x03, 0xc0, 0x00, 0x3c, 0x00, 0x00, 0x00, 0x00, 0x03, 0xc0, 0x00, 0x3c, 0x00, 0x00, 0x00,
	0x00, 0x03, 0xc0, 0x00, 0x3c, 0x00, 0x00, 0x00, 0x00, 0x01, 0x80, 0x00, 0x18, 0x00, 0x00,
	0x00, 0x0f, 0x00, 0x00, 0xf0, 0x00, 0x00, 0x00, 0x00, 0x0f, 0x00, 0x00, 0xf0, 0x00, 0x00,
	0x00, 0x00, 0x0f, 0x00, 0x00, 0xf0, 0x00, 0x00, 0x00, 0x00, 0x06, 0x00, 0x00, 0x60, 0x00,
	0x00, 0x00,
};

const lv_img_header_t rainy_header = { LV_IMG_CF_ALPHA_1BIT, 0, 2, 64, 64 };

const lv_img_dsc_t rainy = { rainy_header, 512, rainy_map };

LV_IMG_DECLARE(rainy);

const LV_ATTRIBUTE_MEM_ALIGN LV_ATTRIBUTE_LARGE_CONST LV_ATTRIBUTE_IMG_FOGGY uint8_t foggy_map[] = {
	0x00, 0x00, 0x00, 0x00, 0x00, 0x00, 0x00, 0x00, 0x00, 0x00, 0x00, 0x00, 0x00, 0x00, 0x00,
	0x00, 0x00, 0x00, 0x00, 0x00, 0x00, 0x00, 0x00, 0x00, 0x00, 0x00, 0x00, 0x00, 0x00, 0x00,
	0x00, 0x00, 0x00, 0x00, 0x60, 0x00, 0x00, 0x00, 0x00, 0x00, 0x00, 0x00, 0xf0, 0x00, 0x00,
	0x00, 0x00, 0x00, 0x00, 0x00, 0xf0, 0x00, 0x00, 0x00, 0x00, 0x00, 0x00, 0x00, 0xf0, 0x00,
	0xe0, 0x00, 0x00, 0x00, 0x00, 0x00, 0x40, 0x01, 0xe0, 0x00, 0x00, 0x00, 0x00, 0x00, 0x00,
	0x01, 0xe0, 0x00, 0x00, 0x00, 0x00, 0x00, 0x00, 0x01, 0xe0, 0x00, 0x00, 0x00, 0x00, 0x00,
	0x00, 0x00, 0x40, 0x00, 0x00, 0x00, 0x00, 0x00, 0x3f, 0xc0, 0x00, 0x00, 0x00, 0x00, 0x1e,
	0x00, 0xff, 0xf0, 0x00, 0x00, 0x00, 0x00, 0x1f, 0x03, 0xff, 0xfc, 0x00, 0x00, 0x00, 0x00,
	0x1e, 0x07, 0xff, 0xfe, 0x00, 0x00, 0x00, 0x00, 0x0e, 0x0f, 0xff, 0xff, 0x07, 0xff, 0xe0,
	0x00, 0x00, 0x1f, 0xff, 0xff, 0x8f, 0xff, 0xf0, 0x00, 0x00, 0x3f, 0xff, 0xff, 0xcf, 0xff,
	0xf0, 0x00, 0x00, 0x3f, 0xff, 0xff, 0xc7, 0xff, 0xe0, 0x00, 0x00, 0x7f, 0xff, 0xff, 0xe1,
	0xf8, 0x00, 0x00, 0x00, 0x7f, 0xff, 0xff, 0xe0, 0xf0, 0x00, 0x00, 0x00, 0xff, 0xff, 0xff,
	0xf0, 0xf0, 0x00, 0x00, 0x00, 0xff, 0xff, 0xff, 0xf1, 0xf8, 0x00, 0x00, 0x00, 0xff, 0xff,
	0xff, 0xff, 0xff, 0xfe, 0x00, 0x00, 0xff, 0xff, 0xff, 0xff, 0xff, 0xff, 0x00, 0x00, 0xff,
	0xff, 0xff, 0xff, 0xff, 0xff, 0x00, 0x00, 0xff, 0xff, 0xff, 0xff, 0xff, 0xfe, 0x00, 0x70,
	0xff, 0xff, 0xff, 0xff, 0xff, 0xf8, 0x00, 0xf0, 0xff, 0xff, 0xff, 0xff, 0xff, 0xf0, 0x00,
	0xf8, 0x7f, 0xff, 0xff, 0xff, 0xff, 0xf0, 0x00, 0x70, 0x7f, 0xff, 0xff, 0xff, 0xff, 0xf8,
	0x00, 0x00, 0x3f, 0xff, 0xff, 0xff, 0xff, 0xff, 0xe0, 0x00, 0x3f, 0xff, 0xff, 0xff, 0xff,
	0xff, 0xf0, 0x00, 0x1f, 0xff, 0xff, 0xff, 0xff, 0xff, 0xf0, 0x00, 0x0f, 0xff, 0xff, 0xff,
	0xff, 0xff, 0xe0, 0x00, 0x07, 0xff, 0xff, 0xff, 0xf8, 0x00, 0x00, 0x00, 0x03, 0xff, 0xff,
	0xff, 0xf0, 0x00, 0x00, 0x00, 0x00, 0xff, 0xff, 0xff, 0xf0, 0x00, 0x00, 0x00, 0x00, 0x3f,
	0xff, 0xff, 0xf8, 0x00, 0x00, 0x07, 0xff, 0xff, 0xff, 0xff, 0xff, 0xff, 0xfe, 0x0f, 0xff,
	0xff, 0xff, 0xff, 0xff, 0xff, 0xff, 0x0f, 0xff, 0xff, 0xff, 0xff, 0xff, 0xff, 0xff, 0x07,
	0xff, 0xff, 0xff, 0xff, 0xff, 0xff, 0xfe, 0x00, 0x1f, 0xff, 0xff, 0xff, 0xf8, 0x00, 0x00,
	0x00, 0x0f, 0xff, 0xff, 0xff, 0xf0, 0x00, 0x00, 0x00, 0x0f, 0xff, 0xff, 0xff, 0xf0, 0x00,
	0x00, 0x00, 0x1f, 0xff, 0xff, 0xff, 0xf8, 0x00, 0x00, 0x00, 0x7f, 0xff, 0xff, 0xff, 0xfe,
	0x07, 0xe0, 0x00, 0xff, 0xff, 0xff, 0xff, 0xff, 0x0f, 0xf0, 0x00, 0xff, 0xff, 0xff, 0xff,
	0xff, 0x0f, 0xf0, 0x00, 0x7f, 0xff, 0xff, 0xff, 0xfe, 0x07, 0xe0, 0x00, 0x00, 0x00, 0x01,
	0xf8, 0x00, 0x00, 0x00, 0x00, 0x00, 0x00, 0x00, 0xf0, 0x00, 0x00, 0x00, 0x00, 0x00, 0x00,
	0x00, 0xf0, 0x00, 0x00, 0x00, 0x00, 0x00, 0x00, 0x01, 0xf8, 0x00, 0x00, 0x00, 0x00, 0x00,
	0x00, 0x7f, 0xfe, 0x00, 0x00, 0x00, 0x00, 0x00, 0x00, 0xff, 0xff, 0x00, 0x00, 0x00, 0x00,
	0x00, 0x00, 0xff, 0xff, 0x00, 0x00, 0x00, 0x00, 0x00, 0x00, 0x7f, 0xfe, 0x00, 0x00, 0x00,
	0x00, 0x00, 0x00, 0x00, 0x00, 0x00, 0x00, 0x00, 0x00, 0x00, 0x00, 0x00, 0x00, 0x00, 0x00,
	0x00, 0x00, 0x00, 0x00, 0x00, 0x00, 0x00, 0x00, 0x00, 0x00, 0x00, 0x00, 0x00, 0x00, 0x00,
	0x00, 0x00,
};

const lv_img_header_t foggy_header = { LV_IMG_CF_ALPHA_1BIT, 0, 2, 64, 64 };

const lv_img_dsc_t foggy = { foggy_header, 512, foggy_map };

LV_IMG_DECLARE(foggy);

const LV_ATTRIBUTE_MEM_ALIGN LV_ATTRIBUTE_LARGE_CONST LV_ATTRIBUTE_IMG_SUNNY uint8_t sunny_map[] = {
	0x00, 0x00, 0x00, 0x00, 0x06, 0x00, 0x00, 0x00, 0x00, 0x00, 0x00, 0x00, 0x0f, 0x00, 0x00,
	0x00, 0x00, 0x00, 0x00, 0x00, 0x0f, 0x00, 0x00, 0x00, 0x00, 0x00, 0x00, 0x00, 0x0f, 0x00,
	0x00, 0x00, 0x00, 0x00, 0x00, 0x00, 0x07, 0x00, 0x00, 0x00, 0x00, 0x07, 0x80, 0x00, 0x00,
	0x00, 0x00, 0x00, 0x00, 0x07, 0x80, 0x00, 0x00, 0x00, 0x00, 0x00, 0x00, 0x07, 0xc0, 0x00,
	0x00, 0x00, 0x00, 0x00, 0x00, 0x03, 0x80, 0x1f, 0xf8, 0x00, 0x00, 0x00, 0x00, 0x00, 0x00,
	0xff, 0xff, 0x00, 0x00, 0x00, 0x00, 0x00, 0x07, 0xff, 0xff, 0xe0, 0x00, 0x00, 0x00, 0x00,
	0x0f, 0xff, 0xff, 0xf0, 0x00, 0x00, 0x00, 0x00, 0x3f, 0xff, 0xff, 0xfc, 0x00, 0x00, 0x00,
	0x00, 0x7f, 0xff, 0xff, 0xfe, 0x00, 0xe0, 0x00, 0x00, 0xff, 0xff, 0xff, 0xff, 0x01, 0xe0,
	0x00, 0x01, 0xff, 0xff, 0xff, 0xff, 0x81, 0xe0, 0x00, 0x03, 0xff, 0xff, 0xff, 0xff, 0xc1,
	0xe0, 0x00, 0x07, 0xff, 0xff, 0xff, 0xff, 0xe0, 0x80, 0x00, 0x0f, 0xff, 0xff, 0xff, 0xff,
	0xf0, 0x00, 0x00, 0x0f, 0xff, 0xff, 0xff, 0xff, 0xf0, 0x00, 0x00, 0x1f, 0xff, 0xff, 0xff,
	0xff, 0xf8, 0x00, 0x00, 0x3f, 0xff, 0xff, 0xff, 0xff, 0xfc, 0x00, 0x00, 0x3f, 0xff, 0xff,
	0xff, 0xff, 0xfc, 0x00, 0x00, 0x3f, 0xff, 0xff, 0xff, 0xff, 0xfc, 0x00, 0x78, 0x7f, 0xff,
	0xff, 0xff, 0xff, 0xfe, 0x00, 0xf8, 0x7f, 0xff, 0xff, 0xff, 0xff, 0xfe, 0x00, 0xf8, 0x7f,
	0xff, 0xff, 0xff, 0xff, 0xfe, 0x00, 0x70, 0xff, 0xff, 0xff, 0xff, 0xff, 0xff, 0x00, 0x00,
	0xff, 0xff, 0xff, 0xff, 0xff, 0xff, 0x00, 0x00, 0xff, 0xff, 0xff, 0xff, 0xff, 0xff, 0x00,
	0x00, 0xff, 0xff, 0xff, 0xff, 0xff, 0xff, 0x00, 0x00, 0xff, 0xff, 0xff, 0xff, 0xff, 0xff,
	0x00, 0x00, 0xff, 0xff, 0xff, 0xff, 0xff, 0xff, 0x00, 0x00, 0xff, 0xff, 0xff, 0xff, 0xff,
	0xff, 0x00, 0x00, 0xff, 0xff, 0xff, 0xff, 0xff, 0xff, 0x00, 0x00, 0xff, 0xff, 0xff, 0xff,
	0xff, 0xff, 0x00, 0x00, 0xff, 0xff, 0xff, 0xff, 0xff, 0xff, 0x0e, 0x00, 0x7f, 0xff, 0xff,
	0xff, 0xff, 0xfe, 0x1f, 0x00, 0x7f, 0xff, 0xff, 0xff, 0xff, 0xfe, 0x1f, 0x00, 0x7f, 0xff,
	0xff, 0xff, 0xff, 0xfe, 0x1e, 0x00, 0x3f, 0xff, 0xff, 0xff, 0xff, 0xfc, 0x00, 0x00, 0x3f,
	0xff, 0xff, 0xff, 0xff, 0xfc, 0x00, 0x00, 0x3f, 0xff, 0xff, 0xff, 0xff, 0xfc, 0x00, 0x00,
	0x1f, 0xff, 0xff, 0xff, 0xff, 0xf8, 0x00, 0x00, 0x0f, 0xff, 0xff, 0xff, 0xff, 0xf0, 0x00,
	0x00, 0x0f, 0xff, 0xff, 0xff, 0xff, 0xf0, 0x00, 0x01, 0x07, 0xff, 0xff, 0xff, 0xff, 0xe0,
	0x00, 0x07, 0x83, 0xff, 0xff, 0xff, 0xff, 0xc0, 0x00, 0x07, 0x81, 0xff, 0xff, 0xff, 0xff,
	0x80, 0x00, 0x07, 0x80, 0xff, 0xff, 0xff, 0xff, 0x00, 0x00, 0x07, 0x00, 0x7f, 0xff, 0xff,
	0xfe, 0x00, 0x00, 0x00, 0x00, 0x3f, 0xff, 0xff, 0xfc, 0x00, 0x00, 0x00, 0x00, 0x0f, 0xff,
	0xff, 0xf0, 0x00, 0x00, 0x00, 0x00, 0x07, 0xff, 0xff, 0xe0, 0x00, 0x00, 0x00, 0x00, 0x00,
	0xff, 0xff, 0x00, 0x00, 0x00, 0x00, 0x00, 0x00, 0x1f, 0xf8, 0x01, 0xc0, 0x00, 0x00, 0x00,
	0x00, 0x00, 0x00, 0x03, 0xe0, 0x00, 0x00, 0x00, 0x00, 0x00, 0x00, 0x01, 0xe0, 0x00, 0x00,
	0x00, 0x00, 0x00, 0x00, 0x01, 0xe0, 0x00, 0x00, 0x00, 0x00, 0xe0, 0x00, 0x00, 0x00, 0x00,
	0x00, 0x00, 0x00, 0xf0, 0x00, 0x00, 0x00, 0x00, 0x00, 0x00, 0x00, 0xf0, 0x00, 0x00, 0x00,
	0x00, 0x00, 0x00, 0x00, 0xf0, 0x00, 0x00, 0x00, 0x00, 0x00, 0x00, 0x00, 0x60, 0x00, 0x00,
	0x00, 0x00,
};

const lv_img_header_t sunny_header = { LV_IMG_CF_ALPHA_1BIT, 0, 2, 64, 64 };

const lv_img_dsc_t sunny = { sunny_header, 512, sunny_map };

LV_IMG_DECLARE(sunny);

#endif /* LVGL_RESOURCES_H_ */
```
