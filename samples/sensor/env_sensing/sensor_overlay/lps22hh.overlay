/*
 * Copyright (c) 2019 STMicroelectronics
 *
 * SPDX-License-Identifier: Apache-2.0
 */

&arduino_i2c {
        env_sensor: lps22hh@5d {
                compatible = "st,lps22hh";
                reg = <0x5d>;
                drdy-gpios =  <&arduino_header 12 GPIO_ACTIVE_HIGH>; /* D6 */
                label = "LPS22HH";
        };
};
