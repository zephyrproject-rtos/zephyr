/*
 * Copyright (c) 2018 Alexander Wachter
 * SPDX-License-Identifier: Apache-2.0
 */

&arduino_i2c {
	status = "okay";
	clock-frequency = <I2C_BITRATE_FAST>;

	env_sensor: ens210@43 {
		compatible = "ams,ens210";
		reg = <0x43>;
		label = "ENS210";
	};
};
