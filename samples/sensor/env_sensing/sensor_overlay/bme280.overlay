/*
 * Copyright (c) 2020, Nordic Semiconductor ASA
 *
 * SPDX-License-Identifier: Apache-2.0
 */

/*
 * Example configuration of a BME280 device on an Arduino I2C bus.
 *
 * Device address 0x77 is assumed. Your device may have a different
 * address; check your device documentation if unsure.
 */
&arduino_i2c {
	status = "okay";
	bme280@77 {
		compatible = "bosch,bme280";
		reg = <0x77>;
		label = "BME280_I2C";
	};
};
