/*
 * Copyright (c) 2018 Jan Van Winkel <jan.van_winkel@dxplore.eu>
 *
 * SPDX-License-Identifier: Apache-2.0
 */

&arduino_i2c {
    status = "okay";
    clock-frequency = <I2C_BITRATE_STANDARD>;
    env_sensor: ms5837@76 {
        compatible = "meas,ms5837";
        reg = <0x76>;
        label = "MS5837";
    };
};
