/*
 * Copyright (c) 2019, Linaro Ltd.
 *
 * SPDX-License-Identifier: Apache-2.0
 */

&arduino_i2c  {
	env_sensor: mcp9808@18 {
		compatible = "microchip,mcp9808";
		reg = <0x18>;
		int-gpios = <&gpioc 16 (GPIO_PULL_UP | GPIO_ACTIVE_LOW)>;
		label = "MCP9808";
	};
};
