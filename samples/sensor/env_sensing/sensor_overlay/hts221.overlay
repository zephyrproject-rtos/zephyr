/*
 * Copyright (c) 2019 STMicroelectronics
 *
 * SPDX-License-Identifier: Apache-2.0
 */

&arduino_i2c {

        env_sensor: hts221@5f {
                compatible = "st,hts221";
                reg = <0x5f>;
                label = "HTS221";
        };
};
