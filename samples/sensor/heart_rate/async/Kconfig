## samples/sensor/heart_rate/async/Kconfig
```kconfig
# heart rate sensor
#
# Copyright (c) 2025, CATIE
#
# SPDX-License-Identifier: Apache-2.0

mainmenu "Heart rate sample application"

DT_CHOSEN_HR := heart-rate-sensor

rsource "Kconfig.base"
rsource "Kconfig.max30101"

config SAMPLE_FEATURES
    bool
    default y if $(dt_chosen_enabled,$(DT_CHOSEN_HR))
    select MAX30101_SAMPLE_FEATURES

# Sample stream
config SAMPLE_STREAM_ENABLE
    bool "Enable asynchronous sensor stream API"

config SAMPLE_STREAM_BURST
    bool "Enable burst read"

config SAMPLE_STREAM
    bool
    depends on SAMPLE_STREAM_ENABLE

source "Kconfig.zephyr"
```

## samples/sensor/heart_rate/async/Kconfig.base
```kconfig
# heart rate sensor base Kconfig
#
# Copyright (c) 2025, CATIE
#
# SPDX-License-Identifier: Apache-2.0

# Sample sensor channels
config SAMPLE_CHANNEL_RED
    bool
    depends on SAMPLE_CHANNEL_RED_ENABLE

config SAMPLE_CHANNEL_IR
    bool
    depends on SAMPLE_CHANNEL_IR_ENABLE

config SAMPLE_CHANNEL_GREEN
    bool
    depends on SAMPLE_CHANNEL_GREEN_ENABLE

config SAMPLE_CHANNEL_DIE_TEMP
    bool
    depends on SAMPLE_CHANNEL_DIE_TEMP_ENABLE

if SAMPLE_STREAM
# Sample sensor triggers opt DATA READY
config SAMPLE_TRIG_DATA_READY_NOP
    bool
    select SAMPLE_TRIGGER_DATA_READY

config SAMPLE_TRIG_DATA_READY_DROP
    bool
    select SAMPLE_TRIGGER_DATA_READY

config SAMPLE_TRIG_DATA_READY_INCLUDE
    bool
    select SAMPLE_TRIGGER_DATA_READY

config SAMPLE_TRIGGER_DATA_READY
    bool

# Sample sensor triggers chan DATA READY
config SAMPLE_TRIG_DATA_READY_NOP_CHAN_RED
    bool
    select SAMPLE_TRIGGER_DATA_READY_NOP_CHAN

config SAMPLE_TRIG_DATA_READY_NOP_CHAN_IR
    bool
    select SAMPLE_TRIGGER_DATA_READY_NOP_CHAN

config SAMPLE_TRIG_DATA_READY_NOP_CHAN_GREEN
    bool
    select SAMPLE_TRIGGER_DATA_READY_NOP_CHAN

config SAMPLE_TRIG_DATA_READY_NOP_CHAN_DIE_TEMP
    bool
    select SAMPLE_TRIGGER_DATA_READY_NOP_CHAN

config SAMPLE_TRIGGER_DATA_READY_NOP_CHAN
    bool
    select SAMPLE_TRIG_DATA_READY_NOP

config SAMPLE_TRIG_DATA_READY_INCLUDE_CHAN_RED
    bool
    select SAMPLE_TRIGGER_DATA_READY_INCLUDE_CHAN

config SAMPLE_TRIG_DATA_READY_INCLUDE_CHAN_IR
    bool
    select SAMPLE_TRIGGER_DATA_READY_INCLUDE_CHAN

config SAMPLE_TRIG_DATA_READY_INCLUDE_CHAN_GREEN
    bool
    select SAMPLE_TRIGGER_DATA_READY_INCLUDE_CHAN

config SAMPLE_TRIG_DATA_READY_INCLUDE_CHAN_DIE_TEMP
    bool
    select SAMPLE_TRIGGER_DATA_READY_INCLUDE_CHAN

config SAMPLE_TRIGGER_DATA_READY_INCLUDE_CHAN
    bool
    select SAMPLE_TRIG_DATA_READY_INCLUDE

config SAMPLE_TRIG_DATA_READY_DROP_CHAN_RED
    bool
    select SAMPLE_TRIGGER_DATA_READY_DROP_CHAN

config SAMPLE_TRIG_DATA_READY_DROP_CHAN_IR
    bool
    select SAMPLE_TRIGGER_DATA_READY_DROP_CHAN

config SAMPLE_TRIG_DATA_READY_DROP_CHAN_GREEN
    bool
    select SAMPLE_TRIGGER_DATA_READY_DROP_CHAN

config SAMPLE_TRIG_DATA_READY_DROP_CHAN_DIE_TEMP
    bool
    select SAMPLE_TRIGGER_DATA_READY_DROP_CHAN

config SAMPLE_TRIGGER_DATA_READY_DROP_CHAN
    bool
    select SAMPLE_TRIG_DATA_READY_DROP

# Sample sensor triggers opt WATERMARK
config SAMPLE_TRIG_FIFO_WATERMARK_NOP
    bool
    select SAMPLE_TRIGGER_FIFO_WATERMARK

config SAMPLE_TRIG_FIFO_WATERMARK_DROP
    bool
    select SAMPLE_TRIGGER_FIFO_WATERMARK

config SAMPLE_TRIG_FIFO_WATERMARK_INCLUDE
    bool
    select SAMPLE_TRIGGER_FIFO_WATERMARK

config SAMPLE_TRIGGER_FIFO_WATERMARK
    bool

# Sample sensor triggers chan WATERMARK
config SAMPLE_TRIG_FIFO_WATERMARK_NOP_CHAN_RED
    bool
    select SAMPLE_TRIGGER_FIFO_WATERMARK_NOP_CHAN

config SAMPLE_TRIG_FIFO_WATERMARK_NOP_CHAN_IR
    bool
    select SAMPLE_TRIGGER_FIFO_WATERMARK_NOP_CHAN

config SAMPLE_TRIG_FIFO_WATERMARK_NOP_CHAN_GREEN
    bool
    select SAMPLE_TRIGGER_FIFO_WATERMARK_NOP_CHAN

config SAMPLE_TRIG_FIFO_WATERMARK_NOP_CHAN_DIE_TEMP
    bool
    select SAMPLE_TRIGGER_FIFO_WATERMARK_NOP_CHAN

config SAMPLE_TRIGGER_FIFO_WATERMARK_NOP_CHAN
    bool
    select SAMPLE_TRIG_FIFO_WATERMARK_NOP

config SAMPLE_TRIG_FIFO_WATERMARK_INCLUDE_CHAN_RED
    bool
    select SAMPLE_TRIGGER_FIFO_WATERMARK_INCLUDE_CHAN

config SAMPLE_TRIG_FIFO_WATERMARK_INCLUDE_CHAN_IR
    bool
    select SAMPLE_TRIGGER_FIFO_WATERMARK_INCLUDE_CHAN

config SAMPLE_TRIG_FIFO_WATERMARK_INCLUDE_CHAN_GREEN
    bool
    select SAMPLE_TRIGGER_FIFO_WATERMARK_INCLUDE_CHAN

config SAMPLE_TRIG_FIFO_WATERMARK_INCLUDE_CHAN_DIE_TEMP
    bool
    select SAMPLE_TRIGGER_FIFO_WATERMARK_INCLUDE_CHAN

config SAMPLE_TRIGGER_FIFO_WATERMARK_INCLUDE_CHAN
    bool
    select SAMPLE_TRIG_FIFO_WATERMARK_INCLUDE

config SAMPLE_TRIG_FIFO_WATERMARK_DROP_CHAN_RED
    bool
    select SAMPLE_TRIGGER_FIFO_WATERMARK_DROP_CHAN

config SAMPLE_TRIG_FIFO_WATERMARK_DROP_CHAN_IR
    bool
    select SAMPLE_TRIGGER_FIFO_WATERMARK_DROP_CHAN

config SAMPLE_TRIG_FIFO_WATERMARK_DROP_CHAN_GREEN
    bool
    select SAMPLE_TRIGGER_FIFO_WATERMARK_DROP_CHAN

config SAMPLE_TRIG_FIFO_WATERMARK_DROP_CHAN_DIE_TEMP
    bool
    select SAMPLE_TRIGGER_FIFO_WATERMARK_DROP_CHAN

config SAMPLE_TRIGGER_FIFO_WATERMARK_DROP_CHAN
    bool
    select SAMPLE_TRIG_FIFO_WATERMARK_DROP

# Sample sensor triggers opt OVERFLOW
config SAMPLE_TRIG_OVERFLOW_NOP
    bool
    select SAMPLE_TRIGGER_OVERFLOW

config SAMPLE_TRIG_OVERFLOW_DROP
    bool
    select SAMPLE_TRIGGER_OVERFLOW

config SAMPLE_TRIG_OVERFLOW_INCLUDE
    bool
    select SAMPLE_TRIGGER_OVERFLOW

config SAMPLE_TRIGGER_OVERFLOW
    bool

# Sample sensor triggers chan OVERFLOW
config SAMPLE_TRIG_OVERFLOW_NOP_CHAN_RED
    bool
    select SAMPLE_TRIGGER_OVERFLOW_NOP_CHAN

config SAMPLE_TRIG_OVERFLOW_NOP_CHAN_IR
    bool
    select SAMPLE_TRIGGER_OVERFLOW_NOP_CHAN

config SAMPLE_TRIG_OVERFLOW_NOP_CHAN_GREEN
    bool
    select SAMPLE_TRIGGER_OVERFLOW_NOP_CHAN

config SAMPLE_TRIG_OVERFLOW_NOP_CHAN_DIE_TEMP
    bool
    select SAMPLE_TRIGGER_OVERFLOW_NOP_CHAN

config SAMPLE_TRIGGER_OVERFLOW_NOP_CHAN
    bool
    select SAMPLE_TRIG_OVERFLOW_NOP

config SAMPLE_TRIG_OVERFLOW_INCLUDE_CHAN_RED
    bool
    select SAMPLE_TRIGGER_OVERFLOW_INCLUDE_CHAN

config SAMPLE_TRIG_OVERFLOW_INCLUDE_CHAN_IR
    bool
    select SAMPLE_TRIGGER_OVERFLOW_INCLUDE_CHAN

config SAMPLE_TRIG_OVERFLOW_INCLUDE_CHAN_GREEN
    bool
    select SAMPLE_TRIGGER_OVERFLOW_INCLUDE_CHAN

config SAMPLE_TRIG_OVERFLOW_INCLUDE_CHAN_DIE_TEMP
    bool
    select SAMPLE_TRIGGER_OVERFLOW_INCLUDE_CHAN

config SAMPLE_TRIGGER_OVERFLOW_INCLUDE_CHAN
    bool
    select SAMPLE_TRIG_OVERFLOW_INCLUDE

config SAMPLE_TRIG_OVERFLOW_DROP_CHAN_RED
    bool
    select SAMPLE_TRIGGER_OVERFLOW_DROP_CHAN

config SAMPLE_TRIG_OVERFLOW_DROP_CHAN_IR
    bool
    select SAMPLE_TRIGGER_OVERFLOW_DROP_CHAN

config SAMPLE_TRIG_OVERFLOW_DROP_CHAN_GREEN
    bool
    select SAMPLE_TRIGGER_OVERFLOW_DROP_CHAN

config SAMPLE_TRIG_OVERFLOW_DROP_CHAN_DIE_TEMP
    bool
    select SAMPLE_TRIGGER_OVERFLOW_DROP_CHAN

config SAMPLE_TRIGGER_OVERFLOW_DROP_CHAN
    bool
    select SAMPLE_TRIG_OVERFLOW_DROP
endif # SAMPLE_STREAM
```

## samples/sensor/heart_rate/async/Kconfig.max30101
```kconfig
# MAX30101 Kconfig file
#
# Copyright (c) 2025, CATIE
#
# SPDX-License-Identifier: Apache-2.0

DT_COMPAT_MAX30101 := maxim,max30101
DT_ARRAY_PROP_SLOT := led-slot

config MAX30101_SAMPLE_FEATURES
    bool
    depends on DT_HAS_MAXIM_MAX30101_ENABLED
    depends on $(dt_chosen_has_compat,$(DT_CHOSEN_HR),$(DT_COMPAT_MAX30101))
    imply SAMPLE_CHANNEL_RED if $(dt_nodelabel_array_prop_has_val,$(dt_chosen_label,$(DT_CHOSEN_HR)),$(DT_ARRAY_PROP_SLOT),1)
    imply SAMPLE_CHANNEL_IR if $(dt_nodelabel_array_prop_has_val,$(dt_chosen_label,$(DT_CHOSEN_HR)),$(DT_ARRAY_PROP_SLOT),2)
    imply SAMPLE_CHANNEL_GREEN if $(dt_nodelabel_array_prop_has_val,$(dt_chosen_label,$(DT_CHOSEN_HR)),$(DT_ARRAY_PROP_SLOT),3)
    imply SAMPLE_CHANNEL_DIE_TEMP if MAX30101_DIE_TEMPERATURE
    select SAMPLE_TRIG_DATA_READY_INCLUDE if MAX30101_TRIGGER && !SAMPLE_STREAM_BURST
    select SAMPLE_TRIG_DATA_READY_INCLUDE_CHAN_DIE_TEMP if MAX30101_TRIGGER && (SAMPLE_STREAM_BURST && MAX30101_DIE_TEMPERATURE)
    select SAMPLE_TRIG_FIFO_WATERMARK_INCLUDE if MAX30101_TRIGGER && SAMPLE_STREAM_BURST
    select SAMPLE_TRIG_OVERFLOW_NOP if MAX30101_TRIGGER
    imply SAMPLE_STREAM if MAX30101_STREAM

if MAX30101_SAMPLE_FEATURES

config MAX30101_SLOT0_VAL_$(dt_node_array_prop_int,$(dt_nodelabel_path,$(dt_chosen_label,$(DT_CHOSEN_HR))),$(DT_ARRAY_PROP_SLOT),0)
    bool
    default y

config MAX30101_SLOT1_VAL_$(dt_node_array_prop_int,$(dt_nodelabel_path,$(dt_chosen_label,$(DT_CHOSEN_HR))),$(DT_ARRAY_PROP_SLOT),1)
    bool
    default y

config MAX30101_SLOT2_VAL_$(dt_node_array_prop_int,$(dt_nodelabel_path,$(dt_chosen_label,$(DT_CHOSEN_HR))),$(DT_ARRAY_PROP_SLOT),2)
    bool
    default y

if SAMPLE_CHANNEL_RED

config SAMPLE_CHANNEL_RED_0
    bool
    default y if MAX30101_SLOT0_VAL_1 || MAX30101_SLOT1_VAL_1 || MAX30101_SLOT2_VAL_1

config SAMPLE_CHANNEL_RED_1
    bool
    default y if (MAX30101_SLOT0_VAL_1 && (MAX30101_SLOT1_VAL_1 || MAX30101_SLOT2_VAL_1)) || (MAX30101_SLOT1_VAL_1 && MAX30101_SLOT2_VAL_1)

config SAMPLE_CHANNEL_RED_2
    bool
    default y if MAX30101_SLOT0_VAL_1 && MAX30101_SLOT1_VAL_1 && MAX30101_SLOT2_VAL_1

endif # SAMPLE_CHANNEL_RED

if SAMPLE_CHANNEL_IR

config SAMPLE_CHANNEL_IR_0
    bool
    default y if MAX30101_SLOT0_VAL_2 || MAX30101_SLOT1_VAL_2 || MAX30101_SLOT2_VAL_2

config SAMPLE_CHANNEL_IR_1
    bool
    default y if (MAX30101_SLOT0_VAL_2 && (MAX30101_SLOT1_VAL_2 || MAX30101_SLOT2_VAL_2)) || (MAX30101_SLOT1_VAL_2 && MAX30101_SLOT2_VAL_2)

config SAMPLE_CHANNEL_IR_2
    bool
    default y if MAX30101_SLOT0_VAL_2 && MAX30101_SLOT1_VAL_2 && MAX30101_SLOT2_VAL_2

endif # SAMPLE_CHANNEL_IR

if SAMPLE_CHANNEL_GREEN

config SAMPLE_CHANNEL_GREEN_0
    bool
    default y if MAX30101_SLOT0_VAL_3 || MAX30101_SLOT1_VAL_3 || MAX30101_SLOT2_VAL_3

config SAMPLE_CHANNEL_GREEN_1
    bool
    default y if (MAX30101_SLOT0_VAL_3 && (MAX30101_SLOT1_VAL_3 || MAX30101_SLOT2_VAL_3)) || (MAX30101_SLOT1_VAL_3 && MAX30101_SLOT2_VAL_3)

config SAMPLE_CHANNEL_GREEN_2
    bool
    default y if MAX30101_SLOT0_VAL_3 && MAX30101_SLOT1_VAL_3 && MAX30101_SLOT2_VAL_3

endif # SAMPLE_CHANNEL_GREEN

if SAMPLE_CHANNEL_DIE_TEMP

config SAMPLE_CHANNEL_DIE_TEMP_0
    bool
    default y

endif # SAMPLE_CHANNEL_DIE_TEMP

endif # MAX30101_SAMPLE_FEATURES
```

## samples/sensor/heart_rate/sample.yaml
```yaml
sample:
  name: Heart Rate Sensor Sample
tests:
  sample.sensor.heart_rate:
    harness: sensor
    tags: sensors
    platform_allow: hexiwear/mk64f12
    depends_on: i2c
    integration_platforms:
      - hexiwear/mk64f12
```

## samples/sensor/hmc5883l/sample.yaml
```yaml
sample:
  name: HMC5883L Sensor Sample
tests:
  sample.sensor.hmc5883l:
    harness: sensor
    tags: sensors
    pre-filter: subsys_dt_compat_enabled("i2c") and subsys_dt_compat_enabled("gpio")
    filter: dt_compat_enabled("honeywell,hmc5883l")
```

## samples/sensor/hts221/sample.yaml
```yaml
sample:
  name: HTS221 Temperature and Humidity Monitor
common:
  harness: console
  integration_platforms:
    - disco_l475_iot1
  filter: dt_compat_enabled("st,hts221")
  tags: sensors
  depends_on:
    - i2c
    - hts221
  harness_config:
    type: multi_line
    ordered: true
    regex:
      - "Observation:(.*)"
      - "Temperature:(.*) C"
      - "Relative Humidity:(.*)%"
tests:
  sample.sensor.hts221:
    extra_configs:
      - CONFIG_HTS221_TRIGGER_NONE=y
  sample.sensor.hts221.trigger:
    extra_configs:
      - CONFIG_HTS221_TRIGGER_OWN_THREAD=y
    platform_exclude:
      - b_u585i_iot02a
```

## samples/sensor/htu21d/sample.yaml
```yaml
sample:
  name: HTU21D Sensor Sample
tests:
  sample.sensor.htu21d:
    build_only: true
    tags: sensors
    platform_whitelist: hexiwear_k64
    depends_on: i2c
```

## samples/sensor/hx711/sample.yaml
```yaml
sample:
  name: HX711 24-Bit Analog-to-Digital Converter (ADC) for Weigh Scales
tests:
  sample.sensor.hx711:
    build_only: true
    tags: sensors
    depends_on: gpio
    filter: dt_compat_enabled("avia,hx711")
    platform_allow:
      - nrf52dk/nrf52832
      - stm32f769i_disco/stm32f769xx
```

## samples/sensor/icm20948/sample.yaml
```yaml
# Copyright The Zephyr Project Contributors
# SPDX-License-Identifier: Apache-2.0

sample:
  name: ICM-20948 Sensor Sample
tests:
  sample.sensor.icm20948:
    build_only: true
    platform_allow: nrf52840dk/nrf52840
    tags: sensors
    integration_platforms:
      - nrf52840dk/nrf52840
```

## samples/sensor/icm42370/sample.yaml
```yaml
#
# Copyright (c) 2024 TDK Invensense
#
# SPDX-License-Identifier: Apache-2.0
#

sample:
  name: ICM42370 Sensor Sample
tests:
  sample.sensor.icm42370:
    build_only: true
    depends_on: i2c
    platform_allow: nrf52dk/nrf52832
    integration_platforms:
      - nrf52dk/nrf52832
    tags: sensors
```

## samples/sensor/icm42605/sample.yaml
```yaml
#
# Copyright (c) 2020 TDK Invensense
#
# SPDX-License-Identifier: Apache-2.0
#

sample:
  name: ICM42605 Sensor Sample
tests:
  sample.sensor.icm42605:
    build_only: true
    platform_allow: nrf52dk/nrf52832
    integration_platforms:
      - nrf52dk/nrf52832
    tags: sensors
```

## samples/sensor/icm4268x/sample.yaml
```yaml
#
# Copyright 2024 NXP
#
# SPDX-License-Identifier: Apache-2.0
#

sample:
  name: ICM4268x Sensor Sample
tests:
  sample.sensor.icm42688:
    build_only: true
    platform_allow: vmu_rt1170/mimxrt1176/cm7
    integration_platforms:
      - vmu_rt1170/mimxrt1176/cm7
    tags: sensors
```

## samples/sensor/icp101xx/sample.yaml
```yaml
sample:
  name: ICP101XX Sensor data sample
tests:
  sample.sensor.icp101xx:
    build_only: true
    depends_on: i2c
    tags: sensors
    integration_platforms:
      - nrf52dk/nrf52832
    platform_exclude:
      - tdk_robokit1
```

## samples/sensor/ina219/sample.yaml
```yaml
#
# Copyright (c) 2021 Leonard Pollak
#
# SPDX-License-Identifier: Apache-2.0


sample:
  name: TI INA219 power/current monitor
  description: Demonstration of the INA219 I2C power/current monitor
tests:
  sample.drivers.ina219:
    build_only: true
    platform_allow: blackpill_f411ce
    tags: sensors
```

## samples/sensor/ina228/sample.yaml
```yaml
# Copyright (c) 2025 Jonas Berg
# SPDX-License-Identifier: Apache-2.0

sample:
  name: TI INA228 Power/Energy/Charge Monitor
tests:
  sample.drivers.ina228:
    build_only: true
    platform_allow: rpi_pico/rp2040/w
    tags: sensors
```

## samples/sensor/isl29035/sample.yaml
```yaml
sample:
  name: ISL29035 Digital Light Sensor
tests:
  sample.sensor.isl29035:
    tags: sensors
    depends_on: i2c
    platform_allow: nrf52dk/nrf52832
    integration_platforms:
      - nrf52dk/nrf52832
    harness: console
    harness_config:
      type: one_line
      regex:
        - "Ambient light sense"
      fixture: fixture_isl29035
```

## samples/sensor/isl29125/sample.yaml
```yaml
sample:
  name: ISL29125 Digital Light Sensor
tests:
  sample.sensor.isl29125:
    harness: console
    tags: sensors
    depends_on: gpio,i2c
    platform_whitelist: nrf52840_pca10056
```

## samples/sensor/ism330dhcx/sample.yaml
```yaml
sample:
  name: ISM330DHCX accelerometer and gyrometer sensor
tests:
  sample.sensor.ism330dhcx:
    harness: console
    tags: sensors
    depends_on: i2c
    filter: dt_compat_enabled("st,ism330dhcx")
    timeout: 15
    harness_config:
      type: multi_line
      ordered: true
      regex:
        - "accel x:[-.0-9]* m/s2 y:[-.0-9]* m/s2 z:[-.0-9]* m/s2"
        - "gyro x:[-.0-9]* dps y:[-.0-9]* dps z:[-.0-9]* dps"
        - "trig_cnt:[0-9]*"
```

## samples/sensor/jc42/sample.yaml
```yaml
sample:
  name: JEDEC JC 42.4 compliant Temperature Sensor
tests:
  sample.sensor.jc42:
    harness: sensor
    tags: sensors
    min_ram: 8
    depends_on: i2c
    filter: dt_compat_enabled("jedec,jc-42.4-temp")
    platform_allow:
      - adafruit_qt_py_rp2040/rp2040
      - nucleo_l053r8
    integration_platforms:
      - nucleo_l053r8
    extra_args:
      - platform:adafruit_qt_py_rp2040/rp2040:SHIELD="adafruit_mcp9808"
```
