## samples/sensor/kx022/sample.yaml
```yaml
sample:
  name: KX022 Accelerometer Monitor
tests:
  sample.sensor.kx022:
    harness: sensor
    tags: samples sensor
    depends_on: i2c kx022
```

## samples/sensor/light_polling/sample.yaml
```yaml
sample:
  name: Light Sensor Polling Sample
common:
  filter: dt_alias_exists("light-sensor")
tests:
  sample.sensor.light_polling.grove:
    tags:
      - drivers
      - sensor
      - grove
      - light
    platform_allow:
      - nrf52dk/nrf52832
    integration_platforms:
      - nrf52dk/nrf52832
    harness: grove
    depends_on: adc
  sample.sensor.light_polling:
    tags:
      - drivers
      - sensor
      - light
    integration_platforms:
      - frdm_mcxw71/mcxw716c
      - adafruit_qt_py_rp2040/rp2040       # adafruit_tsl2591 shield
      - mikroe_clicker_ra4m1/r7fa4m1ab3cfm # mikroe_ambient_2_click shield
      - mikroe_quail/stm32f427xx           # mikroe_illuminance_click shield
    extra_args:
      - platform:adafruit_qt_py_rp2040/rp2040:SHIELD="adafruit_tsl2591"
      - platform:mikroe_clicker_ra4m1/r7fa4m1ab3cfm:SHIELD="mikroe_ambient_2_click"
      - platform:mikroe_quail/stm32f427xx:SHIELD="mikroe_illuminance_click"
```

## samples/sensor/lis2dh/sample.yaml
```yaml
sample:
  name: LIS2DH Accelerometer Monitor
tests:
  sample.sensor.lis2dh:
    filter: dt_compat_enabled("st,lis2dh")
    harness: sensor
    tags:
      - samples
      - sensor
    depends_on:
      - i2c
    integration_platforms:
      - sparkfun_thing_plus/nrf9160
```

## samples/sensor/lm73c/sample.yaml
```yaml
sample:
  name: LM73C I2C Temperature Sensor
tests:
  sample.sensor.lm73c:
    harness: sensor
    tags: sensors
    depends_on: i2c
    filter: dt_compat_enabled("ti,lm73c")
```

## samples/sensor/lps22hb/sample.yaml
```yaml
sample:
  name: LPS22HB Temperature and Humidity Monitor
tests:
  sample.sensor.lps22hb:
    harness: console
    tags: sensors
    pre-filter: subsys_dt_compat_enabled("i2c")
    filter: dt_compat_enabled("st,lps22hb-press")
    harness_config:
        type: multi_line
        ordered: yes
        regex:
            - "Temperature: (.*)"
            - "Relative Humidity: (.*)"
        fixture: fixture_i2c_lps22hb
```
