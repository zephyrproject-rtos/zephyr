/*
 * Copyright (c) 2021 Teslabs Engineering S.L.
 *
 * SPDX-License-Identifier: Apache-2.0
 */

&arduino_spi {
	max6675@0 {
		compatible = "maxim,max6675";
		reg = <0>;
		spi-max-frequency = <4300000>;
		label = "MAX6675";
	};
};
