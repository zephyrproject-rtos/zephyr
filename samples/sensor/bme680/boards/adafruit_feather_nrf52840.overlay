/*
 * Copyright (c) 2020, Patrick Moffitt <patrick@moffitt.com>
 *
 * SPDX-License-Identifier: Apache-2.0
 *
 * i2c interface for the Feather nRF52840 Express and the
 * Adafruit BME680.
 */

&i2c0 {
	compatible = "nordic,nrf-twi";
	bme680: bme680@77 {
		compatible = "bosch,bme680";
		reg = <0x77>;
	};
};
