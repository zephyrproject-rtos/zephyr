/*
 * Copyright (c) 2024 Nordic Semiconductor ASA
 *
 * SPDX-License-Identifier: Apache-2.0
 */

&i2c0 { /* SDA P0.26, SCL P0.27, DRDY P0.11 */
	status = "okay";
	clock-frequency = <I2C_BITRATE_STANDARD>;
	bmm350@14 {
		compatible = "bosch,bmm350";
		reg = <0x14>;
		drdy-gpios = <&gpio0 11 GPIO_ACTIVE_LOW>;
	};
};
