/*
 * Copyright (c) 2018 Jan Van Winkel <jan.van_winkel@dxplore.eu>
 *
 * SPDX-License-Identifier: Apache-2.0
 */

&i2c1 {
	clock-frequency = <I2C_BITRATE_STANDARD>;
	status = "okay";

	ms5837@76 {
		compatible = "meas,ms5837-30ba";
		reg = <0x76>;
		status = "okay";
	};
};
