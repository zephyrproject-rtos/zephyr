## CMakeLists.txt
```
cmake_minimum_required(VERSION 3.8.2)
#
# Copyright (c) 2018 Lars Knudsen
#
# SPDX-License-Identifier: Apache-2.0
#

include($ENV{ZEPHYR_BASE}/cmake/app/boilerplate.cmake NO_POLICY_SCOPE)
project(NONE)

target_sources(app PRIVATE src/main.c)
```

## sample.yaml
```
sample:
  name: MMA8451Q Accelerometer/Magnetometer Sensor
tests:
  test:
    harness: sensor
    platform_whitelist: frdm_kl25z
    tags: sensors
    depends_on: i2c
```

## prj.conf
```kconfig
CONFIG_STDOUT_CONSOLE=y
CONFIG_LOG=y
CONFIG_SENSOR_LOG_LEVEL_INF=y
CONFIG_I2C=y
CONFIG_SENSOR=y
CONFIG_MMA8451Q=y
```

## src/main.c
```c
/*
 * Copyright (c) 2018 Lars Knudsen
 *
 * SPDX-License-Identifier: Apache-2.0
 */

#include <zephyr.h>
#include <sensor.h>
#include <stdio.h>

void main(void)
{
	struct device *dev = device_get_binding(CONFIG_MMA8451Q_NAME);

	if (dev == NULL) {
		printf("Could not get MMA8451Q device\n");
		return;
	}

	int err;
	struct sensor_value x, y, z;

	printf("XYZ Sensor readings:\n");

	while (1) {
		err = sensor_sample_fetch(dev);
		if (err) {
			printk("Failed to fetch sample for device %s (%d)\n",
					"MMA8451Q", err);
		} else {
			sensor_channel_get(dev, SENSOR_CHAN_ACCEL_X, &x);
			sensor_channel_get(dev, SENSOR_CHAN_ACCEL_Y, &y);
			sensor_channel_get(dev, SENSOR_CHAN_ACCEL_Z, &z);

			printf("X: %10.6f, Y: %10.6f, Z: %10.6f\n",
				sensor_value_to_double(&x),
				sensor_value_to_double(&y),
				sensor_value_to_double(&z));
		}
		k_sleep(500);
	}
}
```
