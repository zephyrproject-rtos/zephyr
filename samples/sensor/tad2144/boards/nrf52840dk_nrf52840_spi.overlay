/*
 * Copyright (c) 2024, TDK Invensense
 *
 * SPDX-License-Identifier: Apache-2.0
 */

/*
 * Example configuration of a TAD2144 device on spi2 compatible with an Arduino SPI bus.
 */

&arduino_spi {
	status = "okay";
	cs-gpios = <&gpio1 10 GPIO_ACTIVE_LOW>;

	tad2144: tad2144@0 {
		compatible = "invensense,tad2144";
		reg = <0>;
		spi-max-frequency = <1000000>; /* conservatively set to 1MHz */
		int-gpios = <&arduino_header 2 GPIO_ACTIVE_HIGH>;
	};
};
