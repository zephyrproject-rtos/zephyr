/*
 * Copyright (c) 2024, TDK Invensense
 *
 * SPDX-License-Identifier: Apache-2.0
 */

/*
 * Example configuration of a TAD2144 device on encoder interface.
 */
/ {
    tad2144_encoder: tad2144_encoder {
        compatible = "invensense,tad2144";
        status = "okay";

        encb-gpios = <&gpio0 22 (GPIO_PULL_UP | GPIO_ACTIVE_HIGH)>;
        enca-gpios = <&gpio0 21 (GPIO_PULL_UP | GPIO_ACTIVE_HIGH)>;
        encz-gpios = <&gpio0 23 (GPIO_PULL_UP | GPIO_ACTIVE_HIGH)>;
    };
};
