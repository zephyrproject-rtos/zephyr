/*
 * Copyright (c) 2018 Alexander Wachter
 * SPDX-License-Identifier: Apache-2.0
 */

&arduino_i2c {
	clock-frequency = <I2C_BITRATE_STANDARD>;
	status = "okay";

	iaqcore: iaqcore@5a {
		compatible = "ams,iaqcore";
		reg = <0x5a>;
	};
};
