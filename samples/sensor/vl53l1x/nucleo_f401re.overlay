/*
 * Copyright (c) 2019 Peter Bigot Consulting, LLC
 *
 * SPDX-License-Identifier: Apache-2.0
 */

&i2c1 { /* SDA CN5.9=PB9, SCL CN5.10=PB8, INT CN8.3=A2=PA4 */
	vl53l1x@29 {
		compatible = "st,vl53l1x";
		reg = <0x29>;
		label = "VL53L1X";
		drdy-gpios = <&gpioa 4 GPIO_INT_ACTIVE_LOW>;
	};
};

