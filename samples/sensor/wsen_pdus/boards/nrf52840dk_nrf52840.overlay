/*
 * Copyright (c) 2022 Würth Elektronik eiSos GmbH & Co. KG
 *
 * SPDX-License-Identifier: Apache-2.0
 */

&i2c0 {
	pdus@78 {
		compatible = "we,wsen-pdus";
		reg = <0x78>;
		label = "PDUS";
		sensor-type = <3>;
	};
};