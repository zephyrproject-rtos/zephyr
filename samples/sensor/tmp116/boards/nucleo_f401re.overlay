/*
 * Copyright (c) 2019 Centaur Analytics, Inc
 *
 * SPDX-License-Identifier: Apache-2.0
 */

&i2c1 {

	ti_tmp116: ti_tmp116@4b {
		compatible = "ti,tmp116";
		reg = <0x4B>;
		#address-cells = <1>;
		#size-cells = <0>;

		eeprom: ti_tmp116_eeprom@0 {
			compatible = "ti,tmp116-eeprom";
			reg = <0x0>;
			read-only;
		};
	};

};
