/*
 * Copyright The Zephyr Project Contributors
 * SPDX-License-Identifier: Apache-2.0
 */

#include <zephyr/dt-bindings/sensor/icm20948.h>

/* I2C0: SCL=P0.27, SDA=P0.26 (Arduino header) */
&i2c0 {
	imu: icm20948@68 {
		compatible = "invensense,icm20948";
		status = "okay";
		reg = <0x68>;
		int-gpios = <&gpio0 11 GPIO_ACTIVE_HIGH>;
		mag-mode = <ICM20948_DT_MAG_MODE_100HZ>; /* 100Hz magnetometer */
	};
};
