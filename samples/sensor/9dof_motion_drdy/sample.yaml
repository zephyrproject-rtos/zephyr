## samples/sensor/9dof_motion_drdy/sample.yaml
```yaml
# Copyright The Zephyr Project Contributors
# SPDX-License-Identifier: Apache-2.0

sample:
  name: 9DOF Motion dataready sample
tests:
  sample.sensor.9dof_motion_drdy:
    build_only: true
    platform_allow: nrf52840dk/nrf52840
    tags: sensors
    integration_platforms:
      - nrf52840dk/nrf52840
```

## samples/sensor/a01nyub/sample.yaml
```yaml
# Copyright (c) 2023 SteadConnect
# SPDX-License-Identifier: Apache-2.0

sample:
  name: A01NYUB distance sensor
tests:
  sample.sensor.a01nyub:
    build_only: true
    harness: sensor
    tags:
      - sensor
      - serial
      - uart
    depends_on: serial
    filter: dt_compat_enabled("dfrobot,a01nyub") and CONFIG_SERIAL and
            CONFIG_UART_INTERRUPT_DRIVEN
```

## samples/sensor/accel_polling/sample.yaml
```yaml
sample:
  name: Accelerometer polling sample
common:
  tags: sensors
  harness: console
  harness_config:
    type: one_line
    regex:
      - "^\\s*[0-9A-Za-z_,+-.]*@[0-9A-Fa-f]* \\[m\/s\\^2\\]:    \
         \\(\\s*-?[0-9\\.]*,\\s*-?[0-9\\.]*,\\s*-?[0-9\\.]*\\)$"
tests:
  sample.sensor.accel_polling:
    filter: dt_alias_exists("accel0")
    integration_platforms:
      - cc1352r_sensortag               # adxl362
      - blueclover_plt_demo_v2/nrf52832 # bmi270
      - frdm_kl25z                      # mma8451q
      - lpcxpresso55s28                 # mma8652fc
      - bbc_microbit                    # mmc8653fc
      - frdm_k64f                       # fxos8700
      - mimxrt1040_evk                  # fxls8974
      - sparkfun_thing_plus/nrf9160     # lis2dh
      - thingy52/nrf52832               # lis2dh12
      - stm32f411e_disco                # lsm303agr_accel
      - stm32f3_disco                   # lsm303dlhc_accel
      - bl5340_dvk/nrf5340/cpuapp       # lis3dh
      - b_l4s5i_iot01a                  # lsm6dsl
      - sensortile_box                  # lis2dw12, lsm6dso, iisdhhc
      - thingy53/nrf5340/cpuapp         # adxl362, bmi270
      - frdm_mcxw23                     # fxls8974
  sample.sensor.accel_polling.adxl345-stream:
    extra_args:
      - SHIELD=pmod_acl
      - EXTRA_CONF_FILE=adxl345-stream.conf
      - SNIPPET=rtt-tracing;rtt-console
    extra_configs:
      - CONFIG_UART_CONSOLE=n
    platform_allow:
      - apard32690/max32690/m4
  sample.sensor.accel_polling.adxl362-stream:
    extra_args:
      - SHIELD=eval_adxl362_ardz
      - EXTRA_CONF_FILE=adxl362-stream.conf
      - SNIPPET=rtt-tracing;rtt-console
    extra_configs:
      - CONFIG_UART_CONSOLE=n
    platform_allow:
      - apard32690/max32690/m4
  sample.sensor.accel_polling.adxl367-stream:
    extra_args:
      - SHIELD="eval_adxl367_ardz"
      - EXTRA_CONF_FILE="adxl367-stream.conf"
      - SNIPPET="rtt-tracing;rtt-console"
    platform_allow:
      - apard32690/max32690/m4
  sample.sensor.accel_polling.adxl372-stream:
    extra_args:
      - SHIELD="eval_adxl372_ardz"
      - EXTRA_CONF_FILE="adxl372-stream.conf"
      - SNIPPET="rtt-tracing;rtt-console"
    platform_allow:
      - apard32690/max32690/m4
  sample.sensor.accel_polling.shields:
    build_only: true
    platform_allow:
      - adafruit_qt_py_rp2040/rp2040
    extra_args:
      - platform:adafruit_qt_py_rp2040/rp2040:SHIELD="adafruit_lis3dh"
```

## samples/sensor/accel_stream/sample.yaml
```yaml
sample:
  name: Accelerometer polling sample
common:
  tags: sensors
  harness: console
  harness_config:
    type: one_line
    regex:
      - "^\\s*[0-9A-Za-z_,+-.]*@[0-9A-Fa-f]* \\[m\/s\\^2\\]:    \
         \\(\\s*-?[0-9\\.]*,\\s*-?[0-9\\.]*,\\s*-?[0-9\\.]*\\)$"
tests:
  sample.sensor.accel_stream:
    filter: dt_alias_exists("accel0")
    integration_platforms:
      - cc1352r_sensortag               # adxl362
      - thingy53/nrf5340/cpuapp         # adxl362, bmi270
  sample.sensor.accel_stream.adxl345-stream:
    extra_args:
      - SHIELD=pmod_acl
      - EXTRA_CONF_FILE=adxl345-stream.conf
      - SNIPPET=rtt-tracing;rtt-console
    extra_configs:
      - CONFIG_UART_CONSOLE=n
    platform_allow:
      - apard32690/max32690/m4
  sample.sensor.accel_stream.adxl362-stream:
    extra_args:
      - SHIELD=eval_adxl362_ardz
      - EXTRA_CONF_FILE=adxl362-stream.conf
      - SNIPPET=rtt-tracing;rtt-console
    extra_configs:
      - CONFIG_UART_CONSOLE=n
    platform_allow:
      - apard32690/max32690/m4
  sample.sensor.accel_stream.adxl367-stream:
    extra_args:
      - SHIELD="eval_adxl367_ardz"
      - EXTRA_CONF_FILE="adxl367-stream.conf"
      - SNIPPET="rtt-tracing;rtt-console"
    platform_allow:
      - apard32690/max32690/m4
  sample.sensor.accel_stream.adxl372-stream:
    extra_args:
      - SHIELD="eval_adxl372_ardz"
      - EXTRA_CONF_FILE="adxl372-stream.conf"
      - SNIPPET="rtt-tracing;rtt-console"
    platform_allow:
      - apard32690/max32690/m4
  sample.sensor.accel_stream.shields:
    build_only: true
    platform_allow:
      - adafruit_qt_py_rp2040/rp2040
    extra_args:
      - platform:adafruit_qt_py_rp2040/rp2040:SHIELD="adafruit_lis3dh"
```

## samples/sensor/accel_trig/boards/mimxrt1160_evk_mimxrt1166_cm7.conf
```kconfig
#
# check the fxos8700 dts for this board for addition settings
#

CONFIG_FXOS8700_TRIGGER_OWN_THREAD=y
CONFIG_FXOS8700_MODE_ACCEL=y
```

## samples/sensor/accel_trig/boards/stm32f3_disco.conf
```kconfig
CONFIG_I2C=y
CONFIG_SENSOR_LOG_LEVEL_DBG=y
CONFIG_LIS2DW12_TRIGGER_GLOBAL_THREAD=y
CONFIG_LIS2DW12_TAP=y
```

## samples/sensor/accel_trig/sample.yaml
```yaml
sample:
  name: Accelerometer trigger sample
common:
  tags: sensors
  harness: console
  harness_config:
    type: one_line
    regex:
      - "^\\s*[0-9A-Za-z_,+-.]*@[0-9A-Fa-f]* \\[m\/s\\^2\\]:    \
        \\(\\s*-?[0-9\\.]*,\\s*-?[0-9\\.]*,\\s*-?[0-9\\.]*\\)$"
tests:
  sample.sensor.accel_trig:
    filter: dt_alias_exists("accel0")
    harness_config:
      type: one_line
      regex:
        - "^\\s*[0-9A-Za-z_,+-.]*@[0-9A-Fa-f]* \\[m\/s\\^2\\]:    \
          \\(\\s*-?[0-9\\.]*,\\s*-?[0-9\\.]*,\\s*-?[0-9\\.]*\\)$"
      fixture: fixture_sensor_accel_int
    integration_platforms:
      - frdm_k64f                          # fxos8700
      - mikroe_clicker_ra4m1/r7fa4m1ab3cfm # mikroe_lsm6dsl_click shield
    platform_exclude:
      - sensortile_box
      - stm32f3_disco
      - stm32f411e_disco
      - b_l4s5i_iot01a
      - disco_l475_iot1
      - stm32l562e_dk
      - stm32wb5mm_dk
    extra_args:
      - platform:mikroe_clicker_ra4m1/r7fa4m1ab3cfm:SHIELD="mikroe_lsm6dsl_click"
  sample.sensor.accel_trig.adxl345-trigger:
    extra_args:
      - SHIELD=pmod_acl
      - EXTRA_CONF_FILE=adxl345-trigger.conf
      - SNIPPET=rtt-tracing;rtt-console
    extra_configs:
      - CONFIG_UART_CONSOLE=n
    platform_allow:
      - apard32690/max32690/m4
  sample.sensor.accel_trig.adxl362-trigger:
    extra_args:
      - SHIELD=eval_adxl362_ardz
      - EXTRA_CONF_FILE=adxl362-trigger.conf
      - SNIPPET=rtt-tracing;rtt-console
    extra_configs:
      - CONFIG_UART_CONSOLE=n
    platform_allow:
      - apard32690/max32690/m4
  sample.sensor.accel_trig.shield-tap:
    harness_config:
      fixture: fixture_x_nucleo_iks01a3
    extra_args:
      - SHIELD=x_nucleo_iks01a3
      - EXTRA_DTC_OVERLAY_FILE=x_nucleo_iks01a3.overlay
      - CONFIG_SAMPLE_TAP_DETECTION=y
    depends_on:
      - arduino_i2c
      - arduino_gpio
    platform_allow:
      - nrf52dk/nrf52832
    integration_platforms:
      - nrf52dk/nrf52832
  sample.sensor.accel_trig.generic-tap:
    filter: dt_compat_enabled("nxp,fxos8700") or dt_compat_enabled("invensense,icm42605") or
            dt_compat_enabled("st,iis2dlpc") or dt_compat_enabled("st,lis2dw12")
    extra_args:
      - CONFIG_SAMPLE_TAP_DETECTION=y
    integration_platforms:
      - stm32f3_disco
```

## samples/sensor/acs71020/sample.yaml
```yaml
sample:
  name: BBTherm
tests:
sample.sensor.acs71020:
  harness: console
  tags: sensors
  harness_config:
      type: one_line
      regex:
          - "vrms: (.*); irms: (.*); pactive: (.*)"
      fixture: fixture_i2c_acs71020
  depends_on: i2c
  filter: dt_compat_enabled("allegro,acs71020")
```

## samples/sensor/adc_cmp_npcx/sample.yaml
```yaml
sample:
  description: Demonstration of nuvoton NPCX ADC comparator driver
  name: NPCX ADC comparator sample
common:
  platform_allow:
    - npcx9m6f_evb
  integration_platforms:
    - npcx9m6f_evb
  tags:
    - drivers
    - adc
tests:
  sample.sensor.adc_cmp:
    harness: console
    harness_config:
      type: multi_line
      ordered: true
      regex:
        - "ADC CMP: Set Upper threshold"
        - "ADC CMP: Upper threshold detected"
```

## samples/sensor/ade9153a_shield/Kconfig
```kconfig
# Copyright (c) 2020, Nordic Semiconductor ASA
# SPDX-License-Identifier: Apache-2.0

config LOG
	default y

config LOG_PRINTK
	default y

config SENSOR_LOG_LEVEL
	default 4

source "Kconfig.zephyr"
```

## samples/sensor/adt7420/sample.yaml
```yaml
sample:
  name: ADT7420 Sensor Sample
tests:
  sample.sensor.adt7420:
    harness: sensor
    tags: sensors
    platform_allow:
      - frdm_k64f
    depends_on: i2c
```

## samples/sensor/adxl345/Kconfig
```kconfig
# Copyright (c) 2022 TOKITA Hiroshi <tokita.hiroshi@fujitsu.com>
# SPDX-License-Identifier: Apache-2.0

# Workaround for not being able to have commas in macro arguments
DT_COMPAT_ADI_ADXL345 := adi,adxl345

config SPI
	default $(dt_compat_on_bus,$(DT_COMPAT_ADI_ADXL345),spi)

config I2C
	default $(dt_compat_on_bus,$(DT_COMPAT_ADI_ADXL345),i2c)

source "Kconfig.zephyr"
```

## samples/sensor/adxl345/sample.yaml
```yaml
sample:
  name: ADXL345 Sensor sample
tests:
  sample.sensor.adxl345.i2c:
    harness: console
    tags: sensors
    depends_on: arduino_i2c
    filter: dt_compat_enabled("adi,adxl345")
    extra_args: DTC_OVERLAY_FILE="arduino_i2c.overlay"
    harness_config:
      type: one_line
      regex:
        - "accel x:[-.0-9]* y:[-.0-9]* z:[-.0-9]* \\(m/s\\^2\\)"
  sample.sensor.adxl345.spi:
    harness: console
    tags: sensors
    depends_on: arduino_spi
    filter: dt_compat_enabled("adi,adxl345")
    extra_args: DTC_OVERLAY_FILE="arduino_spi.overlay"
    harness_config:
      type: one_line
      regex:
        - "accel x:[-.0-9]* y:[-.0-9]* z:[-.0-9]* \\(m/s\\^2\\)"
```

## samples/sensor/adxl362/sample.yaml
```yaml
sample:
  name: adxl362 sample
  description: ADXL362 accelerometer sample application
tests:
  sample.sensor.adxl362:
    harness: sensor
    tags: sensors
    depends_on: spi
    integration_platforms:
      - nrf52dk_nrf52832
    platform_allow: nrf52dk_nrf52832
```

## samples/sensor/adxl372/sample.yaml
```yaml
sample:
  name: ADXL372 High-g Accelerometer Sensor
tests:
  sample.sensor.adxl372:
    harness: sensor
    tags: sensors
    depends_on: spi
    platform_allow: nrf52dk_nrf52832
  sample.sensor.adxl372.i2c:
    harness: sensor
    tags: sensors
    depends_on: i2c
    platform_allow: frdm_k64f
    extra_args: "CONF_FILE=prj_i2c.conf"
```

## samples/sensor/aht20_bmp280_board/sample.yaml
```yaml
sample:
  name: ATH20+BMP280 Board Sample
tests:
  sample.sensor.ath20_bmp280_board:
    harness: console
    tags: sensors
    depends_on: i2c
    # harness_config:
    #     type: one_line
    #     regex:
    #         - "temp: (.*); press: (.*);"
    #     fixture: fixture_i2c_dps310
```

## samples/sensor/am2301b/sample.yaml
```yaml
sample:
  name: AM2301B Sensor sample
tests:
  sample.sensor.am2301b:
    harness: console
    tags: sensors
    platform_allow: stm32_min_dev_blue
    integration_platforms:
      - stm32_min_dev_blue
    depends_on: i2c
    timeout: 15
    harness_config:
      type: one_line
      regex:
        - "temp: [-.0-9]*; humidity:[-.0-9]*"
```

## samples/sensor/amg88xx/sample.yaml
```yaml
common:
  tags: sensors
sample:
  description: AMG88XX sensor sample
  name: AMG88XX sample
tests:
  sample.sensor.amg88xx.amg88xx_grid_eye_eval_shield:
    build_only: true
    depends_on:
      - arduino_i2c
      - arduino_gpio
    platform_allow:
      - pan1780_evb
      - pan1770_evb
      - pan1781_evb
      - pan1782_evb
    integration_platforms:
      - pan1780_evb
    extra_args: SHIELD=amg88xx_grid_eye_eval_shield
    extra_configs:
      - CONFIG_AMG88XX_TRIGGER_GLOBAL_THREAD=y
  sample.sensor.amg88xx.amg88xx_eval_kit:
    build_only: true
    depends_on:
      - arduino_i2c
      - arduino_gpio
    platform_exclude:
      - pan1781_evb
      - pan1782_evb
    tags: sensors
    extra_args: SHIELD=amg88xx_eval_kit
    extra_configs:
      - CONFIG_AMG88XX_TRIGGER_GLOBAL_THREAD=y
```

## samples/sensor/ams5915/Kconfig
```kconfig
# Copyright (c) 2024 BoRob Engineering
# SPDX-License-Identifier: Apache-2.0

config LOG
	default y

config LOG_PRINTK
	default y

config SENSOR_LOG_LEVEL
	default 4

# Enable I2C support by default. This default can be overridden if
# needed.

config I2C
	default y

source "Kconfig.zephyr"
```

## samples/sensor/ams5915/sample.yaml
```yaml
sample:
  description: Demonstration of the AMS5915 Pressure Sensor Driver
  name: ams5915 sample
tests:
  sample.sensor.iaqcore:
    harness: sensor
    tags: samples
    depends_on:
      - i2c
      - arduino_i2c
```

## samples/sensor/ams_iAQcore/sample.yaml
```yaml
sample:
  description: Demonstration of the AMS iAQ-core Digital VOC Sensor driver
  name: iAQcore sample
tests:
  sample.sensor.iaqcore:
    harness: sensor
    tags:
      - iAQcore
    platform_allow:
      - nucleo_f446re
    depends_on:
      - i2c
      - arduino_i2c
```

## samples/sensor/apds9960/sample.yaml
```yaml
sample:
  name: APDS9960 sample
tests:
  sample.sensor.apds9960:
    harness: console
    platform_allow:
      - adafruit_qt_py_rp2040/rp2040
      - reel_board
    integration_platforms:
      - reel_board
    tags: sensors
    extra_args:
      - platform:adafruit_qt_py_rp2040/rp2040:SHIELD="adafruit_apds9960"
    depends_on:
      - i2c
      - gpio
    harness_config:
      type: multi_line
      ordered: true
      regex:
        - "APDS9960 sample application"
        - "ambient light intensity (.*), proximity (.*)"
      fixture: fixture_i2c_apds9960
  sample.sensor.apds9960.trigger:
    harness: console
    platform_allow:
      - reel_board
      - mikroe_clicker_ra4m1/r7fa4m1ab3cfm # mikroe_ir_gesture_click shield
    integration_platforms:
      - reel_board
      - mikroe_clicker_ra4m1/r7fa4m1ab3cfm
    tags: sensors
    depends_on:
      - i2c
      - gpio
    extra_configs:
      - CONFIG_APDS9960_TRIGGER_GLOBAL_THREAD=y
    extra_args:
      - platform:mikroe_clicker_ra4m1/r7fa4m1ab3cfm:SHIELD="mikroe_ir_gesture_click"
    harness_config:
      type: multi_line
      ordered: true
      regex:
        - "APDS9960 sample application"
        - "Waiting for a threshold event"
        - "ambient light intensity (.*), proximity (.*)"
      fixture: fixture_i2c_apds9960
```

## samples/sensor/bhi260ap/sample.yaml
```yaml
sample:
  name: BHI260AP Sensor sample
tests:
  sample.sensor.bhi260ap:
    harness: sensor
    tags:
      - samples
      - sensor
    depends_on: i2c
```
