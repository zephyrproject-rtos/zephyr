/*
 * Copyright (c) 2021, Silvano Cortesi
 * Copyright (c) 2021, ETH Zürich
 *
 * SPDX-License-Identifier: Apache-2.0
 */

&i2c0 {
	max30101@57 {
		compatible = "maxim,max30101";
		reg = <0x57>;
		label = "MAX30101";
		status = "okay";
	};
};
