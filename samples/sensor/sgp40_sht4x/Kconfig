## samples/sensor/sgp40_sht4x/Kconfig
```kconfig
#
# Copyright (c) 2021 Leonard Pollak
#
# SPDX-License-Identifier: Apache-2.0
#

mainmenu "SGP40/SHT4X sample application"

config APP_USE_COMPENSATION
	bool "Use the T/RH compensation feature of the SGP40"
	default y

config APP_USE_HEATER
	bool "Use the Heater on the SHT4X"
	default n
	help
		Maximum duty cycle for using the heater is 5%

config APP_HEATER_HUMIDITY_THRESH
	int "RH [%] threshold above which the heater will be activated"
	range 0 99
	default 65
	depends on APP_USE_HEATER

config APP_HEATER_PULSE_POWER
	int "Heater Power Setting"
	range 0 2
	default 2
	depends on APP_USE_HEATER
	help
		0 -> High power heater pulse -> ~200 mW  @3.3V
		1 -> Medium power heater pulse -> ~110 mW  @3.3V
		2 -> Low power heater pulse -> ~20 mW  @3.3V

config APP_HEATER_PULSE_DURATION
	int "Heater Pulse Length Setting"
	range 0 1
	default 1
	depends on APP_USE_HEATER
	help
		0 -> Long heater pulse -> 1.1s
		1 -> Short heater pulse -> 0.11s

source "Kconfig.zephyr"
```

## samples/sensor/sgp40_sht4x/sample.yaml
```yaml
#
# Copyright (c) 2021 Leonard Pollak
#
# SPDX-License-Identifier: Apache-2.0
#

sample:
  name: SGP40 and SHT4X Sensor Sample
tests:
  sample.sensor.sgp40_sht4x:
    build_only: true
    platform_allow: blackpill_f411ce
    tags: sensors
```

## samples/sensor/sht3xd/sample.yaml
```yaml
#
# Copyright (c) 2018 Peter Bigot Consulting, LLC
#
# SPDX-License-Identifier: Apache-2.0
#

sample:
  name: SHT3XD Sensor Sample
common:
  platform_allow:
    - efr32mg_sltb004a/efr32mg12p332f1024gl125
    - frdm_k64f/mk64f12
    - nrf51_ble400/nrf51822
    - nrf52840dk/nrf52840
    - nucleo_l476rg/stm32l476xx
  integration_platforms:
    - nrf52840dk/nrf52840
  tags: sensors
  build_only: true
tests:
  sample.sensor.sht3xd: {}
  sample.sensor.sht3xd.trigger:
    extra_args: CONF_FILE="trigger.conf"
```

## samples/sensor/sht4x/Kconfig
```kconfig
# Copyright (c) 2025 Antmicro <www.antmicro.com>
# SPDX-License-Identifier: Apache-2.0

mainmenu "SHT4X sample application"

config APP_USE_HEATER
	bool "Use the Heater on the SHT4X"
	help
	  Maximum duty cycle for using the heater is 5%

config APP_HEATER_HUMIDITY_THRESH
	int "RH [%] threshold above which the heater will be activated"
	range 0 99
	default 65
	depends on APP_USE_HEATER

config APP_HEATER_PULSE_POWER
	int "Heater Power Setting"
	range 0 2
	default 2
	depends on APP_USE_HEATER
	help
	  0 -> High power heater pulse -> ~200 mW  @3.3V
	  1 -> Medium power heater pulse -> ~110 mW  @3.3V
	  2 -> Low power heater pulse -> ~20 mW  @3.3V

config APP_HEATER_PULSE_DURATION_LONG
	bool "Use long pulse duration Heater setting"
	default y
	depends on APP_USE_HEATER
	help
	  Say 'Y' if you want to use the long pulse duration setting. This sets the pulse time to
	  1.1s. Say 'N' if you want to use the short pulse duration setting, which sets the pulse
	  time to 0.11s.

source "Kconfig.zephyr"
```

## samples/sensor/si7006/sample.yaml
```yaml
sample:
  name: Si7006 Sensor sample
tests:
  sample.sensor.si7006:
    build_only: true
    platform_allow: efm32gg11_wlstk6121a
    tags: sensors
```

## samples/sensor/si7021/sample.yaml
```yaml
#
# Copyright (c) 2020 Nikolaus Huber, Uppsala University
#
# SPDX-License-Identifier: Apache-2.0
#

sample:
  description: Demonstration of the SI7021 Relative Humidity and Temperature Sensor driver
  name: SI7021 sample
tests:
  sample.sensor.si7021:
    harness: sensor
    tags: sensors
    platform_allow: efr32mg_sltb004a
    depends_on: i2c
```

## samples/sensor/si_sensor/sample.yaml
```yaml
sample:
  description: Silabs Si7006/13/20/21 temperature and humidity polling sample
  name: si_sensor
tests:
  sample.sensor.si_sensor_polling:
    tags:
      - sensors
    filter: dt_alias_exists("si-sensor")
    integration_platforms:
      - xg23_rb4210a
    harness: console
    harness_config:
      type: multi_line
      regex:
        - "Temperature: [1-9][0-9].[0-9] °C"
        - "Humidity: [1-9][0-9].[0-9]%"
```

## samples/sensor/sm351lt/sample.yaml
```yaml
sample:
  name: SM351LT Magnetoresistive Sensor Example
tests:
  sample.sensor.sm351lt:
    harness: sensor
    tags:
      - samples
      - sensor
    depends_on:
      - gpio
      - sm351lt
    integration_platforms:
      - bt510
```

## samples/sensor/soc_voltage/sample.yaml
```yaml
sample:
  description: SoC voltage sensor example
  name: soc_voltage
tests:
  sample.sensor.soc_voltage:
    depends_on: adc
    tags: sensors
    timeout: 10
    platform_allow:
      - nucleo_g071rb
    harness: console
    harness_config:
      type: one_line
      ordered: true
      regex:
        - "Sensor voltage\\[[A-Za-z0-9_]+\\]: -?([0-5])\\.([0-9]+) V"
```

## samples/sensor/stm32_temp_sensor/sample.yaml
```yaml
sample:
  description: Usage of STM32 temperature sensor
  name: stm32_temp_sensor
tests:
  sample.sensor.stm32_temp_sensor:
    depends_on: adc
    tags: sensors tests
    filter: dt_compat_enabled("st,stm32-temp-cal") or dt_compat_enabled("st,stm32-temp")
    harness: console
    harness_config:
      type: one_line
      regex:
        - "Current temperature: [1-5][0-9].[0-9] °C"
```

## samples/sensor/stm32_vbat_sensor/sample.yaml
```yaml
sample:
  description: Usage of STM32 Vbat internal sensor
  name: stm32_vbat_sensor
tests:
  sample.sensor.stm32_vbat_sensor:
    depends_on: adc
    tags: sensors
    platform_allow: nucleo_g071rb nucleo_wb55rg
    integration_platforms:
      - nucleo_g071rb
    timeout: 10
    harness: console
    harness_config:
      type: multi_line
      ordered: true
      regex:
        - "STM32 Vbat sensor test"
        - "Current Vbat voltage: 3(.*) V"
```

## samples/sensor/stream_drdy/boards/nucleo_h503rb.conf
```kconfig
# Copyright (c) 2024 STMicroelectronics
# SPDX-License-Identifier: Apache-2.0

CONFIG_I2C_RTIO=y
CONFIG_LSM6DSV16X_STREAM=y
CONFIG_LSM6DSV16X_ENABLE_TEMP=y
```

## samples/sensor/stream_fifo/sample.yaml
```yaml
sample:
  name: Stream FIFO sample
tests:
  sample.sensor.stream_fifo:
    harness: console
    tags: sensors
    filter: dt_alias_exists("stream0")
    harness_config:
      type: one_line
      regex:
        - "^\\s*[0-9A-Za-z_,+-.]*@[0-9A-Fa-f]* \\[m\/s\\^2\\]:    \
           \\(\\s*-?[0-9\\.]*,\\s*-?[0-9\\.]*,\\s*-?[0-9\\.]*\\)$"
```

## samples/sensor/stts22h/sample.yaml
```yaml
sample:
  name: STTS22H temperature sensor
tests:
  sample.sensor.stts22h:
    depends_on:
      - i2c
    filter: dt_compat_enabled("st,stts22h")
    tags:
      - sensors
    integration_platforms:
      - stm32u5g9j_dk1
```

## samples/sensor/sx9500/sample.yaml
```yaml
sample:
  name: SX9500 Sensor Sample
tests:
  sample.sensor.sx9500:
    harness: sensor
    tags: sensors gpio
    depends_on: i2c gpio
    filter: dt_compat_enabled("semtech,sx9500")
```

## samples/sensor/tad2144/sample.yaml
```yaml
sample:
  name: TAD2144 Sensor Sample
tests:
  sample.sensor.tad2144:
    build_only: true
    platform_allow: nrf52840dk/nrf52840
    integration_platforms:
      - nrf52840dk/nrf52840
    tags: sensors
```

## samples/sensor/tap_count/sample.yaml
```yaml
sample:
  name: Tap Count Sample
tests:
  sample.sensor.tap_count:
    harness: sensor
    tags: sensors
    filter: dt_alias_exists("accel0")
```

## samples/sensor/tcs3472x/Kconfig
```kconfig
# Copyright (c) 2023, Thomas Kiss <thokis@gmail.com>
# SPDX-License-Identifier: Apache-2.0

config LOG
	default y

config LOG_PRINTK
	default y

config SENSOR_LOG_LEVEL
	default 5

# Enable SPI and I2C support by default so that the sample works with
# the device connected either way. These defaults can be overridden if
# needed.
config I2C
	default y

source "Kconfig.zephyr"
```

## samples/sensor/tcs3472x/sample.yaml
```yaml
sample:
  name: TCS3472x sensor sample
tests:
  sample.sensor.tcs3472x:
    harness: console
    tags: sensors
    platform_allow: esp32
    integration_platforms:
      - esp32
    harness_config:
      type: one_line
      regex:
        - "red: (.*); green: (.*); blue: (.*)"
      fixture: fixture_i2c_tcs3472x
```

## samples/sensor/tdk_apex/Kconfig
```kconfig
# Copyright (c) 2024, TDK Invensense
# SPDX-License-Identifier: Apache-2.0

# Enable trigger to get APEX sensor data
choice ICM42670_TRIGGER_MODE
	default ICM42670_TRIGGER_OWN_THREAD
endchoice

source "Kconfig.zephyr"
```

## samples/sensor/temp_polling/sample.yaml
```yaml
sample:
  name: Ambient Temperature Polling Sample
tests:
  sample.sensor.temp_polling:
    harness: sensor
    tags: sensors
    filter: dt_alias_exists("temp0")
```

## samples/sensor/th02/sample.yaml
```yaml
sample:
  name: TH02 Temperature and Humidity Monitor
tests:
  sample.sensor.th02:
    harness: sensor
    tags: sensors
    depends_on: i2c
    platform_allow:
      - frdm_k64f
```

## samples/sensor/thermistor/sample.yaml
```yaml
sample:
  description: Illustrates how to use the thermistor to measure temperature
  name: Temperature (thermistor) sensor sample application
tests:
  sample.sensor.thermistor:
    depends_on: adc
    tags: sensors drivers temperature
    filter: dt_compat_enabled("infineon,thermistor")
    harness: sensor
```

## samples/sensor/thermometer/Kconfig
```kconfig
# Copyright (c) 2024 Analog Devices Inc.
# SPDX-License-Identifier: Apache-2.0

config SAMPLES_SENSOR_THERMOMETER_ALERT
	bool "Enable alert mode"
	default y
	help
	  Thermoter sensors generally has alarm pin too, incase of there is not or
	  you have not implemented it for your driver disable this flag
	  in your overlay file to discard alarm code from sample.

source "Kconfig.zephyr"
```
