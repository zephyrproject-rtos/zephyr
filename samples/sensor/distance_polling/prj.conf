## CMakeLists.txt
```
# Copyright (c) 2025 Thiyagarajan Pandiyan <psvthiyagarajan@gmail.com>
# SPDX-License-Identifier: Apache-2.0

cmake_minimum_required(VERSION 3.28.0)
find_package(Zephyr REQUIRED HINTS $ENV{ZEPHYR_BASE})
project(distance_polling)

FILE(GLOB app_sources src/*.c)
target_sources(app PRIVATE ${app_sources})
```

## sample.yaml
```
sample:
  name: Distance measurement sample
common:
  tags: sensors
  harness: console
  harness_config:
    type: one_line
    regex:
      - "^[a-zA-Z0-9_,+-.]*: [0-9\\.]+m$"
tests:
  sample.sensor.distance_polling:
    filter: dt_alias_exists("distance0")
    integration_platforms:
      - arduino_nicla_vision/stm32h747xx/m7     # vl53l1x
      - esp32_devkitc_wroom                      # hc-sr04
```

## prj.conf
```kconfig
CONFIG_LOG=y
CONFIG_GPIO=y
CONFIG_SENSOR=y
```

## boards/arduino_nicla_vision_stm32h747xx_m7.overlay
```dts
/*
 * Copyright (c) 2025 Thiyagarajan Pandiyan <psvthiyagarajan@gmail.com>
 *
 * SPDX-License-Identifier: Apache-2.0
 */

/ {
	aliases {
		distance0 = &vl53l1x;
	};
};
```

## boards/esp32_devkitc_wroom.overlay
```dts
/*
 * Copyright (c) 2026 Malluri Sai Raghu
 *
 * SPDX-License-Identifier: Apache-2.0
 */

/ {
	aliases {
		distance0 = &hc_sr04;
	};

	hc_sr04: hc-sr04 {
		compatible = "hc-sr04";
		trigger-gpios = <&gpio0 4 GPIO_ACTIVE_HIGH>;
		echo-gpios = <&gpio0 5 GPIO_ACTIVE_HIGH>;
	};
};
```

## src/main.c
```c
/*
 * Copyright (c) 2025 Thiyagarajan Pandiyan <psvthiyagarajan@gmail.com>
 *
 * SPDX-License-Identifier: Apache-2.0
 */

#include <stdio.h>
#include <zephyr/kernel.h>
#include <zephyr/device.h>
#include <zephyr/drivers/sensor.h>

#define DISTANCE_ALIAS(i) DT_ALIAS(_CONCAT(distance, i))
#define DISTANCE_SENSOR(i, _)                                                                      \
	IF_ENABLED(DT_NODE_EXISTS(DISTANCE_ALIAS(i)), (DEVICE_DT_GET(DISTANCE_ALIAS(i)),))

/* support up to 5 distance sensors */
static const struct device *const sensors[] = {LISTIFY(5, DISTANCE_SENSOR, ())};

static void fetch_and_display(const struct device *sensor)
{
	struct sensor_value distance;
	int rc = sensor_sample_fetch(sensor);

	if (rc < 0) {
		printf("ERROR: Fetch failed: %d\n", rc);
		return;
	}

	rc = sensor_channel_get(sensor, SENSOR_CHAN_DISTANCE, &distance);
	if (rc < 0) {
		printf("ERROR: get failed: %d\n", rc);
	} else {
		printf("%s: %d.%03dm\n", sensor->name, distance.val1, distance.val2);
	}
}

int main(void)
{
	size_t i = 0;

	for (i = 0; i < ARRAY_SIZE(sensors); i++) {
		if (!device_is_ready(sensors[i])) {
			printf("Error: Device \"%s\" is not ready\n", sensors[i]->name);
			return 0;
		}
	}

	while (true) {
		for (i = 0; i < ARRAY_SIZE(sensors); i++) {
			fetch_and_display(sensors[i]);
			k_sleep(K_MSEC(500));
		}
	}

	return 0;
}
```
