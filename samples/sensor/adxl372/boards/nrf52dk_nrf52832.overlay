/*
 * Copyright (c) 2019 Linaro Limited
 *
 * SPDX-License-Identifier: Apache-2.0
 */

&spi2 {
	cs-gpios = <&gpio0 22 GPIO_ACTIVE_LOW>;
	adxl372@0 {
		compatible = "adi,adxl372";
		reg = <0>;
		spi-max-frequency = <8000000>;
		int1-gpios = <&gpio0 11 GPIO_ACTIVE_HIGH>;
	};
};
