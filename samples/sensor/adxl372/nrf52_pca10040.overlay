/*
 * Copyright (c) 2019 Linaro Limited
 *
 * SPDX-License-Identifier: Apache-2.0
 */

&spi2 {

	adxl372@0 {
		compatible = "adi,adxl372";
		reg = <0>;
		spi-max-frequency = <8000000>;
		label = "ADXL372";
		int1-gpios = <&gpio0 6 0>;
	};
};
