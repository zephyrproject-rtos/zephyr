/*
 * SPDX-FileCopyrightText: Copyright (c) 2026 Infineon Technologies AG,
 * SPDX-FileCopyrightText: or an affiliate of Infineon Technologies AG. All rights reserved.
 *
 * SPDX-License-Identifier: Apache-2.0
 */

i2c1: &scb1 {
	compatible = "infineon,i2c";
	clocks = <&peri_clk_div2>;
	pinctrl-0 = <&p6_3_scb1_i2c_scl &p6_4_scb1_i2c_sda>;
	pinctrl-names = "default";
	#address-cells = <1>;
	#size-cells = <0>;
	status = "okay";

	mpu6050@68 {
		compatible = "invensense,mpu6050";
		reg = <0x68>;
		smplrt-div = <249>;
		status = "okay";
	};
};
