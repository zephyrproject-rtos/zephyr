## CMakeLists.txt
```
# SPDX-License-Identifier: Apache-2.0

cmake_minimum_required(VERSION 3.20.0)
find_package(Zephyr REQUIRED HINTS $ENV{ZEPHYR_BASE})
project(grove_light)

FILE(GLOB app_sources src/*.c)
target_sources(app PRIVATE ${app_sources})
```

## sample.yaml
```
common:
  filter: CONFIG_FULL_LIBC_SUPPORTED
sample:
  name: Grove Light Sensor
tests:
  sample.sensor.grove_light:
    tags:
      - drivers
      - sensor
      - grove
      - light
    platform_allow:
      - nrf52dk/nrf52832
    integration_platforms:
      - nrf52dk/nrf52832
    harness: grove
    depends_on: adc
```

## prj.conf
```kconfig
CONFIG_ADC=y
CONFIG_SENSOR=y
CONFIG_NEWLIB_LIBC=y
CONFIG_NEWLIB_LIBC_FLOAT_PRINTF=y
CONFIG_CBPRINTF_FP_SUPPORT=y
```

## boards/nrf52dk_nrf52832.overlay
```dts
/*
 * Copyright (c) 2019 Nordic Semiconductor ASA
 *
 * SPDX-License-Identifier: Apache-2.0
 */

/ {
	ntc {
		compatible = "seeed,grove-light";
		io-channels = <&arduino_adc 0>;
	};
};
```

## src/main.c
```c
/*
 * Copyright (c) 2016 Intel Corporation
 *
 * SPDX-License-Identifier: Apache-2.0
 */

#include <zephyr/kernel.h>
#include <zephyr/init.h>
#include <stdio.h>
#include <zephyr/drivers/sensor.h>

#define SLEEP_TIME	K_MSEC(1000)

int main(void)
{
	const struct device *const dev = DEVICE_DT_GET_ONE(seeed_grove_light);

	if (!device_is_ready(dev)) {
		printk("sensor: device not ready.\n");
		return 0;
	}

	while (1) {
		int read;
		struct sensor_value lux;

		read = sensor_sample_fetch(dev);
		if (read) {
			printf("sample fetch error %d\n", read);
			continue;
		}

		sensor_channel_get(dev, SENSOR_CHAN_LIGHT, &lux);

		printf("lux: %f\n", sensor_value_to_double(&lux));

		k_sleep(SLEEP_TIME);
	}
	return 0;
}
```
