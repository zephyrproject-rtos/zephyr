## samples/sensor/pzem004t/Kconfig
```kconfig
# Copyright (c) 2025, Srishtik Bhandarkar
# SPDX-License-Identifier: Apache-2.0

mainmenu "PZEM004T Sensor Sample Application"

config READ_MEASUREMENT_VALUES
	bool "Build sample for reading measurement values"
	default n
	help
	  Build the sample application for reading measurement values from the
	  PZEM004T sensor. This sample demonstrates how to read and display
	  various measurement values such as voltage, current, power, and energy.

config READ_SENSOR_PARAMETERS
	bool "Build sample for reading sensor parameters"
	default n
	help
	  Build the sample application for reading sensor parameters from the
	  PZEM004T sensor. This sample demonstrates how to read and display
	  sensor parameters power alarm threshold and modbus rtu address.

config SET_SENSOR_PARAMETERS
	bool "Build sample for setting sensor parameters"
	default n
	help
	  Build the sample application for setting sensor parameters on the
	  PZEM004T sensor. This sample demonstrates how to set sensor parameters
	  such as power alarm threshold and modbus rtu modbus address.

config RESET_ENERGY
	bool "Build sample for setting sensor parameters"
	default n
	help
	  Build the sample application for resetting energy on the
	  PZEM004T sensor. This sample demonstrates how to reset the energy
	  counter on the sensor.

source "Kconfig.zephyr"
```

## samples/sensor/pzem004t/sample.yaml
```yaml
sample:
  name: PZEM004T Sensor Sample
tests:
  sample.sensor.pzem004t:
    build_only: true
    platform_allow: nucleo_g071rb
    integration_platforms:
      - nucleo_g071rb
    tags: sensors
```

## samples/sensor/qdec/boards/frdm_mcxa153.conf
```kconfig
# SPDX-FileCopyrightText: 2026 NXP
# SPDX-License-Identifier: Apache-2.0

# Enable EQDC overflow-trigger support so the qdec sample exercises the
# SENSOR_TRIG_OVERFLOW path on the revolution channel.
CONFIG_EQDC_MCUX_TRIGGER=y
```

## samples/sensor/qdec/sample.yaml
```yaml
sample:
  description: Usage quadrature decoder sensor
  name: qdec_sensor
common:
  tags: sensors
  timeout: 5
  harness: console

tests:
  sample.sensor.qdec_sensor:
    filter: dt_alias_exists("qdec0")
    harness_config:
      type: multi_line
      ordered: true
      regex:
        - "Quadrature decoder sensor test"
        - "Position = (.*) degrees"

  sample.sensor.sam_qdec_sensor:
    platform_allow:
      - sam_e70_xplained/same70q21
      - sam_e70_xplained/same70q21b
    harness_config:
      type: multi_line
      ordered: true
      regex:
        - "Quadrature decoder sensor test"
        - "Position = (.*) degrees"

  sample.sensor.st_qdec_sensor:
    platform_allow: nucleo_f401re
    harness_config:
      fixture: fixture_mech_encoder
      type: multi_line
      ordered: true
      regex:
        - "Quadrature decoder sensor test"
        - "Position = (.*) degrees"

  sample.sensor.nrf_qdec_sensor:
    platform_allow:
      - nrf52840dk/nrf52840
      - nrf5340dk/nrf5340/cpuapp
      - nrf54l15dk/nrf54l15/cpuapp
      - nrf54h20dk/nrf54h20/cpuapp
      - ophelia4ev/nrf54l15/cpuapp
    integration_platforms:
      - nrf52840dk/nrf52840
      - nrf5340dk/nrf5340/cpuapp
      - nrf54l15dk/nrf54l15/cpuapp
      - nrf54h20dk/nrf54h20/cpuapp
      - ophelia4ev/nrf54l15/cpuapp
    harness_config:
      fixture: gpio_loopback
      type: multi_line
      ordered: true
      regex:
        - "Quadrature decoder sensor test"
        - "Position = -[45678]\\d degrees"
```

## samples/sensor/qdec_multi/sample.yaml
```yaml
sample:
  description: Multi-unit quadrature decoder sample (Read-and-Decode API)
  name: qdec_multi
tests:
  sample.sensor.qdec_multi:
    build_only: true
    tags:
      - samples
      - sensor
    platform_allow:
      - esp32_devkitc/esp32/procpu
      - esp32s2_saola
      - esp32s3_devkitc/esp32s3/procpu
      - esp32c5_devkitc/esp32c5/hpcore
      - esp32c6_devkitc/esp32c6/hpcore
      - esp32h2_devkitm/esp32h2
      - esp32p4_function_ev_board/esp32p4/hpcore
    depends_on: pinctrl
```

## samples/sensor/qmi8658c/sample.yaml
```yaml
#
# Copyright (c) 2025 LCKFB
#
# SPDX-License-Identifier: Apache-2.0
#

sample:
  name: QMI8658C Sensor Sample
tests:
  sample.sensor.qmi8658c:
    build_only: true
    platform_allow: esp32c3_lckfb
    tags: sensors
    integration_platforms:
      - esp32c3_lckfb
```

## samples/sensor/scd4x/Kconfig
```kconfig
#
# Copyright (c) 2022 Stephen Oliver
#
# SPDX-License-Identifier: Apache-2.0
#

mainmenu "SCD4X sample application"

config APP_USE_FAHRENHEIT
	bool "Display fahrenheit temperature in console"
	default n
	help
		Converts temperature value from sensor before logging

source "Kconfig.zephyr"
```

## samples/sensor/scd4x/sample.yaml
```yaml
#
# Copyright (c) 2022 Stephen Oliver
#
# SPDX-License-Identifier: Apache-2.0
#

sample:
  name: SCD4X Sensor Sample
tests:
  sample.sensor.scd4x:
    build_only: true
    platform_allow: esp32
    tags: sensors
```

## samples/sensor/sensor_shell/Kconfig
```kconfig
# Copyright (c) 2023 Google LLC
# SPDX-License-Identifier: Apache-2.0

config SAMPLES_SENSOR_SHELL_FAKE_SENSOR
	bool "Enable fake sensor"
	default y
	depends on DT_HAS_VND_FAKE_SENSOR_ENABLED
	help
	  On boards that do not have a sensor, enabling this will build a fake
	  sensor that can be interacted with via the sensor shell.

source "Kconfig.zephyr"
```

## samples/sensor/sensor_shell/boards/mps3_an536_cpu0.conf
```kconfig
CONFIG_SHELL_STACK_SIZE=4096
CONFIG_SHELL_BACKEND_SERIAL_TX_RING_BUFFER_SIZE=1024
CONFIG_SHELL_PRINTF_BUFF_SIZE=256
# This board defaults to QEMU icount mode (CONFIG_QEMU_ICOUNT=y,
# QEMU_ICOUNT_SHIFT=7), which advances virtual time slowly in wall-clock terms.
# The interrupt-driven shell then cannot drain the large "sensor get" burst and
# echo the next command within the harness's wall-clock timeouts, so the test
# times out. Disable icount so the guest runs at host speed.
CONFIG_QEMU_ICOUNT=n
```

## samples/sensor/sensor_shell/boards/native_posix.conf
```kconfig
# Copyright (c) 2023 Intel Corporation
#
# SPDX-License-Identifier: Apache-2.0

CONFIG_EMUL=y
CONFIG_EMUL_BMI160=y
CONFIG_BMI160_TRIGGER_NONE=y
```

## samples/sensor/sensor_shell/boards/qemu_cortex_r5.conf
```kconfig
CONFIG_SHELL_STACK_SIZE=4096
CONFIG_SHELL_BACKEND_SERIAL_TX_RING_BUFFER_SIZE=1024
CONFIG_SHELL_PRINTF_BUFF_SIZE=256
CONFIG_SHELL_BACKEND_SERIAL_FORCE_TX_BLOCKING_MODE=y
```

## samples/sensor/sensor_shell/boards/qemu_riscv64_qemu_virt_riscv64.conf
```kconfig
CONFIG_SHELL_STACK_SIZE=4096
CONFIG_SHELL_BACKEND_SERIAL_TX_RING_BUFFER_SIZE=1024
CONFIG_SHELL_PRINTF_BUFF_SIZE=256
# The interrupt-driven shell cannot echo the next command within the harness's
# 1 s timeout while draining the large "sensor get" burst under QEMU icount
# mode, which advances virtual time slowly in wall-clock terms. Disable icount
# so the guest runs at host speed, matching the already-passing smp variant.
CONFIG_QEMU_ICOUNT=n
```

## samples/sensor/sensor_shell/boards/robokit1.conf
```kconfig
# Copyright (c) 2023 Google LLC
# SPDX-License-Identifier: Apache-2.0
CONFIG_SPI_RTIO=y
```

## samples/sensor/sensor_shell/boards/vmu_rt1170_mimxrt1176_cm7.conf
```kconfig
# Copyright 2025 CogniPilot Foundation
# SPDX-License-Identifier: Apache-2.0

CONFIG_DEBUG=y
CONFIG_SENSOR_SHELL_STREAM=y
CONFIG_SENSOR_LOG_LEVEL_DBG=n
CONFIG_RTIO_SUBMIT_SEM=y
CONFIG_SPI_RTIO=y
CONFIG_SPI_ASYNC=y
CONFIG_SYS_CLOCK_TICKS_PER_SEC=10000
```

## samples/sensor/sensor_shell/dts/bindings/sensor-virtual.yaml
```yaml
# Copyright (c) 2023 Intel Corporation
#
# SPDX-License-Identifier: Apache-2.0

description: Virtual Sensor

compatible: "sensor-virtual"

include: sensor-device.yaml
```

## samples/sensor/sensor_shell/dts/bindings/vnd,fake-sensor.yaml
```yaml
# Copyright (c) 2024 Meta Platforms
# SPDX-License-Identifier: Apache-2.0

description: Fake sensor

include: sensor-device.yaml

compatible: "vnd,fake-sensor"
```

## samples/sensor/sensor_shell/dts/bindings/vnd,sensor-hinge-angle.yaml
```yaml
# Copyright (c) 2022 Intel Corporation
#
# SPDX-License-Identifier: Apache-2.0

description: Hinge Angle Virtual Sensor

include: sensor-virtual.yaml

compatible: "vnd,sensor-hinge-angle"

properties:
    vendor:
      default: "Vendor"

    model:
      default: "Hingle Angle"
```

## samples/sensor/sensor_shell/dts/bindings/vnd,sensor-kalman-filter.yaml
```yaml
# Copyright (c) 2022 Intel Corporation
#
# SPDX-License-Identifier: Apache-2.0

description: Kalman Filter Virtual Sensor

include: sensor-virtual.yaml

compatible: "vnd,sensor-kalman-filter"

properties:
    vendor:
      default: "Vendor"

    model:
      default: "Kalman Filter"
```

## samples/sensor/sensor_shell/sample.yaml
```yaml
sample:
  name: Shell Sensor Module Sample
common:
  tags:
    - sensor
    - shell

tests:
  sample.sensor.shell:
    integration_platforms:
      - frdm_k64f
    # TODO Remove once #63414 is resolved
    platform_exclude: gd32l233r_eval
    filter: ( CONFIG_UART_CONSOLE and CONFIG_SERIAL_SUPPORT_INTERRUPT )
    harness: keyboard
    min_ram: 20
    min_flash: 33
  sample.sensor.shell.pytest:
    platform_exclude: qemu_rx
    filter: CONFIG_SERIAL and dt_chosen_enabled("zephyr,shell-uart")
    min_ram: 40
    harness: pytest
    timeout: 180
    extra_configs:
      - arch:posix:CONFIG_UART_NATIVE_PTY_0_ON_STDINOUT=y
    extra_args: DTC_OVERLAY_FILE=fake_sensor.overlay
    integration_platforms:
      - native_sim
  sample.sensor.shell.shields:
    platform_allow:
      - adafruit_qt_py_rp2040/rp2040
    extra_args:
      - platform:adafruit_qt_py_rp2040/rp2040:SHIELD="adafruit_ina237"
```
