/*
 * Copyright (c) 2024 STMicroelectronics
 *
 * SPDX-License-Identifier: Apache-2.0
 */
#include <zephyr/dt-bindings/sensor/lsm6dsv16x.h>

/*
 * Nucleo F401RE board + shield iks4a1
 *
 * This devicetree overlay file will be automatically picked by the Zephyr
 * build system when building the sample for the nucleo_f401re board.
 */

/ {
	aliases {
		stream0 = &lsm6dsv16x_6b_x_nucleo_iks4a1;
	};
};

&arduino_i2c {
	lsm6dsv16x_6b_x_nucleo_iks4a1: lsm6dsv16x@6b {
		compatible = "st,lsm6dsv16x";
		reg = <0x6b>;
		accel-odr = <LSM6DSV16X_DT_ODR_AT_120Hz>;
		accel-range = <LSM6DSV16X_DT_FS_16G>;
		int2-gpios = <&arduino_header 10 GPIO_ACTIVE_HIGH>; /* D4 (PB5) */
		drdy-pin = <2>;
		drdy-pulsed;
	};
};
