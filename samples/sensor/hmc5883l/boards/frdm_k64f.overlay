/*
 * Copyright (c) 2019, Linaro Ltd.
 *
 * SPDX-License-Identifier: Apache-2.0
 */

&i2c0 {
	hmc5883l@1e {
		compatible = "honeywell,hmc5883l";
		reg = <0x1E>;
		int-gpios = <&gpioc 12 GPIO_ACTIVE_LOW>;
		label = "HMC5883L";
	};
};
