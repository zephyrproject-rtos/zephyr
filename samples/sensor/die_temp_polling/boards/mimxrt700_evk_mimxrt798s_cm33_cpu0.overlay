/*
 * Copyright 2025 NXP
 *
 * SPDX-License-Identifier: Apache-2.0
 */

#include <zephyr/dt-bindings/adc/adc.h>
#include <zephyr/dt-bindings/adc/mcux-lpadc.h>

&pmc_tmpsns {
	status = "okay";
	io-channels = <&lpadc0 0>;
};

&lpadc0 {
	#address-cells = <1>;
	#size-cells = <0>;

	channel@0 {
		reg = <0>;
		zephyr,gain = "ADC_GAIN_1";
		zephyr,reference = "ADC_REF_EXTERNAL0";
		zephyr,acquisition-time = <ADC_ACQ_TIME(ADC_ACQ_TIME_TICKS, 131)>;
		zephyr,input-positive = <MCUX_LPADC_CH6A>;
		zephyr,input-negative = <MCUX_LPADC_CH6B>;
		zephyr,differential;
	};
};
