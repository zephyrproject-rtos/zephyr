## samples/sensor/die_temp_polling/sample.yaml
```yaml
sample:
  description: CPU Die temperature polling sample
  name: die_temp_polling
tests:
  sample.sensor.die_temperature_polling:
    tags:
      - sensors
    platform_allow:
      - stm32f3_disco
      - nucleo_h7a3zi_q
    integration_platforms:
      - nucleo_h7a3zi_q
    harness: console
    harness_config:
      type: one_line
      regex:
        - "CPU Die temperature\\[[A-Za-z0-9_@]+\\]: [1-9][0-9].[0-9] °C"
```

## samples/sensor/distance_measure/sample.yaml
```yaml
sample:
  name: Distance measurement sample
common:
  tags: sensor
  harness: console
tests:
  sample.sensor.distance_measure:
    tags:
      - samples
      - sensor
  sample.sensor.distance_measure.hc-sr04:
    platform_allow:
      - nrf7002dk/nrf5340/cpuapp
    depends_on:
      - hc-sr04
```

## samples/sensor/dps310/sample.yaml
```yaml
sample:
  name: DP310 Sensor sample
tests:
  sample.sensor.dps310:
    harness: console
    tags: sensors
    depends_on: i2c arduino_i2c
    harness_config:
      type: one_line
      regex:
        - "temp: (.*); press: (.*);"
      fixture: fixture_i2c_dps310
```

## samples/sensor/ds18b20/sample.yaml
```yaml
sample:
  name: DS18B20 Temperature Sensor sample
common:
  harness: console
  tags: sensors
tests:
  sample.sensor.ds18b20.w1_serial:
    platform_allow: nucleo_g0b1re nrf52840dk_nrf52840
    integration_platforms:
      - nucleo_g0b1re
      - nrf52840dk_nrf52840
    harness_config:
      type: one_line
      regex:
        - "Temp: (.*)"
      fixture: fixture_w1_serial_ds18b20
  sample.sensor.ds18b20.w1_arduino_serial:
    platform_allow: nucleo_g071rb
    depends_on: arduino_serial
    integration_platforms:
      - nucleo_g071rb
    extra_args: "DTC_OVERLAY_FILE=arduino_serial.overlay"
    harness_config:
      type: one_line
      regex:
        - "Temp: (.*)"
      fixture: fixture_w1_arduino_serial_ds18b20
```

## samples/sensor/ens210/sample.yaml
```yaml
sample:
  description: Demonstration of the AMS Temperature and Humidity Sensor driver
  name: ENS210 sample
tests:
  sample.sensor.ens210:
    harness: sensor
    tags: samples
    depends_on:
      - i2c
      - arduino_i2c
```

## samples/sensor/env_sensing/Kconfig
```kconfig
# Copyright (c) 2021 Intel Corporation
# SPDX-License-Identifier: Apache-2.0

choice
	prompt "Select Display"
	default SAMPLE_DISPLAY_NONE

config SAMPLE_DISPLAY_NONE
	bool "No Display"

config SAMPLE_DISPLAY_GROVE
	bool "Grove LCD Display"
	select GROVE_LCD_RGB
	select DISPLAY

config SAMPLE_DISPLAY_LVGL
	bool "LVGL Display"
	select LVGL
	select DISPLAY
	select LVGL_USE_LABEL
	select LVGL_USE_CONT
	select LVGL_USE_BTN
	select LVGL_FONT_MONTSERRAT_14
	select LVGL_FONT_MONTSERRAT_16
	select LVGL_FONT_MONTSERRAT_18
	select LVGL_FONT_MONTSERRAT_22
	select LVGL_USE_IMG
	select LVGL_USE_LINEMETER
	select LVGL_USE_PAGE

endchoice


if LVGL
config HEAP_MEM_POOL_SIZE
	default 16384

config MAIN_STACK_SIZE
	default 2048

endif

if GROVE_LCD_RGB
config GROVE_LCD_RGB_I2C_MASTER_DEV_NAME
	default "I2C_0"

endif


config HAS_TEMPERATURE
	bool

config HAS_HUMIDITY
	bool

config HAS_PRESSURE
	bool

config HAS_GAS
	bool

config SAMPLE_SENSOR_TRIGGER
	bool "Enable Trigger"

choice
	prompt "Select Sensor"
	default SAMPLE_SENSOR_BME680

config SAMPLE_SENSOR_BME680
	bool "BME680"
	select BME680
	select HAS_TEMPERATURE
	select HAS_HUMIDITY
	select HAS_PRESSURE
	select HAS_GAS

config SAMPLE_SENSOR_TH02
	bool "TH02"
	select TH02
	select HAS_TEMPERATURE

config SAMPLE_SENSOR_SI7006
	bool "SI7006"
	select SI7006
	select HAS_TEMPERATURE
	select HAS_HUMIDITY

config SAMPLE_SENSOR_DHT
	bool "DHT"
	select DHT
	select GPIO
	select HAS_TEMPERATURE
	select HAS_HUMIDITY

config SAMPLE_SENSOR_LPS22HB
	bool "LPS22HB"
	select LPS22HB
	select HAS_TEMPERATURE
	select HAS_PRESSURE

config SAMPLE_SENSOR_LPS22HH
	bool "LPS22HH"
	select LPS22HH
	select HAS_TEMPERATURE
	select HAS_PRESSURE

config SAMPLE_SENSOR_MS5837
	bool "MS5837"
	select MS5837
	select HAS_TEMPERATURE
	select HAS_PRESSURE

config SAMPLE_SENSOR_HDC1080
	bool "HDC1080"
	select TI_HDC
	select HAS_TEMPERATURE
	select HAS_HUMIDITY

config SAMPLE_SENSOR_ENS210
	bool "ENS210"
	select ENS210
	select HAS_TEMPERATURE
	select HAS_HUMIDITY

config SAMPLE_SENSOR_DPS310
	bool "DPS310"
	select DPS310
	select HAS_TEMPERATURE

config SAMPLE_SENSOR_MCP9808
	bool "MCP9808"
	select MCP9808
	select HAS_TEMPERATURE
	select HAS_HUMIDITY

config SAMPLE_SENSOR_HTS221
	bool "HTS221"
	select HTS221
	select HAS_TEMPERATURE
	select HAS_HUMIDITY

config SAMPLE_SENSOR_BME280
	bool "BME 280"
	select BME280
	select HAS_TEMPERATURE
	select HAS_HUMIDITY
	select HAS_PRESSURE

config SAMPLE_SENSOR_TMP007
	bool "TMP007"
	select TMP007
	select HAS_TEMPERATURE

config SAMPLE_SENSOR_SHT3XD
	bool "SHT3XD"
	select SHT3XD
	select HAS_HUMIDITY
	select SHT3XD_TRIGGER if SAMPLE_SENSOR_TRIGGER

endchoice


source "Kconfig.zephyr"
```

## samples/sensor/env_sensing/sample.yaml
```yaml
sample:
  name: Environmnt Sensing Application
tests:
  sample.sensor.env_sensing:
    harness: console
    tags: sensors
    depends_on: arduino_i2c
    integration_platforms:
      - frdm_k64f
    harness_config:
        type: multi_line
        ordered: yes
        regex:
            - "Temperature: (.*)"
            - "Relative Humidity: (.*)"
```

## samples/sensor/eqdc_mcux/sample.yaml
```yaml
sample:
  name: Enhanced Quadrature Decoder MCUX Sensor Sample
tests:
  sample.sensor.eqdc_mcux:
    harness: sensor
    tags: sensors
    platform_allow: frdm_mcxa156
    integration_platforms:
      - frdm_mcxa156
```

## samples/sensor/esp32_temp_sensor/sample.yaml
```yaml
sample:
  description: Usage of ESP32 temperature sensor
  name: esp32_temp_sensor
tests:
  sample.sensor.esp32_temp_sensor:
    tags: sensors tests
    filter: dt_compat_enabled("espressif,esp32-temp")
    harness: console
    harness_config:
      type: one_line
      regex:
        - "Current temperature: [1-5][0-9].[0-9] °C"
```

## samples/sensor/fdc2x1x/sample.yaml
```yaml
sample:
  name: fdc2x1x sample
  description: FDC2X1X sample application
tests:
  sample.sensor.fdc2x1x:
    harness: sensor
    tags: sensors
    platform_allow: nrf9160dk/nrf9160
    integration_platforms:
      - nrf9160dk/nrf9160
```

## samples/sensor/frammb85rs64v/sample.yaml
```yaml
sample:
  name: FRAMMB85RS64V Sensor sample
tests:
  sample.sensor.frammb85rs64v:
    tags: drivers fram
    harness: fram
    depends_on: fram frammb85rs64v
    filter: dt_alias_exists("spi_0")
```

## samples/sensor/freq_meter_stm32_icap/sample.yaml
```yaml
sample:
  name: STM32 Input Capture Frequency Meter Sensor Sample
tests:
  sample.sensor.freq_meter_stm32_icap:
    harness: sensor
    tags: sensors
    platform_allow:
      - nucleo_g474re
      - nucleo_f767zi
```

## samples/sensor/fxas21002/sample.yaml
```yaml
sample:
  name: FXAS21002 Gyroscope Sensor Sample
tests:
  sample.sensor.fxas21002:
    harness: sensor
    tags: sensors
    platform_allow: hexiwear_k64
    integration_platforms:
      - hexiwear_k64
```

## samples/sensor/fxls8974/sample.yaml
```yaml
common:
  harness: console
  harness_config:
    type: multi_line
    ordered: true
    regex:
      - ".*Booting.*"
      - "^AX=\\W*[0]\\..*AY=\\W*[0]\\..*AZ=\\W*([9]|[1])([0-1]|\\.).*$"
      - "^AX=\\W*[0]\\..*AY=\\W*[0]\\..*AZ=\\W*([9]|[1])([0-1]|\\.).*$"
      - "^AX=\\W*[0]\\..*AY=\\W*[0]\\..*AZ=\\W*([9]|[1])([0-1]|\\.).*$"
      - "^AX=\\W*[0]\\..*AY=\\W*[0]\\..*AZ=\\W*([9]|[1])([0-1]|\\.).*$"
  tags: sensors
  depends_on:
    - i2c
    - gpio
sample:
  name: FXOS8974 Accelerometer
tests:
  sample.sensor.fxls8974.accel:
    platform_allow:
      - mimxrt1040_evk
```

## samples/sensor/fxos8700-hid/sample.yaml
```yaml
sample:
  name: USB HID accelerometer mouse sample
tests:
  sample.sensor.usb.fxos8700-hid:
    depends_on: usb_device
    platform_allow: frdm_k64f/mk64f12
    harness: usb
    tags:
      - usb
      - sensors
```

## samples/sensor/fxos8700/sample.yaml
```yaml
common:
  harness: sensor
  tags: sensors
  depends_on:
    - i2c
    - gpio
sample:
  name: FXOS8700 Accelerometer/Magnetometer Sensor
tests:
  sample.sensor.fxos8700.hybrid:
    platform_allow:
      - frdm_k64f
      - hexiwear/mk64f12
      - warp7/mcimx7d/m4
      - frdm_kw41z
      - rv32m1_vega/openisa_rv32m1/ri5cy
      - twr_ke18f
      - lpcxpresso55s16
      - mimxrt685_evk/mimxrt685s/cm33
      - frdm_k22f
      - mimxrt1024_evk
      - mimxrt595_evk/mimxrt595s/cm33
    integration_platforms:
      - frdm_k64f
    extra_configs:
      - CONFIG_FXOS8700_PULSE=y
      - CONFIG_FXOS8700_PULSE_INT1=y
      - CONFIG_FXOS8700_MOTION=y
      - CONFIG_FXOS8700_MOTION_INT1=y
      - CONFIG_FXOS8700_MAG_VECM=y
  sample.sensor.fxos8700.accel:
    platform_allow:
      - frdm_kl25z
      - bbc_microbit
      - lpcxpresso55s69/lpc55s69/cpu0
      - reel_board
      - mimxrt685_evk/mimxrt685s/cm33
      - mimxrt595_evk/mimxrt595s/cm33
    integration_platforms:
      - bbc_microbit
    extra_args: CONF_FILE=prj_accel.conf
```

## samples/sensor/gecko_acmp/sample.yaml
```yaml
sample:
  description: Demonstration of the SiLabs Gecko ACMP driver
  name: SiLabs Gecko ACMP sample
common:
  platform_allow:
    - xg24_dk2601b
  integration_platforms:
    - xg24_dk2601b
  tags:
    - drivers
    - sensor
tests:
  sample.sensor.gecko_acmp:
    harness: console
    harness_config:
      type: one_line
      ordered: true
      regex:
        - "ACMP input [a-z]* threshold"
  sample.sensor.gecko_acmp.no_trigger:
    build_only: true
    extra_configs:
      - CONFIG_GECKO_ACMP_TRIGGER=n
```

## samples/sensor/grove_light/sample.yaml
```yaml
common:
  filter: CONFIG_FULL_LIBC_SUPPORTED
sample:
  name: Grove Light Sensor
tests:
  sample.sensor.grove_light:
    tags:
      - drivers
      - sensor
      - grove
      - light
    platform_allow:
      - nrf52dk/nrf52832
    integration_platforms:
      - nrf52dk/nrf52832
    harness: grove
    depends_on: adc
```

## samples/sensor/grove_temperature/sample.yaml
```yaml
common:
  filter: CONFIG_FULL_LIBC_SUPPORTED
sample:
  name: Grove Temperature Sensor
tests:
  sample.sensor.grove_temperature:
    min_flash: 33
    tags:
      - drivers
      - sensor
      - grove
      - temperature
    platform_allow:
      - nrf52dk/nrf52832
    integration_platforms:
      - nrf52dk/nrf52832
    harness: grove
    depends_on: adc
```

## samples/sensor/grow_r502a/sample.yaml
```yaml
#
# Copyright (c) 2021 Linumiz.
#
# SPDX-License-Identifier: Apache-2.0

sample:
  name: grow_r502a fingerprint sensor sample
tests:
  sample.sensor.grow_r502a:
    tags: sensors
    harness: sensor
    build_only: true
    depends_on: serial
    platform_allow:
      - esp32_devkitc_wroom/esp32/procpu
```

## samples/sensor/hc_sr04/sample.yaml
```yaml
sample:
  name: HC-SR04 ultrasonic distance measurment module
  description: Demonstration of the HC-SR04 module
tests:
  sample.drivers.hc.sr04:
    filter: dt_compat_enabled("hc-sr04")
    build_only: true
    platform_allow:
      - blackpill_f411ce
    tags:
      - sensors
      - gpio
    depends_on: gpio
```
