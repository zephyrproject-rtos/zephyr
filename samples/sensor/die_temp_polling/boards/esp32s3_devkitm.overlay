/*
 * Copyright (c) 2023 Espressif Systems (Shanghai) Co., Ltd.
 *
 * SPDX-License-Identifier: Apache-2.0
 *
 * Application overlay for enabling temperature sensor device instance
 */

&coretemp {
	status = "okay";
};
