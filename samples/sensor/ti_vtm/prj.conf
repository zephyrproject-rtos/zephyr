## CMakeLists.txt
```
# SPDX-License-Identifier: Apache-2.0
# SPDX-FileCopyrightText: Copyright (c) 2026 Texas Instruments Incorporated

cmake_minimum_required(VERSION 3.28.0)
find_package(Zephyr REQUIRED HINTS $ENV{ZEPHYR_BASE})
project(ti_vtm)

target_sources(app PRIVATE src/main.c)
```

## sample.yaml
```
sample:
  name: ti_vtm
tests:
  sample.sensor.ti_vtm:
    tags:
      - sensors
    filter: dt_nodelabel_enabled("sensor0")
    platform_allow:
      - am62l_evm/am62l3/a53
      - am243x_evm/am2434/r5f0_0
      - sk_am62/am6254/a53
    integration_platforms:
      - am62l_evm/am62l3/a53
    harness: console
    harness_config:
      type: one_line
      regex:
        - "VTM temperature: -?[0-9]+.[0-9]+ C"
```

## prj.conf
```kconfig
CONFIG_SENSOR=y
CONFIG_PRINTK=y
CONFIG_CBPRINTF_FP_SUPPORT=y
```

## boards/am62l_evm_am62l3_a53.overlay
```dts
/*
 * SPDX-License-Identifier: Apache-2.0
 * SPDX-FileCopyrightText: Copyright (c) 2026 Texas Instruments Incorporated
 */

/ {
	aliases {
		vtm-temp0 = &sensor_0;
	};
};
```

## src/main.c
```c
/*
 * SPDX-License-Identifier: Apache-2.0
 * SPDX-FileCopyrightText: Copyright (c) 2026 Texas Instruments Incorporated
 */

#include <zephyr/kernel.h>
#include <zephyr/device.h>
#include <zephyr/drivers/sensor.h>
#include <zephyr/drivers/sensor/ti_vtm.h>
#include <stdio.h>

static const struct device *const vtm_temp = DEVICE_DT_GET(DT_NODELABEL(sensor0));

static const struct sensor_trigger th0_trig = {
	.type = (enum sensor_trigger_type)TI_VTM_TRIG_TH0,
	.chan = SENSOR_CHAN_DIE_TEMP,
};

static const struct sensor_trigger th1_trig = {
	.type = (enum sensor_trigger_type)TI_VTM_TRIG_TH1,
	.chan = SENSOR_CHAN_DIE_TEMP,
};

static const struct sensor_trigger th2_trig = {
	.type = (enum sensor_trigger_type)TI_VTM_TRIG_TH2,
	.chan = SENSOR_CHAN_DIE_TEMP,
};

static void threshold_handler(const struct device *dev, const struct sensor_trigger *trig)
{
	ARG_UNUSED(dev);

	switch ((enum ti_vtm_sensor_trigger_type)trig->type) {
	case TI_VTM_TRIG_TH0:
		printf("[TH0] cold threshold crossed\n");
		break;
	case TI_VTM_TRIG_TH1:
		printf("[TH1] hot threshold crossed\n");
		break;
	case TI_VTM_TRIG_TH2:
		printf("[TH2] critical threshold crossed\n");
		break;
	default:
		printf("Unknown handler trigger");
	}

	return;
}

static struct sensor_value mc_to_val(int32_t temp_mc)
{
	struct sensor_value val = {
		.val1 = temp_mc / 1000,
		.val2 = (temp_mc % 1000) * 1000,
	};

	return val;
}

static int read_temperature(int32_t *temp_mc)
{
	struct sensor_value val;
	int ret;

	ret = sensor_sample_fetch(vtm_temp);
	if (ret < 0) {
		printf("Failed to fetch sample (%d)\n", ret);
		return ret;
	}

	ret = sensor_channel_get(vtm_temp, SENSOR_CHAN_DIE_TEMP, &val);
	if (ret < 0) {
		printf("Failed to get channel (%d)\n", ret);
		return ret;
	}

	*temp_mc = val.val1 * 1000 + val.val2 / 1000;
	printf("VTM temperature: %.2f C\n", sensor_value_to_double(&val));

	return 0;
}

static int arm_threshold(enum ti_vtm_sensor_attribute attr, const struct sensor_trigger *trig,
			 sensor_trigger_handler_t handler, int32_t temp_mc)
{
	struct sensor_value val = mc_to_val(temp_mc);
	int ret;

	ret = sensor_attr_set(vtm_temp, SENSOR_CHAN_DIE_TEMP, (enum sensor_attribute)attr, &val);
	if (ret < 0) {
		printf("Failed to set threshold attr %d (%d)\n", attr, ret);
		return ret;
	}

	ret = sensor_trigger_set(vtm_temp, trig, handler);
	if (ret < 0) {
		printf("Failed to set trigger %d (%d)\n", trig->type, ret);
		return ret;
	}

	printf("Armed threshold at %.2f C\n", sensor_value_to_double(&val));
	return 0;
}

int main(void)
{
	int32_t temp_mc;

	if (!device_is_ready(vtm_temp)) {
		printf("VTM sensor device not ready\n");
		return 0;
	}

	if (read_temperature(&temp_mc) < 0) {
		return 0;
	}

	arm_threshold(TI_VTM_ATTR_TH0_THRESH, &th0_trig, threshold_handler, temp_mc - 5000);
	arm_threshold(TI_VTM_ATTR_TH1_THRESH, &th1_trig, threshold_handler, temp_mc + 3000);
	arm_threshold(TI_VTM_ATTR_TH2_THRESH, &th2_trig, threshold_handler, temp_mc + 8000);

	while (1) {
		read_temperature(&temp_mc);
		k_msleep(1000);
	}

	return 0;
}
```
