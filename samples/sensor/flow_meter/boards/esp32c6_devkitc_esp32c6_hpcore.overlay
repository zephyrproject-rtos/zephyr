/* Copyright (c) 2026 Nicolas Belin <nbelin@baylibre.com>
 * SPDX-License-Identifier: Apache-2.0
 */

/ {
	flow_meter_0: flow_meter {
		compatible = "zephyr,flow-meter";
		/* Connect the Hall-effect sensor output to GPIO4. */
		pulse-gpios = <&gpio0 4 GPIO_ACTIVE_HIGH>;
		pulses-per-liter = <450>;
		status = "okay";
	};
};
