## samples/sensor/bma400/sample.yaml
```yaml
sample:
  name: BMA400 Sensor sample
tests:
  sample.sensor.bma400:
    harness: sensor
    tags: samples sensor
    platform_whitelist: nrf52840dk_nrf52840
```

## samples/sensor/bme280/Kconfig
```kconfig
# Copyright (c) 2020, Nordic Semiconductor ASA
# SPDX-License-Identifier: Apache-2.0

config LOG
	default y

config LOG_PRINTK
	default y

config SENSOR_LOG_LEVEL
	default 4

# Enable SPI and I2C support by default so that the sample works with
# the device connected either way. These defaults can be overridden if
# needed.
config SPI
	default y

config I2C
	default y

source "Kconfig.zephyr"
```

## samples/sensor/bme280/sample.yaml
```yaml
sample:
  name: BME280 Sensor sample
common:
  filter: dt_compat_enabled("bosch,bme280")
  tags:
    - sensors
    - bme280
tests:
  sample.sensor.bme280:
    harness: console
    platform_allow:
      - adafruit_feather_m0_basic_proto
      - rpi_pico
    integration_platforms:
      - adafruit_feather_m0_basic_proto
    harness_config:
      type: one_line
      regex:
        - "temp: (.*); press: (.*); humidity: (.*)"
      fixture: fixture_i2c_bme280
  sample.sensor.bme280.spi:
    harness: console
    platform_allow:
      - lpcxpresso55s16
    depends_on:
      - spi
    extra_args: "SHIELD=mikroe_weather_click_spi"
    harness_config:
      type: one_line
      regex:
        - "temp: (.*); press: (.*); humidity: (.*)"
      fixture: fixture_spi_bme280
  sample.sensor.bme280.rpi_pico.pio:
    harness: console
    platform_allow: rpi_pico
    integration_platforms:
      - rpi_pico
    extra_args: "DTC_OVERLAY_FILE=rpi_pico_spi_pio.overlay"
    harness_config:
      type: one_line
      regex:
        - "temp: (.*); press: (.*); humidity: (.*)"
      fixture: fixture_rpi_pico_pio_spi_bme280
```

## samples/sensor/bme680/sample.yaml
```yaml
sample:
  name: BME680 Sensor sample
tests:
  sample.sensor.bme680:
    harness: sensor
    tags:
      - samples
      - sensor
    integration_platforms:
      - nrf52840dk/nrf52840
    platform_allow:
      - nrf52840dk/nrf52840
      - adafruit_feather/nrf52840

  sample.sensor.bme680.nrf54l:
    depends_on: i2c
    tags: drivers i2c sensors
    harness: console
    harness_config:
      fixture: pca63565
      type: one_line
      regex:
        - "^\\s*T:\\s*-?[0-9\\.]*; P:\\s*-?[0-9\\.]*; H: \\s*-?[0-9\\.]*; G:\\s*-?[0-9\\.]*$"
    extra_args:
      - SHIELD=pca63565
    platform_allow: nrf54l15pdk/nrf54l15/cpuapp
```

## samples/sensor/bmg160/sample.yaml
```yaml
sample:
  name: BMG160 Sensor Sample
tests:
  sample.sensor.bmg160:
    harness: sensor
    tags: sensors
    depends_on:
      - i2c
      - gpio
    platform_allow:
      - frdm_k64f
    integration_platforms:
      - frdm_k64f
```

## samples/sensor/bmi160/sample.yaml
```yaml
sample:
  name: BMI160 Sensor Sample
tests:
  sample.sensor.bmi160:
    harness: sensor
    platform_whitelist: arduino_101_sss
    tags: sensors
    depends_on: spi gpio
```

## samples/sensor/bmi270/sample.yaml
```yaml
sample:
  name: BMI270 Sensor sample
tests:
  sample.sensor.bmi270:
    filter: dt_compat_enabled("bosch,bmi270")
    harness: sensor
    tags:
      - samples
      - sensor
```

## samples/sensor/bmm150/sample.yaml
```yaml
sample:
  name: BMM150 Sensor Sample
tests:
  sample.sensor.bmm150:
    harness: sensor
    tags: sensors
    pre-filter: subsys_dt_compat_enabled("gpio") and subsys_dt_compat_enabled("i2c")
    filter: dt_compat_enabled("bosch,bmm150")
```

## samples/sensor/bmm350/sample.yaml
```yaml
sample:
  name: BMM350 Sensor sample
tests:
  sample.sensor.bmm350:
    harness: sensor
    tags:
      - samples
      - sensor
    depends_on: arduino_i2c
```

## samples/sensor/bmp180/sample.yaml
```yaml
sample:
  name: Bosch pressure and temperature BMP180 sensor sample
tests:
  sample.sensor.bmp180:
  build_only: true
    harness: sensor
    tags: samples sensors
    platform_allow: nrf52840dk_nrf52840
    integration_platforms:
      -     platform_allow: nrf52840dk_nrf52840
    depends_on: gpio i2c bmp180
    filter: dt_compat_enabled("bosch,bmp180")
```

## samples/sensor/bmp388/sample.yaml
```yaml
sample:
  name: BMP388 Sensor sample
tests:
  sample.sensor.bmp388:
    harness: console
    tags: sensors
    depends_on: i2c bmp388
    harness_config:
        type: one_line
        regex:
            - "press: (.*) kPa; temp: (.*) oC; altitude: (.*) m"
        fixture: fixture_i2c_bmp388
```

## samples/sensor/bmx160/sample.yaml
```yaml
sample:
  name: BMX160 Sensor Sample
tests:
  sample.sensor.bmx160:
    harness: sensor
    tags: sensors
    depends_on: i2c gpio
    filter: dt_compat_enabled("bosch,bmx160")
```

## samples/sensor/bno055/Kconfig
```kconfig
# SPDX-License-Identifier: Apache-2.0

config LOG
	default y

config LOG_PRINTK
	default y

config SENSOR_LOG_LEVEL
	default 4

config I2C
	default y

source "Kconfig.zephyr"
```

## samples/sensor/bq274xx/sample.yaml
```yaml
sample:
  description: Demonstration of the BQ274XX Fuel gauge Sensor driver
  name: BQ274XX Sample
tests:
  sample.sensor.bq274xx:
    harness: sensor
    platform_allow:
      - innblue22/nrf9160
    integration_platforms:
      - innblue22/nrf9160
    tags: sensors
    depends_on: i2c
  sample.sensor.bq274xx_without_int_gpios:
    harness: sensor
    platform_allow:
      - innblue22/nrf9160
    integration_platforms:
      - innblue22/nrf9160
    tags: sensors
    depends_on: i2c
    extra_configs:
      - CONFIG_BQ274XX_PM=n
```

## samples/sensor/bq34110/sample.yaml
```yaml
sample:
  description: Demonstration of the BQ34110 Fuel gauge Sensor driver
  name: BQ34110 Sample
tests:
  sample.sensor.bq34110:
    harness: sensor
    tags: sensors
    depends_on: i2c gpio
    platform_allow: frdm_k64f
```

## samples/sensor/bq35100/sample.yaml
```yaml
sample:
  name: bq35100 sample
  description: BQ35100 sample application
tests:
  sample.sensor.bq35100:
    harness: sensor
    tags: sensors
    platform_allow: nrf52840_mdk
    integration_platforms:
      - nrf52840_mdk
```

## samples/sensor/ccs811/Kconfig
```kconfig
#
# Copyright (c) 2018 Peter Bigot Consulting, LLC
#
# SPDX-License-Identifier: Apache-2.0
#

mainmenu "CCS811 sample application"

choice
	prompt "CCS811 Trigger On"
	default APP_TRIGGER_ON_DATAREADY
	depends on CCS811_TRIGGER
	help
	  Select the type of trigger to use

config APP_TRIGGER_ON_DATAREADY
	bool "Trigger on data ready"

config APP_TRIGGER_ON_THRESHOLD
	bool "Trigger on eCO2 threshold crossing"

endchoice

config APP_CO2_MEDIUM_PPM
	int "Threshold of eCO2 between low and medium"
	default 1500
	depends on APP_TRIGGER_ON_THRESHOLD

config APP_CO2_HIGH_PPM
	int "Threshold of eCO2 between medium and high"
	default 2500
	depends on APP_TRIGGER_ON_THRESHOLD

config APP_MONITOR_BASELINE
	bool "Display BASELINE register value for each sample"
	default y

config APP_USE_ENVDATA
	bool "Program CCS811 with fixed environmental parameters"
	default n

config APP_ENV_TEMPERATURE
	int "Environment temperature for CCS811, Cel"
	default 25
	depends on APP_USE_ENVDATA

config APP_ENV_HUMIDITY
	int "Environment humidity for CCS811, %RH"
	default 50
	depends on APP_USE_ENVDATA

source "Kconfig.zephyr"
```

## samples/sensor/ccs811/boards/nrf51_ble400.conf
```kconfig
#
# Copyright (c) 2018 Peter Bigot Consulting, LLC
#
# SPDX-License-Identifier: Apache-2.0
#

CONFIG_STDOUT_CONSOLE=y
CONFIG_SENSOR=y
#CONFIG_CCS811_DRIVE_MODE_2=y
#CONFIG_CCS811_TRIGGER_GLOBAL_THREAD=y
#CONFIG_CCS811_TRIGGER_OWN_THREAD=y
```

## samples/sensor/ccs811/sample.yaml
```yaml
#
# Copyright (c) 2018 Linaro Ltd.
#
# SPDX-License-Identifier: Apache-2.0
#

sample:
  description: Demonstration of the CCS811 Digital Gas Sensor driver
  name: CCS811 sample
tests:
  sample.sensor.ccs811:
    harness: sensor
    tags: sensors
    platform_allow:
      - thingy52/nrf52832
      - sltb004a
    integration_platforms:
      - sltb004a
    depends_on: i2c
```

## samples/sensor/clock/sample.yaml
```yaml
#
# Copyright (c) 2024 Cienet
#
# SPDX-License-Identifier: Apache-2.0

tests:
  sample.sensor.clock.counter:
    filter: CONFIG_SENSOR_CLOCK_COUNTER
    tags:
      - drivers
      - sensor
      - counter
    platform_allow:
      - nrf52840dk/nrf52840
      - nrf52833dk/nrf52833
    extra_dtc_overlay_files:
      - "boards/${BOARD}${NORMALIZED_BOARD_QUALIFIERS}.overlay"
      - "boards/nrf528xx_counter.overlay"

  sample.sensor.clock.rtc:
    filter: CONFIG_SENSOR_CLOCK_RTC
    tags:
      - drivers
      - sensor
      - rtc
    platform_allow:
      - nrf52840dk/nrf52840
      - nrf52833dk/nrf52833
    extra_dtc_overlay_files:
      - "boards/${BOARD}${NORMALIZED_BOARD_QUALIFIERS}.overlay"
      - "boards/nrf528xx_rtc.overlay"

  sample.sensor.clock.system:
    filter: CONFIG_SENSOR_CLOCK_SYSTEM
    tags:
      - drivers
      - sensor
      - system_clock
```

## samples/sensor/co2_polling/sample.yaml
```yaml
sample:
  name: CO2 sensor sample
tests:
  sample.sensor.co2:
    harness: sensor
    tags: sensors
    platform_allow:
      - nucleo_h563zi
    integration_platforms:
      - nucleo_h563zi
```

## samples/sensor/dht/sample.yaml
```yaml
#
# Copyright (c) 2019 Nordic Semiconductor ASA
#
# SPDX-License-Identifier: Apache-2.0
#

common:
  filter: CONFIG_FULL_LIBC_SUPPORTED
sample:
  name: DHT Sensor Sample
tests:
  sample.sensor.dht:
    build_only: true
    platform_allow: nrf52dk/nrf52832
    integration_platforms:
      - nrf52dk/nrf52832
    tags: sensors
```

## samples/sensor/dht_polling/sample.yaml
```yaml
#
# Copyright (c) 2023 Ian Morris
#
# SPDX-License-Identifier: Apache-2.0
#

sample:
  description: Digital Humidity Temperature polling sample
  name: DHT polling sample
tests:
  sample.sensor.dht_polling:
    tags: sensors
    filter: dt_alias_exists("dht0")
    integration_platforms:
      - nucleo_f401re
    platform_allow:
      - adafruit_qt_py_rp2040/rp2040
      - nucleo_f401re
    extra_args:
      - platform:adafruit_qt_py_rp2040/rp2040:SHIELD="adafruit_aht20"
    harness: console
    harness_config:
      fixture: fixture_i2c_hs300x
      type: one_line
      regex:
        - "[0-9A-Za-z_,+-.]*@[0-9A-Fa-f]*: temp is (.*) °C humidity is (.*) %RH"
```
