&i2c0 {
	bma400@14 {
		status = "okay";
		compatible = "bosch,bma400";
		reg = <0x14>;
		int1-gpios = <&gpio0 2 GPIO_ACTIVE_HIGH | GPIO_PULL_UP>;
		int2-gpios = <&gpio1 15 GPIO_ACTIVE_HIGH | GPIO_PULL_UP>;
	};
};
