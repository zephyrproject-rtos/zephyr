/*
 * Copyright (c) 2025 Helbling Technik AG
 *
 * SPDX-License-Identifier: Apache-2.0
 */

&i2c0 {
	lsm6dsr: lsm6dsr@6b {
		compatible = "st,lsm6dsr";
		reg = <0x6b>;
		irq-gpios = <&gpio1 7 GPIO_ACTIVE_HIGH>;
	};
};
