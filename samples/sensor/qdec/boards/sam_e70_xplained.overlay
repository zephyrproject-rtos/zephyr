/*
 * Copyright (c) 2021, Piotr Mienkowski
 *
 * SPDX-License-Identifier: Apache-2.0
 */

&tc0 {
	compatible = "atmel,sam-tc-qdec";
	status = "okay";
	label = "QDEC_0";

	pinctrl-0 = <&tc0_qdec_default>;
	pinctrl-names = "default";
};
