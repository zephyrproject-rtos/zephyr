/*
 * Copyright (c) 2024 Gerson Fernando Budke <nandojve@gmail.com>
 *
 * SPDX-License-Identifier: Apache-2.0
 */

/ {
	aliases {
		qdec0 = &qdec0;
	};
};

&tc0 {
	status = "okay";
};

&qdec0 {
	status = "okay";
};
