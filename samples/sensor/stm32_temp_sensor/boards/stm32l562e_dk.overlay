/*
 * Copyright (c) 2022 Wouter Cappelle
 *
 * SPDX-License-Identifier: Apache-2.0
 *
 * Application overlay for creating temperature sensor device instance
 */

&die_temp {
    status = "okay";
};

&adc1 {
    status = "okay";
};
