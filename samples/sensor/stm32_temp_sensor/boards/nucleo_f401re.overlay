/*
 * Copyright (c) 2021 Eug Krashtan
 *
 * SPDX-License-Identifier: Apache-2.0
 *
 * Application overlay for creating temperature sensor device instance
 */

/ {
	stm-temp {
		compatible = "st,stm32-temp";
		io-channels = <&adc1 16>;
		status = "okay";
	};
};
