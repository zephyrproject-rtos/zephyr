/*
 * Copyright (c) 2023 STMicroelectronics
 *
 * SPDX-License-Identifier: Apache-2.0
 *
 * Application overlay for creating temperature sensor device instance
 */

/ {
	stm-temp {
		compatible = "st,stm32-temp";
		io-channels = <&adc1 18>;
		status = "okay";
	};
};
