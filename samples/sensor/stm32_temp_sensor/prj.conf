## CMakeLists.txt
```
# SPDX-License-Identifier: Apache-2.0

cmake_minimum_required(VERSION 3.20.0)
find_package(Zephyr REQUIRED HINTS $ENV{ZEPHYR_BASE})
project(stm32_temp_sensor)

FILE(GLOB app_sources src/*.c)
target_sources(app PRIVATE ${app_sources})
```

## sample.yaml
```
sample:
  description: Usage of STM32 temperature sensor
  name: stm32_temp_sensor
tests:
  sample.sensor.stm32_temp_sensor:
    depends_on: adc
    tags: sensors tests
    filter: dt_compat_enabled("st,stm32-temp-cal") or dt_compat_enabled("st,stm32-temp")
    harness: console
    harness_config:
      type: one_line
      regex:
        - "Current temperature: [1-5][0-9].[0-9] °C"
```

## prj.conf
```kconfig
CONFIG_SENSOR=y
CONFIG_ADC=y
CONFIG_STM32_TEMP=y
CONFIG_PRINTK=y
CONFIG_CBPRINTF_FP_SUPPORT=y
```

## boards/nucleo_f401re.overlay
```dts
/*
 * Copyright (c) 2021 Eug Krashtan
 *
 * SPDX-License-Identifier: Apache-2.0
 *
 * Application overlay for creating temperature sensor device instance
 */

/ {
	stm-temp {
		compatible = "st,stm32-temp";
		io-channels = <&adc1 16>;
		status = "okay";
	};
};
```

## boards/nucleo_f429zi.overlay
```dts
/*
 * Copyright (c) 2023 STMicroelectronics
 *
 * SPDX-License-Identifier: Apache-2.0
 *
 * Application overlay for creating temperature sensor device instance
 */

/ {
	stm-temp {
		compatible = "st,stm32-temp";
		io-channels = <&adc1 18>;
		status = "okay";
	};
};
```

## boards/stm32f103_mini.overlay
```dts
/*
 * Copyright (c) 2021 Eug Krashtan
 *
 * SPDX-License-Identifier: Apache-2.0
 *
 * Application overlay for creating temperature sensor device instance
 */

/ {
	stm-temp {
		label = "DIE_TEMP";
		compatible = "st,stm32-temp";
		io-channels = <&adc1 16>;
		avgslope = <43>;
		v25 = <1430>;
		ntc;
		status = "okay";
	};
};

&adc1 {
	status = "okay";
};
```

## boards/stm32l562e_dk.overlay
```dts
/*
 * Copyright (c) 2022 Wouter Cappelle
 *
 * SPDX-License-Identifier: Apache-2.0
 *
 * Application overlay for creating temperature sensor device instance
 */

&die_temp {
    status = "okay";
};

&adc1 {
    status = "okay";
};
```

## src/main.c
```c
/*
 * Copyright (c) 2021 Eug Krashtan
 *
 * SPDX-License-Identifier: Apache-2.0
 */

#include <zephyr/kernel.h>
#include <zephyr/device.h>
#include <zephyr/drivers/sensor.h>
#include <zephyr/sys/printk.h>

void main(void)
{
#if DT_HAS_COMPAT_STATUS_OKAY(st_stm32_temp)
	const struct device *const dev = DEVICE_DT_GET_ONE(st_stm32_temp);
#elif DT_HAS_COMPAT_STATUS_OKAY(st_stm32_temp_cal)
	const struct device *const dev = DEVICE_DT_GET_ONE(st_stm32_temp_cal);
#endif
	struct sensor_value val;
	int rc;

	if (!device_is_ready(dev)) {
		printk("Temperature sensor is not ready\n");
		return;
	}

	printk("STM32 Die temperature sensor test\n");

	while (1) {
		k_sleep(K_MSEC(300));

		/* fetch sensor samples */
		rc = sensor_sample_fetch(dev);
		if (rc) {
			printk("Failed to fetch sample (%d)\n", rc);
			continue;
		}

		rc = sensor_channel_get(dev, SENSOR_CHAN_DIE_TEMP, &val);
		if (rc) {
			printk("Failed to get data (%d)\n", rc);
			continue;
		}

		printk("Current temperature: %.1f °C\n", sensor_value_to_double(&val));
	}
}
```
