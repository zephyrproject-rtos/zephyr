## samples/sensor/magn_polling/boards/kit_pse84_eval_pse846gps2dbzc4a_m33.conf
```kconfig
# SPDX-FileCopyrightText: Copyright (c) 2026 Infineon Technologies AG,
# SPDX-FileCopyrightText: or an affiliate of Infineon Technologies AG. All rights reserved.

CONFIG_I3C_CONTROLLER_ROLE_ONLY=y
```

## samples/sensor/thermometer/boards/nucleo_h7a3zi_q.conf
```kconfig
# SPDX-FileCopyrightText: Copyright The Zephyr Project Contributors
# SPDX-License-Identifier: Apache-2.0

# Enable trigger support
CONFIG_TMP1075_TRIGGER_GLOBAL_THREAD=y
CONFIG_I2C_STM32_INTERRUPT=n
```

## samples/shields/adi_lsmspg/curve_tracer/Kconfig
```kconfig
# SPDX-License-Identifier: Apache-2.0

menu "ADALM-LSMSPG curve tracer"

config CURVE_TRACER_RSENSE_MOHM
	int "Collector sense resistor (milliohm)"
	default 49900
	help
	  Rsense_npn on the ADALM-LSMSPG schematic is 49.9 ohm. The no-OS
	  example uses 47 ohm (47000).

config CURVE_TRACER_RBASE_OHM
	int "Base resistor (ohm)"
	default 49900
	help
	  Rbase_npn on the ADALM-LSMSPG schematic is 49.9 kohm. The no-OS
	  example uses 47 kohm (47000).

endmenu

source "Kconfig.zephyr"
```

## samples/shields/mchp_QT7/sample.yaml
```yaml
# SPDX-FileCopyrightText: Copyright (c) 2026 Microchip Technology Inc.
# SPDX-License-Identifier: Apache-2.0

sample:
  name: mchp_QT7
  description: Demonstrates the QT7 Addon board touch sensors using the PTC peripheral.

common:
  tags:
    - input
  build_only: true

tests:
  sample.shields.mchp_qt7:
    platform_allow:
      - pic32cm_jh01_cpro
    extra_args:
      - SHIELD=qt7_xplained_pro
    extra_configs:
      - CONFIG_GPIO=y
      - CONFIG_LED=y
      - CONFIG_INPUT=y
      - CONFIG_INPUT_MCHP_TOUCH=y
      - CONFIG_INPUT_MCHP_TOUCH_EN_BTTN_MODULE=y
      - CONFIG_INPUT_MCHP_TOUCH_EN_FREQ_HOP=y
      - CONFIG_INPUT_MCHP_TOUCH_EN_FREQ_AUTO_TUNE=y
      - CONFIG_INPUT_MCHP_TOUCH_DATASTREAMER=y
      - CONFIG_INPUT_MODE_SYNCHRONOUS=y
      - CONFIG_INPUT_GPIO_KEYS=n
      - CONFIG_INPUT_MCHP_TOUCH_EN_SCROLLER=y
```

## samples/subsys/authentication/fido2/Kconfig
```kconfig
# Copyright (c) 2026 Siratul Islam <email@sirat.me>
# Copyright (c) 2026 Jan-Philipp Schmale <jan-philipp.schmale@teratron.de>
# SPDX-License-Identifier: Apache-2.0

mainmenu "FIDO2 Sample Application"

rsource "Kconfig.bt"

source "samples/subsys/usb/common/Kconfig.sample_usbd"

source "Kconfig.zephyr"
```

## samples/subsys/canbus/canopen/Kconfig
```kconfig
# SPDX-FileCopyrightText: Copyright (c) 2026 Linumiz
#
# SPDX-License-Identifier: Apache-2.0

mainmenu "CANopen sample"

config SAMPLE_NODE_ID
	int "CANopen node-ID"
	default 16
	range 1 127

config SAMPLE_BITRATE
	int "CAN bitrate in bit/s"
	default 500000

config SAMPLE_COUNTER_PERIOD_MS
	int "Counter increment period in milliseconds"
	default 100

config SAMPLE_TPDO_EVENT_TIMER_MS
	int "TPDO1 event timer in milliseconds"
	default 1000
	range 0 65535

source "Kconfig.zephyr"
```

## samples/subsys/canbus/j1939/Kconfig
```kconfig
# Private config options to the J1939 sample

# Copyright (c) 2026 Deere & Company
# SPDX-License-Identifier: Apache-2.0

mainmenu "J1939 sample"

config SAMPLE_LOOPBACK_MODE
	bool "Use CAN loopback mode"
	help
	  Set the CAN controller to loopback mode. This allows testing without a second board.

source "Kconfig.zephyr"
```

## samples/subsys/debug/asserts/Kconfig
```kconfig
# Copyright (c) 2026 Måns Ansgariusson <mansgariusson@gmail.com>
# SPDX-License-Identifier: Apache-2.0

menu "Zephyr"
source "Kconfig.zephyr"
endmenu

# Generate CONFIG_ASSERT_MODULE_MYMODULE_LEVEL (a user-facing Off/On/Verbose
# choice plus the derived, non-assignable level) consumed by
# ZASSERT_MODULE(MYMODULE).
module = MYMODULE
module-str = the MYMODULE assert module
source "lib/os/zassert/Kconfig.template.assert"
```

## samples/subsys/display/lvgl/boards/esp32p4x_function_ev_board_hpcore.conf
```kconfig
CONFIG_MIPI_DSI=y
CONFIG_ESP_SPIRAM=y
CONFIG_ESP_SPIRAM_HEAP_SIZE=8388608
CONFIG_HEAP_MEM_POOL_SIZE=262144

CONFIG_LV_Z_MEM_POOL_SIZE=65536
CONFIG_LV_Z_VDB_SIZE=16
CONFIG_MAIN_STACK_SIZE=8192
```

## samples/subsys/display/lvgl/boards/esp32s3_lcd_ev_procpu.conf
```kconfig
CONFIG_MAIN_STACK_SIZE=8192
CONFIG_LV_Z_VDB_SIZE=25
CONFIG_LV_Z_BITS_PER_PIXEL=16
```

## samples/subsys/display/lvgl/boards/mimxrt595_evk_mimxrt595s_cm33.conf
```kconfig
CONFIG_LV_Z_MEM_POOL_SIZE=262144
CONFIG_MAIN_STACK_SIZE=8192
CONFIG_HEAP_MEM_POOL_SIZE=262144
CONFIG_LV_DRAW_BUF_ALIGN=16
CONFIG_LV_ATTRIBUTE_MEM_ALIGN_SIZE=32
CONFIG_LV_DRAW_BUF_STRIDE_ALIGN=64
CONFIG_LV_Z_BITS_PER_PIXEL=16
CONFIG_LV_USE_DRAW_VG_LITE=y
CONFIG_MEMC=y
```

## samples/subsys/display/terminal/boards/native_sim_native_64.conf
```kconfig
CONFIG_LOG_BACKEND_NATIVE_POSIX=n
CONFIG_SHELL_DEFAULT_TERMINAL_WIDTH=32
CONFIG_SHELL_DEFAULT_TERMINAL_HEIGHT=15
```

## samples/subsys/fs/fs_sample/boards/lp_em_cc35x1_cc3551e.conf
```kconfig
CONFIG_SHELL=y

CONFIG_LOG=y
CONFIG_LOG_MODE_IMMEDIATE=y

CONFIG_DISK_ACCESS=y
CONFIG_DISK_DRIVER_SDMMC=y

CONFIG_SDHC=y
CONFIG_SDHC_TI_CC35XX=y

# Disable SPI due to pin conflict
CONFIG_SPI=n
CONFIG_SPI_CC35XX=n

CONFIG_FILE_SYSTEM=y
CONFIG_FILE_SYSTEM_SHELL=y
CONFIG_FILE_SYSTEM_MKFS=y
CONFIG_FAT_FILESYSTEM_ELM=n
CONFIG_FILE_SYSTEM_EXT2=y
CONFIG_EXT2_DISK_STARTING_SECTOR=0
CONFIG_TEST_RANDOM_GENERATOR=y

CONFIG_HEAP_MEM_POOL_SIZE=4096
```

## samples/subsys/fs/fs_sample/boards/native_sim_sdhc.conf
```kconfig
# Copyright 2026 Alif Semiconductor
# SPDX-License-Identifier: Apache-2.0

CONFIG_SDHC_EMUL=y
CONFIG_DISK_DRIVER_SDMMC=y
CONFIG_FILE_SYSTEM_MKFS=y
CONFIG_FS_SAMPLE_MKFS=y
CONFIG_FS_FATFS_LFN=y
CONFIG_HEAP_MEM_POOL_SIZE=2097152
```

## samples/subsys/fs/fs_sample/boards/stm32h735g_disco.conf
```kconfig
# Copyright (c) 2026 EXALT Technologies
# SPDX-License-Identifier: Apache-2.0

CONFIG_SDHC_STM32_SDMMC=n
```

## samples/subsys/fs/littlefs/boards/am62l_evm_am62l3_a53.conf
```kconfig
#
# SPDX-FileCopyrightText: 2026 Texas Instruments Incorporated
#
# SPDX-License-Identifier: Apache-2.0
#

CONFIG_MPU_ALLOW_FLASH_WRITE=y
```

## samples/subsys/input/input_dump/boards/kit_pse84_eval_pse846gps2dbzc4a_m55.conf
```kconfig
# SPDX-FileCopyrightText: Copyright (c) 2026 Infineon Technologies AG,
# SPDX-FileCopyrightText: or an affiliate of Infineon Technologies AG. All rights reserved.
#
# SPDX-License-Identifier: Apache-2.0

CONFIG_INPUT_FT5336_PERIOD_MS=20
CONFIG_INPUT_FT5336_INIT_DELAY_MS=1000
```
