/*
 * SPDX-FileCopyrightText: Copyright The Zephyr Project Contributors
 * SPDX-License-Identifier: Apache-2.0
 */

/ {
	aliases {
		co2 = &explorir_m;
	};
};

&lpuart1 {
	current-speed = <9600>;
	status = "okay";

	explorir_m: explorir_m {
		compatible = "gss,explorir-m";
		status = "okay";
	};
};
