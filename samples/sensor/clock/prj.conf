## CMakeLists.txt
```
#
# Copyright (c) 2024 Cienet
#
# SPDX-License-Identifier: Apache-2.0
#

cmake_minimum_required(VERSION 3.28.0)
find_package(Zephyr REQUIRED HINTS $ENV{ZEPHYR_BASE})
project(clock)

FILE(GLOB app_sources src/*.c)
target_sources(app PRIVATE ${app_sources})
```

## sample.yaml
```
#
# Copyright (c) 2024 Cienet
#
# SPDX-License-Identifier: Apache-2.0

common:
  harness: console
  harness_config:
    type: multi_line
    ordered: false
    regex:
      - "Cycles:.*"
      - "Nanoseconds:.*"

tests:
  sample.sensor.clock.counter:
    filter: CONFIG_SENSOR_CLOCK_COUNTER
    tags:
      - drivers
      - sensor
      - counter
    platform_allow:
      - nrf52840dk/nrf52840
      - nrf52833dk/nrf52833
    extra_dtc_overlay_files:
      - "boards/${BOARD}_${NORMALIZED_BOARD_QUALIFIERS}.overlay"
      - "boards/nrf528xx_counter.overlay"

  sample.sensor.clock.rtc:
    filter: CONFIG_SENSOR_CLOCK_RTC
    tags:
      - drivers
      - sensor
      - rtc
    platform_allow:
      - nrf52840dk/nrf52840
      - nrf52833dk/nrf52833
    extra_dtc_overlay_files:
      - "boards/${BOARD}_${NORMALIZED_BOARD_QUALIFIERS}.overlay"
      - "boards/nrf528xx_rtc.overlay"

  sample.sensor.clock.system:
    filter: CONFIG_SENSOR_CLOCK_SYSTEM
    tags:
      - drivers
      - sensor
      - system_clock
```

## prj.conf
```kconfig
#
# Copyright (c) 2024 Cienet
#
# SPDX-License-Identifier: Apache-2.0
#
CONFIG_LOG=y
CONFIG_LOG_DEFAULT_LEVEL=3

CONFIG_SENSOR=y
CONFIG_COUNTER=y
CONFIG_RTC=y
CONFIG_SENSOR_ASYNC_API=y

CONFIG_SENSOR_CLOCK_COUNTER=y
```

## boards/nrf52840dk_nrf52840.overlay
```dts
/*
 * Copyright (c) 2024 Cienet
 *
 * SPDX-License-Identifier: Apache-2.0
 */

&rtc0 {
	status = "okay";
};

&timer0 {
	status = "okay";
};
```

## boards/nrf528xx_counter.overlay
```dts
/*
 * Copyright (c) 2024 Cienet
 *
 * SPDX-License-Identifier: Apache-2.0
 */

/ {
	chosen {
		zephyr,sensor-clock = &timer0;
	};
};
```

## boards/nrf528xx_rtc.overlay
```dts
/*
 * Copyright (c) 2024 Cienet
 *
 * SPDX-License-Identifier: Apache-2.0
 */

/ {
	chosen {
		zephyr,sensor-clock = &rtc0;
	};
};
```

## src/main.c
```c
/*
 * Copyright (c) 2024 Cienet
 *
 * SPDX-License-Identifier: Apache-2.0
 */

#include <zephyr/kernel.h>
#include <zephyr/drivers/sensor_clock.h>
#include <zephyr/sys/clock.h>
#include <zephyr/drivers/counter.h>
#include <stdio.h>

int main(void)
{
	uint64_t cycles = 0;
	uint64_t delta_ns = 0;
	int err;

	while (true) {
		k_sleep(K_MSEC(1000));

		err = sensor_clock_get_cycles(&cycles);
		if (err) {
			printf("Failed to get sensor clock cycles, error: %d\n", err);
			continue;
		}

		printf("Cycles: %llu\n", cycles);

		delta_ns = sensor_clock_cycles_to_ns(cycles);

		printf("Nanoseconds: %llu\n", delta_ns);
	}

	return 0;
}
```
