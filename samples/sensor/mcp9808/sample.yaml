## samples/sensor/mcp9808/sample.yaml
```yaml
sample:
  name: MCP98XX Temperature Sensor
tests:
  sample.sensor.mcp98xx:
    harness: sensor
    tags: sensors
    depends_on: i2c
    filter: dt_compat_enabled("microchip,mcp98xx")
    platform_allow: nucleo_l053r8
    integration_platforms:
      - nucleo_l053r8
```

## samples/sensor/mcux_acmp/sample.yaml
```yaml
sample:
  description: Demonstration of the NXP MCUX ACMP sensor driver
  name: NXP MCUX ACMP sample
common:
  platform_allow:
    - twr_ke18f
    - mimxrt1170_evk/mimxrt1176/cm7
    - mimxrt1170_evk/mimxrt1176/cm4
    - frdm_ke17z
    - frdm_ke17z512
  integration_platforms:
    - twr_ke18f
  tags:
    - drivers
    - sensor
tests:
  sample.sensor.mcux_acmp:
    harness: console
    harness_config:
      type: multi_line
      ordered: true
      regex:
        - "Adjust ACMP input voltage by turning the potentiometer"
        - "ACMP input [a-z]* threshold"
  sample.sensor.mcux_acmp.no_trigger:
    build_only: true
    extra_configs:
      - CONFIG_MCUX_ACMP_TRIGGER=n
```

## samples/sensor/mcux_lpcmp/Kconfig
```kconfig
#
# Copyright NXP 2025
#
# SPDX-License-Identifier: Apache-2.0
#

config LPCMP_POSITIVE_PORT
	int "The LPCMP positive input port"
	default 0 if $(dt_node_str_prop_equals,$(dt_nodelabel_path,lpcmp0),positive-mux-input,IN0)
	default 1 if $(dt_node_str_prop_equals,$(dt_nodelabel_path,lpcmp0),positive-mux-input,IN1)
	default 2 if $(dt_node_str_prop_equals,$(dt_nodelabel_path,lpcmp0),positive-mux-input,IN2)
	default 3 if $(dt_node_str_prop_equals,$(dt_nodelabel_path,lpcmp0),positive-mux-input,IN3)
	default 4 if $(dt_node_str_prop_equals,$(dt_nodelabel_path,lpcmp0),positive-mux-input,IN4)
	default 5 if $(dt_node_str_prop_equals,$(dt_nodelabel_path,lpcmp0),positive-mux-input,IN5)
	default 7 if $(dt_node_str_prop_equals,$(dt_nodelabel_path,lpcmp0),positive-mux-input,DAC)
	help
	  Specifies positive input port.

config LPCMP_NEGATIVE_PORT
	int "The LPCMP negative input port"
	default 0 if $(dt_node_str_prop_equals,$(dt_nodelabel_path,lpcmp0),negative-mux-input,IN0)
	default 1 if $(dt_node_str_prop_equals,$(dt_nodelabel_path,lpcmp0),negative-mux-input,IN1)
	default 2 if $(dt_node_str_prop_equals,$(dt_nodelabel_path,lpcmp0),negative-mux-input,IN2)
	default 3 if $(dt_node_str_prop_equals,$(dt_nodelabel_path,lpcmp0),negative-mux-input,IN3)
	default 4 if $(dt_node_str_prop_equals,$(dt_nodelabel_path,lpcmp0),negative-mux-input,IN4)
	default 5 if $(dt_node_str_prop_equals,$(dt_nodelabel_path,lpcmp0),negative-mux-input,IN5)
	default 7 if $(dt_node_str_prop_equals,$(dt_nodelabel_path,lpcmp0),negative-mux-input,DAC)
	help
	  Specifies negative input port.

source "Kconfig.zephyr"
```

## samples/sensor/mcux_lpcmp/sample.yaml
```yaml
sample:
  description: Demonstration of the NXP MCUX LPCMP driver
  name: NXP MCUX LPCMP sample
common:
  platform_allow:
    - frdm_mcxn947/mcxn947/cpu0
    - mcx_n9xx_evk/mcxn947/cpu0
    - frdm_mcxn236
    - frdm_mcxa156
    - frdm_mcxa153
    - frdm_mcxa346
    - frdm_mcxa266
  integration_platforms:
    - frdm_mcxn947/mcxn947/cpu0
    - frdm_mcxn236
    - frdm_mcxa346
    - frdm_mcxa266
  tags:
    - drivers
    - sensor
tests:
  sample.sensor.mcux_lpcmp:
    harness: console
    harness_config:
      type: one_line
      ordered: true
      regex:
        - "LPCMP input [a-z]* threshold"
  sample.sensor.mcux_lpcmp.no_trigger:
    build_only: true
    extra_configs:
      - CONFIG_MCUX_LPCMP_TRIGGER=n
```

## samples/sensor/mma8451q/sample.yaml
```yaml
sample:
  name: MMA8451Q Accelerometer/Magnetometer Sensor
tests:
  test:
    harness: sensor
    platform_whitelist: frdm_kl25z
    tags: sensors
    depends_on: i2c
```

## samples/sensor/mpr/sample.yaml
```yaml
sample:
  name: MPR Pressure Sensor
tests:
  sample.sensor.mpr:
    harness: sensor
    tags: sensors
    platform_allow: arduino_due/sam3x8e
    integration_platforms:
      - arduino_due/sam3x8e
```

## samples/sensor/mpu6050/sample.yaml
```yaml
#
# Copyright (c) 2019 Nordic Semiconductor ASA
#
# SPDX-License-Identifier: Apache-2.0
#

sample:
  name: MPU6050 Sensor Sample
tests:
  sample.sensor.mpu6050:
    build_only: true
    platform_allow:
      - nrf52dk/nrf52832
    tags: sensors
```

## samples/sensor/ms5837/sample.yaml
```yaml
sample:
  description: TBD
  name: TBD
tests:
  sample.sensor.ms5837:
    build_only: true
    platform_allow: nrf52840dk/nrf52840
    integration_platforms:
      - nrf52840dk/nrf52840
    tags: sensors
```

## samples/sensor/mtch9010/sample.yaml
```yaml
#
# Copyright (c) 2025 Microchip Technology Inc.
#
# SPDX-License-Identifier: Apache-2.0

sample:
  name: mtch9010 liquid leak detector testbench
  description: Demonstration of the MTCH9010 liquid leak detector
tests:
  sample.sensor.mtch9010.capacitive:
    tags: sensors
    build_only: true
    platform_allow:
      - saml21_xpro
    extra_args:
      - DTC_OVERLAY_FILE="capacitive.overlay"
  sample.sensor.mtch9010.conductive:
    tags: sensors
    build_only: true
    platform_allow:
      - saml21_xpro
    extra_args:
      - DTC_OVERLAY_FILE="conductive.overlay"
```

## samples/sensor/multiple_temp_polling/sample.yaml
```yaml
sample:
  name: Multiple Ambient Temperature Polling Sample
tests:
  sample.sensor.multiple_temp_polling:
    harness: sensor
    tags: sensors
    filter: dt_alias_exists("temp0") and dt_alias_exists("temp1")
```

## samples/sensor/nine_degrees_freedom/sample.yaml
```yaml
sample:
  name: Nine Degrees of Freedom
tests:
  test:
    harness: sensor
    tags: samples sensor
    depends_on: i2c
```

## samples/sensor/ntc_thermistor/sample.yaml
```yaml
sample:
  name: NTC Thermistor Generic
  description: Read temperature from an NTC thermistor using the generic driver

tests:
  sample.sensor.ntc_thermistor:
    tags: sensors
    depends_on: adc
    platform_allow:
      - esp32_devkitc
    integration_platforms:
      - esp32_devkitc
```

## samples/sensor/paj7620_gesture/Kconfig
```kconfig
# Copyright (c) 2025 Paul Timke <ptimkec@live.com>
# SPDX-License-Identifier: Apache-2.0

mainmenu "PAJ7620 sample application"

config APP_USE_POLLING
	bool "Select y to use polling, otherwise the sample will use triggers"
	default y

source "Kconfig.zephyr"
```

## samples/sensor/paj7620_gesture/sample.yaml
```yaml
sample:
  name: PAJ7620 gesture trigger sample
common:
  min_ram: 12
  tags: sensors
  platform_allow: nucleo_f334r8
  filter: dt_compat_enabled("pixart,paj7620")
tests:
  sample.sensor.paj7620_gesture_trig:
    build_only: true
    depends_on:
      - i2c
      - gpio
    extra_args: EXTRA_CONF_FILE=trigger.conf
  sample.sensor.paj7620_gesture_polling:
    build_only: true
    depends_on:
      - i2c
    extra_configs:
      - CONFIG_PAJ7620_TRIGGER_NONE=y
```

## samples/sensor/paj7620_gesture_polling/sample.yaml
```yaml
sample:
  name: PAJ7620 gesture polling sample
tests:
  sample.sensor.paj7620_gesture_polling:
    build_only: true
    tags: sensors
    platform_allow: nucleo_f334r8
    depends_on:
      - i2c
      - paj7620
```

## samples/sensor/particulate_matter/sample.yaml
```yaml
sample:
  name: particulate_matter sensor sample
tests:
  sample.sensor.sngcja5:
    build_only: true
    platform_allow: pan1780_evb pan1770_evb pan1781_evb pan1782_evb
    tags: sensors
    integration_platforms:
      - pan1781_evb
    depends_on: arduino_i2c
    extra_args: "DTC_OVERLAY_FILE=arduino_i2c.overlay"
```

## samples/sensor/pinnacle/sample.yaml
```yaml
sample:
  name: Cirque Pinnacle GlidePoint Trackpad Sensor Sample
tests:
  sample.sensor.pinnacle:
    harness: sensor
    tags: sensors
    platform_allow: nrf52dk_nrf52832
    depends_on: spi
```

## samples/sensor/pressure_interrupt/Kconfig
```kconfig
# Copyright (c) 2024, TDK Invensense
# SPDX-License-Identifier: Apache-2.0

config LOG
	default y

config LOG_PRINTK
	default y

config SENSOR_LOG_LEVEL
	default 4

config PRESSURE_DRDY
	bool "Enable pressure data ready interrupt"
	default y

config PRESSURE_THRESHOLD
	bool "Enable pressure threshold interrupt"
	default y

config PRESSURE_DELTA
	bool "Enable pressure delta interrupt"
	default y

choice ICP201XX_TRIGGER_MODE
	default ICP201XX_TRIGGER_GLOBAL_THREAD
	depends on ICP201XX

endchoice

source "Kconfig.zephyr"
```

## samples/sensor/pressure_interrupt/sample.yaml
```yaml
sample:
  name: Pressure sensor interrupt
tests:
  sample.sensor.pressure_interrupt:
    build_only: true
    tags: sensors
    filter: dt_alias_exists("pressure-sensor")
    integration_platforms:
      - nrf52dk/nrf52832
```

## samples/sensor/pressure_polling/Kconfig
```kconfig
# Copyright (c) 2024, TDK Invensense
# SPDX-License-Identifier: Apache-2.0

config LOG
	default y

config LOG_PRINTK
	default y

config SENSOR_LOG_LEVEL
	default 4

source "Kconfig.zephyr"
```

## samples/sensor/pressure_polling/sample.yaml
```yaml
sample:
  name: Pressure polling sample
tests:
  sample.sensor.pressure_sensor:
    build_only: true
    tags: sensors
    filter: dt_alias_exists("pressure-sensor")
    integration_platforms:
      - nrf52dk/nrf52832
      - adafruit_qt_py_rp2040/rp2040       # adafruit_dps310 shield
      - mikroe_clicker_ra4m1/r7fa4m1ab3cfm # mikroe_pressure_3_click shield
    extra_args:
      - platform:adafruit_qt_py_rp2040/rp2040:SHIELD="adafruit_dps310"
      - platform:mikroe_clicker_ra4m1/r7fa4m1ab3cfm:SHIELD="mikroe_pressure_3_click"
```

## samples/sensor/proximity_polling/sample.yaml
```yaml
sample:
  name: Proximity sensor polling sample
tests:
  sample.sensor.proximity_polling:
    harness: sensor
    tags:
      - sensors
      - proximity
    filter: dt_alias_exists("prox-sensor0")
    integration_platforms:
      - nrf52840dk/nrf52840
      - mikroe_clicker_ra4m1/r7fa4m1ab3cfm # mikroe_proximity_9_click shield
    extra_args:
      - platform:mikroe_clicker_ra4m1/r7fa4m1ab3cfm:SHIELD="mikroe_proximity_9_click"
```
