/*
 * Copyright (c) 2021, Steven Daglish <s.c.daglish@gmail.com>
 *
 * SPDX-License-Identifier: Apache-2.0
 */

&i2c1 {
	mcp98xx@18 {
		compatible = "microchip,mcp98xx";
		reg = <0x18>;
		int-gpios = <&gpioa 8 (GPIO_PULL_UP | GPIO_ACTIVE_LOW)>;
		resolution = <3>;
	};
};
