/*
 * Copyright (c) 2019, Linaro Ltd.
 *
 * SPDX-License-Identifier: Apache-2.0
 */

&i2c0 {
	mcp98xx@18 {
		compatible = "microchip,mcp98xx";
		reg = <0x18>;
		int-gpios = <&gpioc 16 (GPIO_PULL_UP | GPIO_ACTIVE_LOW)>;
	};
};
