/*
 * Copyright (c) 2019 Grinn
 *
 * SPDX-License-Identifier: Apache-2.0
 */

&i2c1 {
	status = "okay";
	clock-frequency = <I2C_BITRATE_STANDARD>;

	mcp9808@19 {
		compatible = "microchip,mcp9808";
		reg = <0x19>;
		label = "MCP9808";
		int-gpios = <&gpioc 6 0>;
	};
};
