## prj.conf
```kconfig
CONFIG_STDOUT_CONSOLE=y

CONFIG_I2C=y
CONFIG_NANO_TIMEOUTS=y

CONFIG_SENSOR=y
CONFIG_SENSOR_DEBUG=y
CONFIG_BMP280=y
```

## src/main.c
```c
/*
 * Copyright (c) 2012-2014 Wind River Systems, Inc.
 *
 * Licensed under the Apache License, Version 2.0 (the "License");
 * you may not use this file except in compliance with the License.
 * You may obtain a copy of the License at
 *
 *     http://www.apache.org/licenses/LICENSE-2.0
 *
 * Unless required by applicable law or agreed to in writing, software
 * distributed under the License is distributed on an "AS IS" BASIS,
 * WITHOUT WARRANTIES OR CONDITIONS OF ANY KIND, either express or implied.
 * See the License for the specific language governing permissions and
 * limitations under the License.
 */

#include <zephyr.h>
#include <device.h>
#include <sensor.h>
#include <nanokernel.h>

#if defined(CONFIG_STDOUT_CONSOLE)
#include <stdio.h>
#define PRINT           printf
#else
#include <misc/printk.h>
#define PRINT           printk
#endif


void main(void)
{
	struct device *dev = device_get_binding("BMP280");

	PRINT("dev %p name %s\n", dev, dev->config->name);

	while (1) {
		struct sensor_value temp, press;

		sensor_sample_fetch(dev);
		sensor_channel_get(dev, SENSOR_CHAN_TEMP, &temp);
		sensor_channel_get(dev, SENSOR_CHAN_PRESS, &press);

		PRINT("temp: %d.%06d; press: %d.%06d\n",
		      temp.val1, temp.val2, press.val1, press.val2);

		task_sleep(sys_clock_ticks_per_sec);
	}
}
```
