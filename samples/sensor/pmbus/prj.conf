## CMakeLists.txt
```
# SPDX-FileCopyrightText: Copyright (c) 2026 Linumiz
#
# SPDX-License-Identifier: Apache-2.0

cmake_minimum_required(VERSION 3.20.0)
find_package(Zephyr REQUIRED HINTS $ENV{ZEPHYR_BASE})
project(pmbus)

target_sources(app PRIVATE src/main.c)
```

## prj.conf
```kconfig
CONFIG_I2C=y
CONFIG_SMBUS=y
CONFIG_SENSOR=y
```

## boards/native_sim.conf
```kconfig
CONFIG_EMUL=y
```

## boards/native_sim.overlay
```dts
/*
 * SPDX-FileCopyrightText: Copyright (c) 2026 Linumiz
 *
 * SPDX-License-Identifier: Apache-2.0
 */

/ {
	smbus0: smbus0 {
		compatible = "zephyr,smbus-i2c";
		i2c = <&i2c0>;
		#address-cells = <1>;
		#size-cells = <0>;

		pmbus@40 {
			compatible = "zephyr,pmbus";
			reg = <0x40>;
		};
	};
};
```

## src/main.c
```c
/*
 * SPDX-FileCopyrightText: Copyright (c) 2026 Linumiz
 *
 * SPDX-License-Identifier: Apache-2.0
 */

#include <stdlib.h>

#include <zephyr/device.h>
#include <zephyr/drivers/sensor.h>
#include <zephyr/kernel.h>
#include <zephyr/sys/printk.h>

static const struct {
	const char *name;
	enum sensor_channel chan;
	const char *unit;
} channels[] = {
	{"VOUT", SENSOR_CHAN_VOLTAGE, "V"},
	{"IOUT", SENSOR_CHAN_CURRENT, "A"},
	{"POUT", SENSOR_CHAN_POWER, "W"},
	{"TEMP", SENSOR_CHAN_AMBIENT_TEMP, "C"},
};

int main(void)
{
	const struct device *const dev = DEVICE_DT_GET_ONE(zephyr_pmbus);
	struct sensor_value val;
	const char *sep;
	int64_t milli;

	if (!device_is_ready(dev)) {
		printk("%s is not ready\n", dev->name);
		return 0;
	}

	while (true) {
		if (sensor_sample_fetch(dev) < 0) {
			printk("fetch failed\n");
			k_sleep(K_SECONDS(1));
			continue;
		}

		sep = "";
		for (int i = 0; i < ARRAY_SIZE(channels); i++) {
			if (sensor_channel_get(dev, channels[i].chan, &val) < 0) {
				continue;
			}

			milli = sensor_value_to_milli(&val);
			printk("%s%s %s%lld.%03lld %s", sep, channels[i].name, milli < 0 ? "-" : "",
			       llabs(milli) / 1000, llabs(milli) % 1000, channels[i].unit);
			sep = ", ";
		}

		printk("\n");
		k_sleep(K_SECONDS(1));
	}

	return 0;
}
```
