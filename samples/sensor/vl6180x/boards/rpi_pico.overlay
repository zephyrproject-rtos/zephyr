/*
 * Copyright (c) 2022, Kamil Serwus
 *
 * SPDX-License-Identifier: Apache-2.0
 */

&i2c0 {
	vl6180x@29 {
		compatible = "st,vl6180x";
		reg = <0x29>;
		xshut-gpios = <&gpio0 6 (GPIO_ACTIVE_HIGH)>;
	};
	status = "okay";
};
