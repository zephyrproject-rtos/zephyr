&i3c0 {
	status = "okay";

	/*
	 * There might be other connected I2C devices
	 * (for example, if using Arduino shield) which
	 * cannot tolerate high clock speed. So slow
	 * down the clock.
	 */
	i2c-scl-hz = <400000>;
	i3c-scl-hz = <400000>;
	i3c-od-scl-hz = <400000>;

	clk-divider = <12>;
	clk-divider-slow = <1>;
	clk-divider-tc = <1>;

	lsm6dso0: lsm6dso@6b0000000000000050 {
		compatible = "st,lsm6dso";
		reg = <0x6b 0x00 0x50>;

		status = "okay";
	};
};
