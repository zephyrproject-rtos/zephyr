## samples/sensor/ti_vtm_shutdown/Kconfig
```kconfig
# SPDX-License-Identifier: Apache-2.0
# SPDX-FileCopyrightText: Copyright The Zephyr Project Contributors

mainmenu "TI VTM thermal shutdown sample"

config APP_CRITICAL_MC
	int "Critical temperature in millidegrees Celsius"
	default 110000
	help
	  Programmed into the VTM GT_TH2 threshold of the monitored sensor.
	  Keep it below the hardware reset threshold (ti,max-reset-mc), so
	  that software gets the chance to shut down before the SoC does a
	  hardware warm reset.

config APP_TEST_BELOW_MC
	int "Test mode: arm the threshold this far below the current temperature"
	range 0 100000
	default 0
	help
	  When non-zero, the critical threshold is programmed to the current
	  die temperature minus this value (millidegrees Celsius) instead of
	  APP_CRITICAL_MC. The trigger then fires without heating the board.
	  The sample reports a pass or a fail line after APP_TEST_TIMEOUT_MS.

config APP_TEST_TIMEOUT_MS
	int "Test mode: time to wait for the trigger"
	default 3000
	help
	  Used only when APP_TEST_BELOW_MC is non-zero.

config APP_ARM_DELAY_S
	int "Delay before arming the trigger, in seconds"
	default 0
	help
	  Gives a console time to attach before a shutdown action runs.

choice APP_ACTION
	prompt "Action on the critical trigger"
	default APP_ACTION_REBOOT

config APP_ACTION_REBOOT
	bool "Cold reboot"
	select REBOOT
	select SCHED_CPU_MASK if SMP
	help
	  The reboot runs on CPU 0: a PSCI reset issued from a secondary core
	  did not reset the AM62L EVM.

config APP_ACTION_LOG
	bool "Log only"

endchoice

source "Kconfig.zephyr"
```

## samples/shields/adi_lsmspg/curve_tracer/Kconfig
```kconfig
# Copyright (c) 2026 Analog Devices, Inc
# SPDX-License-Identifier: Apache-2.0

menu "ADALM-LSMSPG curve tracer"

config SAMPLE_NPN_CURVE_TRACER_RSENSE_MOHM
	int "NPN collector sense resistor (milliohm)"
	default 49900
	help
	  Rsense_npn on the ADALM-LSMSPG schematic is 49.9 ohm. The no-OS
	  example uses 47 ohm (47000).

config SAMPLE_NPN_CURVE_TRACER_RBASE_OHM
	int "NPN base resistor (ohm)"
	default 49900
	help
	  Rbase_npn on the ADALM-LSMSPG schematic is 49.9 kohm. The no-OS
	  example uses 47 kohm (47000).

config SAMPLE_PNP_CURVE_TRACER_RSENSE_MOHM
	int "PNP collector sense resistor (milliohm)"
	default 49900
	help
	  Rsense_pnp on the ADALM-LSMSPG schematic is 49.9 ohm. The no-OS
	  example uses 47 ohm (47000).

config SAMPLE_PNP_CURVE_TRACER_RBASE_OHM
	int "PNP base resistor (ohm)"
	default 49900
	help
	  Rbase_pnp on the ADALM-LSMSPG schematic is 49.9 kohm. The no-OS
	  example uses 47 kohm (47000).

config SAMPLE_PNP_CURVE_TRACER_EMITTER_MV
	int "PNP emitter drive voltage (mV)"
	default 2499
	help
	  Voltage set on the AD5593R CH3 DAC, which drives the emitter through
	  jumper P7. The collector drive is swept down from this voltage.

endmenu

source "Kconfig.zephyr"
```

## samples/subsys/fs/fs_sample/boards/radxa_zero_3e_rk3566.conf
```kconfig
# SPDX-FileCopyrightText: 2026 Seunghoon Park
# SPDX-License-Identifier: Apache-2.0

CONFIG_MAIN_STACK_SIZE=8192
```

## samples/subsys/shell/shell_module/boards/intel_socfpga_agilex5_socdk.conf
```kconfig
# Copyright (c) 2022-2023, Intel Corporation.
# SPDX-License-Identifier: Apache-2.0

# Misc
CONFIG_HEAP_MEM_POOL_SIZE=16384
CONFIG_SHELL_STACK_SIZE=8192

# Setting the max argc
CONFIG_SHELL_ARGC_MAX=12

# Enable the Zephyr boot banner
CONFIG_BOOT_BANNER=y

# Enable timer driver
CONFIG_COUNTER=y

# Enable Timer shell commands
CONFIG_COUNTER_SHELL=y

#SiP SVC Service
CONFIG_ARM_SIP_SVC_DRIVER=y
CONFIG_ARM_SIP_SVC_SUBSYS=y
CONFIG_ARM_SIP_SVC_SUBSYS_SINGLY_OPEN=y

#SiP SVC Service Shell
CONFIG_ARM_SIP_SVC_SUBSYS_SHELL=y

# Enable File System Shell
CONFIG_FILE_SYSTEM_SHELL=y

# Enable Disk access
CONFIG_DISK_ACCESS=y

# File System Setting
CONFIG_FILE_SYSTEM=y
CONFIG_FAT_FILESYSTEM_ELM=y

# Enable SDHC
CONFIG_SDHC=y

# Ethernet
CONFIG_ETH_DRIVER=y
CONFIG_MDIO=y
CONFIG_NET_L2_ETHERNET=y
CONFIG_NET_PKT_RX_COUNT=64
CONFIG_NET_PKT_TX_COUNT=64
CONFIG_NET_BUF_RX_COUNT=1024
CONFIG_NET_BUF_TX_COUNT=512
CONFIG_NET_BUF_DATA_SIZE=1024

# Net Shell + DHCPv4 + net mgmt
CONFIG_NETWORKING=y
CONFIG_NET_SHELL=y
CONFIG_NET_DHCPV4=y
CONFIG_NET_DHCPV4_OPTION_CALLBACKS=y
CONFIG_NET_MGMT=y
CONFIG_NET_MGMT_EVENT=y
CONFIG_NET_CONFIG_SETTINGS=y
CONFIG_NET_CONFIG_AUTO_INIT=y
CONFIG_NET_CONFIG_NEED_IPV4=y

# Zperf (IPv6+IPv4+TCP+UDP, TC and Socket)
CONFIG_NET_ZPERF=y
CONFIG_NET_ZPERF_SERVER=y
CONFIG_NET_ZPERF_MAX_PACKET_SIZE=8192
CONFIG_NET_IPV6=y
CONFIG_NET_IPV4=y
CONFIG_NET_UDP=y
CONFIG_NET_TCP=y
CONFIG_NET_TCP_IPV6_ND_REACHABILITY_HINT=y
CONFIG_NET_IF_UNICAST_IPV6_ADDR_COUNT=4
CONFIG_NET_IF_MCAST_IPV6_ADDR_COUNT=5
CONFIG_NET_IF_UNICAST_IPV4_ADDR_COUNT=1
CONFIG_NET_MAX_CONTEXTS=5
CONFIG_NET_TC_TX_COUNT=1
CONFIG_NET_SOCKETS=y
CONFIG_NET_SOCKETS_SERVICE_THREAD_PRIO=-1
CONFIG_ZVFS_POLL_MAX=9
CONFIG_TEST_RANDOM_GENERATOR=y
```

## snippets/nxp/wifi/nxp-wifi/boards/frdm_imx91_mimx9131.conf
```kconfig
#
# Copyright 2026 NXP
#
# SPDX-License-Identifier: Apache-2.0
#

# Network resources for IW610
CONFIG_NET_PKT_RX_COUNT=36
CONFIG_NET_PKT_TX_COUNT=36
CONFIG_NET_BUF_RX_COUNT=40
CONFIG_NET_BUF_TX_COUNT=40
CONFIG_NET_MGMT_EVENT_QUEUE_TIMEOUT=5000
CONFIG_NET_MGMT_EVENT_QUEUE_SIZE=40

# i.MX91 stack sizes
CONFIG_SHELL_STACK_SIZE=16384
CONFIG_MAIN_STACK_SIZE=8192
CONFIG_SYSTEM_WORKQUEUE_STACK_SIZE=4096
CONFIG_NET_MGMT_EVENT_STACK_SIZE=16384
CONFIG_NET_TX_STACK_SIZE=8192
CONFIG_NET_RX_STACK_SIZE=8192
```

## soc/alif/ensemble/Kconfig
```kconfig
# Copyright (c) 2025 Alif Semiconductor
# SPDX-License-Identifier: Apache-2.0

if SOC_FAMILY_ENSEMBLE

config SOC_FAMILY_ENSEMBLE_RTSS
	bool
	select ARM
	select ARMV8_M_DSP
	select ARMV8_1_M_MVEI
	select ARMV8_1_M_MVEF
	select CPU_CORTEX_M55
	select CPU_CORTEX_M_HAS_SYSTICK
	select CPU_CORTEX_M_HAS_DWT
	select CPU_CORTEX_M_HAS_VTOR
	select CPU_HAS_ARM_MPU
	select CPU_HAS_CUSTOM_FIXED_SOC_MPU_REGIONS
	select CPU_HAS_FPU
	select HAS_FLASH_LOAD_OFFSET
	select SOC_RESET_HOOK
	select XIP
	select HAS_SEGGER_RTT if ZEPHYR_SEGGER_MODULE

config SOC_FAMILY_ENSEMBLE_RTSS_HE
	bool
	select SOC_FAMILY_ENSEMBLE_RTSS

config SOC_FAMILY_ENSEMBLE_RTSS_HP
	bool
	select SOC_FAMILY_ENSEMBLE_RTSS

config SOC_FAMILY_ENSEMBLE_APSS
	bool
	select ARM
	select CPU_CORTEX_A32
	select ARM_ARCH_TIMER if SYS_CLOCK_EXISTS
	imply XIP

config ENSEMBLE_APSS_SECURE
	bool "APSS runs in Secure state, without TF-A"
	depends on SOC_FAMILY_ENSEMBLE_APSS
	select AARCH32_ARMV8_A_MONITOR_INIT
	select CPU_CORTEX_A32_SMPEN
	select SOC_PREP_HOOK
	help
	  Select when the Secure Enclave boots Zephyr directly on the APSS,
	  in Secure state, instead of Zephyr running in Non-secure state
	  behind TF-A. Zephyr then does the parts of TF-A's set-up it relies
	  on: it sets CPUECTLR.SMPEN and zeroes the virtual counter offset
	  (CNTVOFF) on each core, and enables the REFCLK system counter that
	  drives the Generic Timer.

rsource "*/Kconfig"

endif # SOC_FAMILY_ENSEMBLE
```

## soc/allwinner/t153/Kconfig.defconfig
```kconfig
# SPDX-FileCopyrightText: Copyright The Zephyr Project Contributors
# SPDX-License-Identifier: Apache-2.0

if SOC_T153_E907

configdefault NUM_IRQS
	default 256

configdefault RISCV_MCAUSE_EXCEPTION_MASK
	default 0xFFF

endif # SOC_T153_E907

if SOC_T153_A7

configdefault NUM_IRQS
	default 352

configdefault SYS_CLOCK_HW_CYCLES_PER_SEC
	default $(dt_node_int_prop_int,/timer,clock-frequency)

configdefault UART_NS16550_ACCESS_WORD_ONLY
	default y

endif # SOC_T153_A7
```

## soc/ambiq/Kconfig
```kconfig
# SPDX-License-Identifier: Apache-2.0
#
# Copyright (c) 2023 Antmicro <www.antmicro.com>

if SOC_FAMILY_AMBIQ

rsource "*/Kconfig"

config SOC_AMBIQ_HAS_CLKMGR
	bool
	help
	  The SoC HAL provides the clock manager (am_hal_clkmgr) API.

config SOC_AMBIQ_HAS_CRM
	bool
	help
	  The SoC HAL provides the Clock and Reset Management (am_hal_crm) API.

endif # SOC_FAMILY_AMBIQ
```

## soc/ambiq/apollo5x/Kconfig.defconfig.apollo330P
```kconfig
# SPDX-License-Identifier: Apache-2.0
#
# Copyright (c) 2026 Ambiq Micro Inc.

if SOC_APOLLO330P

config NUM_IRQS
	default 134

endif # SOC_APOLLO330P
```

## soc/arm/Kconfig
```kconfig
# Copyright (c) 2024 Nordic Semiconductor ASA
# Copyright 2026 Arm Limited and/or its affiliates <open-source-office@arm.com>
# SPDX-License-Identifier: Apache-2.0

if SOC_FAMILY_ARM || SOC_FAMILY_ARM64 || SOC_FAMILY_CORSTONE1000

rsource "*/Kconfig"

endif # SOC_FAMILY_ARM || SOC_FAMILY_ARM64 || SOC_FAMILY_CORSTONE1000
```

## soc/arm/corstone1000/Kconfig
```kconfig
# Copyright 2026 Arm Limited and/or its affiliates <open-source-office@arm.com>
# SPDX-License-Identifier: Apache-2.0

config SOC_CORSTONE1000_EXTSYS
	select ARM
	select CPU_CORTEX_M3
	select CPU_HAS_ARM_MPU
```

## soc/arm/corstone1000/Kconfig.defconfig
```kconfig
# Copyright 2026 Arm Limited and/or its affiliates <open-source-office@arm.com>
# SPDX-License-Identifier: Apache-2.0

if SOC_SERIES_CORSTONE1000

rsource "Kconfig.defconfig.*"

endif # SOC_SERIES_CORSTONE1000
```

## soc/arm/corstone1000/Kconfig.defconfig.a35
```kconfig
# Copyright 2026 Arm Limited and/or its affiliates <open-source-office@arm.com>
# SPDX-License-Identifier: Apache-2.0

if SOC_CORSTONE1000_A35

config NUM_IRQS
	default 128

config SYS_CLOCK_HW_CYCLES_PER_SEC
	default $(dt_node_int_prop_int,$(dt_nodelabel_path,refclk),clock-frequency)

endif
```

## soc/arm/corstone1000/Kconfig.soc
```kconfig
# Copyright 2026 Arm Limited and/or its affiliates <open-source-office@arm.com>
# SPDX-License-Identifier: Apache-2.0

config SOC_FAMILY_CORSTONE1000
	bool
	help
	  Enable support for Arm Corstone1000 Family

config SOC_SERIES_CORSTONE1000
	bool
	select SOC_FAMILY_CORSTONE1000
	help
	  Enable support for Arm Corstone1000 Series

config SOC_CORSTONE1000
	bool
	select SOC_SERIES_CORSTONE1000

config SOC_CORSTONE1000_EXTSYS
	bool
	select SOC_CORSTONE1000
	help
	  ARM Cortex-M3 External System on Corstone1000

config SOC_CORSTONE1000_A35
	bool
	select SOC_CORSTONE1000
	help
	  ARM Cortex-A35 on Corstone1000

config SOC_FAMILY
	default "corstone1000" if SOC_FAMILY_CORSTONE1000

config SOC_SERIES
	default "corstone1000" if SOC_SERIES_CORSTONE1000

config SOC
	default "corstone1000" if SOC_CORSTONE1000
```

## soc/atmel/sam0/Kconfig.defconfig
```kconfig
# Atmel SAM0 MCU family default configuration options

# Copyright (c) 2017 Google LLC.
# Copyright (c) 2024 Gerson Fernando Budke <nandojve@gmail.com>
# SPDX-License-Identifier: Apache-2.0

if SOC_FAMILY_ATMEL_SAM0

rsource "*/Kconfig.defconfig"

config GPIO
	default y

config HWINFO_SAM0
	default HWINFO

config SYS_CLOCK_HW_CYCLES_PER_SEC
	default $(dt_node_int_prop_int,/cpus/cpu@0,clock-frequency)

if USB_DEVICE_DRIVER

config HEAP_MEM_POOL_ADD_SIZE_SOC
	def_int 1024

endif # USB_DEVICE_DRIVER

if SOC_ATMEL_SAM0_HAS_CMCC

configdefault CACHE_MANAGEMENT
	default y

# The CMCC line is 4 words
configdefault ICACHE_LINE_SIZE
	default 16

choice CACHE_TYPE
	default EXTERNAL_CACHE
endchoice

endif # SOC_ATMEL_SAM0_HAS_CMCC

endif # SOC_FAMILY_ATMEL_SAM0
```
