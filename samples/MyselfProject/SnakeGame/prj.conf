## CMakeLists.txt
```
cmake_minimum_required(VERSION 3.13.1)
find_package(Zephyr REQUIRED HINTS $ENV{ZEPHYR_BASE})
project(SnakeGame)
target_sources(app PRIVATE src/main.c  src/Adafruit_GFX.c src/coll_ball.c)
# src/snake.c src/solve_snake.c
```

## prj.conf
```kconfig
CONFIG_SPI=y
CONFIG_DISPLAY=y
CONFIG_ST7735=y
CONFIG_BUTTON=y
CONFIG_BUTTON_INPUT=y
```

## src/main.c
```c
#include <zephyr.h>
#include <device.h>
#include <devicetree.h>
#include <drivers/gpio.h>
#include <stdlib.h>
#include "drivers/lcd_display.h"

#include "snake.h"
#include "Adafruit_GFX_api.h"
#include "coll_ball.h"
#include "drivers/thread_timer.h"

#include <logging/log.h>

LOG_MODULE_REGISTER(main,LOG_LEVEL_DBG);
#define DISPLAY_DEV_NAME DT_LABEL(DT_INST(0, sitronix_st7735))

#define PRINT_MACRO_HELPER(x) #x
#define PRINT_MACRO(x) #x"="PRINT_MACRO_HELPER(x)

struct k_msgq input_key_message;

static void _check_system_status(struct thread_timer *ttimer,
                                 void *expiry_fn_arg)
{
    printk("thread timer test\n");
}
void main(void)
{

    #if DT_NODE_HAS_STATUS(DT_INST(0, sitronix_st7735), okay)
    #define DISPLAY_DEV_NAME DT_LABEL(DT_INST(0, sitronix_st7735))
    #else 
    #define DISPLAY_DEV_NAME ""
    #pragma message("sitronix_st7735 not find")
    #endif

    #pragma message(PRINT_MACRO(DISPLAY_DEV_NAME))


    Adafruit_displayInit(INIT_ST7735);
    Adafruit_clear(0,0,129,160,WHITE);

    // // LIST_HEAD(list_handle);

    // struct coll_ball ball[3];
    // rand_init_ball(&ball[0]);
    // printk("x:%d,y:%d,r:%d,speed_x:%d,speed_y:%d\n",ball[0].x,ball[0].y,ball[0].r,ball[0].speed_x,ball[0].speed_y);
    // rand_init_ball(&ball[1]);
    // printk("x:%d,y:%d,r:%d,speed_x:%d,speed_y:%d\n",ball[1].x,ball[1].y,ball[1].r,ball[1].speed_x,ball[1].speed_y);
    // rand_init_ball(&ball[2]);
    // printk("x:%d,y:%d,r:%d,speed_x:%d,speed_y:%d\n",ball[2].x,ball[2].y,ball[2].r,ball[2].speed_x,ball[2].speed_y);

    // for(int x=4,w=120;x<=w;x+=4)
    // Adafruit_drawRect(x,x,w-2*x,w-2*x,RED);//这个错误竟然产生了漂亮的效果
    struct thread_timer status_check_timer;
    thread_timer_init(&status_check_timer,
	                  _check_system_status, NULL);
    thread_timer_start(&status_check_timer,1000,1000);
    int cnt=0;
    while (1)
    {
        if(cnt==0)
        Adafruit_clear(0,0,129,160,BLUE);
        else if(cnt==1)
            Adafruit_clear(0,0,129,160,RED);
        else
            Adafruit_clear(0,0,129,160,GREEN);
        cnt++;
        cnt=cnt%3;
        // for(int i=0;i<3;i++){
        //     hit_wall_detect(&ball[i]);
        // }
        // Adafruit_clear(0,0,129,160,WHITE);
        // for(int i=0;i<3;i++){
        //     Adafruit_drawCircle(ball[i].x,ball[i].y,ball[i].r,BLUE);
        // }
        // if(cnt>20){
        //     for(int i=0;i<3;i++){
        //         for (int j=i+1;j<3;j++){
        //             hit_body_detect(&ball[i],&ball[j]);
        //         }
        //     }
        // }else{
        //     cnt++;
        // }
        printk("%d\n",k_uptime_get_32());
        LOG_INF("main");
        thread_timer_handle_expired();
        // k_sleep(K_MSEC(10));
        
    }
    
    

}
```

## src/Adafruit_GFX.c
```c
/**
 * 图形库里用来实现直线,圆等
 * 调用驱动里面的写函数
*/
#include <sys/byteorder.h>
#include "drivers/lcd_driver_api.h"

#include <devicetree.h>
// #include "display_st7735.h"
#include "/home/shuiyihang/zephyrproject/zephyr/drivers/display/display_st7735.h"

#include "Adafruit_GFX_api.h"

#define DT_DRV_COMPAT sitronix_st7735
#define DISPLAY_DEV_NAME DT_LABEL(DT_INST(0, sitronix_st7735))


// #define adafruit_abs(a)         
//                 ({((a)<0)?(-(a)):(a);})

inline int adafruit_abs(int a)
{
    return a<0?-a:a;
}


static const uint8_t
    initcmd[] ={
        16,
        ST7735_CMD_RGBCTRL, 3,
        0x05,
        0x3C,
        0x3C,
        ST7735_CMD_PORCTRL, 3,
        0x05,
        0x3C,
        0x3C,
        ST7735_CMD_B3,  6,
        0x05,0x3C,0x3C,0x05,0x3C,0x3C,
        ST7735_CMD_B4,  1,
        0x03,
        ST7735_CMD_LCMCTRL, 3,
        0x28,0x08,0x04,
        ST7735_CMD_C1,  1,
        0xC0,
        ST7735_CMD_VDVVRHEN,    2,
        0x0D,0x00,
        ST7735_CMD_VRH,   2,
        0x8D,0x2A,
        ST7735_CMD_VDS,   2,
        0x8D,0xEE,
        ST7735_CMD_C5,  1,
        0x1A,
        ST7735_CMD_MADCTL,  1,
        0xC0,
        ST7735_CMD_PVGAMCTRL,  16, 
        0x04,0x22,0x07,0x0A,0x2E,
        0x30,0x25,0x2A,0x28,0x26,
        0x2E,0x3A,0x00,0x01,0x03,
        0x13,
        ST7735_CMD_NVGAMCTRL,  16,
        0x04,0x16,0x06,0x0D,0x2D,
        0x26,0x23,0x27,0x27,0x25,
        0x2D,0x3B,0x00,0x01,0x04,
        0x13, 
        ST7735_CMD_CASET,   4,
        0,0,0,0x7f,
        ST7735_CMD_RASET,   4,
        0,0,0,0x9f,
        ST7735_CMD_COLMOD,  1,
        0x05,

    };




const struct device* display_dev;



void Adafruit_displayInit(uint8_t options)//addr指向的值不可修改,但是addr可以修改    const uint8_t *addr
{
    uint8_t numCmds, cmd, numArgs;

    const uint8_t *addr;
    if(options == INIT_ST7735){
        addr = initcmd;
    }

    display_dev=device_get_binding(DISPLAY_DEV_NAME);
    if(!display_dev){
        printk("displaly is null\n");
        return;
    }
    Adafruit_display_write(display_dev,ST7735_CMD_SLEEP_OUT,NULL,0);
    k_sleep(K_MSEC(100));//唤醒屏幕

    numCmds = read_byte(addr++);
    while(numCmds--){
        cmd = read_byte(addr++);
        numArgs = read_byte(addr++);
        // printk("cmd:%d==numargs:%d\n",cmd,numArgs);
        Adafruit_display_write(display_dev,cmd,addr,numArgs);
        addr += numArgs;
    }
    Adafruit_display_write(display_dev,ST7735_CMD_DISP_ON,NULL,0);
}



static void __setAddrWindow(uint16_t x, uint16_t y, uint16_t w, uint16_t h)
{
    uint32_t xa = ((uint32_t)x << 16) | (x + w - 1);
    uint32_t ya = ((uint32_t)y << 16) | (y + h - 1);
    uint8_t CASET_DATA[] = {xa>>24, xa>>16, xa>>8, xa};
    uint8_t RASET_DATA[] = {ya>>24, ya>>16, ya>>8, ya};
    Adafruit_display_write(display_dev,ST7735_CMD_CASET,CASET_DATA,sizeof(CASET_DATA));

    Adafruit_display_write(display_dev,ST7735_CMD_RASET,RASET_DATA,sizeof(RASET_DATA));

    Adafruit_display_write(display_dev,ST7735_CMD_RAMWR,NULL,0);
}


/**
 * 画点
*/
void Adafruit_drawPixel(int x, int y, uint16_t color)
{
    uint8_t COLOR_DATA[] = {color>>8,color}; 
    if(!display_dev){
        return;
    }
    struct st7735_data* st7735_info = (struct st7735_data*)display_dev->data;
    if((x >= 0)&&(x <=st7735_info->width)&&(y >=0)&&(y <=st7735_info->height)){

        __setAddrWindow(x,y,1,1);
        Adafruit_display_write(display_dev,ST7735_CMD_NULL,COLOR_DATA,sizeof(COLOR_DATA));
    }
}

/**
 * 画线,应该与下层的画点解耦
*/

void Adafruit_drawLine(int16_t x0, int16_t x1, int16_t y0, int16_t y1, uint16_t color)
{

    int16_t steep = adafruit_abs(y1 - y0) > adafruit_abs(x1 - x0);
    if (steep) {
        _swap_int16_t(x0, y0);
        _swap_int16_t(x1, y1);
    }

    if (x0 > x1) {
        _swap_int16_t(x0, x1);
        _swap_int16_t(y0, y1);
    }

    int16_t dx, dy;
    dx = x1 - x0;
    dy = adafruit_abs(y1 - y0);

    int16_t err = dx / 2;
    int16_t ystep;

    if (y0 < y1) {
        ystep = 1;
    } else {
        ystep = -1;
    }

    for (; x0 <= x1; x0++) {
        if (steep) {
        Adafruit_drawPixel(y0, x0, color);
        } else {
        Adafruit_drawPixel(x0, y0, color);
        }
        err -= dy;
        if (err < 0) {
        y0 += ystep;
        err += dx;
        }
    }
}


void Adafruit_drawFastVLine(int16_t x, int16_t y, int16_t h,
                                 uint16_t color)
{
    Adafruit_drawLine(x, x, y, y + h - 1, color);
}

void Adafruit_drawFastHLine(int16_t x, int16_t y, int16_t w,
                                 uint16_t color)
{
    Adafruit_drawLine(x, x + w - 1, y, y, color);
}
/**
 * 无填充画圆
*/
void Adafruit_drawCircle(int16_t x0, int16_t y0, int16_t r, uint16_t color)
{
    int16_t f = 1 - r;
    int16_t ddF_x = 1;
    int16_t ddF_y = -2 * r;
    int16_t x = 0;
    int16_t y = r;

    Adafruit_drawPixel(x0, y0 + r, color);
    Adafruit_drawPixel(x0, y0 - r, color);
    Adafruit_drawPixel(x0 + r, y0, color);
    Adafruit_drawPixel(x0 - r, y0, color);

    while (x < y) {
        if (f >= 0) {
        y--;
        ddF_y += 2;
        f += ddF_y;
        }
        x++;
        ddF_x += 2;
        f += ddF_x;

        Adafruit_drawPixel(x0 + x, y0 + y, color);
        Adafruit_drawPixel(x0 - x, y0 + y, color);
        Adafruit_drawPixel(x0 + x, y0 - y, color);
        Adafruit_drawPixel(x0 - x, y0 - y, color);
        Adafruit_drawPixel(x0 + y, y0 + x, color);
        Adafruit_drawPixel(x0 - y, y0 + x, color);
        Adafruit_drawPixel(x0 + y, y0 - x, color);
        Adafruit_drawPixel(x0 - y, y0 - x, color);
    }
}



/**
 * 1-->2
 * |   |
 * 8<--4
*/

static void Adafruit_drawCircleHelper(int16_t x0, int16_t y0, int16_t r,
                                    uint8_t cornername, uint16_t color)
{
    int16_t f = 1 - r;
    int16_t ddF_x = 1;
    int16_t ddF_y = -2 * r;
    int16_t x = 0;
    int16_t y = r;

    while (x < y) {
        if (f >= 0) {
        y--;
        ddF_y += 2;
        f += ddF_y;
        }
        x++;
        ddF_x += 2;
        f += ddF_x;
        if (cornername & 0x4) {
        Adafruit_drawPixel(x0 + x, y0 + y, color);
        Adafruit_drawPixel(x0 + y, y0 + x, color);
        }
        if (cornername & 0x2) {
        Adafruit_drawPixel(x0 + x, y0 - y, color);
        Adafruit_drawPixel(x0 + y, y0 - x, color);
        }
        if (cornername & 0x8) {
        Adafruit_drawPixel(x0 - y, y0 + x, color);
        Adafruit_drawPixel(x0 - x, y0 + y, color);
        }
        if (cornername & 0x1) {
        Adafruit_drawPixel(x0 - y, y0 - x, color);
        Adafruit_drawPixel(x0 - x, y0 - y, color);
        }
  }
}
/**
 * 无填充画圆角矩形
*/

void Adafruit_drawRoundRect(int16_t x, int16_t y, int16_t w, int16_t h,
                                 int16_t r, uint16_t color)
{
    int16_t max_radius = ((w < h) ? w : h) / 2; // 1/2 minor axis
    if (r > max_radius)
        r = max_radius;
    Adafruit_drawFastHLine(x + r, y, w - 2 * r, color);         // Top
    Adafruit_drawFastHLine(x + r, y + h - 1, w - 2 * r, color); // Bottom
    Adafruit_drawFastVLine(x, y + r, h - 2 * r, color);         // Left
    Adafruit_drawFastVLine(x + w - 1, y + r, h - 2 * r, color); // Right
    // draw four corners
    Adafruit_drawCircleHelper(x + r, y + r, r, 1, color);
    Adafruit_drawCircleHelper(x + w - r - 1, y + r, r, 2, color);
    Adafruit_drawCircleHelper(x + w - r - 1, y + h - r - 1, r, 4, color);
    Adafruit_drawCircleHelper(x + r, y + h - r - 1, r, 8, color);
}

/**
 * 无填充矩形
*/
void Adafruit_drawRect(int16_t x, int16_t y, int16_t w, int16_t h,
                            uint16_t color)
{
    Adafruit_drawFastHLine(x, y, w, color);
    Adafruit_drawFastHLine(x, y + h - 1, w, color);
    Adafruit_drawFastVLine(x, y, h, color);
    Adafruit_drawFastVLine(x + w - 1, y, h, color);
}

/**
 * 无填充三角形
*/
void Adafruit_drawTriangle(int16_t x0, int16_t y0, int16_t x1, int16_t y1,
                                int16_t x2, int16_t y2, uint16_t color)
{
    Adafruit_drawLine(x0, y0, x1, y1, color);
    Adafruit_drawLine(x1, y1, x2, y2, color);
    Adafruit_drawLine(x2, y2, x0, y0, color);
}

//填充矩形
void Adafruit_fillRect(int16_t x, int16_t y, int16_t w, int16_t h,
                            uint16_t color)
{
    for (int16_t i = x; i < x + w; i++) {
    Adafruit_drawFastVLine(i, y, h, color);
  }
}

void Adafruit_clear(int16_t x, int16_t y, int16_t w, int16_t h,
                            uint16_t color)
{
    uint32_t pixel=(w-x+1)*(h-y+1);
    uint8_t COLOR_DATA[] = {color>>8,color}; 
    if(!display_dev){
        return;
    }
    struct st7735_data* st7735_info = (struct st7735_data*)display_dev->data;
    if((x >= 0)&&(x <= st7735_info->width)&&(y >=0)&&(y <= st7735_info->height)){

        __setAddrWindow(x,y,w-x+1,h-y+1);
        while(pixel>0)
        {
            pixel--;
            Adafruit_display_write(display_dev,ST7735_CMD_NULL,COLOR_DATA,sizeof(COLOR_DATA));
        }
    }

}

void Adafruit_fillCircleHelper(int16_t x0, int16_t y0, int16_t r,
                                    uint8_t corners, int16_t delta,
                                    uint16_t color)
{
    int16_t f = 1 - r;
    int16_t ddF_x = 1;
    int16_t ddF_y = -2 * r;
    int16_t x = 0;
    int16_t y = r;
    int16_t px = x;
    int16_t py = y;

    delta++; // Avoid some +1's in the loop

    while (x < y) {
        if (f >= 0) {
        y--;
        ddF_y += 2;
        f += ddF_y;
        }
        x++;
        ddF_x += 2;
        f += ddF_x;
        // These checks avoid double-drawing certain lines, important
        // for the SSD1306 library which has an INVERT drawing mode.
        if (x < (y + 1)) {
        if (corners & 1)
            Adafruit_drawFastVLine(x0 + x, y0 - y, 2 * y + delta, color);
        if (corners & 2)
            Adafruit_drawFastVLine(x0 - x, y0 - y, 2 * y + delta, color);
        }
        if (y != py) {
        if (corners & 1)
            Adafruit_drawFastVLine(x0 + py, y0 - px, 2 * px + delta, color);
        if (corners & 2)
            Adafruit_drawFastVLine(x0 - py, y0 - px, 2 * px + delta, color);
        py = y;
        }
        px = x;
    }
}

//填充圆角矩形

void Adafruit_fillRoundRect(int16_t x, int16_t y, int16_t w, int16_t h,
                                 int16_t r, uint16_t color)
{
    int16_t max_radius = ((w < h) ? w : h) / 2; // 1/2 minor axis
    if (r > max_radius)
        r = max_radius;
    Adafruit_fillRect(x + r, y, w - 2 * r, h, color);
    // draw four corners
    Adafruit_fillCircleHelper(x + w - r - 1, y + r, r, 1, h - 2 * r - 1, color);
    Adafruit_fillCircleHelper(x + r, y + r, r, 2, h - 2 * r - 1, color);
}










//填充圆


void Adafruit_fillCircle(int16_t x0, int16_t y0, int16_t r,
                              uint16_t color)
{
    Adafruit_drawFastVLine(x0, y0 - r, 2 * r + 1, color);//竖着画一条线
    Adafruit_fillCircleHelper(x0, y0, r, 3, 0, color);
}                              

//填充三角

void Adafruit_fillTriangle(int16_t x0, int16_t y0, int16_t x1, int16_t y1,
                                int16_t x2, int16_t y2, uint16_t color)
{

    int16_t a, b, y, last;

    // Sort coordinates by Y order (y2 >= y1 >= y0)
    if (y0 > y1) {
        _swap_int16_t(y0, y1);
        _swap_int16_t(x0, x1);
    }
    if (y1 > y2) {
        _swap_int16_t(y2, y1);
        _swap_int16_t(x2, x1);
    }
    if (y0 > y1) {
        _swap_int16_t(y0, y1);
        _swap_int16_t(x0, x1);
    }

    if (y0 == y2) { // Handle awkward all-on-same-line case as its own thing
        a = b = x0;
        if (x1 < a)
        a = x1;
        else if (x1 > b)
        b = x1;
        if (x2 < a)
        a = x2;
        else if (x2 > b)
        b = x2;
        Adafruit_drawFastHLine(a, y0, b - a + 1, color);
        return;
    }

    int16_t dx01 = x1 - x0, dy01 = y1 - y0, dx02 = x2 - x0, dy02 = y2 - y0,
            dx12 = x2 - x1, dy12 = y2 - y1;
    int32_t sa = 0, sb = 0;

    // For upper part of triangle, find scanline crossings for segments
    // 0-1 and 0-2.  If y1=y2 (flat-bottomed triangle), the scanline y1
    // is included here (and second loop will be skipped, avoiding a /0
    // error there), otherwise scanline y1 is skipped here and handled
    // in the second loop...which also avoids a /0 error here if y0=y1
    // (flat-topped triangle).
    if (y1 == y2)
        last = y1; // Include y1 scanline
    else
        last = y1 - 1; // Skip it

    for (y = y0; y <= last; y++) {
        a = x0 + sa / dy01;
        b = x0 + sb / dy02;
        sa += dx01;
        sb += dx02;
        /* longhand:
        a = x0 + (x1 - x0) * (y - y0) / (y1 - y0);
        b = x0 + (x2 - x0) * (y - y0) / (y2 - y0);
        */
        if (a > b)
        _swap_int16_t(a, b);
        Adafruit_drawFastHLine(a, y, b - a + 1, color);
    }

    // For lower part of triangle, find scanline crossings for segments
    // 0-2 and 1-2.  This loop is skipped if y1=y2.
    sa = (int32_t)dx12 * (y - y1);
    sb = (int32_t)dx02 * (y - y0);
    for (; y <= y2; y++) {
        a = x1 + sa / dy12;
        b = x0 + sb / dy02;
        sa += dx12;
        sb += dx02;
        /* longhand:
        a = x1 + (x2 - x1) * (y - y1) / (y2 - y1);
        b = x0 + (x2 - x0) * (y - y0) / (y2 - y0);
        */
        if (a > b)
        _swap_int16_t(a, b);
        Adafruit_drawFastHLine(a, y, b - a + 1, color);
    }
}


//字符,数字,图片
```

## src/Adafruit_GFX_api.h
```c
#ifndef __ADAFRUIT_GFX_API_H__
#define __ADAFRUIT_GFX_API_H__
#include <sys/byteorder.h>

#define     INIT_ST7735      0x01








void Adafruit_drawFastVLine(int16_t x, int16_t y, int16_t h,
                                 uint16_t color);
                                
void Adafruit_drawFastHLine(int16_t x, int16_t y, int16_t w,
                                 uint16_t color);
void Adafruit_clear(int16_t x, int16_t y, int16_t w, int16_t h,
                            uint16_t color);
void Adafruit_drawRoundRect(int16_t x, int16_t y, int16_t w, int16_t h,
                                 int16_t r, uint16_t color);

void Adafruit_fillRoundRect(int16_t x, int16_t y, int16_t w, int16_t h,
                                 int16_t r, uint16_t color);

void Adafruit_drawRect(int16_t x, int16_t y, int16_t w, int16_t h,
                            uint16_t color);

void Adafruit_displayInit(uint8_t options);
void Adafruit_drawPixel(int x, int y, uint16_t color);
void Adafruit_drawLine(int16_t x0, int16_t x1, int16_t y0, int16_t y1, uint16_t color);
void Adafruit_drawCircle(int16_t x0, int16_t y0, int16_t r, uint16_t color);
void Adafruit_fillRect(int16_t x, int16_t y, int16_t w, int16_t h,
                            uint16_t color);
#endif
```

## src/Hi_PriorityQueue.h
```c
/**
 * 优先队列,可以使用单向/双向链表
 * 为了实现多态，用户自定义的结构数据的要求
 * 
 * 优先队列除了入队操作使用自己的,其他操作共用普通队列
*/
#ifndef __HI_PRIORITYQUEUE_H__
#define __HI_PRIORITYQUEUE_H__

#ifdef __cplusplus
extern "C" {
#endif


#include "Hi_list.h"

struct priority_queue_info
{
    struct list_head prior_hook;
    int prior;

    char* name;//用户自定义的数据放在下面
};

typedef struct priority_queue_info prio_queue_info;


static inline void __queue_node_inset(struct list_head *_new, struct list_head *_pos)
{
    _new->next = _pos;
    _new->prev = _pos->prev;
    _pos->prev->next = _new;
    _pos->prev = _new;
}

/**
 * @brief 优先队列的数据入队
 * @param _new      需要入队的新节点
 * @param head      队列的头节点
*/
static inline void priority_queue_push(struct priority_queue_info *_new,
                                       struct list_head *head)
{
    struct priority_queue_info *temp=NULL;
    list_for_each_entry(temp,head,prior_hook){
        if(_new->prior < temp->prior){
            __queue_node_inset(&_new->prior_hook,&temp->prior_hook);
            return;
        }
    }
    //小丑竟是我自己,就尾插最后
    list_add_tail(&(_new->prior_hook),head);
}


#ifdef __cplusplus
}
#endif

#endif
```

## src/Hi_Queue.h
```c
/**
 * 单链表的队列实现
 * 同样的,队列则是链表的尾插法使用
*/

#ifndef __HI_QUEUE_H__
#define __HI_QUEUE_H__

#ifdef __cplusplus
extern "C" {
#endif


#include "public.h"

struct queue_head
{
    struct queue_head *hook;
};
#define QUEUE_HEAD_INIT()       {NULL}
#define QUEUE_HEAD(name)            \
    struct queue_head name = QUEUE_HEAD_INIT()

/**
 * @brief 数据入队
 * @param _new      需要入队的新节点
 * @param head      队列的头节点
*/
static inline void queue_push(struct queue_head *_new,
                              struct queue_head *head)
{
    struct queue_head *temp = head;
    while(NULL != temp->hook){
        temp = temp->hook;
    }
    temp->hook = _new;
    _new->hook = NULL;
}

/**
 * @brief           数据出队
 * @param head      队列的头节点
 * @return          返回出队数据的节点
*/
static inline struct queue_head* queue_pop(struct queue_head *head)
{
    struct queue_head* temp = head->hook;
    if(NULL == temp){
        printf("queue is null\n");
        return NULL;
    }
    head->hook = temp->hook;

    return temp;
}

/**
 * @brief           队列判空
 * @param head      队列的头节点
 * @return          1:队列空 0:队列非空
*/
static inline int queue_empty(const struct queue_head *head)
{
    return head->hook == NULL;
}




#ifdef __cplusplus
}
#endif


#endif
```

## src/Hi_list.h
```c
#ifndef __HI_LIST_H__
#define __HI_LIST_H__

#ifdef __cplusplus
extern "C" {
#endif

#include "public.h"


/**
 * 双向链表
*/
struct list_head
{
    struct list_head *next,*prev;
};

//头节点的初始化
#define LIST_HEAD_INIT(name)    {&(name),&(name)}
#define LIST_HEAD(name)         \
    struct list_head name = LIST_HEAD_INIT(name)

static inline int list_empty(const struct list_head *head)
{
    return head->next == head;
}

static inline void __list_add(struct list_head *_new,
                              struct list_head *prev,
                              struct list_head *next)
{
    next->prev = _new;
    _new->next = next;
    _new->prev = prev;
    prev->next = _new;
}


//尾插
static inline void list_add_tail(struct list_head *_new, struct list_head *head)
{
    __list_add(_new, head->prev, head);
}

static inline void list_add_head(struct list_head *_new, struct list_head *head)
{
    __list_add(_new, head, head->next);
}


static inline void __list_del(struct list_head *prev, struct list_head *next)
{
    next->prev = prev;
    prev->next = next;
    
}
/**
 * 库里不做内存释放工作，如有需要外部定义指针变量malloc分配，free释放
 * 参考A star算法的使用操作
*/
static inline void list_del(struct list_head *entry)
{
    __list_del(entry->prev, entry->next);
}



#ifdef __cplusplus
}
#endif


#endif
```

## src/coll_ball.c
```c
#include "coll_ball.h"
#include "stdlib.h"

static inline int math_pow(uint8_t data, uint8_t cnt)
{
    int ret=1;
    for(int i=0;i<cnt;i++){
        ret*=data;
    }
    return ret;
}
void hit_wall_detect(struct coll_ball *instance)
{
    instance->x += instance->speed_x;
    if((instance->x+instance->r)>=SCREEN_WIDTH||
        (instance->x-instance->r)<=0){
        if((instance->x+instance->r)>=SCREEN_WIDTH){
            instance->x=SCREEN_WIDTH-instance->r;
        }else{
            instance->x=instance->r;
        }
        instance->speed_x= -instance->speed_x;
    }


    instance->y += instance->speed_y;
    if((instance->y+instance->r)>=SCREEN_HEIGHT||
        (instance->y-instance->r)<=0){
        if((instance->y+instance->r)>=SCREEN_HEIGHT){
            instance->y=SCREEN_HEIGHT-instance->r;
        }else{
            instance->y=instance->r;
        }
        instance->speed_y= -instance->speed_y;
    }

}


void speed_updata_after_coll(struct coll_ball *body1, struct coll_ball *body2)
{
    //由动能守恒
    int quality_sum = body1->r + body2->r;
    int value1_x = ((body1->r - body2->r)*body1->speed_x +2*body2->r*body2->speed_x)/quality_sum;
    int value1_y = ((body1->r - body2->r)*body1->speed_y +2*body2->r*body2->speed_y)/quality_sum;
    int value2_x = ((body2->r - body1->r)*body2->speed_x +2*body1->r*body1->speed_x)/quality_sum;
    int value2_y = ((body2->r - body1->r)*body2->speed_y +2*body1->r*body1->speed_y)/quality_sum;
    body1->speed_x = value1_x;
    body1->speed_y = value1_y;
    body2->speed_x = value2_x;
    body2->speed_y = value2_y;

}

void hit_body_detect(struct coll_ball *body1, struct coll_ball *body2)
{
    int delta_x = abs(((body1->x+body1->speed_x)-(body2->x+body2->speed_x)));
    int delta_y = abs(((body1->y+body1->speed_y)-(body2->y+body2->speed_y)));
    int x_pow_2 = math_pow(delta_x,2);
    int y_pow_2 = math_pow(delta_y,2);
    if(x_pow_2+y_pow_2<math_pow((body1->r+body2->r+LINK_DIS),2)){
        Adafruit_drawLine(body1->x,body2->x,body1->y,body2->y,RED);
    }
    if(x_pow_2+y_pow_2<=math_pow((body1->r+body2->r),2)){
        speed_updata_after_coll(body1,body2);
    }
}

static inline int randint(int llimit, int hlimit)
{
    int delat = hlimit - llimit;
    int value = k_uptime_get_32()%delat;
    return value+llimit;
}
void rand_init_ball(struct coll_ball *body)
{
    body->speed_x = RATE_MID - randint(0,2*RATE_MID);
    body->speed_y = RATE_MID - randint(0,2*RATE_MID);
    body->r = randint(6,16);
    body->x = randint(0,SCREEN_WIDTH);
    body->y = randint(0,SCREEN_HEIGHT);
}
```

## src/coll_ball.h
```c
#ifndef __COLL_BALL_H__
#define __COLL_BALL_H__
#include <sys/byteorder.h>

// #include "Hi_list.h"
#include "Adafruit_GFX_api.h"
#include "drivers/lcd_display.h"
#define SCREEN_WIDTH    129
#define SCREEN_HEIGHT   160

#define LINK_DIS        20

#define RATE_MID        10

struct coll_ball
{
    // struct list_head clue;
    int x;
    int y;
    uint8_t r;
    int speed_x;
    int speed_y;
};

void hit_wall_detect(struct coll_ball *instance);
void speed_updata_after_coll(struct coll_ball *body1, struct coll_ball *body2);

void hit_body_detect(struct coll_ball *body1, struct coll_ball *body2);
void rand_init_ball(struct coll_ball *body);

#endif
```

## src/snake.c
```c
/**
 * 食物不能产生在身子上，
 * 蛇头碰到身体任意部分=>死
 * 使用循环队列
*/


#include "snake.h"

#define KEY_RESERVED		0
#define KEY_LEFT			1
#define KEY_MIDDLE          2
#define KEY_RIGHT           3




enum{
    KEY_TYPE_SHORT_UP,
    KEY_TYPE_DOUBLE_CLICK,
    KEY_TYPE_TRIPLE_CLICK,
};


void SnakeInit(struct device* lcd_dev,Snake* S,food* fd)
{
    S->head=0;//队头是蛇尾
    S->rear=1;//队尾是蛇头

    S->body[S->head].x_pos=2;
    S->body[S->head].y_pos=2;
    S->curdir=S->lastdir=MOVE_LEFT;
    S->score=0;
    S->play_pause=1;//默认暂停

    fd->exist=0;
    st7735_drawAscii(lcd_dev,(SCREEN_SIZE_X/2+20),1,'0',24,WHITE,GREEN);
    CreatFood(lcd_dev,S,fd);
    st7735_fill_area(lcd_dev,(S->body[S->head].x_pos)*X_STEP,(S->body[S->head].y_pos)*Y_STEP,
    (S->body[S->head].x_pos+1)*X_STEP,(S->body[S->head].y_pos+1)*Y_STEP,BLUE);

}

uint8_t is_overlap(struct pos* Object,Snake* S)
{
    
    for(int head=S->head;head<(S->rear);head++){
        if((Object->x_pos==S->body[head].x_pos)&&(Object->y_pos==S->body[head].y_pos))
        {
            return true;
        }
    }
    // if(Object->x_pos<0)
    // {
    //     return true;
    // }
    // if(Object->x_pos>MAX_STEP_X)
    // {
    //     return true;
    // }
    // if(Object->y_pos>MAX_STEP_Y)//13
    // {
    //     return true;
    // }
    // if(Object->y_pos<(Forehead_HEIGHT/Y_STEP))//2
    // {
    //     return true;
    // }
    return false;
}

uint8_t SnakeMove(struct device* lcd_dev,Snake* S,food* fd)
{
    int cur_head=(S->rear-1+MAX_BODY)%MAX_BODY;
    if(S->play_pause)
        return 1;
label:
    switch (S->curdir)
    {
    case MOVE_UP:
        if(S->lastdir==MOVE_DOWN)
        {
            S->curdir=MOVE_DOWN;//如果没有这一行，就会产生暂停效果，也就是暂停功能就是从这个函数直接返回
            goto label;
        }
        S->body[S->rear].x_pos=S->body[cur_head].x_pos;
        S->body[S->rear].y_pos=S->body[cur_head].y_pos-1;
        
        break;
    case MOVE_DOWN:
        if(S->lastdir==MOVE_UP)
        {
            S->curdir=MOVE_UP;
            goto label;
        }
        S->body[S->rear].x_pos=S->body[cur_head].x_pos;
        S->body[S->rear].y_pos=S->body[cur_head].y_pos+1;
        break;
    case MOVE_LEFT:
        if(S->lastdir==MOVE_RIGHT)
        {
            S->curdir=MOVE_RIGHT;
            goto label;
        }
        S->body[S->rear].x_pos=S->body[cur_head].x_pos-1;
        S->body[S->rear].y_pos=S->body[cur_head].y_pos;
    break;
    case MOVE_RIGHT:
        if(S->lastdir==MOVE_LEFT)
        {
            S->curdir=MOVE_LEFT;
            goto label;
        }
        S->body[S->rear].x_pos=S->body[cur_head].x_pos+1;
        S->body[S->rear].y_pos=S->body[cur_head].y_pos;
    
    break;
    default:
        break;
    }
    S->lastdir=S->curdir;////


    if(S->body[S->rear].x_pos<0)
    {
        S->body[S->rear].x_pos=MAX_STEP_X;
    }
    if(S->body[S->rear].x_pos>MAX_STEP_X)
    {
        S->body[S->rear].x_pos=0;
    }
    if(S->body[S->rear].y_pos>MAX_STEP_Y)
    {
        S->body[S->rear].y_pos=Forehead_HEIGHT/Y_STEP;
    }
    if(S->body[S->rear].y_pos<(Forehead_HEIGHT/Y_STEP))
    {
        S->body[S->rear].y_pos=MAX_STEP_Y-1;
    }
    


    if(is_overlap(&(S->body[S->rear]),S))
    {
        printk("game over\n");
        return false;//游戏结束
    }

    st7735_fill_area(lcd_dev,(S->body[S->rear].x_pos)*X_STEP,(S->body[S->rear].y_pos)*Y_STEP,
    (S->body[S->rear].x_pos+1)*X_STEP,(S->body[S->rear].y_pos+1)*Y_STEP,BLUE);

    if(fd->exist&&(S->body[S->rear].x_pos==fd->position.x_pos)&&(S->body[S->rear].y_pos==fd->position.y_pos))
    {
        S->score++;

        uint8_t score_high=S->score/10;
        uint8_t score_low=S->score%10;
        if(score_high==0)
        {
            st7735_drawAscii(lcd_dev,(SCREEN_SIZE_X/2+20),1,'0'+score_low,24,WHITE,GREEN);
        }else{
            st7735_drawAscii(lcd_dev,(SCREEN_SIZE_X/2+20),1,'0'+score_high,24,WHITE,GREEN);
            st7735_drawAscii(lcd_dev,(SCREEN_SIZE_X/2+44),1,'0'+score_low,24,WHITE,GREEN);
        }
        
        fd->exist=0;

    }else
    {
        //队头出队
        //清屏

        st7735_fill_area(lcd_dev,(S->body[S->head].x_pos)*X_STEP,(S->body[S->head].y_pos)*Y_STEP,
        (S->body[S->head].x_pos+1)*X_STEP,(S->body[S->head].y_pos+1)*Y_STEP,GREEN);

        S->head=(S->head+1)%MAX_BODY;
    }
    S->rear=(S->rear+1)%MAX_BODY;
    return true;
}

uint8_t SnakeAutoMove(struct device* lcd_dev,Snake* S,food* fd)
{
    solve_game(S,fd->position,&assist);
}











void CreatFood(struct device* lcd_dev,Snake* S,food* fd)
{
    struct pos food_pos={
        .x_pos=k_cycle_get_32()%(LCD_WIDTH/TEST_SIZE),
        .y_pos=k_cycle_get_32()%(LCD_HIGH/TEST_SIZE),
    };
    if(fd->exist==0)
    {
        while(is_overlap(&food_pos,S))
        {
            food_pos.x_pos=k_cycle_get_32()%(MAX_STEP_X-1);
            food_pos.y_pos=(k_cycle_get_32()%(MAX_STEP_Y-Forehead_BYTE))+Forehead_BYTE;
        }

        printk("ypos:%d\n",food_pos.y_pos);
        fd->exist=1;
        fd->position.x_pos=food_pos.x_pos;
        fd->position.y_pos=food_pos.y_pos;

        st7735_fill_area(lcd_dev,(fd->position.x_pos)*X_STEP,(fd->position.y_pos)*Y_STEP,
            (fd->position.x_pos+1)*X_STEP,(fd->position.y_pos+1)*Y_STEP,RED);
    }
    
    
}


// void CreatFood(struct device* lcd_dev,Snake* S,food* fd)
// {
//     struct pos food_pos={
//         .x_pos=k_cycle_get_32()%(MAX_STEP_X-1),
//         .y_pos=k_cycle_get_32()%(MAX_STEP_Y-Forehead_BYTE)+Forehead_BYTE,
//     };
//     if(fd->exist==0)
//     {
//         while(is_overlap(&food_pos,S))
//         {
//             food_pos.x_pos=k_cycle_get_32()%(MAX_STEP_X-1);
//             food_pos.y_pos=(k_cycle_get_32()%(MAX_STEP_Y-Forehead_BYTE))+Forehead_BYTE;
//         }

//         printk("ypos:%d\n",food_pos.y_pos);
//         fd->exist=1;
//         fd->position.x_pos=food_pos.x_pos;
//         fd->position.y_pos=food_pos.y_pos;

//         st7735_fill_area(lcd_dev,(fd->position.x_pos)*X_STEP,(fd->position.y_pos)*Y_STEP,
//             (fd->position.x_pos+1)*X_STEP,(fd->position.y_pos+1)*Y_STEP,RED);
//     }
    
    
// }













void updata_control_input(Snake* S,uint16_t key_value)
{
    uint8_t keycode=(key_value>>8)&0xff;//哪一个按键
    uint8_t keytype=key_value&0xff;//单双击

    if(keycode)
    {
        
    }else{
        return;
    }

    if(keycode==KEY_LEFT)
    {
        if(keytype==KEY_TYPE_SHORT_UP)
        {
            
            S->curdir=MOVE_LEFT;
        }else{
            S->curdir=MOVE_UP;
        }
    }else if(keycode==KEY_RIGHT)
    {
        if(keytype==KEY_TYPE_SHORT_UP)
        {
            
            S->curdir=MOVE_RIGHT;
        }else{
            S->curdir=MOVE_DOWN;
        }
    }else if(keycode==KEY_MIDDLE)//短按暂停之类
    {
        if(keytype==KEY_TYPE_SHORT_UP)
        {
            if(S->play_pause)
                S->play_pause=0;
            else
                S->play_pause=1;
        }

    }

}
```

## src/snake.h
```c
/**
 * 按键功能说明：
 * 左键单击向左
 * 右键单击向右
 * 左键双击向上
 * 右键双击向下
*/

#include <stdlib.h>
#include <time.h>
#include <zephyr.h>
#include <device.h>
#include "drivers/lcd_display.h"

#define MAX_BODY    80

#define X_STEP      10
#define Y_STEP      10

#define Forehead_BYTE       3

#define Forehead_HEIGHT     (Y_STEP*Forehead_BYTE)

#define SCREEN_SIZE_X   130
#define SCREEN_SIZE_Y   160
#define MAX_STEP_X    (SCREEN_SIZE_X/X_STEP)
#define MAX_STEP_Y    (SCREEN_SIZE_Y/Y_STEP)




#define QUEUE_SIZE  80



#define LCD_WIDTH   128
#define LCD_HIGH    160

#define TEST_SIZE   16

#define VEX_NUM     (LCD_WIDTH/TEST_SIZE)*(LCD_HIGH/TEST_SIZE)



enum{
    MOVE_UP,
    MOVE_DOWN,
    MOVE_LEFT,
    MOVE_RIGHT,
};
struct pos
{
    int8_t x_pos;
    int8_t y_pos;
};

typedef struct
{
    struct pos position;
    uint8_t exist;
}food;

typedef struct
{
    struct pos body[MAX_BODY];
    int head,rear;
    int curdir,lastdir;
    int score;
    int play_pause;
}Snake;

struct step
{
    struct pos locat;
};
struct solve_queue
{
    struct step assist_queue[QUEUE_SIZE];
    uint8_t head,rear;
};

void updata_control_input(Snake* S,uint16_t key_value);
void CreatFood(struct device* lcd_dev,Snake* S,food* fd);
uint8_t SnakeMove(struct device* lcd_dev,Snake* S,food* fd);
void SnakeInit(struct device* lcd_dev,Snake* S,food* fd);
uint8_t is_overlap(struct pos* Object,Snake* S);

void solve_game(Snake* S,struct pos food,struct solve_queue* queue);
uint8_t SnakeAutoMove(struct device* lcd_dev,Snake* S,food* fd);

void map_init(void);

extern struct solve_queue assist;
extern uint8_t distance[LCD_HIGH/TEST_SIZE][LCD_WIDTH/TEST_SIZE];
```

## src/solve_snake.c
```c
/**
 * 解法
 * 按照16*16像素来做,屏幕分为10*8=80个节点
 * 目标产生后，要先初始化一遍图，然后用广度优先
*/


#include "snake.h"
#include "string.h"

#include "zephyr.h"


struct pos stack[QUEUE_SIZE];

struct k_stack my_stack;
/**
 * 初始化图结构
*/  

struct solve_queue assist={
    .head=0,
    .rear=0,
};

int8_t dirx[]={1,0,-1,0};
int8_t diry[]={0,1,0,-1};
uint8_t distance[LCD_HIGH/TEST_SIZE][LCD_WIDTH/TEST_SIZE];


// int8_t temp_map[LCD_HIGH/TEST_SIZE][LCD_WIDTH/TEST_SIZE];//用来记录身体障碍

struct step history_path[LCD_HIGH/TEST_SIZE][LCD_WIDTH/TEST_SIZE];//记录路径

void map_init()
{
    k_stack_init(&my_stack, stack, QUEUE_SIZE);
    memset(&distance,255,sizeof(distance));
    printk("distance:%d\n",distance[10][10]);
    // while(pos!=S.rear)
    // {
    //     map[S.body[pos].y_pos][S.body[pos].x_pos]=1;
    //     pos=(pos+1)%MAX_BODY;
    // }
}



void solve_game(Snake* S,struct pos food,struct solve_queue* queue)
{
    struct pos head=S->body[S->rear-1];
    uint8_t find;
    queue->assist_queue[queue->rear++].locat=head;
    distance[head.y_pos][head.x_pos]=0;
    printk("start_x:%d==y:%d||end_x:%d==end_y:%d\n",head.x_pos,head.y_pos,food.x_pos,food.y_pos);
    
    while(queue->rear!=queue->head)//队列非空
    {
        printk("%d**%d\n",queue->rear,queue->head);
        find=0;
        for(uint8_t i=0;i<4;i++)
        {
            struct pos temp;
            temp.x_pos=queue->assist_queue[queue->head].locat.x_pos+dirx[i];
            temp.y_pos=queue->assist_queue[queue->head].locat.y_pos+diry[i];

            
            if((0<=temp.x_pos&&temp.x_pos<(LCD_WIDTH/TEST_SIZE))&&(0<=temp.y_pos&&temp.y_pos<(LCD_HIGH/TEST_SIZE))&&(distance[temp.y_pos][temp.x_pos]==255)
            &&(!is_overlap(&temp,S)))
            {
                printk("smell_X:%d==smell_Y:%d==distance:%d\n",temp.x_pos,temp.y_pos,distance[temp.y_pos][temp.x_pos]);
                history_path[temp.y_pos][temp.x_pos]=queue->assist_queue[queue->head];
                queue->assist_queue[queue->rear].locat=temp;
                queue->rear=(++queue->rear)%QUEUE_SIZE;
                distance[temp.y_pos][temp.x_pos]=distance[queue->assist_queue[queue->head].locat.y_pos][queue->assist_queue[queue->head].locat.x_pos]+1;

                if(temp.x_pos==food.x_pos&&
                temp.y_pos==food.y_pos)
                {
                    printk("find path");
                    find=true;
                    break;
                }
                
            }
        }

        if(find)
        {
            struct pos temp;
            temp=food;
        
            while(1)
            {
                k_stack_push(&my_stack, (uint32_t)&temp);
                if(temp.x_pos==head.x_pos&&temp.y_pos==head.y_pos)
                {
                    break;
                }
                temp=history_path[temp.y_pos][temp.x_pos].locat;
            }


            struct pos *new_buffer;

            while (k_stack_pop(&my_stack, (uint32_t *)&new_buffer, K_FOREVER))
            {
                
                printk("path:%d##%d\n",new_buffer->x_pos,new_buffer->y_pos);
            }
            
            break;
        }
        queue->head=(++queue->head)%QUEUE_SIZE;//出队
    }

}
/**
 * 还要考虑这个队列的自身覆盖问题
*/


















/*第一种方法深度优先*/
```
