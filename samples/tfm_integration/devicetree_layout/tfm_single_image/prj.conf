## CMakeLists.txt
```
# SPDX-License-Identifier: Apache-2.0

cmake_minimum_required(VERSION 3.20.0)

find_package(Zephyr REQUIRED HINTS $ENV{ZEPHYR_BASE})
project(tfm_single_image)

target_sources(app PRIVATE
  src/main.c
)
```

## sample.yaml
```
sample:
  description: TF-M with MCUBOOT_IMAGE_NUMBER=1
  name: tfm-single-image
tests:
  sample.tfm.tfm_single_img:
    tags: trusted-firmware-m
    build_only: true
    platform_allow:
      - nrf5340dk/nrf5340/cpuapp/ns
    integration_platforms:
      - nrf5340dk/nrf5340/cpuapp/ns
```

## prj.conf
```kconfig
# Default TF-M build but from DTS
CONFIG_TFM_DEVICETREE_LAYOUT=y
CONFIG_TFM_MCUBOOT_IMAGE_NUMBER=1
```

## src/main.c
```c
/**
 * @file
 * @copyright 2024 Embeint Inc
 * @author Jordan Yates <jordan@embeint.com>
 *
 * SPDX-License-Identifier: Apache-2.0
 */

#include <zephyr/kernel.h>

int main(void)
{
	printk("Booted TF-M with MCUBOOT_IMAGE_NUMBER=1\n");

	for (;;) {
		printk("Uptime %6d\n", k_uptime_seconds());
		k_sleep(K_SECONDS(1));
	}
	return 0;
}
```
