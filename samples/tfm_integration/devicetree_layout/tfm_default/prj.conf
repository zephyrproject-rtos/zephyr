## sample.yaml
```
sample:
  description: TF-M with default partitions
  name: tfm-default-partitions
tests:
  sample.tfm.tfm_default:
    tags: trusted-firmware-m
    build_only: true
    platform_allow:
      - nrf5340dk/nrf5340/cpuapp/ns
    integration_platforms:
      - nrf5340dk/nrf5340/cpuapp/ns
```

## prj.conf
```kconfig
# Default TF-M build but from DTS
CONFIG_TFM_DEVICETREE_LAYOUT=y
```

## src/main.c
```c
/**
 * @file
 * @copyright 2024 Embeint Inc
 * @author Jordan Yates <jordan@embeint.com>
 *
 * SPDX-License-Identifier: Apache-2.0
 */

#include <zephyr/kernel.h>

int main(void)
{
	printk("Booted TF-M from devicetree partitions\n");

	for (;;) {
		printk("Uptime %6d\n", k_uptime_seconds());
		k_sleep(K_SECONDS(1));
	}
	return 0;
}
```
