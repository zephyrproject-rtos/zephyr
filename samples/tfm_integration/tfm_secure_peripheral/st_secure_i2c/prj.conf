## CMakeLists.txt
```
# SPDX-FileCopyrightText: Copyright The Zephyr Project Contributors
# SPDX-License-Identifier: Apache-2.0

cmake_minimum_required(VERSION 3.20.0)

find_package(Zephyr REQUIRED HINTS $ENV{ZEPHYR_BASE})

get_target_property(TFM_BINARY_DIR tfm TFM_BINARY_DIR)

configure_file(
  ${CMAKE_CURRENT_LIST_DIR}/st_secure_i2c_partition/tfm_manifest_list.yaml.in
  ${CMAKE_CURRENT_BINARY_DIR}/st_secure_i2c_partition/tfm_manifest_list.yaml
)

configure_file(
  ${CMAKE_CURRENT_LIST_DIR}/st_secure_i2c_partition/tfm_st_secure_i2c_partition.yaml.in
  ${CMAKE_CURRENT_BINARY_DIR}/st_secure_i2c_partition/tfm_st_secure_i2c_partition.yaml
)

set_property(TARGET zephyr_property_target
  APPEND PROPERTY TFM_CMAKE_OPTIONS
  -DTFM_EXTRA_MANIFEST_LIST_FILES=${CMAKE_CURRENT_BINARY_DIR}/st_secure_i2c_partition/tfm_manifest_list.yaml
  -DTFM_EXTRA_PARTITION_PATHS=${CMAKE_CURRENT_LIST_DIR}/st_secure_i2c_partition
)

project(tfm_secure_peripheral_st_secure_i2c)

target_sources(app PRIVATE
  src/main.c
  src/st_secure_i2c_partition.c
)

target_include_directories(app PRIVATE
  $<TARGET_PROPERTY:tfm,TFM_BINARY_DIR>/api_ns/interface/include
  ${CMAKE_CURRENT_LIST_DIR}/include
)
```

## prj.conf
```kconfig
# SPDX-FileCopyrightText: Copyright The Zephyr Project Contributors
# SPDX-License-Identifier: Apache-2.0

CONFIG_TFM_CONNECTION_BASED_SERVICE_API=y
CONFIG_TFM_IPC=y
CONFIG_TFM_ISOLATION_LEVEL=1
```

## app.overlay
```dts
/*
 * SPDX-FileCopyrightText: Copyright The Zephyr Project Contributors
 * SPDX-License-Identifier: Apache-2.0
 */

&i2c2 {
	status = "disabled";
};
```

## src/main.c
```c
/*
 * SPDX-FileCopyrightText: Copyright The Zephyr Project Contributors
 * SPDX-License-Identifier: Apache-2.0
 */

#include <tfm_ns_interface.h>
#include <zephyr/kernel.h>

#include "st_secure_i2c_partition.h"

int main(void)
{
	uint8_t tx_payload[] = {0x00, 0x61, 0x62, 0x63, 0x64, 0x90, 0xC2};
	uint8_t rx_payload[32] = {0};
	size_t rx_expected_len = sizeof(tx_payload) + 2; /* len byte pos 2:3 */
	struct i2c_probe_result r = {0};
	psa_status_t status;

	status = st_secure_i2c_probe(&r);
	if (status != PSA_SUCCESS) {
		printk("I2C probe: service call failed (%d)\n", status);
		return 0;
	}

	/* hal_status carries the HAL_StatusTypeDef returned by the secure side,
	 * HAL_OK (0) meaning the device acknowledged its address.
	 */
	if (r.hal_status != 0) {
		printk("I2C probe: device not ready (hal_status=%u isr=0x%02X%02X)\n", r.hal_status,
		       r.isr_hi, r.isr_lo);
		return 0;
	}
	printk("I2C probe: device ready\n");

	status = st_secure_i2c_echo(tx_payload, sizeof(tx_payload), rx_payload, rx_expected_len);
	if (status != PSA_SUCCESS) {
		printk("I2C echo failed. Status: %d\n", status);
		return 0;
	}

	printk("I2C echo success. RX: ");
	for (size_t i = 0; i < rx_expected_len; i++) {
		printk("%02X ", rx_payload[i]);
	}
	printk("\n");

	return 0;
}
```

## include/st_secure_i2c_common.h
```c
/*
 * SPDX-FileCopyrightText: Copyright The Zephyr Project Contributors
 * SPDX-License-Identifier: Apache-2.0
 */

#ifndef ST_SECURE_I2C_COMMON_H
#define ST_SECURE_I2C_COMMON_H

#include <stdint.h>

/* Shared between the secure partition and the non-secure client. */
struct i2c_probe_result {
	uint8_t hal_status;
	uint8_t isr_lo;
	uint8_t isr_hi;
};

#endif /* ST_SECURE_I2C_COMMON_H */
```

## src/se_i2c_partition.c
```c
/*
 * SPDX-FileCopyrightText: Copyright The Zephyr Project Contributors
 * SPDX-License-Identifier: Apache-2.0
 */

#include <tfm_ns_interface.h>

#include "se_i2c_partition.h"

#include <psa/client.h>
#include <psa_manifest/sid.h>

psa_status_t se_i2c_probe(struct i2c_probe_result *out)
{
	psa_status_t status;
	psa_handle_t handle;
	psa_outvec out_vec[1] = {{out, sizeof(*out)}};

	handle = psa_connect(TFM_SE_I2C_PROBE_SID, TFM_SE_I2C_PROBE_VERSION);
	if (!PSA_HANDLE_IS_VALID(handle)) {
		return PSA_ERROR_GENERIC_ERROR;
	}

	status = psa_call(handle, PSA_IPC_CALL, NULL, 0, out_vec, 1);

	psa_close(handle);

	return status;
}

psa_status_t se_i2c_echo(const uint8_t *tx_data, size_t tx_len, uint8_t *rx_data, size_t rx_len)
{
	psa_handle_t handle;
	psa_status_t status;

	psa_invec in_vec[] = {{tx_data, tx_len}};
	psa_outvec out_vec[] = {{rx_data, rx_len}};

	handle = psa_connect(TFM_SE_I2C_ECHO_SID, TFM_SE_I2C_ECHO_VERSION);
	if (!PSA_HANDLE_IS_VALID(handle)) {
		return PSA_ERROR_GENERIC_ERROR;
	}

	status = psa_call(handle, PSA_IPC_CALL, in_vec, 1, out_vec, 1);

	psa_close(handle);

	return status;
}
```

## src/se_i2c_partition.h
```c
/*
 * SPDX-FileCopyrightText: Copyright The Zephyr Project Contributors
 * SPDX-License-Identifier: Apache-2.0
 */

#ifndef ST_SECURE_I2C_SE_I2C_PARTITION_H
#define ST_SECURE_I2C_SE_I2C_PARTITION_H

#include <psa/error.h>
#include <stdint.h>

struct i2c_probe_result {
	uint8_t hal_status;
	uint8_t isr_lo;
	uint8_t isr_hi;
};

psa_status_t se_i2c_probe(struct i2c_probe_result *out);
psa_status_t se_i2c_echo(const uint8_t *tx_buf, size_t tx_len, uint8_t *rx_buf, size_t rx_len);

#endif /* ST_SECURE_I2C_SE_I2C_PARTITION_H */
```

## src/st_secure_i2c_partition.c
```c
/*
 * SPDX-FileCopyrightText: Copyright The Zephyr Project Contributors
 * SPDX-License-Identifier: Apache-2.0
 */

#include <tfm_ns_interface.h>

#include "st_secure_i2c_partition.h"

#include <psa/client.h>
#include <psa_manifest/sid.h>

psa_status_t st_secure_i2c_probe(struct i2c_probe_result *out)
{
	psa_status_t status;
	psa_handle_t handle;
	psa_outvec out_vec[1] = {{out, sizeof(*out)}};

	handle = psa_connect(TFM_ST_SECURE_I2C_PROBE_SID, TFM_ST_SECURE_I2C_PROBE_VERSION);
	if (!PSA_HANDLE_IS_VALID(handle)) {
		return PSA_ERROR_GENERIC_ERROR;
	}

	status = psa_call(handle, PSA_IPC_CALL, NULL, 0, out_vec, 1);

	psa_close(handle);

	return status;
}

psa_status_t st_secure_i2c_echo(const uint8_t *tx_data, size_t tx_len, uint8_t *rx_data,
			    size_t rx_len)
{
	psa_handle_t handle;
	psa_status_t status;

	psa_invec in_vec[] = {{tx_data, tx_len}};
	psa_outvec out_vec[] = {{rx_data, rx_len}};

	handle = psa_connect(TFM_ST_SECURE_I2C_ECHO_SID, TFM_ST_SECURE_I2C_ECHO_VERSION);
	if (!PSA_HANDLE_IS_VALID(handle)) {
		return PSA_ERROR_GENERIC_ERROR;
	}

	status = psa_call(handle, PSA_IPC_CALL, in_vec, 1, out_vec, 1);

	psa_close(handle);

	return status;
}
```

## src/st_secure_i2c_partition.h
```c
/*
 * SPDX-FileCopyrightText: Copyright The Zephyr Project Contributors
 * SPDX-License-Identifier: Apache-2.0
 */

#ifndef ST_SECURE_I2C_PARTITION_H
#define ST_SECURE_I2C_PARTITION_H

#include <psa/error.h>
#include <stddef.h>
#include <stdint.h>

#include "st_secure_i2c_common.h"

psa_status_t st_secure_i2c_probe(struct i2c_probe_result *out);
psa_status_t st_secure_i2c_echo(const uint8_t *tx_buf, size_t tx_len, uint8_t *rx_buf,
			    size_t rx_len);

#endif /* ST_SECURE_I2C_PARTITION_H */
```
