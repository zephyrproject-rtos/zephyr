## CMakeLists.txt
```
# SPDX-License-Identifier: Apache-2.0

cmake_minimum_required(VERSION 3.20.0)

find_package(Zephyr REQUIRED HINTS $ENV{ZEPHYR_BASE})

project(tfm_psa_firmware)


if (NOT CONFIG_APP_FIRMWARE_UPDATE_IMAGE)
   message(FATAL_ERROR "CONFIG_APP_FIRMWARE_UPDATE_IMAGE required")
endif()

# NOTE: These must not include ${CMAKE_BINARY_DIR} otherwise you get an
# absolute path as part of the C symbols in the generated object file.
# This is difficult to use in a correct and portable way. Instead, we will
# take advantage of running everything from within the build directory.
set(UPDATE_SIGNED_HEX update-signed.hex)
set(UPDATE_BIN update-image.bin)
set(UPDATE_OBJ update-image.o)
set(UPDATE_HEADER_BIN update-header.bin)
set(UPDATE_HEADER_OBJ update-header.o)

# The following sequence of add_custom_command calls builds a dependency
# graph of all the bits we need to sign# an image. The process looks
# something like:
#
#                 [(1) sample.hex ]
#                         |
#                         v
#              [(2) sign with imgtool ]
#                         |
#                         v
#               [(3) split-header.py ]
#                  |             |
#              app |             | header
#                  v             v
#             [(4,5) objdump bin to obj ]
#                  |             |
#          app obj |             | header obj
#                  v             v
#              [(6) target_sources(..) ]
#
# Note that node (1) is an input.

# This is duplicated from the trusted-firmware-m CMakeLists.txt, as this
# needs it and CMAKE does not allow us to import the varibales from that
# directory.
set(TFM_MCUBOOT_DIR "${ZEPHYR_TRUSTED_FIRMWARE_M_MODULE_DIR}/bl2/ext/mcuboot")
# Node (2) in the above graphic
add_custom_command(
  DEPENDS ${CONFIG_APP_FIRMWARE_UPDATE_IMAGE}
  OUTPUT ${UPDATE_SIGNED_HEX}
  COMMAND ${CMAKE_COMMAND} -E env PYTHONPATH=${ZEPHYR_MCUBOOT_MODULE_DIR}/scripts${SEP}$ENV{PYTHONPATH}
    ${PYTHON_EXECUTABLE}
    ${TFM_MCUBOOT_DIR}/scripts/wrapper/wrapper.py
    --layout "${CMAKE_BINARY_DIR}/tfm/bl2/ext/mcuboot/CMakeFiles/signing_layout_ns.dir/signing_layout_ns.o"
    -k ${CONFIG_TFM_KEY_FILE_NS}
    --public-key-format "full"
    --align 1
    -v ${CONFIG_APP_FIRMWARE_UPDATE_IMAGE_VERSION}
    --pad
    -s auto
    -H ${CONFIG_ROM_START_OFFSET}
    ${CONFIG_APP_FIRMWARE_UPDATE_IMAGE}
    ${UPDATE_SIGNED_HEX}
)

# Node (3) in the above graphic
add_custom_command(
  OUTPUT ${UPDATE_HEADER_BIN}
  OUTPUT ${UPDATE_BIN}
  DEPENDS ${UPDATE_SIGNED_HEX}
  COMMAND ${PYTHON_EXECUTABLE}
    ${CMAKE_CURRENT_LIST_DIR}/split-header.py
    ${UPDATE_SIGNED_HEX}
    ${UPDATE_BIN}
    ${UPDATE_HEADER_BIN}
)

# Node (4) in the above graphic
add_custom_command(
  OUTPUT ${UPDATE_HEADER_OBJ}
  DEPENDS ${UPDATE_HEADER_BIN}
  COMMAND ${CMAKE_OBJCOPY} -I binary -O elf32-littlearm -B arm
    ${UPDATE_HEADER_BIN}
    ${UPDATE_HEADER_OBJ}
)

# Node (5) in the above graphic
add_custom_command(
  OUTPUT ${UPDATE_OBJ}
  DEPENDS ${UPDATE_BIN}
  COMMAND ${CMAKE_OBJCOPY} -I binary -O elf32-littlearm -B arm
    ${UPDATE_BIN}
    ${UPDATE_OBJ}
)

# Source files in this sample
# Node (6) in the above graphic
target_sources(app PRIVATE src/main.c ${UPDATE_OBJ} ${UPDATE_HEADER_OBJ})

target_include_directories(app PRIVATE
  $<TARGET_PROPERTY:tfm,TFM_BINARY_DIR>/install/interface/include
)
```

## Kconfig
```
# Private config options for PSA firmware application

# Copyright (c) 2021 Linaro
# SPDX-License-Identifier: Apache-2.0

mainmenu "PSA firmware sample application"

menu "Application configuration"

module = APP
module-str = app
source "subsys/logging/Kconfig.template.log_config"

endmenu

config APP_FIRMWARE_UPDATE_IMAGE
	string "Firmware update image to update to"
	help
	  This required option specifies the path to an image that this
	  exapmle will update to.
	default "$(shell, dirname $(filename))/boards/hello-an547.hex" if BOARD_MPS3_AN547_NS

config APP_FIRMWARE_UPDATE_IMAGE_VERSION
	string "Version of the new image to update to"
	default "0.0.2+0"

source "Kconfig.zephyr"
```

## sample.yaml
```
sample:
    description: This app provides an example of using the PSA Firmware calls
        to update to a new firmware using TF-M and MCUBoot.
    name: TF-M PSA firmware update example
tests:
  sample.update-success:
    tags: introduction tfm
    platform_allow: mps3_an547_ns
    integration_platforms:
      - mps3_an547_ns
    harness: console
    timeout: 300
    extra_configs:
      - CONFIG_APP_FIRMWARE_UPDATE_IMAGE_VERSION="0.0.2+0"
    harness_config:
      type: multi_line
      regex:
        - "Active NS image version: 0.0.1-0"
        - "Wrote Header; Installing Image"
        - "Hello World from UserSpace!"
  sample.fail-rollback:
    tags: introduction tfm
    platform_allow: mps3_an547_ns
    integration_platforms:
    - mps3_an547_ns
    harness: console
    timeout: 300
    extra_configs:
      - CONFIG_APP_FIRMWARE_UPDATE_IMAGE_VERSION="0.0.0+0"
    harness_config:
      type: multi_line
      regex:
        - "Active NS image version: 0.0.1-0"
        - "Wrote Header; Installing Image"
        - "Active NS image version: 0.0.1-0"
```

## prj.conf
```kconfig
CONFIG_LOG=y
CONFIG_LOG_RUNTIME_FILTERING=y
CONFIG_LOG_BUFFER_SIZE=2048
CONFIG_LOG_PROCESS_TRIGGER_THRESHOLD=0
CONFIG_LOG_DEFAULT_LEVEL=4

CONFIG_BUILD_WITH_TFM=y
CONFIG_TFM_BL2=y
CONFIG_TFM_IPC=y
CONFIG_TFM_PARTITION_FIRMWARE_UPDATE=y
CONFIG_TFM_IMAGE_VERSION_S="0.0.3"
CONFIG_TFM_IMAGE_VERSION_NS="0.0.1"

# The Zephyr CMSIS emulation assumes that ticks are ms, currently
CONFIG_SYS_CLOCK_TICKS_PER_SEC=1000

CONFIG_MAIN_STACK_SIZE=4096
CONFIG_HEAP_MEM_POOL_SIZE=4096
```

## src/main.c
```c
/*
 * Copyright (c) 2021 Linaro Limited
 *
 * SPDX-License-Identifier: Apache-2.0
 */

#include <zephyr/kernel.h>
#include <zephyr/logging/log_ctrl.h>
#include <zephyr/logging/log.h>
#include <psa/update.h>

#include "tfm_ns_interface.h"

extern uint8_t _binary_update_image_bin_start[];
extern uint8_t _binary_update_image_bin_end;
extern uint8_t _binary_update_image_bin_size;

extern uint8_t _binary_update_header_bin_start[];
extern uint8_t _binary_update_header_bin_end;
extern uint8_t _binary_update_header_bin_size;
/*
 * The _size symbol is particularly bizarre, since it's a length exposed as
 * a symbol's address, not a variable
 */
const size_t update_image_size = (size_t) &_binary_update_image_bin_size;
const size_t update_header_size = (size_t) &_binary_update_header_bin_size;

/* Turns out you can't flash blocks that are not a multiple of this */
const size_t min_block_size = 512;

/** Declare a reference to the application logging interface. */
LOG_MODULE_DECLARE(app, CONFIG_LOG_DEFAULT_LEVEL);

bool fwu_query_ver_active(psa_image_id_t image_id, psa_image_info_t *info)
{
	psa_status_t status;

	/* Query the active image. */
	status = psa_fwu_query(image_id, info);

	/* Get the active image version. State can be one of: */
	/*   PSA_IMAGE_UNDEFINED */
	/*   PSA_IMAGE_CANDIDATE */
	/*   PSA_IMAGE_INSTALLED */
	/*   PSA_IMAGE_REJECTED */
	/*   PSA_IMAGE_PENDING_INSTALL */
	/*   PSA_IMAGE_REBOOT_NEEDED */
	return info->state == PSA_IMAGE_INSTALLED && status == PSA_SUCCESS;
}

void fwu_disp_ver_active(void)
{
	/* Image type can be one of: */
	/*   FWU_IMAGE_TYPE_NONSECURE */
	/*   FWU_IMAGE_TYPE_SECURE */
	/*   FWU_IMAGE_TYPE_FULL */
	/* Making the call with FWU_IMAGE_TYPE_FULL will return the information */
	/* for the full image, which is a combination of the secure and nonsecure */
	/* images. This is related to the way images are managed in the */
	/* bootloader. For example, if the secure image and the nonsecure image */
	/* are combined together and then the combined image is signed and padded */
	/* with some metadata to generate the final image, then the final */
	/* generated image is a “full image”. This image management mode is */
	/* enabled via: */
	/*   -DMCUBOOT_IMAGE_NUMBER=1 */
	/* If this mode is enabled when building TF-M, then the application */
	/* should use the “FWU_IMAGE_TYPE_FULL” type when calling the Firmware */
	/* Update service. */
	/* If this mode is not enabled, then the application should use the */
	/* “FWU_IMAGE_TYPE_NONSECURE” or “FWU_IMAGE_TYPE_SECURE” type. */
	psa_image_id_t image_id = FWU_CALCULATE_IMAGE_ID(FWU_IMAGE_ID_SLOT_ACTIVE,
							 FWU_IMAGE_TYPE_SECURE,
							 0);
	psa_image_info_t info = { 0 };
	bool status = fwu_query_ver_active(image_id, &info);

	if (status) {
		printk("Active S image version: %d.%d.%d-%d\n",
		       info.version.iv_major,
		       info.version.iv_minor,
		       info.version.iv_revision,
		       info.version.iv_build_num);
	} else {
		printk("\nUnable to query active secure image version!\n");
	}

	image_id = FWU_CALCULATE_IMAGE_ID(FWU_IMAGE_ID_SLOT_ACTIVE,
							 FWU_IMAGE_TYPE_NONSECURE,
							 0);
	status = fwu_query_ver_active(image_id, &info);

	if (status) {
		printk("Active NS image version: %d.%d.%d-%d\n",
		       info.version.iv_major,
		       info.version.iv_minor,
		       info.version.iv_revision,
		       info.version.iv_build_num);
	} else {
		printk("\nUnable to query active nonsecure image version!\n");
	}
}

/**
 * Copy a part of a firmware update from the memory pointed to by `cur_block`,
 * with `size` size, into the `image_id` partition, * at offset `offset`.
 */
void write_update_part(psa_image_id_t image_id, size_t size, size_t offset, void *cur_block)
{
	size_t coppied = 0;

	while (coppied < size) {
		size_t next_block_size = PSA_FWU_MAX_BLOCK_SIZE;
		size_t remainder = size - coppied;

		if (remainder < next_block_size) {
			next_block_size = remainder;
		}
		psa_status_t write_status = psa_fwu_write(
			image_id,
			coppied + offset,
			&((uint8_t *)cur_block)[coppied],
			next_block_size
		);

		switch (write_status) {
		case PSA_ERROR_INVALID_ARGUMENT:
			printk("FW Update failed: Invalid Argument\n");
			k_oops();
			break;
		case PSA_ERROR_INSUFFICIENT_MEMORY:
			printk("FW Update failed: Insufficient Memory\n");
			k_oops();
			break;
		case PSA_ERROR_INSUFFICIENT_STORAGE:
			printk("FW Update failed: Insufficient Storage\n");
			k_oops();
			break;
		case PSA_ERROR_GENERIC_ERROR:
			printk("FW Update failed: Generic Error\n");
			k_oops();
			break;
		case PSA_ERROR_CURRENTLY_INSTALLING:
			printk("FW Update failed: Currently Installing\n");
			k_oops();
			break;
		default:
			break;
		}
		if (write_status != PSA_SUCCESS) {
			k_oops();
		}
		coppied += next_block_size;
	}
}

/**
 * Run a test firmware update
 */
void update_firmware(void)
{
	uintptr_t size = ((update_image_size + (min_block_size - 1)) / min_block_size)
		* min_block_size;
	void *cur_block = &_binary_update_image_bin_start[0];

	printk("Starting FWU; Writing Firmware from %lx size %5ld bytes\n",
		(uintptr_t) cur_block,
		(uintptr_t) update_image_size
	);

	psa_image_id_t image_id = FWU_CALCULATE_IMAGE_ID(FWU_IMAGE_ID_SLOT_STAGE,
							 FWU_IMAGE_TYPE_NONSECURE,
							 0);
	write_update_part(image_id, size, 0, cur_block);

	size_t header_offset = 0x18000 - update_header_size;

	cur_block = &_binary_update_header_bin_start[0];
	printk("Wrote Firmware; Writing Header from %lx size %5ld bytes\n",
		(uintptr_t) cur_block,
		(uintptr_t) update_header_size
	);
	write_update_part(image_id, update_header_size, header_offset, cur_block);

	printk("Wrote Header; Installing Image\n");

	psa_image_id_t uuid;
	psa_image_version_t version;
	psa_status_t install_stat = psa_fwu_install(image_id, &uuid, &version);

	switch (install_stat) {
	case PSA_SUCCESS:
	case PSA_SUCCESS_REBOOT:
		break;
	case PSA_ERROR_INVALID_ARGUMENT:
		printk("FW Update failed: Invalid Argument\n");
		k_oops();
		break;
	case PSA_ERROR_INVALID_SIGNATURE:
		printk("FW Update failed: Invalid Signature\n");
		k_oops();
		break;
	case PSA_ERROR_GENERIC_ERROR:
		printk("FW Update failed: Generic Error\n");
		k_oops();
		break;
	case PSA_ERROR_STORAGE_FAILURE:
		printk("FW Update failed: Storage Failure\n");
		k_oops();
		break;
	case PSA_ERROR_DEPENDENCY_NEEDED:
		printk(
			"FW Update failed: Dependency Needed: uuid: %x version: %d.%d.%d-%d\n",
			uuid,
			version.iv_major,
			version.iv_minor,
			version.iv_revision,
			version.iv_build_num
		);
		k_oops();
		break;
	}

	psa_image_info_t info = { 0 };

	psa_fwu_query(image_id, &info);

	switch (info.state) {
	case PSA_IMAGE_UNDEFINED:
		printk("Installed New Firmware; Error: State UNDEFINED\n");
		break;
	case PSA_IMAGE_CANDIDATE:
		printk("Installed New Firmware as Candidate; Rebooting\n");
		break;
	case PSA_IMAGE_INSTALLED:
		printk("Installed New Firmware; Rebooting\n");
		break;
	case PSA_IMAGE_REJECTED:
		printk("Installed New Firmware; Error: Rejected\n");
		break;
	case PSA_IMAGE_PENDING_INSTALL:
		printk("Installed New Firmware pending install; Rebooting\n");
		break;
	case PSA_IMAGE_REBOOT_NEEDED:
		printk("Installed New Firmware; Reboot Needed; Rebooting\n");
		break;
	}

	/* Flush all logs in the deferred mode. */
	while (IS_ENABLED(CONFIG_LOG_MODE_DEFERRED) && log_data_pending()) {
		k_msleep(100);
	}

	psa_fwu_request_reboot();
}

void tfm_ns_interface_init(void);

void main(void)
{
	/* Initialize the TFM NS interface */
	tfm_ns_interface_init();

	printk("PSA Firmware API test\n");

	/* Display current firmware version. */
	fwu_disp_ver_active();

	update_firmware();
}
```
