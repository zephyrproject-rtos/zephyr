## samples/tfm_integration/psa_firmware/sample.yaml
```yaml
sample:
    description: This app provides an example of using the PSA Firmware calls
        to update to a new firmware using TF-M and MCUBoot.
    name: TF-M PSA firmware update example
tests:
    sample.update-success:
        tags: introduction tfm
        platform_allow: mps3_an547_ns
        harness: console
        timeout: 300
        extra_configs:
          - CONFIG_APP_FIRMWARE_UPDATE_IMAGE_VERSION="0.0.2+0"
        harness_config:
          type: multi_line
          regex:
            - "Active NS image version: 0.0.1-0"
            - "Wrote Header; Installing Image"
            - "Hello World from UserSpace!"
    sample.fail-rollback:
        tags: introduction tfm
        platform_allow: mps3_an547_ns
        harness: console
        timeout: 300
        extra_configs:
          - CONFIG_APP_FIRMWARE_UPDATE_IMAGE_VERSION="0.0.0+0"
        harness_config:
          type: multi_line
          regex:
            - "Active NS image version: 0.0.1-0"
            - "Wrote Header; Installing Image"
            - "Active NS image version: 0.0.1-0"
```

## samples/tfm_integration/psa_level_1/Kconfig
```kconfig
# Private config options for PSA level 1 application

# Copyright (c) 2019,2020 Linaro
# SPDX-License-Identifier: Apache-2.0

mainmenu "PSA level 1 sample application"

menu "Application configuration"

module = PSA
module-str = psa
source "subsys/logging/Kconfig.template.log_config"

endmenu

config PSA_SHELL
	bool "Enable the 'psa' shell command"
	depends on SHELL
	help
	  Enabling this option will make the 'psa' shell command available.

source "Kconfig.zephyr"
```

## samples/tfm_integration/psa_level_1/sample.yaml
```yaml
sample:
    description: This app provides an example of using TF-M on the secure
        side, with Zephyr on the NS side, using IPC mode.
    name: TF-M PSA Level 1 example
tests:
    sample.psa_level_1:
        tags: introduction
        platform_allow: mps2_an521_nonsecure lpcxpresso55s69_ns nrf5340pdk_nrf5340_cpuappns
          nrf5340dk_nrf5340_cpuappns nrf9160dk_nrf9160ns v2m_musca_s1_nonsecure
        harness: console
        harness_config:
          type: multi_line
          regex:
            - "Creating new config file with UID"
            - "System IAT size is"
            - "Generating 256 bytes of random data"
```

## samples/tfm_integration/psa_protected_storage/sample.yaml
```yaml
sample:
  description: Protected Storage API sample
  name: PSA Protected Storage
common:
  tags: psa
  platform_allow:
    - mps2/an521/cpu0/ns
    - v2m_musca_s1/musca_s1/ns
    - nrf5340dk/nrf5340/cpuapp/ns
    - nrf9160dk/nrf9160/ns
    - bl5340_dvk/nrf5340/cpuapp/ns
    - lpcxpresso55s69/lpc55s69/cpu0/ns
    - rd_rw612_bga/rw612/ns
    - frdm_rw612/rw612/ns
  integration_platforms:
    - mps2/an521/cpu0/ns
  harness: console
  harness_config:
    type: multi_line
    regex:
      - "Protected Storage sample started"
      - "PSA Protected Storage API Version [0-9]*.[0-9]*"
      - "Writing data to UID1: .*"
      - "Info on data stored in UID1:"
      - "- Size: [0-9]*"
      - "- Capacity: 0x[0-9a-f]*"
      - "- Flags: 0x[0-9-a-f]*"
      - "Got expected error \\(PSA_ERROR_NOT_PERMITTED\\) when writing to protected\
      \ UID"
      - "Removing UID1"

tests:
  sample.tfm.protected_storage:
    tags:
      - trusted-firmware-m
      - mcuboot
```

## samples/tfm_integration/tfm_ipc/sample.yaml
```yaml
sample:
  description: This app provides an example of using TF-M on the secure side, with
    Zephyr on the NS side, using IPC.
  name: TF-M IPC example
tests:
  sample.tfm_ipc:
    tags:
      - introduction
      - trusted-firmware-m
      - mcuboot
    platform_allow:
      - mps2/an521/cpu0/ns
      - nrf5340dk/nrf5340/cpuapp/ns
      - nrf9160dk/nrf9160/ns
      - nucleo_l552ze_q/stm32l552xx/ns
      - stm32l562e_dk/stm32l562xx/ns
      - v2m_musca_s1/musca_s1/ns
      - bl5340_dvk/nrf5340/cpuapp/ns
      - b_u585i_iot02a/stm32u585xx/ns
      - rd_rw612_bga/rw612/ns
      - frdm_rw612/rw612/ns
    integration_platforms:
      - mps2/an521/cpu0/ns
    harness: console
    harness_config:
      type: multi_line
      regex:
        - "TF-M IPC on .*"
        - "The version of the PSA Framework API is"
        - "The PSA Crypto service minor version is"
        - "Generating 256 bytes of random data"
  sample.tfm_ipc.no_bl2:
    tags:
      - introduction
      - trusted-firmware-m
    platform_allow:
      - mps2/an521/cpu0/ns
      - rd_rw612_bga/rw612/ns
      - frdm_rw612/rw612/ns
    extra_configs:
      - CONFIG_TFM_BL2=n
    harness: console
    harness_config:
      type: multi_line
      regex:
        - "TF-M IPC on .*"
        - "The version of the PSA Framework API is"
        - "The PSA Crypto service minor version is"
        - "Generating 256 bytes of random data"
```

## samples/tfm_integration/tfm_psa_test/sample.yaml
```yaml
common:
  tags:
    - trusted-firmware-m
    - mcuboot
  platform_allow:
    - mps2/an521/cpu0/ns
    - nrf5340dk/nrf5340/cpuapp/ns
    - nrf9160dk/nrf9160/ns
    - nrf9161dk/nrf9161/ns
    - v2m_musca_s1/musca_s1/ns
    - rd_rw612_bga/rw612/ns
  modules:
    - psa-arch-tests
    - tf-m-tests
  integration_platforms:
    - mps2/an521/cpu0/ns
  harness: console
  harness_config:
    type: multi_line
    regex:
      - "\\*\\*\\*\\*\\* PSA Architecture Test Suite - Version .* \\*\\*\\*\\*\\*"
      - "TOTAL FAILED *: 0"
sample:
  name: "TFM PSA Test"

tests:
  sample.tfm.psa_test_protected_storage:
    extra_args: "CONFIG_TFM_PSA_TEST_PROTECTED_STORAGE=y"
    timeout: 120
  sample.tfm.psa_test_internal_trusted_storage:
    extra_args: "CONFIG_TFM_PSA_TEST_INTERNAL_TRUSTED_STORAGE=y"
  sample.tfm.psa_test_storage:
    extra_args: "CONFIG_TFM_PSA_TEST_STORAGE=y"
    timeout: 130
  sample.tfm.psa_test_crypto:
    timeout: 120
    extra_args: "CONFIG_TFM_PSA_TEST_CRYPTO=y"

# The test suite below has been disabled due to licensing issues with the QCBOR
# library used by t_cose. This test will be re-enabled once the licensing
# issues have been sorted out upstream.
#
#  sample.tfm.psa_test_initial_attestation:
#    extra_args: "CONFIG_TFM_PSA_TEST_INITIAL_ATTESTATION=y"
```

## samples/tfm_integration/tfm_regression_test/Kconfig
```kconfig
# Copyright (c) 2026, BayLibre SAS
# SPDX-License-Identifier: Apache-2.0

config TFM_PROFILE_TYPE_NOT_SET
	imply PSA_WANT_ALG_CBC_NO_PADDING
	imply PSA_WANT_ALG_CBC_PKCS7
	imply PSA_WANT_ALG_CCM
	imply PSA_WANT_ALG_CMAC
	imply PSA_WANT_ALG_CFB
	imply PSA_WANT_ALG_CTR
	imply PSA_WANT_ALG_DETERMINISTIC_ECDSA
	imply PSA_WANT_ALG_ECB_NO_PADDING
	imply PSA_WANT_ALG_ECDH
	imply PSA_WANT_ALG_ECDSA
	imply PSA_WANT_ALG_GCM
	imply PSA_WANT_ALG_HKDF
	imply PSA_WANT_ALG_HMAC
	imply PSA_WANT_ALG_OFB
	imply PSA_WANT_ALG_PBKDF2_HMAC
	imply PSA_WANT_ALG_RSA_OAEP
	imply PSA_WANT_ALG_RSA_PKCS1V15_CRYPT
	imply PSA_WANT_ALG_RSA_PKCS1V15_SIGN
	imply PSA_WANT_ALG_RSA_PSS
	imply PSA_WANT_ALG_SHA_224
	imply PSA_WANT_ALG_SHA_256
	imply PSA_WANT_ALG_SHA_384
	imply PSA_WANT_ALG_SHA_512
	imply PSA_WANT_ALG_TLS12_PRF
	imply PSA_WANT_ALG_TLS12_PSK_TO_MS
	imply PSA_WANT_ECC_MONTGOMERY_255
	imply PSA_WANT_ECC_MONTGOMERY_448
	imply PSA_WANT_ECC_SECP_K1_256
	imply PSA_WANT_ECC_SECP_R1_256
	imply PSA_WANT_ECC_SECP_R1_384
	imply PSA_WANT_ECC_SECP_R1_521
	imply PSA_WANT_KEY_TYPE_DERIVE
	imply PSA_WANT_KEY_TYPE_HMAC
	imply PSA_WANT_KEY_TYPE_AES
	imply PSA_WANT_KEY_TYPE_ECC_PUBLIC_KEY
	imply PSA_WANT_KEY_TYPE_RAW_DATA
	imply PSA_WANT_KEY_TYPE_RSA_PUBLIC_KEY
	imply PSA_WANT_KEY_TYPE_ECC_KEY_PAIR_BASIC
	imply PSA_WANT_KEY_TYPE_ECC_KEY_PAIR_IMPORT
	imply PSA_WANT_KEY_TYPE_ECC_KEY_PAIR_EXPORT
	imply PSA_WANT_KEY_TYPE_ECC_KEY_PAIR_GENERATE
	imply PSA_WANT_KEY_TYPE_ECC_KEY_PAIR_DERIVE
	imply PSA_WANT_KEY_TYPE_RSA_KEY_PAIR_BASIC
	imply PSA_WANT_KEY_TYPE_RSA_KEY_PAIR_IMPORT
	imply PSA_WANT_KEY_TYPE_RSA_KEY_PAIR_EXPORT
	imply PSA_WANT_KEY_TYPE_RSA_KEY_PAIR_GENERATE
	help
	  Automatically select crypto features which are enabled in TF-M when
	  no profile is specified. These are taken from
	  "lib/ext/mbedcrypto/crypto_config_default.h".


config TFM_PROFILE_TYPE_SMALL
	imply PSA_WANT_ALG_CCM
	imply PSA_WANT_ALG_HMAC
	imply PSA_WANT_ALG_SHA_224
	imply PSA_WANT_ALG_SHA_256
	imply PSA_WANT_ALG_TLS12_PRF
	imply PSA_WANT_ALG_TLS12_PSK_TO_MS
	imply PSA_WANT_KEY_TYPE_DERIVE
	imply PSA_WANT_KEY_TYPE_HMAC
	imply PSA_WANT_KEY_TYPE_AES
	imply PSA_WANT_KEY_TYPE_RAW_DATA
	help
	  Automatically select crypto features which are enabled in TF-M when
	  small profile is specified. These are taken from
	  "lib/ext/mbedcrypto/crypto_config_profile_small.h".

config TFM_PROFILE_TYPE_MEDIUM
	imply PSA_WANT_ALG_CCM
	imply PSA_WANT_ALG_ECDH
	imply PSA_WANT_ALG_ECDSA
	imply PSA_WANT_ALG_HKDF
	imply PSA_WANT_ALG_HMAC
	imply PSA_WANT_ALG_SHA_224
	imply PSA_WANT_ALG_SHA_256
	imply PSA_WANT_ALG_TLS12_PRF
	imply PSA_WANT_ALG_TLS12_PSK_TO_MS
	imply PSA_WANT_ECC_SECP_R1_256
	imply PSA_WANT_KEY_TYPE_DERIVE
	imply PSA_WANT_KEY_TYPE_HMAC
	imply PSA_WANT_KEY_TYPE_AES
	imply PSA_WANT_KEY_TYPE_ECC_PUBLIC_KEY
	imply PSA_WANT_KEY_TYPE_RAW_DATA
	imply PSA_WANT_KEY_TYPE_ECC_KEY_PAIR_BASIC
	imply PSA_WANT_KEY_TYPE_ECC_KEY_PAIR_IMPORT
	imply PSA_WANT_KEY_TYPE_ECC_KEY_PAIR_EXPORT
	imply PSA_WANT_KEY_TYPE_ECC_KEY_PAIR_GENERATE
	help
	  Automatically select crypto features which are enabled in TF-M when
	  medium profile is specified. These are taken from
	  "lib/ext/mbedcrypto/crypto_config_profile_medium.h".

config TFM_PROFILE_TYPE_AROTLESS
	imply PSA_WANT_ALG_CCM
	imply PSA_WANT_ALG_ECDH
	imply PSA_WANT_ALG_ECDSA
	imply PSA_WANT_ALG_HKDF
	imply PSA_WANT_ALG_HMAC
	imply PSA_WANT_ALG_SHA_224
	imply PSA_WANT_ALG_SHA_256
	imply PSA_WANT_ALG_TLS12_PRF
	imply PSA_WANT_ALG_TLS12_PSK_TO_MS
	imply PSA_WANT_ECC_SECP_R1_256
	imply PSA_WANT_KEY_TYPE_DERIVE
	imply PSA_WANT_KEY_TYPE_HMAC
	imply PSA_WANT_KEY_TYPE_AES
	imply PSA_WANT_KEY_TYPE_ECC_PUBLIC_KEY
	imply PSA_WANT_KEY_TYPE_RAW_DATA
	imply PSA_WANT_KEY_TYPE_ECC_KEY_PAIR_BASIC
	imply PSA_WANT_KEY_TYPE_ECC_KEY_PAIR_IMPORT
	imply PSA_WANT_KEY_TYPE_ECC_KEY_PAIR_EXPORT
	imply PSA_WANT_KEY_TYPE_ECC_KEY_PAIR_GENERATE
	help
	  Automatically select crypto features which are enabled in TF-M when
	  medium-arotless profile is specified. These are taken from
	  "lib/ext/mbedcrypto/crypto_config_profile_medium.h".

config TFM_PROFILE_TYPE_LARGE
	imply PSA_WANT_ALG_CBC_NO_PADDING
	imply PSA_WANT_ALG_CBC_PKCS7
	imply PSA_WANT_ALG_CCM
	imply PSA_WANT_ALG_CMAC
	imply PSA_WANT_ALG_CFB
	imply PSA_WANT_ALG_CTR
	imply PSA_WANT_ALG_DETERMINISTIC_ECDSA
	imply PSA_WANT_ALG_ECDH
	imply PSA_WANT_ALG_ECDSA
	imply PSA_WANT_ALG_GCM
	imply PSA_WANT_ALG_HKDF
	imply PSA_WANT_ALG_HMAC
	imply PSA_WANT_ALG_PBKDF2_HMAC
	imply PSA_WANT_ALG_RSA_OAEP
	imply PSA_WANT_ALG_RSA_PKCS1V15_CRYPT
	imply PSA_WANT_ALG_RSA_PKCS1V15_SIGN
	imply PSA_WANT_ALG_RSA_PSS
	imply PSA_WANT_ALG_SHA_224
	imply PSA_WANT_ALG_SHA_256
	imply PSA_WANT_ALG_SHA_384
	imply PSA_WANT_ALG_SHA_512
	imply PSA_WANT_ALG_TLS12_PRF
	imply PSA_WANT_ALG_TLS12_PSK_TO_MS
	imply PSA_WANT_ECC_SECP_K1_256
	imply PSA_WANT_ECC_SECP_R1_256
	imply PSA_WANT_ECC_SECP_R1_384
	imply PSA_WANT_KEY_TYPE_DERIVE
	imply PSA_WANT_KEY_TYPE_HMAC
	imply PSA_WANT_KEY_TYPE_AES
	imply PSA_WANT_KEY_TYPE_ECC_PUBLIC_KEY
	imply PSA_WANT_KEY_TYPE_RAW_DATA
	imply PSA_WANT_KEY_TYPE_RSA_PUBLIC_KEY
	imply PSA_WANT_KEY_TYPE_ECC_KEY_PAIR_IMPORT
	imply PSA_WANT_KEY_TYPE_ECC_KEY_PAIR_EXPORT
	imply PSA_WANT_KEY_TYPE_ECC_KEY_PAIR_GENERATE
	imply PSA_WANT_KEY_TYPE_ECC_KEY_PAIR_DERIVE
	imply PSA_WANT_KEY_TYPE_RSA_KEY_PAIR_BASIC
	imply PSA_WANT_KEY_TYPE_RSA_KEY_PAIR_IMPORT
	imply PSA_WANT_KEY_TYPE_RSA_KEY_PAIR_EXPORT
	imply PSA_WANT_KEY_TYPE_RSA_KEY_PAIR_GENERATE
	help
	  Automatically select crypto features which are enabled in TF-M when
	  large profile is specified. These are taken from
	  "lib/ext/mbedcrypto/crypto_config_profile_large.h".

source "Kconfig.zephyr"
```

## samples/tfm_integration/tfm_regression_test/boards/max32657evkit_max32657_ns.conf
```kconfig
# Copyright (c) 2025 Analog Devices, Inc.
#
# SPDX-License-Identifier: Apache-2.0
#

CONFIG_TFM_REGRESSION_S=n

# MAX32657 currently only supports SFN
# and isolation level 1
CONFIG_TFM_IPC=n
CONFIG_TFM_ISOLATION_LEVEL=1
```

## samples/tfm_integration/tfm_regression_test/sample.yaml
```yaml
common:
  tags:
    - trusted-firmware-m
    - mcuboot
  modules:
    - psa-arch-tests
  platform_allow:
    - nrf5340dk/nrf5340/cpuapp/ns
    - nrf9160dk/nrf9160/ns
    - nrf9161dk/nrf9161/ns
    - v2m_musca_s1/musca_s1/ns
    - rd_rw612_bga/rw612/ns
    - frdm_rw612/rw612/ns
  integration_platforms:
    - nrf5340dk/nrf5340/cpuapp/ns
  harness: console
  harness_config:
    type: multi_line
    regex:
      - "Non-Secure system starting..."
      - "\\#\\#\\#\\# Execute test suites for the Non-secure area \\#\\#\\#\\#"
      - "\\*\\*\\* End of Non-secure test suites \\*\\*\\*"

sample:
  name: "TFM Regression Test"

tests:
  sample.tfm.regression_ipc_lvl1:
    extra_args:
      - CONFIG_TFM_IPC=y
      - CONFIG_TFM_ISOLATION_LEVEL=1
    timeout: 200

  sample.tfm.regression_ipc_lvl2:
    timeout: 200

  sample.tfm.regression_sfn:
    platform_exclude:
      - rd_rw612_bga/rw612/ns
      - frdm_rw612/rw612/ns
    extra_args:
      - CONFIG_TFM_SFN=y
      - CONFIG_TFM_ISOLATION_LEVEL=1
    timeout: 200
```

## samples/tfm_integration/tfm_secure_partition/sample.yaml
```yaml
common:
  tags:
    - trusted-firmware-m
  platform_allow:
    - mps2/an521/cpu0/ns
    - v2m_musca_s1/musca_s1/ns
    - nrf5340dk/nrf5340/cpuapp/ns
    - nrf9160dk/nrf9160/ns
    - lpcxpresso55s69/lpc55s69/cpu0/ns
  integration_platforms:
    - mps2/an521/cpu0/ns
  harness: console
  harness_config:
    type: multi_line
    regex:
      - "Digest: be45cb2605bf36bebde684841a28f0fd43c69850a3dce5fedba69928ee3a8991"
      - "Digest: 1452c8f04245d355722fdbfb03c69bcfd380b7dff911a3e425013397251f6a4e"
      - "Digest: d3b4349010abb691b9584b6fd6b41ec54596ef7b98d853fb4f5bfa690f50f222"
      - "Digest: 5afbcfede855ca834ff5b4e8a44a32206a51381f3cf52f5001a3241f017ac41a"
      - "Digest: 983318380c325099da63de2e7ca57c1630693b28b4754e08817533295dbfcfbb"
      - "No valid secret for key, received expected error code"
sample:
  name: "TFM Secure Partition Sample"

tests:
  sample.tfm.secure_partition:
    tags:
      - trusted-firmware-m
      - mcuboot
```

## samples/tfm_integration/tfm_secure_peripheral/st/se_over_i2c/sample.yaml
```yaml
sample:
  name: TF-M partition for probing an STSAFE device over I2C
common:
  tags:
    - trusted-firmware-m
  platform_allow:
    - b_u585i_iot02a/stm32u585xx/ns
  harness: console
  harness_config:
    type: one_line
    regex:
      - "I2C echo success. RX: 00 00 06 61 62 63 64 90 C2"
tests:
  sample.tfm.st.se_over_i2c:
    tags:
      - se_over_i2c
```

## samples/touch/iqs5xx/sample.yaml
```yaml
sample:
  name: Touch iqs5xx Sample.
tests:
  sample.touch.iqs5xx:
    tags: iqs5xx
    platform_allow: esp32
    depends_on: i2c
    harness: console
    harness_config:
      type: one_line
      regex:
        - "IQS Driver Probed. Product Number: (.*)"
```

## samples/userspace/hello_world_user/sample.yaml
```yaml
sample:
  description: Hello World sample, the simplest userspace
    Zephyr application
  name: hello world user
common:
  integration_platforms:
    - mps2/an385
  tags: introduction
  harness: console
  harness_config:
    type: one_line
    regex:
      - "Hello World from UserSpace! (.*)"
tests:
  sample.helloworld:
    filter: CONFIG_ARCH_HAS_USERSPACE
    arch_exclude:
      - posix
    platform_exclude:
      - qemu_xtensa/dc233c/mmu
    tags: introduction
```
