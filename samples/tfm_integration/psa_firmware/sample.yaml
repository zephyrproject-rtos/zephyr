## samples/userspace/prod_consumer/sample.yaml
```yaml
sample:
  description: userspace producer-consumer example
  name: producer-consumer
common:
  platform_key:
    - simulation
    - arch
  integration_platforms:
    - mps2/an385
    - qemu_x86
  tags:
    - userspace
  depends_on_anyof:
    - mmu
    - mpu
  harness: console
  harness_config:
    type: one_line
    regex:
      - "SUCCESS"
tests:
  sample.userspace.prod_consumer: {}
```

## samples/userspace/riscv_pmp/sample.yaml
```yaml
sample:
  description: userspace example
  name: riscv-pmp
common:
    tags: userspace
    harness: console
    harness_config:
      type: one_line
      regex:
        - "SUCCESS"
```

## samples/userspace/shared_mem/sample.yaml
```yaml
sample:
  description: userspace memory domain protection
    example application
  name: protected memory
common:
  platform_key:
    - arch
  integration_platforms:
    - mps2/an385
  tags: userspace
  harness: console
  harness_config:
    type: one_line
    regex:
      - "MSG"
tests:
  sample.kernel.memory_protection.shared_mem:
    depends_on_anyof:
      - mmu
      - mpu
```

## samples/userspace/syscall_perf/sample.yaml
```yaml
sample:
  description: syscall performances sample
  name: syscall performances
common:
  tags: userspace
  harness: console
  harness_config:
    type: one_line
    regex:
      - "User thread"
tests:
  sample.syscall_performances:
    filter: CONFIG_ARCH_HAS_USERSPACE
    arch_allow: riscv
    integration_platforms:
      - hifive1@B
```

## samples/uwb/ranging_controller/sample.yaml
```yaml
sample:
  name: UWB Ranging Controller
  description: Demonstrates UWB DS-TWR Controller ranging
tests:
  sample.uwb.demo_ranging_controlee.nxp_sr250_shield:
    build_only: true
    platform_allow:
      - frdm_rw612
      - frdm_mcxw72
    tags: uwb
    depends_on:
      - arduino_i2c
      - arduino_spi
    extra_args: SHIELD=nxp_sr250
    integration_platforms:
      - frdm_rw612
      - frdm_mcxw72
```

## samples/video/capture/sample.yaml
```yaml
sample:
  name: Video capture
tests:
  sample.video.capture:
    build_only: true
    tags: video
    platform_whitelist: mimxrt1064_evk
    pre-filter: subsys_dt_compat_enabled("video")
```

## samples/video/capture_and_display/boards/mimxrt1064_evk.conf
```kconfig
# Enable MT9M114 Sensor Driver
CONFIG_VIDEO_MT9M114=y
CONFIG_I2C=y

# Enable lcd interface and lcd device
CONFIG_VIDEO_RK043FN02H=y
CONFIG_VIDEO_MCUX_ELCDIF=y
```

## samples/video/capture_and_display/sample.yaml
```yaml
sample:
  name: Video capture and display
tests:
  sample.video.capture:
    build_only: true
    tags: video
    platform_whitelist: mimxrt1064_evk
    depends_on: video
```

## samples/video/tcpserversink/sample.yaml
```yaml
sample:
  name: Video TCP server sink
tests:
  sample.video.tcpserversink:
    build_only: true
    tags: video net socket
    platform_whitelist: mimxrt1064_evk
    pre-filter: subsys_dt_compat_enabled("video") and subsys_dt_compat_enabled("ethernet")
```

## samples/web3stream/crypto/ecdsa/sample.yaml
```yaml
sample:
  description: Web3-iot-sdk sample
    application
  name: ecdsa
tests:
  sample.web3stream.crypto.ecdsa:
    tags: introduction
```
