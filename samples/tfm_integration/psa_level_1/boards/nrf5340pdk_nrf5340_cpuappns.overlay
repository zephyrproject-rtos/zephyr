/*
 * Copyright (c) 2019-2020 Nordic Semiconductor ASA
 *
 * SPDX-License-Identifier: Apache-2.0
 */

&sram0_s {
	reg = <0x20000000 DT_SIZE_K(256)>;
};

/delete-node/ &sram0_ns;
/ {
	reserved-memory {
		sram0_ns: image_ns@20040000 {
			reg = <0x20040000 DT_SIZE_K(192)>;
		};
	};
};
