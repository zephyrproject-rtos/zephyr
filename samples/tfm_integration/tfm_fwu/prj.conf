## CMakeLists.txt
```
# SPDX-FileCopyrightText: Copyright The Zephyr Project Contributors
# SPDX-License-Identifier: Apache-2.0

cmake_minimum_required(VERSION 3.20.0)

find_package(Zephyr REQUIRED HINTS $ENV{ZEPHYR_BASE})

project(tfm_fwu)

set(SWAPPED_APP_BUILD_DIR "${CMAKE_CURRENT_BINARY_DIR}/../swapped_app/zephyr")

if(CONFIG_TFM_MCUBOOT_ENCRYPTION)
  set(SWAPPED_APP_IMAGE "${SWAPPED_APP_BUILD_DIR}/zephyr_ns_signed_encrypted.bin")
else()
  set(SWAPPED_APP_IMAGE "${SWAPPED_APP_BUILD_DIR}/zephyr_ns_signed.bin")
endif()

set_source_files_properties(${SWAPPED_APP_IMAGE} PROPERTIES GENERATED TRUE)

generate_inc_file_for_target(
    app
    ${SWAPPED_APP_IMAGE}
    ${ZEPHYR_BINARY_DIR}/include/generated/swapped_app_image.inc
)

target_sources(app PRIVATE src/main.c)
```

## Kconfig.sysbuild
```
# SPDX-FileCopyrightText: Copyright The Zephyr Project Contributors
# SPDX-License-Identifier: Apache-2.0

source "share/sysbuild/Kconfig"

config SAMPLE_TFM_FWU_COMPONENT_ID
	int "PSA FWU component ID to update"
	default 1
	help
	  The PSA Firmware Update component ID that the application
	  operates on.

config SAMPLE_TFM_MCUBOOT_SIGNATURE_TYPE
	string "The signature type used to sign the secure and non-secure firmware images."
	default "EC-P256"
	help
	  The signature type used for TF-M MCUboot.

config SAMPLE_TFM_MCUBOOT_ENCRYPTION
	bool "Image encryption in BL2"
	help
	  Build the swapped application as an encrypted image.

if SAMPLE_TFM_MCUBOOT_ENCRYPTION

choice SAMPLE_TFM_MCUBOOT_ENCRYPTION_KEY_WRAP_SCHEME
	prompt "Image encryption key-wrapping scheme"
	default SAMPLE_TFM_MCUBOOT_ENCRYPTION_RSA_OAEP
	help
	  Selects the algorithm that wraps the per-image AES key.

config SAMPLE_TFM_MCUBOOT_ENCRYPTION_RSA_OAEP
	bool "RSA-OAEP"

config SAMPLE_TFM_MCUBOOT_ENCRYPTION_AES_KW
	bool "AES-KW"

endchoice

config SAMPLE_TFM_MCUBOOT_ENCRYPTION_KEY_LEN
	int "Image encryption AES key length"
	default 128
	help
	  Length in bits of the AES key used to encrypt the image payload.
	  Valid values are 128 and 256.

endif # SAMPLE_TFM_MCUBOOT_ENCRYPTION
```

## sysbuild.conf
```
# SPDX-FileCopyrightText: Copyright The Zephyr Project Contributors
# SPDX-License-Identifier: Apache-2.0

# TF-M provides its own BL2 bootloader, so MCUboot must not be built by
# sysbuild. Some boards default the sysbuild bootloader choice to MCUboot,
# which conflicts with the TF-M build.
SB_CONFIG_BOOTLOADER_NONE=y
```

## prj.conf
```kconfig
CONFIG_BUILD_WITH_TFM=y
CONFIG_TFM_PARTITION_FIRMWARE_UPDATE=y
```

## src/main.c
```c
/*
 * SPDX-FileCopyrightText: Copyright The Zephyr Project Contributors
 * SPDX-License-Identifier: Apache-2.0
 */

#include <zephyr/kernel.h>
#include <zephyr/sys/printk.h>

#include <psa/update.h>

static const uint8_t swapped_ns_firmware[] = {
#include "swapped_app_image.inc"
};

int main(void)
{
	psa_status_t status;
	psa_fwu_component_info_t info;
	size_t written;
	size_t block_size;

	printk("TF-M FWU on %s\n", CONFIG_BOARD);

	printk("Installing new firmware for component %d\n", CONFIG_SAMPLE_TFM_FWU_COMPONENT_ID);

	status = psa_fwu_query(CONFIG_SAMPLE_TFM_FWU_COMPONENT_ID, &info);
	if (status != PSA_SUCCESS) {
		printk("psa_fwu_query failed: %d\n", status);
		return -1;
	}

	if (info.state != PSA_FWU_READY) {
		printk("Component is not in READY state, cannot perform FWU\n");
		return -1;
	}

	printk("Starting FWU\n");
	status = psa_fwu_start(CONFIG_SAMPLE_TFM_FWU_COMPONENT_ID, NULL, 0);
	if (status != PSA_SUCCESS) {
		printk("psa_fwu_start failed: %d\n", status);
		return -1;
	}

	printk("Writing %zu bytes\n", sizeof(swapped_ns_firmware));
	for (written = 0; written < sizeof(swapped_ns_firmware); written += block_size) {
		block_size = MIN(PSA_FWU_MAX_WRITE_SIZE, sizeof(swapped_ns_firmware) - written);

		status = psa_fwu_write(CONFIG_SAMPLE_TFM_FWU_COMPONENT_ID, written,
				   swapped_ns_firmware + written, block_size);
		if (status != PSA_SUCCESS) {
			printk("psa_fwu_write failed: %d\n", status);
			goto fwu_cancel;
		}
	}

	printk("Finishing FWU\n");
	status = psa_fwu_finish(CONFIG_SAMPLE_TFM_FWU_COMPONENT_ID);
	if (status != PSA_SUCCESS) {
		printk("psa_fwu_finish failed: %d\n", status);
		goto fwu_cancel;
	}

	printk("Installing FWU\n");
	status = psa_fwu_install();
	if (status == PSA_SUCCESS) {
		/*
		 * Not expected when updating the running firmware,
		 * as a reboot should be required to apply the update.
		 */
		printk("FWU installed, no reboot or restart required\n");
	} else if (status == PSA_SUCCESS_REBOOT) {
		printk("FWU installed, reboot required\n");

		printk("Rebooting to apply the new firmware...\n");
		status = psa_fwu_request_reboot();
		if (status != PSA_SUCCESS) {
			printk("psa_fwu_request_reboot failed: %d\n", status);
			goto fwu_cancel;
		}
	} else if (status == PSA_SUCCESS_RESTART) {
		/*
		 * Not expected when updating the running firmware,
		 * as a reboot should be required to apply the update.
		 * How to restart a component is implementation specific.
		 */
		printk("FWU installed, restart required\n");
	} else {
		printk("psa_fwu_install failed: %d\n", status);
		goto fwu_cancel;
	}

	return 0;

fwu_cancel:
	printk("Cancelling FWU\n");

	status = psa_fwu_query(CONFIG_SAMPLE_TFM_FWU_COMPONENT_ID, &info);
	if (status != PSA_SUCCESS) {
		printk("psa_fwu_query failed: %d\n", status);
		return -1;
	}

	if (info.state == PSA_FWU_WRITING || info.state == PSA_FWU_CANDIDATE) {
		status = psa_fwu_cancel(CONFIG_SAMPLE_TFM_FWU_COMPONENT_ID);
		if (status != PSA_SUCCESS) {
			printk("psa_fwu_cancel failed: %d\n", status);
			return -1;
		}

		status = psa_fwu_query(CONFIG_SAMPLE_TFM_FWU_COMPONENT_ID, &info);
		if (status != PSA_SUCCESS) {
			printk("psa_fwu_query failed: %d\n", status);
			return -1;
		}
	}

	if (info.state == PSA_FWU_FAILED) {
		status = psa_fwu_clean(CONFIG_SAMPLE_TFM_FWU_COMPONENT_ID);
		if (status != PSA_SUCCESS) {
			printk("psa_fwu_clean failed: %d\n", status);
			return -1;
		}
	}

	return -1;
}
```
