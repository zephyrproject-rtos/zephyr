## samples/chipyard/tacit/sample.yaml
```yaml
sample:
  description: Hello World sample with HTIF exit
    application
  name: hello world
common:
  tags: introduction
  integration_platforms:
    - native_sim
  harness: console
  harness_config:
    type: one_line
    regex:
      - "Hello World! (.*)"
tests:
  sample.basic.helloworld:
    tags: introduction
```

## samples/chipyard/tiled_eigen/sample.yaml
```yaml
sample:
  description: A simple example demonstrating Eigen linear algebra library
  name: simple eigen 
common:
  tags: introduction
  integration_platforms:
    - qemu_riscv32
  harness: console
  harness_config:
    type: one_line
```

## samples/compression/heatshrink/sample.yaml
```yaml
sample:
  name: heatshrink sample
  description: heatshrink data compression library
common:
  tags:
    - compression
    - heatshrink
  min_ram: 16
  harness: console
  harness_config:
    type: one_line
    regex:
      - "Validation done. (.*)"
tests:
  sample.compression.heatshrink:
    integration_platforms:
      - qemu_riscv64
    tags:
      - compression
      - heatshrink
```

## samples/compression/lz4/sample.yaml
```yaml
sample:
  name: lz4 sample
  description: lz4 data compression library
common:
  tags:
    - compression
    - lz4
  min_ram: 64
  filter: CONFIG_FULL_LIBC_SUPPORTED
  harness: console
  harness_config:
    type: one_line
    regex:
      - "Validation done. (.*)"
  modules:
    - lz4
tests:
  sample.compression.lz4:
    integration_platforms:
      - mps2/an385
      - qemu_riscv64
    tags:
      - compression
      - lz4
```

## samples/coop_synchronization/sample.yaml
```yaml
sample:
  description: A simple application that demonstrates even more basic sanity of the kernel
    compared to samples/synchronization. The main variant is the polled_uart which shouldn't
    go through any interrupt driven context switch in a no-systick scenario.
  name: Coop Synchronization Sample
common:
  harness: console
  harness_config:
    type: multi_line
    regex:
      - "thread_a: Hello World from cpu (\\d+) on (\\w+)! counter = (\\d+)"
      - "thread_b: Hello World from cpu (\\d+) on (\\w+)! counter = -(\\d+)"
tests:
  sample.kernel.coop_synchronization.polled_uart:
    # Platforms below do not implement a polled uart driver therefore they dont build
    platform_exclude:
      - rpi_pico
      - rpi_pico_w
      - adafruit_kb2040
      - m2gl025_miv
      - lpcxpresso51u68
      - lpcxpresso54114_m4
      - lpcxpresso55s06
      - lpcxpresso55s16
      - lpcxpresso55s28
      - lpcxpresso55s36
      - lpcxpresso55s69_cpu0
      - lpcxpresso55s69_ns
      - s32z270dc2_rtu0_r52
      - s32z270dc2_rtu1_r52
      - sparkfun_pro_micro_rp2040
    tags: synchronization
    extra_configs:
      - CONFIG_UART_INTERRUPT_DRIVEN=n
  sample.kernel.coop_synchronization.interrupt_driven_uart:
    tags: synchronization
```

## samples/cpp/cpp_synchronization/sample.yaml
```yaml
sample:
  name: Syncronisation (C++)
common:
  platform_key:
    - arch
  tags: cpp
  toolchain_exclude:
    - xcc
  integration_platforms:
    - qemu_x86
tests:
  sample.cpp.synchronization:
    harness: console
    harness_config:
      type: multi_line
      regex:
        - "Create semaphore (.*)"
        - "main: Hello World!"
        - "coop_thread_entry: Hello World!"
  sample.cpp.synchronization.picolibc:
    filter: CONFIG_PICOLIBC_SUPPORTED
    extra_configs:
      - CONFIG_PICOLIBC=y
    harness: console
    harness_config:
      type: multi_line
      regex:
        - "Create semaphore (.*)"
        - "main: Hello World!"
        - "coop_thread_entry: Hello World!"
```

## samples/cpp/hello_world/sample.yaml
```yaml
sample:
  description: Hello World C++ sample, the simplest C++ Zephyr application
  name: hello cpp world
common:
  tags:
    - introduction
    - cpp
  integration_platforms:
    - qemu_riscv32
  harness: console
  harness_config:
    type: one_line
    regex:
      - "Hello, C\\+\\+ world! (.*)"
tests:
  sample.cpp.helloworld:
    min_ram: 128
    arch_exclude:
      # See #66027
      - xtensa
    platform_exclude:
      # See zephyrproject-rtos/sdk-ng#593
      - qemu_x86
      - intel_ish_5_4_1
      - intel_ish_5_6_0
      - intel_ish_5_8_0
```

## samples/cpp_synchronization/sample.yaml
```yaml
sample:
  name: Syncronisation (C++)
tests:
  sample.cpp_syncronisation:
    tags: cpp
    toolchain_exclude: issm
    arch_exclude: posix
    harness: console
    harness_config:
      type: multi_line
      regex:
        - "Create semaphore (.*)"
        - "main: Hello World!"
        - "coop_thread_entry: Hello World!"
```

## samples/crypto/mbedtls_benchmark/sample.yaml
```yaml
common:
  harness: crypto
  tags: crypto
sample:
  description: mbed TLS benchmark application
  name: mbedTLS Benchmark
tests:
  test:
    platform_whitelist: qemu_x86 frdm_k64f sam_e70_xplained nrf52840_pca10056
```

## samples/data_structures/min-heap/sample.yaml
```yaml
# Copyright (c) 2025 Aerlync Labs Inc.
#
# SPDX-License-Identifier: Apache-2.0

sample:
  description: zephyr min-heap library application
  name: min-heap
tests:
  sample.data_structures.min-heap:
    tags:
      - data_structures
    harness: console
    integration_platforms:
      - native_sim
    harness_config:
      type: multi_line
      ordered: false
      regex:
        - "Top of heap: key=2 value=400"
        - "Found element with key 5 at index 1,removing it..."
```

## samples/debug/gdbstub/sample.yaml
```yaml
#
# Copyright (c) 2020 intel Corporation.
#
# SPDX-License-Identifier: Apache-2.0
#

sample:
  name: gdbstub sample
tests:
  sample.debug.gdbstub:
    build_only: true
    platform_allow: qemu_x86
    tags: debug
```

## samples/display/cfb/boards/native_posix_64.conf
```kconfig
CONFIG_SDL_DISPLAY_DEV_NAME="DISPLAY"
CONFIG_SDL_DISPLAY_X_RES=250
CONFIG_SDL_DISPLAY_Y_RES=120
CONFIG_CHARACTER_FRAMEBUFFER_DISPLAY_DEV_NAME="SDL_DISPLAY"
```

## samples/display/cfb/boards/reel_board.conf
```kconfig
CONFIG_SPI=y
CONFIG_SSD16XX=y
CONFIG_CHARACTER_FRAMEBUFFER_DISPLAY_DEV_NAME="SSD16XX"
```

## samples/display/cfb/sample.yaml
```yaml
common:
  tags: display
sample:
  description: Character framebuffer test
  name: cfb sample
tests:
  sample.display.cfb.ssd1306:
    pre-filter: subsys_dt_compat_enabled("i2c") and dt_label_enabled("arduino_i2c") and not dt_compat_enabled("solomon,ssd16xxfb")
    extra_args: SHIELD=ssd1306_128x64
    tags: shield
    harness: console
    harness_config:
      fixture: shield_ssd1306_128x64
  sample.display.cfb.ssd16xx:
    pre-filter: dt_compat_enabled("solomon,ssd16xxfb")
    harness: display
```

## samples/display/cfb_custom_font/sample.yaml
```yaml
common:
  harness: display
  tags: display
sample:
  description: Custom character framebuffer font example
  name: cfb custom font sample
tests:
  sample.display.cfb_custom_font.ssd16xx:
    platform_whitelist: reel_board
  sample.display.cfb_custom_font.elcdif:
    platform_whitelist: mimxrt1050_evk
```

## samples/display/cfb_shell/sample.yaml
```yaml
common:
  harness: display
  tags: display
sample:
  description: Character framebuffer shell test
  name: cfb shell sample
tests:
  sample.display.cfb_shell.ssd1306:
    platform_whitelist: frdm_k64f
    extra_args: SHIELD=ssd1306_128x32
    tags: shield
  sample.display.cfb_shell.ssd16xx:
    platform_whitelist: reel_board
```

## samples/display/eadogs164/sample.yaml
```yaml
#
# Copyright (c) 2020
#
# SPDX-License-Identifier: Apache-2.0
#

sample:
  name: EADOGS164 Display Sample
tests:
  sample.display.eadogs164:
    build_only: true
    platform_allow: disco_l475_iot1
    tags: display
```

## samples/display/grove_display/sample.yaml
```yaml
sample:
  name: Grove LCD Sample
tests:
  sample.display.grove_display:
    tags: drivers
    harness: grove
    pre-filter: subsys_dt_compat_enabled("i2c")
```

## samples/display/ili9340/boards/nrf52_pca10040.conf
```kconfig
CONFIG_SPI_1=y
CONFIG_SPI_1_NRF_SPI=y

CONFIG_ILI9340_RGB565=y
CONFIG_ILI9340_LCD_SEEED_TFTV2=y
```

## samples/display/ili9340/sample.yaml
```yaml
sample:
  description: TBD
  name: TBD
tests:
  sample.display.ili9340:
    build_only: true
    platform_whitelist: nucleo_l476rg nrf52_pca10040
    tags: display
  sample.display.adafruit_2_8_tft_touch_v2:
    platform_whitelist: nrf52840_pca10056
    extra_args: SHIELD=adafruit_2_8_tft_touch_v2
    tags: shield
```
