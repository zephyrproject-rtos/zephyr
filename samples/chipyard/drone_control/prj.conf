## CMakeLists.txt
```
# SPDX-License-Identifier: Apache-2.0

cmake_minimum_required(VERSION 3.20.0)

find_package(Zephyr REQUIRED HINTS $ENV{ZEPHYR_BASE})
project(drone_control)

# Configure the build options required for admm/matlib (the same ones you would pass to TinyMPC)
set(USE_CPU OFF CACHE BOOL "Enable RISCV Scalar support")
set(USE_RVV ON CACHE BOOL "Enable RVV support")
set(MEASURE_CYCLES OFF CACHE BOOL "Automatically Append Cycle Logging")
# set(USE_RVV ON CACHE BOOL "Enable RVV support")
set(USE_TYPE "float32" CACHE STRING "Set floating point type for TinyMPC dependencies")

# Build the matlib dependency.
# set(MATLIB_EXTERNAL_BUILD ON CACHE BOOL "Skip matlib toolchain setup when using Zephyr")
include(${CMAKE_CURRENT_SOURCE_DIR}/tinympc/external/matlib/matlib_header.cmake)
# add_subdirectory(${CMAKE_CURRENT_SOURCE_DIR}/tinympc/external/matlib)

# Build the admm library.
# Add the admm subdirectory to build its target (usually called "admm").
# add_subdirectory(${CMAKE_CURRENT_SOURCE_DIR}/tinympc/external/admm)

# Your main application sources.
target_sources(app PRIVATE src/main_mt.cpp ${CMAKE_CURRENT_SOURCE_DIR}/tinympc/external/admm/src/admm_rvv.cpp)

# Include directories for admm and matlib headers.
target_include_directories(app PRIVATE
  ${CMAKE_CURRENT_SOURCE_DIR}/tinympc/external/admm/include
  ${CMAKE_CURRENT_SOURCE_DIR}/tinympc/external/matlib/include
  ${CMAKE_CURRENT_SOURCE_DIR}/tinympc/examples 
)

# Link the admm library into your Zephyr app.
target_link_libraries(app PRIVATE)
```

## prj.conf
```kconfig
#CONFIG_CPP=y
## CONFIG_REQUIRES_FULL_LIBCPP=n
#CONFIG_MAIN_STACK_SIZE=327680

#CONFIG_SMP=n
#CONFIG_POSIX_API=y
#CONFIG_MULTITHREADING=y

#CONFIG_STD_C17=y
#CONFIG_STD_CPP20=y 
#CONFIG_GLIBCXX_LIBCPP=y
#CONFIG_PICOLIBC=y
#CONFIG_COMMON_LIBC_MALLOC=y
#CONFIG_RISCV_ISA_EXT_V=y

# CONFIG_UART_CONSOLE=y
# CONFIG_BOOT_BANNER=n


CONFIG_CPP=y
# CONFIG_REQUIRES_FULL_LIBCPP=n
CONFIG_MAIN_STACK_SIZE=327680

CONFIG_SMP=y
CONFIG_POSIX_API=y
CONFIG_MULTITHREADING=y
CONFIG_MP_MAX_NUM_CPUS=4

CONFIG_SCHED_CPU_MASK=y
CONFIG_SCHED_CPU_MASK_PIN_ONLY=y
CONFIG_SCHED_DUMB=y

CONFIG_STD_C17=y
CONFIG_STD_CPP20=y 
CONFIG_GLIBCXX_LIBCPP=y
CONFIG_PICOLIBC=y
CONFIG_COMMON_LIBC_MALLOC=y
CONFIG_RISCV_ISA_EXT_V=y
CONFIG_RISCV_VECTOR_MAX_LEN=512

CONFIG_UART_CONSOLE=y
CONFIG_BOOT_BANNER=n
```

## src/main.cpp
```c
/*
 * Copyright (c) 2025, Dima Nikiforov <vnikiforov@berkeley.edu>
 *
 * SPDX-License-Identifier: Apache-2.0
 */

#include <zephyr/sys/reboot.h>
#include <zephyr/drivers/uart.h>
#include <zephyr/kernel.h>
#include <zephyr/device.h>
#include <stdio.h>
#include <stdio.h>
#include <admm.hpp>
//#include "problem_data/quadrotor_50hz_params_constrained.hpp"  // TinyMPC problem data
#include "problem_data/quadrotor_20hz_params.hpp"
#include "glob_opts.hpp"  // Contains NSTATES, NINPUTS, NHORIZON, etc.

#ifdef __cplusplus
extern "C" {
#endif

// Global TinyMPC objects
TinyCache cache;
TinyWorkspace work;
TinySettings settings;
TinySolver solver = {&settings, &cache, &work};

#define BUFFER_SIZE 256
#define NUM_STATE_VARS 12

const struct device *uart0 = DEVICE_DT_GET(DT_NODELABEL(uart0));

void send_str(const char *str) {
    for (size_t i = 0; str[i] != '\0'; i++) {
        uart_poll_out(uart0, str[i]);
    }
}


void recv_str(char *buf, size_t buf_size)
{
    size_t i = 0;
    unsigned char c = 0;

    // Read until newline or buffer full
    while (i < buf_size - 1) {
        if (uart_poll_in(uart0, &c) == 0) {
            if (c == '\r' || c == '\n') {
                break;
            }
            buf[i++] = c;
        } else {
        }
    }

    buf[i] = '\0';
}


void init_all() {
    tiny_init(&solver);

    init_VectorNx(&work.x1);
    init_VectorNx(&work.x2);
    init_VectorNx(&work.x3);
    init_VectorNu(&work.u1);
    init_VectorNu(&work.u2);
}

int main(void)
{
    if (!device_is_ready(uart0)) {
        return -1;
    }

    send_str("Testing drone control via UART\n");

    enable_vector_operations();
    init_all();

    // Local temp vectors
    tiny_VectorNx v1, v2, x0;
    init_VectorNx(&v1);
    init_VectorNx(&v2);
    init_VectorNx(&x0);

    // Set up problem data
    cache.rho = rho_value;
    matsetv(cache.Kinf.data, Kinf_data, cache.Kinf.outer, cache.Kinf.inner);
    transpose(cache.Kinf.data, cache.KinfT.data, NINPUTS, NSTATES);
    matsetv(cache.Pinf.data, Pinf_data, cache.Pinf.outer, cache.Pinf.inner);
    transpose(cache.Pinf.data, cache.PinfT.data, NSTATES, NSTATES);
    matsetv(cache.Quu_inv.data, Quu_inv_data, cache.Quu_inv.outer, cache.Quu_inv.inner);
    matsetv(cache.AmBKt.data, AmBKt_data, cache.AmBKt.outer, cache.AmBKt.inner);
    matsetv(cache.coeff_d2p.data, coeff_d2p_data, cache.coeff_d2p.outer, cache.coeff_d2p.inner);
    matsetv(work.Adyn.data, Adyn_data, work.Adyn.outer, work.Adyn.inner);
    matsetv(work.Bdyn.data, Bdyn_data, work.Bdyn.outer, work.Bdyn.inner);
    transpose(work.Bdyn.data, work.BdynT.data, NSTATES, NINPUTS);
    matsetv(work.Q.data, Q_data, work.Q.outer, work.Q.inner);
    matsetv(work.R.data, R_data, work.R.outer, work.R.inner);
    matset(work.u_min.data, -0.583, work.u_min.outer, work.u_min.inner);
    matset(work.u_max.data, 1 - 0.583, work.u_max.outer, work.u_max.inner);
    matset(work.x_min.data, -5, work.x_min.outer, work.x_min.inner);
    matset(work.x_max.data, 5, work.x_max.outer, work.x_max.inner);

    // Hovering reference
    tiny_VectorNx Xref_origin;
    init_VectorNx(&Xref_origin);
    tinytype Xref_origin_data[NSTATES] = {0, 0, 0, 0, 0, 0, 0, 0, 0, 0, 0, 0};
    matsetv(Xref_origin.data, Xref_origin_data, Xref_origin.outer, Xref_origin.inner);
    for (int j = 0; j < NHORIZON; j++) {
        matsetv(work.Xref.vector[j], Xref_origin_data, 1, NSTATES);
    }

    // Default initial state
    tinytype x0_data[NSTATES] = {
        -0.036, 0.037, 0.225, -0.193,
        -0.192, -0.002, 0.962, -0.409,
        -0.378, 0.075, -0.663, 0.672
    };
    matsetv(x0.data, x0_data, x0.outer, x0.inner);

    char input_buf[BUFFER_SIZE];
    unsigned char c;
    int pos = 0;

    while (1) {
        //send_str("Enter new state (12 floats):\n");
        pos = 0;
        int id;

        recv_str(input_buf, BUFFER_SIZE);

        float parsed[NUM_STATE_VARS];
        int n = sscanf(input_buf,
                       "%d %f %f %f %f %f %f %f %f %f %f %f %f",
                       &id, &parsed[0], &parsed[1], &parsed[2], &parsed[3],
                       &parsed[4], &parsed[5], &parsed[6], &parsed[7],
                       &parsed[8], &parsed[9], &parsed[10], &parsed[11]);

        if (n == NUM_STATE_VARS + 1) {
            matsetv(x0.data, parsed, x0.outer, x0.inner);
        } else {
            send_str("Invalid input. Expected ID + 12 floats.\n");
            continue;
        }

        // Load into work.x
        matsetv(work.x.vector[0], x0.data, 1, NSTATES);
        matset(work.y.data, 0.0, work.y.outer, work.y.inner);
        matset(work.g.data, 0.0, work.g.outer, work.g.inner);

        tiny_solve(&solver);

        // Output control results
        char outbuf[128];
        snprintf(outbuf, sizeof(outbuf),
                 "u = [%0.4f %0.4f %0.4f %0.4f]\n",
                 work.u.vector[0][0], work.u.vector[0][1],
                 work.u.vector[0][2], work.u.vector[0][3]);
        send_str(outbuf);
    }

    return 0;
}

#ifdef __cplusplus
}
#endif
```

## src/main_hover.cpp
```c
/*
 * Copyright (c) 2025, Dima Nikiforov <vnikiforov@berkeley.edu>
 *
 * SPDX-License-Identifier: Apache-2.0
 */


#include <stdio.h>
#include <zephyr/kernel.h>

#include <admm.hpp>
#include <zephyr/sys/reboot.h>
#include "problem_data/quadrotor_50hz_params_unconstrained.hpp"  // TinyMPC problem data
#include "glob_opts.hpp"  // Contains NSTATES, NINPUTS, NHORIZON, etc.

#ifdef __cplusplus
extern "C" {
#endif


// Global TinyMPC objects (they are defined in admm.hpp or related headers)


TinyCache cache;

TinyWorkspace work;
TinySettings settings;

TinySolver solver{&settings, &cache, &work};
/* 
*/



#include <zephyr/kernel.h>
#include <zephyr/device.h>
#include <zephyr/drivers/uart.h>

#include <stdio.h>
#include <string.h>

/*
const struct device *uart0 = DEVICE_DT_GET(DT_NODELABEL(uart0));




void send_str(const struct device *uart, char *str)
{
	int msg_len = strlen(str);

	for (int i = 0; i < msg_len; i++) {
		uart_poll_out(uart, str[i]);
	}

	printk("Device %s sent: \"%s\"\n", uart->name, str);
}*/



int main(void)
{
    printf("Testing drone control on %s\n", CONFIG_BOARD);

    enable_vector_operations();
    tiny_init(&solver);  // Initializes solver, workspace, cache

    printf("Entered MPC simulation main!\n");

    // Temporary vectors for simulation
    tiny_VectorNx v1, v2;
    init_VectorNx(&v1);
    init_VectorNx(&v2);

    // Setup problem data
    cache.rho = rho_value;
    matsetv(cache.Kinf.data, Kinf_data, cache.Kinf.outer, cache.Kinf.inner);
    transpose(cache.Kinf.data, cache.KinfT.data, NINPUTS, NSTATES);
    matsetv(cache.Pinf.data, Pinf_data, cache.Pinf.outer, cache.Pinf.inner);
    transpose(cache.Pinf.data, cache.PinfT.data, NSTATES, NSTATES);
    matsetv(cache.Quu_inv.data, Quu_inv_data, cache.Quu_inv.outer, cache.Quu_inv.inner);
    matsetv(cache.AmBKt.data, AmBKt_data, cache.AmBKt.outer, cache.AmBKt.inner);
    matsetv(cache.coeff_d2p.data, coeff_d2p_data, cache.coeff_d2p.outer, cache.coeff_d2p.inner);
    matsetv(work.Adyn.data, Adyn_data, work.Adyn.outer, work.Adyn.inner);
    matsetv(work.Bdyn.data, Bdyn_data, work.Bdyn.outer, work.Bdyn.inner);
    transpose(work.Bdyn.data, work.BdynT.data, NSTATES, NINPUTS);
    matsetv(work.Q.data, Q_data, work.Q.outer, work.Q.inner);
    matsetv(work.R.data, R_data, work.R.outer, work.R.inner);

    // Valid range for inputs and states
    matset(work.u_min.data, -0.583, work.u_min.outer, work.u_min.inner);
    matset(work.u_max.data, 1 - 0.583, work.u_max.outer, work.u_max.inner);
    matset(work.x_min.data, -5, work.x_min.outer, work.x_min.inner);
    matset(work.x_max.data, 5, work.x_max.outer, work.x_max.inner);

    // Initialize optimization residuals and settings (redundant with tiny_init but safe)
    work.primal_residual_state = 0;
    work.primal_residual_input = 0;
    work.dual_residual_state = 0;
    work.dual_residual_input = 0;
    work.status = 0;
    work.iter = 0;
    settings.abs_pri_tol = 0.001;
    settings.abs_dua_tol = 0.001;
    settings.max_iter = 10;
    settings.check_termination = 1;
    settings.en_input_bound = 1;
    settings.en_state_bound = 1;

    // Setup hovering setpoint (desired state)
    tiny_VectorNx Xref_origin;
    init_VectorNx(&Xref_origin);
    tinytype Xref_origin_data[NSTATES] = {
        0, 0, 0.5, 0, 0, 0, 0, 0, 0, 0, 0, 0
    };
    matsetv(Xref_origin.data, Xref_origin_data, Xref_origin.outer, Xref_origin.inner);
    for (int j = 0; j < NHORIZON; j++) {
        matsetv(work.Xref.vector[j], Xref_origin_data, 1, NSTATES);
    }

    // Setup initial state x0
    tiny_VectorNx x0, x1;
    init_VectorNx(&x0);
    init_VectorNx(&x1);
    tinytype x0_data[NSTATES] = {
        -3.64893626e-02,  3.70428882e-02,  2.25366379e-01, -1.92755080e-01,
        -1.91678221e-01, -2.21354598e-03,  9.62340916e-01, -4.09749891e-01,
        -3.78764621e-01,  7.50158432e-02, -6.63581815e-01,  6.71744046e-01
    };
    matsetv(x0.data, x0_data, x0.outer, x0.inner);
    matset(x1.data, 0, x1.outer, x1.inner);

    // Print CSV header
    printf("Step,TrackingError,x,y,z,phi,theta,psi,dx,dy,dz,dphi,dtheta,dpsi,u1,u2,u3,u4\n");

    for (int k = 0; k < 70; ++k) {
        // 1. Update measurement: copy current state into work.x (column 0)
        matsetv(work.x.vector[0], x0.data, 1, NSTATES);

        // 2. Reset dual variables
        matset(work.y.data, 0.0, work.y.outer, work.y.inner);
        matset(work.g.data, 0.0, work.g.outer, work.g.inner);

        // 3. Solve the MPC problem using ADMM
        tiny_solve(&solver);

        // 4. Simulate forward step: x0 = A*x0 + B*u
#ifdef USE_MATVEC
        matvec(work.Adyn.data, x0.data, v1.data, NSTATES, NSTATES);
        matvec(work.Bdyn.data, work.u.vector[0], v2.data, NSTATES, NINPUTS);
#else
        matmul(x0.data, work.Adyn.data, v1.data, 1, NSTATES, NSTATES);
        matmul(work.u.vector[0], work.Bdyn.data, v2.data, 1, NSTATES, NINPUTS);
#endif
        matadd(v1.data, v2.data, x0.data, 1, NSTATES);

        // 5. Print simulation results
        printf("%d,", k);
        matsub(x0.data, work.Xref.vector[1], v1.data, 1, NSTATES);
        float norm = matnorm(v1.data, 1, NSTATES);
        printf("%0.7f,\n", norm);

        // Optional: print full state/input vectors here if desired
    }

    sys_reboot(SYS_REBOOT_COLD);
    return 0;
}


#ifdef __cplusplus
}
#endif
```

## src/main_mt.cpp
```c
/*
 * Copyright (c) 2025, Dima Nikiforov <vnikiforov@berkeley.edu>
 *
 * SPDX-License-Identifier: Apache-2.0
 */

#include <zephyr/kernel.h>
#include <zephyr/sys/reboot.h>
#include <zephyr/arch/cpu.h>
#include <zephyr/drivers/uart.h>
#include <zephyr/device.h>
#include <stdio.h>
#include <string.h>
#include <admm.hpp>

#include <zephyr/sys/atomic.h>

// #include "problem_data/quadrotor_20hz_params.hpp"
#include "problem_data/quadrotor_50hz_params_constrained.hpp"
#include "glob_opts.hpp"

#define NUM_DRONES 3
#define STACK_SIZE (8192*2)
#define BUFFER_SIZE 256
#define NUM_STATE_VARS 12

#define DEBUG_UART

TinyCache    caches[NUM_DRONES];
TinyWorkspace works[NUM_DRONES];
TinySettings  settings[NUM_DRONES];
TinySolver    solvers[NUM_DRONES];  // Filled during init

K_THREAD_STACK_ARRAY_DEFINE(drone_stacks, NUM_DRONES, STACK_SIZE);
struct k_thread drone_threads[NUM_DRONES];
k_tid_t drone_thread_ids[NUM_DRONES];



struct DroneTask {
    struct k_sem start_sem;
    struct k_sem done_sem;
    float obs[NSTATES];
    float action[NINPUTS];
};




struct k_mutex uart_mutex;

static struct DroneTask drone_tasks[NUM_DRONES];
const struct device *uart0 = DEVICE_DT_GET(DT_NODELABEL(uart0));


void send_str(const char *str) {
    k_mutex_lock(&uart_mutex, K_FOREVER);
    for (size_t i = 0; str[i] != '\0'; i++) {
        uart_poll_out(uart0, str[i]);
    }
    k_mutex_unlock(&uart_mutex);
}

void recv_str(char *buf, size_t buf_size) {
    size_t i = 0;
    unsigned char c = 0;
    while (i < buf_size - 1) {
        if (uart_poll_in(uart0, &c) == 0) {
            if (c == '\r' || c == '\n') break;
            buf[i++] = c;
        }
    }
    buf[i] = '\0';
}

void drone_worker(void *id_ptr, void *, void *) {
    int id = (int)(uintptr_t)id_ptr;

    enable_vector_operations();

    // Use global TinyMPC structs
    TinyCache    *cache   = &caches[id];
    TinyWorkspace *work   = &works[id];
    TinySettings  *setting = &settings[id];
    TinySolver    *solver  = &solvers[id];

    solver->cache = cache;
    solver->work = work;
    solver->settings = setting;

    tiny_init(solver);

    init_VectorNx(&work->x1);
    init_VectorNx(&work->x2);
    init_VectorNx(&work->x3);
    init_VectorNu(&work->u1);
    init_VectorNu(&work->u2);

    // Set up MPC matrices
    cache->rho = rho_value;
    matsetv(cache->Kinf.data, Kinf_data, cache->Kinf.outer, cache->Kinf.inner);
    transpose(cache->Kinf.data, cache->KinfT.data, NINPUTS, NSTATES);
    matsetv(cache->Pinf.data, Pinf_data, cache->Pinf.outer, cache->Pinf.inner);
    transpose(cache->Pinf.data, cache->PinfT.data, NSTATES, NSTATES);
    matsetv(cache->Quu_inv.data, Quu_inv_data, cache->Quu_inv.outer, cache->Quu_inv.inner);
    matsetv(cache->AmBKt.data, AmBKt_data, cache->AmBKt.outer, cache->AmBKt.inner);
    matsetv(cache->coeff_d2p.data, coeff_d2p_data, cache->coeff_d2p.outer, cache->coeff_d2p.inner);

    matsetv(work->Adyn.data, Adyn_data, work->Adyn.outer, work->Adyn.inner);
    matsetv(work->Bdyn.data, Bdyn_data, work->Bdyn.outer, work->Bdyn.inner);
    transpose(work->Bdyn.data, work->BdynT.data, NSTATES, NINPUTS);
    matsetv(work->Q.data, Q_data, work->Q.outer, work->Q.inner);
    matsetv(work->R.data, R_data, work->R.outer, work->R.inner);

    matset(work->u_min.data, -0.583, work->u_min.outer, work->u_min.inner);
    matset(work->u_max.data, 1 - 0.583, work->u_max.outer, work->u_max.inner);
    matset(work->x_min.data, -5, work->x_min.outer, work->x_min.inner);
    matset(work->x_max.data, 5, work->x_max.outer, work->x_max.inner);

    // Xref zero reference
    tinytype Xref_origin[NSTATES] = {0, 0, 0, 0, 0, 0, 0, 0, 0, 0, 0, 0};
    for (int j = 0; j < NHORIZON; j++) {
        matsetv(work->Xref.vector[j], Xref_origin, 1, NSTATES);
    }


    while (1) {
        k_sem_take(&drone_tasks[id].start_sem, K_FOREVER);

        #ifdef DEBUG_UART
        
        char obs_buf[256];
        
        
        snprintf(obs_buf, sizeof(obs_buf),
                 "Obs[%d] = [%d %0.3f %0.3f %0.3f %0.3f %0.3f %0.3f %0.3f %0.3f %0.3f %0.3f %0.3f %0.3f]\n",
                 id,
                 drone_tasks[id].obs[0], drone_tasks[id].obs[1], drone_tasks[id].obs[2],
                 drone_tasks[id].obs[3], drone_tasks[id].obs[4], drone_tasks[id].obs[5],
                 drone_tasks[id].obs[6], drone_tasks[id].obs[7], drone_tasks[id].obs[8],
                 drone_tasks[id].obs[9], drone_tasks[id].obs[10], drone_tasks[id].obs[11]);
        /**/
        /*
        snprintf(obs_buf, sizeof(obs_buf),
                 "Obs[%d] = [%d %0.3f %0.3f %0.3f %0.3f]\n",
                 id,
                 drone_tasks[id].obs[0] , drone_tasks[id].obs[1], drone_tasks[id].obs[2], drone_tasks[id].obs[3]);
        // send_str(obs_buf);
        */
        #endif

        

        matsetv(work->x.vector[0], drone_tasks[id].obs, 1, NSTATES);
        matset(work->y.data, 0.0, work->y.outer, work->y.inner);
        matset(work->g.data, 0.0, work->g.outer, work->g.inner);

        memset(drone_tasks[id].action, 0, sizeof(float) * NINPUTS);

        int status = tiny_solve(solver);


        char outbuf[128];
        snprintf(outbuf, sizeof(outbuf),
                 "u = [%d %0.4f %0.4f %0.4f %0.4f]\n", id,
                  work->u.vector[0][0],  work->u.vector[0][1],
                  work->u.vector[0][2],  work->u.vector[0][3]);
        send_str(outbuf);

    }
}



void spawn_drone_workers() {
    for (int i = 0; i < NUM_DRONES; i++) {
        k_sem_init(&drone_tasks[i].start_sem, 0, 1);
        k_sem_init(&drone_tasks[i].done_sem, 0, 1);

        drone_thread_ids[i] = k_thread_create(&drone_threads[i], drone_stacks[i], STACK_SIZE,
            drone_worker, (void *)(uintptr_t)i, NULL, NULL,
            K_PRIO_PREEMPT(1), 0, K_FOREVER);
        k_thread_cpu_pin(drone_thread_ids[i], (i + 1) % CONFIG_MP_MAX_NUM_CPUS);
    }
    for (int i = 0; i < NUM_DRONES; i++) {
        
        k_thread_start(drone_thread_ids[i]);

    }
}

int main(void) {
    if (!device_is_ready(uart0)) return -1;
    k_mutex_init(&uart_mutex);
    
    spawn_drone_workers();

    send_str("Ready To Receive UART Commands\n");

    char input_buf[BUFFER_SIZE];
    float parsed[NUM_STATE_VARS];
    int id;

    while (1) {
        recv_str(input_buf, BUFFER_SIZE);
        int n = sscanf(input_buf, "%d %f %f %f %f %f %f %f %f %f %f %f %f",
                       &id, &parsed[0], &parsed[1], &parsed[2], &parsed[3],
                       &parsed[4], &parsed[5], &parsed[6], &parsed[7],
                       &parsed[8], &parsed[9], &parsed[10], &parsed[11]);

        if (n != 13 || id >= NUM_DRONES) {
            send_str("Invalid input. Expected ID + 12 floats.\n");
            continue;
        }


        memcpy(drone_tasks[id].obs, parsed, sizeof(parsed));

        __sync_synchronize();
        k_sem_give(&drone_tasks[id].start_sem);




    }

    return 0;
}
```
