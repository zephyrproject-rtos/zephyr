## CMakeLists.txt
```
# SPDX-License-Identifier: Apache-2.0

cmake_minimum_required(VERSION 3.28.0)
find_package(Zephyr REQUIRED HINTS $ENV{ZEPHYR_BASE})
project(bootargs)

target_sources(app PRIVATE src/main.c)
```

## sample.yaml
```
sample:
  name: Bootargs Sample
tests:
  sample.kernel.bootargs.multiboot:
    extra_args: EXTRA_CONF_FILE=prj_multiboot.conf
    platform_allow:
      - qemu_x86
      - qemu_x86_64
    harness: console
    harness_config:
      type: one_line
      regex:
        - "argv\\[0\\] = .*/zephyr(-qemu-locore)?.elf"
  sample.kernel.bootargs.efi:
    extra_args: FILE_SUFFIX=efi
    platform_allow: qemu_x86_64
    harness: console
    harness_config:
      type: one_line
      regex:
        - "argv\\[0\\] = run.efi"
  sample.kernel.bootargs.tokenization:
    extra_configs:
      - CONFIG_BOOTARGS_STRING="appname arg1 'arg2.1 arg2.2' arg3"
    harness: console
    harness_config:
      type: multi_line
      regex:
        - "argv\\[0\\] = appname"
        - "argv\\[1\\] = arg1"
        - "argv\\[2\\] = arg2.1 arg2.2"
        - "argv\\[3\\] = arg3"
```

## prj.conf
```kconfig
CONFIG_BOOTARGS=y
```

## prj_efi.conf
```kconfig
CONFIG_BOOTARGS=y
CONFIG_DYNAMIC_BOOTARGS=y
CONFIG_QEMU_UEFI_BOOT=y
CONFIG_BUILD_OUTPUT_EFI=y
```

## prj_multiboot.conf
```kconfig
CONFIG_DYNAMIC_BOOTARGS=y
CONFIG_MULTIBOOT_INFO=y
CONFIG_X86_MEMMAP=y
```

## prj_static_bootargs.conf
```kconfig
CONFIG_BOOTARGS_STRING="appname This is 'a list of' arguments"
```

## app_efi.overlay
```dts
&dram0 {
	reg = <0x0 0xc800000>;
};
```

## src/main.c
```c
/*
 * Copyright (c) 2024 Antmicro <www.antmicro.com>
 *
 * SPDX-License-Identifier: Apache-2.0
 */

#include <stdio.h>

int main(int argc, char **argv)
{
	for (int i = 0; i < argc; i++) {
		printf("argv[%d] = %s\n", i, argv[i]);
	}
	return 0;
}
```
