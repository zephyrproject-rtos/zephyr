## CMakeLists.txt
```
# SPDX-License-Identifier: Apache-2.0

cmake_minimum_required(VERSION 3.28.0)
find_package(Zephyr REQUIRED HINTS $ENV{ZEPHYR_BASE})
project(servo_motor)

target_sources(app PRIVATE src/main.c)
```

## sample.yaml
```
sample:
  name: Servo Motor using PWM
tests:
  sample.basic.servo_motor:
    tags:
      - drivers
      - pwm
    depends_on: pwm
    harness: motor
    filter: dt_compat_enabled("pwm-servo")
    integration_platforms:
      - bbc_microbit
```

## prj.conf
```kconfig
CONFIG_STDOUT_CONSOLE=y
CONFIG_PRINTK=y
CONFIG_PWM=y
```

## prj_bbc_microbit.conf
```kconfig
CONFIG_STDOUT_CONSOLE=y
CONFIG_PRINTK=y
CONFIG_PWM=y
CONFIG_PWM_NRF5_SW=y
CONFIG_PWM_NRF5_SW_0_CLOCK_PRESCALER=3
```

## bbc_microbit.overlay
```dts
/* SPDX-License-Identifier: Apache-2.0 */


&sw_pwm {
	clock-prescaler = <3>;
};
```

## boards/adafruit_feather_propmaker_rp2040.overlay
```dts
/* SPDX-License-Identifier: Apache-2.0 */
/* Copyright 2026 Jonas Berg */

#include <zephyr/dt-bindings/pwm/pwm.h>

/ {
	servo: servo {
		compatible = "pwm-servo";
		pwms = <&pwm 4 PWM_MSEC(20) PWM_POLARITY_NORMAL>; /* GPIO20 */
		min-pulse = <PWM_USEC(700)>;
		max-pulse = <PWM_USEC(2500)>;
	};
};
```

## boards/arduino_portenta_h7_stm32h747xx_m7.overlay
```dts
/*
 * Copyright (c) 2024 Arduino SA
 *
 * SPDX-License-Identifier: Apache-2.0
 */

&timers3 {
	status = "okay";
	st,prescaler = <100>;

	pwm3: pwm {
		status = "okay";
		pinctrl-0 = <&tim3_ch1_pc6 &tim3_ch2_pc7>;
		pinctrl-names = "default";
	};
};

/ {
    /* The sample expects a node labelled "servo" */
    servo: servo {
        compatible = "pwm-servo";
		pwms = <&pwm3 2 PWM_HZ(333) PWM_POLARITY_NORMAL>;
		label = "PWM Arduino PIN D4";
        min-pulse = <PWM_USEC(500)>;
        max-pulse = <PWM_USEC(2500)>;
    };
};
```

## boards/bbc_microbit.overlay
```dts
/* SPDX-License-Identifier: Apache-2.0 */
/ {
	servo: servo {
		compatible = "pwm-servo";
		pwms = <&sw_pwm 0 PWM_MSEC(20) PWM_POLARITY_NORMAL>;
		min-pulse = <PWM_USEC(700)>;
		max-pulse = <PWM_USEC(2500)>;
	};
};

&sw_pwm {
	clock-prescaler = <3>;
	channel-gpios = <&edge_connector 19 GPIO_ACTIVE_HIGH>;
	status = "okay";
};
```

## boards/esp32c5_devkitc_hpcore.overlay
```dts
/* SPDX-License-Identifier: Apache-2.0 */
/* Copyright 2026 Hayashi Takuma */

#include <zephyr/dt-bindings/pwm/pwm.h>

/ {
	servo: servo {
		compatible = "pwm-servo";
		pwms = <&mcpwm0 0 PWM_MSEC(20) PWM_POLARITY_NORMAL>;
		min-pulse = <PWM_USEC(700)>;
		max-pulse = <PWM_USEC(2500)>;
	};
};

&mcpwm0 {
	pinctrl-0 = <&mcpwm0_default>;
	pinctrl-names = "default";
	prescale = <0>;
	prescale-timer0 = <255>;
	status = "okay";
};
```

## boards/maker_pi_rp2040.overlay
```dts
/* SPDX-License-Identifier: Apache-2.0 */
/* Copyright 2025 Jonas Berg */

#include <zephyr/dt-bindings/pwm/pwm.h>

/ {
	servo: servo {
		compatible = "pwm-servo";
		pwms = <&pwm 12 PWM_MSEC(20) PWM_POLARITY_NORMAL>; /* GP12 */
		/* <&pwm 13 PWM_MSEC(20) PWM_POLARITY_NORMAL> */ /* GP13 */
		/* <&pwm 14 PWM_MSEC(20) PWM_POLARITY_NORMAL> */ /* GP14 */
		/* <&pwm 15 PWM_MSEC(20) PWM_POLARITY_NORMAL> */ /* GP15 */
		min-pulse = <PWM_USEC(700)>;
		max-pulse = <PWM_USEC(2500)>;
	};
};
```

## dts/bindings/pwm-servo.yaml
```yaml
# Copyright (c) 2022 Nordic Semiconductor ASA
# SPDX-License-Identifier: Apache-2.0

description: PWM-driven servo motor.

compatible: "pwm-servo"

include: base.yaml

properties:
  pwms:
    required: true
    type: phandle-array
    description: PWM specifier driving the servo motor.

  min-pulse:
    required: true
    type: int
    description: Minimum pulse width (nanoseconds).

  max-pulse:
    required: true
    type: int
    description: Maximum pulse width (nanoseconds).
```

## src/main.c
```c
/*
 * Copyright (c) 2016 Intel Corporation
 *
 * SPDX-License-Identifier: Apache-2.0
 */

/**
 * @file Sample app to demonstrate PWM-based servomotor control
 */

#include <zephyr/kernel.h>
#include <zephyr/sys/printk.h>
#include <zephyr/device.h>
#include <zephyr/drivers/pwm.h>

static const struct pwm_dt_spec servo = PWM_DT_SPEC_GET(DT_NODELABEL(servo));
static const uint32_t min_pulse = DT_PROP(DT_NODELABEL(servo), min_pulse);
static const uint32_t max_pulse = DT_PROP(DT_NODELABEL(servo), max_pulse);

#define STEP PWM_USEC(100)

enum direction {
	DOWN,
	UP,
};

int main(void)
{
	uint32_t pulse_width = min_pulse;
	enum direction dir = UP;
	int ret;

	printk("Servomotor control\n");

	if (!pwm_is_ready_dt(&servo)) {
		printk("Error: PWM device %s is not ready\n", servo.dev->name);
		return 0;
	}

	while (1) {
		ret = pwm_set_pulse_dt(&servo, pulse_width);
		if (ret < 0) {
			printk("Error %d: failed to set pulse width\n", ret);
			return 0;
		}

		if (dir == DOWN) {
			if (pulse_width <= min_pulse) {
				dir = UP;
				pulse_width = min_pulse;
			} else {
				pulse_width -= STEP;
			}
		} else {
			pulse_width += STEP;

			if (pulse_width >= max_pulse) {
				dir = DOWN;
				pulse_width = max_pulse;
			}
		}

		k_sleep(K_SECONDS(1));
	}
	return 0;
}
```
