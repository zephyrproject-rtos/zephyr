/* SPDX-License-Identifier: Apache-2.0 */
/* Copyright 2026 Jonas Berg */

#include <zephyr/dt-bindings/pwm/pwm.h>

/ {
	servo: servo {
		compatible = "pwm-servo";
		pwms = <&pwm 4 PWM_MSEC(20) PWM_POLARITY_NORMAL>; /* GPIO20 */
		min-pulse = <PWM_USEC(700)>;
		max-pulse = <PWM_USEC(2500)>;
	};
};
