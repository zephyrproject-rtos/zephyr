/* SPDX-License-Identifier: Apache-2.0 */
/* Copyright 2025 Jonas Berg */

#include <zephyr/dt-bindings/pwm/pwm.h>

/ {
	servo: servo {
		compatible = "pwm-servo";
		pwms = <&pwm 14 PWM_MSEC(20) PWM_POLARITY_NORMAL>; /* GP14 */
		/* <&pwm 15 PWM_MSEC(20) PWM_POLARITY_NORMAL> */ /* GP15 */
		/* <&pwm 0 PWM_MSEC(20) PWM_POLARITY_NORMAL> */ /* GP16 */
		/* <&pwm 1 PWM_MSEC(20) PWM_POLARITY_NORMAL> */ /* GP17 */
		min-pulse = <PWM_USEC(700)>;
		max-pulse = <PWM_USEC(2500)>;
	};
};
