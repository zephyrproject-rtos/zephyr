/* SPDX-License-Identifier: Apache-2.0 */
/* Copyright 2025 Jonas Berg */

#include <zephyr/dt-bindings/pwm/pwm.h>

/ {
	servo: servo {
		compatible = "pwm-servo";
		pwms = <&pwm 0 PWM_MSEC(20) PWM_POLARITY_NORMAL>; /* GP0 */
		/* <&pwm 1 PWM_MSEC(20) PWM_POLARITY_NORMAL> */ /* GP1 */
		/* <&pwm 2 PWM_MSEC(20) PWM_POLARITY_NORMAL> */ /* GP2 */
		/* <&pwm 3 PWM_MSEC(20) PWM_POLARITY_NORMAL> */ /* GP3 */
		/* <&pwm 4 PWM_MSEC(20) PWM_POLARITY_NORMAL> */ /* GP4 */
		/* <&pwm 5 PWM_MSEC(20) PWM_POLARITY_NORMAL> */ /* GP5 */
		/* <&pwm 6 PWM_MSEC(20) PWM_POLARITY_NORMAL> */ /* GP6 */
		/* <&pwm 7 PWM_MSEC(20) PWM_POLARITY_NORMAL> */ /* GP7 */
		min-pulse = <PWM_USEC(700)>;
		max-pulse = <PWM_USEC(2500)>;
	};
};
