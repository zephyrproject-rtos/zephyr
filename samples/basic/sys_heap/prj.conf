## CMakeLists.txt
```
# SPDX-License-Identifier: Apache-2.0

cmake_minimum_required(VERSION 3.28.0)

find_package(Zephyr REQUIRED HINTS $ENV{ZEPHYR_BASE})
project(sys_heap)

target_sources(app PRIVATE src/main.c)
```

## sample.yaml
```
sample:
  description: System heap sample showing how to use sys_heap functions
  name: Basic system heap sample
common:
  integration_platforms:
    - native_sim
  harness: console
  harness_config:
    type: multi_line
    ordered: true
    regex:
      - ".*allocated 15.,.*"
      - ".*allocated 1..,.*"
      - ".*allocated 0, free ..., max allocated ..., heap size 256.*"
tests:
  sample.basic.sys_heap:
    tags:
      - heap
      - statistics
      - dynamic_memory
```

## prj.conf
```kconfig
CONFIG_SYS_HEAP_RUNTIME_STATS=y
CONFIG_SYS_HEAP_ARRAY_SIZE=4
```

## src/main.c
```c
/*
 * Copyright (c) 2022 Jeppe Odgaard
 *
 * SPDX-License-Identifier: Apache-2.0
 */

#include <zephyr/kernel.h>
#include <zephyr/sys/sys_heap.h>

#define HEAP_SIZE	256

K_HEAP_DEFINE(my_kernel_heap, HEAP_SIZE);

static char heap_mem[HEAP_SIZE];
static struct sys_heap heap;

static void print_sys_memory_stats(struct sys_heap *);
static void print_static_heaps(void);
static void print_all_heaps(void);

int main(void)
{
	void *p;

	printk("System heap sample\n\n");

	sys_heap_init(&heap, heap_mem, HEAP_SIZE);
	print_sys_memory_stats(&heap);

	p = sys_heap_alloc(&heap, 150);
	print_sys_memory_stats(&heap);

	p = sys_heap_realloc(&heap, p, 100);
	print_sys_memory_stats(&heap);

	sys_heap_free(&heap, p);
	print_sys_memory_stats(&heap);

	/* Allocate from our custom k_heap to make the output
	 * more interesting and prevent compiler optimisations from
	 * discarding it.
	 */
	p = k_heap_alloc(&my_kernel_heap, 10, K_FOREVER);

	print_static_heaps();
	print_all_heaps();

	/* Cleanup memory */
	k_heap_free(&my_kernel_heap, p);
	return 0;
}

static void print_sys_memory_stats(struct sys_heap *hp)
{
	struct sys_memory_stats stats;

	sys_heap_runtime_stats_get(hp, &stats);

	printk("allocated %zu, free %zu, max allocated %zu, heap size %u\n",
		stats.allocated_bytes, stats.free_bytes,
		stats.max_allocated_bytes, HEAP_SIZE);
}

static void print_static_heaps(void)
{
	struct k_heap *ha;
	int n;

	n = k_heap_array_get(&ha);
	printk("%d static heap(s) allocated:\n", n);

	for (int i = 0; i < n; i++) {
		printk("\t%d - address %p ", i, &ha[i]);
		print_sys_memory_stats(&ha[i].heap);
	}
}

static void print_all_heaps(void)
{
	struct sys_heap **ha;
	int n;

	n = sys_heap_array_get(&ha);
	printk("%d heap(s) allocated (including static):\n", n);

	for (int i = 0; i < n; i++) {
		printk("\t%d - address %p ", i, ha[i]);
		print_sys_memory_stats(ha[i]);
	}
}
```
