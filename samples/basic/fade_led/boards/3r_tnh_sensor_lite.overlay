/*
 * Copyright (c) 2026 MASSDRIVER EI (massdriver.space)
 *
 * SPDX-License-Identifier: Apache-2.0
 */

/ {
	leds {
		status = "disabled";
	};
};

&pwmleds {
	status = "okay";
};

&pwm1 {
	pinctrl-0 = <&pwm1_default>;
	pinctrl-names = "default";
	status = "okay";
};
