/*
 * Copyright (c) 2025 MASSDRIVER EI (massdriver.space)
 *
 * SPDX-License-Identifier: Apache-2.0
 */

/ {
	leds {
		status = "disabled";
	};
};

&pwmleds {
	status = "okay";
};

&pwm0 {
	status = "okay";
	pinctrl-0 = <&white_pwm_pinctrl>;
	pinctrl-names = "default";
};
