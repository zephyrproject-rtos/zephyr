/*
 * Copyright (c) 2026 MASSDRIVER EI (massdriver.space)
 *
 * SPDX-License-Identifier: Apache-2.0
 */

/ {
	leds {
		status = "disabled";
	};
};

&pwmleds {
	status = "okay";
};

&pwm0 {
	status = "okay";
	pinctrl-0 = <&blue_pwm_pinctrl>;
	pinctrl-names = "default";
};
