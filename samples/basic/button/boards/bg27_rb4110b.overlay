/*
 * Copyright (c) 2025 Silicon Laboratories Inc.
 *
 * SPDX-License-Identifier: Apache-2.0
 */

/ {
	aliases {
		/* led0 interferes with sw0 since it uses the same pin */
		/delete-property/ led0;
	};
};
