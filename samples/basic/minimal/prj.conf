## CMakeLists.txt
```
# SPDX-License-Identifier: Apache-2.0

cmake_minimum_required(VERSION 3.28.0)

find_package(Zephyr REQUIRED HINTS $ENV{ZEPHYR_BASE})
project(minimal)

target_sources(app PRIVATE src/main.c)
```

## Kconfig
```
# Copyright (c) 2023 Synopsys.
#
# SPDX-License-Identifier: Apache-2.0

config SAMPLE_DO_OUTPUT
	bool "Do print from the main thread which can be checked"

source "Kconfig.zephyr"
```

## sample.yaml
```
sample:
  description: minimal sample, the smallest possible Zephyr application
  name: minimal
common:
  tags: footprint
  harness: console
  harness_config:
    type: one_line
    regex:
      - "Hello World from minimal!"
tests:
  sample.minimal.mt.arm:
    extra_args: CONF_FILE='common.conf;mt.conf;arm.conf'
    build_only: true
    platform_allow:
      - frdm_k64f
      - mps2/an385
      - nrf51dk/nrf51822
      - nucleo_f429zi
      - disco_l475_iot1
      - xg29_rb4412a
    integration_platforms:
      - frdm_k64f
  sample.minimal.mt-no-preempt.arm:
    extra_args: CONF_FILE='common.conf;mt.conf;no-preempt.conf;arm.conf'
    build_only: true
    platform_allow:
      - frdm_k64f
      - mps2/an385
      - nrf51dk/nrf51822
      - nucleo_f429zi
      - disco_l475_iot1
      - xg29_rb4412a
    integration_platforms:
      - frdm_k64f
  sample.minimal.mt-no-preempt-no-timers.arm:
    extra_args: CONF_FILE='common.conf;mt.conf;no-preempt.conf;no-timers.conf;arm.conf'
    build_only: true
    platform_allow:
      - frdm_k64f
      - mps2/an385
      - nrf51dk/nrf51822
      - nucleo_f429zi
      - disco_l475_iot1
      - xg29_rb4412a
    integration_platforms:
      - frdm_k64f
  sample.minimal.no-mt.arm:
    extra_args: CONF_FILE='common.conf;no-mt.conf;arm.conf'
    build_only: true
    platform_allow:
      - frdm_k64f
      - mps2/an385
      - nrf51dk/nrf51822
      - nucleo_f429zi
      - disco_l475_iot1
      - xg29_rb4412a
    integration_platforms:
      - frdm_k64f
  sample.minimal.no-mt-no-timers.arm:
    extra_args: CONF_FILE='common.conf;no-mt.conf;no-timers.conf;arm.conf'
    build_only: true
    platform_allow:
      - frdm_k64f
      - mps2/an385
      - nrf51dk/nrf51822
      - nucleo_f429zi
      - disco_l475_iot1
      - xg29_rb4412a
    integration_platforms:
      - frdm_k64f
  sample.minimal.mt.x86:
    extra_args: CONF_FILE='common.conf;mt.conf;x86.conf'
    build_only: true
    platform_allow: qemu_x86
  sample.minimal.mt-no-preempt.x86:
    extra_args: CONF_FILE='common.conf;mt.conf;no-preempt.conf;x86.conf'
    build_only: true
    platform_allow: qemu_x86
  sample.minimal.mt-no-preempt-no-timers.x86:
    extra_args: CONF_FILE='common.conf;mt.conf;no-preempt.conf;no-timers.conf;x86.conf'
    build_only: true
    platform_allow: qemu_x86
  sample.minimal.no-mt.x86:
    extra_args: CONF_FILE='common.conf;no-mt.conf;x86.conf'
    build_only: true
    platform_allow: qemu_x86
  sample.minimal.no-mt-no-timers.x86:
    extra_args: CONF_FILE='common.conf;no-mt.conf;no-timers.conf;x86.conf'
    build_only: true
    platform_allow: qemu_x86
  sample.minimal.arc.runtime:
    extra_args:
      - CONF_FILE='common-runtime.conf;no-timers.conf'
    arch_allow: arc
    tags:
      - kernel
    integration_platforms:
      - qemu_arc/qemu_arc_em
  sample.minimal.riscv.runtime:
    extra_args:
      - CONF_FILE='common-runtime.conf;no-timers.conf;no-mt.conf;riscv.conf'
    platform_allow: qemu_riscv32
    tags:
      - kernel
    integration_platforms:
      - qemu_riscv32
  sample.minimal.no-mt-no-sw-isr-table.arm:
    extra_args: EXTRA_CONF_FILE='common.conf;no-mt.conf;no-sw-isr-table.conf;arm.conf'
    build_only: true
    platform_allow:
      - nrf54l15dk/nrf54l15/cpuapp
      - nrf54lm20dk/nrf54lm20a/cpuapp
      - nrf7120dk/nrf7120/cpuapp
  sample.minimal.no-mt-no-sw-isr-table.riscv:
    extra_args: CONF_FILE='common.conf;no-mt.conf;no-sw-isr-table.conf;riscv.conf'
    build_only: true
    platform_allow:
      - nrf54l15dk/nrf54l15/cpuflpr
      - nrf54lm20dk/nrf54lm20a/cpuflpr
      - nrf7120dk/nrf7120/cpuflpr
```

## prj.conf
```kconfig
# empty config
```

## arm.conf
```kconfig
CONFIG_ARM_MPU=n

CONFIG_SYS_TIMEOUT_LEGACY_API=n
```

## bluetooth.conf
```kconfig
CONFIG_BT=y
CONFIG_BT_DEBUG_LOG=y
CONFIG_BT_CENTRAL=y
CONFIG_BT_PERIPHERAL=y
```

## common-runtime.conf
```kconfig
# Drivers and peripherals
CONFIG_I2C=n
CONFIG_WATCHDOG=n
CONFIG_GPIO=n
CONFIG_PINCTRL=n
CONFIG_SPI=n
CONFIG_FLASH=n
CONFIG_UART_USE_RUNTIME_CONFIGURE=n
CONFIG_UART_INTERRUPT_DRIVEN=n

# libs
CONFIG_MINIMAL_LIBC=y
CONFIG_CBPRINTF_NANO=y
CONFIG_CBPRINTF_REDUCED_INTEGRAL=y
CONFIG_CBPRINTF_LIBC_SUBSTS=n

# build
CONFIG_FPU=n
CONFIG_SIZE_OPTIMIZATIONS=y

# Boot
CONFIG_BOOT_DELAY=0
CONFIG_SAMPLE_DO_OUTPUT=y
```

## common.conf
```kconfig
# Drivers and peripherals
CONFIG_I2C=n
CONFIG_WATCHDOG=n
CONFIG_GPIO=n
CONFIG_PINCTRL=n
CONFIG_SPI=n
CONFIG_SERIAL=n
CONFIG_FLASH=n

# Power management
CONFIG_PM=n

# Interrupts
CONFIG_DYNAMIC_INTERRUPTS=n
CONFIG_IRQ_OFFLOAD=n

# Memory protection
CONFIG_THREAD_STACK_INFO=n
CONFIG_THREAD_CUSTOM_DATA=n
CONFIG_FPU=n

# Boot
CONFIG_BOOT_BANNER=n
CONFIG_BOOT_DELAY=0

# Console
CONFIG_CONSOLE=n
CONFIG_UART_CONSOLE=n
CONFIG_STDOUT_CONSOLE=n
CONFIG_PRINTK=n
CONFIG_EARLY_CONSOLE=n

# Build
CONFIG_SIZE_OPTIMIZATIONS=y
```

## mec.conf
```kconfig
# Drivers and peripherals
CONFIG_GPIO=n
CONFIG_SPI=n
CONFIG_WATCHDOG=n
CONFIG_FLASH=n
CONFIG_PS2=n
CONFIG_ADC=n
CONFIG_ESPI=n

# power management
CONFIG_PWM=n
CONFIG_SYS_POWER_MANAGEMENT=n
CONFIG_SOC_POWER_MANAGEMENT=n

# Interrupts
CONFIG_DYNAMIC_INTERRUPTS=n
CONFIG_IRQ_OFFLOAD=n

# Memory protection
CONFIG_THREAD_STACK_INFO=n
CONFIG_THREAD_CUSTOM_DATA=n
CONFIG_ARM_MPU=n

# Boot
CONFIG_BOOT_BANNER=n
CONFIG_BOOT_DELAY=0

# Build
CONFIG_SIZE_OPTIMIZATIONS=y

# Multiple thread
CONFIG_MULTITHREADING=n

# Network
CONFIG_NETWORKING=n

# Bluetooth
CONFIG_BT=n

# Random
CONFIG_TEST_RANDOM_GENERATOR=y
```

## mt.conf
```kconfig
CONFIG_MULTITHREADING=y
CONFIG_NUM_COOP_PRIORITIES=16
CONFIG_NUM_METAIRQ_PRIORITIES=0

CONFIG_ERRNO=n
CONFIG_SCHED_SIMPLE=y
CONFIG_WAITQ_SIMPLE=y
```

## src/main.c
```c
/*
 * Copyright (c) 2019 Nordic Semiconductor ASA
 *
 * SPDX-License-Identifier: Apache-2.0
 */

#include <zephyr/kernel.h>

int main(void)
{
#ifdef CONFIG_SAMPLE_DO_OUTPUT
	printk("Hello World from minimal!\n");
#endif

	return 0;
}
```
