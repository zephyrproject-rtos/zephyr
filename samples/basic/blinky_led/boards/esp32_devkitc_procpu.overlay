/*
 * SPDX-License-Identifier: Apache-2.0
 *
 * Copyright (c) 2025 Beechwoods Software, Inc.
 */

#include <zephyr/dt-bindings/led/led.h>

/ {
	aliases {
		led0 = &led_blue;
	};

	leds {
		compatible = "gpio-leds";

		led_blue: led_0 {
			gpios = <&gpio0 2 GPIO_ACTIVE_HIGH>;
		};
	};
};
