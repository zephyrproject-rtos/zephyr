/*
 * SPDX-License-Identifier: Apache-2.0
 *
 * Copyright (c) 2021 Planet Innovation
 */

/ {
	pwmleds {
		compatible = "pwm-leds";
		external_pwm_led: external_pwm_led {
			pwms = <&pwm1 1 0 PWM_POLARITY_NORMAL>;
		};
	};

	aliases {
		pwm-led0 = &external_pwm_led;
	};
};
