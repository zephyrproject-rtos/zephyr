/*
 * SPDX-FileCopyrightText: Copyright 2026 NXP
 *
 * SPDX-License-Identifier: Apache-2.0
 */

#include <zephyr/dt-bindings/pwm/pwm.h>

/ {
	aliases {
		pwm-led0 = &pwm_led0;
	};

	pwmleds {
		compatible = "pwm-leds";

		/* Connect PWM4 (J21-32) to an LED */
		pwm_led0: pwm_led_0 {
			pwms = <&pwm4 0 PWM_MSEC(20)>;
		};
	};
};
