## samples/basic/button_interrupt/sample.yaml
```yaml
sample:
  name: Button interrupt

tests:
  sample.basic.button_interrupt:
    tags:
      - gpio
      - interrupt
    harness: console
    harness_config:
      type: one_line
      regex:
        - "Press SW0 to toggle LED ON/OFF"
    platform_allow:
      - cy8cproto_062_4343w
```

## samples/basic/button_thread/sample.yaml
```yaml
sample:
    description: TBD
    name: TBD
tests:
-   test:
        build_only: true
        platform_whitelist: nucleo_f103rb quark_se_c1000_devboard
        tags: samples
```

## samples/basic/custom_dts_binding/dts/bindings/power-switch.yaml
```yaml
# Copyright (c) 2023 Libre Solar Technologies GmbH
# SPDX-License-Identifier: Apache-2.0

description: GPIO pin to switch a power output on or off

compatible: "power-switch"

properties:
  gpios:
    type: phandle-array
    required: true
    description: |
      The GPIO connected to the gate driver for the MOSFET.
```

## samples/basic/custom_dts_binding/sample.yaml
```yaml
sample:
  name: GPIO with custom devicetree binding
tests:
  sample.basic.custom_dts_binding:
    tags:
      - gpio
      - devicetree
    platform_allow: nucleo_l073rz/stm32l073xx
    integration_platforms:
      - nucleo_l073rz/stm32l073xx
    depends_on: gpio
    harness: console
    harness_config:
      type: multi_line
      regex:
        - "Initializing pin with inactive level."
        - "Waiting one second."
        - "Setting pin to active level."
```

## samples/basic/disco/sample.yaml
```yaml
sample:
  name: Disco Lights
tests:
  sample.disco:
    filter: dt_compat_enabled_with_alias("gpio-leds", "led0") and
            dt_compat_enabled_with_alias("gpio-leds", "led1")
    tags: LED gpio
    depends_on: gpio
    harness: led
```

## samples/basic/fade_led/sample.yaml
```yaml
sample:
  name: Fade LED
tests:
  sample.basic.fade_led:
    tags:
      - drivers
      - pwm
    depends_on: pwm
    harness: led
    filter: dt_alias_exists("pwm-led0") and dt_compat_enabled("pwm-leds")
    integration_platforms:
      - nrf51dk_nrf51422
```

## samples/basic/gpio_key/sample.yaml
```yaml
sample:
  name: GPIO Key Sample
tests:
  sample.basic.key:
    tags: key gpio
    filter: dt_enabled_alias_with_parent_compat("sw0", "gpio-keys")
    depends_on: gpio
    harness: key
```

## samples/basic/greetings/sample.yaml
```yaml
sample:
  description: Greetings sample, a console alternative to blinky.
  name: greetings
common:
  tags: introduction
  integration_platforms:
    - native_posix
  harness: console
  harness_config:
    type: one_line
    regex:
      - "Zephyr says 'Hi!'"
    repeat: 2
tests:
  sample.basic.greetings:
    tags: introduction
```

## samples/basic/hash_map/sample.yaml
```yaml
# Copyright (c) 2022 Meta
#
# SPDX-License-Identifier: Apache-2.0

sample:
  description: System Hashmap sample
  name: System Hashmap sample

common:
  min_ram: 24
  integration_platforms:
    - qemu_x86_64
    - mps2_an385
  harness: console
  harness_config:
    type: one_line
    regex:
      - .*success
  platform_exclude:
    - esp32_net


tests:
  # Minimal Libc
  libraries.hash_map.minimal.separate_chaining.djb2:
    extra_configs:
      - CONFIG_MINIMAL_LIBC=y
      - CONFIG_COMMON_LIBC_MALLOC_ARENA_SIZE=8192
      - CONFIG_SYS_HASH_MAP_CHOICE_SC=y
      - CONFIG_SYS_HASH_FUNC32_CHOICE_DJB2=y
  libraries.hash_map.minimal.open_addressing.djb2:
    extra_configs:
      - CONFIG_MINIMAL_LIBC=y
      - CONFIG_COMMON_LIBC_MALLOC_ARENA_SIZE=8192
      - CONFIG_SYS_HASH_MAP_CHOICE_OA_LP=y
      - CONFIG_SYS_HASH_FUNC32_CHOICE_DJB2=y
  # Newlib
  libraries.hash_map.newlib.separate_chaining.djb2:
    filter: TOOLCHAIN_HAS_NEWLIB == 1
    extra_configs:
      - CONFIG_NEWLIB_LIBC=y
      - CONFIG_NEWLIB_LIBC_MIN_REQUIRED_HEAP_SIZE=8192
      - CONFIG_SYS_HASH_MAP_CHOICE_SC=y
      - CONFIG_SYS_HASH_FUNC32_CHOICE_DJB2=y
  libraries.hash_map.newlib.open_addressing.djb2:
    filter: TOOLCHAIN_HAS_NEWLIB == 1
    extra_configs:
      - CONFIG_NEWLIB_LIBC=y
      - CONFIG_NEWLIB_LIBC_MIN_REQUIRED_HEAP_SIZE=8192
      - CONFIG_SYS_HASH_MAP_CHOICE_OA_LP=y
      - CONFIG_SYS_HASH_FUNC32_CHOICE_DJB2=y
  libraries.hash_map.newlib.cxx_unordered_map.djb2:
    filter: TOOLCHAIN_HAS_NEWLIB == 1
    extra_configs:
      - CONFIG_NEWLIB_LIBC=y
      - CONFIG_NEWLIB_LIBC_MIN_REQUIRED_HEAP_SIZE=8192
      - CONFIG_SYS_HASH_MAP_CHOICE_CXX=y
      - CONFIG_SYS_HASH_FUNC32_CHOICE_DJB2=y
      - CONFIG_MAIN_STACK_SIZE=2048
  # PicoLibc
  libraries.hash_map.picolibc.separate_chaining.djb2:
    extra_configs:
      - CONFIG_PICOLIBC=y
      - CONFIG_COMMON_LIBC_MALLOC_ARENA_SIZE=8192
      - CONFIG_SYS_HASH_MAP_CHOICE_SC=y
      - CONFIG_SYS_HASH_FUNC32_CHOICE_DJB2=y
  libraries.hash_map.picolibc.open_addressing.djb2:
    extra_configs:
      - CONFIG_PICOLIBC=y
      - CONFIG_COMMON_LIBC_MALLOC_ARENA_SIZE=8192
      - CONFIG_SYS_HASH_MAP_CHOICE_OA_LP=y
      - CONFIG_SYS_HASH_FUNC32_CHOICE_DJB2=y
```

## samples/basic/minimal/Kconfig
```kconfig
# Copyright (c) 2023 Synopsys.
#
# SPDX-License-Identifier: Apache-2.0

config SAMPLE_DO_OUTPUT
	bool "Do print from the main thread which can be checked"

source "Kconfig.zephyr"
```

## samples/basic/minimal/sample.yaml
```yaml
sample:
  description: minimal sample, the smallest possible Zephyr application
  name: minimal
common:
  tags: footprint
  depends_on:
    - minimal
  harness: console
  harness_config:
    type: one_line
    regex:
      - "Hello World from minimal!"
tests:
  sample.minimal.mt:
    arch_allow:
      - arm
      - x86
    extra_args:
      - CONF_FILE='common.conf;mt.conf;arm.conf'
      - arch:arm:EXTRA_CONF_FILE=arm.conf
      - arch:x86:EXTRA_CONF_FILE=x86.conf
    build_only: true
    integration_platforms:
      - frdm_k64f
      - mps2/an385
      - nrf51dk/nrf51822
      - nucleo_f429zi
      - disco_l475_iot1
      - qemu_x86
  sample.minimal.mt-no-preempt:
    arch_allow:
      - arm
      - x86
    extra_args:
      - CONF_FILE='common.conf;mt.conf;no-preempt.conf'
      - arch:arm:EXTRA_CONF_FILE=arm.conf
      - arch:x86:EXTRA_CONF_FILE=x86.conf
    build_only: true
    integration_platforms:
      - frdm_k64f
      - mps2/an385
      - nrf51dk/nrf51822
      - nucleo_f429zi
      - disco_l475_iot1
      - qemu_x86
  sample.minimal.mt-no-preempt-no-timers:
    arch_allow:
      - arm
      - x86
    extra_args:
      - CONF_FILE='common.conf;mt.conf;no-preempt.conf;no-timers.conf'
      - arch:arm:EXTRA_CONF_FILE=arm.conf
      - arch:x86:EXTRA_CONF_FILE=x86.conf
    build_only: true
    integration_platforms:
      - frdm_k64f
      - mps2/an385
      - nrf51dk/nrf51822
      - nucleo_f429zi
      - disco_l475_iot1
      - qemu_x86
  sample.minimal.no-mt:
    arch_allow:
      - arm
      - x86
    extra_args:
      - CONF_FILE='common.conf;no-mt.conf'
      - arch:arm:EXTRA_CONF_FILE=arm.conf
      - arch:x86:EXTRA_CONF_FILE=x86.conf
    build_only: true
    integration_platforms:
      - frdm_k64f
      - mps2/an385
      - nrf51dk/nrf51822
      - nucleo_f429zi
      - disco_l475_iot1
      - qemu_x86
  sample.minimal.no-mt-no-timers:
    arch_allow:
      - arm
      - x86
    extra_args:
      - CONF_FILE='common.conf;no-mt.conf;no-timers.conf'
      - arch:arm:EXTRA_CONF_FILE=arm.conf
      - arch:x86:EXTRA_CONF_FILE=x86.conf
    build_only: true
    integration_platforms:
      - frdm_k64f
      - mps2/an385
      - nrf51dk/nrf51822
      - nucleo_f429zi
      - disco_l475_iot1
      - qemu_x86
  sample.minimal.arc.runtime:
    extra_args:
      - CONF_FILE='common-runtime.conf;no-timers.conf'
    arch_allow: arc
    tags:
      - kernel
    integration_platforms:
      - qemu_arc/qemu_arc_em
  sample.minimal.riscv.runtime:
    extra_args:
      - CONF_FILE='common-runtime.conf;no-timers.conf;no-mt.conf;riscv.conf'
    arch_allow: riscv
    tags:
      - kernel
    integration_platforms:
      - qemu_riscv32
```

## samples/basic/multitarget_hello_world/boards/nrf5340dk_nrf5340_cpuapp.conf
```kconfig
# Copyright (c) 2024 Nordic Semiconductor ASA
# SPDX-License-Identifier: Apache-2.0

CONFIG_BOARD_ENABLE_CPUNET=y
```

## samples/basic/multitarget_hello_world/sample.yaml
```yaml
sample:
  name: Multitarget Hello World
  description: |
    Hello World application that builds for multiple targets. Both images print
    the board target they were run on.

common:
  build_only: true
  sysbuild: true

tests:
  sample.basic.multitarget_hello_world.nrf5340dk_cpuapp_cpunet:
    platform_allow:
      - nrf5340dk/nrf5340/cpuapp
    integration_platforms:
      - nrf5340dk/nrf5340/cpuapp
    extra_args:
      SB_CONF_FILE=sysbuild/nrf5340dk_nrf5340_cpunet.conf

  sample.basic.multitarget_hello_world.nrf54h20dk_cpuapp_cpurad:
    platform_allow:
      - nrf54h20dk/nrf54h20/cpuapp
    integration_platforms:
      - nrf54h20dk/nrf54h20/cpuapp
    extra_args:
      SB_CONF_FILE=sysbuild/nrf54h20dk_nrf54h20_cpurad.conf

  sample.basic.multitarget_hello_world.nrf54h20dk_cpuapp_cpuppr:
    platform_allow:
      - nrf54h20dk/nrf54h20/cpuapp
    integration_platforms:
      - nrf54h20dk/nrf54h20/cpuapp
    extra_args:
      SB_CONF_FILE=sysbuild/nrf54h20dk_nrf54h20_cpuppr.conf
      multitarget_hello_world_SNIPPET=nordic-ppr

  sample.basic.multitarget_hello_world.nrf54h20dk_cpuapp_cpuppr_xip:
    platform_allow:
      - nrf54h20dk/nrf54h20/cpuapp
    integration_platforms:
      - nrf54h20dk/nrf54h20/cpuapp
    extra_args:
      SB_CONF_FILE=sysbuild/nrf54h20dk_nrf54h20_cpuppr_xip.conf
      multitarget_hello_world_SNIPPET=nordic-ppr-xip
```

## samples/basic/rgb_gradient/sample.yaml
```yaml
sample:
  name: RGB LED Gradient
tests:
  sample.basic.rgb_gradient:
    filter: dt_alias_exists("red-pwm-led") and
            dt_alias_exists("green-pwm-led") and
            dt_alias_exists("blue-pwm-led")
    tags: drivers pwm
    depends_on: pwm
    harness: led
```

## samples/basic/rgb_led/sample.yaml
```yaml
sample:
  name: RGB LED
tests:
  sample.basic.rgb_led:
    filter: dt_alias_exists("red-pwm-led") and
            dt_alias_exists("green-pwm-led") and
            dt_alias_exists("blue-pwm-led")
    tags: drivers pwm
    depends_on: pwm
    harness: led
```

## samples/basic/servo_motor/dts/bindings/pwm-servo.yaml
```yaml
# Copyright (c) 2022 Nordic Semiconductor ASA
# SPDX-License-Identifier: Apache-2.0

description: PWM-driven servo motor.

compatible: "pwm-servo"

include: base.yaml

properties:
    pwms:
      required: true
      type: phandle-array
      description: PWM specifier driving the servo motor.

    min-pulse:
      required: true
      type: int
      description: Minimum pulse width (nanoseconds).

    max-pulse:
      required: true
      type: int
      description: Maximum pulse width (nanoseconds).
```

## samples/basic/servo_motor/sample.yaml
```yaml
sample:
  name: Servo Motor using PWM
tests:
  sample.basic.servo_motor:
    tags:
      - drivers
      - pwm
    depends_on: pwm
    harness: motor
    filter: dt_compat_enabled("pwm-servo")
    integration_platforms:
      - bbc_microbit
```

## samples/basic/sys_heap/sample.yaml
```yaml
sample:
  description: System heap sample showing how to use sys_heap functions
  name: Basic system heap sample
common:
  integration_platforms:
    - native_sim
  harness: console
  harness_config:
    type: multi_line
    ordered: true
    regex:
      - ".*allocated 15.,.*"
      - ".*allocated 10.,.*"
      - ".*allocated 0, free ..., max allocated ..., heap size 256.*"
tests:
  sample.basic.sys_heap:
    tags:
      - heap
      - statistics
      - dynamic_memory
```

## samples/basic/threads/sample.yaml
```yaml
sample:
  description: A basic demo to showcase multi-threading using K_THREAD_DEFINE
  name: Basic Thread Demo
tests:
  sample.basic.threads:
    tags:
      - kernel
      - threads
      - gpio
    filter: dt_enabled_alias_with_parent_compat("led0", "gpio-leds") and
            dt_enabled_alias_with_parent_compat("led1", "gpio-leds")
    integration_platforms:
      - nrf52833dk/nrf52820
    depends_on: gpio
    harness: console
    harness_config:
      type: multi_line
      ordered: false
      regex:
        - "Toggled led0; counter=(.*)"
        - "Toggled led1; counter=(.*)"
```

## samples/basic/userspace/shared_mem/sample.yaml
```yaml
sample:
  description: userspace memory domain protection
    example application
  name: protected memory
  platforms: all
common:
    tags: samples
    harness: console
    harness_config:
      type: one_line
      regex:
        - "MSG"
tests:
  kernel.memory_protection.userspace:
    filter: CONFIG_ARCH_HAS_USERSPACE
    tags: userspace samples
```

## samples/benchmarks/coremark/Kconfig
```kconfig
#
# Copyright (c) 2025 Ambiq Micro Inc. <www.ambiq.com>
#
# SPDX-License-Identifier: Apache-2.0
#

menu "Zephyr Kernel"
	source "Kconfig.zephyr"
endmenu

menu "CoreMark sample"

config APP_MODE_FLASH_AND_RUN
	bool "Run CoreMark benchmark on start up"
	help
	  If enabled, CoreMark will start execution immediately after CPU start up.
	  Otherwise, it will wait button to be pressed.

endmenu
```

## samples/benchmarks/coremark/Kconfig.sysbuild
```kconfig
#
# Copyright (c) 2025 Ambiq Micro Inc. <www.ambiq.com>
#
# SPDX-License-Identifier: Apache-2.0
#

source "share/sysbuild/Kconfig"

config IMAGE_2_BOARD
	string "Second additional board name to build sample for"

config IMAGE_3_BOARD
	string "Third additional board name to build sample for"
```

## samples/benchmarks/coremark/boards/apollo510_evb.conf
```kconfig
CONFIG_APP_MODE_FLASH_AND_RUN=y
CONFIG_LOG_MODE_IMMEDIATE=y

CONFIG_SYS_CLOCK_HW_CYCLES_PER_SEC=900
CONFIG_SYS_CLOCK_TICKS_PER_SEC=28

CONFIG_SYS_HEAP_AUTO=n
CONFIG_COMMON_LIBC_MALLOC=n
```

## samples/benchmarks/coremark/sample.yaml
```yaml
sample:
  name: CoreMark Benchmark
  description: CoreMark sample for the CPU performance evaluation.
               Sample runs the CoreMark benchmark that measures the CPU efficiency
               performing  different algorithms like state machine, crc calculation,
               matrix manipulation and list processing (find and sort).
tests:
  sample.benchmark.coremark:
    platform_allow: apollo510_evb
    integration_platforms:
      - apollo510_evb
    harness: console
    harness_config:
      type: multi_line
      ordered: true
      regex:
        - "Coremark started"
        - "Correct operation validated"
        - "Coremark finished"

  sample.benchmark.coremark.sysbuild:
    platform_allow: nrf52840dk/nrf52840
    extra_args: --sysbuild
    integration_platforms:
      - nrf52840dk/nrf52840
```
