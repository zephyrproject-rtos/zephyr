## prj.conf
```kconfig
# Let stack canaries use non-random number generator.
# This option is NOT to be used in production code.
CONFIG_RING_BUFFER=y
CONFIG_KERNEL_EVENT_LOGGER=y
CONFIG_NANO_TIMEOUTS=y
CONFIG_KERNEL_EVENT_LOGGER_BUFFER_SIZE=16
CONFIG_KERNEL_EVENT_LOGGER_CONTEXT_SWITCH=y
CONFIG_KERNEL_EVENT_LOGGER_INTERRUPT=y
CONFIG_KERNEL_EVENT_LOGGER_SLEEP=y
CONFIG_IDLE_STACK_SIZE=512
CONFIG_LEGACY_KERNEL=y
CONFIG_BLUETOOTH=n
```

## src/kernel_event_collector_sample.c
```c
#include "../../microkernel/src/kernel_event_collector_sample.c"
```

## src/phil.h
```c
#include "../../../philosophers/microkernel/src/phil.h"
```
