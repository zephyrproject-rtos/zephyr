## samples/wifi/connect/sample.yaml
```yaml
sample:
  description: Wi-Fi STA auto connect demo
  name: connect
tests:
  test:
    harness: wifi
    platform_whitelist: 96b_ivy5661
    tags: wifi
```

## samples/wifi/repeater/sample.yaml
```yaml
sample:
  description: Wi-Fi Repeater demo
  name: repeater
tests:
  test:
    harness: wifi
    platform_whitelist: 96b_ivy5661
    tags: wifi
```

## samples/wifi/rtt/sample.yaml
```yaml
sample:
  description: Wi-Fi STA RTT range demo
  name: rtt
tests:
  test:
    harness: wifi
    platform_whitelist: 96b_ivy5661
    tags: wifi
```

## samples/zervice/Kconfig
```kconfig
# Copyright (c) 2024 Intel Corporation
# SPDX-License-Identifier: Apache-2.0

config ZERVICE_SECOND_AFTER
	string
	default "EARLY;first"

config ZERVICE_SECOND_BEFORE
	string "'second' service should run before"
	default "APPLICATION"

config ZERVICE_THIRD_AFTER
	string
	default "APPLICATION;delta"

config ZERVICE_THIRD_BEFORE
	string
	default "fourth"

source "Kconfig.zephyr"
```

## samples/zervice/sample.yaml
```yaml
sample:
  description: Zervice sample
  name: zervice
tests:
  sample.basic.zervice:
    platform_allow:
      - frdm_k64f
```

## samples/zio/fxos8700/sample.yaml
```yaml
sample:
  name: FXOS8700 ZIO Sample
tests:
  sample.zio.synth:
    harness: console
    tags: zio
    depends_on: zio zio_fxo8700
```

## samples/zio/synth/sample.yaml
```yaml
sample:
  name: Synth ZIO sample
tests:
  sample.zio.synth:
    harness: console
    tags: zio
    depends_on: zio synth
```

## samples/zscilib/mtx_mult/sample.yaml
```yaml
sample:
  description: Demonstrates matrix multiplication using zscilib.
  name: zscilib matrix multiply
tests:
  sample.mtx_mult:
    tags: zscilib
    platform_allow: mps2_an521 mps3_an547
    harness: console
    harness_config:
      type: multi_line
      regex:
        - "14.000000 17.000000 20.000000 23.000000"
        - "35.000000 44.000000 53.000000 62.000000"
        - "56.000000 71.000000 86.000000 101.000000"
        - "7.000000 9.000000 11.000000 13.000000"
```

## scorpio/sample.yaml
```yaml
sample:
  name: Scorpio Console
tests:
  sample.shell.scorpio_console:
    filter: ( CONFIG_SERIAL and CONFIG_UART_SHELL_ON_DEV_NAME )
    tags: shell
    harness: keyboard
    min_ram: 40
```

## scripts/ci/Kconfig.board.v2
```kconfig
# Kconfig top-level ci for compliance testing Kconfig tree for boards / SoC v2 scheme.
#
# Copyright (c) 2022 Nordic Semiconductor ASA
#
# SPDX-License-Identifier: Apache-2.0

mainmenu "Zephyr board / SoC v2 Configuration"

config BOARD_REVISION
	def_string "$(BOARD_REVISION)"

source "boards/Kconfig.v2"
source "soc/Kconfig.v2"
```

## scripts/tests/sanitycheck/test_data/testcases/samples/test_app/sample.yaml
```yaml
sample:
  name: External Library
tests:
  sample.app_dev.external_lib:
    tags: external
    harness: console
    harness_config:
      type: multi_line
      regex:
        - "Hello World!"
        - "mylib says: Hello World!"
      fixture: fixture_i2c_hts221
```

## scripts/tests/sanitycheck/test_data/testcases/tests/test_kernel/fifo/test_fifo_api/testcase.yaml
```yaml
tests:
  kernel.fifo:
    tags: kernel
  kernel.fifo.poll:
    extra_args: CONF_FILE="prj_poll.conf"
    tags: kernel
```

## scripts/tests/twister/test_data/boards/1_level/2_level/board.yml
```yaml
boards:

  - name: demo_board_1
    full_name: Demo Board 1
    vendor: zephyr
    socs:
      - name: unit_testing
  - name: demo_board_2
    full_name: Demo Board 2
    vendor: zephyr
    socs:
      - name: unit_testing
  - name: demo_board_3
    full_name: Demo Board 3
    vendor: zephyr
    socs:
      - name: unit_testing
```

## scripts/tests/twister_blackbox/test_data/boards/others/dummy_board/board.yml
```yaml
board:
  name: dummy
  full_name: dummy
  vendor: others
  socs:
  - name: unit_testing
```

## scripts/tests/twister_blackbox/test_data/tests/seed_native_posix/dummy/Kconfig
```kconfig
# SPDX-License-Identifier: Apache-2.0
# Copyright (c) 2024 Intel Corporation

config FAKE_ENTROPY_NATIVE_POSIX
	default y

source "Kconfig.zephyr"
```

## scripts/tests/twister_blackbox/test_data/tests/seed_native_sim/dummy/Kconfig
```kconfig
# SPDX-License-Identifier: Apache-2.0
# Copyright (c) 2024 Intel Corporation

config FAKE_ENTROPY_NATIVE_SIM
	default y

source "Kconfig.zephyr"
```

## service/Kconfig
```kconfig
# Kconfig - Service configuration options
#
# Copyright (c) 2017 Intel Corporation
#
# SPDX-License-Identifier: Apache-2.0
#

menu "Service Configuration"

source "service/ping/Kconfig"

endmenu
```

## service/ping/Kconfig
```kconfig
#
# Copyright (c) 2017 Intel Corporation
#
# SPDX-License-Identifier: Apache-2.0
#

menu "Ping Server"

config PING_SERVER
	bool "Ping Server"
	default n
	help
	Provides a ping service running on a TCP or UDP port. When the service
	is sent ping it responds with pong.

menu "Ping Server Settings"
	visible if PING_SERVER

config PING_SERVER_RESPONSE
	string "Send this in response to a ping"
	default "pong"

config PING_SERVER_PORT
	int "Port to host on"
	range 0 65535
	default 34861

choice
	prompt "Protocol to listen on"
	default PING_SERVER_UDP

config PING_SERVER_UDP
	bool "UDP"
	help
	Listen for UDP pings

config PING_SERVER_TCP
	bool "TCP"
	help
	Listen for TCP pings

endchoice

endmenu

endmenu
```

## share/sysbuild/Kconfig
```kconfig
# Copyright (c) 2021-2023 Nordic Semiconductor
#
# SPDX-License-Identifier: Apache-2.0

config BOARD
	string
	default "$(BOARD)"
	help
	  This option holds the name of the board and is used to locate the files
	  related to the board in the source tree (under boards/).
	  The Board is the first location where we search for a linker.ld file,
	  if not found we look for the linker file in
	  soc/<arch>/<family>/<series>

config BOARD_REVISION
	def_string "$(BOARD_REVISION)"
	help
	  If the BOARD has a revision field set, this is the revision.
	  Otherwise, it is the empty string. For example, if BOARD is
	  "plank@foo", this option will be "foo". If BOARD is "plank",
	  this option will be the empty string.

config BOARD_DEPRECATED_RELEASE
	string
	help
	  This hidden option is set in the board configuration and indicates
	  the Zephyr release that the board configuration will be removed.
	  When set, any build for that board will generate a clearly visible
	  deprecation warning.

source "boards/Kconfig.v2"
source "soc/Kconfig.v2"

comment "Sysbuild image configuration"

osource "$(KCONFIG_BOARD_DIR)/Kconfig.sysbuild"
osource "$(KCONFIG_BINARY_DIR)/soc/Kconfig.sysbuild"

menu "Modules"

source "modules/Kconfig.sysbuild"

endmenu

config EXPERIMENTAL
	bool
	help
	  Symbol that must be selected by a feature if it is considered to be
	  at an experimental implementation stage.

config WARN_EXPERIMENTAL
	bool
	prompt "Warn on experimental usage"
	help
	  Print a warning when the Kconfig tree is parsed if any experimental
	  features are enabled.

config DEPRECATED
	bool
	help
	  Symbol that must be selected by a feature or module if it is
	  considered to be deprecated.

config WARN_DEPRECATED
	bool
	default y
	prompt "Warn on deprecated usage"
	help
	  Print a warning when the Kconfig tree is parsed if any deprecated
	  features are enabled.

config NOT_SECURE
	bool
	help
	  Symbol to be selected by a feature to indicate that feature is
	  not secure.

rsource "images/Kconfig"

menu "Build options"

rsource "build/Kconfig"

endmenu
```

## share/sysbuild/Kconfig.image.template
```kconfig
# Copyright (c) 2023 Nordic Semiconductor
#
# SPDX-License-Identifier: Apache-2.0

# This is a Kconfig @template@ file used for passing sysbuild controlled Kconfig
# settings from sysbuild to images.

config SYSBUILD_CONTROLLED
	bool
	default y
	help
	  Setting that can be used to indicate this setting is controlled by
	  sysbuild when sysbuild is used as high level build system.

config SYSBUILD_BOARD
	string
	default "@BOARD@"
	help
	  High-level board defined in sysbuild.

if BOARD = SYSBUILD_BOARD

config BOOTLOADER_MCUBOOT
	default y if "@SB_CONFIG_BOOTLOADER_MCUBOOT@" && !MCUBOOT

if BOOTLOADER_MCUBOOT

config MCUBOOT_SIGNATURE_KEY_FILE
	default "@SB_CONFIG_BOOT_SIGNATURE_KEY_FILE@"

config MCUBOOT_GENERATE_UNSIGNED_IMAGE
	default y if "@SB_CONFIG_SIGNATURE_TYPE@" = "NONE"

endif

endif

orsource "Kconfig.sysbuild.*.image"
```
