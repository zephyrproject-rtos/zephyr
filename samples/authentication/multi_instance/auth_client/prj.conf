## CMakeLists.txt
```
# SPDX-License-Identifier: Apache-2.0

cmake_minimum_required(VERSION 3.13.1)
include($ENV{ZEPHYR_BASE}/cmake/app/boilerplate.cmake NO_POLICY_SCOPE)
project(periph_auth)

target_include_directories(app PUBLIC ${CMAKE_SOURCE_DIR})


target_sources(app PRIVATE
  src/main.c
)
```

## sample.yaml
```
sample:
  description: Auth Multi Instance Client sample app
  name: Auth Client Multi Instance
tests:
  sample.auth_client_multi:
    build_only: true
    harness: bluetooth
    platform_allow: nrf52840dk_nrf52840
    tags: bluetooth authentication
```

## prj.conf
```kconfig
CONFIG_BT=y
CONFIG_BT_DEBUG_LOG=y
CONFIG_BT_SMP=y
CONFIG_BT_SIGNING=y
CONFIG_BT_PERIPHERAL=n
CONFIG_BT_DIS=y
CONFIG_BT_ATT_PREPARE_COUNT=5
CONFIG_BT_DEVICE_NAME="Zephyr Central Auth"
CONFIG_BT_DEVICE_APPEARANCE=833
CONFIG_BT_DEVICE_NAME_DYNAMIC=y
CONFIG_BT_DEVICE_NAME_MAX=65
CONFIG_BT_RX_BUF_LEN=1600
CONFIG_BT_GATT_CLIENT=y
CONFIG_BT_CENTRAL=y
CONFIG_BT_MAX_PAIRED=2
CONFIG_BT_MAX_CONN=2


# Increase stack due to settings API usage
CONFIG_SYSTEM_WORKQUEUE_STACK_SIZE=2048
CONFIG_MAIN_STACK_SIZE=4096

# logging
CONFIG_LOG=y
CONFIG_USE_SEGGER_RTT=y
CONFIG_LOG_BACKEND_RTT=y
CONFIG_LOG_BACKEND_UART=n
CONFIG_LOG_PRINTK=y


CONFIG_AUTH_LIB=y
# Enable Bluetooth and serial transports
CONFIG_SERIAL_XPORT=y
CONFIG_BT_XPORT=y

# Using both DTLS and Challenge-Response authentication methods
# in different instances.
CONFIG_AUTH_DTLS=y
CONFIG_AUTH_CHALLENGE_RESPONSE=y

# two authentication instance
CONFIG_NUM_AUTH_INSTANCES=2

CONFIG_TINYCRYPT=y
CONFIG_TINYCRYPT_SHA256=y
CONFIG_LOG=y
CONFIG_AUTH_LOG_LEVEL=0
CONFIG_AUTH_CHALLENGE_RESPONSE=y

# Config vars for Challenge-Response
CONFIG_TINYCRYPT=y
CONFIG_TINYCRYPT_SHA256=y
CONFIG_UART_INTERRUPT_DRIVEN=y

# The SOC must have a hardware based random number generator.
CONFIG_ENTROPY_GENERATOR=y
CONFIG_ENTROPY_DEVICE_RANDOM_GENERATOR=y

# Mbed config vars
CONFIG_MBEDTLS=y
CONFIG_MBEDTLS_BUILTIN=y
CONFIG_MBEDTLS_CFG_FILE="config-tls-generic.h"
CONFIG_MBEDTLS_TLS_VERSION_1_2=y
CONFIG_MBEDTLS_DTLS=y
CONFIG_MBEDTLS_ENTROPY_ENABLED=y

# Supported key exchange modes
CONFIG_MBEDTLS_KEY_EXCHANGE_ECDHE_ECDSA_ENABLED=y
CONFIG_MBEDTLS_KEY_EXCHANGE_ECDH_ECDSA_ENABLED=y

# Supported elliptic curves
CONFIG_MBEDTLS_ECP_DP_SECP256R1_ENABLED=y

# Supported cipher modes
CONFIG_MBEDTLS_CIPHER_AES_ENABLED=y
CONFIG_MBEDTLS_CIPHER_GCM_ENABLED=y
CONFIG_MBEDTLS_CIPHER_MODE_CBC_ENABLED=y


# Supported message authentication methods
CONFIG_MBEDTLS_MAC_SHA256_ENABLED=y
CONFIG_MBEDTLS_MAC_CMAC_ENABLED=y


# Other configurations
CONFIG_MBEDTLS_PEM_CERTIFICATE_FORMAT=y
CONFIG_MBEDTLS_SSL_MAX_CONTENT_LEN=1500
CONFIG_MBEDTLS_DEBUG=y
CONFIG_MBEDTLS_DEBUG_LEVEL=0
CONFIG_MBEDTLS_ENABLE_HEAP=y
CONFIG_MBEDTLS_HEAP_SIZE=65535
CONFIG_APP_LINK_WITH_MBEDTLS=y
```

## src/main.c
```c
/*
 * Copyright (c) 2021 Golden Bits Software, Inc.
 * main.c - Application main entry point
 *
 * SPDX-License-Identifier: Apache-2.0
 */


#include <zephyr/types.h>
#include <stddef.h>
#include <string.h>
#include <errno.h>
#include <sys/printk.h>
#include <sys/byteorder.h>
#include <zephyr.h>
#include <device.h>
#include <drivers/gpio.h>
#include <drivers/uart.h>

#include <bluetooth/bluetooth.h>
#include <bluetooth/hci.h>
#include <bluetooth/conn.h>
#include <bluetooth/uuid.h>
#include <bluetooth/gatt.h>

#include <auth/auth_lib.h>
#include <logging/log.h>
#include <logging/log_ctrl.h>

#include <auth/auth_lib.h>


#include "../../../certs/auth_certs.h"


LOG_MODULE_REGISTER(central_auth, CONFIG_AUTH_LOG_LEVEL);


/**
 * Declare UUIDs used for the Authentication service and characteristics
 * see auth_xport.h
 */

static struct bt_uuid_128 auth_service_uuid = AUTH_SERVICE_UUID;

static struct bt_uuid_128 auth_client_char = AUTH_SVC_CLIENT_CHAR_UUID;

static struct bt_uuid_128 auth_server_char = AUTH_SVC_SERVER_CHAR;


#define AUTH_DTLS_INST          AUTH_INST_1_ID
#define AUTH_CHALLENGE_INST     AUTH_INST_2_ID

/* The Root and Intermediate Certs in a single CA chain.
 * plus the server cert. All in PEM format.
 */
static const uint8_t auth_cert_ca_chain[] = AUTH_ROOTCA_CERT_PEM AUTH_INTERMEDIATE_CERT_PEM;
static const uint8_t auth_dev_client_cert[] = AUTH_CLIENT_CERT_PEM;
static const uint8_t auth_client_privatekey[] = AUTH_CLIENT_PRIVATE_KEY_PEM;

static struct auth_optional_param dtls_certs_param = {
	.param_id = AUTH_DTLS_PARAM,
	.param_body = {
		.dtls_certs = {
			.server_ca_chain_pem = {
				.cert = auth_cert_ca_chain,
				.cert_size = sizeof(auth_cert_ca_chain),
			},

			.device_cert_pem = {
				.cert = auth_dev_client_cert,
				.cert_size = sizeof(auth_dev_client_cert),
				.priv_key = auth_client_privatekey,
				.priv_key_size = sizeof(auth_client_privatekey)
			}
		}
	}
};


#define NEW_SHARED_KEY_LEN          (32u)

/* Use a different key than default */
static uint8_t chal_resp_sharedkey[NEW_SHARED_KEY_LEN] = {
	0x21, 0x8e, 0x37, 0x42, 0x1e, 0xe1, 0x2a, 0x22,
	0x7c, 0x4b, 0x3f, 0x3f, 0x07, 0x5e, 0x8a, 0xd8,
	0x24, 0xdf, 0xca, 0xf4, 0x04, 0xd0, 0x3e, 0x22,
	0x61, 0x9f, 0x24, 0xa3, 0xc7, 0xf6, 0x5d, 0x66
};

static struct auth_optional_param chal_resp_param = {
	.param_id = AUTH_CHALRESP_PARAM,
	.param_body = {
		.chal_resp = {
			.shared_key = chal_resp_sharedkey,
		},
	}
};


static struct bt_conn *default_conn;
static struct bt_gatt_discover_params discover_params;
static struct bt_gatt_subscribe_params subscribe_params;



/**
 * Authentication connect struct
 */
static struct authenticate_conn auth_conn_bt;
static struct authenticate_conn auth_conn_serial;



/* Auth service, client descriptor, server descriptor */
#define AUTH_SVC_GATT_COUNT             (4u)

#define AUTH_SVC_INDEX                  (0u)
#define AUTH_SVC_CLIENT_CHAR_INDEX      (1u)
#define AUTH_SVC_CLIENT_CCC_INDEX       (2u)
#define AUTH_SVC_SERVER_CHAR_INDEX      (3u)

/**
 * Used to store Authentication GATT service and characteristics.
 */
struct auth_svc_gatt {
	const struct bt_uuid *uuid;
	const struct bt_gatt_attr *attr;
	uint16_t handle;
	uint16_t value_handle;
	uint8_t permissions; /* Bitfields from: BT_GATT_PERM_NONE, .., in gatt.h */
	const uint32_t gatt_disc_type;
};


static uint32_t auth_desc_index;

/* Table content should match indexes above */
static struct auth_svc_gatt auth_svc_gatt_tbl[AUTH_SVC_GATT_COUNT] = {
	{ (const struct bt_uuid *)&auth_service_uuid, NULL, 0, 0, BT_GATT_PERM_NONE,
		BT_GATT_DISCOVER_PRIMARY },        /* AUTH_SVC_INDEX */
	{ (const struct bt_uuid *)&auth_client_char,  NULL, 0, 0, BT_GATT_PERM_NONE,
		BT_GATT_DISCOVER_CHARACTERISTIC }, /* AUTH_SVC_CLIENT_CHAR_INDEX */
	{ BT_UUID_GATT_CCC,                           NULL, 0, 0, BT_GATT_PERM_NONE,
		BT_GATT_DISCOVER_DESCRIPTOR },     /* AUTH_SVC_CLIENT_CCC_INDEX CCC  */
	{ (const struct bt_uuid *)&auth_server_char,  NULL, 0, 0, BT_GATT_PERM_NONE,
		BT_GATT_DISCOVER_CHARACTERISTIC }  /* AUTH_SVC_SERVER_CHAR_INDEX */
};

static const struct device *uart_dev;

static struct uart_config uart_cfg = {
	.baudrate = 115200,
	.parity = UART_CFG_PARITY_NONE,
	.stop_bits = UART_CFG_STOP_BITS_1,
	.data_bits = UART_CFG_DATA_BITS_8,
	.flow_ctrl = UART_CFG_FLOW_CTRL_NONE,
};



/**
 * Params used to change the connection MTU length.
 */
struct bt_gatt_exchange_params mtu_parms;

void mtu_change_cb(struct bt_conn *conn, uint8_t err, struct bt_gatt_exchange_params *params)
{
	if (err) {
		LOG_ERR("Failed to set MTU, err: %d", err);
	} else {
		LOG_DBG("Successfully set MTU to: %d", bt_gatt_get_mtu(conn));
	}
}

/**
 * Start DTLS and Challenge-Response auth methods.
 *
 * @return 0 on success, else negative error value
 */
static int start_authentication(void)
{
	int err = auth_lib_start(&auth_conn_bt);

	if (err) {
		LOG_ERR("Failed to start DTLS auth method, err: %d", err);
		return err;
	}

	err = auth_lib_start(&auth_conn_serial);

	if (err) {
		LOG_ERR("Failed to start Challenge-Response auth method, err: %d", err);
		return err;
	}

	return 0;
}

/**
 * Characteristic discovery function
 *
 *
 * @param conn    Bluetooth connection.
 * @param attr    Discovered attribute.  NOTE: This pointer will go out fo scope
 *                do not save pointer for future use.
 * @param params  Discover params.
 *
 * @return BT_GATT_ITER_STOP
 */
static uint8_t discover_func(struct bt_conn *conn,
			     const struct bt_gatt_attr *attr,
			     struct bt_gatt_discover_params *params)
{
	int err;
	char uuid_str[50];

	if (!attr) {
		LOG_INF("Discover complete, NULL attribute.");
		(void)memset(params, 0, sizeof(*params));
		return BT_GATT_ITER_STOP;
	}


	/* debug output */
	LOG_DBG("====auth_desc_index is: %d=====", auth_desc_index);
	LOG_DBG("[ATTRIBUTE] handle 0x%x", attr->handle);
	LOG_DBG("[ATTRIBUTE] value handle 0x%x", bt_gatt_attr_value_handle(attr));

	/* let's get string */
	bt_uuid_to_str(attr->uuid, uuid_str, sizeof(uuid_str));
	LOG_DBG("Attribute UUID: %s", log_strdup(uuid_str));

	/* print attribute UUID */
	bt_uuid_to_str(discover_params.uuid, uuid_str, sizeof(uuid_str));
	LOG_DBG("Discovery UUID: %s", log_strdup(uuid_str));


	/**
	 * Verify the correct UUID was found
	 */
	if (bt_uuid_cmp(discover_params.uuid, auth_svc_gatt_tbl[auth_desc_index].uuid)) {

		/* Failed, not the UUID we're expecting */
		LOG_ERR("Error Unknown UUID.");
		return BT_GATT_ITER_STOP;
	}

	/* save off GATT info */
	auth_svc_gatt_tbl[auth_desc_index].attr = NULL; /* attr var not used for the Central */
	auth_svc_gatt_tbl[auth_desc_index].handle = attr->handle;
	auth_svc_gatt_tbl[auth_desc_index].value_handle = bt_gatt_attr_value_handle(attr);
	auth_svc_gatt_tbl[auth_desc_index].permissions = attr->perm;

	auth_desc_index++;

	/* Are all of the characteristics discovered? */
	if (auth_desc_index >= AUTH_SVC_GATT_COUNT) {

		/* we're done */
		LOG_INF("Discover complete");

		/* save off the server attribute handle */

		/* setup the subscribe params
		 * Value handle for the Client characteristic for indication of
		 * peripheral data.
		 */
		subscribe_params.notify = auth_xp_bt_central_notify;
		subscribe_params.value = BT_GATT_CCC_NOTIFY;
		subscribe_params.value_handle =
			auth_svc_gatt_tbl[AUTH_SVC_CLIENT_CHAR_INDEX].value_handle;

		/* Handle for the CCC descriptor itself */
		subscribe_params.ccc_handle =
			auth_svc_gatt_tbl[AUTH_SVC_CLIENT_CCC_INDEX].handle;

		err = bt_gatt_subscribe(conn, &subscribe_params);
		if (err && err != -EALREADY) {
			LOG_ERR("Subscribe failed (err %d)", err);
		}

		/* Get the server BT characteristic, the central sends data
		 * to this characteristic
		 */
		uint16_t server_char_handle =
			auth_svc_gatt_tbl[AUTH_SVC_SERVER_CHAR_INDEX].value_handle;

		/* setup the BT transport params */
		struct auth_xp_bt_params xport_params = {
			.conn = conn, .is_central = true,
			.server_char_hdl = server_char_handle };

		err = auth_xport_init(&auth_conn_bt.xport_hdl,
				      auth_conn_bt.instance,
				      AUTH_XP_TYPE_BLUETOOTH, &xport_params);

		if (err) {
			LOG_ERR("Failed to initialize Bluetooth transport, err: %d", err);
			return BT_GATT_ITER_STOP;
		}

		/* Start DTLS and Challenge-Response auth process */
		err = start_authentication();

		if (err == 0) {
			LOG_INF("Started auth services.");
		}

		return BT_GATT_ITER_STOP;
	}

	/* set up the next discovery params */
	discover_params.uuid = auth_svc_gatt_tbl[auth_desc_index].uuid,
	discover_params.start_handle = attr->handle + 1;
	discover_params.type = auth_svc_gatt_tbl[auth_desc_index].gatt_disc_type;


	/* Start discovery */
	err = bt_gatt_discover(conn, &discover_params);
	if (err) {
		LOG_ERR("Discover failed (err %d)", err);
	}


	return BT_GATT_ITER_STOP;
}

/**
 * Connected to the peripheral device
 *
 * @param conn       The Bluetooth connection.
 * @param conn_err   Connection error, 0 == no error
 */
static void connected(struct bt_conn *conn, uint8_t conn_err)
{
	char addr[BT_ADDR_LE_STR_LEN];
	int err;

	bt_addr_le_to_str(bt_conn_get_dst(conn), addr, sizeof(addr));

	if (conn_err) {
		LOG_ERR("Failed to connect to %s (%u)", log_strdup(addr), conn_err);
		return;
	}

	LOG_INF("Connected: %s", log_strdup(addr));

	if (conn == default_conn) {

		/* set the max MTU, only for GATT interface */
		mtu_parms.func = mtu_change_cb;
		bt_gatt_exchange_mtu(conn, &mtu_parms);

		/* reset gatt discovery index */
		auth_desc_index = 0;

		discover_params.uuid = auth_svc_gatt_tbl[auth_desc_index].uuid;
		discover_params.func = discover_func;
		discover_params.start_handle = 0x0001;
		discover_params.end_handle = 0xffff;
		discover_params.type = auth_svc_gatt_tbl[auth_desc_index].gatt_disc_type;

		/**
		 * Discover characteristics for the service
		 */
		err = bt_gatt_discover(default_conn, &discover_params);
		if (err) {
			LOG_ERR("Discover failed(err %d)", err);
			return;
		}
	}
}

/**
 * Parse through the BLE adv data, looking for our service
 *
 * @param data       Bluetooth data
 * @param user_data  User data.
 *
 * @return true on success, else false
 */
static bool bt_adv_data_found(struct bt_data *data, void *user_data)
{
	bt_addr_le_t *addr = user_data;
	int err;
	struct bt_uuid_128 auth_uuid;

	LOG_DBG("[AD]: %u data_len %u", data->type, data->data_len);

	if (data->type == BT_DATA_UUID128_ALL) {

		if (data->data_len != BT_UUID_SIZE_128) {
			LOG_WRN("AD malformed");
			return false;
		}

		/* build full UUID to check */
		auth_uuid.uuid.type = BT_UUID_TYPE_128;
		memcpy(auth_uuid.val, data->data, BT_UUID_SIZE_128);


		/**
		 * Is this the service we're looking for? If not continue
		 * else stop the scan and connect to the device.
		 */
		if (bt_uuid_cmp((const struct bt_uuid *)&auth_uuid,
				(const struct bt_uuid *)&auth_service_uuid)) {
			return true;
		}

		/* stop scanning, we've found the service */
		err = bt_le_scan_stop();
		if (err) {
			LOG_ERR("Stop LE scan failed (err %d)", err);
			return false;
		}

		/**
		 * @brief  Connect to the device
		 */
		struct bt_conn_le_create_param param = BT_CONN_LE_CREATE_PARAM_INIT(
			BT_CONN_LE_OPT_NONE,
			BT_GAP_SCAN_FAST_INTERVAL,
			BT_GAP_SCAN_FAST_INTERVAL);

		if (bt_conn_le_create(addr, &param, BT_LE_CONN_PARAM_DEFAULT,
				      &default_conn)) {
			LOG_ERR("Failed to create BLE connection to peripheral.");
		}

		return false;
	}

	return true;
}

/**
 * Found a device when scanning.
 *
 * @param addr  BT address
 * @param rssi  Signal strength
 * @param type  Device type
 * @param ad    Simple buffer.
 */
static void device_found(const bt_addr_le_t *addr, int8_t rssi, uint8_t type,
			 struct net_buf_simple *ad)
{
	char dev[BT_ADDR_LE_STR_LEN];

	bt_addr_le_to_str(addr, dev, sizeof(dev));
	LOG_DBG("[DEVICE]: %s, AD evt type %u, AD data len %u, RSSI %i",
		log_strdup(dev), type, ad->len, rssi);

	/* We're only interested in connectable events */
	if (type == BT_HCI_ADV_IND || type == BT_HCI_ADV_DIRECT_IND) {
		bt_data_parse(ad, bt_adv_data_found, (void *)addr);
	}
}

/**
 * BT disconnect callback.
 *
 * @param conn    The Bluetooth connection.
 * @param reason  Disconnect reason.
 */
static void disconnected(struct bt_conn *conn, uint8_t reason)
{
	char addr[BT_ADDR_LE_STR_LEN];

	bt_addr_le_to_str(bt_conn_get_dst(conn), addr, sizeof(addr));

	LOG_INF("Disconnected: %s (reason 0x%02x)", log_strdup(addr), reason);

	if (default_conn != conn) {
		return;
	}

	/* de init transport */
	/* Send disconnect event to BT transport. */
	struct auth_xport_evt conn_evt = { .event = XP_EVT_DISCONNECT };

	auth_xport_event(auth_conn_bt.xport_hdl, &conn_evt);

	/* Deinit lower transport */
	auth_xport_deinit(auth_conn_bt.xport_hdl);
	auth_conn_bt.xport_hdl = NULL;

	bt_conn_unref(default_conn);
	default_conn = NULL;
}

/**
 * (dis)Connection callbacks
 */
static struct bt_conn_cb conn_callbacks = {
	.connected = connected,
	.disconnected = disconnected,
};

/**
 * Configures the UART
 *
 * @return 0 on success, else negative error code.
 */
static int config_uart(void)
{
	struct auth_xp_serial_params xp_params;

	uart_dev = device_get_binding(DT_LABEL(DT_NODELABEL(uart0)));

	int err = uart_configure(uart_dev, &uart_cfg);

	if (err) {
		LOG_ERR("Failed to configure UART, err: %d", err);
		return err;
	}

	/* If successful,then init lower transport layer. */
	xp_params.uart_dev = uart_dev;

	err = auth_xport_init(&auth_conn_serial.xport_hdl, auth_conn_serial.instance,
			      AUTH_XP_TYPE_SERIAL, &xp_params);

	if (err) {
		LOG_ERR("Failed to initialize authentication transport, error: %d", err);
	}

	return err;
}


/**
 * Authentication status callback.
 *
 * @param auth_conn  Authentication connection.
 * @param instance   Instance ID.
 * @param status     Auth status.
 * @param context    Optional context.
 */
static void auth_status(struct authenticate_conn *auth_conn,
			enum auth_instance_id instance,
			enum auth_status status, void *context)
{
	/* display status */
	if (instance == AUTH_DTLS_INST) {
		printk("Auth instance DTLS (%d) status: %s\n", instance,
		       auth_lib_getstatus_str(status));

		if (status == AUTH_STATUS_IN_PROCESS) {
			printk("     DTLS may take 30-60 seconds.\n");
		}
	}

	if (instance == AUTH_CHALLENGE_INST) {
		printk("Auth instance Challenge-Response (%d) status: %s\n",
		       instance, auth_lib_getstatus_str(status));
	}

}

/**
 * Process log messages.
 */
static void process_log_msgs(void)
{
	while (log_process(false)) {
		; /* intentionally empty statement */
	}
}

/**
 * Idle process for app.
 */
static void idle_function(void)
{
	/* Just spin while the BT modules handle the connection. */
	while (true) {

		process_log_msgs();

		/* Let the handshake thread run */
		k_yield();
	}
}


/**
 *  main entry point.
 */
void main(void)
{
	int err = 0;

	log_init();


	printk("Starting multi auth client.\n");

	/* Instance 1 uses DTLS auth method over Bluetooth. */
	err = auth_lib_init(&auth_conn_bt, AUTH_DTLS_INST, auth_status, NULL,
			    &dtls_certs_param,
			    AUTH_CONN_CLIENT | AUTH_CONN_DTLS_AUTH_METHOD);

	if (err) {
		LOG_ERR("Failed to init DTLS authentication service, err: %d.", err);
		idle_function(); /* does not return */
	}

	/* Instance 2 uses Challenge-Response auth method over Serial transport. */
	err = auth_lib_init(&auth_conn_serial, AUTH_CHALLENGE_INST, auth_status,
			    NULL, &chal_resp_param,
			    AUTH_CONN_CLIENT | AUTH_CONN_CHALLENGE_AUTH_METHOD);

	if (err) {
		LOG_ERR("Failed to init Challenge-Response authentication service, err: %d.", err);
		idle_function(); /* does not return */
	}


	/* Configure the UART for serial transport. */
	err = config_uart();

	if (err) {
		LOG_ERR("Failed to configure the UART, err: %d.", err);
		idle_function(); /* does not return */
	}

	/**
	 * @brief Enable the Bluetooth module.  Passing NULL to bt_enable
	 * will block while the BLE stack is initialized.
	 * Enable bluetooth module
	 */
	err = bt_enable(NULL);
	if (err) {
		LOG_ERR("Failed to enable the bluetooth module, err: %d", err);
		idle_function(); /* does not return */
	}

	/* Register connect/disconnect callbacks */
	bt_conn_cb_register(&conn_callbacks);

	/* start scanning for peripheral */
	err = bt_le_scan_start(BT_LE_SCAN_ACTIVE, device_found);

	if (err) {
		printk("Scanning failed to start (err %d)\n", err);
	}


	/* does not return */
	idle_function();

	/* should not reach here */

}
```
