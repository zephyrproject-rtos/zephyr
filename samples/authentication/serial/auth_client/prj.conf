## CMakeLists.txt
```
# SPDX-License-Identifier: Apache-2.0

cmake_minimum_required(VERSION 3.13.1)
include($ENV{ZEPHYR_BASE}/cmake/app/boilerplate.cmake NO_POLICY_SCOPE)
project(auth_serial_client)


target_include_directories(app PUBLIC ${CMAKE_SOURCE_DIR})

target_sources(app PRIVATE
  src/main.c
)

#zephyr_library_include_directories(${CMAKE_SOURCE_DIR})
```

## sample.yaml
```
sample:
  description: Auth Client serial transport sample app
  name: Auth Client Serial
tests:
  sample.auth_client_serial:
    harness: bluetooth
    platform_allow:  qemu_x86
    tags: authentication
    extra_args: CONF_FILE=ci.prj.conf
```

## prj.conf
```kconfig
#
# Project configuration to us if Challenge-Response authentication method
# is enabled.
#


# Increase stack due to settings API usage
CONFIG_SYSTEM_WORKQUEUE_STACK_SIZE=2048
CONFIG_MAIN_STACK_SIZE=1024
CONFIG_AUTH_LIB=y
CONFIG_SERIAL_XPORT=y
CONFIG_AUTH_CHALLENGE_RESPONSE=y
CONFIG_TINYCRYPT=y
CONFIG_TINYCRYPT_SHA256=y
CONFIG_UART_INTERRUPT_DRIVEN=y

# The SOC must have a hardware based random number generator.
CONFIG_ENTROPY_GENERATOR=y
CONFIG_ENTROPY_DEVICE_RANDOM_GENERATOR=y


# Don't use UART backend for logging, will collide with serial link
CONFIG_LOG=y
CONFIG_USE_SEGGER_RTT=y
CONFIG_LOG_BACKEND_RTT=y
CONFIG_LOG_BACKEND_UART=n
CONFIG_LOG_PRINTK=y
```

## ci.prj.conf
```kconfig
#
# Project configuration specifically for CI (Continues Integration) tests
#


# Increase stack due to settings API usage
CONFIG_SYSTEM_WORKQUEUE_STACK_SIZE=2048
CONFIG_MAIN_STACK_SIZE=1024
CONFIG_AUTH_LIB=y
CONFIG_SERIAL_XPORT=y
CONFIG_AUTH_CHALLENGE_RESPONSE=y
CONFIG_TINYCRYPT=y
CONFIG_TINYCRYPT_SHA256=y
CONFIG_UART_INTERRUPT_DRIVEN=y
CONFIG_LOG=y

# For CI testing only
CONFIG_TEST_RANDOM_GENERATOR=y
```

## dtls.prj.conf
```kconfig
#
# Project configuration to us if DTLS authentication method
# is enabled.
#

CONFIG_MAIN_STACK_SIZE=4096

# Increase stack due to settings API usage
CONFIG_SYSTEM_WORKQUEUE_STACK_SIZE=2048
CONFIG_AUTH_LIB=y
CONFIG_SERIAL_XPORT=y
CONFIG_AUTH_DTLS=y
CONFIG_UART_INTERRUPT_DRIVEN=y

# Don't use UART backend for logging, will collide with serial link
CONFIG_LOG=y
CONFIG_USE_SEGGER_RTT=y
CONFIG_LOG_BACKEND_RTT=y
CONFIG_LOG_BACKEND_UART=n
CONFIG_LOG_PRINTK=y

# The SOC must have a hardware based random number generator.
CONFIG_ENTROPY_GENERATOR=y
CONFIG_ENTROPY_DEVICE_RANDOM_GENERATOR=y

# Mbed config'CONFIG_MBEDTLS=y
CONFIG_MBEDTLS=y
CONFIG_MBEDTLS_BUILTIN=y
CONFIG_MBEDTLS_CFG_FILE="config-tls-generic.h"
CONFIG_MBEDTLS_TLS_VERSION_1_2=y
CONFIG_MBEDTLS_DTLS=y
CONFIG_MBEDTLS_ENTROPY_ENABLED=y

# Supported key exchange modes
CONFIG_MBEDTLS_KEY_EXCHANGE_ECDHE_ECDSA_ENABLED=y
CONFIG_MBEDTLS_KEY_EXCHANGE_ECDH_ECDSA_ENABLED=y

# Supported elliptic curves
CONFIG_MBEDTLS_ECP_DP_SECP256R1_ENABLED=y

# Supported cipher modes
CONFIG_MBEDTLS_CIPHER_AES_ENABLED=y
CONFIG_MBEDTLS_CIPHER_GCM_ENABLED=y
CONFIG_MBEDTLS_CIPHER_MODE_CBC_ENABLED=y


# Supported message authentication methods
CONFIG_MBEDTLS_MAC_SHA256_ENABLED=y
CONFIG_MBEDTLS_MAC_CMAC_ENABLED=y


# Other configurations
CONFIG_MBEDTLS_PEM_CERTIFICATE_FORMAT=y
CONFIG_MBEDTLS_SSL_MAX_CONTENT_LEN=1500
CONFIG_MBEDTLS_DEBUG=y
CONFIG_MBEDTLS_DEBUG_LEVEL=0
CONFIG_MBEDTLS_ENABLE_HEAP=y

# Mbed uses a chunk of memory, it might be possible to reduce
# this heap usage.
CONFIG_MBEDTLS_HEAP_SIZE=65535
CONFIG_APP_LINK_WITH_MBEDTLS=y
```

## src/main.c
```c
/*
 * Copyright (c) 2021 Golden Bits Software, Inc.
 *  SPDX-License-Identifier: Apache-2.0
 *
 * main.c - Application main entry point
 *          Sample authenticating over a UART link
 */


#include <zephyr/types.h>
#include <stddef.h>
#include <string.h>
#include <errno.h>
#include <sys/printk.h>
#include <sys/byteorder.h>
#include <zephyr.h>
#include <device.h>
#include <drivers/uart.h>


#include <auth/auth_lib.h>
#include <logging/log.h>
#include <logging/log_ctrl.h>

#if defined(CONFIG_AUTH_DTLS)
#include "../../../certs/auth_certs.h"
#endif

LOG_MODULE_REGISTER(auth_serial_client, CONFIG_AUTH_LOG_LEVEL);


static const struct device *uart_dev;

static struct uart_config uart_cfg = {
	.baudrate = 115200,
	.parity = UART_CFG_PARITY_NONE,
	.stop_bits = UART_CFG_STOP_BITS_1,
	.data_bits = UART_CFG_DATA_BITS_8,
	.flow_ctrl = UART_CFG_FLOW_CTRL_NONE,
};

#if defined(CONFIG_AUTH_DTLS)
/* The Root and Intermediate Certs in a single CA chain.
 * plus the server cert. All in PEM format.
 */
static const uint8_t auth_cert_ca_chain[] = AUTH_ROOTCA_CERT_PEM AUTH_INTERMEDIATE_CERT_PEM;
static const uint8_t auth_dev_client_cert[] = AUTH_CLIENT_CERT_PEM;
static const uint8_t auth_client_privatekey[] = AUTH_CLIENT_PRIVATE_KEY_PEM;

static struct auth_optional_param tls_certs_param = {
	.param_id = AUTH_DTLS_PARAM,
	.param_body = {
		.dtls_certs = {
			.server_ca_chain_pem = {
				.cert = auth_cert_ca_chain,
				.cert_size = sizeof(auth_cert_ca_chain),
			},

			.device_cert_pem = {
				.cert = auth_dev_client_cert,
				.cert_size = sizeof(auth_dev_client_cert),
				.priv_key = auth_client_privatekey,
				.priv_key_size = sizeof(auth_client_privatekey)
			}
		}
	}
};
#endif

#if defined(CONFIG_AUTH_CHALLENGE_RESPONSE)
#define NEW_SHARED_KEY_LEN          (32u)

/* Use a different key than default */
static uint8_t chal_resp_sharedkey[NEW_SHARED_KEY_LEN] = {
	0x21, 0x8e, 0x37, 0x42, 0x1e, 0xe1, 0x2a, 0x22,
	0x7c, 0x4b, 0x3f, 0x3f, 0x07, 0x5e, 0x8a, 0xd8,
	0x24, 0xdf, 0xca, 0xf4, 0x04, 0xd0, 0x3e, 0x22,
	0x61, 0x9f, 0x24, 0xa3, 0xc7, 0xf6, 0x5d, 0x66
};


static struct auth_optional_param chal_resp_param = {
	.param_id = AUTH_CHALRESP_PARAM,
	.param_body = {
		.chal_resp = {
			.shared_key = chal_resp_sharedkey,
		},
	}
};
#endif


/* Authentication connection info */
static struct authenticate_conn auth_conn_serial;

/**
 * Authentication status callback.
 *
 * @param auth_conn   The authentication connection.
 * @param instance    Authentication instance id.
 * @param status      Authentication status.
 * @param context     Optional context
 */
void auth_status_callback(struct authenticate_conn *auth_conn,
			  enum auth_instance_id instance,
			  enum auth_status status, void *context)
{
	printk("Authentication instance (%d) status: %s\n", instance,
	       auth_lib_getstatus_str(status));

#if defined(CONFIG_AUTH_DTLS)
	if (status == AUTH_STATUS_IN_PROCESS) {
		printk("     DTLS may take 30-60 seconds.\n");
	}
#endif


	if ((status == AUTH_STATUS_FAILED) ||
	    (status == AUTH_STATUS_AUTHENTICATION_FAILED) ||
	    (status == AUTH_STATUS_SUCCESSFUL)) {
		/* Authentication has finished */
		auth_lib_deinit(auth_conn);
	}
}

/**
 * Process log messages
 */
static void process_log_msgs(void)
{
	while (log_process(false)) {
		; /* intentionally empty statement */
	}
}

/**
 * Idle processing.
 */
static void idle_process(void)
{
	/* Just spin while the BT modules handle the connection. */
	while (true) {

		process_log_msgs();

		/* Let the handshake thread run */
		k_yield();
	}
}


/**
 * Configures the UART
 *
 * @return 0 on success, else negative error code.
 */
static int config_uart(void)
{
	struct auth_xp_serial_params xp_params;

	uart_dev = device_get_binding(DT_LABEL(DT_NODELABEL(uart0)));

	int err = uart_configure(uart_dev, &uart_cfg);

	if (err) {
		LOG_ERR("Failed to configure UART, err: %d", err);
		return err;
	}

	/* If successful,then init lower transport layer. */
	xp_params.uart_dev = uart_dev;

	err = auth_xport_init(&auth_conn_serial.xport_hdl,
			      auth_conn_serial.instance,
			      AUTH_XP_TYPE_SERIAL, &xp_params);

	if (err) {
		LOG_ERR("Failed to initialize authentication transport, error: %d", err);
	}

	return err;
}


void main(void)
{
	struct auth_optional_param *opt_parms = NULL;

	log_init();

	uint32_t flags = AUTH_CONN_CLIENT;

#if defined(CONFIG_AUTH_DTLS)
	flags |= AUTH_CONN_DTLS_AUTH_METHOD;

	/* set TLS certs */
	opt_parms = &tls_certs_param;
	printk("Using DTLS authentication method.\n");
#endif


#if defined(CONFIG_AUTH_CHALLENGE_RESPONSE)
	flags |= AUTH_CONN_CHALLENGE_AUTH_METHOD;

	/* Use different shared key */
	opt_parms = &chal_resp_param;
	printk("Using Challenge-Response authentication method.\n");
#endif


	/* init authentication library */
	int err = auth_lib_init(&auth_conn_serial, AUTH_INST_1_ID,
				auth_status_callback, NULL,
				opt_parms, flags);

	/* If successful, then configure the UAR and start the
	 * authentication process
	 */
	if (!err) {

		/* configure the UART and init the lower serial transport */
		err = config_uart();

		/* start authentication */
		if (!err) {
			err = auth_lib_start(&auth_conn_serial);

			if (err) {
				LOG_ERR("Failed to start authentication, err: %d", err);
			}
		}

	}

	/* does not return */
	idle_process();

	/* should not reach here */
}
```
