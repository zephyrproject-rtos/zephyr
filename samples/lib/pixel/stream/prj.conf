## sample.yaml
```
sample:
  description: Pixel Stream sample, convert a stream of lines from a frame
  name: pixel stream
common:
  min_ram: 32
  tags: pixel
  integration_platforms:
    - native_sim
  harness: console
  harness_config:
    type: one_line
    regex:
      - "Output image preview:"
tests:
  sample.lib.pixel.stream:
    tags: pixel
    extra_configs:
      - CONFIG_PIXEL_PRINT_NONE=y
```

## prj.conf
```kconfig
CONFIG_ASSERT=y
CONFIG_LOG=y
CONFIG_PIXEL=y

# Required to make sure the test harnesses catch the log output
CONFIG_LOG_MODE_IMMEDIATE=y
```

## src/main.c
```c
/*
 * Copyright (c) 2025 tinyVision.ai Inc.
 *
 * SPDX-License-Identifier: Apache-2.0
 */

#include <stdint.h>

#include <zephyr/sys/util.h>
#include <zephyr/pixel/formats.h>
#include <zephyr/pixel/print.h>
#include <zephyr/logging/log.h>

LOG_MODULE_REGISTER(app, LOG_LEVEL_INF);

#define WIDTH  20
#define HEIGHT 4

static const uint8_t rgb24frame[WIDTH * HEIGHT * 3] = {
	0x47, 0x84, 0xee, 0x46, 0x84, 0xee, 0x47, 0x84, 0xee, 0x46, 0x83, 0xee, 0x47, 0x84, 0xee,
	0x78, 0xaa, 0xec, 0x74, 0xb2, 0xe0, 0x67, 0xaa, 0xdd, 0x78, 0xb2, 0xef, 0x39, 0x8c, 0xf1,
	0x3a, 0x8c, 0xf2, 0x39, 0x8b, 0xf1, 0x3a, 0x8b, 0xf1, 0x3a, 0x8b, 0xf1, 0x3a, 0x8b, 0xf1,
	0x3a, 0x8b, 0xf1, 0x3b, 0x8b, 0xf1, 0x3b, 0x8b, 0xf1, 0x3b, 0x8b, 0xf1, 0x3b, 0x8a, 0xf1,
	0x47, 0x82, 0xed, 0x47, 0x82, 0xed, 0x47, 0x82, 0xee, 0x47, 0x82, 0xed, 0x47, 0x82, 0xed,
	0x47, 0x82, 0xed, 0x5d, 0x93, 0xed, 0x5f, 0x9d, 0xeb, 0x3a, 0x8a, 0xf1, 0x3a, 0x8a, 0xf0,
	0x3a, 0x8a, 0xf1, 0x3a, 0x8a, 0xf0, 0x3b, 0x8a, 0xf0, 0x3b, 0x8a, 0xf0, 0x3b, 0x8a, 0xf0,
	0x3b, 0x89, 0xf0, 0x3b, 0x8a, 0xf0, 0x3b, 0x89, 0xf0, 0x3c, 0x89, 0xf0, 0x3c, 0x89, 0xf0,
	0x49, 0x82, 0xee, 0x49, 0x82, 0xed, 0x49, 0x82, 0xee, 0x48, 0x82, 0xed, 0x49, 0x82, 0xee,
	0x49, 0x82, 0xed, 0x73, 0x92, 0xe9, 0x50, 0x65, 0xd4, 0x4c, 0x93, 0xf2, 0x3c, 0x8a, 0xf1,
	0x3c, 0x8a, 0xf1, 0x3c, 0x8a, 0xf0, 0x3c, 0x8a, 0xf1, 0x3c, 0x89, 0xf0, 0x3d, 0x8a, 0xf1,
	0x3d, 0x89, 0xf0, 0x3d, 0x89, 0xf0, 0x3d, 0x89, 0xf0, 0x3e, 0x89, 0xf0, 0x3d, 0x89, 0xf0,
	0x4a, 0x81, 0xed, 0x49, 0x81, 0xed, 0x4a, 0x81, 0xed, 0x49, 0x81, 0xed, 0x49, 0x81, 0xed,
	0x71, 0x8c, 0xe5, 0x3e, 0x4c, 0xcc, 0x3d, 0x4c, 0xcb, 0x65, 0x85, 0xe1, 0x3d, 0x89, 0xf0,
	0x3d, 0x89, 0xf0, 0x3d, 0x88, 0xf0, 0x3d, 0x89, 0xf0, 0x3d, 0x88, 0xf0, 0x3e, 0x88, 0xf0,
	0x3e, 0x88, 0xf0, 0x3e, 0x88, 0xf0, 0x3e, 0x88, 0xf0, 0x3f, 0x88, 0xf0, 0x3e, 0x88, 0xef,
};
static uint8_t yuyvframe[WIDTH * HEIGHT * 2] = {0};

/* Stream conversion steps are declared at build time */
PIXEL_STREAM_RGB24_TO_RGB565LE(step_rgb24_to_rgb565le, WIDTH, HEIGHT);
PIXEL_STREAM_RGB565LE_TO_RGB24(step_rgb565le_to_rgb24, WIDTH, HEIGHT);
PIXEL_STREAM_RGB24_TO_YUYV_BT709(step_rgb24_to_yuyv, WIDTH, HEIGHT);

int main(void)
{
	struct pixel_stream root = {0};
	struct pixel_stream *step = &root;
	struct pixel_stream step_export_yuyv = {
		.ring = RING_BUF_INIT(yuyvframe, sizeof(yuyvframe)),
		.pitch = WIDTH * 2,
		.name = "[export_yuyv]",
	};

	LOG_INF("Input image preview:");
	pixel_print_rgb24frame_truecolor(rgb24frame, sizeof(rgb24frame), WIDTH, HEIGHT);

	/* Interconnection between the stream steps can be done arbitrarily at runtime */
	step = step->next = &step_rgb24_to_rgb565le;
	step = step->next = &step_rgb565le_to_rgb24;
	step = step->next = &step_rgb24_to_yuyv;
	step = step->next = &step_export_yuyv;
	pixel_stream_load(root.next, rgb24frame, sizeof(rgb24frame));

	LOG_INF("Output image preview:");
	pixel_print_yuyvframe_bt709_truecolor(yuyvframe, sizeof(yuyvframe), WIDTH, HEIGHT);

	LOG_INF("Total time spent on each step:");
	for (step = root.next; step != NULL; step = step->next) {
		LOG_INF(" %4u us on %s", k_cyc_to_us_ceil32(step->total_time), step->name);
	}

	return 0;
}
```
