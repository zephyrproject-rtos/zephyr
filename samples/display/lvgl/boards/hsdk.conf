## samples/display/lvgl/boards/hsdk.conf
```kconfig
CONFIG_ILI9340=y

CONFIG_LVGL=y
CONFIG_LV_HOR_RES_MAX=320
CONFIG_LV_VER_RES_MAX=240
CONFIG_LV_DPI=100
```

## samples/display/lvgl/boards/native_posix.conf
```kconfig
CONFIG_SDL_DISPLAY_DEV_NAME="DISPLAY"
CONFIG_SDL_DISPLAY_X_RES=320
CONFIG_SDL_DISPLAY_Y_RES=240

CONFIG_KSCAN=y
CONFIG_LVGL_POINTER_KSCAN=y
CONFIG_LVGL_HOR_RES_MAX=320
CONFIG_LVGL_VER_RES_MAX=240
CONFIG_LVGL_DPI=100
```

## samples/display/lvgl/boards/reel_board.conf
```kconfig
CONFIG_SPI=y
CONFIG_SSD16XX=y

CONFIG_LV_COLOR_DEPTH=1
CONFIG_LVGL_BITS_PER_PIXEL=1
CONFIG_LV_HOR_RES_MAX=250
CONFIG_LV_VER_RES_MAX=120
CONFIG_LV_DPI=130
CONFIG_LVGL_VDB_SIZE=16
```

## samples/display/lvgl/sample.yaml
```yaml
sample:
  description: LVGL sample application
  name: lvgl
tests:
  sample.gui.lvgl:
    harness: display
    platform_allow: reel_board mimxrt1050_evk mimxrt1060_evk mimxrt1064_evk
    tags: samples display gui
  sample.display.adafruit_2_8_tft_touch_v2:
    platform_allow: nrf52840dk_nrf52840
    extra_args: SHIELD=adafruit_2_8_tft_touch_v2
    tags: shield
  sample.display.waveshare_epaper_gdeh0213b1:
    platform_allow: nrf52840dk_nrf52840
    extra_args: SHIELD=waveshare_epaper_gdeh0213b1
    tags: shield
  sample.display.waveshare_epaper_gdeh0213b72:
    platform_allow: nrf52840dk_nrf52840
    extra_args: SHIELD=waveshare_epaper_gdeh0213b72
    tags: shield
  sample.display.waveshare_epaper_gdeh029a1:
    platform_allow: nrf52840dk_nrf52840
    extra_args: SHIELD=waveshare_epaper_gdeh029a1
    tags: shield
  sample.display.lvgl.sdl:
    build_only: true
    platform_allow: native_posix_64
    tags: samples display gui
  sample.display.buydisplay_2_8_tft_touch_arduino:
    platform_allow: nrf52840dk_nrf52840
    extra_args: SHIELD=buydisplay_2_8_tft_touch_arduino
    tags: shield
  sample.display.dummy:
    build_only: true
    platform_allow: native_posix
    extra_configs:
      - CONFIG_DUMMY_DISPLAY=y
      - CONFIG_DUMMY_DISPLAY_DEV_NAME="DISPLAY"
      - CONFIG_KSCAN=n
      - CONFIG_SDL_DISPLAY=n
    tags: samples display gui
```

## samples/display/st7789v/sample.yaml
```yaml
sample:
  description: Sample application for ST7789V display
  name: st7789v_sample
tests:
  sample.display.st7789v_tl019fqv01:
    build_only: true
    platform_whitelist: nrf52_pca10040
    extra_args: SHIELD=st7789v_tl019fqv01
    tags: display shield
  sample.display.st7789v_waveshare_240x240:
    build_only: true
    platform_whitelist: nrf52_pca10040
    extra_args: SHIELD=st7789v_waveshare_240x240
    tags: display shield
```

## samples/drivers/CAN/Kconfig
```kconfig
# Kconfig - Private config options for can sample app

#
# Copyright (c) 2018 Alexander Wachter
#
# SPDX-License-Identifier: Apache-2.0
#

mainmenu "Controller Area Network sample application"

config CAN_DEV
	string "Name of the CAN device"
	default "CAN_1"
	help
	  Name of the can device used for send an receive.

config LOOPBACK_MODE
	bool "Loopback LOOPBACK_MODE"
	default y
	help
	  Set the controller to loopback mode.
	  This allows testing without a second board.


source "Kconfig.zephyr"
```

## samples/drivers/CAN/boards/frdm_k64f.conf
```kconfig
CONFIG_CAN_DEV="CAN_0"
CONFIG_GPIO_LED_DEV="GPIO_4"
CONFIG_GPIO_BUTTON_DEV="GPIO_2"
CONFIG_PIN_USER_BUTTON=6
CONFIG_PIN_LED_1=26

CONFIG_LOG=y
CONFIG_LOG_BUFFER_SIZE=2048

CONFIG_CAN_0=y
CONFIG_CAN_1=n
```

## samples/drivers/CAN/boards/twr_ke18f.conf
```kconfig
CONFIG_CAN_DEV="CAN_0"
CONFIG_GPIO_LED_DEV="GPIO_2"
CONFIG_GPIO_BUTTON_DEV="GPIO_3"
CONFIG_PIN_USER_BUTTON=3
CONFIG_PIN_LED_1=13

CONFIG_LOG=y
CONFIG_LOG_BUFFER_SIZE=2048

CONFIG_CAN_0=y
CONFIG_CAN_1=n
```

## samples/drivers/CAN/sample.yaml
```yaml
sample:
  name: CAN driver sample
tests:
  sample.drivers.can:
    tags: CAN
    depends_on: can
    harness: console
    harness_config:
      type: one_line
      regex:
        - "Counter received: (.*)"
```

## samples/drivers/adc/adc_dt/Kconfig
```kconfig
# Copyright The Zephyr Project Contributors
# SPDX-License-Identifier: Apache-2.0

mainmenu "ADC DT sample"

source "Kconfig.zephyr"


config SAMPLE_ADC_CALIBRATE_REQUIRED
	bool "Require calibrate field in ADC"
	default y if DT_HAS_RENESAS_RA_ADC16_ENABLED
```

## samples/drivers/adc/adc_dt/boards/frdm_mcxn236.conf
```kconfig
#Copyright 2024 NXP
#SPDX-License-Identifier: Apache-2.0

CONFIG_LPADC_ENABLE_DMA=y
```

## samples/drivers/adc/adc_dt/sample.yaml
```yaml
sample:
  name: ADC devicetree driver sample
common:
  tags:
    - adc
  depends_on: adc
  filter: dt_node_has_prop("/zephyr,user","io-channels")

tests:
  sample.drivers.adc.adc_dt:
    platform_allow:
      - nucleo_l073rz
      - nucleo_h753zi
      - disco_l475_iot1
      - cc3220sf_launchxl
      - cc3235sf_launchxl
      - cy8cproto_063_ble
      - stm32l496g_disco
      - stm32h735g_disco
      - nrf51dk/nrf51822
      - nrf52840dk/nrf52840
      - nrf54h20dk/nrf54h20/cpuapp
      - nrf54h20dk/nrf54h20/cpuppr
      - nrf54l15dk/nrf54l15/cpuapp
      - nrf54lm20dk/nrf54lm20a/cpuapp
      - ophelia4ev/nrf54l15/cpuapp
      - mec172xevb_assy6906
      - gd32f350r_eval
      - gd32f450i_eval
      - gd32vf103v_eval
      - gd32f403z_eval
      - esp32_devkitc/esp32/procpu
      - esp32s2_saola
      - esp32c3_devkitm
      - gd32l233r_eval
      - lpcxpresso55s36
      - mr_canhubk3
      - longan_nano
      - longan_nano/gd32vf103/lite
      - rd_rw612_bga
      - frdm_mcxn947/mcxn947/cpu0
      - mcx_n9xx_evk/mcxn947/cpu0
      - frdm_mcxc242
      - ucans32k1sic
      - slwrb4180a
      - xg27_rb4194a
      - xg29_rb4412a
      - frdm_mcxa346
      - frdm_mcxa266
      - frdm_mcxa366
      - s32k148_evb
      - raytac_an54lq_db_15/nrf54l15/cpuapp
    integration_platforms:
      - nucleo_l073rz
      - nrf52840dk/nrf52840
    harness: console
    timeout: 10
    harness_config:
      type: multi_line
      regex:
        - "ADC reading\\[\\d+\\]:"
        - "- .+, channel \\d+: -?\\d+"
```

## samples/drivers/adc/adc_f1_bug_repro/boards/nucleo_f103rb.conf
```kconfig
# Activate ADC
CONFIG_ADC=y
CONFIG_ADC_STM32=y

# Activate logging subsystem for LOG_INF etc. to work
CONFIG_LOG=y
```

## samples/drivers/adc/adc_power_measure/boards/frdm_mcxc444.conf
```kconfig
CONFIG_ADC_MCUX_ADC16_VREF_ALTERNATE=y

CONFIG_SHELL_ADC_PS=y
CONFIG_SHELL=y
CONFIG_SHELL_MINIMAL=y
CONFIG_SHELL_STACK_SIZE=1024
CONFIG_SHELL_BACKEND_SERIAL=y

# Power management
CONFIG_PM=n

# Memory protection
CONFIG_THREAD_STACK_INFO=n
CONFIG_THREAD_CUSTOM_DATA=n
CONFIG_FPU=n

# Boot
CONFIG_BOOT_BANNER=n
CONFIG_BOOT_DELAY=0
```

## samples/drivers/adc/adc_power_measure/boards/stm32f030_demo.conf
```kconfig
# A4114 driver can only acquire one sequence sample
CONFIG_SEQUENCE_SAMPLES=1
CONFIG_SEQUENCE_RESOLUTION=12
CONFIG_SEQUENCE_32BITS_REGISTERS=y
CONFIG_LOG=n
#CONFIG_SCHED_SIMPLE=y
#CONFIG_WAITQ_SIMPLE=y
#CONFIG_ARM_MPU=n
CONFIG_GEN_SW_ISR_TABLE=n
CONFIG_GEN_ISR_TABLES=n
CONFIG_CBPRINTF_NANO=y

# Memory constraints
CONFIG_MAIN_STACK_SIZE=512
CONFIG_IDLE_STACK_SIZE=256
CONFIG_ISR_STACK_SIZE=512
CONFIG_HEAP_MEM_POOL_SIZE=0

# ADC minimal
CONFIG_ADC_ASYNC=n
```

## samples/drivers/adc/adc_power_measure/sample.yaml
```yaml
sample:
  name: ADC power shield sample
common:
  tags:
    - adc
  depends_on: adc
  filter: dt_alias_exists("adc0")
  harness: console
  timeout: 10
  harness_config:
    type: multi_line
    regex:
      - "ADC sequence reading \\[\\d+\\]:"
      - "- .+, channel \\d+, \\d+ sequence samples:"
      - "- - \\d+ (= \\d+mV)|(\\(value in mV not available\\))"
tests:
  sample.drivers.adc.adc_power_shield:
    integration_platforms:
      - frdm_mcxc444
      - mimxrt1040_evk
    platform_allow:
      - frdm_k64f
      - frdm_mcxc242
      - frdm_mcxc444
      - mimxrt1040_evk
```

## samples/drivers/adc/adc_power_shield/sample.yaml
```yaml
sample:
  name: ADC power shield sample
common:
  tags:
    - adc
  depends_on: adc
  filter: dt_alias_exists("adc0")
  harness: console
  timeout: 10
  harness_config:
    type: multi_line
    regex:
      - "ADC sequence reading \\[\\d+\\]:"
      - "- .+, channel \\d+, \\d+ sequence samples:"
      - "- - \\d+ (= \\d+mV)|(\\(value in mV not available\\))"
tests:
  sample.drivers.adc.adc_power_shield:
    integration_platforms:
      - nrf52840dk/nrf52840
  sample.drivers.adc.adc_power_shield.8bit:
    platform_allow:
      - nrf54h20dk/nrf54h20/cpuapp
      - nrf54l15dk/nrf54l15/cpuapp
      - nrf54lm20dk/nrf54lm20a/cpuapp
    integration_platforms:
      - nrf54l15dk/nrf54l15/cpuapp
    extra_configs:
      - CONFIG_SEQUENCE_RESOLUTION=8
```

## samples/drivers/adc/adc_sequence/Kconfig
```kconfig
# Copyright (c) 2024 Centro de Inovacao EDGE.
# SPDX-License-Identifier: Apache-2.0

config SEQUENCE_SAMPLES
	int "Number of samples to be made on the sequence for each channel."
	default 5

config SEQUENCE_RESOLUTION
	int "Set the resolution of the sequence readings."
	default 12

source "Kconfig.zephyr"
```

## samples/drivers/adc/adc_sequence/boards/esp32s3_devkitc_procpu.conf
```kconfig
#
# Copyright (c) 2026 Espressif Systems (Shanghai) Co., Ltd.
#
# SPDX-License-Identifier: Apache-2.0
#

CONFIG_ADC_ESP32_DMA=y
```

## samples/drivers/adc/adc_sequence/boards/frdm_mcxe31b.conf
```kconfig
# Copyright 2025 NXP
# SPDX-License-Identifier: Apache-2.0

CONFIG_ADC_NXP_SAR_ADC_INTERRUPT=y
CONFIG_SEQUENCE_RESOLUTION=15
```
