## sample.yaml
```
sample:
  name: LS013B7DH05 Display Sample
```

## prj.conf
```kconfig
CONFIG_HEAP_MEM_POOL_SIZE=16384

CONFIG_SYS_LOG=y
CONFIG_SYS_LOG_DEFAULT_LEVEL=0
CONFIG_SYS_LOG_SHOW_TAGS=y
CONFIG_SYS_LOG_SHOW_COLOR=y
CONFIG_SYS_LOG_OVERRIDE_LEVEL=0

CONFIG_SPI=y
CONFIG_SPI_0=y
CONFIG_SPI_NRFX=y

CONFIG_GPIO=y

CONFIG_SPI_0_IRQ_PRI=2
CONFIG_SPI_0_NRF_SCK_PIN=21
CONFIG_SPI_0_NRF_MOSI_PIN=17
CONFIG_SPI_0_NRF_MISO_PIN=16

CONFIG_DISPLAY=y
CONFIG_LS013B7DH05=y

CONFIG_LS013B7DH05_SPI_DEV_NAME="SPI_0"
CONFIG_LS013B7DH05_SPI_DEV_NUM=17
CONFIG_LS013B7DH05_SPI_DEV_FREQ=1000000

CONFIG_LS013B7DH05_SCS_GPIO_PORT_NAME="GPIO_0"
CONFIG_LS013B7DH05_SCS_GPIO_PIN_NUM=15
```

## src/main.c
```c
#include <device.h>
#include <display/segdl.h>

/** Draws a small smiley face in the top-left corner of the display. */
void main(void)
{
	struct device *dev = device_get_binding(CONFIG_LS013B7DH05_DEV_NAME);

	uint8_t colors_0[18] = {0x00};
	colors_0[0] = 0b00101000;

	struct segdl_ln ln_0 = {
		.x = 0,
		.y = 1,
		.colors = colors_0
	};

	uint8_t colors_1[18] = {0x00};
	colors_1[0] = 0b01000100;

	struct segdl_ln ln_1 = {
		.x = 0,
		.y = 3,
		.colors = colors_1
	};

	uint8_t colors_2[18] = {0x00};
	colors_2[0] = 0b00111000;

	struct segdl_ln ln_2 = {
		.x = 0,
		.y = 4,
		.colors = colors_2
	};

	struct segdl_ln lns[3];
	lns[0] = ln_0;
	lns[1] = ln_1;
	lns[2] = ln_2;

	segdl_draw_fh_lns(dev, &lns, 3);
}
```
