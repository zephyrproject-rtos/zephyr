/*
 * Copyright (c) 2019 Nordic Semiconductor ASA
 *
 * SPDX-License-Identifier: Apache-2.0
 */

&spi1 {
	status = "okay";
	sck-pin = <25>;
	mosi-pin = <23>;
	miso-pin = <24>;
	cs-gpios = <&gpio0 16 0>;

	ili9340@0 {
		compatible = "ilitek,ili9340";
		label = "DISPLAY";
		spi-max-frequency = <10000000>;
		reg = <0>;
		reset-gpios = <&gpio0 21 0>;
		cmd-data-gpios = <&gpio0 17 0>;
	};
};
