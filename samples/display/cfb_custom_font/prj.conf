## CMakeLists.txt
```
# SPDX-License-Identifier: Apache-2.0

cmake_minimum_required(VERSION 3.15.7)

find_package(Zephyr REQUIRED HINTS $ENV{ZEPHYR_BASE})
include(${ZEPHYR_BASE}/cmake/cfb.cmake NO_POLICY_SCOPE)
project(cfb_custom_font)

target_sources(app PRIVATE src/main.c)

set(gen_dir ${ZEPHYR_BINARY_DIR}/include/generated/)
generate_cfb_font_for_target(app fonts/dice.png ${gen_dir}/cfb_font_dice.h 32 32 --first 49 --last 54)
```

## sample.yaml
```
common:
  harness: display
  tags: display
sample:
  description: Custom character framebuffer font example
  name: cfb custom font sample
tests:
  sample.display.cfb_custom_font.ssd16xx:
    platform_whitelist: reel_board
  sample.display.cfb_custom_font.elcdif:
    platform_whitelist: mimxrt1050_evk
```

## prj.conf
```kconfig
CONFIG_HEAP_MEM_POOL_SIZE=16384

CONFIG_DISPLAY=y

CONFIG_CHARACTER_FRAMEBUFFER=y
CONFIG_CHARACTER_FRAMEBUFFER_USE_DEFAULT_FONTS=n

CONFIG_SYS_TIMEOUT_LEGACY_API=n
```

## boards/mimxrt1050_evk.conf
```kconfig
CONFIG_HEAP_MEM_POOL_SIZE=300000
```

## src/main.c
```c
/*
 * Copyright (c) 2018 Henrik Brix Andersen <henrik@brixandersen.dk>
 *
 * SPDX-License-Identifier: Apache-2.0
 */

#include <zephyr.h>
#include <device.h>
#include <display/cfb.h>
#include <sys/printk.h>

#include "cfb_font_dice.h"

#if defined(CONFIG_SSD1306)
#define DISPLAY_NAME DT_LABEL(DT_INST(0, solomon_ssd1306fb))
#elif defined(CONFIG_SSD16XX)
#define DISPLAY_NAME DT_LABEL(DT_INST(0, solomon_ssd16xxfb))
#else
#error Unsupported board
#endif

const struct device *display;

void main(void)
{
	int err;

	display = device_get_binding(DISPLAY_NAME);
	if (!display) {
		printk("Could not get device binding for display device\n");
	}

	err = cfb_framebuffer_init(display);
	if (err) {
		printk("Could not initialize framebuffer (err %d)\n", err);
	}

	err = cfb_framebuffer_clear(display, true);
	if (err) {
		printk("Could not clear framebuffer (err %d)\n", err);
	}

	err = cfb_print(display, "123456", 0, 0);
	if (err) {
		printk("Could not display custom font (err %d)\n", err);
	}

	err = cfb_framebuffer_finalize(display);
	if (err) {
		printk("Could not finalize framebuffer (err %d)\n", err);
	}
}
```
