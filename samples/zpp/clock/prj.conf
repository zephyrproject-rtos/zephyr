## CMakeLists.txt
```
# SPDX-License-Identifier: Apache-2.0

cmake_minimum_required(VERSION 3.13.1)
include($ENV{ZEPHYR_BASE}/cmake/app/boilerplate.cmake NO_POLICY_SCOPE)
project(zpp_clock)

target_sources(app PRIVATE src/main.cpp)
```

## prj.conf
```kconfig
CONFIG_CPLUSPLUS=y
CONFIG_STD_CPP17=y
CONFIG_NEWLIB_LIBC=y
CONFIG_ASSERT=y
```

## src/main.cpp
```c
//
// Copyright (c) 2019 Erwin Rol <erwin@erwinrol.com>
//
// SPDX-License-Identifier: Apache-2.0
//

#ifdef NDEBUG
#undef NDEBUG
#endif

#include <zpp/clock.hpp>
#include <zpp/thread.hpp>
#include <zpp/fmt.hpp>

#include <chrono>

int main(int argc, char* argv[])
{
	using namespace zpp;
	using namespace std::chrono;

	while (true) {
		print("uptime_clock={} cyles_clock={}\n",
			uptime_clock::now(), cycle_clock::now());

		this_thread::sleep_for(100ms);
	}

	return 0;
}
```
