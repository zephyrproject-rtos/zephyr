## CMakeLists.txt
```
# SPDX-License-Identifier: Apache-2.0

cmake_minimum_required(VERSION 3.20.0)

find_package(Zephyr REQUIRED HINTS $ENV{ZEPHYR_BASE})
project(edf_sample)

target_sources(app PRIVATE src/main.c)
```

## sample.yaml
```
sample:
  description: A basic Earliest Deadline First (EDF) example
  name: Earliest Deadline First (EDF) sample
common:
  tags: EDF
tests:
  sample.subsys.basic.edf:
    build_only: true
    platform_allow:
      - qemu_x86
      - qemu_riscv32
      - qemu_cortex_a53
    integration_platforms:
      - qemu_riscv32
    tags: edf
```

## prj.conf
```kconfig
CONFIG_SYS_CLOCK_TICKS_PER_SEC=10000
CONFIG_SCHED_SCALABLE=y
CONFIG_SCHED_DEADLINE=y
CONFIG_LOG=y                  # makes printk be executed by a background thread

###############################################################################
### Uncomment the following if target is meant to use USB, but ################
### remains invisible to the computer after flashing the code. ################
### Such was the case for Raspberry Pi Pico. ##################################
###############################################################################

# CONFIG_USB_DEVICE_STACK=y
# CONFIG_USB_DEVICE_INITIALIZE_AT_BOOT=y

# CONFIG_USB_DEVICE_VID=0x2e8a
# CONFIG_USB_DEVICE_PID=0x000a
# CONFIG_USB_DEVICE_PRODUCT="MCU name (Zephyr)"
# CONFIG_USB_DEVICE_MANUFACTURER="MCU vendor"

# CONFIG_USB_SELF_POWERED=n
# CONFIG_USB_MAX_POWER=125

# CONFIG_SERIAL=y
# CONFIG_CONSOLE=y
# CONFIG_UART_CONSOLE=y
# CONFIG_UART_LINE_CTRL=y

###############################################################################
### Uncomment the following if using QEMU targets. ############################
###############################################################################

CONFIG_QEMU_ICOUNT=n
CONFIG_STDOUT_CONSOLE=y

###############################################################################
```

## boards/rpi_pico.overlay
```dts
/*** insert the following in your app.overlay file if using ******/
/*** the Raspberry Pi Pico and targeting USB as the log output ***/

&zephyr_udc0 {
	usb_cdc: usb_cdc_0 {
		compatible = "zephyr,cdc-acm-uart";
	};
};

/ {
	chosen {
		zephyr,console = &usb_cdc;
		zephyr,shell-uart = &usb_cdc;
	};
};
```

## src/main.c
```c
/*
 * Copyright (c) 2024 Instituto Superior de Engenharia do Porto (ISEP).
 *
 * SPDX-License-Identifier: Apache-2.0
 */
#include <zephyr/kernel.h>
#include "lib/helper.h"

/*
 * A simple EDF sample with three threads.
 * Their properties are defined in the
 * structs below, so feel free to change
 * them as you will. Keep in mind that
 * the sum of all threads' wcet/deadline
 * should be <= 1 for guarantees that no
 * deadline will be missed.
 */

edf_t task1 = {.id = 1,
	       .initial_delay_msec = 1000,
	       .rel_deadline_msec = 3000,
	       .period_msec = 6000,
	       .wcet_msec = 1000};

edf_t task2 = {.id = 2,
	       .initial_delay_msec = 1000,
	       .rel_deadline_msec = 6000,
	       .period_msec = 8000,
	       .wcet_msec = 2000};

edf_t task3 = {.id = 3,
	       .initial_delay_msec = 1000,
	       .rel_deadline_msec = 10000,
	       .period_msec = 10000,
	       .wcet_msec = 3000};

void trigger(struct k_timer *timer)
{
	const char t = 1;
	edf_t *task = (edf_t *)k_timer_user_data_get(timer);
	int deadline = MSEC_TO_CYC(task->rel_deadline_msec);

	/*
	 * the message itself is not relevant -
	 * the *act* of sending the message is.
	 * That's what unblocks the thread to
	 * execute a cycle.
	 */
	k_msgq_put(&task->queue, &t, K_NO_WAIT);

	/*
	 * sets the task deadline. Note that
	 * after setting the deadline, we need
	 * to trigger a rescheduling so the
	 * earliest thread gets properly selected.
	 */
	k_thread_deadline_set(task->thread, deadline);
	k_reschedule();
}

void thread_function(void *task_props, void *a2, void *a3)
{
	char buffer[10];
	char message;
	int32_t deadline;
	edf_t *task = (edf_t *)task_props;

	task->thread = k_current_get();

	/* value passed to k_busy_wait needs to be in usec */
	uint32_t wcet = MSEC_TO_USEC(task->wcet_msec);

	k_msgq_init(&task->queue, buffer, sizeof(char), 10);
	k_timer_init(&task->timer, trigger, NULL);
	k_timer_user_data_set(&task->timer, (void *)task);
	k_timer_start(&task->timer, K_MSEC(task->initial_delay_msec), K_MSEC(task->period_msec));

	/* allow other threads to set up */
	k_sleep(K_MSEC(1));

	for (;;) {
		/*
		 * The periodic thread has no period, ironically.
		 * What makes it periodic is that it has a timer
		 * associated with it that regularly sends new
		 * messages to the thread queue (e.g. every two
		 * seconds).
		 *
		 * This thread itself does nothing special. It
		 * just remains in the processor for a given
		 * amount of time ("busy wait") to emulate
		 * the WCET (worst case execution time). Thus,
		 * what we want to see with this example is
		 * just if the edf scheduler works alright
		 */
		k_msgq_get(&task->queue, &message, K_FOREVER);
		deadline = k_thread_deadline_get(task->thread);
		cycle(task->id, wcet, deadline);
	}
}

K_THREAD_DEFINE(task1_thread, 2048, thread_function, &task1, NULL, NULL, EDF_PRIORITY, 0, INACTIVE);
K_THREAD_DEFINE(task2_thread, 2048, thread_function, &task2, NULL, NULL, EDF_PRIORITY, 0, INACTIVE);
K_THREAD_DEFINE(task3_thread, 2048, thread_function, &task3, NULL, NULL, EDF_PRIORITY, 0, INACTIVE);

int main(void)
{
	printk("\n");
	k_thread_start(task1_thread);
	k_thread_start(task2_thread);
	k_thread_start(task3_thread);
	return 0;
}
```
