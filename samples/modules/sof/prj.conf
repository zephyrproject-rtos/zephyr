## sample.yaml
```
sample:
  description: Audio with SOF
  name: sof
common:
  tags: audio
  modules:
    - sof
tests:
  sample.audio.sof:
    tags: sof
    build_only: true
    platform_allow: intel_adsp_cavs15 intel_adsp_cavs18 intel_adsp_cavs20
                    intel_adsp_cavs25 nxp_adsp_imx8 nxp_adsp_imx8x nxp_adsp_imx8m

    integration_platforms:
      - intel_adsp_cavs15
      - intel_adsp_cavs18
      - intel_adsp_cavs20
      - intel_adsp_cavs25
      - nxp_adsp_imx8
      - nxp_adsp_imx8x
      - nxp_adsp_imx8m
```

## prj.conf
```kconfig
CONFIG_SOF=y
CONFIG_LOG=y
CONFIG_LOG_PRINTK=y
CONFIG_BUILD_OUTPUT_BIN=n
CONFIG_HAVE_AGENT=n

# Requires heap_info() be implemented, but no Zephyr wrapper
CONFIG_DEBUG_MEMORY_USAGE_SCAN=n

# Ensure -O2 (or similar) is used for optimization
CONFIG_SPEED_OPTIMIZATIONS=y

# Zephyr top-level default of -fno-strict-overflow is
# not a good fit for audio DSP code
CONFIG_COMPILER_OPT="-fstrict-overflow"

CONFIG_SCHED_DEADLINE=y
CONFIG_SCHED_CPU_MASK=y
CONFIG_SMP_BOOT_DELAY=y

# Fix the sys ticks value  until following bugs are solved:
# - https://github.com/zephyrproject-rtos/zephyr/issues/46378
CONFIG_SYS_CLOCK_TICKS_PER_SEC=15000
CONFIG_DAI=y
CONFIG_HEAP_MEM_POOL_SIZE=2048

# SoF pins threads to specific cores. This option allows
# Zephyr to do further cache optimizations
CONFIG_SCHED_CPU_MASK_PIN_ONLY=y
```

## boards/intel_adsp_ace15_mtpm.conf
```kconfig
CONFIG_INTEL_DMIC=y
CONFIG_INTEL_SSP=y
CONFIG_INTEL_ALH=y
CONFIG_LP_MEMORY_BANKS=1
CONFIG_RIMAGE_SIGNING_SCHEMA="mtl"
CONFIG_IPC_MAJOR_4=y
CONFIG_COMP_SRC=n
CONFIG_INTEL_ADSP_TIMER=n
CONFIG_FORMAT_CONVERT_HIFI3=n

CONFIG_PM=y
CONFIG_PM_DEVICE=y
CONFIG_PM_DEVICE_RUNTIME=y
```

## boards/intel_adsp_cavs20.conf
```kconfig
CONFIG_ICELAKE=y
CONFIG_INTEL_DMIC=y
CONFIG_INTEL_SSP=y
CONFIG_INTEL_ALH=y
CONFIG_LP_MEMORY_BANKS=1
CONFIG_HP_MEMORY_BANKS=47
```

## boards/intel_adsp_cavs20_jsl.conf
```kconfig
CONFIG_ICELAKE=y
CONFIG_INTEL_DMIC=y
CONFIG_INTEL_SSP=y
CONFIG_LP_MEMORY_BANKS=1
CONFIG_HP_MEMORY_BANKS=16
```

## boards/intel_adsp_cavs25.conf
```kconfig
CONFIG_TIGERLAKE=y
CONFIG_INTEL_DMIC=y
CONFIG_INTEL_SSP=y
CONFIG_INTEL_ALH=y
CONFIG_LP_MEMORY_BANKS=1
CONFIG_HP_MEMORY_BANKS=30
CONFIG_RIMAGE_SIGNING_SCHEMA="tgl"
CONFIG_PM=y
CONFIG_PM_DEVICE=y
CONFIG_PM_DEVICE_RUNTIME=y
```

## boards/nxp_adsp_imx8.conf
```kconfig
CONFIG_IMX8=y
CONFIG_HAVE_AGENT=n
CONFIG_FORMAT_CONVERT_HIFI3=n
CONFIG_KPB_FORCE_COPY_TYPE_NORMAL=n
```

## src/main.c
```c
/*
 * Copyright (c) 2020 Intel Corporation.
 *
 * SPDX-License-Identifier: Apache-2.0
 */

#include <zephyr/kernel.h>

#include <zephyr/logging/log.h>
LOG_MODULE_REGISTER(main, LOG_LEVEL_DBG);

/**
 * Should be included from sof/schedule/task.h
 * but triggers include chain issue
 * FIXME
 */
int sof_main(int argc, char *argv[]);

/**
 * TODO: Here comes SOF initialization
 */

void main(void)
{
	int ret;

	LOG_INF("SOF on %s", CONFIG_BOARD);

	/* sof_main is actually SOF initialization */
	ret = sof_main(0, NULL);
	if (ret) {
		LOG_ERR("SOF initialization failed");
	}

	LOG_INF("SOF initialized");
}
```
