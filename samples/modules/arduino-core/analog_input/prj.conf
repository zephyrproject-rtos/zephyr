## CMakeLists.txt
```
# SPDX-License-Identifier: Apache-2.0

cmake_minimum_required(VERSION 3.20.0)

find_package(Zephyr REQUIRED HINTS $ENV{ZEPHYR_BASE})
project(analog_input)

target_sources(app PRIVATE src/main.cpp)
zephyr_compile_options(-Wno-unused-variable -Wno-comment)
```

## sample.yaml
```
sample:
  name: Arduino Analog Input sample

common:
  tags:
    - arduino-core
  required_snippets:
    - arduino-core
  platform_allow:
    - arduino_mkrzero/samd21g18a
    - arduino_nano_33_ble/nrf52840
    - arduino_nano_33_ble/nrf52840/sense
    - arduino_nano_33_iot/samd21g18a
    - beagleconnect_freedom/cc1352p7
    - cc3220sf_launchxl/cc3220sf
    - nrf52840dk/nrf52840
    - nrf9160dk/nrf9160
    - rpi_pico/rp2040

tests:
  sample.arduino-core.analog_impot.build:
    build_only: true
```

## prj.conf
```kconfig
CONFIG_ADC=y
CONFIG_ARDUINO_API=y
```

## src/main.cpp
```c
/*
 * Copyright (c) 2022 TOKITA Hiroshi <tokita.hiroshi@gmail.com>
 *
 * SPDX-License-Identifier: Apache-2.0
 */

#include <Arduino.h>

const int analog_input = A0;    // select the input pin for the potentiometer
const int ledPin = LED_BUILTIN;      // select the pin for the LED
const float wait_factor = 1.f;

void setup() {
  pinMode(ledPin, OUTPUT);
}

void loop() {
  int value = 0;

  value = analogRead(analog_input);

  /* Blinks slowly when the input voltage is high */

  digitalWrite(ledPin, HIGH);
  delay(value * wait_factor);

  digitalWrite(ledPin, LOW);
  delay(value * wait_factor);
}
```
