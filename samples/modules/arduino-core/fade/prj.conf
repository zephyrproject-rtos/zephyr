## CMakeLists.txt
```
# SPDX-License-Identifier: Apache-2.0

cmake_minimum_required(VERSION 3.20.0)

find_package(Zephyr REQUIRED HINTS $ENV{ZEPHYR_BASE})
project(fade)

target_sources(app PRIVATE src/app.cpp)

zephyr_compile_options(-Wno-unused-variable -Wno-comment)
```

## sample.yaml
```
sample:
  name: fade sample

common:
  tags:
    - arduino-core
  required_snippets:
    - arduino-core
  platform_allow:
    - arduino_mkrzero/samd21g18a
    - arduino_nano_33_ble/nrf52840
    - arduino_nano_33_ble/nrf52840/sense
    - arduino_nano_33_iot/samd21g18a
    - beagleconnect_freedom/cc1352p7
    - cc3220sf_launchxl/cc3220sf
    - nrf52840dk/nrf52840
    - nrf9160dk/nrf9160
    - rpi_pico/rp2040

tests:
  sample.arduino-core.fade.build:
    build_only: true
```

## prj.conf
```kconfig
CONFIG_ARDUINO_API=y
CONFIG_PWM=y
```

## src/app.cpp
```c
/*
 * Copyright (c) 2022 TOKITA Hiroshi <tokita.hiroshi@fujitsu.com>
 *
 * SPDX-License-Identifier: Apache-2.0
 */

#include <Arduino.h>

const int led = 3;  // PWM output pin.
const int increments = 5;
const int wait_ms = 10;

void setup() {
  /* Pin that use as the PWM output need not be configured by pinMode() */
}

void loop() {
  int value = 0;
  while (value < 256) {
    analogWrite(led, value);
    value += increments;
    delay(wait_ms);
  }

  value = 255;
  while (value >= 0) {
    analogWrite(led, value);
    value -= increments;
    delay(wait_ms);
  }
}
```
