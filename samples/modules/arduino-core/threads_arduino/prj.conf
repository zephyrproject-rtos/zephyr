## CMakeLists.txt
```
# SPDX-License-Identifier: Apache-2.0

cmake_minimum_required(VERSION 3.20.0)

find_package(Zephyr REQUIRED HINTS $ENV{ZEPHYR_BASE})
project(threads)

target_sources(app PRIVATE src/main.cpp)

zephyr_compile_options(-Wno-unused-variable -Wno-comment)
```

## sample.yaml
```
sample:
  name: Threads Arduino sample

common:
  tags:
    - arduino-core
  required_snippets:
    - arduino-core
  platform_allow:
    - arduino_mkrzero/samd21g18a
    - arduino_nano_33_ble/nrf52840
    - arduino_nano_33_ble/nrf52840/sense
    - arduino_nano_33_iot/samd21g18a
    - beagleconnect_freedom/cc1352p7
    - cc3220sf_launchxl/cc3220sf
    - nrf52840dk/nrf52840
    - nrf9160dk/nrf9160
    - rpi_pico/rp2040

tests:
  sample.arduino-core.threads_arduino.build:
    build_only: true
```

## prj.conf
```kconfig
CONFIG_HEAP_MEM_POOL_SIZE=256
CONFIG_GPIO=y
CONFIG_ARDUINO_API=y
```

## src/main.cpp
```c
/*
 * Copyright (c) 2022 Dhruva Gole
 *
 * SPDX-License-Identifier: Apache-2.0
 */

#include <Arduino.h>

/* size of stack area used by each thread */
#define STACKSIZE 1024

/* scheduling priority used by each thread */
#define PRIORITY 7

void blink0(void)
{
	while (1) {
		digitalWrite(LED_BUILTIN, HIGH);
		delay(100);
		digitalWrite(LED_BUILTIN, LOW);
		delay(100);
	}
}

void blink1(void)
{
	while (1) {
		digitalWrite(D11, HIGH);
		delay(1000);
		digitalWrite(D11, LOW);
		delay(1000);
	}
}

K_THREAD_DEFINE(blink0_id, STACKSIZE, blink0, NULL, NULL, NULL, PRIORITY, 0, 0);
K_THREAD_DEFINE(blink1_id, STACKSIZE, blink1, NULL, NULL, NULL, PRIORITY, 0, 0);
K_THREAD_DEFINE(blink2_id, STACKSIZE, loop, NULL, NULL, NULL, PRIORITY, 0, 0);

void setup()
{
	pinMode(LED_BUILTIN, OUTPUT);
	pinMode(D11, OUTPUT);
	pinMode(D10, OUTPUT);
}
void loop()
{
		digitalWrite(D10, HIGH);
		delay(300);
		digitalWrite(D10, LOW);
		delay(300);
}
```
