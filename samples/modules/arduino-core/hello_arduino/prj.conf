## CMakeLists.txt
```
# SPDX-License-Identifier: Apache-2.0

cmake_minimum_required(VERSION 3.20.0)

find_package(Zephyr REQUIRED HINTS $ENV{ZEPHYR_BASE})
project(hello_world)

target_sources(app PRIVATE src/app.cpp)

zephyr_compile_options(-Wno-unused-variable -Wno-comment)
```

## sample.yaml
```
sample:
  name: Hello Arduino sample

common:
  tags:
    - arduino-core
  required_snippets:
    - arduino-core
  platform_allow:
    - arduino_mkrzero/samd21g18a
    - arduino_nano_33_ble/nrf52840
    - arduino_nano_33_ble/nrf52840/sense
    - arduino_nano_33_iot/samd21g18a
    - beagleconnect_freedom/cc1352p7
    - cc3220sf_launchxl/cc3220sf
    - nrf52840dk/nrf52840
    - nrf9160dk/nrf9160
    - rpi_pico/rp2040

tests:
  sample.arduino-core.hello_arduino.build:
    build_only: true
```

## prj.conf
```kconfig
CONFIG_ARDUINO_API=y
```

## src/app.cpp
```c
/*
 * Copyright (c) 2025 John Doe
 *
 * SPDX-License-Identifier: Apache-2.0
 */

#include <Arduino.h>
#include "zephyrSerial.h"


void setup() {
  // put your setup code here, to run once:
  Serial.begin(115200); // dummy as of now, need to study and refer https://docs.zephyrproject.org/latest/hardware/peripherals/uart.html
}
void loop() {
  char c = 'D';
  size_t ret1;
  size_t ret2;
  ret1 = Serial.print(c);
  ret2 = Serial.println("Hello, World!");
  printk("Sizes: %d %d\n", ret1, ret2);
  Serial.println();
  ret1 = Serial.print("My letter is: ");
  ret2 = Serial.println(c);
  printk("Sizes: %d %d\n", ret1, ret2);
  Serial.println();
  char myString[] = "Will it print?";
  ret1 = Serial.println(myString);
  printk("Size: %d \n\n\n", ret1);
  delay(1000); // 1 second delay
}
```
