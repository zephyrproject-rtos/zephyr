## CMakeLists.txt
```
# SPDX-License-Identifier: Apache-2.0

cmake_minimum_required(VERSION 3.20.0)

find_package(Zephyr REQUIRED HINTS $ENV{ZEPHYR_BASE})
project(button_press_led)

target_sources(app PRIVATE src/main.cpp)

zephyr_compile_options(-Wno-unused-variable -Wno-comment)
```

## sample.yaml
```
sample:
  name: Button press LED sample

common:
  tags:
    - arduino-core
  required_snippets:
    - arduino-core
  platform_allow:
    - arduino_mkrzero/samd21g18a
    - arduino_nano_33_ble/nrf52840
    - arduino_nano_33_ble/nrf52840/sense
    - arduino_nano_33_iot/samd21g18a
    - beagleconnect_freedom/cc1352p7
    - cc3220sf_launchxl/cc3220sf
    - nrf52840dk/nrf52840
    - nrf9160dk/nrf9160
    - rpi_pico/rp2040

tests:
  sample.arduino-core.button_press_led.build:
    build_only: true
```

## prj.conf
```kconfig
CONFIG_GPIO=y
CONFIG_ARDUINO_API=y
```

## src/main.cpp
```c
/*
 * Copyright (c) 2025 John Doe
 * SPDX-License-Identifier: Apache-2.0
 */

/* Button Press turns on inbuilt LED example */

#include <Arduino.h>

const int buttonPin = D9; // the number of the pushbutton pin
const int ledPin = 13;    // the number of the LED pin

// variables will change:
int buttonState = 0; // variable for reading the pushbutton status

void setup() {
  // initialize the LED pin as an output:
  pinMode(ledPin, OUTPUT);
  // initialize the pushbutton pin as an input:
  pinMode(buttonPin, INPUT);
}

void loop() {
  // read the state of the pushbutton value:
  buttonState = digitalRead(buttonPin);

  // check if the pushbutton is pressed. If it is, the buttonState is HIGH:
  if (buttonState == HIGH) {
    // turn LED on:
    digitalWrite(ledPin, HIGH);
  } else {
    // turn LED off:
    digitalWrite(ledPin, LOW);
  }
}
```
