## CMakeLists.txt
```
# SPDX-License-Identifier: Apache-2.0

cmake_minimum_required(VERSION 3.20.0)

find_package(Zephyr REQUIRED HINTS $ENV{ZEPHYR_BASE})
project(spi_controller)

target_sources(app PRIVATE src/app.cpp)

zephyr_compile_options(-Wno-unused-variable -Wno-comment)
```

## sample.yaml
```
sample:
  name: SPI controller sample

common:
  tags:
    - arduino-core
  required_snippets:
    - arduino-core
  platform_allow:
    - arduino_mkrzero/samd21g18a
    - arduino_nano_33_ble/nrf52840
    - arduino_nano_33_ble/nrf52840/sense
    - arduino_nano_33_iot/samd21g18a
    - beagleconnect_freedom/cc1352p7
    - cc3220sf_launchxl/cc3220sf
    - nrf52840dk/nrf52840
    - nrf9160dk/nrf9160
    - rpi_pico/rp2040

tests:
  sample.arduino-core.spi_controller.build:
    build_only: true
```

## prj.conf
```kconfig
CONFIG_CPP=y
CONFIG_ARDUINO_API=y
CONFIG_SPI=y
CONFIG_LOG=y
CONFIG_LOG_OUTPUT=y
CONFIG_LOG_MODE_IMMEDIATE=y
```

## src/app.cpp
```c
/*
 * Copyright (c) 2024 Ayush Singh <ayush@beagleboard.org>
 *
 * SPDX-License-Identifier: Apache-2.0
 */

#include "SPI.h"
#include <Arduino.h>

#define CHIPSELECT 3

static uint8_t data = 0;

void setup() {
  SPI.begin();
  pinMode(CHIPSELECT, OUTPUT);
  digitalWrite(CHIPSELECT, HIGH);
}

void loop() {
  SPI.beginTransaction(SPISettings(2000000, MSBFIRST, SPI_MODE0));
  digitalWrite(CHIPSELECT, LOW);
  SPI.transfer(data++);
  digitalWrite(CHIPSELECT, HIGH);
  SPI.endTransaction();
  delay(1000);
}
```
