## samples/modules/arduino-core/serial_event/sample.yaml
```yaml
sample:
  name: Serial Event sample

common:
  tags:
    - arduino-core
  required_snippets:
    - arduino-core
  platform_allow:
    - arduino_mkrzero/samd21g18a
    - arduino_nano_33_ble/nrf52840
    - arduino_nano_33_ble/nrf52840/sense
    - arduino_nano_33_iot/samd21g18a
    - beagleconnect_freedom/cc1352p7
    - cc3220sf_launchxl/cc3220sf
    - nrf52840dk/nrf52840
    - nrf9160dk/nrf9160
    - rpi_pico/rp2040

tests:
  sample.arduino-core.serial_event.build:
    build_only: true
```

## samples/modules/canopennode/sample.yaml
```yaml
sample:
  name: CANopenNode sample
common:
  tags:
    - can
    - canopen
  modules:
    - canopennode
  depends_on: can
  filter: dt_chosen_enabled("zephyr,canbus")
  harness: console
  harness_config:
    type: one_line
    regex:
      - "(.*)CANopen stack initialized"
tests:
  sample.modules.canopennode:
    depends_on: nvs
  sample.modules.canopennode.program_download:
    sysbuild: true
    depends_on: nvs
    platform_allow:
      - frdm_k64f
      - twr_ke18f
    integration_platforms:
      - frdm_k64f
    extra_args:
      canopennode_CONF_FILE=prj_img_mgmt.conf
      SB_CONFIG_BOOTLOADER_MCUBOOT=y

  sample.modules.canopennode.no_storage:
    extra_args: CONF_FILE=prj_no_storage.conf
```

## samples/modules/chre/sample.yaml
```yaml
sample:
  description: A simple echo app using Android's Context Hub Runtime
    Environment (CHRE).
  name: chre
tests:
  sample.modules.chre:
    tags: introduction chre
    platform_exclude: qemu_leon3
    modules:
      - chre
    harness: console
    harness_config:
      type: multi_line
      ordered: false
      regex:
        - "Hello CHRE!"
        - "I: EventLoop start.*"
        - "D: Instance ID 1 assigned to app ID 0x0000000000000001.*"
        - "EchoApp::nanoappStart\\(\\)"
        - "EchoApp::nanoappHandleEvent\\(sender_instance_id=0, event_type=1,
          event_data@(\\(nil\\))|0\\)"
        - "Event \\(1\\) complete!"
        - "EchoApp::nanoappEnd\\(\\)"
        - "I: Exiting EventLoop.*"
    integration_platforms:
      - native_posix
    filter: not CONFIG_MINIMAL_LIBC
```

## samples/modules/cmsis_dsp/moving_average/sample.yaml
```yaml
sample:
  description: Use CMSIS DSP to calculate moving average
  name: CMSIS DSP Moving Average
tests:
  sample.modules.cmsis_dsp.moving_average:
    tags:
      - samples
    integration_platforms:
      - qemu_cortex_m0
      - native_sim
    modules:
      - cmsis-dsp
    harness: console
    harness_config:
      type: multi_line
      regex:
        - "Input\\[00\\]:  0  0  0  0  0  0  0  0  0  0 | Output\\[00\\]:   0.00"
        - "Input\\[01\\]:  0  0  0  0  0  0  0  0  0  1 | Output\\[01\\]:   0.10"
        - "Input\\[02\\]:  0  0  0  0  0  0  0  0  1  2 | Output\\[02\\]:   0.30"
        - "Input\\[03\\]:  0  0  0  0  0  0  0  1  2  3 | Output\\[03\\]:   0.60"
        - "Input\\[04\\]:  0  0  0  0  0  0  1  2  3  4 | Output\\[04\\]:   1.00"
        - "Input\\[05\\]:  0  0  0  0  0  1  2  3  4  5 | Output\\[05\\]:   1.50"
        - "Input\\[06\\]:  0  0  0  0  1  2  3  4  5  6 | Output\\[06\\]:   2.10"
        - "Input\\[07\\]:  0  0  0  1  2  3  4  5  6  7 | Output\\[07\\]:   2.80"
        - "Input\\[08\\]:  0  0  1  2  3  4  5  6  7  8 | Output\\[08\\]:   3.60"
        - "Input\\[09\\]:  0  1  2  3  4  5  6  7  8  9 | Output\\[09\\]:   4.50"
        - "Input\\[10\\]:  1  2  3  4  5  6  7  8  9 10 | Output\\[10\\]:   5.50"
        - "Input\\[11\\]:  2  3  4  5  6  7  8  9 10 11 | Output\\[11\\]:   6.50"
        - "Input\\[12\\]:  3  4  5  6  7  8  9 10 11 12 | Output\\[12\\]:   7.50"
        - "Input\\[13\\]:  4  5  6  7  8  9 10 11 12 13 | Output\\[13\\]:   8.50"
        - "Input\\[14\\]:  5  6  7  8  9 10 11 12 13 14 | Output\\[14\\]:   9.50"
        - "Input\\[15\\]:  6  7  8  9 10 11 12 13 14 15 | Output\\[15\\]:  10.50"
        - "Input\\[16\\]:  7  8  9 10 11 12 13 14 15 16 | Output\\[16\\]:  11.50"
        - "Input\\[17\\]:  8  9 10 11 12 13 14 15 16 17 | Output\\[17\\]:  12.50"
        - "Input\\[18\\]:  9 10 11 12 13 14 15 16 17 18 | Output\\[18\\]:  13.50"
        - "Input\\[19\\]: 10 11 12 13 14 15 16 17 18 19 | Output\\[19\\]:  14.50"
        - "Input\\[20\\]: 11 12 13 14 15 16 17 18 19 20 | Output\\[20\\]:  15.50"
        - "Input\\[21\\]: 12 13 14 15 16 17 18 19 20 21 | Output\\[21\\]:  16.50"
        - "Input\\[22\\]: 13 14 15 16 17 18 19 20 21 22 | Output\\[22\\]:  17.50"
        - "Input\\[23\\]: 14 15 16 17 18 19 20 21 22 23 | Output\\[23\\]:  18.50"
        - "Input\\[24\\]: 15 16 17 18 19 20 21 22 23 24 | Output\\[24\\]:  19.50"
        - "Input\\[25\\]: 16 17 18 19 20 21 22 23 24 25 | Output\\[25\\]:  20.50"
        - "Input\\[26\\]: 17 18 19 20 21 22 23 24 25 26 | Output\\[26\\]:  21.50"
        - "Input\\[27\\]: 18 19 20 21 22 23 24 25 26 27 | Output\\[27\\]:  22.50"
        - "Input\\[28\\]: 19 20 21 22 23 24 25 26 27 28 | Output\\[28\\]:  23.50"
        - "Input\\[29\\]: 20 21 22 23 24 25 26 27 28 29 | Output\\[29\\]:  24.50"
        - "Input\\[30\\]: 21 22 23 24 25 26 27 28 29 30 | Output\\[30\\]:  25.50"
        - "Input\\[31\\]: 22 23 24 25 26 27 28 29 30 31 | Output\\[31\\]:  26.50"
```

## samples/modules/cmsis_dsp/number_crunching/sample.yaml
```yaml
sample:
  description: An application that demonstrates
    how to integrate a proprietary library which
    executes math functions on target.
  name: Proprietary Library
tests:
  sample.app_dev.number_crunching:
    integration_platforms:
      - native_sim
      - imx8mp_evk/mimx8ml8/adsp
    tags: external
    harness: console
    harness_config:
      type: multi_line
      regex:
        - "Number crunching example!"
        - "[Library Test]"
```

## samples/modules/embarc_mli/example_cifar10_caffe/sample.yaml
```yaml
sample:
  description: cifar10_caffe embarc_mli sample
  name: example_cifar10_caffe
tests:
  sample.embarc_mli.example_cifar10_caffe:
    platform_allow: nsim_em
    tags: embarc_mli
```

## samples/modules/embarc_mli/example_har_smartphone/sample.yaml
```yaml
sample:
  description: har_smartphone embarc_mli sample
  name: example_har_smartphone
tests:
  sample.embarc_mli.example_har_smartphone:
    platform_allow: nsim_em
    tags: embarc_mli
```

## samples/modules/embarc_mli/hello_world/sample.yaml
```yaml
sample:
  description: simple hello_world embarc_mli sample
  name: hello_world
tests:
  sample.embarc_mli.hello_world:
    platform_allow: nsim_em
    tags: embarc_mli
```

## samples/modules/libsrtp/rtpw/Kconfig
```kconfig
# Copyright (c) 2025 Sayed Naser Moravej <seyednasermoravej@gmail.com>
# SPDX-License-Identifier: Apache-2.0

mainmenu "RTPW Sample Application"

config NET_SAMPLE_SRTP_KEY
	string "SRTP master key for RTPW example."
	default "c1eec3717da76195bb878578790af71c4ee9f859e197a414a78d5abc7451"
	help
	  This key in hexadecimal which is used by the application. You can override it in prj.conf
	  or via menuconfig / guiconfig.

choice
	prompt "Program mode"
	default NET_SAMPLE_SENDER
	help
	  Select whether this application runs as sender or receiver.

config NET_SAMPLE_SENDER
	bool "Sender mode"
	help
	  Build the application as an RTP sender.

config NET_SAMPLE_RECEIVER
	bool "Receiver mode"
	help
	  Build the application as an RTP receiver.

endchoice

config NET_SAMPLE_SRTP_SERVER_PORT
	int "SRTP port"
	default 9999
	help
	  SRTP port that the application sends or receives over that port.

source "Kconfig.zephyr"
```

## samples/modules/libsrtp/rtpw/sample.yaml
```yaml
sample:
  name: sender and receiver (S)RTP protocol
tests:
  samples.modules.libsrtp.rtpw.sender:
    depends_on: netif
    tags:
      - net
    build_only: true
    extra_args: OVERLAY_CONFIG=overlay-sender.conf
    platform_allow:
      - frdm_mcxn947/mcxn947/cpu0
      - nucleo_n657x0_q/stm32n657xx/sb

  samples.modules.libsrtp.rtpw.receiver:
    depends_on: netif
    tags:
      - net
    build_only: true
    extra_args: OVERLAY_CONFIG=overlay-receiver.conf
    platform_allow:
      - frdm_mcxn947/mcxn947/cpu0
      - nucleo_n657x0_q/stm32n657xx/sb
```

## samples/modules/lvgl/accelerometer_chart/Kconfig
```kconfig
# Copyright (c) 2023 Benjamin Cabé <benjamin@zephyrproject.org>
# SPDX-License-Identifier: Apache-2.0

config SAMPLE_CHART_POINTS_PER_SERIES
	int "Number of points per series"
	default 50
	range 10 200
	help
	  Maximum number of points per series in the accelerometer chart.
	  Warning: More points means more memory usage, and slower rendering!

config SAMPLE_ACCEL_SAMPLING_RATE
	int "Accelerometer sampling rate (Hz)"
	default 50
	range 1 100

source "Kconfig.zephyr"
```

## samples/modules/lvgl/accelerometer_chart/sample.yaml
```yaml
sample:
  description: Real-time visualization of acceleration data using LVGL chart widget
  name: LVGL acceleration chart
tests:
  sample.modules.lvgl.accelerometer_chart:
    filter: dt_chosen_enabled("zephyr,display") and dt_alias_exists("accel0")
    min_flash: 250
    min_ram: 32
    harness: none
    tags:
      - samples
      - display
      - gui
      - lvgl
    modules:
      - lvgl
    integration_platforms:
      - native_sim/native/64
```

## samples/modules/lvgl/demos/Kconfig
```kconfig
# Copyright (c) 2023 Fabian Blatz <fabianblatz@gmail.com>
# SPDX-License-Identifier: Apache-2.0

choice LV_Z_DEMO
	prompt "LVGL demo to build"
	default LV_Z_DEMO_MUSIC
	help
	  Demo application to build.

config LV_Z_DEMO_MUSIC
	bool "LVGL music demo"
	select LV_USE_DEMO_MUSIC
	help
	  Build music player demo application.

config LV_Z_DEMO_BENCHMARK
	bool "LVGL benchmark demo"
	select LV_USE_DEMO_BENCHMARK
	select LV_USE_DEMO_WIDGETS
	imply LV_USE_PERF_MONITOR
	imply LV_USE_SYSMON
	help
	  Build benchmarking demo application.

config LV_Z_DEMO_STRESS
	bool "LVGL stress demo"
	select LV_USE_DEMO_STRESS
	help
	  Build stress testing demo application.

config LV_Z_DEMO_WIDGETS
	bool "LVGL widgets demo"
	select LV_USE_DEMO_WIDGETS
	help
	  Build widgets demo application.

config LV_Z_DEMO_KEYPAD_AND_ENCODER
	bool "LVGL keypad and encoder demo"
	select LV_USE_DEMO_KEYPAD_AND_ENCODER
	help
	  Build keypad and encoder demo application.

config LV_Z_DEMO_RENDER
	bool "LVGL render demo"
	select LV_USE_DEMO_RENDER
	help
	  Build render demo application.

endchoice

if LV_Z_DEMO_RENDER

config LV_Z_DEMO_RENDER_SCENE_DYNAMIC
	bool "Switch scenes dynamically"
	help
	  Switch between scenes to render dynamically.

config LV_Z_DEMO_RENDER_SCENE_INDEX
	int "Index of the rendered scene"
	depends on !LV_Z_DEMO_RENDER_SCENE_DYNAMIC
	default 0
	range 0 11
	help
	  Render scene by its index (refer to lv_demo_render.h)

config LV_Z_DEMO_RENDER_DYNAMIC_SCENE_TIMEOUT
	int "Seconds each rendered scene is shown"
	depends on LV_Z_DEMO_RENDER_SCENE_DYNAMIC
	default 3
	help
	  Seconds each rendered scenar is shown

endif

source "Kconfig.zephyr"
```

## samples/modules/lvgl/demos/boards/apollo510_evb.conf
```kconfig
CONFIG_LV_USE_DRAW_AMBIQ=y
CONFIG_LV_USE_AMBIQ_VG=y
CONFIG_LV_DRAW_BUF_ALIGN=8
CONFIG_LV_ATTRIBUTE_MEM_ALIGN_SIZE=8
CONFIG_LV_DRAW_LAYER_SIMPLE_BUF_SIZE=262144
CONFIG_LV_BIN_DECODER_RAM_LOAD=y
# CONFIG_LV_USE_LOG=y
# CONFIG_LV_LOG_LEVEL_WARN=y
# CONFIG_LV_LOG_LEVEL_INFO=y
CONFIG_LV_USE_SYSMON=y
CONFIG_LV_USE_PERF_MONITOR=y
CONFIG_LV_USE_MEM_MONITOR=y
CONFIG_LV_PERF_MONITOR_ALIGN_BOTTOM_MID=y
CONFIG_LV_MEM_MONITOR_ALIGN_TOP_MID=y
CONFIG_LV_COLOR_DEPTH_16=y
CONFIG_LV_DEF_REFR_PERIOD=16

CONFIG_LV_Z_LARGE_CONST_SECTION=".gfx.assets"
CONFIG_LV_Z_COLOR_24_BGR_TO_RGB=n
CONFIG_LV_Z_FLUSH_THREAD=y
CONFIG_LV_Z_AUTO_INIT=y
CONFIG_LV_Z_RUN_LVGL_ON_WORKQUEUE=n
CONFIG_LV_Z_USE_OSAL=y
CONFIG_LV_Z_MEM_POOL_SYS_HEAP=y
CONFIG_LV_Z_MEM_POOL_SIZE=262144
CONFIG_LV_Z_MEMORY_POOL_CUSTOM_SECTION=y
CONFIG_LV_Z_VDB_SIZE=100
CONFIG_LV_Z_MONOCHROME_CONVERSION_BUFFER=n
CONFIG_LV_Z_BUFFER_ALLOC_DYNAMIC=y
CONFIG_LV_Z_REFRESH_AREA_WIDTH=392
CONFIG_LV_Z_REFRESH_AREA_HEIGHT=392

#CONFIG_NO_OPTIMIZATIONS=y
CONFIG_MAIN_STACK_SIZE=8192
CONFIG_SYSTEM_WORKQUEUE_STACK_SIZE=2048
CONFIG_CPU_LOAD=y
CONFIG_SYS_HEAP_RUNTIME_STATS=y



# Dynamic thread support
CONFIG_DYNAMIC_THREAD=y
CONFIG_DYNAMIC_THREAD_ALLOC=y
CONFIG_DYNAMIC_THREAD_PREFER_ALLOC=y


CONFIG_HEAP_MEM_POOL_SIZE=20480
CONFIG_LV_Z_FLUSH_THREAD_STACK_SIZE=4096

CONFIG_INPUT_MODE_SYNCHRONOUS=y

# PSRAM
CONFIG_MEMC=y
CONFIG_MEMC_MSPI_APS_Z8=y
CONFIG_MEMC_MSPI_APS51216BA=y
```

## samples/modules/lvgl/demos/boards/ek_ra8p1_r7ka8p1kflcac_cm85.conf
```kconfig
# Copyright (c) 2025 Renesas Electronics Corporation
# SPDX-License-Identifier: Apache-2.0

CONFIG_LV_Z_MEM_POOL_SIZE=245760
CONFIG_LV_DRAW_LAYER_SIMPLE_BUF_SIZE=49152
CONFIG_MAIN_STACK_SIZE=8192
CONFIG_IDLE_STACK_SIZE=1024
```

## samples/modules/lvgl/demos/boards/m5stack_core2_procpu.conf
```kconfig
# Copyright 2023 Fabian Blatz <fabianblatz@gmail.com>
# SPDX-License-Identifier: Apache-2.0

CONFIG_MAIN_STACK_SIZE=4096
```

## samples/modules/lvgl/demos/boards/mimxrt1170_evk_mimxrt1176_cm7_A.conf
```kconfig
# Copyright 2023 Fabian Blatz <fabianblatz@gmail.com>
# SPDX-License-Identifier: Apache-2.0

# Enable PXP DMA engine and set rotation angle to 0 degrees.
# This allows us to verify the DMA driver functions without altering
# the output image
CONFIG_DMA=y
CONFIG_MCUX_ELCDIF_PXP=y
```

## samples/modules/lvgl/demos/boards/mimxrt595_evk_mimxrt595s_cm33.conf
```kconfig
#
# Copyright 2024, NXP
#
# SPDX-License-Identifier: Apache-2.0
#

# Sample will allocate buffer equal to: (panelwidth / 8) * (panelwidth / 4) * pixel depth. For a
# 1280x720 display in a 16-bpp format (e.g. RGB565), this is (1280 / 8) * (720 / 4) * 2 = 57600
# bytes. We include 128 bytes of padding for kernel heap structures
CONFIG_HEAP_MEM_POOL_SIZE=57600
```

## samples/modules/lvgl/demos/boards/mimxrt700_evk_mimxrt798s_cm33_cpu0.conf
```kconfig
#
# Copyright 2025 NXP
#
# SPDX-License-Identifier: Apache-2.0
#

CONFIG_LV_Z_MEM_POOL_SIZE=81920
# RT700 uses DC8000 to drive all panels which requires a 64 byte align of buffer address and stride.
CONFIG_LV_DRAW_BUF_STRIDE_ALIGN=64
CONFIG_LV_DRAW_BUF_ALIGN=64
```

## samples/modules/lvgl/demos/boards/native_posix.conf
```kconfig
# Copyright 2023 Fabian Blatz <fabianblatz@gmail.com>
# SPDX-License-Identifier: Apache-2.0

CONFIG_LV_COLOR_DEPTH_32=y
```

## samples/modules/lvgl/demos/boards/native_sim_native_64.conf
```kconfig
# Copyright 2023 Fabian Blatz <fabianblatz@gmail.com>
# SPDX-License-Identifier: Apache-2.0

CONFIG_LV_COLOR_DEPTH_32=y
CONFIG_LV_Z_MEM_POOL_SIZE=75264
```

## samples/modules/lvgl/demos/boards/qemu_riscv64.conf
```kconfig
# SPDX-License-Identifier: Apache-2.0

CONFIG_MAIN_STACK_SIZE=16384
CONFIG_LV_Z_MEM_POOL_SIZE=98304
CONFIG_LV_DRAW_LAYER_SIMPLE_BUF_SIZE=32768
CONFIG_LV_DRAW_LAYER_MAX_MEMORY=98304
```
