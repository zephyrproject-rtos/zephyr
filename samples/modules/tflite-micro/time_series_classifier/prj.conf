## CMakeLists.txt
```
cmake_minimum_required(VERSION 3.20.0)

find_package(Zephyr REQUIRED HINTS $ENV{ZEPHYR_BASE})
project(tflm_time_series_classifier)

# These samples use local static initialization. Since Zephyr doesn't support the
# C++ ABI for thread-safe initialization of local statics and the constructors don't
# appear to require thread safety, we turn it off in the C++ compiler.
set(NO_THREADSAFE_STATICS $<TARGET_PROPERTY:compiler-cpp,no_threadsafe_statics>)
zephyr_compile_options($<$<COMPILE_LANGUAGE:CXX>:${NO_THREADSAFE_STATICS}>)

file(GLOB app_sources src/*)
target_sources(app PRIVATE ${app_sources})
```

## sample.yaml
```
sample:
  description: Time-series TensorFlow Lite Micro classifier sample
  name: time series tensorflow classifier
common:
  tags: tensorflow
  modules:
    - tflite-micro
  harness: console
  harness_config:
    type: multi_line
    ordered: false
    regex:
      - "prediction:.*, score:.*"
      - "result: PASS"
tests:
  sample.tensorflow.time_series_classifier:
    platform_allow:
      - qemu_x86
      - qemu_x86_64
    integration_platforms:
      - qemu_x86
    tags: tensorflow
    filter: CONFIG_FULL_LIBC_SUPPORTED

  sample.tensorflow.time_series_classifier.cmsis_nn:
    tags: tensorflow
    platform_allow:
      - mps3/corstone300/fvp
      - ek_ra8m1
    integration_platforms:
      - mps3/corstone300/fvp
      - ek_ra8m1
    extra_configs:
      - CONFIG_TENSORFLOW_LITE_MICRO_CMSIS_NN_KERNELS=y
```

## prj.conf
```kconfig
# Copyright 2019 The TensorFlow Authors. All Rights Reserved.
#
# Licensed under the Apache License, Version 2.0 (the "License");
# you may not use this file except in compliance with the License.
# You may obtain a copy of the License at
#
#    http://www.apache.org/licenses/LICENSE-2.0
#
# Unless required by applicable law or agreed to in writing, software
# distributed under the License is distributed on an "AS IS" BASIS,
# WITHOUT WARRANTIES OR CONDITIONS OF ANY KIND, either express or implied.
# See the License for the specific language governing permissions and
# limitations under the License.
# ==============================================================================s
CONFIG_CPP=y
CONFIG_STD_CPP17=y
CONFIG_TENSORFLOW_LITE_MICRO=y
CONFIG_MAIN_STACK_SIZE=2048
CONFIG_REQUIRES_FLOAT_PRINTF=y
```

## src/main.c
```c
/*
 * SPDX-FileCopyrightText: Copyright 2020 The TensorFlow Authors. All Rights Reserved.
 * SPDX-License-Identifier: Apache-2.0
 */

/*
 * Copyright 2020 The TensorFlow Authors. All Rights Reserved.
 *
 * Licensed under the Apache License, Version 2.0 (the "License");
 * you may not use this file except in compliance with the License.
 * You may obtain a copy of the License at
 *
 *     http://www.apache.org/licenses/LICENSE-2.0
 *
 * Unless required by applicable law or agreed to in writing, software
 * distributed under the License is distributed on an "AS IS" BASIS,
 * WITHOUT WARRANTIES OR CONDITIONS OF ANY KIND, either express or implied.
 * See the License for the specific language governing permissions and
 * limitations under the License.
 */

#include "main_functions.h"

/* Increase number of loops to see full period of the sine curve */
#define NUM_LOOPS 10

/* This is the default main used on systems that have the standard C entry
 * point. Other devices (for example FreeRTOS or ESP32) that have different
 * requirements for entry code (like an app_main function) should specialize
 * this main.cc file in a target-specific subfolder.
 */
int main(int argc, char *argv[])
{
	setup();
	/* Note: Modified from original while(true) to accommodate CI */
	for (int i = 0; i < NUM_LOOPS; i++) {
		loop();
	}
	return 0;
}
```

## src/assert.cpp
```c
/*
 * SPDX-FileCopyrightText: Copyright 2020 The TensorFlow Authors. All Rights Reserved.
 * SPDX-License-Identifier: Apache-2.0
 */

/*
 * Copyright 2020 The TensorFlow Authors. All Rights Reserved.
 *
 * Licensed under the Apache License, Version 2.0 (the "License");
 * you may not use this file except in compliance with the License.
 * You may obtain a copy of the License at
 *
 *     http://www.apache.org/licenses/LICENSE-2.0
 *
 * Unless required by applicable law or agreed to in writing, software
 * distributed under the License is distributed on an "AS IS" BASIS,
 * WITHOUT WARRANTIES OR CONDITIONS OF ANY KIND, either express or implied.
 * See the License for the specific language governing permissions and
 * limitations under the License.
 */

extern "C" {

void __assert_func(const char *, int, const char *, const char *)
{
}

}
```

## src/features.c
```c
/*
 * SPDX-FileCopyrightText: Copyright (c) 2026 Mahad Faisal
 * SPDX-License-Identifier: Apache-2.0
 */

#include "features.h"

#include <math.h>
#include <stdbool.h>
#include <stddef.h>
#include <stdint.h>

static bool crossed_zero(int16_t previous, int16_t current)
{
	return (previous < 0 && current >= 0) ||
		       (previous >= 0 && current < 0);
}

void time_series_extract_features(const int16_t *samples, size_t len,
				  struct time_series_features *features)
{
	float sum = 0.0f;
	float sum_sq = 0.0f;
	float peak = 0.0f;
	uint32_t zero_crossings;

	zero_crossings = 0U;

	for (size_t i = 0; i < len; i++) {
		float value = (float)samples[i];
		float abs_value = fabsf(value);

		sum += value;
		sum_sq += value * value;

		if (abs_value > peak) {
			peak = abs_value;
		}

		if (i > 0U && crossed_zero(samples[i - 1U], samples[i])) {
			zero_crossings++;
		}
	}

	features->mean = sum / (float)len;
	features->rms = sqrtf(sum_sq / (float)len);
	features->peak = peak;
	features->zero_crossing_rate = (float)zero_crossings / (float)(len - 1U);
	features->energy = sum_sq;
}
```

## src/features.h
```c
/*
 * SPDX-FileCopyrightText: Copyright (c) 2026 Mahad Faisal
 * SPDX-License-Identifier: Apache-2.0
 */

#pragma once

#include <stddef.h>
#include <stdint.h>

#ifdef __cplusplus
extern "C" {
#endif

struct time_series_features {
	float mean;
	float rms;
	float peak;
	float zero_crossing_rate;
	float energy;
};

void time_series_extract_features(const int16_t *samples,
				  size_t len,
				  struct time_series_features *features);

#ifdef __cplusplus
}
#endif
```

## src/input_data.c
```c
/*
 * SPDX-FileCopyrightText: Copyright (c) 2026 Mahad Faisal
 * SPDX-License-Identifier: Apache-2.0
 */

#include "input_data.h"

static const int16_t normal_window[TIME_SERIES_WINDOW_SIZE] = {
0, 195, 383, 556, 707, 831, 924, 981,
1000, 981, 924, 831, 707, 556, 383, 195,
0, -195, -383, -556, -707, -831, -924, -981,
-1000, -981, -924, -831, -707, -556, -383, -195,
0, 195, 383, 556, 707, 831, 924, 981,
1000, 981, 924, 831, 707, 556, 383, 195,
0, -195, -383, -556, -707, -831, -924, -981,
-1000, -981, -924, -831, -707, -556, -383, -195,
};

static const int16_t low_frequency_window[TIME_SERIES_WINDOW_SIZE] = {
0, 98, 195, 290, 383, 471, 556, 634,
707, 773, 831, 882, 924, 957, 981, 995,
1000, 995, 981, 957, 924, 882, 831, 773,
707, 634, 556, 471, 383, 290, 195, 98,
0, -98, -195, -290, -383, -471, -556, -634,
-707, -773, -831, -882, -924, -957, -981, -995,
-1000, -995, -981, -957, -924, -882, -831, -773,
-707, -634, -556, -471, -383, -290, -195, -98,
};

static const int16_t transient_window[TIME_SERIES_WINDOW_SIZE] = {
0, 98, 195, 290, 383, 471, 556, 634,
707, 773, 831, 882, 924, 957, 981, 995,
3200, 995, 981, 957, 924, 882, 831, 773,
707, 634, 556, 471, 383, 290, 195, 98,
0, -98, -195, -290, -383, -471, -556, -634,
-707, -773, -831, -882, -924, -957, -981, -995,
-2800, -995, -981, -957, -924, -882, -831, -773,
-707, -634, -556, -471, -383, -290, -195, -98,
};

static const struct time_series_window windows[TIME_SERIES_NUM_WINDOWS] = {
{
.name = "normal",
.label = TIME_SERIES_NORMAL,
.samples = normal_window,
.len = TIME_SERIES_WINDOW_SIZE,
},
{
.name = "low_frequency",
.label = TIME_SERIES_LOW_FREQUENCY,
.samples = low_frequency_window,
.len = TIME_SERIES_WINDOW_SIZE,
},
{
.name = "transient",
.label = TIME_SERIES_TRANSIENT,
.samples = transient_window,
.len = TIME_SERIES_WINDOW_SIZE,
},
};

const struct time_series_window *time_series_get_window(size_t index)
{
return &windows[index % TIME_SERIES_NUM_WINDOWS];
}

const char *time_series_label_name(enum time_series_label label)
{
switch (label) {
case TIME_SERIES_NORMAL:
return "normal";
case TIME_SERIES_LOW_FREQUENCY:
return "low_frequency";
case TIME_SERIES_TRANSIENT:
return "transient";
default:
return "unknown";
}
}
```

## src/input_data.h
```c
/*
 * SPDX-FileCopyrightText: Copyright (c) 2026 Mahad Faisal
 * SPDX-License-Identifier: Apache-2.0
 */

#pragma once

#include <stddef.h>
#include <stdint.h>

#ifdef __cplusplus
extern "C" {
#endif

#define TIME_SERIES_WINDOW_SIZE 64U
#define TIME_SERIES_NUM_WINDOWS 3U

enum time_series_label {
TIME_SERIES_NORMAL = 0,
TIME_SERIES_LOW_FREQUENCY = 1,
TIME_SERIES_TRANSIENT = 2,
};

struct time_series_window {
const char *name;
enum time_series_label label;
const int16_t *samples;
size_t len;
};

const struct time_series_window *time_series_get_window(size_t index);
const char *time_series_label_name(enum time_series_label label);

#ifdef __cplusplus
}
#endif
```

## src/main_functions.cpp
```c
/*
 * Copyright 2020 The TensorFlow Authors. All Rights Reserved.
 * Copyright (c) 2025 Aerlync Labs Inc.
 * Copyright (c) 2026 Mahad Faisal
 *
 * SPDX-License-Identifier: Apache-2.0
 */

#include "main_functions.h"

#include <math.h>

#include <tensorflow/lite/micro/micro_interpreter.h>
#include <tensorflow/lite/micro/micro_log.h>
#include <tensorflow/lite/micro/micro_mutable_op_resolver.h>
#include <tensorflow/lite/micro/system_setup.h>
#include <tensorflow/lite/schema/schema_generated.h>
#include <zephyr/kernel.h>

#include "features.h"
#include "input_data.h"
#include "model.hpp"

namespace {
const tflite::Model *model = nullptr;
tflite::MicroInterpreter *interpreter = nullptr;
TfLiteTensor *input = nullptr;
TfLiteTensor *output = nullptr;
size_t inference_count = 0U;

constexpr int kTensorArenaSize = 3000;
uint8_t tensor_arena[kTensorArenaSize];

float normalize_feature(size_t index, const struct time_series_features *features)
{
switch (index) {
case 0:
return features->mean / 3200.0f;
case 1:
return features->rms / 1200.0f;
case 2:
return features->peak / 3200.0f;
case 3:
return features->zero_crossing_rate / 0.10f;
default:
return 0.0f;
}
}

int8_t quantize_input(float value)
{
int32_t quantized = (int32_t)roundf(value / input->params.scale) +
    input->params.zero_point;

if (quantized > 127) {
return 127;
}

if (quantized < -128) {
return -128;
}

return (int8_t)quantized;
}

float dequantize_output(int8_t value)
{
return ((float)value - (float)output->params.zero_point) *
       output->params.scale;
}

enum time_series_label output_to_label(size_t index)
{
switch (index) {
case 0:
return TIME_SERIES_NORMAL;
case 1:
return TIME_SERIES_LOW_FREQUENCY;
case 2:
return TIME_SERIES_TRANSIENT;
default:
return TIME_SERIES_NORMAL;
}
}
}  /* namespace */

void setup(void)
{
model = tflite::GetModel(g_model);
if (model->version() != TFLITE_SCHEMA_VERSION) {
MicroPrintf("Model schema version %d not equal to supported version %d.",
    model->version(), TFLITE_SCHEMA_VERSION);
return;
}

static tflite::MicroMutableOpResolver<1> resolver;
resolver.AddFullyConnected();

static tflite::MicroInterpreter static_interpreter(
model, resolver, tensor_arena, kTensorArenaSize);
interpreter = &static_interpreter;

TfLiteStatus allocate_status = interpreter->AllocateTensors();
if (allocate_status != kTfLiteOk) {
MicroPrintf("AllocateTensors() failed");
return;
}

input = interpreter->input(0);
output = interpreter->output(0);

inference_count = 0U;
}

void loop(void)
{
const struct time_series_window *window =
time_series_get_window(inference_count);
struct time_series_features features;
enum time_series_label predicted;
float best_score;
size_t best_index = 0U;

time_series_extract_features(window->samples, window->len, &features);

for (size_t i = 0; i < 4U; i++) {
input->data.int8[i] = quantize_input(normalize_feature(i, &features));
}

uint32_t start_cycles = k_cycle_get_32();
TfLiteStatus invoke_status = interpreter->Invoke();
uint32_t end_cycles = k_cycle_get_32();
uint32_t invoke_cycles = end_cycles - start_cycles;
uint32_t invoke_us = (uint32_t)(k_cyc_to_ns_floor64(invoke_cycles) / 1000U);

if (invoke_status != kTfLiteOk) {
MicroPrintf("Invoke failed");
return;
}

best_score = dequantize_output(output->data.int8[0]);
for (size_t i = 1U; i < 3U; i++) {
float score = dequantize_output(output->data.int8[i]);

if (score > best_score) {
best_score = score;
best_index = i;
}
}

predicted = output_to_label(best_index);

MicroPrintf("input_window: %s\n", window->name);
MicroPrintf("features: mean=%f, rms=%f, peak=%f, zcr=%f\n",
    (double)features.mean,
    (double)features.rms,
    (double)features.peak,
    (double)features.zero_crossing_rate);
MicroPrintf("invoke_cycles: %u, invoke_time_us: %u\n",
    (unsigned int)invoke_cycles, (unsigned int)invoke_us);
MicroPrintf("prediction: %s, score: %f\n",
    time_series_label_name(predicted),
    (double)best_score);
MicroPrintf("result: %s\n",
    predicted == window->label ? "PASS" : "FAIL");

inference_count++;
if (inference_count >= TIME_SERIES_NUM_WINDOWS) {
inference_count = 0U;
}
}
```

## src/main_functions.h
```c
/*
 * SPDX-FileCopyrightText: Copyright 2020 The TensorFlow Authors. All Rights Reserved.
 * SPDX-License-Identifier: Apache-2.0
 */

/*
 * Copyright 2020 The TensorFlow Authors. All Rights Reserved.
 *
 * Licensed under the Apache License, Version 2.0 (the "License");
 * you may not use this file except in compliance with the License.
 * You may obtain a copy of the License at
 *
 *     http://www.apache.org/licenses/LICENSE-2.0
 *
 * Unless required by applicable law or agreed to in writing, software
 * distributed under the License is distributed on an "AS IS" BASIS,
 * WITHOUT WARRANTIES OR CONDITIONS OF ANY KIND, either express or implied.
 * See the License for the specific language governing permissions and
 * limitations under the License.
 */

#ifndef TENSORFLOW_LITE_MICRO_EXAMPLES_HELLO_WORLD_MAIN_FUNCTIONS_H_
#define TENSORFLOW_LITE_MICRO_EXAMPLES_HELLO_WORLD_MAIN_FUNCTIONS_H_

/* Expose a C friendly interface for main functions. */
#ifdef __cplusplus
extern "C" {
#endif

/* Initializes all data needed for the example. The name is important, and needs
 * to be setup() for Arduino compatibility.
 */
void setup(void);

/* Runs one iteration of data gathering and inference. This should be called
 * repeatedly from the application code. The name needs to be loop() for Arduino
 * compatibility.
 */
void loop(void);

#ifdef __cplusplus
}
#endif

#endif /* TENSORFLOW_LITE_MICRO_EXAMPLES_HELLO_WORLD_MAIN_FUNCTIONS_H_ */
```

## src/model.cpp
```c
/*
 * SPDX-FileCopyrightText: Copyright (c) 2026 Mahad Faisal
 * SPDX-License-Identifier: Apache-2.0
 */

#include "model.hpp"

#include <cstdint>

alignas(16) const unsigned char g_model[] = {
	0x1c, 0x00, 0x00, 0x00, 0x54, 0x46, 0x4c, 0x33, 0x14, 0x00, 0x20, 0x00,
	0x1c, 0x00, 0x18, 0x00, 0x14, 0x00, 0x10, 0x00, 0x0c, 0x00, 0x00, 0x00,
	0x08, 0x00, 0x04, 0x00, 0x14, 0x00, 0x00, 0x00, 0x1c, 0x00, 0x00, 0x00,
	0x98, 0x00, 0x00, 0x00, 0xf0, 0x00, 0x00, 0x00, 0x4c, 0x02, 0x00, 0x00,
	0x5c, 0x02, 0x00, 0x00, 0xe8, 0x07, 0x00, 0x00, 0x03, 0x00, 0x00, 0x00,
	0x01, 0x00, 0x00, 0x00, 0x10, 0x00, 0x00, 0x00, 0x00, 0x00, 0x0a, 0x00,
	0x10, 0x00, 0x0c, 0x00, 0x08, 0x00, 0x04, 0x00, 0x0a, 0x00, 0x00, 0x00,
	0x0c, 0x00, 0x00, 0x00, 0x1c, 0x00, 0x00, 0x00, 0x3c, 0x00, 0x00, 0x00,
	0x0f, 0x00, 0x00, 0x00, 0x73, 0x65, 0x72, 0x76, 0x69, 0x6e, 0x67, 0x5f,
	0x64, 0x65, 0x66, 0x61, 0x75, 0x6c, 0x74, 0x00, 0x01, 0x00, 0x00, 0x00,
	0x04, 0x00, 0x00, 0x00, 0x90, 0xff, 0xff, 0xff, 0x06, 0x00, 0x00, 0x00,
	0x04, 0x00, 0x00, 0x00, 0x08, 0x00, 0x00, 0x00, 0x6f, 0x75, 0x74, 0x70,
	0x75, 0x74, 0x5f, 0x30, 0x00, 0x00, 0x00, 0x00, 0x01, 0x00, 0x00, 0x00,
	0x04, 0x00, 0x00, 0x00, 0x4e, 0xfe, 0xff, 0xff, 0x04, 0x00, 0x00, 0x00,
	0x0c, 0x00, 0x00, 0x00, 0x6b, 0x65, 0x72, 0x61, 0x73, 0x5f, 0x74, 0x65,
	0x6e, 0x73, 0x6f, 0x72, 0x00, 0x00, 0x00, 0x00, 0x02, 0x00, 0x00, 0x00,
	0x34, 0x00, 0x00, 0x00, 0x04, 0x00, 0x00, 0x00, 0xdc, 0xff, 0xff, 0xff,
	0x09, 0x00, 0x00, 0x00, 0x04, 0x00, 0x00, 0x00, 0x13, 0x00, 0x00, 0x00,
	0x43, 0x4f, 0x4e, 0x56, 0x45, 0x52, 0x53, 0x49, 0x4f, 0x4e, 0x5f, 0x4d,
	0x45, 0x54, 0x41, 0x44, 0x41, 0x54, 0x41, 0x00, 0x08, 0x00, 0x0c, 0x00,
	0x08, 0x00, 0x04, 0x00, 0x08, 0x00, 0x00, 0x00, 0x08, 0x00, 0x00, 0x00,
	0x04, 0x00, 0x00, 0x00, 0x13, 0x00, 0x00, 0x00, 0x6d, 0x69, 0x6e, 0x5f,
	0x72, 0x75, 0x6e, 0x74, 0x69, 0x6d, 0x65, 0x5f, 0x76, 0x65, 0x72, 0x73,
	0x69, 0x6f, 0x6e, 0x00, 0x0a, 0x00, 0x00, 0x00, 0x58, 0x01, 0x00, 0x00,
	0x50, 0x01, 0x00, 0x00, 0x34, 0x01, 0x00, 0x00, 0x04, 0x01, 0x00, 0x00,
	0xd4, 0x00, 0x00, 0x00, 0xa4, 0x00, 0x00, 0x00, 0x9c, 0x00, 0x00, 0x00,
	0x94, 0x00, 0x00, 0x00, 0x74, 0x00, 0x00, 0x00, 0x04, 0x00, 0x00, 0x00,
	0xf2, 0xfe, 0xff, 0xff, 0x04, 0x00, 0x00, 0x00, 0x60, 0x00, 0x00, 0x00,
	0x0c, 0x00, 0x00, 0x00, 0x08, 0x00, 0x0e, 0x00, 0x08, 0x00, 0x04, 0x00,
	0x08, 0x00, 0x00, 0x00, 0x10, 0x00, 0x00, 0x00, 0x28, 0x00, 0x00, 0x00,
	0x00, 0x00, 0x06, 0x00, 0x08, 0x00, 0x04, 0x00, 0x06, 0x00, 0x00, 0x00,
	0x04, 0x00, 0x00, 0x00, 0x01, 0x00, 0x00, 0x00, 0xeb, 0x03, 0x00, 0x00,
	0x0c, 0x00, 0x18, 0x00, 0x14, 0x00, 0x10, 0x00, 0x0c, 0x00, 0x04, 0x00,
	0x0c, 0x00, 0x00, 0x00, 0x7e, 0xe1, 0xad, 0x50, 0x56, 0x66, 0xb0, 0x66,
	0x02, 0x00, 0x00, 0x00, 0x02, 0x00, 0x00, 0x00, 0x04, 0x00, 0x00, 0x00,
	0x06, 0x00, 0x00, 0x00, 0x32, 0x2e, 0x32, 0x31, 0x2e, 0x30, 0x00, 0x00,
	0x5e, 0xff, 0xff, 0xff, 0x04, 0x00, 0x00, 0x00, 0x10, 0x00, 0x00, 0x00,
	0x31, 0x2e, 0x31, 0x34, 0x2e, 0x30, 0x00, 0x00, 0x00, 0x00, 0x00, 0x00,
	0x00, 0x00, 0x00, 0x00, 0xd4, 0xfe, 0xff, 0xff, 0xd8, 0xfe, 0xff, 0xff,
	0x82, 0xff, 0xff, 0xff, 0x04, 0x00, 0x00, 0x00, 0x20, 0x00, 0x00, 0x00,
	0x81, 0xb1, 0xf6, 0x99, 0x24, 0x00, 0xe4, 0x7f, 0xa8, 0x70, 0x81, 0xca,
	0x81, 0x2b, 0x9b, 0x09, 0x15, 0x81, 0xe5, 0x06, 0x7f, 0x1a, 0x6f, 0x1c,
	0x55, 0xf4, 0xe7, 0x7f, 0x96, 0x81, 0x47, 0xe2, 0xae, 0xff, 0xff, 0xff,
	0x04, 0x00, 0x00, 0x00, 0x20, 0x00, 0x00, 0x00, 0x00, 0x00, 0x00, 0x00,
	0x7a, 0xe5, 0xff, 0xff, 0x78, 0xcf, 0xff, 0xff, 0xac, 0x4a, 0x00, 0x00,
	0x00, 0x00, 0x00, 0x00, 0x11, 0xdf, 0xff, 0xff, 0x4a, 0xe9, 0xff, 0xff,
	0x4c, 0xf2, 0xff, 0xff, 0xda, 0xff, 0xff, 0xff, 0x04, 0x00, 0x00, 0x00,
	0x18, 0x00, 0x00, 0x00, 0xf2, 0x6a, 0x09, 0x0e, 0x0b, 0xd9, 0x7f, 0xfe,
	0xff, 0xb2, 0xfe, 0x47, 0x10, 0xc9, 0x81, 0xf5, 0x23, 0xac, 0xf6, 0x81,
	0x16, 0x6c, 0xc0, 0xea, 0x00, 0x00, 0x06, 0x00, 0x08, 0x00, 0x04, 0x00,
	0x06, 0x00, 0x00, 0x00, 0x04, 0x00, 0x00, 0x00, 0x0c, 0x00, 0x00, 0x00,
	0x54, 0xf2, 0xff, 0xff, 0x00, 0x0c, 0x00, 0x00, 0x68, 0x03, 0x00, 0x00,
	0x78, 0xff, 0xff, 0xff, 0x7c, 0xff, 0xff, 0xff, 0x0f, 0x00, 0x00, 0x00,
	0x4d, 0x4c, 0x49, 0x52, 0x20, 0x43, 0x6f, 0x6e, 0x76, 0x65, 0x72, 0x74,
	0x65, 0x64, 0x2e, 0x00, 0x01, 0x00, 0x00, 0x00, 0x14, 0x00, 0x00, 0x00,
	0x00, 0x00, 0x0e, 0x00, 0x18, 0x00, 0x14, 0x00, 0x10, 0x00, 0x0c, 0x00,
	0x08, 0x00, 0x04, 0x00, 0x0e, 0x00, 0x00, 0x00, 0x14, 0x00, 0x00, 0x00,
	0x1c, 0x00, 0x00, 0x00, 0xb4, 0x00, 0x00, 0x00, 0xb8, 0x00, 0x00, 0x00,
	0xbc, 0x00, 0x00, 0x00, 0x04, 0x00, 0x00, 0x00, 0x6d, 0x61, 0x69, 0x6e,
	0x00, 0x00, 0x00, 0x00, 0x02, 0x00, 0x00, 0x00, 0x5c, 0x00, 0x00, 0x00,
	0x14, 0x00, 0x00, 0x00, 0x00, 0x00, 0x0e, 0x00, 0x14, 0x00, 0x00, 0x00,
	0x10, 0x00, 0x0c, 0x00, 0x0b, 0x00, 0x04, 0x00, 0x0e, 0x00, 0x00, 0x00,
	0x14, 0x00, 0x00, 0x00, 0x00, 0x00, 0x00, 0x08, 0x10, 0x00, 0x00, 0x00,
	0x14, 0x00, 0x00, 0x00, 0x04, 0x00, 0x04, 0x00, 0x04, 0x00, 0x00, 0x00,
	0x01, 0x00, 0x00, 0x00, 0x06, 0x00, 0x00, 0x00, 0x03, 0x00, 0x00, 0x00,
	0x05, 0x00, 0x00, 0x00, 0x02, 0x00, 0x00, 0x00, 0x01, 0x00, 0x00, 0x00,
	0x00, 0x00, 0x0e, 0x00, 0x16, 0x00, 0x00, 0x00, 0x10, 0x00, 0x0c, 0x00,
	0x0b, 0x00, 0x04, 0x00, 0x0e, 0x00, 0x00, 0x00, 0x18, 0x00, 0x00, 0x00,
	0x00, 0x00, 0x00, 0x08, 0x18, 0x00, 0x00, 0x00, 0x1c, 0x00, 0x00, 0x00,
	0x00, 0x00, 0x06, 0x00, 0x08, 0x00, 0x07, 0x00, 0x06, 0x00, 0x00, 0x00,
	0x00, 0x00, 0x00, 0x01, 0x01, 0x00, 0x00, 0x00, 0x05, 0x00, 0x00, 0x00,
	0x03, 0x00, 0x00, 0x00, 0x00, 0x00, 0x00, 0x00, 0x04, 0x00, 0x00, 0x00,
	0x03, 0x00, 0x00, 0x00, 0x01, 0x00, 0x00, 0x00, 0x06, 0x00, 0x00, 0x00,
	0x01, 0x00, 0x00, 0x00, 0x00, 0x00, 0x00, 0x00, 0x07, 0x00, 0x00, 0x00,
	0x18, 0x04, 0x00, 0x00, 0x78, 0x03, 0x00, 0x00, 0xd4, 0x02, 0x00, 0x00,
	0xf8, 0x01, 0x00, 0x00, 0x34, 0x01, 0x00, 0x00, 0x80, 0x00, 0x00, 0x00,
	0x04, 0x00, 0x00, 0x00, 0x1a, 0xfc, 0xff, 0xff, 0x00, 0x00, 0x00, 0x01,
	0x18, 0x00, 0x00, 0x00, 0x20, 0x00, 0x00, 0x00, 0x3c, 0x00, 0x00, 0x00,
	0x07, 0x00, 0x00, 0x00, 0x00, 0x00, 0x00, 0x09, 0x50, 0x00, 0x00, 0x00,
	0x02, 0x00, 0x00, 0x00, 0xff, 0xff, 0xff, 0xff, 0x03, 0x00, 0x00, 0x00,
	0x04, 0xfc, 0xff, 0xff, 0x08, 0x00, 0x00, 0x00, 0x10, 0x00, 0x00, 0x00,
	0x01, 0x00, 0x00, 0x00, 0xdf, 0xff, 0xff, 0xff, 0xff, 0xff, 0xff, 0xff,
	0x01, 0x00, 0x00, 0x00, 0x6f, 0xa6, 0x9f, 0x3d, 0x1b, 0x00, 0x00, 0x00,
	0x53, 0x74, 0x61, 0x74, 0x65, 0x66, 0x75, 0x6c, 0x50, 0x61, 0x72, 0x74,
	0x69, 0x74, 0x69, 0x6f, 0x6e, 0x65, 0x64, 0x43, 0x61, 0x6c, 0x6c, 0x5f,
	0x31, 0x3a, 0x30, 0x00, 0x02, 0x00, 0x00, 0x00, 0x01, 0x00, 0x00, 0x00,
	0x03, 0x00, 0x00, 0x00, 0x92, 0xfc, 0xff, 0xff, 0x00, 0x00, 0x00, 0x01,
	0x18, 0x00, 0x00, 0x00, 0x20, 0x00, 0x00, 0x00, 0x3c, 0x00, 0x00, 0x00,
	0x06, 0x00, 0x00, 0x00, 0x00, 0x00, 0x00, 0x09, 0x88, 0x00, 0x00, 0x00,
	0x02, 0x00, 0x00, 0x00, 0xff, 0xff, 0xff, 0xff, 0x08, 0x00, 0x00, 0x00,
	0x7c, 0xfc, 0xff, 0xff, 0x08, 0x00, 0x00, 0x00, 0x10, 0x00, 0x00, 0x00,
	0x01, 0x00, 0x00, 0x00, 0x80, 0xff, 0xff, 0xff, 0xff, 0xff, 0xff, 0xff,
	0x01, 0x00, 0x00, 0x00, 0x1d, 0xfe, 0x43, 0x3c, 0x52, 0x00, 0x00, 0x00,
	0x73, 0x65, 0x71, 0x75, 0x65, 0x6e, 0x74, 0x69, 0x61, 0x6c, 0x5f, 0x31,
	0x2f, 0x64, 0x65, 0x6e, 0x73, 0x65, 0x5f, 0x31, 0x2f, 0x4d, 0x61, 0x74,
	0x4d, 0x75, 0x6c, 0x3b, 0x73, 0x65, 0x71, 0x75, 0x65, 0x6e, 0x74, 0x69,
	0x61, 0x6c, 0x5f, 0x31, 0x2f, 0x64, 0x65, 0x6e, 0x73, 0x65, 0x5f, 0x31,
	0x2f, 0x52, 0x65, 0x6c, 0x75, 0x3b, 0x73, 0x65, 0x71, 0x75, 0x65, 0x6e,
	0x74, 0x69, 0x61, 0x6c, 0x5f, 0x31, 0x2f, 0x64, 0x65, 0x6e, 0x73, 0x65,
	0x5f, 0x31, 0x2f, 0x42, 0x69, 0x61, 0x73, 0x41, 0x64, 0x64, 0x00, 0x00,
	0x02, 0x00, 0x00, 0x00, 0x01, 0x00, 0x00, 0x00, 0x08, 0x00, 0x00, 0x00,
	0xde, 0xfd, 0xff, 0xff, 0x00, 0x00, 0x00, 0x01, 0x14, 0x00, 0x00, 0x00,
	0x88, 0x00, 0x00, 0x00, 0x05, 0x00, 0x00, 0x00, 0x00, 0x00, 0x00, 0x09,
	0x9c, 0x00, 0x00, 0x00, 0x1c, 0xfd, 0xff, 0xff, 0x08, 0x00, 0x00, 0x00,
	0x4c, 0x00, 0x00, 0x00, 0x08, 0x00, 0x00, 0x00, 0x00, 0x00, 0x00, 0x00,
	0x00, 0x00, 0x00, 0x00, 0x00, 0x00, 0x00, 0x00, 0x00, 0x00, 0x00, 0x00,
	0x00, 0x00, 0x00, 0x00, 0x00, 0x00, 0x00, 0x00, 0x00, 0x00, 0x00, 0x00,
	0x00, 0x00, 0x00, 0x00, 0x00, 0x00, 0x00, 0x00, 0x00, 0x00, 0x00, 0x00,
	0x00, 0x00, 0x00, 0x00, 0x00, 0x00, 0x00, 0x00, 0x00, 0x00, 0x00, 0x00,
	0x00, 0x00, 0x00, 0x00, 0x00, 0x00, 0x00, 0x00, 0x00, 0x00, 0x00, 0x00,
	0x00, 0x00, 0x00, 0x00, 0x08, 0x00, 0x00, 0x00, 0x79, 0x0d, 0x93, 0x3b,
	0x9c, 0xb3, 0x05, 0x3d, 0x84, 0x57, 0x80, 0x3b, 0x8f, 0x54, 0xdf, 0x3c,
	0x36, 0x97, 0x85, 0x3b, 0x9e, 0xcc, 0xe4, 0x3c, 0x43, 0x2e, 0x0f, 0x3d,
	0x59, 0xe0, 0x89, 0x3b, 0x1b, 0x00, 0x00, 0x00, 0x73, 0x65, 0x71, 0x75,
	0x65, 0x6e, 0x74, 0x69, 0x61, 0x6c, 0x5f, 0x31, 0x2f, 0x64, 0x65, 0x6e,
	0x73, 0x65, 0x5f, 0x31, 0x2f, 0x4d, 0x61, 0x74, 0x4d, 0x75, 0x6c, 0x00,
	0x02, 0x00, 0x00, 0x00, 0x08, 0x00, 0x00, 0x00, 0x04, 0x00, 0x00, 0x00,
	0x9e, 0xfe, 0xff, 0xff, 0x00, 0x00, 0x00, 0x01, 0x14, 0x00, 0x00, 0x00,
	0x88, 0x00, 0x00, 0x00, 0x04, 0x00, 0x00, 0x00, 0x00, 0x00, 0x00, 0x02,
	0xb8, 0x00, 0x00, 0x00, 0xdc, 0xfd, 0xff, 0xff, 0x08, 0x00, 0x00, 0x00,
	0x4c, 0x00, 0x00, 0x00, 0x08, 0x00, 0x00, 0x00, 0x00, 0x00, 0x00, 0x00,
	0x00, 0x00, 0x00, 0x00, 0x00, 0x00, 0x00, 0x00, 0x00, 0x00, 0x00, 0x00,
	0x00, 0x00, 0x00, 0x00, 0x00, 0x00, 0x00, 0x00, 0x00, 0x00, 0x00, 0x00,
	0x00, 0x00, 0x00, 0x00, 0x00, 0x00, 0x00, 0x00, 0x00, 0x00, 0x00, 0x00,
	0x00, 0x00, 0x00, 0x00, 0x00, 0x00, 0x00, 0x00, 0x00, 0x00, 0x00, 0x00,
	0x00, 0x00, 0x00, 0x00, 0x00, 0x00, 0x00, 0x00, 0x00, 0x00, 0x00, 0x00,
	0x00, 0x00, 0x00, 0x00, 0x08, 0x00, 0x00, 0x00, 0x64, 0x26, 0x99, 0x37,
	0xcf, 0x3e, 0x0b, 0x39, 0xd3, 0xa9, 0x85, 0x37, 0x24, 0x97, 0xe8, 0x38,
	0x3c, 0x21, 0x8b, 0x37, 0x40, 0x49, 0xee, 0x38, 0x14, 0x1e, 0x15, 0x39,
	0xdd, 0x97, 0x8f, 0x37, 0x36, 0x00, 0x00, 0x00, 0x73, 0x65, 0x71, 0x75,
	0x65, 0x6e, 0x74, 0x69, 0x61, 0x6c, 0x5f, 0x31, 0x2f, 0x64, 0x65, 0x6e,
	0x73, 0x65, 0x5f, 0x31, 0x2f, 0x52, 0x65, 0x6c, 0x75, 0x3b, 0x73, 0x65,
	0x71, 0x75, 0x65, 0x6e, 0x74, 0x69, 0x61, 0x6c, 0x5f, 0x31, 0x2f, 0x64,
	0x65, 0x6e, 0x73, 0x65, 0x5f, 0x31, 0x2f, 0x42, 0x69, 0x61, 0x73, 0x41,
	0x64, 0x64, 0x00, 0x00, 0x01, 0x00, 0x00, 0x00, 0x08, 0x00, 0x00, 0x00,
	0x76, 0xff, 0xff, 0xff, 0x00, 0x00, 0x00, 0x01, 0x14, 0x00, 0x00, 0x00,
	0x4c, 0x00, 0x00, 0x00, 0x03, 0x00, 0x00, 0x00, 0x00, 0x00, 0x00, 0x09,
	0x64, 0x00, 0x00, 0x00, 0xb4, 0xfe, 0xff, 0xff, 0x08, 0x00, 0x00, 0x00,
	0x24, 0x00, 0x00, 0x00, 0x03, 0x00, 0x00, 0x00, 0x00, 0x00, 0x00, 0x00,
	0x00, 0x00, 0x00, 0x00, 0x00, 0x00, 0x00, 0x00, 0x00, 0x00, 0x00, 0x00,
	0x00, 0x00, 0x00, 0x00, 0x00, 0x00, 0x00, 0x00, 0x00, 0x00, 0x00, 0x00,
	0x03, 0x00, 0x00, 0x00, 0xe9, 0xe5, 0x23, 0x3d, 0xbd, 0x12, 0x34, 0x3d,
	0xb0, 0xa1, 0x85, 0x3c, 0x1d, 0x00, 0x00, 0x00, 0x73, 0x65, 0x71, 0x75,
	0x65, 0x6e, 0x74, 0x69, 0x61, 0x6c, 0x5f, 0x31, 0x2f, 0x64, 0x65, 0x6e,
	0x73, 0x65, 0x5f, 0x31, 0x5f, 0x32, 0x2f, 0x4d, 0x61, 0x74, 0x4d, 0x75,
	0x6c, 0x00, 0x00, 0x00, 0x02, 0x00, 0x00, 0x00, 0x03, 0x00, 0x00, 0x00,
	0x08, 0x00, 0x00, 0x00, 0x00, 0x00, 0x16, 0x00, 0x1c, 0x00, 0x18, 0x00,
	0x17, 0x00, 0x10, 0x00, 0x0c, 0x00, 0x08, 0x00, 0x00, 0x00, 0x00, 0x00,
	0x00, 0x00, 0x07, 0x00, 0x16, 0x00, 0x00, 0x00, 0x00, 0x00, 0x00, 0x01,
	0x14, 0x00, 0x00, 0x00, 0x4c, 0x00, 0x00, 0x00, 0x02, 0x00, 0x00, 0x00,
	0x00, 0x00, 0x00, 0x02, 0x64, 0x00, 0x00, 0x00, 0x54, 0xff, 0xff, 0xff,
	0x08, 0x00, 0x00, 0x00, 0x24, 0x00, 0x00, 0x00, 0x03, 0x00, 0x00, 0x00,
	0x00, 0x00, 0x00, 0x00, 0x00, 0x00, 0x00, 0x00, 0x00, 0x00, 0x00, 0x00,
	0x00, 0x00, 0x00, 0x00, 0x00, 0x00, 0x00, 0x00, 0x00, 0x00, 0x00, 0x00,
	0x00, 0x00, 0x00, 0x00, 0x03, 0x00, 0x00, 0x00, 0xa2, 0xf5, 0xfa, 0x39,
	0x05, 0xdd, 0x09, 0x3a, 0x9d, 0x9d, 0x4c, 0x39, 0x1e, 0x00, 0x00, 0x00,
	0x73, 0x65, 0x71, 0x75, 0x65, 0x6e, 0x74, 0x69, 0x61, 0x6c, 0x5f, 0x31,
	0x2f, 0x64, 0x65, 0x6e, 0x73, 0x65, 0x5f, 0x31, 0x5f, 0x32, 0x2f, 0x42,
	0x69, 0x61, 0x73, 0x41, 0x64, 0x64, 0x00, 0x00, 0x01, 0x00, 0x00, 0x00,
	0x03, 0x00, 0x00, 0x00, 0x00, 0x00, 0x16, 0x00, 0x20, 0x00, 0x1c, 0x00,
	0x1b, 0x00, 0x14, 0x00, 0x10, 0x00, 0x0c, 0x00, 0x00, 0x00, 0x00, 0x00,
	0x08, 0x00, 0x07, 0x00, 0x16, 0x00, 0x00, 0x00, 0x00, 0x00, 0x00, 0x01,
	0x18, 0x00, 0x00, 0x00, 0x2c, 0x00, 0x00, 0x00, 0x4c, 0x00, 0x00, 0x00,
	0x01, 0x00, 0x00, 0x00, 0x00, 0x00, 0x00, 0x09, 0x64, 0x00, 0x00, 0x00,
	0x02, 0x00, 0x00, 0x00, 0xff, 0xff, 0xff, 0xff, 0x04, 0x00, 0x00, 0x00,
	0x0c, 0x00, 0x0c, 0x00, 0x00, 0x00, 0x00, 0x00, 0x08, 0x00, 0x04, 0x00,
	0x0c, 0x00, 0x00, 0x00, 0x08, 0x00, 0x00, 0x00, 0x14, 0x00, 0x00, 0x00,
	0x01, 0x00, 0x00, 0x00, 0x81, 0xff, 0xff, 0xff, 0xff, 0xff, 0xff, 0xff,
	0x00, 0x00, 0x00, 0x00, 0x01, 0x00, 0x00, 0x00, 0xae, 0x4e, 0x85, 0x3b,
	0x1e, 0x00, 0x00, 0x00, 0x73, 0x65, 0x72, 0x76, 0x69, 0x6e, 0x67, 0x5f,
	0x64, 0x65, 0x66, 0x61, 0x75, 0x6c, 0x74, 0x5f, 0x6b, 0x65, 0x72, 0x61,
	0x73, 0x5f, 0x74, 0x65, 0x6e, 0x73, 0x6f, 0x72, 0x3a, 0x30, 0x00, 0x00,
	0x02, 0x00, 0x00, 0x00, 0x01, 0x00, 0x00, 0x00, 0x04, 0x00, 0x00, 0x00,
	0x01, 0x00, 0x00, 0x00, 0x10, 0x00, 0x00, 0x00, 0x0c, 0x00, 0x10, 0x00,
	0x0f, 0x00, 0x00, 0x00, 0x08, 0x00, 0x04, 0x00, 0x0c, 0x00, 0x00, 0x00,
	0x09, 0x00, 0x00, 0x00, 0x04, 0x00, 0x00, 0x00, 0x00, 0x00, 0x00, 0x09
};

const int g_model_len = sizeof(g_model);
```
