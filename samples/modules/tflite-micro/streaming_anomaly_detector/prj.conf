## CMakeLists.txt
```
# SPDX-FileCopyrightText: Copyright (c) 2026 Mahad Faisal
# SPDX-License-Identifier: Apache-2.0

cmake_minimum_required(VERSION 3.20.0)

find_package(Zephyr REQUIRED HINTS $ENV{ZEPHYR_BASE})
project(tflm_streaming_anomaly_detector)

target_include_directories(app PRIVATE src)

target_sources(app PRIVATE
  src/assert.cpp
  src/input_stream.c
  src/main.c
  src/main_functions.cpp
  src/model.cpp
  src/ring_buffer.c
  src/stream_features.c
)
```

## sample.yaml
```
sample:
  description: TensorFlow Lite Micro streaming anomaly detector sample
  name: Streaming anomaly detector TensorFlow Lite Micro

common:
  tags:
    - tensorflow
  modules:
    - tflite-micro
  harness: console
  harness_config:
    type: multi_line
    ordered: false
    regex:
      - "stream_window: .*"
      - "raw_prediction: .*"
      - "stable_prediction: .*"
      - "result: PASS"

tests:
  sample.tensorflow.streaming_anomaly_detector:
    platform_allow:
      - qemu_x86
      - qemu_x86_64
    integration_platforms:
      - qemu_x86
    filter: CONFIG_FULL_LIBC_SUPPORTED

  sample.tensorflow.streaming_anomaly_detector.cmsis_nn:
    platform_allow:
      - ek_ra8m1
    extra_configs:
      - CONFIG_TENSORFLOW_LITE_MICRO_CMSIS_NN_KERNELS=y
```

## prj.conf
```kconfig
CONFIG_STDOUT_CONSOLE=y
CONFIG_CPP=y
CONFIG_STD_CPP14=y
CONFIG_REQUIRES_FULL_LIBC=y

CONFIG_TENSORFLOW_LITE_MICRO=y
CONFIG_CBPRINTF_FP_SUPPORT=y
```

## src/main.c
```c
/*
 * SPDX-FileCopyrightText: Copyright 2020 The TensorFlow Authors. All Rights Reserved.
 * SPDX-License-Identifier: Apache-2.0
 */

#include "main_functions.h"

int main(void)
{
	setup();

	while (1) {
		loop();
	}

	return 0;
}
```

## src/assert.cpp
```c
/*
 * SPDX-FileCopyrightText: Copyright 2020 The TensorFlow Authors. All Rights Reserved.
 * SPDX-License-Identifier: Apache-2.0
 */

extern "C" void __assert_func(const char *file, int line,
      const char *func, const char *expr)
{
(void)file;
(void)line;
(void)func;
(void)expr;

while (1) {
}
}
```

## src/input_stream.c
```c
/*
 * SPDX-FileCopyrightText: Copyright (c) 2026 Mahad Faisal
 * SPDX-License-Identifier: Apache-2.0
 */

#include "stream_features.h"
#include "input_stream.h"

#include <stddef.h>
#include <stdint.h>

static const int16_t normal_stream[STREAM_SAMPLES_PER_CLASS] = {
	0, 195, 383, 556, 707, 831, 924, 981,
	1000, 981, 924, 831, 707, 556, 383, 195,
	0, -195, -383, -556, -707, -831, -924, -981,
	-1000, -981, -924, -831, -707, -556, -383, -195,
	0, 195, 383, 556, 707, 831, 924, 981,
	1000, 981, 924, 831, 707, 556, 383, 195,
	0, -195, -383, -556, -707, -831, -924, -981,
	-1000, -981, -924, -831, -707, -556, -383, -195,
	0, 195, 383, 556, 707, 831, 924, 981,
	1000, 981, 924, 831, 707, 556, 383, 195,
	0, -195, -383, -556, -707, -831, -924, -981,
	-1000, -981, -924, -831, -707, -556, -383, -195
};

static const int16_t drift_stream[STREAM_SAMPLES_PER_CLASS] = {
	0, 76, 152, 227, 299, 370, 437, 501,
	561, 616, 667, 712, 752, 786, 814, 836,
	852, 862, 865, 862, 853, 839, 818, 793,
	763, 728, 690, 647, 602, 555, 506, 455,
	404, 353, 303, 253, 206, 161, 119, 80,
	46, 15, -10, -30, -45, -54, -56, -53,
	-44, -28, -6, 22, 56, 96, 142, 192,
	248, 308, 372, 439, 509, 582, 656, 732,
	808, 885, 960, 1035, 1108, 1178, 1245, 1309,
	1369, 1425, 1475, 1521, 1561, 1595, 1623, 1645,
	1661, 1670, 1673, 1670, 1662, 1647, 1627, 1601,
	1571, 1537, 1498, 1456, 1411, 1363, 1314, 1264
};

static const int16_t transient_stream[STREAM_SAMPLES_PER_CLASS] = {
	0, 156, 306, 444, 566, 665, 739, 785,
	800, 785, 739, 665, 566, 444, 306, 156,
	0, -156, -306, -444, 1934, -665, -739, -785,
	-800, -785, -739, -665, -566, -444, -306, -156,
	0, 156, 306, 444, 566, 665, 739, 785,
	800, 785, 739, 665, 566, 444, 306, 156,
	0, -156, -306, -444, -566, -665, -739, -785,
	-800, -785, -739, -665, -566, -444, -306, -156,
	0, 156, 306, 444, 566, 665, 739, 785,
	-1500, 785, 739, 665, 566, 444, 306, 156,
	0, -156, -306, -444, -566, -665, -739, -785,
	-800, -785, -739, -665, -566, -444, -306, -156
};

static const int16_t *const streams[STREAM_NUM_CLASSES] = {
	[0] = normal_stream,
	[1] = drift_stream,
	[2] = transient_stream
};

const int16_t *input_stream_get_samples(enum stream_label label)
{
return streams[(size_t)label];
}

enum stream_label input_stream_expected_label(size_t stream_window)
{
return (enum stream_label)(stream_window / STREAM_WINDOWS_PER_CLASS);
}

const char *input_stream_label_name(enum stream_label label)
{
switch (label) {
case STREAM_LABEL_NORMAL:
return "normal";
case STREAM_LABEL_DRIFT:
return "drift";
case STREAM_LABEL_TRANSIENT:
return "transient";
default:
return "unknown";
}
}

size_t input_stream_window_start(size_t stream_window)
{
return (stream_window % STREAM_WINDOWS_PER_CLASS) * STREAM_HOP_SIZE;
}
```

## src/input_stream.h
```c
/*
 * SPDX-FileCopyrightText: Copyright (c) 2026 Mahad Faisal
 * SPDX-License-Identifier: Apache-2.0
 */

#pragma once

#include <stddef.h>
#include <stdint.h>

#ifdef __cplusplus
extern "C" {
#endif

#define STREAM_WINDOWS_PER_CLASS 2U
#define STREAM_NUM_CLASSES 3U
#define STREAM_TOTAL_WINDOWS (STREAM_WINDOWS_PER_CLASS * STREAM_NUM_CLASSES)
#define STREAM_SAMPLES_PER_CLASS (STREAM_WINDOW_SIZE + STREAM_HOP_SIZE)

enum stream_label {
STREAM_LABEL_NORMAL = 0,
STREAM_LABEL_DRIFT = 1,
STREAM_LABEL_TRANSIENT = 2,
};

const int16_t *input_stream_get_samples(enum stream_label label);
enum stream_label input_stream_expected_label(size_t stream_window);
const char *input_stream_label_name(enum stream_label label);
size_t input_stream_window_start(size_t stream_window);

#ifdef __cplusplus
}
#endif
```

## src/main_functions.cpp
```c
/*
 * SPDX-FileCopyrightText: Copyright 2020 The TensorFlow Authors. All Rights Reserved.
 * SPDX-FileCopyrightText: Copyright (c) 2026 Mahad Faisal
 * SPDX-License-Identifier: Apache-2.0
 */

#include "main_functions.h"

#include <math.h>
#include <stddef.h>
#include <stdint.h>

#include <tensorflow/lite/micro/micro_interpreter.h>
#include <tensorflow/lite/micro/micro_log.h>
#include <tensorflow/lite/micro/micro_mutable_op_resolver.h>
#include <tensorflow/lite/micro/system_setup.h>
#include <tensorflow/lite/schema/schema_generated.h>
#include <zephyr/kernel.h>

#include "input_stream.h"
#include "model.hpp"
#include "ring_buffer.h"
#include "stream_features.h"

namespace {
const tflite::Model *model = nullptr;
tflite::MicroInterpreter *interpreter = nullptr;
TfLiteTensor *input = nullptr;
TfLiteTensor *output = nullptr;

struct stream_ring_buffer sample_ring;
int16_t current_window[STREAM_WINDOW_SIZE];
enum stream_label prediction_history[3];
size_t stream_window_index = 0U;
size_t history_count = 0U;
size_t history_head = 0U;

constexpr int kTensorArenaSize = 4096;
uint8_t tensor_arena[kTensorArenaSize];

void prediction_history_reset(void)
{
history_count = 0U;
history_head = 0U;
}

void prediction_history_push(enum stream_label label)
{
prediction_history[history_head] = label;
history_head = (history_head + 1U) % 3U;

if (history_count < 3U) {
history_count++;
}
}

enum stream_label prediction_history_majority(void)
{
uint32_t counts[STREAM_NUM_CLASSES] = {0U};
uint32_t best_count = 0U;
enum stream_label best_label = STREAM_LABEL_NORMAL;

for (size_t i = 0U; i < history_count; i++) {
enum stream_label label = prediction_history[i];

counts[(size_t)label]++;
}

for (size_t i = 0U; i < STREAM_NUM_CLASSES; i++) {
if (counts[i] > best_count) {
best_count = counts[i];
best_label = (enum stream_label)i;
}
}

return best_label;
}

float normalize_feature(size_t index, const struct stream_features *features)
{
switch (index) {
case 0:
return features->mean / 3000.0f;
case 1:
return features->rms / 2000.0f;
case 2:
return features->peak / 4000.0f;
case 3:
return features->zero_crossing_rate / 0.20f;
case 4:
return features->slope / 100.0f;
case 5:
return features->energy / 200000000.0f;
default:
return 0.0f;
}
}

int8_t quantize_input(float value)
{
int32_t quantized = (int32_t)roundf(value / input->params.scale) +
    input->params.zero_point;

if (quantized > 127) {
return 127;
}

if (quantized < -128) {
return -128;
}

return (int8_t)quantized;
}

float dequantize_output(int8_t value)
{
return ((float)value - (float)output->params.zero_point) *
       output->params.scale;
}

enum stream_label output_to_label(size_t index)
{
switch (index) {
case 0:
return STREAM_LABEL_NORMAL;
case 1:
return STREAM_LABEL_DRIFT;
case 2:
return STREAM_LABEL_TRANSIENT;
default:
return STREAM_LABEL_NORMAL;
}
}

void load_stream_window(size_t index)
{
enum stream_label label = input_stream_expected_label(index);
const int16_t *samples = input_stream_get_samples(label);
size_t position = index % STREAM_WINDOWS_PER_CLASS;

if (position == 0U) {
stream_ring_buffer_reset(&sample_ring);
stream_ring_buffer_push_many(&sample_ring, samples, STREAM_WINDOW_SIZE);
prediction_history_reset();
} else {
stream_ring_buffer_push_many(&sample_ring,
     &samples[STREAM_WINDOW_SIZE],
     STREAM_HOP_SIZE);
}

stream_ring_buffer_copy_window(&sample_ring, current_window,
       STREAM_WINDOW_SIZE);
}
}  /* namespace */

void setup(void)
{
model = tflite::GetModel(g_model);
if (model->version() != TFLITE_SCHEMA_VERSION) {
MicroPrintf("Model schema version %d not equal to supported version %d.",
    model->version(), TFLITE_SCHEMA_VERSION);
return;
}

static tflite::MicroMutableOpResolver<1> resolver;
resolver.AddFullyConnected();

static tflite::MicroInterpreter static_interpreter(
model, resolver, tensor_arena, kTensorArenaSize);
interpreter = &static_interpreter;

TfLiteStatus allocate_status = interpreter->AllocateTensors();
if (allocate_status != kTfLiteOk) {
MicroPrintf("AllocateTensors() failed");
return;
}

input = interpreter->input(0);
output = interpreter->output(0);

stream_ring_buffer_reset(&sample_ring);
prediction_history_reset();
stream_window_index = 0U;
}

void loop(void)
{

struct stream_features features;
enum stream_label expected;
enum stream_label raw_prediction;
enum stream_label stable_prediction;
size_t best_index = 0U;
float best_score;
uint32_t invoke_start;
uint32_t invoke_cycles;
uint32_t invoke_us;

load_stream_window(stream_window_index);
expected = input_stream_expected_label(stream_window_index);

stream_extract_features(current_window, STREAM_WINDOW_SIZE, &features);

for (size_t i = 0U; i < STREAM_NUM_FEATURES; i++) {
input->data.int8[i] = quantize_input(normalize_feature(i, &features));
}

invoke_start = k_cycle_get_32();
TfLiteStatus invoke_status = interpreter->Invoke();
invoke_cycles = k_cycle_get_32() - invoke_start;
invoke_us = (uint32_t)(k_cyc_to_ns_floor64(invoke_cycles) / 1000U);

if (invoke_status != kTfLiteOk) {
MicroPrintf("Invoke failed\n");
return;
}

best_score = dequantize_output(output->data.int8[0]);
for (size_t i = 1U; i < STREAM_NUM_CLASSES; i++) {
float score = dequantize_output(output->data.int8[i]);

if (score > best_score) {
best_score = score;
best_index = i;
}
}

raw_prediction = output_to_label(best_index);
prediction_history_push(raw_prediction);
stable_prediction = prediction_history_majority();

MicroPrintf("stream_window: %u\n", (unsigned int)stream_window_index);
MicroPrintf("window_start: %u\n",
    (unsigned int)input_stream_window_start(stream_window_index));
MicroPrintf("features: mean=%f, rms=%f, peak=%f, zcr=%f, slope=%f, energy=%f\n",
    (double)features.mean,
    (double)features.rms,
    (double)features.peak,
    (double)features.zero_crossing_rate,
    (double)features.slope,
    (double)features.energy);
MicroPrintf("invoke_cycles: %u, invoke_time_us: %u\n",
    (unsigned int)invoke_cycles,
    (unsigned int)invoke_us);
MicroPrintf("raw_prediction: %s, score: %f\n",
    input_stream_label_name(raw_prediction),
    (double)best_score);
MicroPrintf("stable_prediction: %s\n",
    input_stream_label_name(stable_prediction));

if (stable_prediction != STREAM_LABEL_NORMAL) {
MicroPrintf("event: %s detected\n",
    input_stream_label_name(stable_prediction));
}

MicroPrintf("result: %s\n",
    raw_prediction == expected ? "PASS" : "FAIL");
	stream_window_index++;
	if (stream_window_index >= STREAM_TOTAL_WINDOWS) {
		k_sleep(K_FOREVER);
	}
}
```

## src/model.cpp
```c
/*
 * SPDX-FileCopyrightText: Copyright (c) 2026 Mahad Faisal
 * SPDX-License-Identifier: Apache-2.0
 */

#include "model.hpp"

#include <cstdint>

alignas(16) const unsigned char g_model[] = {
	0x20, 0x00, 0x00, 0x00, 0x54, 0x46, 0x4c, 0x33, 0x00, 0x00, 0x00, 0x00,
	0x14, 0x00, 0x20, 0x00, 0x1c, 0x00, 0x18, 0x00, 0x14, 0x00, 0x10, 0x00,
	0x0c, 0x00, 0x00, 0x00, 0x08, 0x00, 0x04, 0x00, 0x14, 0x00, 0x00, 0x00,
	0x1c, 0x00, 0x00, 0x00, 0x98, 0x00, 0x00, 0x00, 0xf0, 0x00, 0x00, 0x00,
	0x90, 0x02, 0x00, 0x00, 0xa0, 0x02, 0x00, 0x00, 0x8c, 0x08, 0x00, 0x00,
	0x03, 0x00, 0x00, 0x00, 0x01, 0x00, 0x00, 0x00, 0x10, 0x00, 0x00, 0x00,
	0x00, 0x00, 0x0a, 0x00, 0x10, 0x00, 0x0c, 0x00, 0x08, 0x00, 0x04, 0x00,
	0x0a, 0x00, 0x00, 0x00, 0x0c, 0x00, 0x00, 0x00, 0x1c, 0x00, 0x00, 0x00,
	0x3c, 0x00, 0x00, 0x00, 0x0f, 0x00, 0x00, 0x00, 0x73, 0x65, 0x72, 0x76,
	0x69, 0x6e, 0x67, 0x5f, 0x64, 0x65, 0x66, 0x61, 0x75, 0x6c, 0x74, 0x00,
	0x01, 0x00, 0x00, 0x00, 0x04, 0x00, 0x00, 0x00, 0x90, 0xff, 0xff, 0xff,
	0x06, 0x00, 0x00, 0x00, 0x04, 0x00, 0x00, 0x00, 0x08, 0x00, 0x00, 0x00,
	0x6f, 0x75, 0x74, 0x70, 0x75, 0x74, 0x5f, 0x30, 0x00, 0x00, 0x00, 0x00,
	0x01, 0x00, 0x00, 0x00, 0x04, 0x00, 0x00, 0x00, 0x0a, 0xfe, 0xff, 0xff,
	0x04, 0x00, 0x00, 0x00, 0x0c, 0x00, 0x00, 0x00, 0x6b, 0x65, 0x72, 0x61,
	0x73, 0x5f, 0x74, 0x65, 0x6e, 0x73, 0x6f, 0x72, 0x00, 0x00, 0x00, 0x00,
	0x02, 0x00, 0x00, 0x00, 0x34, 0x00, 0x00, 0x00, 0x04, 0x00, 0x00, 0x00,
	0xdc, 0xff, 0xff, 0xff, 0x09, 0x00, 0x00, 0x00, 0x04, 0x00, 0x00, 0x00,
	0x13, 0x00, 0x00, 0x00, 0x43, 0x4f, 0x4e, 0x56, 0x45, 0x52, 0x53, 0x49,
	0x4f, 0x4e, 0x5f, 0x4d, 0x45, 0x54, 0x41, 0x44, 0x41, 0x54, 0x41, 0x00,
	0x08, 0x00, 0x0c, 0x00, 0x08, 0x00, 0x04, 0x00, 0x08, 0x00, 0x00, 0x00,
	0x08, 0x00, 0x00, 0x00, 0x04, 0x00, 0x00, 0x00, 0x13, 0x00, 0x00, 0x00,
	0x6d, 0x69, 0x6e, 0x5f, 0x72, 0x75, 0x6e, 0x74, 0x69, 0x6d, 0x65, 0x5f,
	0x76, 0x65, 0x72, 0x73, 0x69, 0x6f, 0x6e, 0x00, 0x0a, 0x00, 0x00, 0x00,
	0x9c, 0x01, 0x00, 0x00, 0x94, 0x01, 0x00, 0x00, 0x78, 0x01, 0x00, 0x00,
	0x3c, 0x01, 0x00, 0x00, 0xfc, 0x00, 0x00, 0x00, 0xa4, 0x00, 0x00, 0x00,
	0x9c, 0x00, 0x00, 0x00, 0x94, 0x00, 0x00, 0x00, 0x74, 0x00, 0x00, 0x00,
	0x04, 0x00, 0x00, 0x00, 0xae, 0xfe, 0xff, 0xff, 0x04, 0x00, 0x00, 0x00,
	0x60, 0x00, 0x00, 0x00, 0x0c, 0x00, 0x00, 0x00, 0x08, 0x00, 0x0e, 0x00,
	0x08, 0x00, 0x04, 0x00, 0x08, 0x00, 0x00, 0x00, 0x10, 0x00, 0x00, 0x00,
	0x28, 0x00, 0x00, 0x00, 0x00, 0x00, 0x06, 0x00, 0x08, 0x00, 0x04, 0x00,
	0x06, 0x00, 0x00, 0x00, 0x04, 0x00, 0x00, 0x00, 0x01, 0x00, 0x00, 0x00,
	0xeb, 0x03, 0x00, 0x00, 0x0c, 0x00, 0x18, 0x00, 0x14, 0x00, 0x10, 0x00,
	0x0c, 0x00, 0x04, 0x00, 0x0c, 0x00, 0x00, 0x00, 0x4c, 0x7d, 0x37, 0xeb,
	0x7b, 0x19, 0xed, 0x78, 0x02, 0x00, 0x00, 0x00, 0x02, 0x00, 0x00, 0x00,
	0x04, 0x00, 0x00, 0x00, 0x06, 0x00, 0x00, 0x00, 0x32, 0x2e, 0x32, 0x31,
	0x2e, 0x30, 0x00, 0x00, 0x1a, 0xff, 0xff, 0xff, 0x04, 0x00, 0x00, 0x00,
	0x10, 0x00, 0x00, 0x00, 0x31, 0x2e, 0x31, 0x34, 0x2e, 0x30, 0x00, 0x00,
	0x00, 0x00, 0x00, 0x00, 0x00, 0x00, 0x00, 0x00, 0x90, 0xfe, 0xff, 0xff,
	0x94, 0xfe, 0xff, 0xff, 0x3e, 0xff, 0xff, 0xff, 0x04, 0x00, 0x00, 0x00,
	0x48, 0x00, 0x00, 0x00, 0x81, 0xb7, 0x30, 0x89, 0x69, 0x8d, 0x7a, 0xd0,
	0x5c, 0xfa, 0x7f, 0xdc, 0x9f, 0xcb, 0x65, 0x52, 0x81, 0xc8, 0xcd, 0xe0,
	0x7f, 0x56, 0xb9, 0xd2, 0x47, 0x67, 0x81, 0xa4, 0x67, 0x75, 0xb3, 0x28,
	0x81, 0xe7, 0x6a, 0x40, 0x81, 0x1f, 0x48, 0x27, 0x82, 0x1e, 0x7f, 0x28,
	0x9c, 0xd5, 0x73, 0x27, 0xb9, 0x81, 0x43, 0x10, 0x5a, 0x81, 0x82, 0x3b,
	0xbc, 0x0c, 0x81, 0x55, 0xa3, 0x99, 0xe4, 0x6c, 0xf3, 0x7f, 0xfb, 0x89,
	0xb8, 0x85, 0x71, 0x7f, 0x92, 0xff, 0xff, 0xff, 0x04, 0x00, 0x00, 0x00,
	0x30, 0x00, 0x00, 0x00, 0x00, 0x00, 0x00, 0x00, 0x4c, 0x08, 0x00, 0x00,
	0xe9, 0xdc, 0xff, 0xff, 0x00, 0xca, 0xff, 0xff, 0x84, 0x52, 0x00, 0x00,
	0x00, 0x00, 0x00, 0x00, 0x51, 0xfa, 0xff, 0xff, 0x9b, 0x42, 0x00, 0x00,
	0x78, 0xd8, 0xff, 0xff, 0xfe, 0x1e, 0x00, 0x00, 0xbe, 0xc0, 0xff, 0xff,
	0x2d, 0xe3, 0xff, 0xff, 0xce, 0xff, 0xff, 0xff, 0x04, 0x00, 0x00, 0x00,
	0x24, 0x00, 0x00, 0x00, 0x02, 0x93, 0x81, 0xda, 0x4b, 0xf2, 0x1b, 0x07,
	0x05, 0x5f, 0xf9, 0x02, 0x06, 0x6d, 0xea, 0xe0, 0x3c, 0xed, 0xa6, 0x4e,
	0x0d, 0x81, 0x0b, 0xf3, 0x0f, 0x0f, 0x7f, 0x54, 0x9a, 0xef, 0x4f, 0x8e,
	0x08, 0xf1, 0x0f, 0xf7, 0x00, 0x00, 0x06, 0x00, 0x08, 0x00, 0x04, 0x00,
	0x06, 0x00, 0x00, 0x00, 0x04, 0x00, 0x00, 0x00, 0x0c, 0x00, 0x00, 0x00,
	0xb8, 0x01, 0x00, 0x00, 0x07, 0x03, 0x00, 0x00, 0x9b, 0xfb, 0xff, 0xff,
	0x78, 0xff, 0xff, 0xff, 0x7c, 0xff, 0xff, 0xff, 0x0f, 0x00, 0x00, 0x00,
	0x4d, 0x4c, 0x49, 0x52, 0x20, 0x43, 0x6f, 0x6e, 0x76, 0x65, 0x72, 0x74,
	0x65, 0x64, 0x2e, 0x00, 0x01, 0x00, 0x00, 0x00, 0x14, 0x00, 0x00, 0x00,
	0x00, 0x00, 0x0e, 0x00, 0x18, 0x00, 0x14, 0x00, 0x10, 0x00, 0x0c, 0x00,
	0x08, 0x00, 0x04, 0x00, 0x0e, 0x00, 0x00, 0x00, 0x14, 0x00, 0x00, 0x00,
	0x1c, 0x00, 0x00, 0x00, 0xb4, 0x00, 0x00, 0x00, 0xb8, 0x00, 0x00, 0x00,
	0xbc, 0x00, 0x00, 0x00, 0x04, 0x00, 0x00, 0x00, 0x6d, 0x61, 0x69, 0x6e,
	0x00, 0x00, 0x00, 0x00, 0x02, 0x00, 0x00, 0x00, 0x5c, 0x00, 0x00, 0x00,
	0x14, 0x00, 0x00, 0x00, 0x00, 0x00, 0x0e, 0x00, 0x14, 0x00, 0x00, 0x00,
	0x10, 0x00, 0x0c, 0x00, 0x0b, 0x00, 0x04, 0x00, 0x0e, 0x00, 0x00, 0x00,
	0x14, 0x00, 0x00, 0x00, 0x00, 0x00, 0x00, 0x08, 0x10, 0x00, 0x00, 0x00,
	0x14, 0x00, 0x00, 0x00, 0x04, 0x00, 0x04, 0x00, 0x04, 0x00, 0x00, 0x00,
	0x01, 0x00, 0x00, 0x00, 0x06, 0x00, 0x00, 0x00, 0x03, 0x00, 0x00, 0x00,
	0x05, 0x00, 0x00, 0x00, 0x02, 0x00, 0x00, 0x00, 0x01, 0x00, 0x00, 0x00,
	0x00, 0x00, 0x0e, 0x00, 0x16, 0x00, 0x00, 0x00, 0x10, 0x00, 0x0c, 0x00,
	0x0b, 0x00, 0x04, 0x00, 0x0e, 0x00, 0x00, 0x00, 0x18, 0x00, 0x00, 0x00,
	0x00, 0x00, 0x00, 0x08, 0x18, 0x00, 0x00, 0x00, 0x1c, 0x00, 0x00, 0x00,
	0x00, 0x00, 0x06, 0x00, 0x08, 0x00, 0x07, 0x00, 0x06, 0x00, 0x00, 0x00,
	0x00, 0x00, 0x00, 0x01, 0x01, 0x00, 0x00, 0x00, 0x05, 0x00, 0x00, 0x00,
	0x03, 0x00, 0x00, 0x00, 0x00, 0x00, 0x00, 0x00, 0x04, 0x00, 0x00, 0x00,
	0x03, 0x00, 0x00, 0x00, 0x01, 0x00, 0x00, 0x00, 0x06, 0x00, 0x00, 0x00,
	0x01, 0x00, 0x00, 0x00, 0x00, 0x00, 0x00, 0x00, 0x07, 0x00, 0x00, 0x00,
	0x78, 0x04, 0x00, 0x00, 0xd8, 0x03, 0x00, 0x00, 0x34, 0x03, 0x00, 0x00,
	0x28, 0x02, 0x00, 0x00, 0x34, 0x01, 0x00, 0x00, 0x80, 0x00, 0x00, 0x00,
	0x04, 0x00, 0x00, 0x00, 0xba, 0xfb, 0xff, 0xff, 0x00, 0x00, 0x00, 0x01,
	0x18, 0x00, 0x00, 0x00, 0x20, 0x00, 0x00, 0x00, 0x3c, 0x00, 0x00, 0x00,
	0x07, 0x00, 0x00, 0x00, 0x00, 0x00, 0x00, 0x09, 0x50, 0x00, 0x00, 0x00,
	0x02, 0x00, 0x00, 0x00, 0xff, 0xff, 0xff, 0xff, 0x03, 0x00, 0x00, 0x00,
	0xa4, 0xfb, 0xff, 0xff, 0x08, 0x00, 0x00, 0x00, 0x10, 0x00, 0x00, 0x00,
	0x01, 0x00, 0x00, 0x00, 0xfd, 0xff, 0xff, 0xff, 0xff, 0xff, 0xff, 0xff,
	0x01, 0x00, 0x00, 0x00, 0x92, 0x49, 0x10, 0x3e, 0x1b, 0x00, 0x00, 0x00,
	0x53, 0x74, 0x61, 0x74, 0x65, 0x66, 0x75, 0x6c, 0x50, 0x61, 0x72, 0x74,
	0x69, 0x74, 0x69, 0x6f, 0x6e, 0x65, 0x64, 0x43, 0x61, 0x6c, 0x6c, 0x5f,
	0x31, 0x3a, 0x30, 0x00, 0x02, 0x00, 0x00, 0x00, 0x01, 0x00, 0x00, 0x00,
	0x03, 0x00, 0x00, 0x00, 0x32, 0xfc, 0xff, 0xff, 0x00, 0x00, 0x00, 0x01,
	0x18, 0x00, 0x00, 0x00, 0x20, 0x00, 0x00, 0x00, 0x3c, 0x00, 0x00, 0x00,
	0x06, 0x00, 0x00, 0x00, 0x00, 0x00, 0x00, 0x09, 0x88, 0x00, 0x00, 0x00,
	0x02, 0x00, 0x00, 0x00, 0xff, 0xff, 0xff, 0xff, 0x0c, 0x00, 0x00, 0x00,
	0x1c, 0xfc, 0xff, 0xff, 0x08, 0x00, 0x00, 0x00, 0x10, 0x00, 0x00, 0x00,
	0x01, 0x00, 0x00, 0x00, 0x80, 0xff, 0xff, 0xff, 0xff, 0xff, 0xff, 0xff,
	0x01, 0x00, 0x00, 0x00, 0x1b, 0x02, 0x36, 0x3c, 0x52, 0x00, 0x00, 0x00,
	0x73, 0x65, 0x71, 0x75, 0x65, 0x6e, 0x74, 0x69, 0x61, 0x6c, 0x5f, 0x31,
	0x2f, 0x64, 0x65, 0x6e, 0x73, 0x65, 0x5f, 0x31, 0x2f, 0x4d, 0x61, 0x74,
	0x4d, 0x75, 0x6c, 0x3b, 0x73, 0x65, 0x71, 0x75, 0x65, 0x6e, 0x74, 0x69,
	0x61, 0x6c, 0x5f, 0x31, 0x2f, 0x64, 0x65, 0x6e, 0x73, 0x65, 0x5f, 0x31,
	0x2f, 0x52, 0x65, 0x6c, 0x75, 0x3b, 0x73, 0x65, 0x71, 0x75, 0x65, 0x6e,
	0x74, 0x69, 0x61, 0x6c, 0x5f, 0x31, 0x2f, 0x64, 0x65, 0x6e, 0x73, 0x65,
	0x5f, 0x31, 0x2f, 0x42, 0x69, 0x61, 0x73, 0x41, 0x64, 0x64, 0x00, 0x00,
	0x02, 0x00, 0x00, 0x00, 0x01, 0x00, 0x00, 0x00, 0x0c, 0x00, 0x00, 0x00,
	0x7e, 0xfd, 0xff, 0xff, 0x00, 0x00, 0x00, 0x01, 0x14, 0x00, 0x00, 0x00,
	0xb8, 0x00, 0x00, 0x00, 0x05, 0x00, 0x00, 0x00, 0x00, 0x00, 0x00, 0x09,
	0xcc, 0x00, 0x00, 0x00, 0xbc, 0xfc, 0xff, 0xff, 0x08, 0x00, 0x00, 0x00,
	0x6c, 0x00, 0x00, 0x00, 0x0c, 0x00, 0x00, 0x00, 0x00, 0x00, 0x00, 0x00,
	0x00, 0x00, 0x00, 0x00, 0x00, 0x00, 0x00, 0x00, 0x00, 0x00, 0x00, 0x00,
	0x00, 0x00, 0x00, 0x00, 0x00, 0x00, 0x00, 0x00, 0x00, 0x00, 0x00, 0x00,
	0x00, 0x00, 0x00, 0x00, 0x00, 0x00, 0x00, 0x00, 0x00, 0x00, 0x00, 0x00,
	0x00, 0x00, 0x00, 0x00, 0x00, 0x00, 0x00, 0x00, 0x00, 0x00, 0x00, 0x00,
	0x00, 0x00, 0x00, 0x00, 0x00, 0x00, 0x00, 0x00, 0x00, 0x00, 0x00, 0x00,
	0x00, 0x00, 0x00, 0x00, 0x00, 0x00, 0x00, 0x00, 0x00, 0x00, 0x00, 0x00,
	0x00, 0x00, 0x00, 0x00, 0x00, 0x00, 0x00, 0x00, 0x00, 0x00, 0x00, 0x00,
	0x00, 0x00, 0x00, 0x00, 0x00, 0x00, 0x00, 0x00, 0x00, 0x00, 0x00, 0x00,
	0x0c, 0x00, 0x00, 0x00, 0xb6, 0x6b, 0x61, 0x3b, 0x8d, 0x7d, 0xe3, 0x3c,
	0x5e, 0x60, 0xe6, 0x3c, 0xca, 0x94, 0xe1, 0x3c, 0xc9, 0x10, 0x9f, 0x3c,
	0xb2, 0x7a, 0x6a, 0x3b, 0x33, 0x12, 0xdb, 0x3c, 0x92, 0x50, 0xc1, 0x3c,
	0x12, 0x8c, 0xb1, 0x3b, 0xce, 0xb9, 0xe0, 0x3c, 0x72, 0x6e, 0x43, 0x3b,
	0xd7, 0xd0, 0x7e, 0x3b, 0x1b, 0x00, 0x00, 0x00, 0x73, 0x65, 0x71, 0x75,
	0x65, 0x6e, 0x74, 0x69, 0x61, 0x6c, 0x5f, 0x31, 0x2f, 0x64, 0x65, 0x6e,
	0x73, 0x65, 0x5f, 0x31, 0x2f, 0x4d, 0x61, 0x74, 0x4d, 0x75, 0x6c, 0x00,
	0x02, 0x00, 0x00, 0x00, 0x0c, 0x00, 0x00, 0x00, 0x06, 0x00, 0x00, 0x00,
	0x6e, 0xfe, 0xff, 0xff, 0x00, 0x00, 0x00, 0x01, 0x14, 0x00, 0x00, 0x00,
	0xb8, 0x00, 0x00, 0x00, 0x04, 0x00, 0x00, 0x00, 0x00, 0x00, 0x00, 0x02,
	0xe8, 0x00, 0x00, 0x00, 0xac, 0xfd, 0xff, 0xff, 0x08, 0x00, 0x00, 0x00,
	0x6c, 0x00, 0x00, 0x00, 0x0c, 0x00, 0x00, 0x00, 0x00, 0x00, 0x00, 0x00,
	0x00, 0x00, 0x00, 0x00, 0x00, 0x00, 0x00, 0x00, 0x00, 0x00, 0x00, 0x00,
	0x00, 0x00, 0x00, 0x00, 0x00, 0x00, 0x00, 0x00, 0x00, 0x00, 0x00, 0x00,
	0x00, 0x00, 0x00, 0x00, 0x00, 0x00, 0x00, 0x00, 0x00, 0x00, 0x00, 0x00,
	0x00, 0x00, 0x00, 0x00, 0x00, 0x00, 0x00, 0x00, 0x00, 0x00, 0x00, 0x00,
	0x00, 0x00, 0x00, 0x00, 0x00, 0x00, 0x00, 0x00, 0x00, 0x00, 0x00, 0x00,
	0x00, 0x00, 0x00, 0x00, 0x00, 0x00, 0x00, 0x00, 0x00, 0x00, 0x00, 0x00,
	0x00, 0x00, 0x00, 0x00, 0x00, 0x00, 0x00, 0x00, 0x00, 0x00, 0x00, 0x00,
	0x00, 0x00, 0x00, 0x00, 0x00, 0x00, 0x00, 0x00, 0x00, 0x00, 0x00, 0x00,
	0x0c, 0x00, 0x00, 0x00, 0x55, 0xbc, 0x15, 0x37, 0x47, 0x1c, 0x97, 0x38,
	0x09, 0x07, 0x99, 0x38, 0x9e, 0xd7, 0x95, 0x38, 0x8a, 0x51, 0x53, 0x38,
	0xb7, 0xc0, 0x1b, 0x37, 0x96, 0x84, 0x91, 0x38, 0xc5, 0x68, 0x80, 0x38,
	0x0d, 0xdf, 0x6b, 0x37, 0x28, 0x46, 0x95, 0x38, 0xb6, 0xd0, 0x01, 0x37,
	0xe5, 0x42, 0x29, 0x37, 0x36, 0x00, 0x00, 0x00, 0x73, 0x65, 0x71, 0x75,
	0x65, 0x6e, 0x74, 0x69, 0x61, 0x6c, 0x5f, 0x31, 0x2f, 0x64, 0x65, 0x6e,
	0x73, 0x65, 0x5f, 0x31, 0x2f, 0x52, 0x65, 0x6c, 0x75, 0x3b, 0x73, 0x65,
	0x71, 0x75, 0x65, 0x6e, 0x74, 0x69, 0x61, 0x6c, 0x5f, 0x31, 0x2f, 0x64,
	0x65, 0x6e, 0x73, 0x65, 0x5f, 0x31, 0x2f, 0x42, 0x69, 0x61, 0x73, 0x41,
	0x64, 0x64, 0x00, 0x00, 0x01, 0x00, 0x00, 0x00, 0x0c, 0x00, 0x00, 0x00,
	0x76, 0xff, 0xff, 0xff, 0x00, 0x00, 0x00, 0x01, 0x14, 0x00, 0x00, 0x00,
	0x4c, 0x00, 0x00, 0x00, 0x03, 0x00, 0x00, 0x00, 0x00, 0x00, 0x00, 0x09,
	0x64, 0x00, 0x00, 0x00, 0xb4, 0xfe, 0xff, 0xff, 0x08, 0x00, 0x00, 0x00,
	0x24, 0x00, 0x00, 0x00, 0x03, 0x00, 0x00, 0x00, 0x00, 0x00, 0x00, 0x00,
	0x00, 0x00, 0x00, 0x00, 0x00, 0x00, 0x00, 0x00, 0x00, 0x00, 0x00, 0x00,
	0x00, 0x00, 0x00, 0x00, 0x00, 0x00, 0x00, 0x00, 0x00, 0x00, 0x00, 0x00,
	0x03, 0x00, 0x00, 0x00, 0xeb, 0x34, 0x22, 0x3d, 0xc9, 0xaf, 0x08, 0x3d,
	0x8b, 0x93, 0x05, 0x3d, 0x1d, 0x00, 0x00, 0x00, 0x73, 0x65, 0x71, 0x75,
	0x65, 0x6e, 0x74, 0x69, 0x61, 0x6c, 0x5f, 0x31, 0x2f, 0x64, 0x65, 0x6e,
	0x73, 0x65, 0x5f, 0x31, 0x5f, 0x32, 0x2f, 0x4d, 0x61, 0x74, 0x4d, 0x75,
	0x6c, 0x00, 0x00, 0x00, 0x02, 0x00, 0x00, 0x00, 0x03, 0x00, 0x00, 0x00,
	0x0c, 0x00, 0x00, 0x00, 0x00, 0x00, 0x16, 0x00, 0x1c, 0x00, 0x18, 0x00,
	0x17, 0x00, 0x10, 0x00, 0x0c, 0x00, 0x08, 0x00, 0x00, 0x00, 0x00, 0x00,
	0x00, 0x00, 0x07, 0x00, 0x16, 0x00, 0x00, 0x00, 0x00, 0x00, 0x00, 0x01,
	0x14, 0x00, 0x00, 0x00, 0x4c, 0x00, 0x00, 0x00, 0x02, 0x00, 0x00, 0x00,
	0x00, 0x00, 0x00, 0x02, 0x64, 0x00, 0x00, 0x00, 0x54, 0xff, 0xff, 0xff,
	0x08, 0x00, 0x00, 0x00, 0x24, 0x00, 0x00, 0x00, 0x03, 0x00, 0x00, 0x00,
	0x00, 0x00, 0x00, 0x00, 0x00, 0x00, 0x00, 0x00, 0x00, 0x00, 0x00, 0x00,
	0x00, 0x00, 0x00, 0x00, 0x00, 0x00, 0x00, 0x00, 0x00, 0x00, 0x00, 0x00,
	0x00, 0x00, 0x00, 0x00, 0x03, 0x00, 0x00, 0x00, 0xe9, 0xa5, 0xe6, 0x39,
	0x31, 0x5c, 0xc2, 0x39, 0xfc, 0xef, 0xbd, 0x39, 0x1e, 0x00, 0x00, 0x00,
	0x73, 0x65, 0x71, 0x75, 0x65, 0x6e, 0x74, 0x69, 0x61, 0x6c, 0x5f, 0x31,
	0x2f, 0x64, 0x65, 0x6e, 0x73, 0x65, 0x5f, 0x31, 0x5f, 0x32, 0x2f, 0x42,
	0x69, 0x61, 0x73, 0x41, 0x64, 0x64, 0x00, 0x00, 0x01, 0x00, 0x00, 0x00,
	0x03, 0x00, 0x00, 0x00, 0x00, 0x00, 0x16, 0x00, 0x20, 0x00, 0x1c, 0x00,
	0x1b, 0x00, 0x14, 0x00, 0x10, 0x00, 0x0c, 0x00, 0x00, 0x00, 0x00, 0x00,
	0x08, 0x00, 0x07, 0x00, 0x16, 0x00, 0x00, 0x00, 0x00, 0x00, 0x00, 0x01,
	0x18, 0x00, 0x00, 0x00, 0x2c, 0x00, 0x00, 0x00, 0x4c, 0x00, 0x00, 0x00,
	0x01, 0x00, 0x00, 0x00, 0x00, 0x00, 0x00, 0x09, 0x64, 0x00, 0x00, 0x00,
	0x02, 0x00, 0x00, 0x00, 0xff, 0xff, 0xff, 0xff, 0x06, 0x00, 0x00, 0x00,
	0x0c, 0x00, 0x0c, 0x00, 0x00, 0x00, 0x00, 0x00, 0x08, 0x00, 0x04, 0x00,
	0x0c, 0x00, 0x00, 0x00, 0x08, 0x00, 0x00, 0x00, 0x14, 0x00, 0x00, 0x00,
	0x01, 0x00, 0x00, 0x00, 0x8e, 0xff, 0xff, 0xff, 0xff, 0xff, 0xff, 0xff,
	0x00, 0x00, 0x00, 0x00, 0x01, 0x00, 0x00, 0x00, 0x45, 0x0c, 0x2a, 0x3b,
	0x1e, 0x00, 0x00, 0x00, 0x73, 0x65, 0x72, 0x76, 0x69, 0x6e, 0x67, 0x5f,
	0x64, 0x65, 0x66, 0x61, 0x75, 0x6c, 0x74, 0x5f, 0x6b, 0x65, 0x72, 0x61,
	0x73, 0x5f, 0x74, 0x65, 0x6e, 0x73, 0x6f, 0x72, 0x3a, 0x30, 0x00, 0x00,
	0x02, 0x00, 0x00, 0x00, 0x01, 0x00, 0x00, 0x00, 0x06, 0x00, 0x00, 0x00,
	0x01, 0x00, 0x00, 0x00, 0x10, 0x00, 0x00, 0x00, 0x0c, 0x00, 0x10, 0x00,
	0x0f, 0x00, 0x00, 0x00, 0x08, 0x00, 0x04, 0x00, 0x0c, 0x00, 0x00, 0x00,
	0x09, 0x00, 0x00, 0x00, 0x04, 0x00, 0x00, 0x00, 0x00, 0x00, 0x00, 0x09
};

const int g_model_len = sizeof(g_model);
```

## src/ring_buffer.c
```c
/*
 * SPDX-FileCopyrightText: Copyright (c) 2026 Mahad Faisal
 * SPDX-License-Identifier: Apache-2.0
 */

#include "ring_buffer.h"

void stream_ring_buffer_reset(struct stream_ring_buffer *ring)
{
	ring->head = 0U;
	ring->count = 0U;
}

void stream_ring_buffer_push(struct stream_ring_buffer *ring, int16_t sample)
{
	ring->data[ring->head] = sample;
	ring->head = (ring->head + 1U) % STREAM_RING_BUFFER_SIZE;

	if (ring->count < STREAM_RING_BUFFER_SIZE) {
		ring->count++;
	}
}

void stream_ring_buffer_push_many(struct stream_ring_buffer *ring,
				  const int16_t *samples, size_t len)
{
	for (size_t i = 0U; i < len; i++) {
		stream_ring_buffer_push(ring, samples[i]);
	}
}

void stream_ring_buffer_copy_window(const struct stream_ring_buffer *ring,
				    int16_t *window, size_t len)
{
	size_t start = (ring->head + STREAM_RING_BUFFER_SIZE - len) %
			       STREAM_RING_BUFFER_SIZE;

	for (size_t i = 0U; i < len; i++) {
		window[i] = ring->data[(start + i) % STREAM_RING_BUFFER_SIZE];
	}
}
```

## src/ring_buffer.h
```c
/*
 * SPDX-FileCopyrightText: Copyright (c) 2026 Mahad Faisal
 * SPDX-License-Identifier: Apache-2.0
 */

#pragma once

#include <stddef.h>
#include <stdint.h>

#ifdef __cplusplus
extern "C" {
#endif

#define STREAM_RING_BUFFER_SIZE 64U

struct stream_ring_buffer {
	int16_t data[STREAM_RING_BUFFER_SIZE];
	size_t head;
	size_t count;
};

void stream_ring_buffer_reset(struct stream_ring_buffer *ring);
void stream_ring_buffer_push(struct stream_ring_buffer *ring, int16_t sample);
void stream_ring_buffer_push_many(struct stream_ring_buffer *ring,
				  const int16_t *samples, size_t len);
void stream_ring_buffer_copy_window(const struct stream_ring_buffer *ring,
				    int16_t *window, size_t len);

#ifdef __cplusplus
}
#endif
```

## src/stream_features.c
```c
/*
 * SPDX-FileCopyrightText: Copyright (c) 2026 Mahad Faisal
 * SPDX-License-Identifier: Apache-2.0
 */

#include "stream_features.h"

#include <math.h>
#include <stdbool.h>
#include <stddef.h>
#include <stdint.h>

static bool stream_crossed_zero(int16_t previous, int16_t current)
{
	return (previous < 0 && current >= 0) ||
		       (previous >= 0 && current < 0);
}

void stream_extract_features(const int16_t *samples, size_t len,
			     struct stream_features *features)
{
	float sum;
	float sum_sq;
	float peak;
	uint32_t zero_crossings;

	sum = 0.0f;
	sum_sq = 0.0f;
	peak = 0.0f;
	zero_crossings = 0U;

	for (size_t i = 0U; i < len; i++) {
		float value = (float)samples[i];
		float abs_value = fabsf(value);

		sum += value;
		sum_sq += value * value;

		if (abs_value > peak) {
			peak = abs_value;
		}

		if (i > 0U && stream_crossed_zero(samples[i - 1U], samples[i])) {
			zero_crossings++;
		}
	}

	features->mean = sum / (float)len;
	features->rms = sqrtf(sum_sq / (float)len);
	features->peak = peak;
	features->zero_crossing_rate = (float)zero_crossings / (float)(len - 1U);
	features->slope = (float)(samples[len - 1U] - samples[0]) / (float)len;
	features->energy = sum_sq;
}
```

## src/stream_features.h
```c
/*
 * SPDX-FileCopyrightText: Copyright (c) 2026 Mahad Faisal
 * SPDX-License-Identifier: Apache-2.0
 */

#pragma once

#include <stddef.h>
#include <stdint.h>

#ifdef __cplusplus
extern "C" {
#endif

#define STREAM_WINDOW_SIZE 64U
#define STREAM_HOP_SIZE 32U
#define STREAM_NUM_FEATURES 6U

struct stream_features {
	float mean;
	float rms;
	float peak;
	float zero_crossing_rate;
	float slope;
	float energy;
};

void stream_extract_features(const int16_t *samples, size_t len,
			     struct stream_features *features);

#ifdef __cplusplus
}
#endif
```
