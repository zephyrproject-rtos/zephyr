## CMakeLists.txt
```
# Copyright (c) 2026 Mahad Faisal
# SPDX-License-Identifier: Apache-2.0

cmake_minimum_required(VERSION 3.20.0)

find_package(Zephyr REQUIRED HINTS $ENV{ZEPHYR_BASE})
project(tflm_fft_event_classifier)

target_include_directories(app PRIVATE src)

target_sources(app PRIVATE
  src/assert.cpp
  src/dsp_features.c
  src/input_data.c
  src/main.c
  src/main_functions.cpp
  src/model.cpp
)
```

## sample.yaml
```
sample:
  description: TensorFlow Lite Micro FFT event classifier sample
  name: FFT event classifier TensorFlow Lite Micro

common:
  tags:
    - tensorflow
    - cmsis_dsp
  modules:
    - tflite-micro
    - cmsis-dsp
  harness: console
  harness_config:
    type: multi_line
    ordered: false
    regex:
      - "input_window: .*"
      - "prediction: .*"
      - "result: PASS"

tests:
  sample.tensorflow.fft_event_classifier:
    platform_allow:
      - qemu_x86
      - qemu_x86_64
    integration_platforms:
      - qemu_x86
    filter: CONFIG_FULL_LIBC_SUPPORTED

  sample.tensorflow.fft_event_classifier.cmsis_nn:
    platform_allow:
      - ek_ra8m1
    extra_configs:
      - CONFIG_TENSORFLOW_LITE_MICRO_CMSIS_NN_KERNELS=y
```

## prj.conf
```kconfig
# Copyright 2019 The TensorFlow Authors. All Rights Reserved.
#
# Licensed under the Apache License, Version 2.0 (the "License");
# you may not use this file except in compliance with the License.
# You may obtain a copy of the License at
#
#    http://www.apache.org/licenses/LICENSE-2.0
#
# Unless required by applicable law or agreed to in writing, software
# distributed under the License is distributed on an "AS IS" BASIS,
# WITHOUT WARRANTIES OR CONDITIONS OF ANY KIND, either express or implied.
# See the License for the specific language governing permissions and
# limitations under the License.
# ==============================================================================s
CONFIG_CPP=y
CONFIG_STD_CPP17=y
CONFIG_TENSORFLOW_LITE_MICRO=y
CONFIG_MAIN_STACK_SIZE=2048
CONFIG_REQUIRES_FLOAT_PRINTF=y

CONFIG_CMSIS_DSP=y
CONFIG_CMSIS_DSP_TRANSFORM=y
```

## src/dsp_features.c
```c
/*
 * SPDX-FileCopyrightText: Copyright (c) 2026 Mahad Faisal
 * SPDX-License-Identifier: Apache-2.0
 */

#include "dsp_features.h"

#include <arm_math.h>
#include <errno.h>
#include <math.h>
#include <stdbool.h>
#include <stddef.h>
#include <stdint.h>

#define FFT_EVENT_NUM_BINS (FFT_EVENT_WINDOW_SIZE / 2U)
#define FFT_EVENT_PI 3.14159265358979323846f

static arm_rfft_fast_instance_f32 fft_instance;
static bool fft_initialized;
static float32_t fft_input[FFT_EVENT_WINDOW_SIZE];
static float32_t fft_output[FFT_EVENT_WINDOW_SIZE];

static bool fft_event_crossed_zero(int16_t previous, int16_t current)
{
	return (previous < 0 && current >= 0) ||
		       (previous >= 0 && current < 0);
}

static float fft_event_band_energy(const float *magnitudes, size_t first,
				   size_t last)
{
	float energy;

	energy = 0.0f;

	for (size_t i = first; i <= last; i++) {
		energy += magnitudes[i] * magnitudes[i];
	}

	return energy;
}

static int fft_event_init_fft(void)
{
	if (fft_initialized) {
		return 0;
	}

	if (arm_rfft_fast_init_f32(&fft_instance,
				   FFT_EVENT_WINDOW_SIZE) != ARM_MATH_SUCCESS) {
		return -EIO;
	}

	fft_initialized = true;

	return 0;
}

static void fft_event_extract_time_features(const int16_t *samples, size_t len,
					    struct fft_event_features *features)
{
	float sum;
	float sum_sq;
	float peak;
	uint32_t zero_crossings;

	sum = 0.0f;
	sum_sq = 0.0f;
	peak = 0.0f;
	zero_crossings = 0U;

	for (size_t i = 0; i < len; i++) {
		float value = (float)samples[i];
		float abs_value = fabsf(value);

		sum += value;
		sum_sq += value * value;

		if (abs_value > peak) {
			peak = abs_value;
		}

		if (i > 0U && fft_event_crossed_zero(samples[i - 1U], samples[i])) {
			zero_crossings++;
		}
	}

	features->mean = sum / (float)len;
	features->rms = sqrtf(sum_sq / (float)len);
	features->peak = peak;
	features->zero_crossing_rate = (float)zero_crossings / (float)(len - 1U);
}

static void fft_event_apply_window(const int16_t *samples,
				   const struct fft_event_features *features,
				   size_t len)
{
	for (size_t i = 0; i < len; i++) {
		float centered = (float)samples[i] - features->mean;
		float phase = (2.0f * FFT_EVENT_PI * (float)i) /
			      (float)(FFT_EVENT_WINDOW_SIZE - 1U);
		float window = 0.5f - (0.5f * cosf(phase));

		fft_input[i] = centered * window;
	}
}

static void fft_event_compute_magnitudes(float *magnitudes)
{
	magnitudes[0] = fabsf(fft_output[0]);
	magnitudes[FFT_EVENT_NUM_BINS] = fabsf(fft_output[1]);

	for (size_t i = 1U; i < FFT_EVENT_NUM_BINS; i++) {
		float real = fft_output[2U * i];
		float imag = fft_output[(2U * i) + 1U];

		magnitudes[i] = sqrtf((real * real) + (imag * imag));
	}
}

static void fft_event_extract_spectral_features(float *magnitudes,
					struct fft_event_features *features)
{
	float low_energy;
	float mid_energy;
	float high_energy;
	float total_energy;
	float weighted_sum;
	float magnitude_sum;

	low_energy = fft_event_band_energy(magnitudes, 1U, 4U);
	mid_energy = fft_event_band_energy(magnitudes, 5U, 12U);
	high_energy = fft_event_band_energy(magnitudes, 13U, FFT_EVENT_NUM_BINS);
	total_energy = low_energy + mid_energy + high_energy;

	if (total_energy <= 0.0f) {
		total_energy = 1.0f;
	}

	features->low_band_energy = low_energy / total_energy;
	features->mid_band_energy = mid_energy / total_energy;
	features->high_band_energy = high_energy / total_energy;

	weighted_sum = 0.0f;
	magnitude_sum = 0.0f;

	for (size_t i = 1U; i <= FFT_EVENT_NUM_BINS; i++) {
		weighted_sum += (float)i * magnitudes[i];
		magnitude_sum += magnitudes[i];
	}

	if (magnitude_sum <= 0.0f) {
		features->spectral_centroid = 0.0f;
	} else {
		features->spectral_centroid =
			(weighted_sum / magnitude_sum) / (float)FFT_EVENT_NUM_BINS;
	}
}

int fft_event_extract_features(const int16_t *samples, size_t len,
			       struct fft_event_features *features)
{
	float magnitudes[FFT_EVENT_NUM_BINS + 1U];
	int ret;

	if (len != FFT_EVENT_WINDOW_SIZE || samples == NULL || features == NULL) {
		return -EINVAL;
	}

	ret = fft_event_init_fft();
	if (ret != 0) {
		return ret;
	}

	fft_event_extract_time_features(samples, len, features);
	fft_event_apply_window(samples, features, len);
	arm_rfft_fast_f32(&fft_instance, fft_input, fft_output, 0);
	fft_event_compute_magnitudes(magnitudes);
	fft_event_extract_spectral_features(magnitudes, features);

	return 0;
}
```

## src/dsp_features.h
```c
/*
 * SPDX-FileCopyrightText: Copyright (c) 2026 Mahad Faisal
 * SPDX-License-Identifier: Apache-2.0
 */

#pragma once

#include <stddef.h>
#include <stdint.h>

#ifdef __cplusplus
extern "C" {
#endif

#define FFT_EVENT_WINDOW_SIZE 64U
#define FFT_EVENT_NUM_CLASSES 3U
#define FFT_EVENT_NUM_FEATURES 8U

struct fft_event_features {
	float mean;
	float rms;
	float peak;
	float zero_crossing_rate;
	float low_band_energy;
	float mid_band_energy;
	float high_band_energy;
	float spectral_centroid;
};

int fft_event_extract_features(const int16_t *samples, size_t len,
			       struct fft_event_features *features);

#ifdef __cplusplus
}
#endif
```

## src/input_data.c
```c
/*
 * Copyright (c) 2026 Mahad Faisal
 *
 * SPDX-License-Identifier: Apache-2.0
 */

#include "dsp_features.h"
#include "input_data.h"

#include <stddef.h>
#include <stdint.h>

static const int16_t normal_window[FFT_EVENT_WINDOW_SIZE] = {
	0, 195, 383, 556, 707, 831, 924, 981,
	1000, 981, 924, 831, 707, 556, 383, 195,
	0, -195, -383, -556, -707, -831, -924, -981,
	-1000, -981, -924, -831, -707, -556, -383, -195,
	0, 195, 383, 556, 707, 831, 924, 981,
	1000, 981, 924, 831, 707, 556, 383, 195,
	0, -195, -383, -556, -707, -831, -924, -981,
	-1000, -981, -924, -831, -707, -556, -383, -195
};

static const int16_t high_frequency_window[FFT_EVENT_WINDOW_SIZE] = {
	0, 831, 924, 195, -707, -981, -383, 556,
	1000, 556, -383, -981, -707, 195, 924, 831,
	0, -831, -924, -195, 707, 981, 383, -556,
	-1000, -556, 383, 981, 707, -195, -924, -831,
	0, 831, 924, 195, -707, -981, -383, 556,
	1000, 556, -383, -981, -707, 195, 924, 831,
	0, -831, -924, -195, 707, 981, 383, -556,
	-1000, -556, 383, 981, 707, -195, -924, -831
};

static const int16_t transient_window[FFT_EVENT_WINDOW_SIZE] = {
	0, 176, 344, 500, 636, 748, 831, 883,
	900, 883, 831, 748, 636, 500, 344, 176,
	2500, -176, -344, -500, -636, -748, -831, -883,
	-900, -883, -831, -748, -636, -500, -344, -176,
	0, 176, 344, 500, 636, 748, 831, 883,
	900, 883, 831, 748, 636, 500, 344, 176,
	-2300, -176, -344, -500, -636, -748, -831, -883,
	-900, -883, -831, -748, -636, -500, -344, -176
};

static const struct fft_event_window windows[FFT_EVENT_NUM_CLASSES] = {
	{
		.name = "normal",
		.label = FFT_EVENT_NORMAL,
		.samples = normal_window,
		.len = FFT_EVENT_WINDOW_SIZE,
	},
	{
		.name = "high_frequency",
		.label = FFT_EVENT_HIGH_FREQUENCY,
		.samples = high_frequency_window,
		.len = FFT_EVENT_WINDOW_SIZE,
	},
	{
		.name = "transient",
		.label = FFT_EVENT_TRANSIENT,
		.samples = transient_window,
		.len = FFT_EVENT_WINDOW_SIZE,
	}
};

const struct fft_event_window *fft_event_get_window(size_t index)
{
return &windows[index % FFT_EVENT_NUM_CLASSES];
}

const char *fft_event_label_name(enum fft_event_label label)
{
switch (label) {
case FFT_EVENT_NORMAL:
return "normal";
case FFT_EVENT_HIGH_FREQUENCY:
return "high_frequency";
case FFT_EVENT_TRANSIENT:
return "transient";
default:
return "unknown";
}
}
```

## src/input_data.h
```c
/*
 * Copyright (c) 2026 Mahad Faisal
 *
 * SPDX-License-Identifier: Apache-2.0
 */

#pragma once

#include <stddef.h>
#include <stdint.h>

#ifdef __cplusplus
extern "C" {
#endif

enum fft_event_label {
FFT_EVENT_NORMAL = 0,
FFT_EVENT_HIGH_FREQUENCY = 1,
FFT_EVENT_TRANSIENT = 2,
};

struct fft_event_window {
const char *name;
enum fft_event_label label;
const int16_t *samples;
size_t len;
};

const struct fft_event_window *fft_event_get_window(size_t index);
const char *fft_event_label_name(enum fft_event_label label);

#ifdef __cplusplus
}
#endif
```

## src/main_functions.cpp
```c
/*
 * Copyright 2020 The TensorFlow Authors. All Rights Reserved.
 * Copyright (c) 2026 Mahad Faisal
 *
 * SPDX-License-Identifier: Apache-2.0
 */

#include "main_functions.h"

#include <math.h>
#include <stddef.h>
#include <stdint.h>

#include <tensorflow/lite/micro/micro_interpreter.h>
#include <tensorflow/lite/micro/micro_log.h>
#include <tensorflow/lite/micro/micro_mutable_op_resolver.h>
#include <tensorflow/lite/micro/system_setup.h>
#include <tensorflow/lite/schema/schema_generated.h>
#include <zephyr/kernel.h>

#include "dsp_features.h"
#include "input_data.h"
#include "model.hpp"

namespace {
const tflite::Model *model = nullptr;
tflite::MicroInterpreter *interpreter = nullptr;
TfLiteTensor *input = nullptr;
TfLiteTensor *output = nullptr;
size_t inference_count = 0U;

constexpr int kTensorArenaSize = 4096;
uint8_t tensor_arena[kTensorArenaSize];

float normalize_feature(size_t index, const struct fft_event_features *features)
{
switch (index) {
case 0:
return features->mean / 4000.0f;
case 1:
return features->rms / 2000.0f;
case 2:
return features->peak / 4000.0f;
case 3:
return features->zero_crossing_rate / 0.50f;
case 4:
return features->low_band_energy;
case 5:
return features->mid_band_energy;
case 6:
return features->high_band_energy;
case 7:
return features->spectral_centroid;
default:
return 0.0f;
}
}

int8_t quantize_input(float value)
{
int32_t quantized = (int32_t)roundf(value / input->params.scale) +
    input->params.zero_point;

if (quantized > 127) {
return 127;
}

if (quantized < -128) {
return -128;
}

return (int8_t)quantized;
}

float dequantize_output(int8_t value)
{
return ((float)value - (float)output->params.zero_point) *
       output->params.scale;
}

enum fft_event_label output_to_label(size_t index)
{
switch (index) {
case 0:
return FFT_EVENT_NORMAL;
case 1:
return FFT_EVENT_HIGH_FREQUENCY;
case 2:
return FFT_EVENT_TRANSIENT;
default:
return FFT_EVENT_NORMAL;
}
}
}  /* namespace */

void setup(void)
{
model = tflite::GetModel(g_model);
if (model->version() != TFLITE_SCHEMA_VERSION) {
MicroPrintf("Model schema version %d not equal to supported version %d.",
    model->version(), TFLITE_SCHEMA_VERSION);
return;
}

static tflite::MicroMutableOpResolver<1> resolver;
resolver.AddFullyConnected();

static tflite::MicroInterpreter static_interpreter(
model, resolver, tensor_arena, kTensorArenaSize);
interpreter = &static_interpreter;

TfLiteStatus allocate_status = interpreter->AllocateTensors();
if (allocate_status != kTfLiteOk) {
MicroPrintf("AllocateTensors() failed");
return;
}

input = interpreter->input(0);
output = interpreter->output(0);
inference_count = 0U;
}

void loop(void)
{
const struct fft_event_window *window =
fft_event_get_window(inference_count);
struct fft_event_features features;
enum fft_event_label predicted;
uint32_t preprocess_start;
uint32_t preprocess_cycles;
uint32_t preprocess_us;
uint32_t invoke_start;
uint32_t invoke_cycles;
uint32_t invoke_us;
uint32_t total_cycles;
uint32_t total_us;
float best_score;
size_t best_index = 0U;

preprocess_start = k_cycle_get_32();

if (fft_event_extract_features(window->samples, window->len, &features) != 0) {
MicroPrintf("Feature extraction failed\n");
return;
}

preprocess_cycles = k_cycle_get_32() - preprocess_start;
preprocess_us = (uint32_t)(k_cyc_to_ns_floor64(preprocess_cycles) / 1000U);

for (size_t i = 0U; i < FFT_EVENT_NUM_FEATURES; i++) {
input->data.int8[i] = quantize_input(normalize_feature(i, &features));
}

invoke_start = k_cycle_get_32();
TfLiteStatus invoke_status = interpreter->Invoke();
invoke_cycles = k_cycle_get_32() - invoke_start;
invoke_us = (uint32_t)(k_cyc_to_ns_floor64(invoke_cycles) / 1000U);

if (invoke_status != kTfLiteOk) {
MicroPrintf("Invoke failed\n");
return;
}

best_score = dequantize_output(output->data.int8[0]);
for (size_t i = 1U; i < FFT_EVENT_NUM_CLASSES; i++) {
float score = dequantize_output(output->data.int8[i]);

if (score > best_score) {
best_score = score;
best_index = i;
}
}

predicted = output_to_label(best_index);
total_cycles = preprocess_cycles + invoke_cycles;
total_us = preprocess_us + invoke_us;

MicroPrintf("input_window: %s\n", window->name);
MicroPrintf("features: rms=%f, peak=%f, zcr=%f, low=%f, mid=%f, high=%f, centroid=%f\n",
    (double)features.rms,
    (double)features.peak,
    (double)features.zero_crossing_rate,
    (double)features.low_band_energy,
    (double)features.mid_band_energy,
    (double)features.high_band_energy,
    (double)features.spectral_centroid);
MicroPrintf("preprocess_cycles: %u, preprocess_time_us: %u\n",
    (unsigned int)preprocess_cycles,
    (unsigned int)preprocess_us);
MicroPrintf("invoke_cycles: %u, invoke_time_us: %u\n",
    (unsigned int)invoke_cycles,
    (unsigned int)invoke_us);
MicroPrintf("total_cycles: %u, total_time_us: %u\n",
    (unsigned int)total_cycles,
    (unsigned int)total_us);
MicroPrintf("prediction: %s, score: %f\n",
    fft_event_label_name(predicted),
    (double)best_score);
MicroPrintf("result: %s\n",
    predicted == window->label ? "PASS" : "FAIL");

inference_count++;
if (inference_count >= FFT_EVENT_NUM_CLASSES) {
inference_count = 0U;
}
}
```

## src/model.cpp
```c
/*
 * Copyright (c) 2026 Mahad Faisal
 *
 * SPDX-License-Identifier: Apache-2.0
 */

#include "model.hpp"

#include <cstdint>

alignas(16) const unsigned char g_model[] = {
	0x20, 0x00, 0x00, 0x00, 0x54, 0x46, 0x4c, 0x33, 0x00, 0x00, 0x00, 0x00,
	0x14, 0x00, 0x20, 0x00, 0x1c, 0x00, 0x18, 0x00, 0x14, 0x00, 0x10, 0x00,
	0x0c, 0x00, 0x00, 0x00, 0x08, 0x00, 0x04, 0x00, 0x14, 0x00, 0x00, 0x00,
	0x1c, 0x00, 0x00, 0x00, 0x98, 0x00, 0x00, 0x00, 0xf0, 0x00, 0x00, 0x00,
	0xa8, 0x02, 0x00, 0x00, 0xb8, 0x02, 0x00, 0x00, 0xa4, 0x08, 0x00, 0x00,
	0x03, 0x00, 0x00, 0x00, 0x01, 0x00, 0x00, 0x00, 0x10, 0x00, 0x00, 0x00,
	0x00, 0x00, 0x0a, 0x00, 0x10, 0x00, 0x0c, 0x00, 0x08, 0x00, 0x04, 0x00,
	0x0a, 0x00, 0x00, 0x00, 0x0c, 0x00, 0x00, 0x00, 0x1c, 0x00, 0x00, 0x00,
	0x3c, 0x00, 0x00, 0x00, 0x0f, 0x00, 0x00, 0x00, 0x73, 0x65, 0x72, 0x76,
	0x69, 0x6e, 0x67, 0x5f, 0x64, 0x65, 0x66, 0x61, 0x75, 0x6c, 0x74, 0x00,
	0x01, 0x00, 0x00, 0x00, 0x04, 0x00, 0x00, 0x00, 0x90, 0xff, 0xff, 0xff,
	0x06, 0x00, 0x00, 0x00, 0x04, 0x00, 0x00, 0x00, 0x08, 0x00, 0x00, 0x00,
	0x6f, 0x75, 0x74, 0x70, 0x75, 0x74, 0x5f, 0x30, 0x00, 0x00, 0x00, 0x00,
	0x01, 0x00, 0x00, 0x00, 0x04, 0x00, 0x00, 0x00, 0xf2, 0xfd, 0xff, 0xff,
	0x04, 0x00, 0x00, 0x00, 0x0c, 0x00, 0x00, 0x00, 0x6b, 0x65, 0x72, 0x61,
	0x73, 0x5f, 0x74, 0x65, 0x6e, 0x73, 0x6f, 0x72, 0x00, 0x00, 0x00, 0x00,
	0x02, 0x00, 0x00, 0x00, 0x34, 0x00, 0x00, 0x00, 0x04, 0x00, 0x00, 0x00,
	0xdc, 0xff, 0xff, 0xff, 0x09, 0x00, 0x00, 0x00, 0x04, 0x00, 0x00, 0x00,
	0x13, 0x00, 0x00, 0x00, 0x43, 0x4f, 0x4e, 0x56, 0x45, 0x52, 0x53, 0x49,
	0x4f, 0x4e, 0x5f, 0x4d, 0x45, 0x54, 0x41, 0x44, 0x41, 0x54, 0x41, 0x00,
	0x08, 0x00, 0x0c, 0x00, 0x08, 0x00, 0x04, 0x00, 0x08, 0x00, 0x00, 0x00,
	0x08, 0x00, 0x00, 0x00, 0x04, 0x00, 0x00, 0x00, 0x13, 0x00, 0x00, 0x00,
	0x6d, 0x69, 0x6e, 0x5f, 0x72, 0x75, 0x6e, 0x74, 0x69, 0x6d, 0x65, 0x5f,
	0x76, 0x65, 0x72, 0x73, 0x69, 0x6f, 0x6e, 0x00, 0x0a, 0x00, 0x00, 0x00,
	0xb4, 0x01, 0x00, 0x00, 0xac, 0x01, 0x00, 0x00, 0x90, 0x01, 0x00, 0x00,
	0x54, 0x01, 0x00, 0x00, 0x14, 0x01, 0x00, 0x00, 0xa4, 0x00, 0x00, 0x00,
	0x9c, 0x00, 0x00, 0x00, 0x94, 0x00, 0x00, 0x00, 0x74, 0x00, 0x00, 0x00,
	0x04, 0x00, 0x00, 0x00, 0x96, 0xfe, 0xff, 0xff, 0x04, 0x00, 0x00, 0x00,
	0x60, 0x00, 0x00, 0x00, 0x0c, 0x00, 0x00, 0x00, 0x08, 0x00, 0x0e, 0x00,
	0x08, 0x00, 0x04, 0x00, 0x08, 0x00, 0x00, 0x00, 0x10, 0x00, 0x00, 0x00,
	0x28, 0x00, 0x00, 0x00, 0x00, 0x00, 0x06, 0x00, 0x08, 0x00, 0x04, 0x00,
	0x06, 0x00, 0x00, 0x00, 0x04, 0x00, 0x00, 0x00, 0x01, 0x00, 0x00, 0x00,
	0xeb, 0x03, 0x00, 0x00, 0x0c, 0x00, 0x18, 0x00, 0x14, 0x00, 0x10, 0x00,
	0x0c, 0x00, 0x04, 0x00, 0x0c, 0x00, 0x00, 0x00, 0xcd, 0x98, 0xfd, 0xce,
	0x96, 0x52, 0x81, 0x8a, 0x02, 0x00, 0x00, 0x00, 0x02, 0x00, 0x00, 0x00,
	0x04, 0x00, 0x00, 0x00, 0x06, 0x00, 0x00, 0x00, 0x32, 0x2e, 0x32, 0x31,
	0x2e, 0x30, 0x00, 0x00, 0x02, 0xff, 0xff, 0xff, 0x04, 0x00, 0x00, 0x00,
	0x10, 0x00, 0x00, 0x00, 0x31, 0x2e, 0x31, 0x34, 0x2e, 0x30, 0x00, 0x00,
	0x00, 0x00, 0x00, 0x00, 0x00, 0x00, 0x00, 0x00, 0x78, 0xfe, 0xff, 0xff,
	0x7c, 0xfe, 0xff, 0xff, 0x26, 0xff, 0xff, 0xff, 0x04, 0x00, 0x00, 0x00,
	0x60, 0x00, 0x00, 0x00, 0xc6, 0x5f, 0x31, 0xd1, 0x7f, 0xe0, 0x92, 0xaf,
	0xeb, 0x61, 0xfa, 0x79, 0x81, 0x53, 0xda, 0xee, 0x1b, 0xf1, 0x43, 0xff,
	0xf5, 0xdf, 0x7f, 0x75, 0xd4, 0xeb, 0x81, 0x2f, 0xb6, 0xd4, 0xda, 0xa5,
	0x5d, 0xa8, 0xe9, 0x51, 0x81, 0xe3, 0x83, 0xc3, 0xf1, 0x40, 0xd3, 0x53,
	0x9f, 0x7f, 0xab, 0x29, 0x81, 0x11, 0x9f, 0x88, 0xd3, 0xfc, 0x1a, 0x43,
	0x02, 0xb4, 0x85, 0x81, 0xb8, 0x55, 0x46, 0x07, 0xc4, 0x3c, 0xd6, 0x3f,
	0x8a, 0x7f, 0xd2, 0x37, 0x2b, 0xfc, 0x7f, 0x3e, 0xd1, 0x23, 0x64, 0x6b,
	0x0e, 0x0b, 0x50, 0x28, 0xd4, 0x2a, 0x7f, 0x71, 0xf8, 0x81, 0xbf, 0x27,
	0x24, 0xc1, 0xc2, 0xa9, 0x92, 0xff, 0xff, 0xff, 0x04, 0x00, 0x00, 0x00,
	0x30, 0x00, 0x00, 0x00, 0x83, 0x60, 0x00, 0x00, 0x06, 0x26, 0x00, 0x00,
	0x13, 0xf3, 0xff, 0xff, 0x00, 0x00, 0x00, 0x00, 0x54, 0xea, 0xff, 0xff,
	0xda, 0x25, 0x00, 0x00, 0x00, 0x00, 0x00, 0x00, 0xc2, 0xf0, 0xff, 0xff,
	0x03, 0x30, 0x00, 0x00, 0xe6, 0xfd, 0xff, 0xff, 0xbc, 0x02, 0x00, 0x00,
	0xbe, 0xf4, 0xff, 0xff, 0xce, 0xff, 0xff, 0xff, 0x04, 0x00, 0x00, 0x00,
	0x24, 0x00, 0x00, 0x00, 0x45, 0xe9, 0xcf, 0xf3, 0x14, 0x05, 0x18, 0xf9,
	0xfc, 0x9c, 0x81, 0xf6, 0x81, 0x5b, 0xc3, 0x2e, 0xe7, 0x61, 0x2f, 0x09,
	0x75, 0x00, 0x41, 0x1a, 0xdb, 0xbb, 0x7f, 0xdd, 0x18, 0xe2, 0xe0, 0x0a,
	0x99, 0x77, 0x5a, 0xe9, 0x00, 0x00, 0x06, 0x00, 0x08, 0x00, 0x04, 0x00,
	0x06, 0x00, 0x00, 0x00, 0x04, 0x00, 0x00, 0x00, 0x0c, 0x00, 0x00, 0x00,
	0x42, 0x0a, 0x00, 0x00, 0x1b, 0xf6, 0xff, 0xff, 0xa6, 0xf6, 0xff, 0xff,
	0x78, 0xff, 0xff, 0xff, 0x7c, 0xff, 0xff, 0xff, 0x0f, 0x00, 0x00, 0x00,
	0x4d, 0x4c, 0x49, 0x52, 0x20, 0x43, 0x6f, 0x6e, 0x76, 0x65, 0x72, 0x74,
	0x65, 0x64, 0x2e, 0x00, 0x01, 0x00, 0x00, 0x00, 0x14, 0x00, 0x00, 0x00,
	0x00, 0x00, 0x0e, 0x00, 0x18, 0x00, 0x14, 0x00, 0x10, 0x00, 0x0c, 0x00,
	0x08, 0x00, 0x04, 0x00, 0x0e, 0x00, 0x00, 0x00, 0x14, 0x00, 0x00, 0x00,
	0x1c, 0x00, 0x00, 0x00, 0xb4, 0x00, 0x00, 0x00, 0xb8, 0x00, 0x00, 0x00,
	0xbc, 0x00, 0x00, 0x00, 0x04, 0x00, 0x00, 0x00, 0x6d, 0x61, 0x69, 0x6e,
	0x00, 0x00, 0x00, 0x00, 0x02, 0x00, 0x00, 0x00, 0x5c, 0x00, 0x00, 0x00,
	0x14, 0x00, 0x00, 0x00, 0x00, 0x00, 0x0e, 0x00, 0x14, 0x00, 0x00, 0x00,
	0x10, 0x00, 0x0c, 0x00, 0x0b, 0x00, 0x04, 0x00, 0x0e, 0x00, 0x00, 0x00,
	0x14, 0x00, 0x00, 0x00, 0x00, 0x00, 0x00, 0x08, 0x10, 0x00, 0x00, 0x00,
	0x14, 0x00, 0x00, 0x00, 0x04, 0x00, 0x04, 0x00, 0x04, 0x00, 0x00, 0x00,
	0x01, 0x00, 0x00, 0x00, 0x06, 0x00, 0x00, 0x00, 0x03, 0x00, 0x00, 0x00,
	0x05, 0x00, 0x00, 0x00, 0x02, 0x00, 0x00, 0x00, 0x01, 0x00, 0x00, 0x00,
	0x00, 0x00, 0x0e, 0x00, 0x16, 0x00, 0x00, 0x00, 0x10, 0x00, 0x0c, 0x00,
	0x0b, 0x00, 0x04, 0x00, 0x0e, 0x00, 0x00, 0x00, 0x18, 0x00, 0x00, 0x00,
	0x00, 0x00, 0x00, 0x08, 0x18, 0x00, 0x00, 0x00, 0x1c, 0x00, 0x00, 0x00,
	0x00, 0x00, 0x06, 0x00, 0x08, 0x00, 0x07, 0x00, 0x06, 0x00, 0x00, 0x00,
	0x00, 0x00, 0x00, 0x01, 0x01, 0x00, 0x00, 0x00, 0x05, 0x00, 0x00, 0x00,
	0x03, 0x00, 0x00, 0x00, 0x00, 0x00, 0x00, 0x00, 0x04, 0x00, 0x00, 0x00,
	0x03, 0x00, 0x00, 0x00, 0x01, 0x00, 0x00, 0x00, 0x06, 0x00, 0x00, 0x00,
	0x01, 0x00, 0x00, 0x00, 0x00, 0x00, 0x00, 0x00, 0x07, 0x00, 0x00, 0x00,
	0x78, 0x04, 0x00, 0x00, 0xd8, 0x03, 0x00, 0x00, 0x34, 0x03, 0x00, 0x00,
	0x28, 0x02, 0x00, 0x00, 0x34, 0x01, 0x00, 0x00, 0x80, 0x00, 0x00, 0x00,
	0x04, 0x00, 0x00, 0x00, 0xba, 0xfb, 0xff, 0xff, 0x00, 0x00, 0x00, 0x01,
	0x18, 0x00, 0x00, 0x00, 0x20, 0x00, 0x00, 0x00, 0x3c, 0x00, 0x00, 0x00,
	0x07, 0x00, 0x00, 0x00, 0x00, 0x00, 0x00, 0x09, 0x50, 0x00, 0x00, 0x00,
	0x02, 0x00, 0x00, 0x00, 0xff, 0xff, 0xff, 0xff, 0x03, 0x00, 0x00, 0x00,
	0xa4, 0xfb, 0xff, 0xff, 0x08, 0x00, 0x00, 0x00, 0x10, 0x00, 0x00, 0x00,
	0x01, 0x00, 0x00, 0x00, 0x0f, 0x00, 0x00, 0x00, 0x00, 0x00, 0x00, 0x00,
	0x01, 0x00, 0x00, 0x00, 0xe4, 0x21, 0xc2, 0x3d, 0x1b, 0x00, 0x00, 0x00,
	0x53, 0x74, 0x61, 0x74, 0x65, 0x66, 0x75, 0x6c, 0x50, 0x61, 0x72, 0x74,
	0x69, 0x74, 0x69, 0x6f, 0x6e, 0x65, 0x64, 0x43, 0x61, 0x6c, 0x6c, 0x5f,
	0x31, 0x3a, 0x30, 0x00, 0x02, 0x00, 0x00, 0x00, 0x01, 0x00, 0x00, 0x00,
	0x03, 0x00, 0x00, 0x00, 0x32, 0xfc, 0xff, 0xff, 0x00, 0x00, 0x00, 0x01,
	0x18, 0x00, 0x00, 0x00, 0x20, 0x00, 0x00, 0x00, 0x3c, 0x00, 0x00, 0x00,
	0x06, 0x00, 0x00, 0x00, 0x00, 0x00, 0x00, 0x09, 0x88, 0x00, 0x00, 0x00,
	0x02, 0x00, 0x00, 0x00, 0xff, 0xff, 0xff, 0xff, 0x0c, 0x00, 0x00, 0x00,
	0x1c, 0xfc, 0xff, 0xff, 0x08, 0x00, 0x00, 0x00, 0x10, 0x00, 0x00, 0x00,
	0x01, 0x00, 0x00, 0x00, 0x80, 0xff, 0xff, 0xff, 0xff, 0xff, 0xff, 0xff,
	0x01, 0x00, 0x00, 0x00, 0xf9, 0x44, 0x76, 0x3c, 0x52, 0x00, 0x00, 0x00,
	0x73, 0x65, 0x71, 0x75, 0x65, 0x6e, 0x74, 0x69, 0x61, 0x6c, 0x5f, 0x31,
	0x2f, 0x64, 0x65, 0x6e, 0x73, 0x65, 0x5f, 0x31, 0x2f, 0x4d, 0x61, 0x74,
	0x4d, 0x75, 0x6c, 0x3b, 0x73, 0x65, 0x71, 0x75, 0x65, 0x6e, 0x74, 0x69,
	0x61, 0x6c, 0x5f, 0x31, 0x2f, 0x64, 0x65, 0x6e, 0x73, 0x65, 0x5f, 0x31,
	0x2f, 0x52, 0x65, 0x6c, 0x75, 0x3b, 0x73, 0x65, 0x71, 0x75, 0x65, 0x6e,
	0x74, 0x69, 0x61, 0x6c, 0x5f, 0x31, 0x2f, 0x64, 0x65, 0x6e, 0x73, 0x65,
	0x5f, 0x31, 0x2f, 0x42, 0x69, 0x61, 0x73, 0x41, 0x64, 0x64, 0x00, 0x00,
	0x02, 0x00, 0x00, 0x00, 0x01, 0x00, 0x00, 0x00, 0x0c, 0x00, 0x00, 0x00,
	0x7e, 0xfd, 0xff, 0xff, 0x00, 0x00, 0x00, 0x01, 0x14, 0x00, 0x00, 0x00,
	0xb8, 0x00, 0x00, 0x00, 0x05, 0x00, 0x00, 0x00, 0x00, 0x00, 0x00, 0x09,
	0xcc, 0x00, 0x00, 0x00, 0xbc, 0xfc, 0xff, 0xff, 0x08, 0x00, 0x00, 0x00,
	0x6c, 0x00, 0x00, 0x00, 0x0c, 0x00, 0x00, 0x00, 0x00, 0x00, 0x00, 0x00,
	0x00, 0x00, 0x00, 0x00, 0x00, 0x00, 0x00, 0x00, 0x00, 0x00, 0x00, 0x00,
	0x00, 0x00, 0x00, 0x00, 0x00, 0x00, 0x00, 0x00, 0x00, 0x00, 0x00, 0x00,
	0x00, 0x00, 0x00, 0x00, 0x00, 0x00, 0x00, 0x00, 0x00, 0x00, 0x00, 0x00,
	0x00, 0x00, 0x00, 0x00, 0x00, 0x00, 0x00, 0x00, 0x00, 0x00, 0x00, 0x00,
	0x00, 0x00, 0x00, 0x00, 0x00, 0x00, 0x00, 0x00, 0x00, 0x00, 0x00, 0x00,
	0x00, 0x00, 0x00, 0x00, 0x00, 0x00, 0x00, 0x00, 0x00, 0x00, 0x00, 0x00,
	0x00, 0x00, 0x00, 0x00, 0x00, 0x00, 0x00, 0x00, 0x00, 0x00, 0x00, 0x00,
	0x00, 0x00, 0x00, 0x00, 0x00, 0x00, 0x00, 0x00, 0x00, 0x00, 0x00, 0x00,
	0x0c, 0x00, 0x00, 0x00, 0x6d, 0x51, 0x69, 0x3c, 0xb6, 0xe2, 0x01, 0x3c,
	0x3d, 0xaf, 0x77, 0x3c, 0xba, 0xaa, 0x8a, 0x3b, 0x7f, 0x90, 0xa9, 0x3b,
	0xd4, 0xcd, 0x1f, 0x3c, 0x21, 0x51, 0x85, 0x3b, 0x1f, 0x23, 0x96, 0x3b,
	0xbb, 0x6a, 0x4c, 0x3c, 0xcb, 0xbe, 0x61, 0x3c, 0x00, 0xd2, 0x9f, 0x3c,
	0x8b, 0x05, 0x95, 0x3b, 0x1b, 0x00, 0x00, 0x00, 0x73, 0x65, 0x71, 0x75,
	0x65, 0x6e, 0x74, 0x69, 0x61, 0x6c, 0x5f, 0x31, 0x2f, 0x64, 0x65, 0x6e,
	0x73, 0x65, 0x5f, 0x31, 0x2f, 0x4d, 0x61, 0x74, 0x4d, 0x75, 0x6c, 0x00,
	0x02, 0x00, 0x00, 0x00, 0x0c, 0x00, 0x00, 0x00, 0x08, 0x00, 0x00, 0x00,
	0x6e, 0xfe, 0xff, 0xff, 0x00, 0x00, 0x00, 0x01, 0x14, 0x00, 0x00, 0x00,
	0xb8, 0x00, 0x00, 0x00, 0x04, 0x00, 0x00, 0x00, 0x00, 0x00, 0x00, 0x02,
	0xe8, 0x00, 0x00, 0x00, 0xac, 0xfd, 0xff, 0xff, 0x08, 0x00, 0x00, 0x00,
	0x6c, 0x00, 0x00, 0x00, 0x0c, 0x00, 0x00, 0x00, 0x00, 0x00, 0x00, 0x00,
	0x00, 0x00, 0x00, 0x00, 0x00, 0x00, 0x00, 0x00, 0x00, 0x00, 0x00, 0x00,
	0x00, 0x00, 0x00, 0x00, 0x00, 0x00, 0x00, 0x00, 0x00, 0x00, 0x00, 0x00,
	0x00, 0x00, 0x00, 0x00, 0x00, 0x00, 0x00, 0x00, 0x00, 0x00, 0x00, 0x00,
	0x00, 0x00, 0x00, 0x00, 0x00, 0x00, 0x00, 0x00, 0x00, 0x00, 0x00, 0x00,
	0x00, 0x00, 0x00, 0x00, 0x00, 0x00, 0x00, 0x00, 0x00, 0x00, 0x00, 0x00,
	0x00, 0x00, 0x00, 0x00, 0x00, 0x00, 0x00, 0x00, 0x00, 0x00, 0x00, 0x00,
	0x00, 0x00, 0x00, 0x00, 0x00, 0x00, 0x00, 0x00, 0x00, 0x00, 0x00, 0x00,
	0x00, 0x00, 0x00, 0x00, 0x00, 0x00, 0x00, 0x00, 0x00, 0x00, 0x00, 0x00,
	0x0c, 0x00, 0x00, 0x00, 0x7d, 0x9b, 0x73, 0x38, 0x11, 0x9d, 0x07, 0x38,
	0xbf, 0x4d, 0x81, 0x38, 0x38, 0xc8, 0x90, 0x37, 0xcf, 0x0a, 0xb1, 0x37,
	0xf3, 0xd9, 0x26, 0x38, 0x39, 0x32, 0x8b, 0x37, 0x1b, 0xc2, 0x9c, 0x37,
	0x83, 0x6e, 0x55, 0x38, 0x5d, 0xb3, 0x6b, 0x38, 0x4e, 0xde, 0xa6, 0x38,
	0xef, 0x97, 0x9b, 0x37, 0x36, 0x00, 0x00, 0x00, 0x73, 0x65, 0x71, 0x75,
	0x65, 0x6e, 0x74, 0x69, 0x61, 0x6c, 0x5f, 0x31, 0x2f, 0x64, 0x65, 0x6e,
	0x73, 0x65, 0x5f, 0x31, 0x2f, 0x52, 0x65, 0x6c, 0x75, 0x3b, 0x73, 0x65,
	0x71, 0x75, 0x65, 0x6e, 0x74, 0x69, 0x61, 0x6c, 0x5f, 0x31, 0x2f, 0x64,
	0x65, 0x6e, 0x73, 0x65, 0x5f, 0x31, 0x2f, 0x42, 0x69, 0x61, 0x73, 0x41,
	0x64, 0x64, 0x00, 0x00, 0x01, 0x00, 0x00, 0x00, 0x0c, 0x00, 0x00, 0x00,
	0x76, 0xff, 0xff, 0xff, 0x00, 0x00, 0x00, 0x01, 0x14, 0x00, 0x00, 0x00,
	0x4c, 0x00, 0x00, 0x00, 0x03, 0x00, 0x00, 0x00, 0x00, 0x00, 0x00, 0x09,
	0x64, 0x00, 0x00, 0x00, 0xb4, 0xfe, 0xff, 0xff, 0x08, 0x00, 0x00, 0x00,
	0x24, 0x00, 0x00, 0x00, 0x03, 0x00, 0x00, 0x00, 0x00, 0x00, 0x00, 0x00,
	0x00, 0x00, 0x00, 0x00, 0x00, 0x00, 0x00, 0x00, 0x00, 0x00, 0x00, 0x00,
	0x00, 0x00, 0x00, 0x00, 0x00, 0x00, 0x00, 0x00, 0x00, 0x00, 0x00, 0x00,
	0x03, 0x00, 0x00, 0x00, 0x36, 0xaf, 0xb8, 0x3c, 0xd0, 0x27, 0x55, 0x3c,
	0x2b, 0x79, 0x8f, 0x3c, 0x1d, 0x00, 0x00, 0x00, 0x73, 0x65, 0x71, 0x75,
	0x65, 0x6e, 0x74, 0x69, 0x61, 0x6c, 0x5f, 0x31, 0x2f, 0x64, 0x65, 0x6e,
	0x73, 0x65, 0x5f, 0x31, 0x5f, 0x32, 0x2f, 0x4d, 0x61, 0x74, 0x4d, 0x75,
	0x6c, 0x00, 0x00, 0x00, 0x02, 0x00, 0x00, 0x00, 0x03, 0x00, 0x00, 0x00,
	0x0c, 0x00, 0x00, 0x00, 0x00, 0x00, 0x16, 0x00, 0x1c, 0x00, 0x18, 0x00,
	0x17, 0x00, 0x10, 0x00, 0x0c, 0x00, 0x08, 0x00, 0x00, 0x00, 0x00, 0x00,
	0x00, 0x00, 0x07, 0x00, 0x16, 0x00, 0x00, 0x00, 0x00, 0x00, 0x00, 0x01,
	0x14, 0x00, 0x00, 0x00, 0x4c, 0x00, 0x00, 0x00, 0x02, 0x00, 0x00, 0x00,
	0x00, 0x00, 0x00, 0x02, 0x64, 0x00, 0x00, 0x00, 0x54, 0xff, 0xff, 0xff,
	0x08, 0x00, 0x00, 0x00, 0x24, 0x00, 0x00, 0x00, 0x03, 0x00, 0x00, 0x00,
	0x00, 0x00, 0x00, 0x00, 0x00, 0x00, 0x00, 0x00, 0x00, 0x00, 0x00, 0x00,
	0x00, 0x00, 0x00, 0x00, 0x00, 0x00, 0x00, 0x00, 0x00, 0x00, 0x00, 0x00,
	0x00, 0x00, 0x00, 0x00, 0x03, 0x00, 0x00, 0x00, 0x20, 0xaa, 0xb1, 0x39,
	0xb0, 0x0d, 0x4d, 0x39, 0x17, 0x05, 0x8a, 0x39, 0x1e, 0x00, 0x00, 0x00,
	0x73, 0x65, 0x71, 0x75, 0x65, 0x6e, 0x74, 0x69, 0x61, 0x6c, 0x5f, 0x31,
	0x2f, 0x64, 0x65, 0x6e, 0x73, 0x65, 0x5f, 0x31, 0x5f, 0x32, 0x2f, 0x42,
	0x69, 0x61, 0x73, 0x41, 0x64, 0x64, 0x00, 0x00, 0x01, 0x00, 0x00, 0x00,
	0x03, 0x00, 0x00, 0x00, 0x00, 0x00, 0x16, 0x00, 0x20, 0x00, 0x1c, 0x00,
	0x1b, 0x00, 0x14, 0x00, 0x10, 0x00, 0x0c, 0x00, 0x00, 0x00, 0x00, 0x00,
	0x08, 0x00, 0x07, 0x00, 0x16, 0x00, 0x00, 0x00, 0x00, 0x00, 0x00, 0x01,
	0x18, 0x00, 0x00, 0x00, 0x2c, 0x00, 0x00, 0x00, 0x4c, 0x00, 0x00, 0x00,
	0x01, 0x00, 0x00, 0x00, 0x00, 0x00, 0x00, 0x09, 0x64, 0x00, 0x00, 0x00,
	0x02, 0x00, 0x00, 0x00, 0xff, 0xff, 0xff, 0xff, 0x08, 0x00, 0x00, 0x00,
	0x0c, 0x00, 0x0c, 0x00, 0x00, 0x00, 0x00, 0x00, 0x08, 0x00, 0x04, 0x00,
	0x0c, 0x00, 0x00, 0x00, 0x08, 0x00, 0x00, 0x00, 0x14, 0x00, 0x00, 0x00,
	0x01, 0x00, 0x00, 0x00, 0x8a, 0xff, 0xff, 0xff, 0xff, 0xff, 0xff, 0xff,
	0x00, 0x00, 0x00, 0x00, 0x01, 0x00, 0x00, 0x00, 0x11, 0xa5, 0x85, 0x3b,
	0x1e, 0x00, 0x00, 0x00, 0x73, 0x65, 0x72, 0x76, 0x69, 0x6e, 0x67, 0x5f,
	0x64, 0x65, 0x66, 0x61, 0x75, 0x6c, 0x74, 0x5f, 0x6b, 0x65, 0x72, 0x61,
	0x73, 0x5f, 0x74, 0x65, 0x6e, 0x73, 0x6f, 0x72, 0x3a, 0x30, 0x00, 0x00,
	0x02, 0x00, 0x00, 0x00, 0x01, 0x00, 0x00, 0x00, 0x08, 0x00, 0x00, 0x00,
	0x01, 0x00, 0x00, 0x00, 0x10, 0x00, 0x00, 0x00, 0x0c, 0x00, 0x10, 0x00,
	0x0f, 0x00, 0x00, 0x00, 0x08, 0x00, 0x04, 0x00, 0x0c, 0x00, 0x00, 0x00,
	0x09, 0x00, 0x00, 0x00, 0x04, 0x00, 0x00, 0x00, 0x00, 0x00, 0x00, 0x09
};

const int g_model_len = sizeof(g_model);
```

## src/model.hpp
```c
/*
 * Copyright (c) 2026 Mahad Faisal
 *
 * SPDX-License-Identifier: Apache-2.0
 */

#pragma once

extern const unsigned char g_model[];
extern const int g_model_len;
```
