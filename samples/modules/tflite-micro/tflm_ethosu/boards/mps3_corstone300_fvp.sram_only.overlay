/*
 * SPDX-FileCopyrightText: <text>Copyright 2026 Arm Limited and/or its
 * affiliates <open-source-office@arm.com></text>
 * SPDX-License-Identifier: Apache-2.0
 */

/ {
	chosen {
		/* Writable on-chip ISRAM for TFLM buffers */
		zephyr,tflm-storage = &isram;
	};
};
