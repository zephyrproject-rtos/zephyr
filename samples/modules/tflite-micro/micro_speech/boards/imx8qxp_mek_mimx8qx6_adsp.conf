## samples/modules/tflite-micro/micro_speech/boards/imx8qxp_mek_mimx8qx6_adsp.conf
```kconfig
CONFIG_LOG_PRINTK=n
CONFIG_IPM_IMX_MAX_DATA_SIZE_16=n
CONFIG_IPM_IMX_MAX_DATA_SIZE_4=y
CONFIG_OPENAMP_WITH_DCACHE=y
CONFIG_SHELL=n

#vendor-specific resource table
CONFIG_OPENAMP_VENDOR_RSC_TABLE=y
CONFIG_OPENAMP_VENDOR_RSC_TABLE_FILE="nxp_resource_table.c"
```

## samples/modules/tflite-micro/micro_speech/sample.yaml
```yaml
sample:
  description: Micro Speech OpenAMP Sample
  name: micro speech openamp
common:
  tags:
    - tensorflow
    - openamp
    - ipc
    - audio
  build_only: true
  modules:
    - tflite-micro
  harness: console
  harness_config:
    type: multi_line
    ordered: false
    regex:
      - "Detected: (yes|no|silence|unknown)"
tests:
  sample.tensorflow.micro_speech_openamp:
    platform_allow:
      - imx8mp_evk/mimx8ml8/adsp
    integration_platforms:
      - imx8mp_evk/mimx8ml8/adsp
```

## samples/modules/tflite-micro/streaming_anomaly_detector/sample.yaml
```yaml
sample:
  description: TensorFlow Lite Micro streaming anomaly detector sample
  name: Streaming anomaly detector TensorFlow Lite Micro

common:
  tags:
    - tensorflow
  modules:
    - tflite-micro
  harness: console
  harness_config:
    type: multi_line
    ordered: false
    regex:
      - "stream_window: .*"
      - "raw_prediction: .*"
      - "stable_prediction: .*"
      - "result: PASS"

tests:
  sample.tensorflow.streaming_anomaly_detector:
    platform_allow:
      - qemu_x86
      - qemu_x86_64
    integration_platforms:
      - qemu_x86
    filter: CONFIG_FULL_LIBC_SUPPORTED

  sample.tensorflow.streaming_anomaly_detector.cmsis_nn:
    platform_allow:
      - ek_ra8m1
    extra_configs:
      - CONFIG_TENSORFLOW_LITE_MICRO_CMSIS_NN_KERNELS=y
```

## samples/modules/tflite-micro/tflm_ethosu/Kconfig
```kconfig
# SPDX-FileCopyrightText: <text>Copyright 2022, 2025-2026 Arm Limited and/or its
# affiliates <open-source-office@arm.com></text>
# SPDX-License-Identifier: Apache-2.0

config TAINT_BLOBS_TFLM
	bool
	default y
	select TAINT_BLOBS

config TAINT_BLOBS_TFLM_ETHOSU
	bool "Choose Vela-compiled model targeting Ethos-U"
	default y
	depends on ETHOS_U_ARM || ETHOS_U_NUMAKER || ETHOS_U_RENESAS || ETHOS_U_INFINEON
	select TAINT_BLOBS_TFLM

config SAMPLE_TFLM_ETHOSU_PMU
	bool "Enable PMU counters in sample"
	depends on ETHOS_U
	help
	  Enable PMU counters for this sample. When enabled,
	  the sample collects cycle and selected event counters per inference.

choice SAMPLE_TFLM_ETHOSU_MEM_MODE
	prompt "Vela memory mode (sample override)"
	default SAMPLE_TFLM_ETHOSU_MEM_MODE_HAL_DEFAULT
	depends on ETHOS_U
	help
	  Configure memory mode used by Vela.

	  - On Arm Ethos-U55 NPU and Arm Ethos-U65 NPU:
	    REGIONCFG values 0/1 route to AXI0 (governed by AXI_LIMIT0/1, typically on-chip SRAM),
	    REGIONCFG values 2/3 route to AXI1 (governed by AXI_LIMIT2/3, typically external memory).
	    (U55: AXI1 is read-only; U65: both ports are read/write.)
	    This mapping is architectural (fixed).

	  - On Arm Ethos-U85 NPU:
	    REGIONCFG values 0/1 select MEM_ATTR[0/1] (typically the SRAM AXI port),
	    REGIONCFG values 2/3 select MEM_ATTR[2/3] (typically the external AXI port).
	    These defaults come from the HAL but can be changed by redefining
	    NPU_MEM_ATTR_[0-3] if your system requires different attributes.

	  The chosen mode must match the mode used when compiling the model with Vela.

config SAMPLE_TFLM_ETHOSU_MEM_MODE_HAL_DEFAULT
	bool "HAL default"
	help
	  Do not override the HAL defaults for region mapping.
	  The HAL determines NPU_REGIONCFG_n and NPU_QCONFIG.

config SAMPLE_TFLM_ETHOSU_MEM_MODE_SHARED_SRAM
	bool "Shared_Sram (weights=3, scratch=0, fast_scratch=0, cmd_stream=3)"
	help
	  Match Vela's Shared_Sram mode:
	  - U55/U65: weights & command stream -> AXI1 / AXI_LIMIT3 (typically external),
	             scratch & fast_scratch -> AXI0 / AXI_LIMIT0 (typically on-chip)
	  - U85:     weights & command stream -> MEM_ATTR[3] (typically external),
	             scratch & fast_scratch -> MEM_ATTR[0] (typically on-chip)

config SAMPLE_TFLM_ETHOSU_MEM_MODE_DEDICATED_SRAM
	bool "Dedicated_Sram (weights=3, scratch=3, fast_scratch=0, cmd_stream=3)"
	depends on !(ETHOS_U55_64 || ETHOS_U55_128 || ETHOS_U55_256)
	help
	  Match Vela's Dedicated_Sram mode:
	  - U55/U65: weights, scratch & command stream -> AXI1 / AXI_LIMIT3 (typically external),
	             fast_scratch -> AXI0 / AXI_LIMIT0 (typically on-chip)
	  - U85:     weights, scratch & command stream -> MEM_ATTR[3] (typically external),
	             fast_scratch -> MEM_ATTR[0] (typically on-chip)
	  Not supported on Arm Ethos-U55 NPU.

config SAMPLE_TFLM_ETHOSU_MEM_MODE_SRAM_ONLY
	bool "Sram_Only (weights=1, scratch=0, fast_scratch=0, cmd_stream=1)"
	help
	  Match Vela's SRAM_Only mode (everything on the SRAM side):
	  - U55/U65: weights & command stream -> AXI0 / AXI_LIMIT1,
	             scratch & fast_scratch -> AXI0 / AXI_LIMIT0
	  - U85:     weights & command stream -> MEM_ATTR[1] (SRAM port),
	             scratch & fast_scratch -> MEM_ATTR[0] (SRAM port)
endchoice

source "Kconfig.zephyr"
```

## samples/modules/tflite-micro/tflm_ethosu/boards/kit_pse84_eval_pse846gps2dbzc4a_m55.conf
```kconfig
# Board-specific configuration for kit_pse84_eval
# Increase main thread stack to handle C++ STL and TFLite/Ethos-U init overhead
CONFIG_MAIN_STACK_SIZE=4096
```

## samples/modules/tflite-micro/tflm_ethosu/sample.yaml
```yaml
sample:
  description: Demonstration of the Arm Ethos-U NPU
  name: Arm Ethos-U NPU sample
tests:
  sample.drivers.tflm_ethosu:
    tags:
      - NPU
    modules:
      - tflite-micro
    filter: dt_compat_enabled("arm,ethos-u")
    build_only: true
    platform_allow:
      - mps3/corstone300/fvp
      - kit_pse84_ai/pse846gps2dbzc4a/m55
    integration_platforms:
      - mps3/corstone300/fvp
      - kit_pse84_ai/pse846gps2dbzc4a/m55
  sample.drivers.tflm_ethosu_sram_only:
    tags:
      - NPU
    modules:
      - tflite-micro
    filter: dt_compat_enabled("arm,ethos-u")
    build_only: true
    platform_allow:
      - mps3/corstone300/fvp
    integration_platforms:
      - mps3/corstone300/fvp
    extra_configs:
      - CONFIG_SAMPLE_TFLM_ETHOSU_MEM_MODE_SRAM_ONLY=y
    extra_args:
      - DTC_OVERLAY_FILE=boards/mps3_corstone300_fvp.sram_only.overlay
  sample.drivers.tflm_ethosu_dedicated_sram:
    tags:
      - NPU
    modules:
      - tflite-micro
    filter: dt_compat_enabled("arm,ethos-u")
    build_only: true
    platform_allow:
      - mps3/corstone300/fvp
    integration_platforms:
      - mps3/corstone300/fvp
    extra_configs:
      - CONFIG_SAMPLE_TFLM_ETHOSU_MEM_MODE_DEDICATED_SRAM=y
    extra_args:
      - CONFIG_ETHOS_U65_256=y
      - DTC_OVERLAY_FILE=boards/mps3_corstone300_fvp.dedicated_sram.overlay
  sample.drivers.tflm_ethosu_mps4_u85_pmu:
    tags:
      - NPU
    modules:
      - tflite-micro
    filter: dt_compat_enabled("arm,ethos-u")
    build_only: true
    platform_allow:
      - mps4/corstone320/fvp
    integration_platforms:
      - mps4/corstone320/fvp
    extra_configs:
      - CONFIG_SAMPLE_TFLM_ETHOSU_MEM_MODE_SRAM_ONLY=y
    extra_args:
      - CONFIG_ETHOS_U85_2048=y
      - CONFIG_SAMPLE_TFLM_ETHOSU_PMU=y
      - DTC_OVERLAY_FILE="boards/mps4_corstone320_fvp.ta.overlay;boards/mps4_corstone320_fvp.sram_only.overlay"
```

## samples/modules/tflite-micro/tflm_neutron/Kconfig
```kconfig
# SPDX-License-Identifier: Apache-2.0
# Copyright (c) 2024 NXP
#
# NXP eIQ ML middleware configuration

config NXP_NEUTRON
	bool "NXP NEUTRON NPU Driver"
	depends on SOC_SERIES_IMXRT7XX || SOC_FAMILY_MCXN
	help
	  Enable the NXP NEUTRON Neural Processing Unit driver.

config TENSORFLOW_LITE_MICRO_NXP_NEUTRON
	bool "TensorFlow Lite Micro NEUTRON integration"
	depends on TENSORFLOW_LITE_MICRO
	select NXP_NEUTRON
	default n
	help
	  Enable TensorFlow Lite Micro integration with NEUTRON NPU.
	  This allows TFLM models to use the NEUTRON accelerator
	  for inference operations.

source "Kconfig.zephyr"
```

## samples/modules/tflite-micro/tflm_neutron/sample.yaml
```yaml
sample:
  description: Hello world TFLM inference with NXP Neutron NPU.
  name: NXP Neutron NPU sample
tests:
  sample.modules.tflite_micro.neutron:
    tags:
      - NPU
    modules:
      - tflite-micro
    build_only: true
    depends_on: []
    integration_platforms:
      - mimxrt700_evk/mimxrt798s/cm33_cpu0
      - mcx_n9xx_evk/mcxn947/cpu0
      - frdm_mcxn947/mcxn947/cpu0
```

## samples/modules/tflite-micro/time_series_classifier/sample.yaml
```yaml
sample:
  description: Time-series TensorFlow Lite Micro classifier sample
  name: time series tensorflow classifier
common:
  tags: tensorflow
  modules:
    - tflite-micro
  harness: console
  harness_config:
    type: multi_line
    ordered: false
    regex:
      - "prediction:.*, score:.*"
      - "result: PASS"
tests:
  sample.tensorflow.time_series_classifier:
    platform_allow:
      - qemu_x86
      - qemu_x86_64
    integration_platforms:
      - qemu_x86
    tags: tensorflow
    filter: CONFIG_FULL_LIBC_SUPPORTED

  sample.tensorflow.time_series_classifier.cmsis_nn:
    tags: tensorflow
    platform_allow:
      - mps3/corstone300/fvp
      - ek_ra8m1
    integration_platforms:
      - mps3/corstone300/fvp
      - ek_ra8m1
    extra_configs:
      - CONFIG_TENSORFLOW_LITE_MICRO_CMSIS_NN_KERNELS=y
```

## samples/modules/thrift/hello/client/sample.yaml
```yaml
sample:
  description: Hello Thrift client sample
  name: hello thrift client
common:
  tags:
    - thrift
    - cpp
    - sample
  build_only: true
  modules:
    - thrift
  platform_allow:
    - mps2/an385
    - qemu_x86_64
  integration_platforms:
    - qemu_x86_64
  filter: CONFIG_FULL_LIBCPP_SUPPORTED
tests:
  sample.thrift.hello.client.binaryProtocol: {}
  sample.thrift.hello.client.compactProtocol:
    extra_configs:
      - CONFIG_THRIFT_COMPACT_PROTOCOL=y
  sample.thrift.hello.client.tlsTransport:
    extra_args: EXTRA_CONF_FILE="../overlay-tls.conf"
```

## samples/modules/thrift/hello/server/Kconfig
```kconfig
# SPDX-License-Identifier: Apache-2.0
# Copyright (c) 2022 Meta

source "Kconfig.zephyr"

config THRIFT_COMPACT_PROTOCOL
	bool "Use TCompactProtocol in samples"
	depends on THRIFT
	help
	  Enable this option to use TCompactProtocol in samples
```

## samples/modules/thrift/hello/server/sample.yaml
```yaml
sample:
  description: Hello Thrift server sample
  name: hello thrift server
common:
  tags:
    - thrift
    - cpp
    - sample
  build_only: true
  modules:
    - thrift
  platform_allow:
    - mps2/an385
    - qemu_x86_64
  integration_platforms:
    - qemu_x86_64
  filter: CONFIG_FULL_LIBCPP_SUPPORTED
tests:
  sample.thrift.hello.server.binaryProtocol: {}
  sample.thrift.hello.server.compactProtocol:
    extra_configs:
      - CONFIG_THRIFT_COMPACT_PROTOCOL=y
  sample.thrift.hello.server.tlsTransport:
    extra_args: OVERLAY_CONFIG="../overlay-tls.conf"
```

## samples/modules/u8g2/u8g2_logo/sample.yaml
```yaml
sample:
  description: U8G2 Logo
  name: u8g2 logo
tests:
  sample.modules.u8g2.u8x2_logo.sdl:
    platform_allow: native_posix native_posix_64
    build_only: true
    tags: display
```

## samples/mpu/mem_domain_apis_test/sample.yaml
```yaml
sample:
  name: Memory Domain APIs Test
tests:
  kernel.memory_protection.memory_domains:
    filter: CONFIG_ARCH_HAS_USERSPACE
    tags: samples
    harness: console
    timeout: 120
    harness_config:
      type: multi_line
      ordered: false
      regex:
        - "initialize memory domains"
        - "add app thread \\d \\(0x[0-9a-f]+\\) into app\\d_domain."
        - "app thread \\d \\(0x[0-9a-f]+\\) starts."
        - "main thread \\(0x[0-9a-f]+\\) is back."
        - "remove app0_parts0 from app0_domain."
        - "main thread \\(0x[0-9a-f]+\\) yields."
        - "destroy app0_domain."
```

## samples/mpu/mpu_stack_guard_test/sample.yaml
```yaml
sample:
  name: MPU Stack Guard
tests:
  test:
    tags: apps
    harness: console
    # We do not handle segfaults here
    arch_exclude: posix riscv32 nios2 xtensa
    platform_exclude: qemu_cortex_m3
    harness_config:
      type: multi_line
      ordered: false
      regex:
        - "Fatal fault in .*thread"
        - "STACK_ALIGN.*"
        - "Canary Initial Value = 0x[0-9a-f]+ threads 0x[0-9a-f]+"
  test_stack_guard:
    arch_whitelist: arm
    extra_args: CONF_FILE=prj_stack_guard.conf
    filter: CONFIG_MPU_STACK_GUARD
    tags: apps
    harness: console
    harness_config:
      type: multi_line
      ordered: false
      regex:
        - "Fatal fault in thread 0x[0-9a-f]+! Aborting."
        - "STACK_ALIGN.*"
        - "Canary Initial Value = 0x[0-9a-f]+ threads 0x[0-9a-f]+"
```

## samples/mpu/mpu_test/sample.yaml
```yaml
sample:
  name: MPU Test
tests:
  sample.mpu.mpu_test:
    arch_whitelist: arm
    filter: CONFIG_CPU_HAS_MPU
    tags: mpu
    harness: keyboard
```

## samples/multi_api_shell/sensor_shell/sample.yaml
```yaml
sample:
  description: Simple dummy shell
  name: Multi API sensor shell

tests:
  sample.multi_api_shell.sensor_shell:
    platform_allow: b_u585i_iot02a
```

## samples/net/QoS/sample.yaml
```yaml
sample:
  description: simple demo of quality of service
  name: quality_of_service
common:
  harness: net
tests:
  sample.net.Qos:
    tags:
      - net
      - socket
```

## samples/net/capture/Kconfig
```kconfig
# Private config options for capture sample app

# Copyright (c) 2024 Intel Corporation
# SPDX-License-Identifier: Apache-2.0

mainmenu "Networking capture sample application"

config NET_SAMPLE_TUNNEL_PEER_ADDR
	string "Remote IP address of the tunnel interface"
	depends on NET_L2_IPIP
	help
	  Use overlay-tunnel.conf to setup the tunnel support.

config NET_SAMPLE_TUNNEL_MY_ADDR
	string "My address for tunnel interface"
	depends on NET_L2_IPIP
	help
	  The value depends on your network setup.

source "Kconfig.zephyr"
```

## samples/net/capture/sample.yaml
```yaml
common:
  harness: net
  depends_on: netif
sample:
  description: Network packet capture
  name: Network packet capture sample application
tests:
  sample.net.capture:
    tags: net capture
```

## samples/net/cellular_modem/Kconfig
```kconfig
# Copyright (c) 2025 Olivier Lalonde
# SPDX-License-Identifier: Apache-2.0

# Configuration options for cellular modem sample

mainmenu "Cellular modem sample application"

config SAMPLE_CELLULAR_MODEM_ENDPOINT_HOSTNAME
	string "Endpoint hostname"
	default "test-endpoint.com"

config SAMPLE_CELLULAR_MODEM_AUTO_APN
	bool "Autodetect APN from SIM IMSI"
	help
	  If enabled, the sample derives the APN from the SIM’s MCC + MNC.

menu "APN profiles for the application"
	depends on SAMPLE_CELLULAR_MODEM_AUTO_APN

config SAMPLE_CELLULAR_APN_0
	string "APN for profile #0"
	default ""
	help
	  Leave empty to disable the profile.

config SAMPLE_CELLULAR_IMSI_LIST_0
	string "IMSI prefix list for profile #0"
	default ""
	help
	  Space separated list of 5- or 6-digit MCC+MNC codes
	  that should use the APN above.
	  Example: 22801 22802 90143

config SAMPLE_CELLULAR_APN_1
	string "APN for profile #1"
	default ""

config SAMPLE_CELLULAR_IMSI_LIST_1
	string "IMSI prefix list for profile #1"
	default ""

config SAMPLE_CELLULAR_APN_2
	string "APN for profile #2"
	default ""

config SAMPLE_CELLULAR_IMSI_LIST_2
	string "IMSI prefix list for profile #2"
	default ""

config SAMPLE_CELLULAR_APN_3
	string "APN for profile #3"
	default ""

config SAMPLE_CELLULAR_IMSI_LIST_3
	string "IMSI prefix list for profile #3"
	default ""

endmenu

source "Kconfig.zephyr"
```

## samples/net/cellular_modem/boards/b_u585i_iot02a.conf
```kconfig
# Copyright (c) 2023, Bjarki Arge Andreasen
# SPDX-License-Identifier: Apache-2.0

CONFIG_UART_ASYNC_API=y
CONFIG_MODEM_CELLULAR_APN="internet"
```

## samples/net/cellular_modem/boards/nrf52840dk_nrf52840.conf
```kconfig
# Otherwise we run into DLCI buffer overruns (maybe due to lack of UART hardware flow control?)
CONFIG_MODEM_CMUX_WORK_BUFFER_SIZE=1507
CONFIG_NET_IPV6=n
```
