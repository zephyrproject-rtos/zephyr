## Kconfig
```
# SPDX-License-Identifier: Apache-2.0
# Copyright (c) 2022 Meta

source "Kconfig.zephyr"

config THRIFT_COMPACT_PROTOCOL
	bool "Use TCompactProtocol in samples"
	depends on THRIFT
	help
	  Enable this option to use TCompactProtocol in samples
```

## sample.yaml
```
sample:
  description: Hello Thrift server sample
  name: hello thrift server
common:
  tags:
    - thrift
    - cpp
    - sample
  build_only: true
  modules:
    - thrift
  platform_allow:
    - mps2/an385
    - qemu_x86_64
  integration_platforms:
    - qemu_x86_64
  filter: CONFIG_FULL_LIBCPP_SUPPORTED
tests:
  sample.thrift.hello.server.binaryProtocol: {}
  sample.thrift.hello.server.compactProtocol:
    extra_configs:
      - CONFIG_THRIFT_COMPACT_PROTOCOL=y
  sample.thrift.hello.server.tlsTransport:
    extra_args: EXTRA_CONF_FILE="../overlay-tls.conf"
```

## prj.conf
```kconfig
# Need a full libc++
CONFIG_REQUIRES_FULL_LIBCPP=y

# CONFIG_THRIFT Dependencies
CONFIG_CPP=y
CONFIG_STD_CPP17=y
CONFIG_CPP_EXCEPTIONS=y
CONFIG_POSIX_API=y
CONFIG_XSI_STREAMS=y
CONFIG_NET_SOCKETPAIR=y
CONFIG_HEAP_MEM_POOL_SIZE=16384
CONFIG_EVENTFD=y

CONFIG_THRIFT=y

# Generic networking options
CONFIG_NETWORKING=y
CONFIG_NET_UDP=y
CONFIG_NET_TCP=y
CONFIG_NET_IPV6=n
CONFIG_NET_IPV4=y
CONFIG_NET_SOCKETS=y
CONFIG_NET_CONNECTION_MANAGER=y

# Kernel options
CONFIG_ENTROPY_GENERATOR=y
CONFIG_TEST_RANDOM_GENERATOR=y
CONFIG_INIT_STACKS=y

# Logging
CONFIG_NET_LOG=y
CONFIG_LOG=y
CONFIG_NET_STATISTICS=y
CONFIG_PRINTK=y

# Network buffers
CONFIG_NET_PKT_RX_COUNT=16
CONFIG_NET_PKT_TX_COUNT=16
CONFIG_NET_BUF_RX_COUNT=64
CONFIG_NET_BUF_TX_COUNT=64
CONFIG_NET_CONTEXT_NET_PKT_POOL=y

# IP address options
CONFIG_NET_MAX_CONTEXTS=10

# Network application options and configuration
CONFIG_NET_CONFIG_SETTINGS=y
CONFIG_NET_CONFIG_NEED_IPV6=n
CONFIG_NET_CONFIG_NEED_IPV4=y
CONFIG_NET_CONFIG_MY_IPV4_ADDR="192.0.2.1"
CONFIG_NET_CONFIG_PEER_IPV4_ADDR="192.0.2.2"

# Some platforms require relatively large stack sizes.
# This can be tuned per-board.
CONFIG_MAIN_STACK_SIZE=8192
CONFIG_SYSTEM_WORKQUEUE_STACK_SIZE=8192
CONFIG_NET_TCP_WORKQ_STACK_SIZE=4096
CONFIG_NET_MGMT_EVENT_STACK_SIZE=4096
CONFIG_IDLE_STACK_SIZE=4096
CONFIG_NET_RX_STACK_SIZE=8192
```

## src/main.cpp
```c
/*
 * Copyright 2022 Young Mei
 *
 * SPDX-License-Identifier: Apache-2.0
 */

#ifdef __ZEPHYR__
#include <zephyr/kernel.h>
#endif

#include <cstdio>
#include <cstdlib>

#include <thrift/protocol/TBinaryProtocol.h>
#include <thrift/protocol/TCompactProtocol.h>
#include <thrift/server/TSimpleServer.h>
#include <thrift/transport/TBufferTransports.h>
#include <thrift/transport/TSSLServerSocket.h>
#include <thrift/transport/TSSLSocket.h>
#include <thrift/transport/TServerSocket.h>

#include "Hello.h"
#include "HelloHandler.h"

using namespace ::apache::thrift;
using namespace ::apache::thrift::protocol;
using namespace ::apache::thrift::transport;
using namespace ::apache::thrift::server;

#ifndef IS_ENABLED
#define IS_ENABLED(flag) flag
#endif

#ifndef CONFIG_THRIFT_COMPACT_PROTOCOL
#define CONFIG_THRIFT_COMPACT_PROTOCOL 0
#endif

#ifndef CONFIG_THRIFT_SSL_SOCKET
#define CONFIG_THRIFT_SSL_SOCKET 0
#endif

#ifdef __ZEPHYR__
int main(void)
#else
int main(int argc, char **argv)
#endif
{
	std::string my_addr;

#ifdef __ZEPHYR__
	my_addr = CONFIG_NET_CONFIG_MY_IPV4_ADDR;
#else
	if (IS_ENABLED(CONFIG_THRIFT_SSL_SOCKET)) {
		if (argc != 5) {
			printf("usage: %s <ip> <native-cert.pem> <native-key.pem> "
			       "<qemu-cert.pem>\n",
			       argv[0]);
			return EXIT_FAILURE;
		}
	} else {
		if (argc != 2) {
			printf("usage: %s <ip>\n", argv[0]);
			return EXIT_FAILURE;
		}
	}

	my_addr = std::string(argv[1]);
#endif

	const int port = 4242;
	std::shared_ptr<TServerTransport> serverTransport;
	std::shared_ptr<TTransportFactory> transportFactory;
	std::shared_ptr<TProtocolFactory> protocolFactory;
	std::shared_ptr<HelloHandler> handler(new HelloHandler());
	std::shared_ptr<TProcessor> processor(new HelloProcessor(handler));

	if (IS_ENABLED(CONFIG_THRIFT_SSL_SOCKET)) {
		std::shared_ptr<TSSLSocketFactory> socketFactory(new TSSLSocketFactory());
		socketFactory->server(true);
#ifdef __ZEPHYR__
		static const char qemu_cert_pem[] = {
#include "qemu_cert.pem.inc"
			'\0'
		};

		static const char qemu_key_pem[] = {
#include "qemu_key.pem.inc"
			'\0'
		};

		static const char native_cert_pem[] = {
#include "native_cert.pem.inc"
			'\0'
		};

		socketFactory->loadCertificateFromBuffer(qemu_cert_pem);
		socketFactory->loadPrivateKeyFromBuffer(qemu_key_pem);
		socketFactory->loadTrustedCertificatesFromBuffer(native_cert_pem);
#else
		socketFactory->loadCertificate(argv[2]);
		socketFactory->loadPrivateKey(argv[3]);
		socketFactory->loadTrustedCertificates(argv[4]);
#endif
		serverTransport =
			std::make_shared<TSSLServerSocket>("0.0.0.0", port, socketFactory);
	} else {
		serverTransport = std::make_shared<TServerSocket>(my_addr, port);
	}

	transportFactory = std::make_shared<TBufferedTransportFactory>();
	if (IS_ENABLED(CONFIG_THRIFT_COMPACT_PROTOCOL)) {
		protocolFactory = std::make_shared<TCompactProtocolFactory>();
	} else {
		protocolFactory = std::make_shared<TBinaryProtocolFactory>();
	}

	TSimpleServer server(processor, serverTransport, transportFactory, protocolFactory);

	try {
		server.serve();
	} catch (std::exception &e) {
		printf("caught exception: %s\n", e.what());
		return EXIT_FAILURE;
	}

	return EXIT_SUCCESS;
}
```

## src/HelloHandler.h
```c
/*
 * Copyright 2022 Meta
 *
 * SPDX-License-Identifier: Apache-2.0
 */

#pragma once

#ifdef __ZEPHYR__
#include <zephyr/kernel.h>
#else
#define printk printf
#endif

#include <iostream>

#include "Hello.h"

class HelloHandler : virtual public HelloIf
{
public:
	HelloHandler() : count(0)
	{
	}

	void ping()
	{
		printk("%s\n", __func__);
	}

	void echo(std::string &_return, const std::string &msg)
	{
		printk("%s: %s\n", __func__, msg.c_str());
		_return = msg;
	}

	int32_t counter()
	{
		++count;
		printk("%s: %d\n", __func__, count);
		return count;
	}

protected:
	int count;
};
```
