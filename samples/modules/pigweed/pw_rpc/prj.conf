## CMakeLists.txt
```
# Copyright (c) 2023 Google LLC
# SPDX-License-Identifier: Apache-2.0

cmake_minimum_required(VERSION 3.20)

find_package(Zephyr REQUIRED HINTS $ENV{ZEPHYR_BASE})

project(rpc_demo)

add_definitions(-DVERSION=5)
add_definitions(-DCONFIG_RPC_BUFFER_SIZE=1024)
add_definitions(-DPW_LOG_LEVEL=PW_LOG_LEVEL_INFO)
add_definitions(-DPW_LOG_SHOW_MODULE=1)

# Define the proto library
include($ENV{PW_ROOT}/pw_protobuf_compiler/proto.cmake)
pw_proto_library(
    rpc_demo.protos
    SOURCES proto/demo.proto
)

file(GLOB app_sources src/*.cpp)
target_sources(app
  PRIVATE
    ${app_sources}
)
zephyr_include_directories(include)
zephyr_link_libraries(
    rpc_demo.protos.nanopb
    rpc_demo.protos.nanopb_rpc
)
target_link_libraries(app
  PRIVATE
    rpc_demo.protos.nanopb
    rpc_demo.protos.nanopb_rpc
)
```

## sample.yaml
```
sample:
  description: A simple sample of the Pigweed pw_rpc sub module.
  name: pw_rpc sample
tests:
  sample.modules.pw_rpc:
    tags: pw_rpc
    platform_allow: native_posix
    timeout: 10
    modules:
      - pigweed
    harness: console
    harness_config:
      type: multi_line
      ordered: true
      regex:
        - "(.*)Starting RPC demo(.*)"
        - "(.*)Service waiting for data(.*)"
        - "(.*)Starting pw_rpc service(.*)"
        - "(.*)Service got packet!(.*)"
        - "(.*)Client waiting for response(.*)"
        - "(.*)Reading bytes(.*)"
        - "(.*)Client got packet!(.*)"
        - "(.*)Received version #5(.*)"
```

## prj.conf
```kconfig
# Copyright (c) 2023 Google LLC
# SPDX-License-Identifier: Apache-2.0

CONFIG_ASSERT=y
CONFIG_NANOPB=y
CONFIG_BOARD_NATIVE_POSIX_64BIT=y
CONFIG_LOG=y
CONFIG_LOG_DEFAULT_LEVEL=4

CONFIG_PIGWEED_ASSERT=y
CONFIG_PIGWEED_BYTES=y
CONFIG_PIGWEED_CHECKSUM=y
CONFIG_PIGWEED_CHRONO_SYSTEM_CLOCK=y
CONFIG_PIGWEED_CONTAINERS=y
CONFIG_PIGWEED_FUNCTION=y
CONFIG_PIGWEED_HDLC=y
CONFIG_PIGWEED_INTERRUPT_CONTEXT=y
CONFIG_PIGWEED_LOG=y
CONFIG_PIGWEED_POLYFILL=y
CONFIG_PIGWEED_POLYFILL_OVERRIDES=y
CONFIG_PIGWEED_PREPROCESSOR=y
CONFIG_PIGWEED_RESULT=y
CONFIG_PIGWEED_ROUTER_PACKET_PARSER=y
CONFIG_PIGWEED_RPC_COMMON=y
CONFIG_PIGWEED_SPAN=y
CONFIG_PIGWEED_STATUS=y
CONFIG_PIGWEED_STREAM=y
CONFIG_PIGWEED_STRING=y
CONFIG_PIGWEED_SYNC_MUTEX=y
CONFIG_PIGWEED_SYS_IO=y
CONFIG_PIGWEED_VARINT=y

CONFIG_CPLUSPLUS=y
CONFIG_STD_CPP17=y
CONFIG_LIB_CPLUSPLUS=y
CONFIG_CPP_MAIN=y
```

## src/main.cpp
```c
/*
 * Copyright (c) 2023 Google LLC
 *
 * SPDX-License-Identifier: Apache-2.0
 */

#define PW_LOG_MODULE_NAME "MAIN"

#include <pw_hdlc/rpc_channel.h>
#include <pw_hdlc/rpc_packets.h>
#include <pw_log/log.h>
#include <pw_status/status.h>

#include "proto/demo.pb.h"
#include "rpc_demo/client/client_reader.h"
#include "rpc_demo/service/service_reader.h"
#include "rpc_demo/rxtx.h"


namespace {
// Create the client channel output with a built-in buffer.
pw::hdlc::RpcChannelOutput
    client_to_service_channel_output(ClientToServiceStream().as_writer(),
                                     pw::hdlc::kDefaultRpcAddress,
                                     "HDLC client output");
pw::hdlc::RpcChannelOutput
    service_to_client_channel_output(ServiceToClientStream().as_writer(),
                                     pw::hdlc::kDefaultRpcAddress,
                                     "HDLC service output");

// Configure the channel. Is this an output channel only?
pw::rpc::Channel client_channels[] = {
    pw::rpc::Channel::Create<rpc_demo_RpcClientChannelId_DEFAULT,
                             rpc_demo_RpcClientChannelId>(
        &client_to_service_channel_output),
};
pw::rpc::Channel service_channels[] = {
    pw::rpc::Channel::Create<rpc_demo_RpcClientChannelId_DEFAULT,
                             rpc_demo_RpcClientChannelId>(
        &service_to_client_channel_output),
};

pw::rpc::Client rpc_client(client_channels);
rpc_demo::pw_rpc::nanopb::DemoService::Client
    service_client(rpc_client, rpc_demo_RpcClientChannelId_DEFAULT);

void GetVersionResponse(const rpc_demo_GetVersionResponse &response,
                               pw::Status status) {
  if (status.ok()) {
    PW_LOG_INFO("Received version #%u", response.version_number);
  } else {
    PW_LOG_ERROR("Failed to get version number, status: %s",
                 pw_StatusString(status));
  }
}

} // namespace

int main(void) {
  PW_LOG_INFO("Starting RPC demo...");
  rpc_demo::ServiceReader ec_service(
      &ClientToServiceStream().as_reader(),
      &ServiceToClientStream().as_writer(),
      reinterpret_cast<pw::hdlc::RpcChannelOutput*>(
          &service_to_client_channel_output),
      service_channels);
  rpc_demo::ClientReader ap_client(ServiceToClientStream().as_reader(), &rpc_client);

  auto response = service_client.GetVersion(rpc_demo_Empty_init_default,
                                            GetVersionResponse);
  PW_ASSERT(response.active());
  PW_LOG_INFO("Service waiting for data...");
  PW_ASSERT(ec_service.ParsePacket());
  PW_LOG_INFO("Client waiting for response...");
  PW_ASSERT(ap_client.ParsePacket());
  return 0;
}
```

## src/client_reader.cpp
```c
/*
 * Copyright (c) 2023 Google LLC
 *
 * SPDX-License-Identifier: Apache-2.0
 */

#define PW_LOG_MODULE_NAME "ClientReader"

#include "rpc_demo/client/client_reader.h"

#include <pw_hdlc/decoder.h>
#include <pw_hdlc/rpc_packets.h>
#include <pw_log/log.h>
#include <pw_status/status.h>

namespace rpc_demo {

ClientReader::ClientReader(pw::stream::Reader& rx, pw::rpc::Client* rpc_client)
    : rx_(rx), rpc_client_(rpc_client), decoder_(decode_buffer_) {}

bool ClientReader::ParsePacket() {
  PW_LOG_INFO("Reading bytes...");
  while (true) {
    std::byte data;
    if (auto result = rx_.Read(&data, 1); !result.ok()) {
      PW_LOG_ERROR("Failed to read data");
      continue;
    }
    PW_LOG_DEBUG("0x%02x", static_cast<uint8_t>(data));

    pw::Result<pw::hdlc::Frame> result = decoder_.Process(data);
    if (!result.ok()) {
      continue;
    }

    pw::hdlc::Frame& frame = result.value();
    if (frame.address() != pw::hdlc::kDefaultRpcAddress) {
      return false;
    }

    PW_LOG_INFO("Client got packet!");
    auto client_result = rpc_client_->ProcessPacket(frame.data());
    PW_LOG_DEBUG("Client ProcessPacket status (%s)",
                 pw_StatusString(client_result));
    decoder_.Clear();
    return true;
  }
}

}  // namespace rpc_demo
```

## src/demo_service.cpp
```c
/*
 * Copyright (c) 2023 Google LLC
 *
 * SPDX-License-Identifier: Apache-2.0
 */

#include "rpc_demo/service/demo_service.h"

namespace rpc_demo {

// Method definitions for pw_demo.DemoHostService.
::pw::Status DemoService::GetVersion(const rpc_demo_Empty& request,
                                     rpc_demo_GetVersionResponse& response) {
  static_cast<void>(request);
  response.version_number = VERSION;
  return ::pw::OkStatus();
}

::pw::Status DemoService::GetSensorList(
    const rpc_demo_Empty& request, rpc_demo_GetSensorListResponse& response) {
  // TODO: Read the request as appropriate for your application
  static_cast<void>(request);
  // TODO: Fill in the response as appropriate for your application
  static_cast<void>(response);
  return ::pw::Status::Unimplemented();
}

::pw::Status DemoService::UpdateSensorFrequency(
    const rpc_demo_UpdateSensorFrequencyRequest& request,
    rpc_demo_UpdateSensorFrequencyResponse& response) {
  // TODO: Read the request as appropriate for your application
  static_cast<void>(request);
  // TODO: Fill in the response as appropriate for your application
  static_cast<void>(response);
  return ::pw::Status::Unimplemented();
}

::pw::Status DemoService::GetSensorSamples(
    const rpc_demo_GetSensorSamplesRequest& request,
    rpc_demo_GetSensorSamplesResponse& response) {
  // TODO: Read the request as appropriate for your application
  static_cast<void>(request);
  // TODO: Fill in the response as appropriate for your application
  static_cast<void>(response);
  return ::pw::Status::Unimplemented();
}

}  // namespace rpc_demo
```

## src/deque_stream.cpp
```c
/*
 * Copyright (c) 2023 Google LLC
 *
 * SPDX-License-Identifier: Apache-2.0
 */

#include <mutex>
#include "rpc_demo/deque_stream.h"

pw::StatusWithSize DequeReadWriter::DoRead(pw::ByteSpan destination) {
  size_t count = 0;
  std::lock_guard lock(mutex_);

  while (!buff_.empty() && count < destination.size_bytes()) {
    destination[count++] = buff_.front();
    buff_.pop_front();
  }

  auto status = (count == 0) ? pw::Status::OutOfRange() : pw::OkStatus();
  return pw::StatusWithSize(status, count);
}

pw::Status DequeReadWriter::DoWrite(pw::ConstByteSpan data) {
  std::lock_guard lock(mutex_);
  for (size_t i = 0; i < data.size_bytes(); ++i) {
    buff_.push_back(data[i]);
  }

  return pw::OkStatus();
}
```

## src/rxtx.cpp
```c
/*
 * Copyright (c) 2023 Google LLC
 *
 * SPDX-License-Identifier: Apache-2.0
 */

#include "rpc_demo/rxtx.h"
#include "rpc_demo/deque_stream.h"

namespace {
DequeReadWriter client_to_service_stream;
DequeReadWriter service_to_client_stream;
} // namespace

pw::stream::ReaderWriter &ClientToServiceStream() {
  return client_to_service_stream;
}
pw::stream::ReaderWriter &ServiceToClientStream() {
  return service_to_client_stream;
}
```

## src/service_reader.cpp
```c
/*
 * Copyright (c) 2023 Google LLC
 *
 * SPDX-License-Identifier: Apache-2.0
 */

#define PW_LOG_MODULE_NAME "ServiceReader"

#include "rpc_demo/service/service_reader.h"

#include <pw_hdlc/rpc_channel.h>
#include <pw_hdlc/rpc_packets.h>
#include <pw_log/log.h>
#include <pw_span/span.h>

namespace rpc_demo {

ServiceReader::ServiceReader(pw::stream::Reader* reader,
                             pw::stream::Writer* writer,
                             pw::hdlc::RpcChannelOutput* output,
                             pw::span<pw::rpc::Channel> channels)
    : reader_(reader), writer_(writer), output_(output), channels_(channels) {}

bool ServiceReader::ParsePacket() {
  std::array<std::byte, CONFIG_RPC_BUFFER_SIZE> decode_buffer{};
  pw::rpc::Server server(channels_);
  pw::hdlc::Decoder decoder(decode_buffer);
  DemoService service;

  server.RegisterService(service);

  // Input buffer
  PW_LOG_INFO("Starting pw_rpc service...");
  while (true) {
    std::byte data;

    if (auto result = reader_->Read(&data, 1); !result.ok()) {
      std::this_thread::sleep_for(std::chrono::milliseconds(50));
      continue;
    }

    PW_LOG_DEBUG("0x%02x", static_cast<uint8_t>(data));
    auto result = decoder.Process(data);
    if (!result.ok()) {
      continue;
    }

    auto& frame = result.value();
    if (frame.address() != pw::hdlc::kDefaultRpcAddress) {
      decoder.Clear();
      return false;
    }

    PW_LOG_INFO("Service got packet!");
    auto server_result = server.ProcessPacket(frame.data());
    PW_LOG_DEBUG("Client ProcessPacket status (%s)",
                 pw_StatusString(server_result));
    decoder.Clear();
    return true;
  }
}

}  // namespace rpc_demo
```
