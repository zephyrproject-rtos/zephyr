/* Copyright (c) 2023 Benjamin Cabé <benjamin@zephyrproject.org>
 * SPDX-License-Identifier: Apache-2.0
 */

/ {
	aliases {
		accel0 = &bmi_i2c;
	};
};

&i2c0 {
	bmi_i2c: bmi@68 {
		compatible = "bosch,bmi160";
		reg = <0x68>;
	};
};
