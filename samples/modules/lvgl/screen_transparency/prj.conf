## CMakeLists.txt
```
# SPDX-License-Identifier: Apache-2.0

cmake_minimum_required(VERSION 3.28.0)

find_package(Zephyr REQUIRED HINTS $ENV{ZEPHYR_BASE})
project(screen_transparency)

FILE(GLOB app_sources src/*.c)
target_sources(app PRIVATE ${app_sources})
```

## Kconfig
```
# Copyright (c) 2024 Martin Stumpf <finomnis@gmail.com>
# SPDX-License-Identifier: Apache-2.0

mainmenu "LVGL screen transparency sample"

config APP_DRAW_BACKGROUND_CHECKERBOARD
	bool "Draw an opaque checkerboard behind the transparent screen"
	default y if !SDL_DISPLAY
	help
	  Draw an opaque black/white checkerboard on the bottom layer so the
	  transparent screen has a defined background to composite over. This is
	  needed on displays that do NOT have a separate hardware layer (e.g. a
	  video plane) behind the LVGL framebuffer; otherwise the background is
	  whatever happens to be in the framebuffer. Disable it on boards where an
	  underlying hardware layer provides the background (the on-screen-display
	  / OSD use case), or under the SDL display which draws its own grid.

source "Kconfig.zephyr"
```

## sample.yaml
```
sample:
  description: Demonstrating Screen Transparency using LVGL
  name: LVGL screen transparency
tests:
  sample.modules.lvgl.screen_transparency:
    filter: dt_chosen_enabled("zephyr,display")
    min_flash: 250
    min_ram: 32
    harness: none
    tags:
      - samples
      - display
      - gui
      - lvgl
    modules:
      - lvgl
    integration_platforms:
      - native_sim/native/64
```

## prj.conf
```kconfig
CONFIG_MAIN_STACK_SIZE=4096
CONFIG_LOG=y

CONFIG_LVGL=y
CONFIG_LV_Z_MEM_POOL_SIZE=16384
CONFIG_LV_COLOR_FORMAT_XRGB8888=y

CONFIG_LV_FONT_MONTSERRAT_28=y
CONFIG_LV_FONT_MONTSERRAT_48=y

CONFIG_DISPLAY=y
```

## src/main.c
```c
/*
 * Copyright (c) 2024 Martin Stumpf <finomnis@gmail.com>
 *
 * SPDX-License-Identifier: Apache-2.0
 */

#include <zephyr/device.h>
#include <zephyr/devicetree.h>
#include <zephyr/drivers/display.h>

#include <lvgl.h>
#include <stdio.h>
#include <string.h>
#include <zephyr/kernel.h>

#include <zephyr/logging/log.h>
LOG_MODULE_REGISTER(app, CONFIG_LOG_DEFAULT_LEVEL);

#ifdef CONFIG_APP_DRAW_BACKGROUND_CHECKERBOARD

#define CHECKERBOARD_COLS 40

static void checkerboard_draw_cb(lv_event_t *e)
{
	lv_layer_t *layer = lv_event_get_layer(e);
	lv_obj_t *target = lv_event_get_target_obj(e);
	lv_display_t *disp = lv_obj_get_display(target);
	int32_t hor = lv_display_get_horizontal_resolution(disp);
	int32_t ver = lv_display_get_vertical_resolution(disp);
	int32_t sq = LV_MAX(hor / CHECKERBOARD_COLS, 1);
	lv_draw_rect_dsc_t dsc;

	lv_draw_rect_dsc_init(&dsc);
	dsc.bg_opa = LV_OPA_COVER;
	dsc.bg_color = lv_color_black();

	/* The bottom layer already has an opaque white background, so only the
	 * black squares need to be drawn on top of it.
	 */
	for (int32_t y = 0; y < ver; y += sq) {
		for (int32_t x = 0; x < hor; x += sq) {
			if ((((x / sq) + (y / sq)) & 1) == 0) {
				continue;
			}

			lv_area_t coords = {
				.x1 = x,
				.y1 = y,
				.x2 = x + sq - 1,
				.y2 = y + sq - 1,
			};

			lv_draw_rect(layer, &dsc, &coords);
		}
	}
}

#endif /* CONFIG_APP_DRAW_BACKGROUND_CHECKERBOARD */

static const lv_font_t *ui_font(int32_t screen_dim)
{
#if LV_FONT_MONTSERRAT_48
	if (screen_dim >= 480) {
		return &lv_font_montserrat_48;
	}
#endif
#if LV_FONT_MONTSERRAT_28
	if (screen_dim >= 240) {
		return &lv_font_montserrat_28;
	}
#endif
	return LV_FONT_DEFAULT;
}

static void add_label(lv_obj_t *parent, const char *text, lv_color_t color,
		      const lv_font_t *font, int32_t col, int32_t col_span, int32_t row)
{
	int32_t lh = lv_font_get_line_height(font);
	lv_obj_t *label = lv_label_create(parent);

	lv_label_set_text(label, text);
	lv_obj_set_style_text_font(label, font, LV_PART_MAIN);
	lv_obj_set_style_text_color(label, color, LV_PART_MAIN);

	lv_obj_set_style_bg_opa(label, LV_OPA_50, LV_PART_MAIN);
	lv_obj_set_style_bg_color(label, lv_color_black(), LV_PART_MAIN);
	lv_obj_set_style_pad_all(label, lh / 4, LV_PART_MAIN);
	lv_obj_set_style_radius(label, lh / 4, LV_PART_MAIN);

	lv_obj_set_grid_cell(label, LV_GRID_ALIGN_CENTER, col, col_span,
			     LV_GRID_ALIGN_CENTER, row, 1);
}

static void initialize_gui(void)
{
	lv_display_t *disp = lv_display_get_default();
	int32_t screen_dim = LV_MIN(lv_display_get_horizontal_resolution(disp),
				    lv_display_get_vertical_resolution(disp));
	const lv_font_t *font = ui_font(screen_dim);
	int32_t lh = lv_font_get_line_height(font);
	static const int32_t col_dsc[] = {LV_GRID_CONTENT, LV_GRID_CONTENT, LV_GRID_CONTENT,
					  LV_GRID_TEMPLATE_LAST};
	static const int32_t row_dsc[] = {LV_GRID_CONTENT, LV_GRID_CONTENT, LV_GRID_TEMPLATE_LAST};
	lv_obj_t *grid;

	/* Configure the screen for transparency */
	lv_obj_set_style_bg_opa(lv_screen_active(), LV_OPA_TRANSP, LV_PART_MAIN);

#ifdef CONFIG_APP_DRAW_BACKGROUND_CHECKERBOARD
	/* This board has no separate hardware layer behind the LVGL framebuffer,
	 * so paint an opaque black/white checkerboard on the bottom layer to give
	 * the transparent screen a defined background to composite over.
	 */
	lv_obj_set_style_bg_opa(lv_layer_bottom(), LV_OPA_COVER, LV_PART_MAIN);
	lv_obj_set_style_bg_color(lv_layer_bottom(), lv_color_white(), LV_PART_MAIN);
	lv_obj_add_event_cb(lv_layer_bottom(), checkerboard_draw_cb, LV_EVENT_DRAW_MAIN, NULL);
#else
	/* Default: keep the bottom layer transparent, so a separate hardware
	 * layer (e.g. a video plane for an OSD overlay) shows through.
	 */
	lv_obj_set_style_bg_opa(lv_layer_bottom(), LV_OPA_TRANSP, LV_PART_MAIN);
#endif

	grid = lv_obj_create(lv_screen_active());
	lv_obj_remove_style_all(grid);
	lv_obj_set_size(grid, LV_SIZE_CONTENT, LV_SIZE_CONTENT);
	lv_obj_set_grid_dsc_array(grid, col_dsc, row_dsc);
	lv_obj_set_style_pad_row(grid, lh / 2, LV_PART_MAIN);
	lv_obj_set_style_pad_column(grid, lh / 2, LV_PART_MAIN);
	lv_obj_center(grid);

	add_label(grid, "Hello, world!", lv_color_hex(0xff00ff), font, 0, 3, 0);
	add_label(grid, "RED", lv_color_hex(0xff0000), font, 0, 1, 1);
	add_label(grid, "GREEN", lv_color_hex(0x00ff00), font, 1, 1, 1);
	add_label(grid, "BLUE", lv_color_hex(0x0000ff), font, 2, 1, 1);
}

int main(void)
{
	const struct device *display_dev;
	int ret;

	display_dev = DEVICE_DT_GET(DT_CHOSEN(zephyr_display));
	if (!device_is_ready(display_dev)) {
		LOG_ERR("Device not ready, aborting test");
		return -ENODEV;
	}

	initialize_gui();

	lv_timer_handler();
	ret = display_blanking_off(display_dev);
	if (ret < 0 && ret != -ENOSYS) {
		LOG_ERR("Failed to turn blanking off (error %d)", ret);
		return 0;
	}

	while (1) {
		uint32_t sleep_ms = lv_timer_handler();

		k_msleep(MIN(sleep_ms, INT32_MAX));
	}

	return 0;
}
```
