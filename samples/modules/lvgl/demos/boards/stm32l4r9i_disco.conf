## samples/modules/lvgl/demos/boards/stm32l4r9i_disco.conf
```kconfig
#
# Copyright (c) 2026 STMicroelectronics
#
# SPDX-License-Identifier: Apache-2.0
#
CONFIG_LV_Z_MEM_POOL_SIZE=81920
CONFIG_LV_DRAW_LAYER_SIMPLE_BUF_SIZE=38912
```

## samples/modules/lvgl/demos/boards/uedx32480035e_wb_a_procpu.conf
```kconfig
CONFIG_MAIN_STACK_SIZE=8192
CONFIG_LV_Z_MEM_POOL_SIZE=58368
CONFIG_LV_Z_POINTER_INPUT_MSGQ_COUNT=256
CONFIG_INPUT_QUEUE_MAX_MSGS=256
```

## samples/modules/lvgl/demos/sample.yaml
```yaml
sample:
  description: LVGL sample, containing all upstream demos
  name: LVGL demos
common:
  modules:
    - lvgl
  harness: console
  filter: dt_chosen_enabled("zephyr,display")
  extra_args:
    - platform:mimxrt1060_evk:SHIELD=rk043fn66hs_ctg
    - platform:mimxrt1170_evk/mimxrt1176/cm7:SHIELD=rk055hdmipi4ma0
    - platform:mimxrt595_evk/mimxrt595s/cm33:SHIELD=rk055hdmipi4ma0
  tags:
    - samples
    - display
    - lvgl
    - gui
  harness_config:
    fixture: fixture_display
    type: one_line
    regex:
      - "\\[\\w+ free bytes, \\w+ allocated bytes, overhead = \\w+ bytes | lvgl in malloc mode\\]"
tests:
  sample.modules.lvgl.demo_music:
    extra_configs:
      - CONFIG_LV_Z_DEMO_MUSIC=y
  sample.modules.lvgl.demo_benchmark:
    extra_configs:
      - CONFIG_LV_Z_DEMO_BENCHMARK=y
      - CONFIG_LV_USE_DEMO_WIDGETS=y
  sample.modules.lvgl.demo_stress:
    extra_configs:
      - CONFIG_LV_Z_DEMO_STRESS=y
  sample.modules.lvgl.demo_widgets:
    extra_configs:
      - CONFIG_LV_Z_DEMO_WIDGETS=y
  sample.modules.lvgl.demo_flex_layout:
    extra_configs:
      - CONFIG_LV_Z_DEMO_FLEX_LAYOUT=y
  sample.modules.lvgl.demo_keypad_encoder:
    extra_configs:
      - CONFIG_LV_Z_DEMO_KEYPAD_AND_ENCODER=y
  sample.modules.lvgl.demo_render:
    extra_configs:
      - CONFIG_LV_Z_DEMO_RENDER=y
  sample.modules.lvgl.demo_scroll:
    extra_configs:
      - CONFIG_LV_Z_DEMO_SCROLL=y
  sample.modules.lvgl.demo_multilang:
    extra_configs:
      - CONFIG_LV_Z_DEMO_MULTILANG=y
  sample.modules.lvgl.demos.st_b_lcd40_dsi1_mb1166:
    filter: dt_compat_enabled("orisetech,otm8009a")
    platform_allow: stm32h747i_disco/stm32h747xx/m7
    extra_args: SHIELD=st_b_lcd40_dsi1_mb1166
    harness: console
    harness_config:
      fixture: fixture_display
    extra_configs:
      - CONFIG_LV_Z_DEMO_BENCHMARK=y
    modules:
      - lvgl
    tags:
      - samples
      - display
      - shield
      - lvgl
      - gui
  sample.modules.lvgl.demos.st_b_lcd40_dsi1_mb1166_a09:
    filter: dt_compat_enabled("frida,nt35510")
    platform_allow: stm32h747i_disco/stm32h747xx/m7
    extra_args: SHIELD=st_b_lcd40_dsi1_mb1166_a09
    harness: console
    harness_config:
      fixture: fixture_display
    extra_configs:
      - CONFIG_LV_Z_DEMO_BENCHMARK=y
    modules:
      - lvgl
    tags:
      - samples
      - display
      - shield
      - lvgl
      - gui
  sample.modules.lvgl.demos.rtkmipilcdb00000be:
    platform_allow: ek_ra8d1
    harness: console
    harness_config:
      fixture: fixture_display
    extra_args: SHIELD=rtkmipilcdb00000be
    modules:
      - lvgl
    tags:
      - samples
      - display
      - shield
      - lvgl
      - gui
  sample.modules.lvgl.demos.rtk7eka6m3b00001bu:
    platform_allow: ek_ra8d1
    harness: console
    harness_config:
      fixture: fixture_display
    extra_args:
      - SHIELD=rtk7eka6m3b00001bu
      - DTC_OVERLAY_FILE=rtk7eka6m3b00001bu.overlay
    extra_configs:
      - CONFIG_LV_DEMO_MUSIC_LANDSCAPE=y
    modules:
      - lvgl
    tags:
      - samples
      - display
      - shield
      - lvgl
      - gui
```

## samples/modules/lvgl/multi_display/Kconfig
```kconfig
# Copyright (c) 2023 Fabian Blatz <fabianblatz@gmail.com>
# Copyright (c) 2025 Abderrahmane JARMOUNI
# SPDX-License-Identifier: Apache-2.0

choice LV_Z_DEMO_FIRST_DISP
	prompt "LVGL demo to build for 1st display"
	default LV_Z_DEMO_MUSIC_FIRST_DISP
	help
	  Demo application to build for 1st display.

config LV_Z_DEMO_MUSIC_FIRST_DISP
	bool "LVGL music demo"
	select LV_USE_DEMO_MUSIC
	help
	  Build music player demo application.

config LV_Z_DEMO_BENCHMARK_FIRST_DISP
	bool "LVGL benchmark demo"
	select LV_USE_DEMO_BENCHMARK
	select LV_USE_SYSMON
	select LV_USE_PERF_MONITOR
	help
	  Build benchmarking demo application.

config LV_Z_DEMO_STRESS_FIRST_DISP
	bool "LVGL stress demo"
	select LV_USE_DEMO_STRESS
	select LV_USE_SYSMON
	select LV_USE_PERF_MONITOR
	help
	  Build stress testing demo application.

config LV_Z_DEMO_WIDGETS_FIRST_DISP
	bool "LVGL widgets demo"
	select LV_USE_DEMO_WIDGETS
	help
	  Build widgets demo application.

endchoice

choice LV_Z_DEMO_OTHER_DISPS
	prompt "LVGL demo to build for other displays"
	default LV_Z_DEMO_WIDGETS_OTHER_DISPS
	help
	  Demo application to build for other displays.

config LV_Z_DEMO_MUSIC_OTHER_DISPS
	bool "LVGL music demo"
	select LV_USE_DEMO_MUSIC
	help
	  Build music player demo application.

config LV_Z_DEMO_BENCHMARK_OTHER_DISPS
	bool "LVGL benchmark demo"
	select LV_USE_DEMO_BENCHMARK
	select LV_USE_SYSMON
	select LV_USE_PERF_MONITOR
	help
	  Build benchmarking demo application.

config LV_Z_DEMO_STRESS_OTHER_DISPS
	bool "LVGL stress demo"
	select LV_USE_DEMO_STRESS
	select LV_USE_SYSMON
	select LV_USE_PERF_MONITOR
	help
	  Build stress testing demo application.

config LV_Z_DEMO_WIDGETS_OTHER_DISPS
	bool "LVGL widgets demo"
	select LV_USE_DEMO_WIDGETS
	help
	  Build widgets demo application.

endchoice

source "Kconfig.zephyr"
```

## samples/modules/lvgl/multi_display/boards/native_sim_native_64.conf
```kconfig
# Copyright 2025 Abderrahmane JARMOUNI
# SPDX-License-Identifier: Apache-2.0

CONFIG_LV_COLOR_DEPTH_32=y
CONFIG_LV_Z_MEM_POOL_SIZE=150536

CONFIG_INPUT=y
```

## samples/modules/lvgl/multi_display/sample.yaml
```yaml
sample:
  description: LVGL multi-display sample
  name: LVGL Multi-display
common:
  modules:
    - lvgl
  filter: dt_compat_enabled("zephyr,displays")
  tags:
    - samples
    - display
    - lvgl
    - gui
  harness_config:
    fixture: fixture_display
tests:
  sample.modules.lvgl.multi_display:
    integration_platforms:
      - native_sim/native/64
```

## samples/modules/lvgl/screen_transparency/sample.yaml
```yaml
sample:
  description: Demonstrating Screen Transparency using LVGL
  name: LVGL screen transparency
tests:
  sample.modules.lvgl.screen_transparency:
    filter: dt_chosen_enabled("zephyr,display")
    min_flash: 250
    min_ram: 32
    harness: none
    tags:
      - samples
      - display
      - gui
      - lvgl
    modules:
      - lvgl
    integration_platforms:
      - native_sim/native/64
```

## samples/modules/lvgl/touch_draw/sample.yaml
```yaml
sample:
  description: LVGL touch draw demo
  name: LVGL touch draw
common:
  modules:
    - lvgl
  harness: none
  tags:
    - samples
    - display
    - touch
    - gui
    - lvgl
tests:
  sample.display.lvgl.touch_draw:
    filter: dt_chosen_enabled("zephyr,display") and dt_chosen_enabled("zephyr,lvgl-pointer-input")
    min_flash: 250
    min_ram: 32
```

## samples/modules/nanopb/Kconfig
```kconfig
# Private config options for nanopb app

# Copyright (c) 2024 Basalte bv
# SPDX-License-Identifier: Apache-2.0

mainmenu "Nanopb protobuf sample application"

config SAMPLE_BUFFER_SIZE
	int "Simple message buffer size"
	default 8
	help
	  Configure the simple message buffer field's size.

source "Kconfig.zephyr"
```

## samples/modules/nanopb/sample.yaml
```yaml
sample:
  description: Nanopb sample, with a simple proto
    buffer
  name: Simple nanopb
common:
  modules:
    - nanopb
  harness: console
  harness_config:
    type: one_line
    regex:
      - "Your lucky number was 13!"
tests:
  sample.modules.nanopb:
    tags: samples nanopb
    integration_platforms:
    - native_posix
    - native_posix_64
```

## samples/modules/nanopb2/sample.yaml
```yaml
sample:
  description: Nanopb sample2, with a person proto
    buffer
  name: Person nanopb2
common:
  harness: console
  harness_config:
    type: one_line
    regex:
      - ""
tests:
  sample.modules.nanopb2:
    tags: samples nanopb2
```

## samples/modules/paddlelite/sample.yaml
```yaml
sample:
  description: CNN PaddleLite sample
  name: paddlelite
tests:
  sample.paddlelite:
    platform_allow: roc_rk3568_pc 
    build_only: true
    tags: paddlelite
    integration_platforms:
      - roc_rk3568_pc
    modules:
      - paddlelite
 
```

## samples/modules/pigweed/pw_rpc/sample.yaml
```yaml
sample:
  description: A simple sample of the Pigweed pw_rpc sub module.
  name: pw_rpc sample
tests:
  sample.modules.pw_rpc:
    tags: pw_rpc
    platform_allow: native_posix
    timeout: 10
    modules:
      - pigweed
    harness: console
    harness_config:
      type: multi_line
      ordered: true
      regex:
        - "(.*)Starting RPC demo(.*)"
        - "(.*)Service waiting for data(.*)"
        - "(.*)Starting pw_rpc service(.*)"
        - "(.*)Service got packet!(.*)"
        - "(.*)Client waiting for response(.*)"
        - "(.*)Reading bytes(.*)"
        - "(.*)Client got packet!(.*)"
        - "(.*)Received version #5(.*)"
```

## samples/modules/pigweed/pw_tokenizer/sample.yaml
```yaml
sample:
  name: pw_tokenizer sample
tests:
  sample.pw_tokenizer:
    tags: pw_tokenizer
    platform_allow: native_posix
    timeout: 10
    harness: console
    harness_config:
      type: multi_line
      regex:
        - "token=\\d+"
        - "tokenized buffer size is 9 bytes"
        - "detokenized message size is 17 bytes"
```

## samples/modules/qcbor/sample.yaml
```yaml
sample:
  description: QCBOR sample, with simple encoding and decoding
  name: Simple QCBOR sample
common:
  harness: console
  harness_config:
    type: one_line
    regex:
      - "Decoded message is equal to encoded message"
tests:
  sample.modules.qcbor:
    tags: samples qcbor
```

## samples/modules/sof/boards/intel_adsp_ace15_mtpm.conf
```kconfig
CONFIG_INTEL_DMIC=y
CONFIG_INTEL_SSP=y
CONFIG_INTEL_ALH=y
CONFIG_LP_MEMORY_BANKS=1
CONFIG_RIMAGE_SIGNING_SCHEMA="mtl"
CONFIG_IPC_MAJOR_4=y
CONFIG_COMP_SRC=n
CONFIG_INTEL_ADSP_TIMER=n
CONFIG_FORMAT_CONVERT_HIFI3=n
```

## samples/modules/sof/boards/intel_adsp_cavs20.conf
```kconfig
CONFIG_ICELAKE=y
CONFIG_INTEL_DMIC=y
CONFIG_INTEL_SSP=y
CONFIG_INTEL_ALH=y
CONFIG_LP_MEMORY_BANKS=1
CONFIG_HP_MEMORY_BANKS=47
```

## samples/modules/sof/boards/intel_adsp_cavs25.conf
```kconfig
CONFIG_TIGERLAKE=y
CONFIG_INTEL_DMIC=y
CONFIG_INTEL_SSP=y
CONFIG_INTEL_ALH=y
CONFIG_LP_MEMORY_BANKS=1
CONFIG_HP_MEMORY_BANKS=30
CONFIG_RIMAGE_SIGNING_SCHEMA="tgl"
CONFIG_PM=y
CONFIG_PM_DEVICE=y
CONFIG_PM_DEVICE_RUNTIME=y
```

## samples/modules/tflite-micro/adc_anomaly_detector/Kconfig
```kconfig
# SPDX-FileCopyrightText: Copyright (c) 2026 Mahad Faisal
# SPDX-License-Identifier: Apache-2.0

source "Kconfig.zephyr"

menu "TFLM ADC anomaly detector"

config TFLM_ADC_ANOMALY_DETECTOR_ADC_SOURCE
	bool "Use ADC sample source"
	depends on ADC
	default n
	help
		Use Zephyr's ADC API as the sample source. The default synthetic
		source is used for deterministic CI and QEMU validation.

config TFLM_ADC_ANOMALY_DETECTOR_ADC_INTERVAL_US
	int "ADC sample interval in microseconds"
	depends on TFLM_ADC_ANOMALY_DETECTOR_ADC_SOURCE
	default 1000
	help
		Delay between ADC samples when the ADC source is enabled.

endmenu
```

## samples/modules/tflite-micro/adc_anomaly_detector/sample.yaml
```yaml
sample:
  description: TensorFlow Lite Micro ADC anomaly detector sample
  name: ADC anomaly detector TensorFlow Lite Micro

common:
  tags:
    - tensorflow
    - adc
  modules:
    - tflite-micro
  harness: console
  harness_config:
    type: multi_line
    ordered: false
    regex:
      - "sample_source: .*"
      - "sample_window: .*"
      - "raw_prediction: .*"
      - "stable_prediction: .*"
      - "result: PASS"

tests:
  sample.tensorflow.adc_anomaly_detector:
    platform_allow:
      - qemu_x86
      - qemu_x86_64
    integration_platforms:
      - qemu_x86
    filter: CONFIG_FULL_LIBC_SUPPORTED

  sample.tensorflow.adc_anomaly_detector.cmsis_nn:
    platform_allow:
      - ek_ra8m1
    extra_configs:
      - CONFIG_TENSORFLOW_LITE_MICRO_CMSIS_NN_KERNELS=y
```

## samples/modules/tflite-micro/cnn_fault_classifier/sample.yaml
```yaml
sample:
  description: TensorFlow Lite Micro 1D CNN fault classifier sample
  name: 1D CNN fault classifier TensorFlow Lite Micro

common:
  tags:
    - tensorflow
  modules:
    - tflite-micro
  harness: console
  harness_config:
    type: multi_line
    ordered: false
    regex:
      - "input_window: .*"
      - "prediction: .*"
      - "result: PASS"

tests:
  sample.tensorflow.cnn_fault_classifier:
    platform_allow:
      - qemu_x86
      - qemu_x86_64
    integration_platforms:
      - qemu_x86
    filter: CONFIG_FULL_LIBC_SUPPORTED

  sample.tensorflow.cnn_fault_classifier.cmsis_nn:
    platform_allow:
      - ek_ra8m1
    extra_configs:
      - CONFIG_TENSORFLOW_LITE_MICRO_CMSIS_NN_KERNELS=y
```

## samples/modules/tflite-micro/fft_event_classifier/sample.yaml
```yaml
sample:
  description: TensorFlow Lite Micro FFT event classifier sample
  name: FFT event classifier TensorFlow Lite Micro

common:
  tags:
    - tensorflow
    - cmsis_dsp
  modules:
    - tflite-micro
    - cmsis-dsp
  harness: console
  harness_config:
    type: multi_line
    ordered: false
    regex:
      - "input_window: .*"
      - "prediction: .*"
      - "result: PASS"

tests:
  sample.tensorflow.fft_event_classifier:
    platform_allow:
      - qemu_x86
      - qemu_x86_64
    integration_platforms:
      - qemu_x86
    filter: CONFIG_FULL_LIBC_SUPPORTED

  sample.tensorflow.fft_event_classifier.cmsis_nn:
    platform_allow:
      - ek_ra8m1
    extra_configs:
      - CONFIG_TENSORFLOW_LITE_MICRO_CMSIS_NN_KERNELS=y
```

## samples/modules/tflite-micro/hello_world/sample.yaml
```yaml
sample:
  description: Hello World TensorFlow sample
  name: hello world tensorflow
common:
  tags: tensorflow
  modules:
    - tflite-micro
  harness: console
  harness_config:
    type: multi_line
    ordered: false
    regex:
      - "x_value:.*, y_value:.*"
      - ""
tests:
  sample.tensorflow.helloworld:
    platform_allow:
      - qemu_x86/atom
      - qemu_x86_64/atom
    integration_platforms:
      - qemu_x86/atom
    tags: tensorflow
    filter: CONFIG_FULL_LIBC_SUPPORTED
  sample.tensorflow.helloworld.cmsis_nn:
    tags: tensorflow
    platform_allow: mps3/an547
    extra_configs:
      - CONFIG_TENSORFLOW_LITE_MICRO_CMSIS_NN_KERNELS=y
```

## samples/modules/tflite-micro/magic_wand/sample.yaml
```yaml
sample:
  description: Magic Wand TensorFlow sample
  name: magic wand tensorflow
tests:
  sample.tensorflow.magicwand:
    platform_allow: litex_vexriscv
    build_only: true
    tags: tensorflow
```
