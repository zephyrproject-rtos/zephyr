/*
 * Copyright (c) 2025 Renesas Electronics Corporation
 *
 * SPDX-License-Identifier: Apache-2.0
 */

/ {
	lvgl_pointer {
		compatible = "zephyr,lvgl-pointer-input";
		swap-xy;
		input = <&ft5336_rtk7eka6m3b00001bu>;
	};
};
