## prj.conf
```kconfig
# nothing here


# ISSM_CONFIGURATION
# Enable OS Awareness
CONFIG_DEBUG_TRACING_KERNEL_OBJECTS=y
CONFIG_THREAD_MONITOR=y
CONFIG_GDB_INFO=y

# Configure platform
CONFIG_ARC_INIT=y
CONFIG_ARC_INIT_DEBUG=n
CONFIG_ARC_GDB_ENABLE=n

CONFIG_BOARD_PANTHER=y

CONFIG_PRINTK=y

# syslog
CONFIG_SYS_LOG=y
CONFIG_SYS_LOG_SHOW_TAGS=y
# CONFIG_SYS_LOG_DEFAULT_LEVEL=SYS_LOG_LEVEL_DEBUG
# CONFIG_SYS_LOG_ETHERNET_LEVEL=SYS_LOG_LEVEL_DEBUG

CONFIG_IPM=y
CONFIG_IPM_QUARK_SE=y
CONFIG_IPM_QUARK_SE_MASTER=y
CONFIG_IPM_CONSOLE_RECEIVER=y

CONFIG_TIMESLICE_SIZE=1
CONFIG_MAIN_STACK_SIZE=2048

CONFIG_NETWORKING=y
CONFIG_NET_IPV4=y
CONFIG_NET_DHCPV4=y
CONFIG_NET_IPV6=n
CONFIG_NET_L2_ETHERNET=n
CONFIG_NET_TCP=y
CONFIG_NET_MGMT=y
CONFIG_NET_MGMT_EVENT=y

CONFIG_NET_LOG=y

CONFIG_WIFI=y
CONFIG_WIFI_WINC1500=y
CONFIG_NET_MGMT_WIFI=y

CONFIG_NET_OFFLOAD=y

CONFIG_MQTT_LIB=y
CONFIG_MQTT_MSG_MAX_SIZE=512

CONFIG_RANDOM_GENERATOR=y
CONFIG_TEST_RANDOM_GENERATOR=y
CONFIG_TIMER_RANDOM_GENERATOR=y
```

## src/main.c
```c
/*
 * Copyright (c) 2017 IpTronix S.r.l.
 *
 * SPDX-License-Identifier: Apache-2.0
 */

#include <device.h>
#include <misc/byteorder.h>
#include <misc/printk.h>
#include <zephyr.h>
#include <string.h>
#include <net/wifi_mgmt.h>

#include "wifi.h"
#include "mqtt.h"

int ipm_init(char *device_hid, char *topic);

/**
 * definition for WiFi connection
 *
 *	ap_name 	SSID of your network access point
 *	password 	password
 *	security 	security see wifi_security_t
 *
 */
struct wifi_conn_params wifi_params = {
	.ap_name = "SSID",
	.password = "password",
	.security = WIFI_SECURITY_OPEN,
};

/**
 * definitions for MQTT
 *
 *		server_addr 	server address
 *		server_port 	server port
 *		device_hid 		device identification
 *		client_id 		client identification
 *		user_id 		user identification
 *		password 		password
 *		topic 			publish topic
 */
struct mqtt_client_prm client_prm = {
	.server_addr = "104.214.111.120",
	.server_port = 1883,
	.device_hid = "device_hid",
	.client_id = "client_id",
	.user_id = "user",
	.password = "password",
	.topic = "topic",
};

void main(void)
{
	int ret;

	printk("Panther mqtt test program "__DATE__" "__TIME__"\n");

	/**
	 * Initialize IPM communication
	 */
	printk("IPM init\n");
	ret = ipm_init(client_prm.device_hid, client_prm.topic);
	if (ret) {
		printk("IPM init FAIL\n");
	}

	/**
	 * Initialize WiFi connection and start MQTT Publisher after WiFi is connected
	 */
	printk("Test WiFi mqtt\n");
	ret = wifi_init(&wifi_params, mqtt_pub_init, (void *)&client_prm);
	if (ret) {
		printk("WiFi init callback function FAIL\n");
	}

	k_sleep(K_FOREVER);
}
```

## src/echo_server.c
```c
/* echo.c - Networking echo server */

/*
 * Copyright (c) 2016 Intel Corporation.
 *
 * SPDX-License-Identifier: Apache-2.0
 */

#if 1
#define SYS_LOG_DOMAIN "echo-server"
#define NET_SYS_LOG_LEVEL SYS_LOG_LEVEL_DEBUG
#define NET_LOG_ENABLED 1
#endif

#include <zephyr.h>
#include <sections.h>
#include <errno.h>

#include <net/net_pkt.h>
#include <net/net_if.h>
#include <net/net_core.h>
#include <net/net_context.h>

#if defined(CONFIG_NET_L2_BLUETOOTH)
#include <bluetooth/bluetooth.h>
#include <gatt/ipss.h>
#endif

#if defined(CONFIG_NET_L2_IEEE802154)
#include <ieee802154_settings.h>
#endif

/* Allow binding to ANY IP address. */
#define NET_BIND_ANY_ADDR 1

#if defined(CONFIG_NET_IPV6)
/* Define my IP address where to expect messages */
#define MY_IP6ADDR { { { 0x20, 0x01, 0x0d, 0xb8, 0, 0, 0, 0, \
			 0, 0, 0, 0, 0, 0, 0, 0x1 } } }
#define MY_PREFIX_LEN 64

static struct in6_addr in6addr_my = MY_IP6ADDR;
#endif /* IPv6 */

#if defined(CONFIG_NET_IPV4)
/* The 192.0.2.0/24 is the private address space for documentation RFC 5737 */
#define MY_IP4ADDR { { { 192, 0, 2, 1 } } }

#if !defined(CONFIG_NET_DHCPV4) || !NET_BIND_ANY_ADDR
static struct in_addr in4addr_my = MY_IP4ADDR;
#endif /* CONFIG_NET_DHCPV4 || !NET_BIND_ANY_ADDR */
#endif /* IPv4 */

/* Note that both tcp and udp can share the same pool but in this
 * example the UDP context and TCP context have separate pools.
 */
#if defined(CONFIG_NET_CONTEXT_NET_PKT_POOL)
#if defined(CONFIG_NET_TCP)
NET_PKT_TX_SLAB_DEFINE(echo_tx_tcp, 15);
NET_PKT_DATA_POOL_DEFINE(echo_data_tcp, 30);

static struct k_mem_slab *tx_tcp_slab(void)
{
	return &echo_tx_tcp;
}

static struct net_buf_pool *data_tcp_pool(void)
{
	return &echo_data_tcp;
}
#endif

#if defined(CONFIG_NET_UDP)
NET_PKT_TX_SLAB_DEFINE(echo_tx_udp, 5);
NET_PKT_DATA_POOL_DEFINE(echo_data_udp, 20);

static struct k_mem_slab *tx_udp_slab(void)
{
	return &echo_tx_udp;
}

static struct net_buf_pool *data_udp_pool(void)
{
	return &echo_data_udp;
}
#endif
#endif /* CONFIG_NET_CONTEXT_NET_PKT_POOL */

#define MY_PORT 4242

#define STACKSIZE 4000
char __noinit __stack thread_stack[STACKSIZE];

#define MAX_DBG_PRINT 64

static struct k_sem quit_lock;

static inline void quit(void)
{
	k_sem_give(&quit_lock);
}

static inline void init_app(void)
{
	NET_INFO("Run echo server");

	k_sem_init(&quit_lock, 0, UINT_MAX);

#if defined(CONFIG_NET_IPV6)
#if defined(CONFIG_NET_APP_MY_IPV6_ADDR)
	if (net_addr_pton(AF_INET6,
			  CONFIG_NET_APP_MY_IPV6_ADDR,
			  &in6addr_my) < 0) {
		NET_ERR("Invalid IPv6 address %s",
			CONFIG_NET_APP_MY_IPV6_ADDR);
	}
#endif

	do {
		struct net_if_addr *ifaddr;

		ifaddr = net_if_ipv6_addr_add(net_if_get_default(),
					      &in6addr_my, NET_ADDR_MANUAL, 0);
	} while (0);
#endif

#if defined(CONFIG_NET_IPV4)
#if defined(CONFIG_NET_DHCPV4)
//TODO	net_dhcpv4_start(net_if_get_default());
#else
#if defined(CONFIG_NET_APP_MY_IPV4_ADDR)
	if (net_addr_pton(AF_INET,
			  CONFIG_NET_APP_MY_IPV4_ADDR,
			  &in4addr_my) < 0) {
		NET_ERR("Invalid IPv4 address %s",
			CONFIG_NET_APP_MY_IPV4_ADDR);
	}

	net_if_ipv4_addr_add(net_if_get_default(), &in4addr_my,
			     NET_ADDR_MANUAL, 0);
#endif
#endif /* CONFIG_NET_DHCPV4 */
#endif /* CONFIG_NET_IPV4 */
}

static inline bool get_context(struct net_context **udp_recv4,
			       struct net_context **udp_recv6,
			       struct net_context **tcp_recv4,
			       struct net_context **tcp_recv6)
{
	int ret;

#if defined(CONFIG_NET_IPV6)
	struct sockaddr_in6 my_addr6 = { 0 };
#endif

#if defined(CONFIG_NET_IPV4)
	struct sockaddr_in my_addr4 = { 0 };
#endif

#if defined(CONFIG_NET_IPV6)
#if !NET_BIND_ANY_ADDR
	net_ipaddr_copy(&my_addr6.sin6_addr, &in6addr_my);
#endif

	my_addr6.sin6_family = AF_INET6;
	my_addr6.sin6_port = htons(MY_PORT);
#endif

#if defined(CONFIG_NET_IPV4)
#if !NET_BIND_ANY_ADDR
	net_ipaddr_copy(&my_addr4.sin_addr, &in4addr_my);
#endif

	my_addr4.sin_family = AF_INET;
	my_addr4.sin_port = htons(MY_PORT);
#endif

#if defined(CONFIG_NET_IPV6) && defined(CONFIG_NET_UDP)
	ret = net_context_get(AF_INET6, SOCK_DGRAM, IPPROTO_UDP, udp_recv6);
	if (ret < 0) {
		NET_ERR("Cannot get network context for IPv6 UDP (%d)",
			ret);
		return false;
	}

	net_context_setup_pools(*udp_recv6, tx_udp_slab, data_udp_pool);

	ret = net_context_bind(*udp_recv6, (struct sockaddr *)&my_addr6,
			       sizeof(struct sockaddr_in6));
	if (ret < 0) {
		NET_ERR("Cannot bind IPv6 UDP port %d (%d)",
			ntohs(my_addr6.sin6_port), ret);
		return false;
	}
#endif

#if defined(CONFIG_NET_IPV4) && defined(CONFIG_NET_UDP)
	printk("echo server:get IPv4 UDP net context\n");
	ret = net_context_get(AF_INET, SOCK_DGRAM, IPPROTO_UDP, udp_recv4);
	if (ret < 0) {
		NET_ERR("Cannot get network context for IPv4 UDP (%d)",
			ret);
		return false;
	}

	net_context_setup_pools(*udp_recv4, tx_udp_slab, data_udp_pool);

	ret = net_context_bind(*udp_recv4, (struct sockaddr *)&my_addr4,
			       sizeof(struct sockaddr_in));
	if (ret < 0) {
		NET_ERR("Cannot bind IPv4 UDP port %d (%d)",
			ntohs(my_addr4.sin_port), ret);
		return false;
	}
	printk("echo server:IPv4 UDP binded on port %d\n",
			ntohs(my_addr4.sin_port));
#endif

#if defined(CONFIG_NET_IPV6) && defined(CONFIG_NET_TCP)
	if (tcp_recv6) {
		ret = net_context_get(AF_INET6, SOCK_STREAM, IPPROTO_TCP,
				      tcp_recv6);
		if (ret < 0) {
			NET_ERR("Cannot get network context "
				"for IPv6 TCP (%d)", ret);
			return false;
		}

		net_context_setup_pools(*tcp_recv6, tx_tcp_slab, data_tcp_pool);

		ret = net_context_bind(*tcp_recv6,
				       (struct sockaddr *)&my_addr6,
				       sizeof(struct sockaddr_in6));
		if (ret < 0) {
			NET_ERR("Cannot bind IPv6 TCP port %d (%d)",
				ntohs(my_addr6.sin6_port), ret);
			return false;
		}

		ret = net_context_listen(*tcp_recv6, 0);
		if (ret < 0) {
			NET_ERR("Cannot listen IPv6 TCP (%d)", ret);
			return false;
		}
	}
#endif

#if defined(CONFIG_NET_IPV4) && defined(CONFIG_NET_TCP)
	if (tcp_recv4) {
		ret = net_context_get(AF_INET, SOCK_STREAM, IPPROTO_TCP,
				      tcp_recv4);
		if (ret < 0) {
			NET_ERR("Cannot get network context for IPv4 TCP");
			return false;
		}

		net_context_setup_pools(*tcp_recv4, tx_tcp_slab, data_tcp_pool);

		ret = net_context_bind(*tcp_recv4,
				       (struct sockaddr *)&my_addr4,
				       sizeof(struct sockaddr_in));
		if (ret < 0) {
			NET_ERR("Cannot bind IPv4 TCP port %d",
				ntohs(my_addr4.sin_port));
			return false;
		}

		ret = net_context_listen(*tcp_recv4, 0);
		if (ret < 0) {
			NET_ERR("Cannot listen IPv4 TCP");
			return false;
		}
		printk("echo server:IPv4 TCP server is listening on %d.%d.%d.%d:%d\n",
				my_addr4.sin_addr.s4_addr[0],
				my_addr4.sin_addr.s4_addr[1],
				my_addr4.sin_addr.s4_addr[2],
				my_addr4.sin_addr.s4_addr[3],
				ntohs(my_addr4.sin_port));
	}
#endif

	return true;
}

static struct net_pkt *build_reply_pkt(const char *name,
				       struct net_context *context,
				       struct net_pkt *pkt)
{
	struct net_pkt *reply_pkt;
	struct net_buf *frag, *tmp;
	int header_len, recv_len, reply_len;

	NET_INFO("%s received %d bytes", name,
		 net_pkt_appdatalen(pkt));

	if (net_pkt_appdatalen(pkt) == 0) {
		return NULL;
	}

	reply_pkt = net_pkt_get_tx(context, K_FOREVER);

	NET_ASSERT(reply_pkt);

	recv_len = net_pkt_get_len(pkt);

	tmp = pkt->frags;

	/* First fragment will contain IP header so move the data
	 * down in order to get rid of it.
	 */
	header_len = net_pkt_appdata(pkt) - tmp->data;

	NET_ASSERT(header_len < CONFIG_NET_BUF_DATA_SIZE);

	/* After this pull, the tmp->data points directly to application
	 * data.
	 */
	net_buf_pull(tmp, header_len);

	while (tmp) {
		frag = net_pkt_get_data(context, K_FOREVER);

		if (!net_buf_headroom(tmp)) {
			/* If there is no link layer headers in the
			 * received fragment, then get rid of that also
			 * in the sending fragment. We end up here
			 * if MTU is larger than fragment size, this
			 * is typical for ethernet.
			 */
			net_buf_push(frag, net_buf_headroom(frag));

			frag->len = 0; /* to make fragment empty */

			/* Make sure to set the reserve so that
			 * in sending side we add the link layer
			 * header if needed.
			 */
			net_pkt_set_ll_reserve(reply_pkt, 0);
		}

		NET_ASSERT(net_buf_tailroom(frag) >= tmp->len);

		memcpy(net_buf_add(frag, tmp->len), tmp->data, tmp->len);

		net_pkt_frag_add(reply_pkt, frag);

		tmp = net_pkt_frag_del(pkt, NULL, tmp);
	}

	reply_len = net_pkt_get_len(reply_pkt);

	NET_ASSERT_INFO((recv_len - header_len) == reply_len,
			"Received %d bytes, sending %d bytes",
			recv_len - header_len, reply_len);

	return reply_pkt;
}

static inline void pkt_sent(struct net_context *context,
			    int status,
			    void *token,
			    void *user_data)
{
	if (!status) {
		NET_INFO("Sent %d bytes", POINTER_TO_UINT(token));
	}
}

#if defined(CONFIG_NET_UDP)
static inline void set_dst_addr(sa_family_t family,
				struct net_pkt *pkt,
				struct sockaddr *dst_addr)
{
#if defined(CONFIG_NET_IPV6)
	if (family == AF_INET6) {
		net_ipaddr_copy(&net_sin6(dst_addr)->sin6_addr,
				&NET_IPV6_HDR(pkt)->src);
		net_sin6(dst_addr)->sin6_family = AF_INET6;
		net_sin6(dst_addr)->sin6_port = NET_UDP_HDR(pkt)->src_port;
	}
#endif /* CONFIG_NET_IPV6) */

#if defined(CONFIG_NET_IPV4)
	if (family == AF_INET) {
		net_ipaddr_copy(&net_sin(dst_addr)->sin_addr,
				&NET_IPV4_HDR(pkt)->src);
		net_sin(dst_addr)->sin_family = AF_INET;
		net_sin(dst_addr)->sin_port = NET_UDP_HDR(pkt)->src_port;
	}
#endif /* CONFIG_NET_IPV6) */
}

static void udp_received(struct net_context *context,
			 struct net_pkt *pkt,
			 int status,
			 void *user_data)
{
	struct net_pkt *reply_pkt;
	struct sockaddr dst_addr;
	sa_family_t family = net_pkt_family(pkt);
	static char dbg[MAX_DBG_PRINT + 1];
	int ret;

	snprintk(dbg, MAX_DBG_PRINT, "UDP IPv%c",
		 family == AF_INET6 ? '6' : '4');

	set_dst_addr(family, pkt, &dst_addr);

	reply_pkt = build_reply_pkt(dbg, context, pkt);

	net_pkt_unref(pkt);

	if (!reply_pkt) {
		return;
	}

	ret = net_context_sendto(reply_pkt, &dst_addr,
				 family == AF_INET6 ?
				 sizeof(struct sockaddr_in6) :
				 sizeof(struct sockaddr_in),
				 pkt_sent, 0,
				 UINT_TO_POINTER(net_pkt_get_len(reply_pkt)),
				 user_data);
	if (ret < 0) {
		NET_ERR("Cannot send data to peer (%d)", ret);
		net_pkt_unref(reply_pkt);
	}
}

static void setup_udp_recv(struct net_context *udp_recv4,
			   struct net_context *udp_recv6)
{
	int ret;

#if defined(CONFIG_NET_IPV6)
	ret = net_context_recv(udp_recv6, udp_received, 0, NULL);
	if (ret < 0) {
		NET_ERR("Cannot receive IPv6 UDP packets");
	}
#endif /* CONFIG_NET_IPV6 */

#if defined(CONFIG_NET_IPV4)
	ret = net_context_recv(udp_recv4, udp_received, 0, NULL);
	if (ret < 0) {
		NET_ERR("Cannot receive IPv4 UDP packets");
	}
#endif /* CONFIG_NET_IPV4 */
}
#endif /* CONFIG_NET_UDP */

#if defined(CONFIG_NET_TCP)
static void tcp_received(struct net_context *context,
			 struct net_pkt *pkt,
			 int status,
			 void *user_data)
{
	static char dbg[MAX_DBG_PRINT + 1];
	struct net_pkt *reply_pkt;
	sa_family_t family;
	int ret;
printk("echo server:tcp_received\n");
	if (!pkt) {
		/* EOF condition */
		return;
	}

	family = net_pkt_family(pkt);

	snprintk(dbg, MAX_DBG_PRINT, "TCP IPv%c",
		 family == AF_INET6 ? '6' : '4');

	reply_pkt = build_reply_pkt(dbg, context, pkt);

	net_pkt_unref(pkt);

	if (!reply_pkt) {
		return;
	}

	ret = net_context_send(reply_pkt, pkt_sent, K_NO_WAIT,
			       UINT_TO_POINTER(net_pkt_get_len(reply_pkt)),
			       NULL);
	if (ret < 0) {
		NET_ERR("Cannot send data to peer (%d)", ret);
		net_pkt_unref(reply_pkt);

		quit();
	}
}

static void tcp_accepted(struct net_context *context,
			 struct sockaddr *addr,
			 socklen_t addrlen,
			 int error,
			 void *user_data)
{
	int ret;

	NET_DBG("Accept called, context %p error %d", context, error);

	printk("echo server:tcp_accepted: from %d.%d.%d.%d:%d\n",
			((struct sockaddr_in*)addr)->sin_addr.s4_addr[0],
			((struct sockaddr_in*)addr)->sin_addr.s4_addr[1],
			((struct sockaddr_in*)addr)->sin_addr.s4_addr[2],
			((struct sockaddr_in*)addr)->sin_addr.s4_addr[3],
			ntohs(((struct sockaddr_in*)addr)->sin_port));
	printk("echo server:tcp_accepted:call net_context_recv(). Wait for data\n");

	ret = net_context_recv(context, tcp_received, 0, NULL);
	printk("echo server:tcp_accepted:net_context_recv return %d\n", ret);
	if (ret < 0) {
		NET_ERR("Cannot receive TCP packet (family %d)",
			net_context_get_family(context));
	}
}

static void setup_tcp_accept(struct net_context *tcp_recv4,
			     struct net_context *tcp_recv6)
{
	int ret;

#if defined(CONFIG_NET_IPV6)
	ret = net_context_accept(tcp_recv6, tcp_accepted, 0, NULL);
	if (ret < 0) {
		NET_ERR("Cannot receive IPv6 TCP packets (%d)", ret);
	}
#endif /* CONFIG_NET_IPV6 */

#if defined(CONFIG_NET_IPV4)
	printk("echo server:call accept\n");
	ret = net_context_accept(tcp_recv4, tcp_accepted, 0, NULL);
	printk("echo server:accept return %d\n", ret);
	if (ret < 0) {
		NET_ERR("Cannot receive IPv4 TCP packets (%d)", ret);
	}
#endif /* CONFIG_NET_IPV4 */
}
#endif /* CONFIG_NET_TCP */

void receive(void)
{
	struct net_context *udp_recv4 = { 0 };
	struct net_context *udp_recv6 = { 0 };
	struct net_context *tcp_recv4 = { 0 };
	struct net_context *tcp_recv6 = { 0 };

	if (!get_context(&udp_recv4, &udp_recv6,
			 &tcp_recv4, &tcp_recv6)) {
		NET_ERR("Cannot get network contexts");
		return;
	}

	NET_INFO("Starting to wait");

#if defined(CONFIG_NET_TCP)
	setup_tcp_accept(tcp_recv4, tcp_recv6);
#endif

#if defined(CONFIG_NET_UDP)
	setup_udp_recv(udp_recv4, udp_recv6);
#endif

	k_sem_take(&quit_lock, K_FOREVER);

	NET_INFO("Stopping...");

#if defined(CONFIG_NET_IPV6) && defined(CONFIG_NET_UDP)
	net_context_put(udp_recv6);
#endif

#if defined(CONFIG_NET_IPV4) && defined(CONFIG_NET_UDP)
	net_context_put(udp_recv4);
#endif

#if defined(CONFIG_NET_IPV6) && defined(CONFIG_NET_TCP)
	net_context_put(tcp_recv6);
#endif

#if defined(CONFIG_NET_IPV4) && defined(CONFIG_NET_TCP)
	net_context_put(tcp_recv4);
#endif
}

int echo_server_init(void *arg)
{
	init_app();

#if defined(CONFIG_NET_L2_BLUETOOTH)
	if (bt_enable(NULL)) {
		NET_ERR("Bluetooth init failed");
		return -1;
	}
	ipss_init();
	ipss_advertise();
#endif

#if defined(CONFIG_NET_L2_IEEE802154)
	if (ieee802154_sample_setup()) {
		NET_ERR("IEEE 802.15.4 setup failed");
		return;
	}
#endif

	k_thread_spawn(&thread_stack[0], STACKSIZE,
		       (k_thread_entry_t)receive,
		       NULL, NULL, NULL, K_PRIO_COOP(7), 0, 0);

	return 0;
}
```

## src/ipm.c
```c
/*
 * Copyright (c) 2017 IpTronix S.r.l.
 *
 * SPDX-License-Identifier: Apache-2.0
 */

#include <kernel.h>
#include <stdio.h>
#include <ipm.h>
#include <ipm/ipm_quark_se.h>
#include <sensor.h>
#include <zephyr.h>
#include <misc/printk.h>

#include <mqtt.h>

#include "mqtt.h"

#define STACKSIZE               2000

#define MAIN_FIBER_PRI          2

struct shield_sens {
	struct sensor_value BME280[3];
	struct sensor_value ADXL362[4];
	struct sensor_value ADXRS290[3];
	struct sensor_value SI1153[5];
};

QUARK_SE_IPM_DEFINE(ess_ipm, 0, QUARK_SE_IPM_INBOUND);

static char ipm_stack[STACKSIZE];
static char json[2048];
static struct shield_sens sensors;
static struct k_sem	sync_sem;
static char *mqtt_device_hid;
static char *mqtt_topic;

static void sensor_ipm_callback(void *context, uint32_t id, volatile void *data);
static void ipm_thread(void *arg1, void *arg2, void *arg3);
static int json_get(void);

int ipm_init(char *device_hid, char *topic)
{
	struct device *ipm;
	int ret;

	mqtt_device_hid = device_hid;
	mqtt_topic = topic;

	ipm = device_get_binding("ess_ipm");
	if (!ipm) {
		return -1;
	}

	ipm_register_callback(ipm, sensor_ipm_callback, NULL);

	ret = ipm_set_enabled(ipm, 1);
	if (ret) {
		return -1;
	}

	k_sem_init(&sync_sem, 0, 1);

	k_thread_spawn(ipm_stack, STACKSIZE, ipm_thread,
		       0, 0, 0, K_PRIO_COOP(MAIN_FIBER_PRI), 0, 0);

	return 0;
}

static void sensor_ipm_callback(void *context, uint32_t id,
		volatile void *data)
{
	volatile struct sensor_value *val = data;

	switch (id) {
	case SENSOR_CHAN_TEMP:
		/* resolution of 0.01 degrees Celsius */
		sensors.BME280[0].val1 = val->val1;
		sensors.BME280[0].val2 = val->val2;
		break;
	case SENSOR_CHAN_HUMIDITY:
		/* resolution of 0.01 percent */
		sensors.BME280[1].val1 = val->val1 / 1000;
		sensors.BME280[1].val2 = (val->val1 % 1000)*1000;
		break;
	case SENSOR_CHAN_PRESS:
		/* resolution of 0.1 Pa */
		sensors.BME280[2].val1 = (val->val1 * 10) + (val->val2 / 100000);
		sensors.BME280[2].val2 = (val->val2 % 100000) * 10;
		break;

	case SENSOR_CHAN_ACCEL_Y:
		sensors.ADXL362[0].val1 = -val->val1;
		sensors.ADXL362[0].val2 = -val->val2;
		break;
	case SENSOR_CHAN_ACCEL_X:
		sensors.ADXL362[1].val1 = val->val1;
		sensors.ADXL362[1].val2 = val->val2;
		break;
	case SENSOR_CHAN_ACCEL_Z:
		sensors.ADXL362[2].val1 = -val->val1;
		sensors.ADXL362[2].val2 = -val->val2;

		printk("ipm received, give sem\n");
		k_sem_give(&sync_sem);

		break;

	case SENSOR_CHAN_GYRO_X:
		sensors.ADXRS290[0].val1 = val->val1;
		sensors.ADXRS290[0].val2 = val->val2;
		break;
	case SENSOR_CHAN_GYRO_Y:
		sensors.ADXRS290[1].val1 = val->val1;
		sensors.ADXRS290[1].val2 = val->val2;
		break;

	case SENSOR_CHAN_GESTURE:
		sensors.SI1153[4].val1 = val->val1;
		break;
	default:
		break;
	}
}

static void ipm_thread(void *arg1, void *arg2, void *arg3)
{
	ARG_UNUSED(arg1);
	ARG_UNUSED(arg2);
	ARG_UNUSED(arg3);

	while (1) {
		if (k_sem_take(&sync_sem, K_FOREVER) == 0) {
			if (mqtt_status_get()==1) {
				json_get();
				printk("send mqtt\n%s\n",json);
				mqtt_send(mqtt_topic, json);
			}
		}
	}
}

#define abs(a) ((a)<0?-(a):(a))

int addvalue(char *string, struct sensor_value *value,char *trailer)
{
	int len = 0;

	if (value->val1 <0 || value->val2<0)
	{
		len += sprintf(string+len, "-");
	}
	len += sprintf(string+len, "%d.%06d%s",
			abs(value->val1), abs(value->val2), trailer);

	return len;
}

int json_get(void)
{
	int len = 0;

	len += sprintf(json+len, "{");
	len += sprintf(json+len, "\"_|deviceHid\":\"%s\",", mqtt_device_hid);

	len += sprintf(json+len, "\"f|Temperature\":\"");
	len += addvalue(json+len, &sensors.BME280[0],"\",");

	len += sprintf(json+len, "\"f|Humidity\":\"");
	len += addvalue(json+len, &sensors.BME280[1],"\",");

	len += sprintf(json+len, "\"f|Pressure\":\"");
	len += addvalue(json+len, &sensors.BME280[2],"\",");

	len += sprintf(json+len, "\"f3|AccelXYZ\":\"");
	len += addvalue(json+len, &sensors.ADXL362[0],"|");
	len += addvalue(json+len, &sensors.ADXL362[1],"|");
	len += addvalue(json+len, &sensors.ADXL362[2],"\",");

	len += sprintf(json+len, "\"f|AccelTemp\":\"");
	len += addvalue(json+len, &sensors.ADXL362[3],"\",");

	len += sprintf(json+len, "\"f2|GyroXY\":\"");
	len += addvalue(json+len, &sensors.ADXRS290[0],"|");
	len += addvalue(json+len, &sensors.ADXRS290[1],"\",");

	len += sprintf(json+len, "\"f|GyroTemp\":\"");
	len += addvalue(json+len, &sensors.ADXRS290[2],"\",");

	len += sprintf(json+len, "\"i|Ambient\":\"%d\",",
			sensors.SI1153[0].val1);
	len += sprintf(json+len, "\"i3|Proximity\":\"%d|%d|%d\",",
			sensors.SI1153[1].val1,
			sensors.SI1153[2].val1,
			sensors.SI1153[3].val1);

	len += sprintf(json+len, "\"i|Gesture\":\"%d\"", sensors.SI1153[4].val1);

	len += sprintf(json+len, "}");

	return 0;
}
```

## src/mqtt.c
```c
/*
 * Copyright (c) 2017 IpTronix S.r.l.
 *
 * SPDX-License-Identifier: Apache-2.0
 */

#include <zephyr.h>
#include <net/mqtt.h>

#include <net/net_context.h>

#include <misc/printk.h>
#include <string.h>
#include <errno.h>

#include "mqtt.h"

#define ZEPHYR_ADDR       "0.0.0.0"

#define APP_SLEEP_MSECS	  5000
#define APP_TX_RX_TIMEOUT  800
#define APP_CONNECT_TRIES	10

/**
 * @brief mqtt_client_ctx	Container of some structures used by the
 *				publisher app.
 */
struct mqtt_client_ctx {
	/**
	 * The connect message structure is only used during the connect
	 * stage. Developers must set some msg properties before calling the
	 * mqtt_tx_connect routine. See below.
	 */
	struct mqtt_connect_msg connect_msg;
	/**
	 * This is the message that will be received by the server
	 * (MQTT broker).
	 */
	struct mqtt_publish_msg pub_msg;

	/**
	 * This is the MQTT application context variable.
	 */
	struct mqtt_ctx mqtt_ctx;

	/**
	 * This variable will be passed to the connect callback, declared inside
	 * the mqtt context struct. If not used, it could be set to NULL.
	 */
	void *connect_data;

	/**
	 * This variable will be passed to the disconnect callback, declared
	 * inside the mqtt context struct. If not used, it could be set to NULL.
	 */
	void *disconnect_data;

	/**
	 * This variable will be passed to the publish_tx callback, declared
	 * inside the mqtt context struct. If not used, it could be set to NULL.
	 */
	void *publish_data;
};

/* This is the network context structure. */
static struct net_context *net_ctx;

/* The mqtt client struct */
static struct mqtt_client_ctx client_ctx;

/* Status of mqtt */
static int mqtt_status = 0;

/* This routine sets some basic properties for the network context variable */
static int network_setup(struct net_context **net_ctx, const char *local_addr,
			 const char *server_addr, u16_t server_port);

/* The signature of this routine must match the connect callback declared at
 * the mqtt.h header.
 */
static void connect_cb(struct mqtt_ctx *mqtt_ctx)
{
	struct mqtt_client_ctx *client_ctx;

	client_ctx = CONTAINER_OF(mqtt_ctx, struct mqtt_client_ctx, mqtt_ctx);

	printk("[%s:%d]", __func__, __LINE__);

	if (client_ctx->connect_data) {
		printk(" user_data: %s",
		       (const char *)client_ctx->connect_data);
	}

	printk("\n");

	mqtt_status = 1;
}

/* The signature of this routine must match the disconnect callback declared at
 * the mqtt.h header.
 */
static void disconnect_cb(struct mqtt_ctx *mqtt_ctx)
{
	struct mqtt_client_ctx *client_ctx;

	client_ctx = CONTAINER_OF(mqtt_ctx, struct mqtt_client_ctx, mqtt_ctx);

	printk("[%s:%d]", __func__, __LINE__);

	if (client_ctx->disconnect_data) {
		printk(" user_data: %s",
		       (const char *)client_ctx->disconnect_data);
	}

	printk("\n");

	mqtt_status = 0;
}

/**
 * The signature of this routine must match the publish_tx callback declared at
 * the mqtt.h header.
 *
 * NOTE: we have two callbacks for MQTT Publish related stuff:
 *	- publish_tx, for publishers
 *	- publish_rx, for subscribers
 *
 * Applications must keep a "message database" with pkt_id's. So far, this is
 * not implemented here. For example, if we receive a PUBREC message with an
 * unknown pkt_id, this routine must return an error, for example -EINVAL or
 * any negative value.
 */
static int publish_cb(struct mqtt_ctx *mqtt_ctx, u16_t pkt_id,
		      enum mqtt_packet type)
{
	struct mqtt_client_ctx *client_ctx;
	const char *str;
	int rc = 0;

	client_ctx = CONTAINER_OF(mqtt_ctx, struct mqtt_client_ctx, mqtt_ctx);

	switch (type) {
	case MQTT_PUBACK:
		str = "MQTT_PUBACK";
		break;
	case MQTT_PUBCOMP:
		str = "MQTT_PUBCOMP";
		break;
	case MQTT_PUBREC:
		str = "MQTT_PUBREC";
		break;
	default:
		rc = -EINVAL;
		str = "Invalid MQTT packet";
	}

	printk("[%s:%d] <%s> packet id: %u", __func__, __LINE__, str, pkt_id);

	if (client_ctx->publish_data) {
		printk(", user_data: %s",
		       (const char *)client_ctx->publish_data);
	}

	printk("\n");

	return rc;
}

/**
 * The signature of this routine must match the malformed callback declared at
 * the mqtt.h header.
 */
static void malformed_cb(struct mqtt_ctx *mqtt_ctx, u16_t pkt_type)
{
	printk("[%s:%d] pkt_type: %u\n", __func__, __LINE__, pkt_type);
}

/* In this routine we block until the connected variable is 1 */
static int try_to_connect(struct mqtt_client_ctx *client_ctx)
{

	int i = 0;

	while (i++ < APP_CONNECT_TRIES && !client_ctx->mqtt_ctx.connected) {
		int rc;

		rc = mqtt_tx_connect(&client_ctx->mqtt_ctx,
				&client_ctx->connect_msg);
		k_sleep(APP_SLEEP_MSECS);
		printk("try_to_connect:mqtt_tx_connect return %d connected %d\n",
				rc, client_ctx->mqtt_ctx.connected);
		if (rc != 0) {
			continue;
		}
	}

	if (client_ctx->mqtt_ctx.connected) {
		return 0;
	}

	return -EINVAL;
}

int mqtt_pub_init(void *arg)
{
	struct mqtt_client_prm *client_prm = (struct mqtt_client_prm *)arg;
	int rc;

	printk("mqtt_pub_init\n");
	/* The net_ctx variable must be ready BEFORE passing it to the MQTT API.
	 */
	rc = network_setup(&net_ctx, ZEPHYR_ADDR,
			(const char *)client_prm->server_addr, client_prm->server_port);
	printk("network_setup return %d\n", rc);
	if (rc != 0) {
		goto exit_app;
	}

	/* Set everything to 0 and later just assign the required fields. */
	memset(&client_ctx, 0x00, sizeof(client_ctx));

	/* The network context is the only field that must be set BEFORE
	 * calling the mqtt_init routine.
	 */
	client_ctx.mqtt_ctx.net_ctx = net_ctx;

	/* connect, disconnect and malformed may be set to NULL */
	client_ctx.mqtt_ctx.connect    = connect_cb;
	client_ctx.mqtt_ctx.disconnect = disconnect_cb;
	client_ctx.mqtt_ctx.malformed  = malformed_cb;

	client_ctx.mqtt_ctx.net_timeout = APP_TX_RX_TIMEOUT;

	/* Publisher apps TX the MQTT PUBLISH msg */
	client_ctx.mqtt_ctx.publish_tx = publish_cb;

	rc = mqtt_init(&client_ctx.mqtt_ctx, MQTT_APP_PUBLISHER);
	printk("mqtt_init return %d\n", rc);
	if (rc != 0) {
		goto exit_app;
	}

	/* The connect message will be sent to the MQTT server (broker).
	 * If clean_session here is 0, the mqtt_ctx clean_session variable
	 * will be set to 0 also. Please don't do that, set always to 1.
	 * Clean session = 0 is not yet supported.
	 */
	client_ctx.connect_msg.clean_session = 1;
	client_ctx.connect_msg.client_id     = client_prm->client_id;
	client_ctx.connect_msg.client_id_len = strlen(client_prm->client_id);

	client_ctx.connect_msg.keep_alive     = 5;

	client_ctx.connect_msg.user_name      = client_prm->user_id;
	client_ctx.connect_msg.user_name_len  = strlen(client_prm->user_id);
	client_ctx.connect_msg.password       = client_prm->password;
	client_ctx.connect_msg.password_len   = strlen(client_prm->password);

	client_ctx.connect_data    = "CONNECTED";
	client_ctx.disconnect_data = "DISCONNECTED";
	client_ctx.publish_data    = "PUBLISH";

	rc = try_to_connect(&client_ctx);
	printk("mqttInit:try_to_connect return %d\n", rc);
	if (rc != 0) {
		goto exit_app;
	}

	return 0;

exit_app:
	printk("\nmqttInit:Error!\n");
	return -1;
}

/**
 */
int mqtt_status_get(void)
{
	return mqtt_status;
}

/**
 *
 */
int mqtt_send(char *topic, char *payload)
{
  struct mqtt_publish_msg *pub_msg = &client_ctx.pub_msg;
  int rc;

  rc = mqtt_tx_pingreq(&client_ctx.mqtt_ctx);
  if (rc) {
    printk("mqttSend:mqtt_tx_pingreq ERROR %d status = %d\n", rc, mqtt_status);
    return rc;
  }

  /* MQTT Quality of Service */
  pub_msg->qos = MQTT_QoS0;// TODO add global var or define

  pub_msg->retain = 0;

  /* Packet Identifier, always use different values */
  pub_msg->pkt_id = sys_rand32_get();

  /* Message's topic */
  pub_msg->topic = topic;
  pub_msg->topic_len = strlen(pub_msg->topic);

  /* MQTT message payload */
  pub_msg->msg = payload;
  pub_msg->msg_len = strlen(pub_msg->msg);

  rc = mqtt_tx_publish(&client_ctx.mqtt_ctx, &client_ctx.pub_msg);
  if (rc) {
    printk("mqtt_tx_publish ERROR %d\n", rc);
    return rc;
  }

  return 0;
}

static int set_addr(struct sockaddr *sock_addr, const char *addr, u16_t port)
{
	int rc;

	net_sin(sock_addr)->sin_port = htons(port);
	sock_addr->family = AF_INET;

	rc = net_addr_pton(AF_INET, addr, &(net_sin(sock_addr)->sin_addr));
	if (rc) {
		printk("Invalid IP address: %s\n", addr);
	}

	return rc;
}

static int network_setup(struct net_context **net_ctx, const char *local_addr,
			 const char *server_addr, u16_t server_port)
{
	socklen_t addr_len = sizeof(struct sockaddr_in);
	struct sockaddr server_sock, local_sock;
	int rc;
	int i;

	rc = set_addr(&local_sock, local_addr, 0);
	if (rc) {
		printk("set_addr (local) error\n");
		return rc;
	}

	rc = net_context_get(AF_INET, SOCK_STREAM, IPPROTO_TCP, net_ctx);
	if (rc) {
		printk("net_context_get error %d\n", rc);
		return rc;
	}

	rc = net_context_bind(*net_ctx, &local_sock, addr_len);
	if (rc) {
		printk("net_context_bind error %d\n", rc);
		goto lb_exit;
	}

	rc = set_addr(&server_sock, server_addr, server_port);
	if (rc) {
		printk("set_addr (server) error %d\n", rc);
		goto lb_exit;
	}

	for (i = 0; i < 4; i++) {
		rc = net_context_connect(*net_ctx, &server_sock, addr_len, NULL,
					 APP_SLEEP_MSECS, NULL);
		printk("net_context_connect return %d\n", rc);
		if (rc == 0) {
			break;
		}
	}
	if (i == 4) {
		printk("net_context_connect error %d.\n"
			   "Is the server (broker) up and running?\n", rc);
		goto lb_exit;
	}

	return 0;

lb_exit:
	net_context_put(*net_ctx);

	return rc;
}
```

## src/mqtt.h
```c
/*
 * Copyright (c) 2017 IpTronix S.r.l.
 *
 * SPDX-License-Identifier: Apache-2.0
 */

#ifndef SRC_MQTT_H_
#define SRC_MQTT_H_

#include <zephyr/types.h>

struct mqtt_client_prm {
	char *server_addr;
	u16_t server_port;
	char *device_hid;
	char *client_id;
	char *user_id;
	char *password;
	char *topic;
};

int mqtt_pub_init(void *arg);
int mqtt_status_get(void);
int mqtt_send(char *topic, char *payload);


#endif /* SRC_MQTT_H_ */
```

## src/sensors.c
```c
/*
 * sensors.c
 *
 *  Created on: Mar 7, 2017
 *      Author: max
 */


#include <zephyr.h>
#include <stdio.h>
#include <device.h>
#include <sensor.h>
#include <misc/printk.h>

#if 1
#define DBG_PRINT(...) printk(__VA_ARGS__)
#else
#define DBG_PRINT(...)
#endif

/**
 * shield A0 definition structure
 */
typedef struct {
	struct device *devBME280;
	struct device *devADXL362;
	struct device *devADXRS290;
	struct device *devSI1153;
}sShieldA0Def, *psShieldA0Def;

/**
 *
 */
typedef struct {
	struct sensor_value BME280[3];
	struct sensor_value ADXL362[4];
	struct sensor_value ADXRS290[3];
	struct sensor_value SI1153[4];
}sShieldA0Sens;

sShieldA0Def shieldA0Def;
sShieldA0Sens sensors;
/*

	/ * test of sensors on SHIELD0 board  * /

	DBG_PRINT("Initialize Shield A0\n");
	ret = shieldA0Init();
	if (ret) {
		DBG_PRINT("Initialize Shield A0 fail\n");
	} else {
		DBG_PRINT("Initialize Shield A0 OK\n");
	}

	DBG_PRINT("Get sensors\n");
	while (1) {
		shieldA0SensorGet();
		shieldA0SensorPrint();
		k_sleep(MSEC_PER_SEC);
	}


*/

/**
 *
 */
int shieldA0Init(void)
{
	shieldA0Def.devBME280 = device_get_binding("BME280");
	if(!shieldA0Def.devBME280){
		DBG_PRINT("ERROR getting device BME280\n");
	}else{
		DBG_PRINT("dev %p name %s\n", shieldA0Def.devBME280, shieldA0Def.devBME280->config->name);
	}

	shieldA0Def.devADXL362 = device_get_binding("ADXL362");
	if(!shieldA0Def.devADXL362){
		DBG_PRINT("ERROR getting device ADXL362\n");
	}else{
		DBG_PRINT("dev %p name %s\n", shieldA0Def.devADXL362, shieldA0Def.devADXL362->config->name);
	}

	shieldA0Def.devADXRS290 = device_get_binding("ADXRS290");
	if(!shieldA0Def.devADXRS290){
		DBG_PRINT("ERROR getting device ADXRS290\n");
	}else{
		DBG_PRINT("dev %p name %s\n", shieldA0Def.devADXRS290, shieldA0Def.devADXRS290->config->name);
	}

	shieldA0Def.devSI1153 = device_get_binding("SI1153");
	if(!shieldA0Def.devSI1153){
		DBG_PRINT("ERROR getting device SI1153\n");
	}else{
		DBG_PRINT("dev %p name %s\n", shieldA0Def.devSI1153, shieldA0Def.devSI1153->config->name);
	}

	return 0;
}

int shieldA0SensorGet(void)
{
	if(shieldA0Def.devBME280){
		sensor_sample_fetch(shieldA0Def.devBME280);
		sensor_channel_get(shieldA0Def.devBME280, SENSOR_CHAN_TEMP    , &sensors.BME280[0]);
		sensor_channel_get(shieldA0Def.devBME280, SENSOR_CHAN_PRESS   , &sensors.BME280[1]);
		sensor_channel_get(shieldA0Def.devBME280, SENSOR_CHAN_HUMIDITY, &sensors.BME280[2]);
	}
	if(shieldA0Def.devADXL362){
		sensor_sample_fetch(shieldA0Def.devADXL362);
		sensor_channel_get(shieldA0Def.devADXL362, SENSOR_CHAN_ACCEL_X, &sensors.ADXL362[0]);
		sensor_channel_get(shieldA0Def.devADXL362, SENSOR_CHAN_ACCEL_Y, &sensors.ADXL362[1]);
		sensor_channel_get(shieldA0Def.devADXL362, SENSOR_CHAN_ACCEL_Z, &sensors.ADXL362[2]);
		sensor_channel_get(shieldA0Def.devADXL362, SENSOR_CHAN_TEMP, &sensors.ADXL362[3]);
	}
	if(shieldA0Def.devADXRS290){
		sensor_sample_fetch(shieldA0Def.devADXRS290);
		sensor_channel_get(shieldA0Def.devADXRS290, SENSOR_CHAN_GYRO_X, &sensors.ADXRS290[0]);
		sensor_channel_get(shieldA0Def.devADXRS290, SENSOR_CHAN_GYRO_Y, &sensors.ADXRS290[1]);
		sensor_channel_get(shieldA0Def.devADXRS290, SENSOR_CHAN_TEMP, &sensors.ADXRS290[2]);
	}
	if(shieldA0Def.devSI1153){
		sensor_sample_fetch(shieldA0Def.devSI1153);
		sensor_channel_get(shieldA0Def.devSI1153, SENSOR_CHAN_LIGHT, &sensors.SI1153[0]);
		sensor_channel_get(shieldA0Def.devSI1153, SENSOR_CHAN_PROX, &sensors.SI1153[1]);
	}
	//shield0SensorJSON();
	//sens_send(&sensors);
	return 0;
}

void shieldA0SensorPrint(void)
{
	printk("BME280 temp: %d.%06d; press: %d.%06d; humidity: %d.%06d\n",
			sensors.BME280[0].val1, sensors.BME280[0].val2,
			sensors.BME280[1].val1, sensors.BME280[1].val2,
			sensors.BME280[2].val1, sensors.BME280[2].val2);
	printk("ADXL362 Accel X:%d.%06d Y:%d.%06d Z:%d.%06d T:%d.%06d \n",
			sensors.ADXL362[0].val1, sensors.ADXL362[0].val2,
			sensors.ADXL362[1].val1, sensors.ADXL362[1].val2,
			sensors.ADXL362[2].val1, sensors.ADXL362[2].val2,
			sensors.ADXL362[3].val1, sensors.ADXL362[3].val2);
	printk("ADXRS290 Gyro X:%d.%06d Y:%d.%06d T:%d.%06d\n",
			sensors.ADXRS290[0].val1, sensors.ADXRS290[0].val2,
			sensors.ADXRS290[1].val1, sensors.ADXRS290[1].val2,
			sensors.ADXRS290[2].val1, sensors.ADXRS290[2].val2);
	printk("SI1153 amb:%d, prox1:%d, prox2:%d, prox3:%d\n",
			sensors.SI1153[0].val1, sensors.SI1153[1].val1, sensors.SI1153[2].val1, sensors.SI1153[3].val1);
}
```

## src/wifi.c
```c
/*
 * Copyright (c) 2017 IpTronix S.r.l.
 *
 * SPDX-License-Identifier: Apache-2.0
 */

#include <stdint.h>
#include <string.h>
#include <stddef.h>
#include <errno.h>
#include <zephyr.h>
#include <device.h>
#include <gpio.h>
#include <misc/printk.h>
#include <board.h>

#include <net/net_if.h>
#include <net/net_mgmt.h>
#include <net/wifi_mgmt.h>

#include "wifi.h"

static struct net_mgmt_event_callback mgmt_cb;
static wifi_cb_t wifi_cb;
static void *wifi_arg;

/**
 * called after wifi connetcion is done
 */
static void handler(struct net_mgmt_event_callback *cb,
		    uint32_t mgmt_event,
		    struct net_if *iface)
{
	int ret;

	if (mgmt_event != NET_EVENT_IPV4_ADDR_ADD) {
		return;
	}
	if (wifi_cb) {
		printk("wifi: run callback function\n");
		ret = wifi_cb(wifi_arg);
		if (ret) {
			printk("wifi: callback function error %d\n", ret);
		}
	}
}

int wifi_init(struct wifi_conn_params *conn_params, wifi_cb_t cb, void* arg)
{
	struct net_if *iface;
	struct wifi_req_params req = {
		.ap_name = conn_params->ap_name,
		.password = conn_params->password,
		.security = conn_params->security,
	};
	int ret;

	printk("wifi_init\n");

	iface = net_if_get_default();
	if (!iface) {
		printk("wifi:ERROR getting iface\n");
		return -1;
	}

	wifi_cb  = cb;
	wifi_arg = arg;

	printk("wifi init net mgmt event callback\n");
	net_mgmt_init_event_callback(&mgmt_cb, handler, NET_EVENT_IPV4_ADDR_ADD);
	net_mgmt_add_event_callback(&mgmt_cb);

	ret = net_mgmt(NET_REQUEST_WIFI_CMD_AP_CONNECT, iface,
			&req, sizeof(req));
	if(ret){
		printk("wifi connect request return error (%d)\n", ret);
	}else{
		printk("wifi connect request OK\n");
	}

	return 0;
}
```

## src/wifi.h
```c
/*
 * Copyright (c) 2017 IpTronix S.r.l.
 *
 * SPDX-License-Identifier: Apache-2.0
 */

#ifndef __WIFI_H
#define __WIFI_H

typedef int (*wifi_cb_t)(void*);

struct wifi_conn_params {
	char *ap_name;
	char *password;
	int   security;
};

int wifi_init(struct wifi_conn_params *conn_params, wifi_cb_t cb, void *arg);

#endif /* __WIFI_H */
```
