## prj.conf
```kconfig
# nothing here


# ISSM_CONFIGURATION
# Enable OS Awareness
CONFIG_DEBUG_TRACING_KERNEL_OBJECTS=y
CONFIG_THREAD_MONITOR=y
CONFIG_GDB_INFO=y

# Configure platform

CONFIG_STDOUT_CONSOLE=y
CONFIG_PRINTK=y
CONFIG_IPM=y
CONFIG_IPM_QUARK_SE=y
CONFIG_IPM_CONSOLE_SENDER=y
CONFIG_CONSOLE=y
CONFIG_SERIAL=n

# Configure platform
CONFIG_PINMUX=y
CONFIG_PINMUX_DEV=y
CONFIG_PINMUX_QMSI=y
CONFIG_PINMUX_DEV_QMSI=y

CONFIG_GPIO=y
CONFIG_SENSOR=y
CONFIG_I2C=y
CONFIG_SPI=y
CONFIG_SPI_QMSI=n
CONFIG_GPIO_QMSI=n

CONFIG_BME280=y
CONFIG_BME280_DEV_TYPE_SPI=y
CONFIG_BME280_SPI_DEV_NAME="SPI_0"
CONFIG_BME280_SPI_DEV_SLAVE=2

CONFIG_ADXL362=y
CONFIG_ADXL362_SPI_DEV_NAME="SPI_0"
CONFIG_ADXL362_SPI_DEV_SLAVE=1

CONFIG_ADXRS290=y
CONFIG_ADXRS290_SPI_DEV_NAME="SPI_0"
CONFIG_ADXRS290_SPI_DEV_SLAVE=4

CONFIG_SI1153=y
CONFIG_SI1153_OWN_THREAD=y
CONFIG_SI1153_THREAD_PRIORITY=10
CONFIG_SI1153_THREAD_STACK_SIZE=1024
```

## src/main.c
```c
/*
 * Copyright (c) 2016 Intel Corporation
 *
 * SPDX-License-Identifier: Apache-2.0
 */

#include <device.h>
#include <ipm.h>
#include <ipm/ipm_quark_se.h>
#include <misc/printk.h>
#include <misc/util.h>
#include <sensor.h>
#include <zephyr.h>

QUARK_SE_IPM_DEFINE(ess_ipm, 0, QUARK_SE_IPM_OUTBOUND);

struct channel_info {
	char               *dev_name;
	struct device      *dev;
	int                 chan;
	struct sensor_value val;
	int                 id;
};

static struct channel_info info[] = {

#ifdef CONFIG_BME280
	{"BME280", NULL, SENSOR_CHAN_TEMP    , {0, 0}, SENSOR_CHAN_TEMP},
	{"BME280", NULL, SENSOR_CHAN_HUMIDITY, {0, 0}, SENSOR_CHAN_HUMIDITY},
	{"BME280", NULL, SENSOR_CHAN_PRESS   , {0, 0}, SENSOR_CHAN_PRESS},
#endif

#ifdef CONFIG_ADXL362
	{"ADXL362", NULL, SENSOR_CHAN_ACCEL_X, {0, 0}, SENSOR_CHAN_ACCEL_X},
	{"ADXL362", NULL, SENSOR_CHAN_ACCEL_Y, {0, 0}, SENSOR_CHAN_ACCEL_Y},
	{"ADXL362", NULL, SENSOR_CHAN_ACCEL_Z, {0, 0}, SENSOR_CHAN_ACCEL_Z},
#endif

#ifdef CONFIG_ADXRS290
	{"ADXRS290", NULL, SENSOR_CHAN_GYRO_X, {0, 0}, SENSOR_CHAN_GYRO_X},
	{"ADXRS290", NULL, SENSOR_CHAN_GYRO_Y, {0, 0}, SENSOR_CHAN_GYRO_Y},
#endif

#ifdef CONFIG_SI1153
	{"SI1153", NULL, SENSOR_CHAN_GESTURE, {0, 0}, SENSOR_CHAN_GESTURE},
#endif

};

void main(void)
{
	struct device *ipm;
	struct device *old;
	unsigned int i;
	int rc;

	ipm = device_get_binding("ess_ipm");
	if (ipm == NULL) {
		printk("Failed to get ESS IPM device\n");
		return;
	}

	for (i = 0; i < ARRAY_SIZE(info); i++) {
		info[i].dev = device_get_binding(info[i].dev_name);
		if (info[i].dev == NULL) {
			printk("Failed to get \"%s\" device\n", info[i].dev_name);
		}
	}

	while (1) {

		/* fetch sensor samples */
		old = NULL;
		for (i = 0; i < ARRAY_SIZE(info); i++) {
			if (info[i].dev) {
				if(info[i].dev != old){
					rc = sensor_sample_fetch(info[i].dev);
					if (rc) {
						printk("Failed to fetch sample for device %s (%d)\n",
							   info[i].dev_name, rc);
					}
					old = info[i].dev;
				}
			}
		}

		/* get sensor data and send to x86 core via IPM */
		for (i = 0; i < ARRAY_SIZE(info); i++) {
			if (info[i].dev) {
				/* get sensor channel */
				rc = sensor_channel_get(info[i].dev, info[i].chan, &info[i].val);
				if (rc) {
					printk("Failed to get data for device %s (%d)\n",
						   info[i].dev_name, rc);
					continue;
				}

				/* send sensor value to quark via ipm */
				rc = ipm_send(ipm, 1, info[i].id,
						&info[i].val, sizeof(info[i].val));
				if (rc) {
					printk("Failed to send data for device %s (%d)\n",
						   info[i].dev_name, rc);
				}
			}
		}
		k_sleep(K_MSEC(300));
	}
}
```
