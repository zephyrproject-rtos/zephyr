## CMakeLists.txt
```
# Copyright (c) 2020 Intel Corporation
# SPDX-License-Identifier: Apache-2.0

cmake_minimum_required(VERSION 3.8.2)

find_package(Zephyr REQUIRED HINTS $ENV{ZEPHYR_BASE})

project(wamr-simple)

target_sources(app PRIVATE src/main.c)
```

## prj.conf
```kconfig
CONFIG_SPI=y
CONFIG_SPI_STM32=y
CONFIG_PRINTK=y
CONFIG_LOG=y
CONFIG_UART_INTERRUPT_DRIVEN=y
CONFIG_STACK_SENTINEL=y
CONFIG_MAIN_STACK_SIZE=2048
CONFIG_WAMR=y
CONFIG_WAMR_INTERP=y
CONFIG_WAMR_AOT=y
CONFIG_WAMR_APP_FRAMEWORK=y
```

## src/main.c
```c
/*
 * Copyright (c) 2020 Intel Corporation
 *
 * SPDX-License-Identifier: Apache-2.0
 */

#include <stdlib.h>
#include <string.h>
#include "bh_platform.h"
#include "wasm_export.h"

int iwasm_main(void);

void main(void)
{
	iwasm_main();
	for (;;) {
		k_sleep(Z_TIMEOUT_MS(1000));
	}
}
```

## src/board_config.h
```c
/*
 * Copyright (c) 2020 Intel Corporation
 *
 * SPDX-License-Identifier: Apache-2.0
 */

#ifndef __BOARD_CONFIG_H__
#define __BOARD_CONFIG_H__
#include "pin_config_stm32.h"
#endif /* __BOARD_CONFIG_H__ */
```

## src/ext_lib_export.c
```c
/*
 * Copyright (C) 2019 Intel Corporation.  All rights reserved.
 *
 * Licensed under the Apache License, Version 2.0 (the "License");
 * you may not use this file except in compliance with the License.
 * You may obtain a copy of the License at
 *
 *      http://www.apache.org/licenses/LICENSE-2.0
 *
 * Unless required by applicable law or agreed to in writing, software
 * distributed under the License is distributed on an "AS IS" BASIS,
 * WITHOUT WARRANTIES OR CONDITIONS OF ANY KIND, either express or implied.
 * See the License for the specific language governing permissions and
 * limitations under the License.
 */

#include "lib_export.h"

static NativeSymbol extended_native_symbol_defs[] = { };

#include "ext_lib_export.h"
```

## src/iwasm_main.c
```c
/*
 * Copyright (c) 2020 Intel Corporation
 *
 * SPDX-License-Identifier: Apache-2.0
 */

#include "bh_platform.h"
#include "wasm_export.h"
#include "app_manager_export.h"
#include "runtime_lib.h"
#include "board_config.h"

#include <zephyr.h>
#include <drivers/uart.h>
#include <device.h>

extern void init_sensor_framework(void);
extern void exit_sensor_framework(void);
extern int aee_host_msg_callback(void *msg, uint16_t msg_len);

static int uart_char_cnt;

struct device *uart_dev;

static void uart_irq_callback(struct device *dev)
{
	unsigned char ch;

	while (uart_poll_in(dev, &ch) == 0) {
		uart_char_cnt++;
		aee_host_msg_callback(&ch, 1);
	}
}

static bool host_init(void)
{
	uart_dev = device_get_binding(HOST_DEVICE_COMM_UART_NAME);
	if (!uart_dev) {
		printf("UART: Device driver not found.\n");
		return false;
	}
	uart_irq_rx_enable(uart_dev);
	uart_irq_callback_set(uart_dev, uart_irq_callback);
	return true;
}

int host_send(void *ctx, const char *buf, int size)
{
	if (!uart_dev)
		return 0;

	for (int i = 0; i < size; i++)
		uart_poll_out(uart_dev, buf[i]);

	return size;
}

void host_destroy(void)
{
}

static host_interface interface = {
	.init = host_init,
	.send = host_send,
	.destroy = host_destroy
};

static char global_heap_buf[240 * 1024] = { 0 };

int iwasm_main(void)
{
	RuntimeInitArgs init_args;

	host_init();

	memset(&init_args, 0, sizeof(RuntimeInitArgs));
	init_args.mem_alloc_type = Alloc_With_Pool;
	init_args.mem_alloc_option.pool.heap_buf = global_heap_buf;
	init_args.mem_alloc_option.pool.heap_size = sizeof(global_heap_buf);

	/* initialize runtime environment */
	if (!wasm_runtime_full_init(&init_args)) {
		printf("Init runtime environment failed.\n");
		return -1;
	}

	init_wasm_timer();

	app_manager_startup(&interface);

	wasm_runtime_destroy();
	return -1;
}
```
