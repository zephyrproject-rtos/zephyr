## samples/grove/temperature/sample.yaml
```yaml
sample:
  name: Grove Temperature Sensor
tests:
  test:
    min_flash: 33
    platform_whitelist: arduino_101_sss quark_d2000_crb
      arduino_due
    tags: drivers sensor grove temperature
    harness: grove
    depends_on: adc
```

## samples/gui/lvgl/boards/mimxrt1060_evk.conf
```kconfig
#
# Copyright (c) 2019, NXP
#
# SPDX-License-Identifier: Apache-2.0
#

CONFIG_LVGL_DISPLAY_DEV_NAME="ELCDIF_1"
CONFIG_LVGL_HOR_RES=480
CONFIG_LVGL_VER_RES=272
CONFIG_LVGL_VDB_SIZE=16
CONFIG_LVGL_DPI=128
CONFIG_LVGL_BITS_PER_PIXEL=0
CONFIG_LVGL_COLOR_DEPTH_16=y

CONFIG_DISPLAY_LOG_LEVEL_DBG=y
```

## samples/gui/lvgl/boards/native_posix_64.conf
```kconfig
CONFIG_SDL_DISPLAY=y
CONFIG_SDL_DISPLAY_DEV_NAME="DISPLAY"
CONFIG_SDL_DISPLAY_X_RES=320
CONFIG_SDL_DISPLAY_Y_RES=240
```

## samples/gui/lvgl/boards/nrf52840_pca10056.conf
```kconfig
CONFIG_SPI=y
CONFIG_SPI_1=y
CONFIG_SPI_NRFX=y

CONFIG_ILI9340=y

CONFIG_LVGL_BITS_PER_PIXEL=24
```

## samples/gui/lvgl/boards/reel_board.conf
```kconfig
CONFIG_SPI=y
CONFIG_SSD16XX=y

CONFIG_LVGL_COLOR_DEPTH_1=y
CONFIG_LVGL_BITS_PER_PIXEL=1
CONFIG_LVGL_HOR_RES=250
CONFIG_LVGL_VER_RES=120
CONFIG_LVGL_DPI=130
CONFIG_LVGL_VDB_SIZE=16
```

## samples/gui/lvgl/sample.yaml
```yaml
sample:
  description: LVGL sample application
  name: lvgl
tests:
  sample.gui.lvgl:
    harness: display
    platform_whitelist: reel_board mimxrt1050_evk mimxrt1060_evk
    tags: samples display gui
  sample.display.adafruit_2_8_tft_touch_v2:
    platform_whitelist: nrf52840_pca10056
    extra_args: SHIELD=adafruit_2_8_tft_touch_v2
    tags: shield
  sample.display.waveshare_epaper_gdeh0213b1:
    platform_whitelist: nrf52840_pca10056
    extra_args: SHIELD=waveshare_epaper_gdeh0213b1
    tags: shield
  sample.display.waveshare_epaper_gdeh0213b72:
    platform_whitelist: nrf52840_pca10056
    extra_args: SHIELD=waveshare_epaper_gdeh0213b72
    tags: shield
  sample.display.waveshare_epaper_gdeh029a1:
    platform_whitelist: nrf52840_pca10056
    extra_args: SHIELD=waveshare_epaper_gdeh029a1
    tags: shield
```

## samples/hello_world/Kconfig
```kconfig
config IMAGE_NAME
	string "Image name"
	default "Default"

source "Kconfig.zephyr"
```

## samples/hello_world/boards/qemu_cortex_m0.conf
```kconfig
# Make this as small an example as possible
CONFIG_MULTITHREADING=n
CONFIG_NRF_TIMER_TIMER=n
```

## samples/hello_world/boards/qemu_riscv32e.conf
```kconfig
# Make this as small an example as possible
CONFIG_MULTITHREADING=n
CONFIG_RISCV_PMP=n
```

## samples/hello_world/sample.yaml
```yaml
sample:
  description: Hello World sample, the simplest Zephyr
    application
  name: hello world
common:
  min_ram: 2
  min_flash: 16
  tags: introduction
  integration_platforms:
    - native_sim
    - mini_stm32h7b0
  harness: console
  harness_config:
    type: one_line
    regex:
      - "Hello World! (.*)"
tests:
  sample.basic.helloworld:
    tags: introduction
```

## samples/kernel/bootargs/sample.yaml
```yaml
sample:
  name: Bootargs Sample
tests:
  sample.kernel.bootargs.multiboot:
    extra_args: EXTRA_CONF_FILE=prj_multiboot.conf
    platform_allow:
      - qemu_x86
      - qemu_x86_64
    harness: console
    harness_config:
      type: one_line
      regex:
        - "argv\\[0\\] = .*/zephyr(-qemu-locore)?.elf"
  sample.kernel.bootargs.efi:
    extra_args: EXTRA_CONF_FILE=prj_efi.conf
    platform_allow: qemu_x86_64
    harness: console
    harness_config:
      type: one_line
      regex:
        - "argv\\[0\\] = run.efi"
  sample.kernel.bootargs.tokenization:
    extra_configs:
      - CONFIG_BOOTARGS_STRING="appname arg1 'arg2.1 arg2.2' arg3"
    harness: console
    harness_config:
      type: multi_line
      regex:
        - "argv\\[0\\] = appname"
        - "argv\\[1\\] = arg1"
        - "argv\\[2\\] = arg2.1 arg2.2"
        - "argv\\[3\\] = arg3"
```

## samples/kernel/condition_variables/condvar/sample.yaml
```yaml
tests:
  sample.kernel.cond_var:
    platform_key:
      - arch
    integration_platforms:
      - native_sim
    tags:
      - kernel
      - condition_variables
    harness: console
    harness_config:
      type: one_line
      regex:
        - ".*Waited and joined with 3 threads"
```

## samples/kernel/condition_variables/simple/sample.yaml
```yaml
tests:
  sample.kernel.cond_var.simple:
    integration_platforms:
      - native_posix
    tags: kernel condition_variables
    harness: console
    harness_config:
      type: one_line
      regex:
        - ".*done == 20 so everyone is done"
```

## samples/kernel/cycle64/sample.yaml
```yaml
sample:
  description: k_cycle_get_64() example
  name: cycle64
common:
  integration_platforms:
    - native_posix_64
    - qemu_riscv
    - qemu_riscv64
  tags: kernel
  harness: console
  harness_config:
    type: one_line
    regex:
      - "SUCCESS"
tests:
    sample.kernel.cycle64:
        filter: CONFIG_TIMER_HAS_64BIT_CYCLE_COUNTER
```

## samples/kernel/metairq_dispatch/sample.yaml
```yaml
sample:
  description: Sample demonstrating dispatch of hardware events from a
    MetaIRQ thread
  name: MetaIRQ Dispatch
common:
  tags:
    - kernel
  integration_platforms:
    - mps2_an385
    - qemu_x86
  harness: console
  harness_config:
    type: one_line
    regex:
      - "MetaIRQ Test Complete"

# Note that native_posix architectures are filtered, they require
# instrumentation (e.g. a k_busy_wait()) inside the worker threads
# "busy" loops in order for the interrupts to fire on time, and the
# sample is designed to demonstrate completely arbitrary CPU work.
tests:
  sample.kernel.metairq_dispatch:
    arch_exclude:
      - posix
```

## samples/kernel/msg_queue/sample.yaml
```yaml
sample:
  description: Message queue demo sample
  name: message queue
common:
  tags:
    - message_queue
tests:
  sample.kernel.msgqueue:
    integration_platforms:
      - native_sim
    harness: console
    harness_config:
      type: one_line
      regex:
        - ".*CBA012345"
```

## samples/kernel/workq/sample.yaml
```yaml
sample:
  description: workq demo
  name: workq demo
common:
  tags:
    - workq
tests:
  sample.kernel.workq:
    integration_platforms:
      - native_sim
```

## samples/lib/pixel/distort/sample.yaml
```yaml
sample:
  description: Pixel Distort sample, correct fish-eye deformation of an image
  name: pixel distort
common:
  min_ram: 32
  tags: pixel
  integration_platforms:
    - native_sim
  harness: console
  harness_config:
    type: one_line
    regex:
      - "output image, distorted,"
      - "output image, corrected,"
tests:
  sample.pixel.distort:
    tags: pixel
    extra_configs:
      - CONFIG_PIXEL_PRINT_NONE=y
```

## samples/lib/pixel/image/sample.yaml
```yaml
sample:
  description: Pixel image sample, image manipulation library
  name: pixel image
common:
  min_ram: 32
  tags: pixel
  integration_platforms:
    - native_sim
  harness: console
  harness_config:
    type: one_line
    regex:
      - "input image, 32x8, 768 bytes:"
      - "output image, 120x40, 14400 bytes:"
tests:
  sample.pixel.image:
    tags: pixel
    extra_configs:
      - CONFIG_PIXEL_PRINT_NONE=y
```

## samples/lib/pixel/print/sample.yaml
```yaml
sample:
  description: Pixel Print sample, print images in the terminal for debug purpose
  name: pixel print
common:
  min_ram: 32
  tags: pixel
  integration_platforms:
    - native_sim
  harness: console
  harness_config:
    type: one_line
    regex:
      - "truecolor:"
      - "256color:"
      - "hexdump:"
      - "histogram"
tests:
  sample.pixel.print:
    tags: pixel
    extra_configs:
      - CONFIG_PIXEL_PRINT_NONE=y
```

## samples/lib/pixel/resize/sample.yaml
```yaml
sample:
  description: Pixel Resize sample, down-scale/up-scale an image
  name: pixel resize
common:
  min_ram: 32
  tags: pixel
  integration_platforms:
    - native_sim
  harness: console
  harness_config:
    type: one_line
    regex:
      - "output image, bigger,"
      - "output image, smaller,"
tests:
  sample.pixel.resize:
    tags: pixel
```

## samples/lib/pixel/stats/sample.yaml
```yaml
sample:
  description: Pixel Stats sample, collect statistics of an input buffer
  name: pixel stats
common:
  min_ram: 32
  tags: pixel
  integration_platforms:
    - native_sim
  harness: console
  harness_config:
    type: one_line
    regex:
      - "RGB histogram of the image"
      - "RGB channel averages of the image"
tests:
  sample.pixel.stats:
    tags: pixel
    extra_configs:
      - CONFIG_PIXEL_PRINT_NONE=y
```

## samples/lib/pixel/stream/sample.yaml
```yaml
sample:
  description: Pixel Stream sample, convert a stream of lines from a frame
  name: pixel stream
common:
  min_ram: 32
  tags: pixel
  integration_platforms:
    - native_sim
  harness: console
  harness_config:
    type: one_line
    regex:
      - "Output image preview:"
tests:
  sample.lib.pixel.stream:
    tags: pixel
```

## samples/matrix-multiply-fpu/sample.yaml
```yaml
sample:
  description: Matrix Multiplication sample, the simplest Zephyr
    application
  name: Matrix Multiplication
common:
    tags: introduction
    integration_platforms:
      - native_posix
    harness: console
    harness_config:
      type: few lines
      regex:
        - "(.*)"
tests:
  sample.basic.matrix-multiply:
    tags: introduction
```

## samples/memory/sram_regions/sample.yaml
```yaml
sample:
  description: SRAM MPU sample application
  name: sram_mpu
tests:
  sample.memory.sram_regions:
    platform_allow: mps2_an385
    tags: sample board sram mpu
    build_only: true
```
