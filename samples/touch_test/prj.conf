## CMakeLists.txt
```
# SPDX-License-Identifier: Apache-2.0

cmake_minimum_required(VERSION 3.20.0)

find_package(Zephyr REQUIRED HINTS $ENV{ZEPHYR_BASE})
project(touch_test)

target_sources(app PRIVATE src/main.c src/cst816s.c)
if(CONFIG_XIP)
    zephyr_code_relocate(src/main.c ROM_TEXT NOCOPY)
    zephyr_code_relocate(src/main.c ROM_DATA)
    zephyr_code_relocate(src/main.c ROM_BSS)
endif()
```

## prj.conf
```kconfig
# CONFIG_LV_Z_MEM_POOL_SIZE=16384
CONFIG_LV_Z_MEM_POOL_SIZE=100000
CONFIG_MAIN_STACK_SIZE=2048

# CONFIG_DISPLAY=y
# CONFIG_DISPLAY_LOG_LEVEL_ERR=y

# CONFIG_LOG=y

# CONFIG_LVGL=y
# CONFIG_LV_MEM_CUSTOM=y
# CONFIG_LV_USE_LOG=y
# CONFIG_LV_USE_LABEL=y
# CONFIG_LV_USE_BTN=y
# CONFIG_LV_USE_IMG=y
# CONFIG_LV_FONT_MONTSERRAT_14=y

CONFIG_GC9X01X=y
CONFIG_MULTITHREADING=y

CONFIG_I2C_SECURE_IOT=y

CONFIG_SYS_CLOCK_HW_CYCLES_PER_SEC=156250
CONFIG_SYS_CLOCK_TICKS_PER_SEC=10000

CONFIG_I2C=y
# CONFIG_SHAKTI_PLIC=y

# CONFIG_GEN_ISR_TABLES=y
# CONFIG_GEN_SW_ISR_TABLE=y
# CONFIG_PLIC=y
# CONFIG_TIMESLICING=y
# CONFIG_TIMESLICE_SIZE=1
# CONFIG_TIMESLICE_PRIORITY=0
```

## src/main.c
```c
/*
 * Copyright (c) 2012-2014 Wind River Systems, Inc.
 *
 * SPDX-License-Identifier: Apache-2.0
 */

#include <stdio.h>
#include<zephyr/device.h>
#include<zephyr/devicetree.h>
#include"cst816s.h"
#include <zephyr/irq.h>
#include <zephyr/drivers/gpio.h>
data_struct data;
uint8_t data_arr[8];
const struct device *dev =  DEVICE_DT_GET(DT_NODELABEL(i2c0));
const struct device *dev1 =  DEVICE_DT_GET(DT_NODELABEL(gpio0));
bool is_first = true;
cst816s_t touch_dev_handle;

K_MSGQ_DEFINE(touch_msg_q, sizeof(data_struct), 10, 1);
data_struct data_send;
void touch_isr(void);
void thread1(void)
{



data_struct data_recv;
CST816S_init(&touch_dev_handle,dev1,dev,5,6,data_arr);
// CST816S_begin(&touch_dev_handle);// 
// /* Enabling intterupts*/
IRQ_CONNECT(32, 1, touch_isr, NULL, NULL);
irq_enable(32);
gpio_pin_configure(dev1, 0, 0);
gpio_pin_interrupt_configure(dev1, 0, 1);
plic_irq_enable(32);
while (1)
{
		printf("Running main thread\n");
		k_msgq_get(&touch_msg_q, &data_recv, K_FOREVER);
		printk("Gesture ID:%d\n",data_recv.gestureID);
	}
}

void touch_isr(void)
{
    printf("Touch detected\n");
    data_send = CST816S_read_touch(&touch_dev_handle);
	if(data_send.gestureID != 0)
    k_msgq_put(&touch_msg_q, &data_send, K_NO_WAIT);
}






// while(1){
 
// //  printf("gesture code:%d\nX:%d\nY:%d\n",data.gestureID,data.x,data.y);
// //  if(data.gestureID==3) printf("Swipe left\n");
// //  else if(data.gestureID==4) printf("Swipe right\n");
// //  else if(data.gestureID==1) printf("Swipe up\n");
// //  else if(data.gestureID==2) printf("Swipe down\n");
 
// }

K_THREAD_DEFINE(thread1_id, 1024, thread1, NULL, NULL, NULL,
		7, 0, 0);
```

## src/cst816s.c
```c
#include "cst816s.h"

void CST816S_init(cst816s_t *handle,const struct device *gpio_dev,const struct device *i2c_dev,uint8_t rst,uint8_t irq,uint8_t *data)
{
    handle->rst.pin = rst;
    handle->irq.pin = irq;
    handle->i2c_dev = i2c_dev;
    handle->rst.port = gpio_dev;
    handle->irq.port = gpio_dev;
    gpio_pin_configure(gpio_dev,rst,GPIO_OUTPUT);
    gpio_pin_configure(gpio_dev,irq,GPIO_INPUT);
    handle->data_arr = data;
}

data_struct CST816S_begin(cst816s_t *handle)
{
/*implementation without interrupt*/
/*Have to set irq pin as input for interrupt*/
/*rst pin by default configured as output*/

 gpio_pin_set_dt(&handle->rst, 1);
  k_msleep(50);
  gpio_pin_set_dt(&handle->rst, 0);
  k_msleep(5);
  gpio_pin_set_dt(&handle->rst, 1 );
  k_msleep(50);
  data_struct data;
  CST816S_read(handle,CST816S_ADDRESS, 0x15, &data.version, 1);
  k_msleep(5);
  CST816S_read(handle,CST816S_ADDRESS, 0xA7, data.versionInfo, 3);
  return data;

}
uint8_t CST816S_read(cst816s_t *handle,uint16_t addr, uint8_t reg_addr, uint8_t *reg_data, uint32_t length)
{
    uint8_t msg_arr[1];
	struct i2c_msg msg_obj;
	msg_obj.buf = msg_arr; 
	msg_obj.len = 1;
	for(uint8_t i=0;i<length;i++){
      msg_arr[0] = reg_addr+i;
	  msg_obj.flags = I2C_MSG_WRITE;
	  i2c_transfer(handle->i2c_dev,&msg_obj,1,addr);
      msg_obj.flags = I2C_MSG_READ;
	  i2c_transfer(handle->i2c_dev,&msg_obj,1,addr);
	  reg_data[i] = msg_arr[0];
    }
  return 0;
}
uint8_t CST816S_write(cst816s_t *handle,uint8_t addr, uint8_t reg_addr, const uint8_t *reg_data, uint32_t length)
{
      uint8_t msg_arr[10];
	  struct i2c_msg msg_obj;
	  msg_obj.buf = msg_arr;
	  msg_obj.len = length;
      msg_arr[0] = reg_addr;
      for(uint8_t i=1;i<=length;i++){
        msg_arr[i] = reg_data[i];
      }
	  msg_obj.flags = I2C_MSG_WRITE;
	  i2c_transfer(handle->i2c_dev,&msg_obj,1,addr);
  return 0;
}

data_struct CST816S_read_touch(cst816s_t *handle) {
  uint8_t *data_raw = handle->data_arr;
  CST816S_read(handle,CST816S_ADDRESS, 0x01, data_raw, 6);
  data_struct data;
  // printf("Data: %x\n %x\n %x\n %x\n %x\n %x\n",data_raw[0],data_raw[1],data_raw[2],data_raw[3],data_raw[4],data_raw[5]);
  data.gestureID = data_raw[0];
  data.points = data_raw[1];
  data.event = data_raw[2] >> 6;
  data.x = ((data_raw[2] & 0xF) << 8) + data_raw[3];
  data.y = ((data_raw[4] & 0xF) << 8) + data_raw[5];
  return data;
}

void CST816S_sleep(cst816s_t *handle) {
  gpio_pin_set_dt(&handle->rst, 0);
  k_msleep(5);
  gpio_pin_set_dt(&handle->rst, 1 );
  k_msleep(50);
  uint8_t standby_value = 0x03;
  CST816S_write(handle->i2c_dev,CST816S_ADDRESS, 0xA5, &standby_value, 1);
}
```

## src/summa.c
```c
#include <zephyr/kernel.h>

#include <zephyr/sys/printk.h>

#include <zephyr/device.h>

#include <zephyr/drivers/gpio.h>

#include <zephyr/logging/log.h>

// 2 diody na threadach, button->intterupt set0



#define LED1_NODE DT_NODELABEL(led4)

#define LED2_NODE DT_NODELABEL(led5)

#define BUTTON_NODE DT_NODELABEL(button1)

#define BUTTON_NODE_2 DT_NODELABEL(button2)



#define SLEEP_TIME_MS 1000

#define STACKSIZE 1024

#define PRIORITY 5




#if !DT_NODE_HAS_STATUS(BUTTON_NODE, okay)

#error "Unsupported board: sw0 devicetree alias is not defined"

#endif




LOG_MODULE_REGISTER(Fist_Exercise,LOG_LEVEL_DBG);

K_TIMER_DEFINE(debounce_timer, NULL, NULL);



K_THREAD_STACK_DEFINE(thread_led1_stack,STACKSIZE);

K_THREAD_STACK_DEFINE(thread_led2_stack,STACKSIZE);




int toggler;

int counter=0;



static struct k_thread thread_led1;

static struct k_thread thread_led2;




static const struct gpio_dt_spec button = GPIO_DT_SPEC_GET_OR(BUTTON_NODE,gpios,{0});

static struct gpio_callback button_cb_data;



static const struct gpio_dt_spec button_2 = GPIO_DT_SPEC_GET_OR(BUTTON_NODE_2,gpios,{0});

static struct gpio_callback button_cb_data_2;



struct led {

 struct gpio_dt_spec spec;

};

static const struct led led0 ={

 .spec = GPIO_DT_SPEC_GET(LED1_NODE, gpios),

};

static const struct led led1 ={

 .spec = GPIO_DT_SPEC_GET(LED2_NODE, gpios),

};




void button_pressed(const struct device *dev, struct gpio_callback*cb){



 if (k_timer_status_get(&debounce_timer) > 0) {

 // Timer is running, this means a button press was recently handled

 // Ignore the new button press

 return;

 }

 toggler++;



 LOG_INF("Toggler count %d \n", toggler);



 k_timer_start(&debounce_timer, K_MSEC(100), K_NO_WAIT); //

}

void button_pressed_2(const struct device *dev, struct gpio_callback*cb){




 LOG_INF("Counter %d \n",counter);

 counter++;



}

void blink( const struct led *led, int sleep){

 if (!device_is_ready(button.port)) {

 printk("Error: button device %s is not ready\n",

 button.port->name);

 return;

 }



 



 const struct gpio_dt_spec *spec = &led->spec;



 gpio_pin_configure_dt(spec, GPIO_OUTPUT);

 

 while(1){

 if(toggler%2==0){

 gpio_pin_toggle(spec->port, spec->pin);

 k_msleep(sleep);

 }

 else{

 LOG_INF("TOGGLER IS NOR PARITY\n");

 }

 

 }

}



void blink0(void){

 blink(&led0, SLEEP_TIME_MS);

}

void blink1(void){

 blink(&led1, SLEEP_TIME_MS);

}

void main(void){

 gpio_pin_configure_dt(&button, GPIO_INPUT);



 gpio_pin_interrupt_configure_dt(&button,

 GPIO_INT_EDGE_RISING);



 gpio_init_callback(&button_cb_data, button_pressed,BIT(button.pin));



 gpio_add_callback(button.port, &button_cb_data);



 gpio_pin_configure_dt(&button_2, GPIO_INPUT);



 gpio_pin_interrupt_configure_dt(&button_2,

 GPIO_INT_EDGE_RISING);



 gpio_init_callback(&button_cb_data_2, button_pressed_2,BIT(button_2.pin));



 gpio_add_callback(button_2.port, &button_cb_data_2);

 k_timer_init(&debounce_timer, NULL, NULL);



 k_thread_create(&thread_led1, thread_led1_stack,

 K_THREAD_STACK_SIZEOF(thread_led1_stack),

 blink0, NULL, NULL, NULL,

 PRIORITY, 0, K_FOREVER);



 k_thread_name_set(&thread_led1, "thread_led1");



 k_thread_create(&thread_led2, thread_led2_stack,

 K_THREAD_STACK_SIZEOF(thread_led2_stack),

 blink1, NULL, NULL, NULL,

 PRIORITY, 0, K_FOREVER);



 k_thread_name_set(&thread_led1, "thread_led1");



 k_thread_start(&thread_led1);

 // k_thread_start(&thread_led2);



 

}
```
