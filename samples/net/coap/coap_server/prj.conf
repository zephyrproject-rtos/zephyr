## Kconfig
```
# Copyright (c) 2023, Emna Rekik
# Copyright (c) 2025, Basalte bv
# SPDX-License-Identifier: Apache-2.0

# Config options for CoAP server sample application

mainmenu "CoAP server sample application"

config NET_SAMPLE_COAPS_SERVICE
	bool "Enable CoAP secure service"
	depends on NET_SOCKETS_ENABLE_DTLS || TLS_CREDENTIALS

config NET_SAMPLE_COAP_SERVER_SERVICE_PORT
	int "Port number for CoAP service"
	default 5684 if NET_SAMPLE_COAPS_SERVICE
	default 5683

if NET_SAMPLE_COAPS_SERVICE

config NET_SAMPLE_PSK_HEADER_FILE
	string "Header file containing PSK"
	default "dummy_psk.h"
	depends on MBEDTLS_KEY_EXCHANGE_PSK_ENABLED
	help
	  Name of a header file containing a pre-shared key.

config NET_SAMPLE_CERTS_WITH_SC
	bool "Signed Certificates"
	depends on NET_SOCKETS_SOCKOPT_TLS
	help
	  Enable this flag, if you are interested to run this
	  application with certificates.

endif

source "Kconfig.zephyr"
```

## sample.yaml
```
common:
  harness: net
  tags:
    - net
    - socket
  filter: CONFIG_FULL_LIBC_SUPPORTED and not CONFIG_NATIVE_LIBC
sample:
  description: BSD Sockets API CoAP server example
  name: socket_coap_server
tests:
  sample.net.sockets.coap_server:
    platform_allow:
      - native_sim
      - qemu_x86
  sample.net.sockets.coaps_server:
    harness: net
    extra_args: EXTRA_CONF_FILE="overlay-dtls.conf"
    tags:
      - net
      - socket
      - tls
    platform_allow:
      - native_sim
      - qemu_x86
  sample.net.sockets.coap_server.wifi.nrf70dk:
    extra_args:
      - SNIPPET=wifi-ipv4
      - CONFIG_BUILD_ONLY_NO_BLOBS=y
    platform_allow:
      - nrf7002dk/nrf5340/cpuapp
  sample.net.sockets.coap_server.802154.subg:
    extra_args: EXTRA_CONF_FILE="overlay-802154-subg.conf"
    platform_allow: beagleconnect_freedom
  sample.net.sockets.coap_server.oscore:
    harness: net
    extra_args: EXTRA_CONF_FILE="overlay-oscore.conf"
    tags:
      - net
      - socket
      - oscore
    platform_allow:
      - native_sim
      - qemu_x86
  sample.net.sockets.coap_server.oscore.ipv4:
    harness: net
    extra_args: EXTRA_CONF_FILE="overlay-oscore-ipv4.conf"
    tags:
      - net
      - socket
      - oscore
    platform_allow:
      - native_sim
      - qemu_x86
```

## prj.conf
```kconfig
# Generic networking options
CONFIG_NETWORKING=y
CONFIG_REQUIRES_FULL_LIBC=y
CONFIG_NET_UDP=y

# Socket
CONFIG_NET_SOCKETS=y
CONFIG_POSIX_API=y
CONFIG_ZVFS_POLL_MAX=10

# CoAP
CONFIG_COAP=y
CONFIG_COAP_SERVER=y
CONFIG_COAP_SERVER_WELL_KNOWN_CORE=y
CONFIG_COAP_WELL_KNOWN_BLOCK_WISE=n
CONFIG_COAP_EXTENDED_OPTIONS_LEN=y
CONFIG_COAP_EXTENDED_OPTIONS_LEN_VALUE=40

# Kernel options
CONFIG_ENTROPY_GENERATOR=y
CONFIG_TEST_RANDOM_GENERATOR=y

# Logging
CONFIG_PRINTK=y
CONFIG_NET_LOG=y

# Network Shell
CONFIG_NET_SHELL=y
CONFIG_COAP_SERVER_SHELL=y

# Configuration
CONFIG_NET_CONFIG_SETTINGS=y

# Events
CONFIG_NET_MGMT=y
CONFIG_NET_MGMT_EVENT=y
CONFIG_NET_MGMT_EVENT_INFO=y

# Enable only one protocol, if you enable both sources
# won't compile.
# IPv6 Support
CONFIG_NET_IPV6=n
CONFIG_NET_CONFIG_NEED_IPV6=n
CONFIG_NET_CONFIG_MY_IPV6_ADDR="2001:db8::1"
CONFIG_NET_IF_MCAST_IPV6_ADDR_COUNT=5

#IPv4 Support
CONFIG_NET_IPV4=y
CONFIG_NET_CONFIG_NEED_IPV4=y
CONFIG_NET_CONFIG_MY_IPV4_ADDR="192.0.2.1"

# Enable v4-mapped-on-v6
CONFIG_NET_IPV4_MAPPING_TO_IPV6=y
```

## overlay-oscore-ipv4.conf
```kconfig
# OSCORE Support with IPv4
CONFIG_COAP_OSCORE=y
CONFIG_UOSCORE=y
CONFIG_PSA_CRYPTO=y
CONFIG_PSA_WANT_ALG_CCM=y
CONFIG_PSA_WANT_ALG_HKDF=y
CONFIG_PSA_WANT_ALG_SHA_256=y
CONFIG_PSA_WANT_KEY_TYPE_AES=y
CONFIG_PSA_WANT_KEY_TYPE_HMAC=y
CONFIG_PSA_WANT_KEY_TYPE_RAW_DATA=y
CONFIG_MBEDTLS_PSA_CRYPTO_C=y

# ZCBOR for OSCORE
CONFIG_ZCBOR=y
CONFIG_ZCBOR_CANONICAL=y

# Enhanced logging for debugging
CONFIG_LOG=y
CONFIG_COAP_LOG_LEVEL_DBG=y
CONFIG_NET_LOG=y

# Increase heap for OSCORE
CONFIG_HEAP_MEM_POOL_SIZE=8192

# OSCORE Configuration
CONFIG_COAP_OSCORE_MAX_PLAINTEXT_LEN=1024
CONFIG_COAP_OSCORE_EXCHANGE_CACHE_SIZE=8
CONFIG_COAP_OSCORE_EXCHANGE_LIFETIME_MS=60000

# Increase network buffer sizes for OSCORE
CONFIG_NET_BUF_DATA_SIZE=256
CONFIG_NET_PKT_RX_COUNT=16
CONFIG_NET_PKT_TX_COUNT=16
CONFIG_NET_BUF_RX_COUNT=32
CONFIG_NET_BUF_TX_COUNT=32

# More stack for OSCORE operations
CONFIG_MAIN_STACK_SIZE=4096
CONFIG_NET_TX_STACK_SIZE=2048
CONFIG_NET_RX_STACK_SIZE=2048

# IPv4 Configuration (disable IPv6)
CONFIG_NET_IPV6=n
CONFIG_NET_CONFIG_NEED_IPV6=n
CONFIG_NET_IPV4=y
CONFIG_NET_CONFIG_NEED_IPV4=y
CONFIG_NET_CONFIG_MY_IPV4_ADDR="192.0.2.1"
```

## overlay-oscore.conf
```kconfig
# OSCORE Support
CONFIG_COAP_OSCORE=y
CONFIG_UOSCORE=y
CONFIG_PSA_CRYPTO=y
CONFIG_PSA_WANT_ALG_CCM=y
CONFIG_PSA_WANT_ALG_HKDF=y
CONFIG_PSA_WANT_ALG_SHA_256=y
CONFIG_PSA_WANT_KEY_TYPE_AES=y
CONFIG_PSA_WANT_KEY_TYPE_HMAC=y
CONFIG_PSA_WANT_KEY_TYPE_RAW_DATA=y
CONFIG_MBEDTLS_PSA_CRYPTO_C=y

# ZCBOR for OSCORE
CONFIG_ZCBOR=y
CONFIG_ZCBOR_CANONICAL=y

# Enhanced logging for debugging
CONFIG_LOG=y
CONFIG_COAP_LOG_LEVEL_DBG=y
CONFIG_NET_LOG=y

# Increase heap for OSCORE
CONFIG_HEAP_MEM_POOL_SIZE=8192

# OSCORE Configuration
CONFIG_COAP_OSCORE_MAX_PLAINTEXT_LEN=1024
CONFIG_COAP_OSCORE_EXCHANGE_CACHE_SIZE=8
CONFIG_COAP_OSCORE_EXCHANGE_LIFETIME_MS=60000

# Increase network buffer sizes for OSCORE
CONFIG_NET_BUF_DATA_SIZE=256
CONFIG_NET_PKT_RX_COUNT=16
CONFIG_NET_PKT_TX_COUNT=16
CONFIG_NET_BUF_RX_COUNT=32
CONFIG_NET_BUF_TX_COUNT=32

# More stack for OSCORE operations
CONFIG_MAIN_STACK_SIZE=4096
CONFIG_NET_TX_STACK_SIZE=2048
CONFIG_NET_RX_STACK_SIZE=2048

# Disable deferred logging to avoid stack overflow in logging thread
# The uOSCORE library functions use ~3.3KB of stack, which causes
# issues when log messages are processed in the separate logging thread
CONFIG_LOG_MODE_DEFERRED=n
CONFIG_LOG_MODE_IMMEDIATE=y
```

## src/main.c
```c
/*
 * Copyright (c) 2023 Basalte bv
 *
 * SPDX-License-Identifier: Apache-2.0
 */

#include <zephyr/logging/log.h>
LOG_MODULE_REGISTER(net_coap_service_sample, LOG_LEVEL_DBG);

#include <zephyr/net/coap_service.h>

#include "net_sample_common.h"

#if defined(CONFIG_COAP_OSCORE)
#include <oscore.h>
#include <oscore/security_context.h>
#include <psa/crypto.h>
#endif

#ifdef CONFIG_NET_IPV6
#include <zephyr/net/mld.h>

#include "net_private.h"
#include "ipv6.h"
#endif

static uint16_t coap_port = CONFIG_NET_SAMPLE_COAP_SERVER_SERVICE_PORT;

#if defined(CONFIG_COAP_OSCORE)
/* OSCORE context - matches libcoap configuration */
static struct context oscore_ctx;

/* Master secret (shared with client) */
static const uint8_t master_secret[] = {
	0x01, 0x02, 0x03, 0x04, 0x05, 0x06, 0x07, 0x08,
	0x09, 0x0a, 0x0b, 0x0c, 0x0d, 0x0e, 0x0f, 0x10
};

/* Master salt (optional, shared with client) */
static const uint8_t master_salt[] = {
	0x9e, 0x7c, 0xa9, 0x22, 0x23, 0x78, 0x63, 0x40
};

/* Sender ID (this device is the server) */
static const uint8_t sender_id[] = "server";

/* Recipient ID (remote peer is the client) */
static const uint8_t recipient_id[] = "client";

COAP_SERVICE_DEFINE(coap_server, NULL, &coap_port, COAP_SERVICE_AUTOSTART);
#else

#ifndef CONFIG_NET_SAMPLE_COAPS_SERVICE

COAP_SERVICE_DEFINE(coap_server, NULL, &coap_port, COAP_SERVICE_AUTOSTART);

#else /* CONFIG_NET_SAMPLE_COAPS_SERVICE */

#include "certificate.h"

static const sec_tag_t sec_tag_list_verify_none[] = {
		SERVER_CERTIFICATE_TAG,
#if defined(CONFIG_MBEDTLS_KEY_EXCHANGE_PSK_ENABLED)
		PSK_TAG,
#endif
};

COAPS_SERVICE_DEFINE(coap_server, NULL, &coap_port, 0,
		     sec_tag_list_verify_none, sizeof(sec_tag_list_verify_none));

#endif /* CONFIG_NET_SAMPLE_COAPS_SERVICE */
#endif /* CONFIG_COAP_OSCORE */

static int setup_dtls(void)
{
#if defined(CONFIG_NET_SAMPLE_COAPS_SERVICE)
#if defined(CONFIG_NET_SOCKETS_ENABLE_DTLS)
	int err;

#if defined(CONFIG_NET_SAMPLE_CERTS_WITH_SC)
	err = tls_credential_add(SERVER_CERTIFICATE_TAG,
				 TLS_CREDENTIAL_CA_CERTIFICATE,
				 ca_certificate,
				 sizeof(ca_certificate));
	if (err < 0) {
		LOG_ERR("Failed to register CA certificate: %d", err);
		return err;
	}
#endif /* defined(CONFIG_NET_SAMPLE_CERTS_WITH_SC) */

	err = tls_credential_add(SERVER_CERTIFICATE_TAG,
				 TLS_CREDENTIAL_SERVER_CERTIFICATE,
				 server_certificate,
				 sizeof(server_certificate));
	if (err < 0) {
		LOG_ERR("Failed to register public certificate: %d", err);
		return err;
	}

	err = tls_credential_add(SERVER_CERTIFICATE_TAG,
				 TLS_CREDENTIAL_PRIVATE_KEY,
				 private_key, sizeof(private_key));
	if (err < 0) {
		LOG_ERR("Failed to register private key: %d", err);
		return err;
	}

#if defined(CONFIG_MBEDTLS_KEY_EXCHANGE_PSK_ENABLED)
	err = tls_credential_add(PSK_TAG,
				 TLS_CREDENTIAL_PSK,
				 psk,
				 sizeof(psk));
	if (err < 0) {
		LOG_ERR("Failed to register PSK: %d", err);
		return err;
	}

	err = tls_credential_add(PSK_TAG,
				 TLS_CREDENTIAL_PSK_ID,
				 psk_id,
				 sizeof(psk_id) - 1);
	if (err < 0) {
		LOG_ERR("Failed to register PSK ID: %d", err);
		return err;
	}

#endif /* defined(CONFIG_MBEDTLS_KEY_EXCHANGE_PSK_ENABLED) */
#endif /* defined(CONFIG_NET_SOCKETS_ENABLE_DTLS) */
#endif /* defined(CONFIG_NET_SAMPLE_COAPS_SERVICE) */
	return 0;
}

#if !defined(CONFIG_NET_SAMPLE_COAPS_SERVICE) && defined(CONFIG_NET_IPV6)

#define ALL_NODES_LOCAL_COAP_MCAST \
	{ { { 0xff, 0x02, 0, 0, 0, 0, 0, 0, 0, 0, 0, 0, 0, 0, 0, 0xfd } } }

#define MY_IP6ADDR \
	{ { { 0x20, 0x01, 0x0d, 0xb8, 0, 0, 0, 0, 0, 0, 0, 0, 0, 0, 0, 0x1 } } }

static int join_coap_multicast_group(uint16_t port)
{
	static struct in6_addr my_addr = MY_IP6ADDR;
	struct sockaddr_in6 mcast_addr = {
		.sin6_family = AF_INET6,
		.sin6_addr = ALL_NODES_LOCAL_COAP_MCAST,
		.sin6_port = htons(port) };
	struct net_if_addr *ifaddr;
	struct net_if *iface;
	int ret;

	iface = net_if_get_default();
	if (!iface) {
		LOG_ERR("Could not get the default interface");
		return -ENOENT;
	}

#if defined(CONFIG_NET_CONFIG_SETTINGS)
	if (net_addr_pton(AF_INET6,
			  CONFIG_NET_CONFIG_MY_IPV6_ADDR,
			  &my_addr) < 0) {
		LOG_ERR("Invalid IPv6 address %s",
			CONFIG_NET_CONFIG_MY_IPV6_ADDR);
	}
#endif

	ifaddr = net_if_ipv6_addr_add(iface, &my_addr, NET_ADDR_MANUAL, 0);
	if (!ifaddr) {
		LOG_ERR("Could not add unicast address to interface");
		return -EINVAL;
	}

	ifaddr->addr_state = NET_ADDR_PREFERRED;

	ret = net_ipv6_mld_join(iface, &mcast_addr.sin6_addr);
	if (ret < 0) {
		LOG_ERR("Cannot join %s IPv6 multicast group (%d)",
			net_sprint_ipv6_addr(&mcast_addr.sin6_addr), ret);
		return ret;
	}

	return 0;
}

#endif /* CONFIG_NET_IPV6 */

static int setup_oscore(void)
{
#if defined(CONFIG_COAP_OSCORE)
	psa_status_t psa_status;
	
	/* Initialize PSA Crypto */
	LOG_DBG("Initializing PSA Crypto");
	psa_status = psa_crypto_init();
	if (psa_status != PSA_SUCCESS) {
		LOG_ERR("PSA Crypto initialization failed: %d", psa_status);
		return -ENODEV;
	}
	LOG_DBG("PSA Crypto initialized");

	struct oscore_init_params params = {
		.master_secret.ptr = (uint8_t *)master_secret,
		.master_secret.len = sizeof(master_secret),
		.sender_id.ptr = (uint8_t *)sender_id,
		.sender_id.len = sizeof(sender_id) - 1, /* Exclude null terminator */
		.recipient_id.ptr = (uint8_t *)recipient_id,
		.recipient_id.len = sizeof(recipient_id) - 1, /* Exclude null terminator */
		.id_context.ptr = NULL,  /* No ID context */
		.id_context.len = 0,
		.master_salt.ptr = (uint8_t *)master_salt,
		.master_salt.len = sizeof(master_salt),
		.aead_alg = OSCORE_AES_CCM_16_64_128,
		.hkdf = OSCORE_SHA_256,
		.fresh_master_secret_salt = true,  /* Fixed test keys, OK to reset SSN on reboot */
	};

	LOG_DBG("Initializing OSCORE context");
	LOG_DBG("  master_secret: %p, len: %d", (void *)params.master_secret.ptr, params.master_secret.len);
	LOG_DBG("  sender_id: %p, len: %d", (void *)params.sender_id.ptr, params.sender_id.len);
	LOG_DBG("  recipient_id: %p, len: %d", (void *)params.recipient_id.ptr, params.recipient_id.len);
	LOG_DBG("  master_salt: %p, len: %d", (void *)params.master_salt.ptr, params.master_salt.len);
	
	int ret = oscore_context_init(&params, &oscore_ctx);
	if (ret != 0) {
		LOG_ERR("Failed to initialize OSCORE context: %d (%s)", ret, 
			ret == -ENOMEM ? "Out of memory" :
			ret == -EINVAL ? "Invalid parameter" :
			ret == -ENOTSUP ? "Not supported" :
			ret == -ENOENT ? "Not found" :
			ret == -ENOSPC ? "No space (check heap/PSA key slots)" :
			"Unknown error");
		return ret;
	}

	/* Attach OSCORE context to the service */
	coap_server.data->oscore_ctx = &oscore_ctx;
	coap_server.data->require_oscore = true; /* Require OSCORE for all requests */

	LOG_INF("OSCORE enabled (server/client, AES-CCM-16-64-128)");
	LOG_DBG("  Sender ID: %s", sender_id);
	LOG_DBG("  Recipient ID: %s", recipient_id);
	LOG_DBG("  Master secret: %d bytes, Master salt: %d bytes", 
		sizeof(master_secret), sizeof(master_salt));
#endif /* CONFIG_COAP_OSCORE */
	return 0;
}

int main(void)
{
	int ret;

	wait_for_network();

	ret = setup_oscore();
	if (ret < 0) {
		LOG_ERR("Failed to setup OSCORE (%d)", ret);
		return ret;
	}

	ret = setup_dtls();
	if (ret < 0) {
		LOG_ERR("Failed to setup DTLS (%d)", ret);
		return ret;
	}

#if !defined(CONFIG_NET_SAMPLE_COAPS_SERVICE) && defined(CONFIG_NET_IPV6)
	ret = join_coap_multicast_group(coap_port);
	if (ret < 0) {
		LOG_ERR("Failed to join CoAP all-nodes multicast (%d)", ret);
		return ret;
	}
#endif

#ifdef CONFIG_NET_SAMPLE_COAPS_SERVICE
	/* CoAP secure server has to be started manually after DTLS setup */
	ret = coap_service_start(&coap_server);
	if (ret < 0) {
		LOG_ERR("Failed to start CoAP secure server (%d)", ret);
		return ret;
	}
#endif

	return ret;
}
```

## src/core.c
```c
/*
 * Copyright (c) 2018 Intel Corporation
 * Copyright (c) 2023 Basalte bv
 *
 * SPDX-License-Identifier: Apache-2.0
 */

#include <zephyr/logging/log.h>
LOG_MODULE_DECLARE(net_coap_service_sample);

#include <zephyr/sys/printk.h>
#include <zephyr/net/coap_service.h>
#include <zephyr/net/coap_link_format.h>

static int core_get(struct coap_resource *resource,
		    struct coap_packet *request,
		    struct sockaddr *addr, socklen_t addr_len)
{
	static const char dummy_str[] = "Just a test\n";
	uint8_t data[CONFIG_COAP_SERVER_MESSAGE_SIZE];
	struct coap_packet response;
	uint8_t token[COAP_TOKEN_MAX_LEN];
	uint16_t id;
	uint8_t tkl;
	uint8_t type;
	bool suppress = false;
	int r;

	id = coap_header_get_id(request);
	tkl = coap_header_get_token(request, token);
	type = coap_header_get_type(request);

	/* Check if response should be suppressed per RFC 7967 */
	r = coap_no_response_check(request, COAP_RESPONSE_CODE_CONTENT, &suppress);
	if (r < 0 && r != -ENOENT) {
		/* Invalid No-Response option - do not suppress */
		suppress = false;
	}

	if (suppress) {
		/* Response suppressed, but send empty ACK for CON requests */
		if (type == COAP_TYPE_CON) {
			r = coap_packet_init(&response, data, sizeof(data),
					     COAP_VERSION_1, COAP_TYPE_ACK, tkl, token,
					     COAP_CODE_EMPTY, id);
			if (r < 0) {
				return r;
			}

			r = coap_resource_send(resource, &response, addr, addr_len, NULL);
		}
		/* For NON requests, send nothing */
		return 0;
	}

	/* Response not suppressed, send normal response */
	r = coap_packet_init(&response, data, sizeof(data),
			     COAP_VERSION_1, COAP_TYPE_ACK, tkl, token,
			     COAP_RESPONSE_CODE_CONTENT, id);
	if (r < 0) {
		return r;
	}

	r = coap_packet_append_payload_marker(&response);
	if (r < 0) {
		return r;
	}

	r = coap_packet_append_payload(&response, (uint8_t *)dummy_str,
				       sizeof(dummy_str));
	if (r < 0) {
		return r;
	}

	r = coap_resource_send(resource, &response, addr, addr_len, NULL);

	return r;
}

static const char * const core_1_path[] = { "core1", NULL };
static const char * const core_1_attributes[] = {
	"title=\"Core 1\"",
	"rt=core1",
	NULL,
};
COAP_RESOURCE_DEFINE(core_1, coap_server,
{
	.get = core_get,
	.path = core_1_path,
	.user_data = &((struct coap_core_metadata) {
		.attributes = core_1_attributes,
	}),
});

static const char * const core_2_path[] = { "core2", NULL };
static const char * const core_2_attributes[] = {
	"title=\"Core 2\"",
	"rt=core2",
	NULL,
};
COAP_RESOURCE_DEFINE(core_2, coap_server,
{
	.get = core_get,
	.path = core_2_path,
	.user_data = &((struct coap_core_metadata) {
		.attributes = core_2_attributes,
	}),
});
```

## src/large.c
```c
/*
 * Copyright (c) 2018 Intel Corporation
 * Copyright (c) 2023 Basalte bv
 *
 * SPDX-License-Identifier: Apache-2.0
 */

#include <zephyr/logging/log.h>
LOG_MODULE_DECLARE(net_coap_service_sample);

#include <zephyr/sys/printk.h>
#include <zephyr/net/coap_service.h>

#define BLOCK_WISE_TRANSFER_SIZE_GET 2048

static int large_get(struct coap_resource *resource,
		     struct coap_packet *request,
		     struct sockaddr *addr, socklen_t addr_len)

{
	uint8_t data[CONFIG_COAP_SERVER_MESSAGE_SIZE];
	static struct coap_block_context ctx;
	struct coap_packet response;
	uint8_t payload[64];
	uint8_t token[COAP_TOKEN_MAX_LEN];
	uint16_t size;
	uint16_t id;
	uint8_t code;
	uint8_t type;
	uint8_t tkl;
	bool suppress = false;
	int r;

	if (ctx.total_size == 0) {
		coap_block_transfer_init(&ctx, COAP_BLOCK_64, BLOCK_WISE_TRANSFER_SIZE_GET);
	}

	r = coap_update_from_block(request, &ctx);
	if (r < 0) {
		return -EINVAL;
	}

	code = coap_header_get_code(request);
	type = coap_header_get_type(request);
	id = coap_header_get_id(request);
	tkl = coap_header_get_token(request, token);

	LOG_INF("*******");
	LOG_INF("type: %u code %u id %u", type, code, id);
	LOG_INF("*******");

	/* Check if response should be suppressed per RFC 7967 */
	r = coap_no_response_check(request, COAP_RESPONSE_CODE_CONTENT, &suppress);
	if (r < 0 && r != -ENOENT) {
		/* Invalid No-Response option - do not suppress */
		suppress = false;
	}

	if (suppress) {
		/* Response suppressed, but send empty ACK for CON requests */
		if (type == COAP_TYPE_CON) {
			r = coap_packet_init(&response, data, sizeof(data),
					     COAP_VERSION_1, COAP_TYPE_ACK, tkl, token,
					     COAP_CODE_EMPTY, id);
			if (r < 0) {
				return -EINVAL;
			}

			r = coap_resource_send(resource, &response, addr, addr_len, NULL);
		}
		/* For NON requests, send nothing */
		return 0;
	}

	/* Response not suppressed, send normal response */
	r = coap_packet_init(&response, data, sizeof(data),
			     COAP_VERSION_1, COAP_TYPE_ACK, tkl, token,
			     COAP_RESPONSE_CODE_CONTENT, id);
	if (r < 0) {
		return -EINVAL;
	}

	/* RFC 7959 §2.4 + RFC 9175 §3.8: Include ETag in Block2 responses.
	 * Use a stable ETag for this representation. If the representation changes,
	 * the ETag MUST also change (RFC 9175 §3.8).
	 * ETag option (4) must come before Content-Format (12) and Block2 (23).
	 */
	static const uint8_t etag_value[] = {0x01, 0x02, 0x03, 0x04};

	r = coap_packet_append_option(&response, COAP_OPTION_ETAG,
				      etag_value, sizeof(etag_value));
	if (r < 0) {
		return r;
	}

	r = coap_append_option_int(&response, COAP_OPTION_CONTENT_FORMAT,
				   COAP_CONTENT_FORMAT_TEXT_PLAIN);
	if (r < 0) {
		return r;
	}

	r = coap_append_block2_option(&response, &ctx);
	if (r < 0) {
		return r;
	}

	r = coap_packet_append_payload_marker(&response);
	if (r < 0) {
		return r;
	}

	size = MIN(coap_block_size_to_bytes(ctx.block_size),
		   ctx.total_size - ctx.current);

	memset(payload, 'A', MIN(size, sizeof(payload)));

	r = coap_packet_append_payload(&response, (uint8_t *)payload, size);
	if (r < 0) {
		return r;
	}

	r = coap_next_block(&response, &ctx);
	if (!r) {
		/* Will return 0 when it's the last block. */
		memset(&ctx, 0, sizeof(ctx));
	}

	r = coap_resource_send(resource, &response, addr, addr_len, NULL);

	return r;
}

static int large_update_put(struct coap_resource *resource,
			    struct coap_packet *request,
			    struct sockaddr *addr, socklen_t addr_len)
{
	uint8_t data[CONFIG_COAP_SERVER_MESSAGE_SIZE];
	static struct coap_block_context ctx;
	struct coap_packet response;
	const uint8_t *payload;
	uint8_t token[COAP_TOKEN_MAX_LEN];
	uint16_t id;
	uint16_t len;
	uint8_t code;
	uint8_t type;
	uint8_t tkl;
	int r;
	bool last_block;

	r = coap_get_option_int(request, COAP_OPTION_BLOCK1);
	if (r < 0) {
		return -EINVAL;
	}

	last_block = !GET_MORE(r);

	/* initialize block context upon the arrival of first block */
	if (!GET_BLOCK_NUM(r)) {
		coap_block_transfer_init(&ctx, COAP_BLOCK_64, 0);
	}

	r = coap_update_from_block(request, &ctx);
	if (r < 0) {
		LOG_ERR("Invalid block size option from request");
		return -EINVAL;
	}

	payload = coap_packet_get_payload(request, &len);
	if (!last_block && payload == NULL) {
		LOG_ERR("Packet without payload");
		return -EINVAL;
	}

	LOG_INF("**************");
	LOG_INF("[ctx] current %zu block_size %u total_size %zu",
		ctx.current, coap_block_size_to_bytes(ctx.block_size),
		ctx.total_size);
	LOG_INF("**************");

	code = coap_header_get_code(request);
	type = coap_header_get_type(request);
	id = coap_header_get_id(request);
	tkl = coap_header_get_token(request, token);

	LOG_INF("*******");
	LOG_INF("type: %u code %u id %u", type, code, id);
	LOG_INF("*******");

	/* Do something with the payload */

	if (!last_block) {
		code = COAP_RESPONSE_CODE_CONTINUE;
	} else {
		code = COAP_RESPONSE_CODE_CHANGED;
	}

	/* Check if response should be suppressed per RFC 7967 */
	bool suppress = false;

	r = coap_no_response_check(request, code, &suppress);
	if (r < 0 && r != -ENOENT) {
		/* Invalid No-Response option - do not suppress */
		suppress = false;
	}

	if (suppress) {
		/* Response suppressed, but send empty ACK for CON requests */
		if (type == COAP_TYPE_CON) {
			r = coap_packet_init(&response, data, sizeof(data),
					     COAP_VERSION_1, COAP_TYPE_ACK, tkl, token,
					     COAP_CODE_EMPTY, id);
			if (r < 0) {
				return r;
			}

			r = coap_resource_send(resource, &response, addr, addr_len, NULL);
		}
		/* For NON requests, send nothing */
		return 0;
	}

	/* Response not suppressed, send normal response */
	r = coap_ack_init(&response, request, data, sizeof(data), code);
	if (r < 0) {
		return r;
	}

	r = coap_append_block1_option(&response, &ctx);
	if (r < 0) {
		LOG_ERR("Could not add Block1 option to response");
		return r;
	}

	r = coap_resource_send(resource, &response, addr, addr_len, NULL);

	return r;
}

static int large_create_post(struct coap_resource *resource,
			     struct coap_packet *request,
			     struct sockaddr *addr, socklen_t addr_len)
{
	uint8_t data[CONFIG_COAP_SERVER_MESSAGE_SIZE];
	static struct coap_block_context ctx;
	struct coap_packet response;
	const uint8_t *payload;
	uint8_t token[COAP_TOKEN_MAX_LEN];
	uint16_t len;
	uint16_t id;
	uint8_t code;
	uint8_t type;
	uint8_t tkl;
	int r;
	bool last_block;

	r = coap_get_option_int(request, COAP_OPTION_BLOCK1);
	if (r < 0) {
		return -EINVAL;
	}

	last_block = !GET_MORE(r);

	/* initialize block context upon the arrival of first block */
	if (!GET_BLOCK_NUM(r)) {
		coap_block_transfer_init(&ctx, COAP_BLOCK_32, 0);
	}

	r = coap_update_from_block(request, &ctx);
	if (r < 0) {
		LOG_ERR("Invalid block size option from request");
		return -EINVAL;
	}

	payload = coap_packet_get_payload(request, &len);
	if (!last_block && payload) {
		LOG_ERR("Packet without payload");
		return -EINVAL;
	}

	code = coap_header_get_code(request);
	type = coap_header_get_type(request);
	id = coap_header_get_id(request);
	tkl = coap_header_get_token(request, token);

	LOG_INF("*******");
	LOG_INF("type: %u code %u id %u", type, code, id);
	LOG_INF("*******");

	if (!last_block) {
		code = COAP_RESPONSE_CODE_CONTINUE;
	} else {
		code = COAP_RESPONSE_CODE_CREATED;
	}

	/* Check if response should be suppressed per RFC 7967 */
	bool suppress = false;

	r = coap_no_response_check(request, code, &suppress);
	if (r < 0 && r != -ENOENT) {
		/* Invalid No-Response option - do not suppress */
		suppress = false;
	}

	if (suppress) {
		/* Response suppressed, but send empty ACK for CON requests */
		if (type == COAP_TYPE_CON) {
			r = coap_packet_init(&response, data, sizeof(data),
					     COAP_VERSION_1, COAP_TYPE_ACK, tkl, token,
					     COAP_CODE_EMPTY, id);
			if (r < 0) {
				return r;
			}

			r = coap_resource_send(resource, &response, addr, addr_len, NULL);
		}
		/* For NON requests, send nothing */
		return 0;
	}

	/* Response not suppressed, send normal response */
	r = coap_ack_init(&response, request, data, sizeof(data), code);
	if (r < 0) {
		return r;
	}

	r = coap_append_block1_option(&response, &ctx);
	if (r < 0) {
		LOG_ERR("Could not add Block1 option to response");
		return r;
	}

	r = coap_resource_send(resource, &response, addr, addr_len, NULL);

	return r;
}

static const char * const large_path[] = { "large", NULL };
COAP_RESOURCE_DEFINE(large, coap_server,
{
	.get = large_get,
	.path = large_path,
});

static const char * const large_update_path[] = { "large-update", NULL };
COAP_RESOURCE_DEFINE(large_update, coap_server,
{
	.put = large_update_put,
	.path = large_update_path,
});

static const char * const large_create_path[] = { "large-create", NULL };
COAP_RESOURCE_DEFINE(large_create, coap_server,
{
	.post = large_create_post,
	.path = large_create_path,
});
```

## src/location_query.c
```c
/*
 * Copyright (c) 2018 Intel Corporation
 * Copyright (c) 2023 Basalte bv
 *
 * SPDX-License-Identifier: Apache-2.0
 */

#include <zephyr/logging/log.h>
LOG_MODULE_DECLARE(net_coap_service_sample);

#include <zephyr/sys/printk.h>
#include <zephyr/net/coap_service.h>

static int location_query_post(struct coap_resource *resource,
			       struct coap_packet *request,
			       struct sockaddr *addr, socklen_t addr_len)
{
	static const char *const location_query[] = { "first=1",
						      "second=2",
						      NULL };
	uint8_t data[CONFIG_COAP_SERVER_MESSAGE_SIZE];
	const char * const *p;
	struct coap_packet response;
	uint8_t token[COAP_TOKEN_MAX_LEN];
	uint16_t id;
	uint8_t code;
	uint8_t type;
	uint8_t tkl;
	bool suppress = false;
	int r;

	code = coap_header_get_code(request);
	type = coap_header_get_type(request);
	id = coap_header_get_id(request);
	tkl = coap_header_get_token(request, token);

	LOG_INF("*******");
	LOG_INF("type: %u code %u id %u", type, code, id);
	LOG_INF("*******");

	/* Check if response should be suppressed per RFC 7967 */
	r = coap_no_response_check(request, COAP_RESPONSE_CODE_CREATED, &suppress);
	if (r < 0 && r != -ENOENT) {
		/* Invalid No-Response option - do not suppress */
		suppress = false;
	}

	if (suppress) {
		/* Response suppressed, but send empty ACK for CON requests */
		if (type == COAP_TYPE_CON) {
			r = coap_packet_init(&response, data, sizeof(data),
					     COAP_VERSION_1, COAP_TYPE_ACK, tkl, token,
					     COAP_CODE_EMPTY, id);
			if (r < 0) {
				return r;
			}

			r = coap_resource_send(resource, &response, addr, addr_len, NULL);
		}
		/* For NON requests, send nothing */
		return 0;
	}

	/* Response not suppressed, send normal response */
	if (type == COAP_TYPE_CON) {
		type = COAP_TYPE_ACK;
	} else {
		type = COAP_TYPE_NON_CON;
	}

	r = coap_packet_init(&response, data, sizeof(data),
			     COAP_VERSION_1, type, tkl, token,
			     COAP_RESPONSE_CODE_CREATED, id);
	if (r < 0) {
		return r;
	}

	for (p = location_query; *p; p++) {
		r = coap_packet_append_option(&response,
					      COAP_OPTION_LOCATION_QUERY,
					      *p, strlen(*p));
		if (r < 0) {
			return r;
		}
	}

	r = coap_resource_send(resource, &response, addr, addr_len, NULL);

	return r;
}

static const char * const location_query_path[] = { "location-query", NULL };
COAP_RESOURCE_DEFINE(location_query, coap_server,
{
	.post = location_query_post,
	.path = location_query_path,
});
```

## src/observer.c
```c
/*
 * Copyright (c) 2018 Intel Corporation
 * Copyright (c) 2023 Basalte bv
 *
 * SPDX-License-Identifier: Apache-2.0
 */

#include <zephyr/logging/log.h>
LOG_MODULE_DECLARE(net_coap_service_sample);

#include <zephyr/kernel.h>
#include <zephyr/sys/printk.h>
#include <zephyr/net/coap_service.h>

static int obs_counter;

static void update_counter(struct k_work *work);
K_WORK_DELAYABLE_DEFINE(obs_work, update_counter);

static int send_notification_packet(struct coap_resource *resource,
				    const struct sockaddr *addr,
				    socklen_t addr_len,
				    uint16_t age, uint16_t id,
				    const uint8_t *token, uint8_t tkl,
				    bool is_response)
{
	uint8_t data[CONFIG_COAP_SERVER_MESSAGE_SIZE];
	struct coap_packet response;
	char payload[14];
	uint8_t type;
	int r;

	if (is_response) {
		type = COAP_TYPE_ACK;
	} else {
		type = COAP_TYPE_CON;
	}

	if (!is_response) {
		id = coap_next_id();
	}

	r = coap_packet_init(&response, data, sizeof(data),
			     COAP_VERSION_1, type, tkl, token,
			     COAP_RESPONSE_CODE_CONTENT, id);
	if (r < 0) {
		return r;
	}

	if (age >= 2U) {
		r = coap_append_option_int(&response, COAP_OPTION_OBSERVE, age);
		if (r < 0) {
			return r;
		}
	}

	r = coap_append_option_int(&response, COAP_OPTION_CONTENT_FORMAT,
				   COAP_CONTENT_FORMAT_TEXT_PLAIN);
	if (r < 0) {
		return r;
	}

	r = coap_packet_append_payload_marker(&response);
	if (r < 0) {
		return r;
	}

	/* The response that coap-client expects */
	r = snprintk((char *) payload, sizeof(payload),
		     "Counter: %d\n", obs_counter);
	if (r < 0) {
		return r;
	}

	r = coap_packet_append_payload(&response, (uint8_t *)payload,
				       strlen(payload));
	if (r < 0) {
		return r;
	}

	k_work_reschedule(&obs_work, K_SECONDS(5));

	r = coap_resource_send(resource, &response, addr, addr_len, NULL);

	return r;
}

static int obs_get(struct coap_resource *resource,
		   struct coap_packet *request,
		   struct sockaddr *addr, socklen_t addr_len)
{
	uint8_t token[COAP_TOKEN_MAX_LEN];
	uint16_t id;
	uint8_t code;
	uint8_t type;
	uint8_t tkl;
	bool suppress = false;
	int r;
	int observe_result;

	observe_result = coap_resource_parse_observe(resource, request, addr);

	code = coap_header_get_code(request);
	type = coap_header_get_type(request);
	id = coap_header_get_id(request);
	tkl = coap_header_get_token(request, token);

	LOG_INF("*******");
	LOG_INF("type: %u code %u id %u", type, code, id);
	LOG_INF("*******");

	/* Check if response should be suppressed per RFC 7967 */
	r = coap_no_response_check(request, COAP_RESPONSE_CODE_CONTENT, &suppress);
	if (r < 0 && r != -ENOENT) {
		/* Invalid No-Response option - do not suppress */
		suppress = false;
	}

	if (suppress) {
		/* Response suppressed, but send empty ACK for CON requests */
		if (type == COAP_TYPE_CON) {
			uint8_t data[CONFIG_COAP_SERVER_MESSAGE_SIZE];
			struct coap_packet response;

			r = coap_packet_init(&response, data, sizeof(data),
					     COAP_VERSION_1, COAP_TYPE_ACK, tkl, token,
					     COAP_CODE_EMPTY, id);
			if (r < 0) {
				return r;
			}

			return coap_resource_send(resource, &response, addr, addr_len, NULL);
		}
		/* For NON requests, send nothing */
		return 0;
	}

	/* Response not suppressed, send normal response */
	return send_notification_packet(resource, addr, addr_len,
					observe_result == 0 ? resource->age : 0,
					id, token, tkl, true);
}

static void obs_notify(struct coap_resource *resource,
		       struct coap_observer *observer)
{
	send_notification_packet(resource,
				 &observer->addr,
				 sizeof(observer->addr),
				 resource->age, 0,
				 observer->token, observer->tkl, false);
}

static const char * const obs_path[] = { "obs", NULL };
COAP_RESOURCE_DEFINE(obs, coap_server,
{
	.get = obs_get,
	.path = obs_path,
	.notify = obs_notify,
});

static void update_counter(struct k_work *work)
{
	obs_counter++;

	coap_resource_notify(&obs);

	k_work_reschedule(&obs_work, K_SECONDS(5));
}
```

## src/query.c
```c
/*
 * Copyright (c) 2018 Intel Corporation
 * Copyright (c) 2023 Basalte bv
 *
 * SPDX-License-Identifier: Apache-2.0
 */

#include <zephyr/logging/log.h>
LOG_MODULE_DECLARE(net_coap_service_sample);

#include <zephyr/sys/printk.h>
#include <zephyr/net/coap_service.h>

static int query_get(struct coap_resource *resource,
		     struct coap_packet *request,
		     struct sockaddr *addr, socklen_t addr_len)
{
	uint8_t data[CONFIG_COAP_SERVER_MESSAGE_SIZE];
	struct coap_option options[4];
	struct coap_packet response;
	uint8_t payload[40];
	uint8_t token[COAP_TOKEN_MAX_LEN];
	uint16_t id;
	uint8_t code;
	uint8_t type;
	uint8_t tkl;
	bool suppress = false;
	int i, r;

	code = coap_header_get_code(request);
	type = coap_header_get_type(request);
	id = coap_header_get_id(request);
	tkl = coap_header_get_token(request, token);

	r = coap_find_options(request, COAP_OPTION_URI_QUERY, options, 4);
	if (r < 0) {
		return -EINVAL;
	}

	LOG_INF("*******");
	LOG_INF("type: %u code %u id %u", type, code, id);
	LOG_INF("num queries: %d", r);

	for (i = 0; i < r; i++) {
		char str[16];

		if (options[i].len + 1 > sizeof(str)) {
			LOG_INF("Unexpected length of query: "
				"%d (expected %zu)",
				options[i].len, sizeof(str));
			break;
		}

		memcpy(str, options[i].value, options[i].len);
		str[options[i].len] = '\0';

		LOG_INF("query[%d]: %s", i + 1, str);
	}

	LOG_INF("*******");

	/* Check if response should be suppressed per RFC 7967 */
	r = coap_no_response_check(request, COAP_RESPONSE_CODE_CONTENT, &suppress);
	if (r < 0 && r != -ENOENT) {
		/* Invalid No-Response option - do not suppress */
		suppress = false;
	}

	if (suppress) {
		/* Response suppressed, but send empty ACK for CON requests */
		if (type == COAP_TYPE_CON) {
			r = coap_packet_init(&response, data, sizeof(data),
					     COAP_VERSION_1, COAP_TYPE_ACK, tkl, token,
					     COAP_CODE_EMPTY, id);
			if (r < 0) {
				return r;
			}

			r = coap_resource_send(resource, &response, addr, addr_len, NULL);
		}
		/* For NON requests, send nothing */
		return 0;
	}

	/* Response not suppressed, send normal response */
	r = coap_packet_init(&response, data, sizeof(data),
			     COAP_VERSION_1, COAP_TYPE_ACK, tkl, token,
			     COAP_RESPONSE_CODE_CONTENT, id);
	if (r < 0) {
		return r;
	}

	r = coap_append_option_int(&response, COAP_OPTION_CONTENT_FORMAT,
				   COAP_CONTENT_FORMAT_TEXT_PLAIN);
	if (r < 0) {
		return r;
	}

	r = coap_packet_append_payload_marker(&response);
	if (r < 0) {
		return r;
	}

	/* The response that coap-client expects */
	r = snprintk((char *) payload, sizeof(payload),
		     "Type: %u\nCode: %u\nMID: %u\n", type, code, id);
	if (r < 0) {
		return r;
	}

	r = coap_packet_append_payload(&response, (uint8_t *)payload,
				       strlen(payload));
	if (r < 0) {
		return r;
	}

	r = coap_resource_send(resource, &response, addr, addr_len, NULL);

	return r;
}

static const char * const query_path[] = { "query", NULL };
COAP_RESOURCE_DEFINE(query, coap_server,
{
	.get = query_get,
	.path = query_path,
});
```

## src/separate.c
```c
/*
 * Copyright (c) 2018 Intel Corporation
 * Copyright (c) 2023 Basalte bv
 *
 * SPDX-License-Identifier: Apache-2.0
 */

#include <zephyr/logging/log.h>
LOG_MODULE_DECLARE(net_coap_service_sample);

#include <zephyr/sys/printk.h>
#include <zephyr/net/coap_service.h>

static int separate_get(struct coap_resource *resource,
			struct coap_packet *request,
			struct sockaddr *addr, socklen_t addr_len)
{
	uint8_t data[CONFIG_COAP_SERVER_MESSAGE_SIZE];
	struct coap_packet response;
	uint8_t payload[40];
	uint8_t token[COAP_TOKEN_MAX_LEN];
	uint16_t id;
	uint8_t code;
	uint8_t type;
	uint8_t tkl;
	bool suppress = false;
	int r;

	code = coap_header_get_code(request);
	type = coap_header_get_type(request);
	id = coap_header_get_id(request);
	tkl = coap_header_get_token(request, token);

	LOG_INF("*******");
	LOG_INF("type: %u code %u id %u", type, code, id);
	LOG_INF("*******");

	if (type == COAP_TYPE_ACK) {
		return 0;
	}

	/* Check if response should be suppressed per RFC 7967 */
	r = coap_no_response_check(request, COAP_RESPONSE_CODE_CONTENT, &suppress);
	if (r < 0 && r != -ENOENT) {
		/* Invalid No-Response option - do not suppress */
		suppress = false;
	}

	/* Always send empty ACK for separate response */
	r = coap_ack_init(&response, request, data, sizeof(data), 0);
	if (r < 0) {
		return r;
	}

	r = coap_resource_send(resource, &response, addr, addr_len, NULL);
	if (r < 0) {
		return r;
	}

	/* If response is suppressed, don't send the separate response */
	if (suppress) {
		return 0;
	}

	/* Response not suppressed, send separate response */
	if (type == COAP_TYPE_CON) {
		type = COAP_TYPE_CON;
	} else {
		type = COAP_TYPE_NON_CON;
	}

	/* Re-use the buffer */
	r = coap_packet_init(&response, data, sizeof(data),
			     COAP_VERSION_1, type, tkl, token,
			     COAP_RESPONSE_CODE_CONTENT, coap_next_id());
	if (r < 0) {
		return r;
	}

	r = coap_append_option_int(&response, COAP_OPTION_CONTENT_FORMAT,
				   COAP_CONTENT_FORMAT_TEXT_PLAIN);
	if (r < 0) {
		return r;
	}

	r = coap_packet_append_payload_marker(&response);
	if (r < 0) {
		return r;
	}

	/* The response that coap-client expects */
	r = snprintk((char *) payload, sizeof(payload),
		     "Type: %u\nCode: %u\nMID: %u\n", type, code, id);
	if (r < 0) {
		return r;
	}

	r = coap_packet_append_payload(&response, (uint8_t *)payload,
				       strlen(payload));
	if (r < 0) {
		return r;
	}

	r = coap_resource_send(resource, &response, addr, addr_len, NULL);

	return r;
}

static const char * const separate_path[] = { "separate", NULL };
COAP_RESOURCE_DEFINE(separate, coap_server,
{
	.get = separate_get,
	.path = separate_path,
});
```

## src/test.c
```c
/*
 * Copyright (c) 2018 Intel Corporation
 * Copyright (c) 2023 Basalte bv
 *
 * SPDX-License-Identifier: Apache-2.0
 */

#include <zephyr/logging/log.h>
LOG_MODULE_DECLARE(net_coap_service_sample);

#include <zephyr/sys/printk.h>
#include <zephyr/net/coap_service.h>

#include "net_private.h"

static int piggyback_get(struct coap_resource *resource,
			 struct coap_packet *request,
			 struct sockaddr *addr, socklen_t addr_len)
{
	uint8_t data[CONFIG_COAP_SERVER_MESSAGE_SIZE];
	struct coap_packet response;
	uint8_t payload[40];
	uint8_t token[COAP_TOKEN_MAX_LEN];
	uint16_t id;
	uint8_t code;
	uint8_t type;
	uint8_t tkl;
	bool suppress = false;
	int r;

	code = coap_header_get_code(request);
	type = coap_header_get_type(request);
	id = coap_header_get_id(request);
	tkl = coap_header_get_token(request, token);

	LOG_INF("*******");
	LOG_INF("type: %u code %u id %u", type, code, id);
	LOG_INF("*******");

	/* Check if response should be suppressed per RFC 7967 */
	r = coap_no_response_check(request, COAP_RESPONSE_CODE_CONTENT, &suppress);
	if (r < 0 && r != -ENOENT) {
		/* Invalid No-Response option - do not suppress */
		suppress = false;
	}

	if (suppress) {
		/* Response suppressed, but send empty ACK for CON requests */
		if (type == COAP_TYPE_CON) {
			r = coap_packet_init(&response, data, sizeof(data),
					     COAP_VERSION_1, COAP_TYPE_ACK, tkl, token,
					     COAP_CODE_EMPTY, id);
			if (r < 0) {
				return r;
			}

			r = coap_resource_send(resource, &response, addr, addr_len, NULL);
		}
		/* For NON requests, send nothing */
		return 0;
	}

	/* Response not suppressed, send normal response */
	if (type == COAP_TYPE_CON) {
		type = COAP_TYPE_ACK;
	} else {
		type = COAP_TYPE_NON_CON;
	}

	r = coap_packet_init(&response, data, sizeof(data),
			     COAP_VERSION_1, type, tkl, token,
			     COAP_RESPONSE_CODE_CONTENT, id);
	if (r < 0) {
		return r;
	}

	r = coap_append_option_int(&response, COAP_OPTION_CONTENT_FORMAT,
				   COAP_CONTENT_FORMAT_TEXT_PLAIN);
	if (r < 0) {
		return r;
	}

	r = coap_packet_append_payload_marker(&response);
	if (r < 0) {
		return r;
	}

	/* The response that coap-client expects */
	r = snprintk((char *) payload, sizeof(payload),
		     "Type: %u\nCode: %u\nMID: %u\n", type, code, id);
	if (r < 0) {
		return r;
	}

	r = coap_packet_append_payload(&response, (uint8_t *)payload,
				       strlen(payload));
	if (r < 0) {
		return r;
	}

	r = coap_resource_send(resource, &response, addr, addr_len, NULL);

	return r;
}

static int test_del(struct coap_resource *resource,
		    struct coap_packet *request,
		    struct sockaddr *addr, socklen_t addr_len)
{
	uint8_t data[CONFIG_COAP_SERVER_MESSAGE_SIZE];
	struct coap_packet response;
	uint8_t token[COAP_TOKEN_MAX_LEN];
	uint8_t tkl;
	uint8_t code;
	uint8_t type;
	uint16_t id;
	bool suppress = false;
	int r;

	code = coap_header_get_code(request);
	type = coap_header_get_type(request);
	id = coap_header_get_id(request);
	tkl = coap_header_get_token(request, token);

	LOG_INF("*******");
	LOG_INF("type: %u code %u id %u", type, code, id);
	LOG_INF("*******");

	/* Check if response should be suppressed per RFC 7967 */
	r = coap_no_response_check(request, COAP_RESPONSE_CODE_DELETED, &suppress);
	if (r < 0 && r != -ENOENT) {
		/* Invalid No-Response option - do not suppress */
		suppress = false;
	}

	if (suppress) {
		/* Response suppressed, but send empty ACK for CON requests */
		if (type == COAP_TYPE_CON) {
			r = coap_packet_init(&response, data, sizeof(data),
					     COAP_VERSION_1, COAP_TYPE_ACK, tkl, token,
					     COAP_CODE_EMPTY, id);
			if (r < 0) {
				return r;
			}

			r = coap_resource_send(resource, &response, addr, addr_len, NULL);
		}
		/* For NON requests, send nothing */
		return 0;
	}

	/* Response not suppressed, send normal response */
	if (type == COAP_TYPE_CON) {
		type = COAP_TYPE_ACK;
	} else {
		type = COAP_TYPE_NON_CON;
	}

	r = coap_packet_init(&response, data, sizeof(data),
			     COAP_VERSION_1, type, tkl, token,
			     COAP_RESPONSE_CODE_DELETED, id);
	if (r < 0) {
		return r;
	}

	r = coap_resource_send(resource, &response, addr, addr_len, NULL);

	return r;
}

static int test_put(struct coap_resource *resource,
		    struct coap_packet *request,
		    struct sockaddr *addr, socklen_t addr_len)
{
	uint8_t data[CONFIG_COAP_SERVER_MESSAGE_SIZE];
	struct coap_packet response;
	uint8_t token[COAP_TOKEN_MAX_LEN];
	const uint8_t *payload;
	uint16_t payload_len;
	uint8_t code;
	uint8_t type;
	uint8_t tkl;
	uint16_t id;
	bool suppress = false;
	int r;

	code = coap_header_get_code(request);
	type = coap_header_get_type(request);
	id = coap_header_get_id(request);
	tkl = coap_header_get_token(request, token);

	LOG_INF("*******");
	LOG_INF("type: %u code %u id %u", type, code, id);
	LOG_INF("*******");

	payload = coap_packet_get_payload(request, &payload_len);
	if (payload) {
		net_hexdump("PUT Payload", payload, payload_len);
	}

	/* Check if response should be suppressed per RFC 7967 */
	r = coap_no_response_check(request, COAP_RESPONSE_CODE_CHANGED, &suppress);
	if (r < 0 && r != -ENOENT) {
		/* Invalid No-Response option - do not suppress */
		suppress = false;
	}

	if (suppress) {
		/* Response suppressed, but send empty ACK for CON requests */
		if (type == COAP_TYPE_CON) {
			r = coap_packet_init(&response, data, sizeof(data),
					     COAP_VERSION_1, COAP_TYPE_ACK, tkl, token,
					     COAP_CODE_EMPTY, id);
			if (r < 0) {
				return r;
			}

			r = coap_resource_send(resource, &response, addr, addr_len, NULL);
		}
		/* For NON requests, send nothing */
		return 0;
	}

	/* Response not suppressed, send normal response */
	if (type == COAP_TYPE_CON) {
		type = COAP_TYPE_ACK;
	} else {
		type = COAP_TYPE_NON_CON;
	}

	r = coap_packet_init(&response, data, sizeof(data),
			     COAP_VERSION_1, type, tkl, token,
			     COAP_RESPONSE_CODE_CHANGED, id);
	if (r < 0) {
		return r;
	}

	r = coap_resource_send(resource, &response, addr, addr_len, NULL);

	return r;
}

static int test_post(struct coap_resource *resource,
		     struct coap_packet *request,
		     struct sockaddr *addr, socklen_t addr_len)
{
	static const char * const location_path[] = { "location1",
						      "location2",
						      "location3",
						      NULL };
	uint8_t data[CONFIG_COAP_SERVER_MESSAGE_SIZE];
	const char * const *p;
	struct coap_packet response;
	uint8_t token[COAP_TOKEN_MAX_LEN];
	const uint8_t *payload;
	uint16_t payload_len;
	uint8_t code;
	uint8_t type;
	uint8_t tkl;
	uint16_t id;
	bool suppress = false;
	int r;

	code = coap_header_get_code(request);
	type = coap_header_get_type(request);
	id = coap_header_get_id(request);
	tkl = coap_header_get_token(request, token);

	LOG_INF("*******");
	LOG_INF("type: %u code %u id %u", type, code, id);
	LOG_INF("*******");

	payload = coap_packet_get_payload(request, &payload_len);
	if (payload) {
		net_hexdump("POST Payload", payload, payload_len);
	}

	/* Check if response should be suppressed per RFC 7967 */
	r = coap_no_response_check(request, COAP_RESPONSE_CODE_CREATED, &suppress);
	if (r < 0 && r != -ENOENT) {
		/* Invalid No-Response option - do not suppress */
		suppress = false;
	}

	if (suppress) {
		/* Response suppressed, but send empty ACK for CON requests */
		if (type == COAP_TYPE_CON) {
			r = coap_packet_init(&response, data, sizeof(data),
					     COAP_VERSION_1, COAP_TYPE_ACK, tkl, token,
					     COAP_CODE_EMPTY, id);
			if (r < 0) {
				return r;
			}

			r = coap_resource_send(resource, &response, addr, addr_len, NULL);
		}
		/* For NON requests, send nothing */
		return 0;
	}

	/* Response not suppressed, send normal response */
	if (type == COAP_TYPE_CON) {
		type = COAP_TYPE_ACK;
	} else {
		type = COAP_TYPE_NON_CON;
	}

	r = coap_packet_init(&response, data, sizeof(data),
			     COAP_VERSION_1, type, tkl, token,
			     COAP_RESPONSE_CODE_CREATED, id);
	if (r < 0) {
		return r;
	}

	for (p = location_path; *p; p++) {
		r = coap_packet_append_option(&response,
					      COAP_OPTION_LOCATION_PATH,
					      *p, strlen(*p));
		if (r < 0) {
			return r;
		}
	}

	r = coap_resource_send(resource, &response, addr, addr_len, NULL);

	return r;
}

static const char * const test_path[] = { "test", NULL };
COAP_RESOURCE_DEFINE(test, coap_server,
{
	.get = piggyback_get,
	.post = test_post,
	.del = test_del,
	.put = test_put,
	.path = test_path,
});

static const char * const segments_path[] = { "seg1", "seg2", "seg3", NULL };
COAP_RESOURCE_DEFINE(segments, coap_server,
{
	.get = piggyback_get,
	.path = segments_path,
});

#if defined(CONFIG_COAP_URI_WILDCARD)

static const char * const wildcard1_path[] = { "wild1", "+", "wild3", NULL };
COAP_RESOURCE_DEFINE(wildcard1, coap_server,
{
	.get = piggyback_get,
	.path = wildcard1_path,
});

static const char * const wildcard2_path[] = { "wild2", "#", NULL };
COAP_RESOURCE_DEFINE(wildcard2, coap_server,
{
	.get = piggyback_get,
	.path = wildcard2_path,
});

#endif
```
