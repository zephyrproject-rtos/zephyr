## CMakeLists.txt
```
# SPDX-License-Identifier: Apache-2.0

cmake_minimum_required(VERSION 3.28.0)

find_package(Zephyr REQUIRED HINTS $ENV{ZEPHYR_BASE})
project(ocpp)

include(${ZEPHYR_BASE}/samples/net/common/common.cmake)
target_sources(app PRIVATE src/main.c)

set(gen_dir ${ZEPHYR_BINARY_DIR}/include/generated/)

if(CONFIG_NET_SOCKETS_SOCKOPT_TLS AND (NOT USE_DUMMY_CREDS))
generate_inc_file_for_target(
    app
    # <path-to-certificate-file> (e.g. src/credentials/device.crt)
    # <path-to-generated-.inc-file> (e.g. ${gen_dir}/device.crt.inc)
)
endif()
```

## Kconfig
```
# Config options for OCPP sample application

# Copyright (c) 2025 Linumiz GmbH
# SPDX-License-Identifier: Apache-2.0

mainmenu "OCPP sample application"
config NET_SAMPLE_OCPP_SERVER
	string "OCPP server ip"
	help
	  OCPP central system server ip address

config NET_SAMPLE_OCPP_PORT
	int "OCPP server port"
	help
	  OCPP central system server port

config NET_SAMPLE_OCPP_WS_PATH
	string "OCPP websocket path"
	default "/steve/websocket/CentralSystemService/zephyr"
	help
	  WebSocket URL path (excluding IP address and port) for OCPP connection to the central
	  system server.

config NET_SAMPLE_OCPP_AUTH_USERNAME
	string "OCPP basic authentication username"
	depends on OCPP_BASIC_AUTH
	default "zephyr"
	help
	  Username of the HTTP Basic authentication. It must be equal to the
	  charge point identity, the last element of NET_SAMPLE_OCPP_WS_PATH
	  (A00.FR.204 of the OCPP 1.6 security whitepaper).

config NET_SAMPLE_OCPP_AUTH_PASSWORD
	string "OCPP basic authentication password"
	depends on OCPP_BASIC_AUTH
	help
	  Password of the HTTP Basic authentication, sent as it is. The
	  build fails unless it has 16 to OCPP_BASIC_AUTH_PASSWORD_MAX_LEN
	  characters.

config NET_SAMPLE_SNTP_SERVER
	string "SNTP server ip"
	help
	  SNTP server ip to get the time from network

config NET_SAMPLE_SNTP_SERVER_PORT
	int "SNTP server port"
	help
	  SNTP server port to get the time from network

source "samples/net/common/Kconfig"
source "Kconfig.zephyr"
```

## sample.yaml
```
sample:
  description: OCPP sample application
  name: OCPP charge point
tests:
  sample.net.ocpp:
    harness: net
    depends_on: netif
    tags:
      - net
      - ocpp

  sample.net.ocpp.tls:
    harness: net
    depends_on: netif
    extra_args:
      - EXTRA_CONF_FILE="overlay-tls13.conf"
      - USE_DUMMY_CREDS=1
    tags:
      - net
      - ocpp
      - tls
```

## prj.conf
```kconfig
# HTTP & Websocket
CONFIG_HTTP_CLIENT=y
CONFIG_WEBSOCKET_CLIENT=y

# Networking config
CONFIG_NETWORKING=y
CONFIG_NET_IPV4=y
CONFIG_NET_IPV6=n
CONFIG_NET_CONNECTION_MANAGER=y
CONFIG_NET_CONFIG_SETTINGS=y
CONFIG_NET_TCP=y
CONFIG_NET_SOCKETS=y
CONFIG_ZVFS_POLL_MAX=4
CONFIG_ETH_DRIVER=y
CONFIG_LOG=y
CONFIG_NET_LOG=y

# OCPP
CONFIG_OCPP=y

# Please set the server addresses when compiling the sample
CONFIG_NET_SAMPLE_SNTP_SERVER=""
CONFIG_NET_SAMPLE_SNTP_SERVER_PORT=123
CONFIG_NET_SAMPLE_OCPP_SERVER=""
CONFIG_NET_SAMPLE_OCPP_PORT=8180

CONFIG_MAIN_STACK_SIZE=4096
CONFIG_HEAP_MEM_POOL_SIZE=15000

CONFIG_JSON_LIBRARY=y
CONFIG_PICOLIBC=y
CONFIG_NET_ARP=y
CONFIG_NET_UDP=y
CONFIG_NET_DHCPV4=y
CONFIG_NET_DHCPV4_OPTION_CALLBACKS=y
CONFIG_TEST_RANDOM_GENERATOR=y

CONFIG_NET_TX_STACK_SIZE=2048
CONFIG_NET_RX_STACK_SIZE=2048
CONFIG_NET_PKT_RX_COUNT=28
CONFIG_NET_BUF_RX_COUNT=60
CONFIG_NET_MGMT=y
CONFIG_NET_MGMT_EVENT=y

CONFIG_DNS_RESOLVER=y
CONFIG_NET_SOCKETS_DNS_TIMEOUT=5000

CONFIG_SNTP=y

CONFIG_ZBUS=y
CONFIG_ZBUS_RUNTIME_OBSERVERS=y
CONFIG_POSIX_AEP_CHOICE_NETAPP=y
CONFIG_POSIX_CLOCK_SELECTION=y
```

## overlay-ec.conf
```kconfig
CONFIG_PSA_WANT_ALG_ECDH=y
CONFIG_PSA_WANT_ALG_ECDSA=y
CONFIG_PSA_WANT_KEY_TYPE_ECC_KEY_PAIR_GENERATE=y
CONFIG_PSA_WANT_KEY_TYPE_ECC_KEY_PAIR_IMPORT=y
CONFIG_PSA_WANT_KEY_TYPE_ECC_KEY_PAIR_EXPORT=y
CONFIG_PSA_WANT_KEY_TYPE_ECC_KEY_PAIR_DERIVE=y
CONFIG_PSA_WANT_ECC_SECP_R1_256=y
```

## overlay-tls13.conf
```kconfig
# Enable Secure Sockets
CONFIG_NET_SOCKETS_SOCKOPT_TLS=y

# Mbed TLS configuration
CONFIG_MBEDTLS=y
CONFIG_MBEDTLS_ENABLE_HEAP=y
CONFIG_MBEDTLS_HEAP_SIZE=20000
CONFIG_MBEDTLS_SSL_IN_CONTENT_LEN=2048
CONFIG_MBEDTLS_SSL_OUT_CONTENT_LEN=2048
CONFIG_MBEDTLS_PEM_PARSE_C=y
CONFIG_MBEDTLS_PEM_WRITE_C=y
CONFIG_MBEDTLS_SSL_SERVER_NAME_INDICATION=y
# Build the PSA Crypto core so that the TLS stack uses the PSA crypto API.
CONFIG_PSA_CRYPTO=y
CONFIG_ENTROPY_GENERATOR=y

# Debug log options (optional)
# CONFIG_MBEDTLS_LOG_LEVEL_DBG=y
# CONFIG_MBEDTLS_DEBUG=y

# TLS1.3 Configuration
CONFIG_MBEDTLS_SSL_PROTO_TLS1_3=y
CONFIG_PSA_WANT_ALG_HKDF_EXTRACT=y
CONFIG_PSA_WANT_ALG_HKDF_EXPAND=y

CONFIG_PSA_WANT_ALG_GCM=y
CONFIG_PSA_WANT_KEY_TYPE_AES=y
CONFIG_PSA_WANT_ALG_CBC_NO_PADDING=y
CONFIG_PSA_WANT_ALG_SHA_256=y
CONFIG_PSA_WANT_ALG_SHA_384=y

CONFIG_PSA_WANT_ALG_ECDH=y
CONFIG_PSA_WANT_ALG_ECDSA=y
CONFIG_PSA_WANT_KEY_TYPE_ECC_KEY_PAIR_GENERATE=y
CONFIG_PSA_WANT_KEY_TYPE_ECC_KEY_PAIR_IMPORT=y
CONFIG_PSA_WANT_KEY_TYPE_ECC_KEY_PAIR_EXPORT=y
CONFIG_PSA_WANT_KEY_TYPE_ECC_KEY_PAIR_DERIVE=y
CONFIG_PSA_WANT_ECC_SECP_R1_256=y
CONFIG_MBEDTLS_SSL_TLS1_3_KEY_EXCHANGE_MODE_EPHEMERAL_ENABLED=y
```

## boards/native_sim.conf
```kconfig
# Network address config
CONFIG_NET_DHCPV4=n
CONFIG_NET_CONFIG_NEED_IPV4=y
CONFIG_NET_CONFIG_MY_IPV4_ADDR="192.0.2.1"
CONFIG_NET_CONFIG_PEER_IPV4_ADDR="192.0.2.2"
CONFIG_NET_CONFIG_MY_IPV4_GW="192.0.2.2"
```

## src/main.c
```c
/*
 * Copyright (c) 2025 Linumiz GmbH
 *
 * SPDX-License-Identifier: Apache-2.0
 */

#undef _POSIX_C_SOURCE
#define _POSIX_C_SOURCE 200809L /* for strdup() */
#include <stdio.h>
#include <time.h>

#include <zephyr/posix/sys/socket.h>
#include <zephyr/posix/arpa/inet.h>
#include <zephyr/posix/netinet/in.h>
#include <zephyr/posix/unistd.h>
#include <zephyr/posix/netdb.h>

#include <zephyr/logging/log.h>
#include <zephyr/net/net_if.h>
#include <zephyr/net/net_core.h>
#include <zephyr/net/net_context.h>
#include <zephyr/net/net_mgmt.h>
#include <zephyr/net/sntp.h>
#include <zephyr/net/ocpp.h>
#include <zephyr/random/random.h>
#include <zephyr/zbus/zbus.h>

#include <zephyr/net/conn_mgr_monitor.h>
#include "net_sample_common.h"

#if defined(CONFIG_NET_SOCKETS_SOCKOPT_TLS)
#include "credentials/certificate.h"
#endif

LOG_MODULE_REGISTER(main, LOG_LEVEL_INF);

#if defined(CONFIG_OCPP_BASIC_AUTH)
BUILD_ASSERT(sizeof(CONFIG_NET_SAMPLE_OCPP_AUTH_PASSWORD) - 1 >=
	     OCPP_BASIC_AUTH_PASSWORD_MIN_LEN,
	     "CONFIG_NET_SAMPLE_OCPP_AUTH_PASSWORD is not set or too short");
BUILD_ASSERT(sizeof(CONFIG_NET_SAMPLE_OCPP_AUTH_PASSWORD) - 1 <=
	     CONFIG_OCPP_BASIC_AUTH_PASSWORD_MAX_LEN,
	     "CONFIG_NET_SAMPLE_OCPP_AUTH_PASSWORD is too long");
#endif

#define NO_OF_CONN 2
K_KERNEL_STACK_ARRAY_DEFINE(cp_stk, NO_OF_CONN, 2 * 1024);

static struct k_thread tinfo[NO_OF_CONN];
static k_tid_t tid[NO_OF_CONN];
static char idtag[NO_OF_CONN][25];

static int dns_query(const char *host, uint16_t port, int family, int socktype,
			  struct sockaddr *addr, socklen_t *addrlen)
{
	struct addrinfo hints = {
		.ai_family = family,
		.ai_socktype = socktype,
	};

	struct addrinfo *res = NULL;
	char addr_str[INET6_ADDRSTRLEN] = {0};
	int ret;

	/* Perform DNS query */
	ret = getaddrinfo(host, NULL, &hints, &res);
	if (ret < 0) {
		LOG_ERR("getaddrinfo failed (%d, errno %d)", ret, errno);
		return ret;
	}

	/* Store the first result */
	*addr = *res->ai_addr;
	*addrlen = res->ai_addrlen;
	/* Free the allocated memory */
	freeaddrinfo(res);
	/* Store the port */
	net_sin(addr)->sin_port = htons(port);
	/* Print the found address */
	inet_ntop(addr->sa_family, &net_sin(addr)->sin_addr, addr_str, sizeof(addr_str));
	LOG_INF("%s -> %s", host, addr_str);

	return 0;
}

static int ocpp_get_time_from_sntp(void)
{
	struct sntp_ctx ctx;
	struct sntp_time stime;
	struct sockaddr addr;
	socklen_t addrlen;
	struct timespec tv;
	int ret;

	ret = dns_query(CONFIG_NET_SAMPLE_SNTP_SERVER, CONFIG_NET_SAMPLE_SNTP_SERVER_PORT,
				   AF_INET, SOCK_DGRAM, &addr, &addrlen);
	if (ret != 0) {
		LOG_ERR("Failed to lookup SNTP server (%d)", ret);
		return ret;
	}

	ret = sntp_init(&ctx, &addr, addrlen);
	if (ret < 0) {
		LOG_ERR("Failed to init SNTP IPv4 ctx: %d", ret);
		return ret;
	}

	ret = sntp_query(&ctx, 4 * MSEC_PER_SEC, &stime);
	if (ret < 0) {
		LOG_ERR("SNTP IPv4 request failed: %d", ret);
		return ret;
	}

	LOG_INF("SNTP success, epoch seconds: %llu\n", stime.seconds);
	tv.tv_sec = stime.seconds;
	clock_settime(CLOCK_REALTIME, &tv);
	sntp_close(&ctx);
	return 0;
}

ZBUS_CHAN_DEFINE(ch_event, /* Name */
		 union ocpp_io_value,
		 NULL,			/* Validator */
		 NULL,			/* User data */
		 ZBUS_OBSERVERS_EMPTY,	/* observers */
		 ZBUS_MSG_INIT(0) /* Initial value {0} */
);

ZBUS_SUBSCRIBER_DEFINE(cp_thread0, 5);
ZBUS_SUBSCRIBER_DEFINE(cp_thread1, 5);
struct zbus_observer *obs[NO_OF_CONN] = {(struct zbus_observer *)&cp_thread0,
					 (struct zbus_observer *)&cp_thread1};

static void ocpp_cp_entry(void *p1, void *p2, void *p3);
static int user_notify_cb(enum ocpp_notify_reason reason,
			  union ocpp_io_value *io,
			  void *user_data)
{
	static int wh = 6 + NO_OF_CONN;
	int idx;
	int i;

	switch (reason) {
	case OCPP_USR_GET_METER_VALUE:
		if (OCPP_OMM_ACTIVE_ENERGY_TO_EV == io->meter_val.mes) {
			snprintf(io->meter_val.val, CISTR50, "%u",
				 wh + io->meter_val.id_con);

			wh++;
			LOG_DBG("mtr reading val %s con %d", io->meter_val.val,
				io->meter_val.id_con);

			return 0;
		}
		break;

	case OCPP_USR_START_CHARGING:
		if (io->start_charge.id_con < 0) {
			for (i = 0; i < NO_OF_CONN; i++) {
				if (tid[i] == NULL) {
					break;
				}
			}

			if (i >= NO_OF_CONN) {
				return -EBUSY;
			}
			idx = i;
		} else {
			idx = io->start_charge.id_con - 1;
		}

		if (tid[idx] == NULL) {
			LOG_INF("Remote start charging idtag %s connector %d\n",
				idtag[idx], idx + 1);

			strncpy(idtag[idx], io->start_charge.idtag,
				sizeof(idtag[0]));

			tid[idx] = k_thread_create(&tinfo[idx], cp_stk[idx],
						   sizeof(cp_stk[idx]), ocpp_cp_entry,
						   (void *)(uintptr_t)(idx + 1), idtag[idx],
						   obs[idx], 7, 0, K_NO_WAIT);

			return 0;
		}
		break;

	case OCPP_USR_STOP_CHARGING:
		zbus_chan_pub(&ch_event, io, K_MSEC(100));
		return 0;

	case OCPP_USR_UNLOCK_CONNECTOR:
		LOG_INF("unlock connector %d\n", io->unlock_con.id_con);
		return 0;
	}

	return -ENOTSUP;
}

static void ocpp_cp_entry(void *p1, void *p2, void *p3)
{
	int ret;
	int idcon = (int)(uintptr_t)p1;
	char *idtag = (char *)p2;
	struct zbus_observer *obs = (struct zbus_observer *)p3;
	ocpp_session_handle_t sh = NULL;
	enum ocpp_auth_status status;
	const uint32_t timeout_ms = 500;

	ret = ocpp_session_open(&sh);
	if (ret < 0) {
		LOG_ERR("ocpp open ses idcon %d> res %d\n", idcon, ret);
		return;
	}

	while (1) {
		/* Avoid quick retry since authorization request is possible only
		 * after Bootnotification process (handled in lib) completed.
		 */

		k_sleep(K_SECONDS(5));
		ret = ocpp_authorize(sh,
				     idtag,
				     &status,
				     timeout_ms);
		if (ret < 0) {
			LOG_ERR("ocpp auth %d> idcon %d status %d\n",
				ret, idcon, status);
		} else {
			LOG_INF("ocpp auth %d> idcon %d status %d\n",
				ret, idcon, status);
			break;
		}
	}

	if (status != OCPP_AUTH_ACCEPTED) {
		LOG_ERR("ocpp start idcon %d> not authorized status %d\n",
			idcon, status);
		return;
	}

	ret = ocpp_start_transaction(sh, sys_rand32_get(), idcon, timeout_ms);
	if (ret == 0) {
		const struct zbus_channel *chan;
		union ocpp_io_value io;

		LOG_INF("ocpp start charging connector id %d\n", idcon);
		memset(&io, 0xff, sizeof(io));

		/* wait for stop charging event from main or remote CS */
		zbus_chan_add_obs(&ch_event, obs, K_SECONDS(1));
		do {
			zbus_sub_wait(obs, &chan, K_FOREVER);
			zbus_chan_read(chan, &io, K_SECONDS(1));

			if (io.stop_charge.id_con == idcon) {
				break;
			}

		} while (1);
	}

	ret = ocpp_stop_transaction(sh, sys_rand32_get(), timeout_ms);
	if (ret < 0) {
		LOG_ERR("ocpp stop txn idcon %d> %d\n", idcon, ret);
		return;
	}

	LOG_INF("ocpp stop charging connector id %d\n", idcon);
	k_sleep(K_SECONDS(1));
	ocpp_session_close(sh);
	tid[idcon - 1] = NULL;
	k_sleep(K_SECONDS(1));
	k_thread_abort(k_current_get());
}

static int ocpp_getaddrinfo(char *server, int port, char **ip)
{
	int ret;
	uint8_t retry = 5;
	char addr_str[INET_ADDRSTRLEN];
	struct sockaddr_storage b;
	struct addrinfo *result = NULL;
	struct addrinfo *addr;
	struct addrinfo hints = {
		.ai_family = AF_INET,
		.ai_socktype = SOCK_STREAM
	};

	LOG_INF("cs server %s %d", server, port);
	do {
		ret = getaddrinfo(server, NULL, &hints, &result);
		if (ret == -EAGAIN) {
			LOG_ERR("ERROR: getaddrinfo %d, rebind", ret);
			k_sleep(K_SECONDS(1));
		} else if (ret != 0) {
			LOG_ERR("ERROR: getaddrinfo failed %d", ret);
			return ret;
		}
	} while (--retry && ret);

	addr = result;
	while (addr != NULL) {
		/* IPv4 Address. */
		if (addr->ai_addrlen == sizeof(struct sockaddr_in)) {
			struct sockaddr_in *broker =
				((struct sockaddr_in *)&b);

			broker->sin_addr.s_addr =
				((struct sockaddr_in *)addr->ai_addr)
				->sin_addr.s_addr;
			broker->sin_family = AF_INET;
			broker->sin_port = htons(port);

			inet_ntop(AF_INET, &broker->sin_addr, addr_str,
				  sizeof(addr_str));

			*ip = strdup(addr_str);
			LOG_INF("IPv4 Address %s", addr_str);
			break;
		}

		LOG_ERR("error: ai_addrlen = %u should be %u or %u",
			(unsigned int)addr->ai_addrlen,
			(unsigned int)sizeof(struct sockaddr_in),
			(unsigned int)sizeof(struct sockaddr_in6));

		addr = addr->ai_next;
	}

	/* Free the address. */
	freeaddrinfo(result);

	return 0;
}

int main(void)
{
	int ret;
	int i;
	char *ip = NULL;
	uint32_t ready_mask = CONN_MGR_READY_IPV4;

	struct ocpp_cp_info cpi = {
		"basic",   "zephyr",  .num_of_con = NO_OF_CONN,
		"SNCP001", "SNBX001", "v0.1",
		"ICCIS",   "IMSI",    "MPMSN001",
		"MPMTYPE",
	};
	struct ocpp_cs_info csi = {NULL,
				   CONFIG_NET_SAMPLE_OCPP_WS_PATH,
				   CONFIG_NET_SAMPLE_OCPP_PORT,
				   AF_INET};

	printk("OCPP sample %s\n", CONFIG_BOARD);

	/* Hostname servers also need a DNS server */
	if (IS_ENABLED(CONFIG_NET_SAMPLE_COMMON_WAIT_DNS) &&
	    (is_hostname(CONFIG_NET_SAMPLE_OCPP_SERVER) ||
	     is_hostname(CONFIG_NET_SAMPLE_SNTP_SERVER))) {
		ready_mask |= CONN_MGR_READY_DNS;
	}

	LOG_INF("Waiting for network...");
	(void)conn_mgr_wait_ready(ready_mask, NULL, K_FOREVER);
	LOG_INF("Network ready");

	ret = ocpp_getaddrinfo(CONFIG_NET_SAMPLE_OCPP_SERVER, CONFIG_NET_SAMPLE_OCPP_PORT, &ip);
	if (ret < 0) {
		return ret;
	}

	csi.cs_ip = ip;

	ocpp_get_time_from_sntp();

#if defined(CONFIG_NET_SOCKETS_SOCKOPT_TLS)
	sec_tag_t tags[] = {CA_CERTIFICATE_TAG};

	ret = tls_credential_add(CA_CERTIFICATE_TAG,
				 TLS_CREDENTIAL_CA_CERTIFICATE,
				 ca_certificate,
				 sizeof(ca_certificate));
	if (ret < 0) {
		LOG_ERR("Failed to register CA certificate: %d", ret);
		return ret;
	}

	csi.creds.sec_tag_list = tags;
	csi.creds.tls_hostname = TLS_PEER_HOSTNAME;
	csi.creds.sec_tag_list_size = sizeof(tags);
	csi.creds.tls_hostname_size = strlen(TLS_PEER_HOSTNAME);
#endif
#if defined(CONFIG_OCPP_BASIC_AUTH)
	csi.auth.username = CONFIG_NET_SAMPLE_OCPP_AUTH_USERNAME;
	csi.auth.password = (const uint8_t *)CONFIG_NET_SAMPLE_OCPP_AUTH_PASSWORD;
	csi.auth.password_len = strlen(CONFIG_NET_SAMPLE_OCPP_AUTH_PASSWORD);
#endif
	ret = ocpp_init(&cpi,
			&csi,
			user_notify_cb,
			NULL);
	if (ret < 0) {
		LOG_ERR("ocpp init failed %d\n", ret);
		return ret;
	}

	/* Spawn threads for each connector */
	for (i = 0; i < NO_OF_CONN; i++) {
		snprintf(idtag[i], sizeof(idtag[0]), "ZepId%02d", i);

		tid[i] = k_thread_create(&tinfo[i], cp_stk[i],
					 sizeof(cp_stk[i]),
					 ocpp_cp_entry, (void *)(uintptr_t)(i + 1),
					 idtag[i], obs[i], 7, 0, K_NO_WAIT);
	}

	/* Active charging session */
	k_sleep(K_SECONDS(30));

	/* Send stop charging to thread */
	for (i = 0; i < NO_OF_CONN; i++) {
		union ocpp_io_value io = {0};

		io.stop_charge.id_con = i + 1;

		zbus_chan_pub(&ch_event, &io, K_MSEC(100));
		k_sleep(K_SECONDS(1));
	}

	/* User could trigger remote start/stop transaction from CS server */
	k_sleep(K_SECONDS(1200));

	return 0;
}
```
