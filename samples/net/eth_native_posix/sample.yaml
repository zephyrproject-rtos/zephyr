## samples/net/eth_native_posix/sample.yaml
```yaml
common:
  harness: net
  tags: net
sample:
  description: Can be used to test native posix connectivity via ethernet.
  name: Native posix ethernet demo application
tests:
  sample.net.eth_native_posix:
    platform_allow:
      - native_posix
      - native_posix_64
    integration_platforms:
      - native_posix
```

## samples/net/ethernet/bridge/boards/mimxrt1180_evk_mimxrt1189_cm33.conf
```kconfig
CONFIG_NET_ETHERNET_BRIDGE_ETH_INTERFACE_COUNT=5
CONFIG_NET_IF_MAX_IPV4_COUNT=8
CONFIG_NET_IF_MAX_IPV6_COUNT=8
```

## samples/net/ethernet/bridge/sample.yaml
```yaml
sample:
  description: Test bridge functionality
  name: bridge sample app
common:
  harness: net
  tags:
    - net
tests:
  sample.net.bridge:
    build_only: true
    platform_allow:
      - native_sim
      - native_sim/native/64
      - mimxrt1180_evk/mimxrt1189/cm33
    depends_on: eth
```

## samples/net/ethernet/dsa/sample.yaml
```yaml
sample:
  description: Test DSA functionality
  name: DSA sample app
common:
  harness: net
  tags:
    - net
    - dsa
tests:
  sample.net.dsa:
    build_only: true
    platform_allow:
      - mimxrt1180_evk/mimxrt1189/cm33
      - mimxrt1180_evk/mimxrt1189/cm7
      - frdm_imxrt1186/mimxrt1186/cm33
      - frdm_imxrt1186/mimxrt1186/cm7/extmem
      - imx943_evk/mimx94398/m33/ddr
      - imx943_evk/mimx94398/a55
    depends_on: eth
```

## samples/net/ethernet/gptp/boards/frdm_k64f.conf
```kconfig
CONFIG_NET_CONFIG_MY_IPV6_ADDR="2001:db8::2"
CONFIG_NET_CONFIG_PEER_IPV6_ADDR="2001:db8::1"
CONFIG_NET_CONFIG_MY_IPV4_ADDR="192.0.2.2"
CONFIG_NET_CONFIG_PEER_IPV4_ADDR="192.0.2.1"
CONFIG_CBPRINTF_FP_SUPPORT=y
CONFIG_CBPRINTF_FP_A_SUPPORT=y
CONFIG_CBPRINTF_FP_ALWAYS_A=y
CONFIG_NET_GPTP_NEIGHBOR_PROP_DELAY_THR=1000000
```

## samples/net/ethernet/gptp/boards/imx943_evk_mimx94398_m33_ddr.conf
```kconfig
CONFIG_NET_L2_ETHERNET=y
CONFIG_ETH_DRIVER=y
CONFIG_NET_IF_MAX_IPV4_COUNT=7
CONFIG_NET_DSA=y
CONFIG_NET_GPTP_MONITOR_SYNC_STATUS=y
CONFIG_NET_GPTP_NUM_PORTS=5
```

## samples/net/ethernet/gptp/boards/mimxrt1050_evk_mimxrt1052_hyperflash.conf
```kconfig
CONFIG_NET_CONFIG_MY_IPV6_ADDR="2001:db8::2"
CONFIG_NET_CONFIG_PEER_IPV6_ADDR="2001:db8::1"
CONFIG_NET_CONFIG_MY_IPV4_ADDR="192.0.2.2"
CONFIG_NET_CONFIG_PEER_IPV4_ADDR="192.0.2.1"
CONFIG_ETH_NXP_ENET_RX_BUFFERS=6
CONFIG_ETH_NXP_ENET_TX_BUFFERS=4
CONFIG_NET_GPTP_STATISTICS=y
CONFIG_REQUIRES_FULL_LIBC=y
CONFIG_REQUIRES_FLOAT_PRINTF=y
```

## samples/net/ethernet/lldp/sample.yaml
```yaml
common:
  harness: net
  tags:
    - net
    - lldp
sample:
  description: Test LLDP functionality
  name: LLDP sample app
tests:
  sample.net.lldp:
    platform_allow:
      - native_sim
      - native_sim/native/64
    integration_platforms:
      - native_sim
    depends_on: eth
```

## samples/net/google_iot_mqtt/Kconfig
```kconfig
# Kconfig - Private config options for Google Cloud IOT application

#
# Copyright (c) 2018 Linaro
#
# SPDX-License-Identifier: Apache-2.0
#

mainmenu "Google IOT MQTT/TLS sample application"

config CLOUD_CLIENT_ID
	string "Client ID string"
	default "put client string here"
	help
	  Set required client string that matches Google Cloud project

config CLOUD_AUDIENCE
	string "Audience string"
	default "put audience string here"
	help
	  Set required audience string that matches Google Cloud project

config CLOUD_SUBSCRIBE_CONFIG
	string "Subscription string for config"
	default "put subscription string here"
	help
	  Set required subscription string that matches Google Cloud project
	  config item.

config CLOUD_PUBLISH_TOPIC
	string "Publish topic string"
	default "put topic string here"
	help
	  Set publish topics string that matches Google Cloud project

source "Kconfig.zephyr"
```

## samples/net/google_iot_mqtt/sample.yaml
```yaml
common:
  harness: net
  tags: net
sample:
  name: Full stack sample
tests:
  test:
    depends_on: netif
```

## samples/net/gptp/boards/mimxrt1050_evk_mimxrt1052.conf
```kconfig
CONFIG_PTP_CLOCK_MCUX=y
CONFIG_NET_CONFIG_MY_IPV6_ADDR="2001:db8::2"
CONFIG_NET_CONFIG_PEER_IPV6_ADDR="2001:db8::1"
CONFIG_NET_CONFIG_MY_IPV4_ADDR="192.0.2.2"
CONFIG_NET_CONFIG_PEER_IPV4_ADDR="192.0.2.1"
CONFIG_ETH_MCUX_PTP_CLOCK_SRC_HZ=25000000
CONFIG_ETH_MCUX_RX_BUFFERS=6
CONFIG_ETH_MCUX_TX_BUFFERS=4
CONFIG_NET_GPTP_STATISTICS=y
CONFIG_REQUIRES_FULL_LIBC=y
CONFIG_REQUIRES_FLOAT_PRINTF=y
```

## samples/net/gptp/boards/mimxrt1060_evk_mimxrt1062.conf
```kconfig
CONFIG_PTP_CLOCK_MCUX=y
CONFIG_ETH_MCUX_PTP_CLOCK_SRC_HZ=25000000
CONFIG_NET_GPTP_NEIGHBOR_PROP_DELAY_THR=1000000
CONFIG_NET_GPTP_PROBE_CLOCK_SOURCE_ON_DEMAND=y
CONFIG_NET_GPTP_CLOCK_ACCURACY_25MS=y
#CONFIG_ETH_MCUX_RX_BUFFERS=6
#CONFIG_ETH_MCUX_TX_BUFFERS=8
CONFIG_NET_GPTP_STATISTICS=y
CONFIG_REQUIRES_FLOAT_PRINTF=y
CONFIG_REQUIRES_FULL_LIBC=y
CONFIG_NET_GPTP_INIT_LOG_PDELAY_REQ_ITV=-3
```

## samples/net/gptp/boards/mimxrt1170_evk_cm7.conf
```kconfig
CONFIG_PTP_CLOCK_MCUX=y
CONFIG_ETH_MCUX_RX_BUFFERS=4
CONFIG_ETH_MCUX_TX_BUFFERS=4
CONFIG_NEWLIB_LIBC_FLOAT_PRINTF=y
CONFIG_NEWLIB_LIBC=y
CONFIG_INIT_ARCH_HW_AT_BOOT=y
CONFIG_ETH_MCUX_PTP_CLOCK_SRC_HZ=100000000
```

## samples/net/gptp/boards/native_posix.conf
```kconfig
# Settings for native_posix ethernet driver
CONFIG_SYS_LOG_ETHERNET_LEVEL=1
CONFIG_ETH_NATIVE_POSIX_PTP_CLOCK=y

#CONFIG_ETH_NATIVE_POSIX_RANDOM_MAC=y
CONFIG_ETH_NATIVE_POSIX_MAC_ADDR="00:00:5e:00:53:2a"
```

## samples/net/gptp/boards/native_sim.conf
```kconfig
# Settings for native_sim / native_tap ethernet driver
CONFIG_ETH_NATIVE_TAP_PTP_CLOCK=y

#CONFIG_ETH_NATIVE_TAP_RANDOM_MAC=y
CONFIG_ETH_NATIVE_TAP_MAC_ADDR="00:00:5e:00:53:2a"

# Assume 1 ms accuracy for native_sim simulated clock
CONFIG_NET_GPTP_CLOCK_ACCURACY_1MS=y
```

## samples/net/gptp/boards/sam_e70_xplained.conf
```kconfig
# GMAC driver settings
CONFIG_PTP_CLOCK_SAM_GMAC=y

CONFIG_ETH_SAM_GMAC_MAC_I2C_EEPROM=y
```

## samples/net/gptp/sample.yaml
```yaml
common:
  harness: net
  tags:
    - net
    - gptp
sample:
  description: Test gPTP functionality
  name: gPTP sample app
tests:
  sample.net.gptp:
    platform_allow:
      - frdm_k64f
      - sam_e70_xplained/same70q21
      - native_posix
      - native_posix/native/64
      - native_sim
      - native_sim/native/64
      - nucleo_f767zi
      - nucleo_h743zi
      - nucleo_h745zi_q/stm32h745xx/m7
    depends_on: eth
    integration_platforms:
      - frdm_k64f
```
