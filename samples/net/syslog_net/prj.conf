## CMakeLists.txt
```
# SPDX-License-Identifier: Apache-2.0

cmake_minimum_required(VERSION 3.28.0)

find_package(Zephyr REQUIRED HINTS $ENV{ZEPHYR_BASE})
project(syslog_net)

FILE(GLOB app_sources src/*.c)
target_sources(app PRIVATE ${app_sources})

include(${ZEPHYR_BASE}/samples/net/common/common.cmake)
```

## Kconfig
```
# Private config options for syslog-net sample app

# Copyright (c) 2020 Intel Corporation
# SPDX-License-Identifier: Apache-2.0

mainmenu "Networking syslog sample application"

config NET_SAMPLE_SEND_ITERATIONS
	int "Send sample data this many times"
	default 0
	help
	  Send sample data this many times before exiting. A value of
	  zero means that the defaults in the application are used.


config NET_SAMPLE_SERVER_RUNTIME
	string "Syslog server IP address set at runtime"
	help
	  Server address for the syslog server.
	  This server address gets set at runtime by the sample
	  app before the backend is initialized. This can be
	  either IPv4 or IPv6 address. Server listen UDP port
	  number can be configured here too.
	  Following syntax is supported:
	  192.0.2.1:514
	  192.0.2.42
	  [2001:db8::1]:514
	  [2001:db8::2]
	  2001:db::42

source "Kconfig.zephyr"
```

## sample.yaml
```
common:
  harness: net
  depends_on: netif
  tags:
    - net
    - syslog
sample:
  description: syslog network backend
  name: syslog_net
tests:
  sample.net.syslog.with_timefuncs:
    filter: CONFIG_FULL_LIBC_SUPPORTED
    extra_configs:
      - CONFIG_REQUIRES_FULL_LIBC=y
  sample.net.syslog.ipv4_only:
    filter: CONFIG_FULL_LIBC_SUPPORTED
    extra_configs:
      - CONFIG_NET_IPV6=n
      - CONFIG_NET_CONFIG_NEED_IPV6=n
      - CONFIG_NET_CONFIG_MY_IPV6_ADDR=""
      - CONFIG_NET_CONFIG_PEER_IPV6_ADDR=""
      - CONFIG_NET_CONFIG_MY_IPV6_GW=""
      - CONFIG_LOG_BACKEND_NET_SERVER="192.0.2.1:514"
      - CONFIG_DNS_SERVER1="192.0.2.2"
  sample.net.syslog.ipv6_only:
    filter: CONFIG_FULL_LIBC_SUPPORTED
    extra_configs:
      - CONFIG_NET_IPV4=n
      - CONFIG_NET_CONFIG_NEED_IPV4=n
      - CONFIG_NET_CONFIG_MY_IPV4_ADDR=""
      - CONFIG_NET_CONFIG_PEER_IPV4_ADDR=""
      - CONFIG_NET_CONFIG_MY_IPV4_GW=""
  sample.net.syslog.no_autostart:
    filter: CONFIG_FULL_LIBC_SUPPORTED
    extra_configs:
      - CONFIG_LOG_BACKEND_NET_AUTOSTART=n
  sample.net.syslog.net_conn_mgr:
    filter: CONFIG_FULL_LIBC_SUPPORTED
    extra_configs:
      - CONFIG_NET_CONNECTION_MANAGER=y
  sample.net.syslog.runtime_srv_addr:
    filter: CONFIG_FULL_LIBC_SUPPORTED
    extra_configs:
      - CONFIG_LOG_BACKEND_NET_AUTOSTART=n
      - CONFIG_LOG_BACKEND_NET_SERVER=""
      - CONFIG_NET_SAMPLE_SERVER_RUNTIME="192.0.2.2:514"
  sample.net.syslog.wifi.nrf70dk:
    extra_args:
      - SNIPPET=wifi-ipv4
      - CONFIG_BUILD_ONLY_NO_BLOBS=y
    platform_allow:
      - nrf7002dk/nrf5340/cpuapp
```

## prj.conf
```kconfig
CONFIG_NETWORKING=y
CONFIG_NET_UDP=y
CONFIG_ENTROPY_GENERATOR=y
CONFIG_TEST_RANDOM_GENERATOR=y
CONFIG_INIT_STACKS=y
CONFIG_NET_PKT_RX_COUNT=32
CONFIG_NET_PKT_TX_COUNT=32
CONFIG_NET_BUF_RX_COUNT=32
CONFIG_NET_BUF_TX_COUNT=32
CONFIG_NET_SOCKETS=y

CONFIG_NET_IF_UNICAST_IPV6_ADDR_COUNT=3
CONFIG_NET_IF_MCAST_IPV6_ADDR_COUNT=5

CONFIG_NET_LOG=y
CONFIG_LOG=y

# Deferred mode is required, synchronous mode does not work with network syslog
# as it would cause the sent packet to be malformed (contains only 1 byte data)
CONFIG_LOG_MODE_DEFERRED=y

CONFIG_NET_IPV6=y
CONFIG_NET_IPV4=y
CONFIG_NET_DHCPV4=n

CONFIG_NET_SHELL=y

CONFIG_NET_CONFIG_SETTINGS=y
CONFIG_NET_CONFIG_NEED_IPV6=y
CONFIG_NET_CONFIG_NEED_IPV4=y
CONFIG_NET_CONFIG_MY_IPV6_ADDR="2001:db8::1"
CONFIG_NET_CONFIG_PEER_IPV6_ADDR="2001:db8::2"
CONFIG_NET_CONFIG_MY_IPV4_ADDR="192.0.2.1"
CONFIG_NET_CONFIG_PEER_IPV4_ADDR="192.0.2.2"

# logging net backend config
CONFIG_LOG_BACKEND_NET=y
CONFIG_POSIX_C_LANG_SUPPORT_R=y
CONFIG_LOG_BACKEND_NET_SERVER="[2001:db8::2]:514"
```

## overlay-runtime-srv-addr.conf
```kconfig
CONFIG_LOG_BACKEND_NET_SERVER=""
CONFIG_LOG_BACKEND_NET_AUTOSTART=n
CONFIG_NET_SAMPLE_SERVER_RUNTIME="192.0.2.2:514"
```

## boards/native_posix.conf
```kconfig
# To avoid flood of missing log_strdup messages
CONFIG_LOG_DETECT_MISSED_STRDUP=n
```

## src/main.c
```c
/*
 * Copyright (c) 2018 Intel Corporation.
 *
 * SPDX-License-Identifier: Apache-2.0
 */

#include <zephyr/logging/log.h>
LOG_MODULE_REGISTER(net_syslog, LOG_LEVEL_DBG);

#include <zephyr/kernel.h>

#include <zephyr/logging/log_backend.h>
#include <zephyr/logging/log_backend_net.h>
#include <zephyr/logging/log_ctrl.h>

#include <stdlib.h>

#include <zephyr/net/conn_mgr_monitor.h>
#include "net_sample_common.h"

BUILD_ASSERT(IS_ENABLED(CONFIG_LOG_BACKEND_NET), "syslog backend not enabled");

#define SLEEP_BETWEEN_PRINTS 3

int main(void)
{
	int i, count, sleep;

	LOG_DBG("Starting");

	LOG_INF("Waiting for network...");
	(void)conn_mgr_wait_ready(CONN_MGR_READY_IP_ANY, NULL, K_FOREVER);
	LOG_INF("Network ready");

	if (!IS_ENABLED(CONFIG_LOG_BACKEND_NET_AUTOSTART)) {
		/* Example how to start the backend if autostart is disabled.
		 * This is useful if the application needs to wait the network
		 * to be fully up before the syslog-net is able to work.
		 */
		const struct log_backend *backend = log_backend_net_get();

		if (!log_backend_is_active(backend)) {

			/* Specifying an address by calling this function will
			 * override the value given to LOG_BACKEND_NET_SERVER.
			   It can also be called at any other time after the backend
			   is started. The net context will be released and
			   restarted with the newly specified address.
			 */
			if (strlen(CONFIG_LOG_BACKEND_NET_SERVER) == 0) {
				log_backend_net_set_addr(CONFIG_NET_SAMPLE_SERVER_RUNTIME);
			}
			log_backend_init(backend);
			log_backend_enable(backend, backend->cb->ctx, CONFIG_LOG_MAX_LEVEL);
		}
	}

	if (CONFIG_NET_SAMPLE_SEND_ITERATIONS) {
		count = CONFIG_NET_SAMPLE_SEND_ITERATIONS;
		sleep = 500;

		/* This will let the Docker process to start listening */
		k_msleep(1500);

		LOG_DBG("Sending total %d messages", 4 * count);
	} else {
		count = 60 / SLEEP_BETWEEN_PRINTS;
		sleep = SLEEP_BETWEEN_PRINTS * MSEC_PER_SEC;
	}

	/* Allow some setup time before starting to send data */
	k_msleep(sleep);

	i = count;

	do {
		LOG_ERR("Error message (%d)", i);
		LOG_WRN("Warning message (%d)", i);
		LOG_INF("Info message (%d)", i);
		LOG_DBG("Debug message (%d)", i);

		k_msleep(sleep);

	} while (--i);

	LOG_DBG("Stopped after %d msg", count);

	if (CONFIG_NET_SAMPLE_SEND_ITERATIONS) {
		/* We get here when doing Docker based testing */
		k_msleep(1000);
		exit(0);
	}
	return 0;
}
```
