## CMakeLists.txt
```
cmake_minimum_required(VERSION 3.13.1)
include($ENV{ZEPHYR_BASE}/cmake/app/boilerplate.cmake NO_POLICY_SCOPE)
project(http_client)

FILE(GLOB app_sources src/*.c)
target_sources(app PRIVATE ${app_sources})

include($ENV{ZEPHYR_BASE}/samples/net/common/common.cmake)

generate_inc_file_for_target(
  app
  src/echo-apps-cert.der
  ${ZEPHYR_BINARY_DIR}/include/generated/echo-apps-cert.der.inc
  )
```

## sample.yaml
```
common:
    harness: net
    tags: net http
sample:
  name: HTTP Client
tests:
  test:
    depends_on: netif
    min_flash: 140
  test_bt:
    extra_args: CONF_FILE="prj_bt.conf"
    platform_whitelist: qemu_x86 qemu_cortex_m3
  test_tls:
    extra_args: CONF_FILE="prj_tls.conf"
    platform_whitelist: qemu_x86 qemu_cortex_m3
```

## prj.conf
```kconfig
CONFIG_NETWORKING=y
CONFIG_NET_TCP=y
CONFIG_ENTROPY_GENERATOR=y
CONFIG_TEST_RANDOM_GENERATOR=y
CONFIG_NET_LOG=y
CONFIG_LOG=y
CONFIG_INIT_STACKS=y

CONFIG_NET_PKT_RX_COUNT=32
CONFIG_NET_PKT_TX_COUNT=32
CONFIG_NET_BUF_RX_COUNT=32
CONFIG_NET_BUF_TX_COUNT=32

CONFIG_NET_IF_UNICAST_IPV6_ADDR_COUNT=2
CONFIG_NET_IF_MCAST_IPV6_ADDR_COUNT=4

CONFIG_NET_MAX_CONTEXTS=16

CONFIG_HTTP=y
CONFIG_HTTP_CLIENT=y

CONFIG_NET_IPV6=y
CONFIG_NET_IPV4=y
#CONFIG_NET_DHCPV4=y

CONFIG_HTTPS=n
CONFIG_MBEDTLS=n

CONFIG_NET_CONFIG_SETTINGS=y
CONFIG_NET_CONFIG_MY_IPV6_ADDR="2001:db8::1"
CONFIG_NET_CONFIG_MY_IPV4_ADDR="192.0.2.1"
CONFIG_NET_CONFIG_PEER_IPV6_ADDR="2001:db8::2"
CONFIG_NET_CONFIG_PEER_IPV4_ADDR="192.0.2.2"

CONFIG_NET_CONFIG_NEED_IPV6=y
CONFIG_NET_CONFIG_NEED_IPV4=y

CONFIG_NET_SHELL=y
CONFIG_NET_STATISTICS=y

CONFIG_NET_MGMT=y
CONFIG_NET_MGMT_EVENT=y

CONFIG_MAIN_STACK_SIZE=2048
```

## prj_arduino_101.conf
```kconfig
CONFIG_RANDOM_GENERATOR=y

CONFIG_NETWORKING=y
CONFIG_NET_TCP=y
CONFIG_NET_ARP=y
CONFIG_NET_L2_ETHERNET=y
CONFIG_NET_LOG=y
CONFIG_NET_SHELL=y

CONFIG_NET_IPV6_RA_RDNSS=y
CONFIG_NET_IFACE_UNICAST_IPV4_ADDR_COUNT=3

CONFIG_NET_PKT_RX_COUNT=64
CONFIG_NET_PKT_TX_COUNT=64
CONFIG_NET_BUF_RX_COUNT=16
CONFIG_NET_BUF_TX_COUNT=16

CONFIG_TEST_RANDOM_GENERATOR=y

CONFIG_NET_IPV4=y
CONFIG_NET_DHCPV4=y
CONFIG_NET_IPV6=n

CONFIG_HTTP_CLIENT=y

CONFIG_STDOUT_CONSOLE=y

# Set the IP addresses here or in the
# src/config.h file
#
CONFIG_NET_APP_SETTINGS=y
CONFIG_NET_APP_MY_IPV6_ADDR="2001:db8::1"
CONFIG_NET_APP_PEER_IPV6_ADDR="2001:db8::2"
CONFIG_NET_APP_MY_IPV4_ADDR="192.0.2.1"
CONFIG_NET_APP_PEER_IPV4_ADDR="192.0.2.2"

CONFIG_NET_MGMT=y
CONFIG_NET_MGMT_EVENT=y

# ENC28J60 Ethernet Device
CONFIG_ETH_ENC28J60=y
CONFIG_ETH_ENC28J60_0=y
CONFIG_ETH_ENC28J60_0_SPI_PORT_NAME="SPI_1"
CONFIG_ETH_ENC28J60_0_MAC3=0x2D
CONFIG_ETH_ENC28J60_0_MAC4=0x30
CONFIG_ETH_ENC28J60_0_MAC5=0x36

# Arduino 101
CONFIG_SPI=y
```

## prj_bt.conf
```kconfig
CONFIG_NETWORKING=y
CONFIG_NET_TCP=y
CONFIG_ENTROPY_GENERATOR=y
CONFIG_TEST_RANDOM_GENERATOR=y
CONFIG_NET_LOG=y
CONFIG_LOG=y
CONFIG_INIT_STACKS=y

CONFIG_NET_PKT_RX_COUNT=32
CONFIG_NET_PKT_TX_COUNT=32
CONFIG_NET_BUF_RX_COUNT=32
CONFIG_NET_BUF_TX_COUNT=32

CONFIG_NET_IF_UNICAST_IPV6_ADDR_COUNT=2
CONFIG_NET_IF_MCAST_IPV6_ADDR_COUNT=4

CONFIG_NET_MAX_CONTEXTS=16

CONFIG_HTTP=y
CONFIG_HTTP_CLIENT=y

CONFIG_NET_IPV6=y

CONFIG_HTTPS=n
CONFIG_MBEDTLS=y
CONFIG_MBEDTLS_BUILTIN=y
CONFIG_MBEDTLS_CFG_FILE="config-mini-tls1_2.h"
CONFIG_MBEDTLS_SSL_MAX_CONTENT_LEN=2500
CONFIG_MBEDTLS_ENABLE_HEAP=y
CONFIG_MBEDTLS_HEAP_SIZE=12000

CONFIG_NET_CONFIG_SETTINGS=y
CONFIG_NET_CONFIG_MY_IPV6_ADDR="2001:db8::1"
CONFIG_NET_CONFIG_PEER_IPV6_ADDR="2001:db8::2"

CONFIG_NET_CONFIG_NEED_IPV6=y

CONFIG_NET_SHELL=y
CONFIG_NET_STATISTICS=y

CONFIG_NET_MGMT=y
CONFIG_NET_MGMT_EVENT=y

CONFIG_BT=y
CONFIG_BT_DEBUG_LOG=y
CONFIG_BT_SMP=y
CONFIG_BT_PERIPHERAL=y
CONFIG_BT_L2CAP_DYNAMIC_CHANNEL=y
CONFIG_BT_DEVICE_NAME="Test Http_Client"
CONFIG_NET_L2_BT=y
```

## prj_frdm_k64f.conf
```kconfig
CONFIG_RANDOM_GENERATOR=y

CONFIG_NETWORKING=y
CONFIG_NET_TCP=y
CONFIG_NET_ARP=y
CONFIG_NET_L2_ETHERNET=y
CONFIG_NET_LOG=y
CONFIG_NET_SHELL=y

CONFIG_NET_IPV6_RA_RDNSS=y
CONFIG_NET_IF_UNICAST_IPV4_ADDR_COUNT=3

CONFIG_NET_PKT_RX_COUNT=64
CONFIG_NET_PKT_TX_COUNT=64
CONFIG_NET_BUF_RX_COUNT=64
CONFIG_NET_BUF_TX_COUNT=64

CONFIG_NET_IPV4=y
CONFIG_NET_DHCPV4=y
CONFIG_NET_IPV6=n

CONFIG_HTTP_CLIENT=y

CONFIG_STDOUT_CONSOLE=y

# Set the IP addresses here or in the
# src/config.h file
#
CONFIG_NET_APP_SETTINGS=y
CONFIG_NET_APP_MY_IPV6_ADDR="2001:db8::1"
CONFIG_NET_APP_PEER_IPV6_ADDR="2001:db8::2"
CONFIG_NET_APP_MY_IPV4_ADDR="192.0.2.1"
CONFIG_NET_APP_PEER_IPV4_ADDR="192.0.2.2"

CONFIG_NET_MGMT=y
CONFIG_NET_MGMT_EVENT=y
```

## prj_qemu_x86.conf
```kconfig
CONFIG_NETWORKING=y
CONFIG_NET_TCP=y
CONFIG_RANDOM_GENERATOR=y
CONFIG_TEST_RANDOM_GENERATOR=y
CONFIG_NET_LOG=y
CONFIG_INIT_STACKS=y

CONFIG_NET_PKT_RX_COUNT=64
CONFIG_NET_PKT_TX_COUNT=64
CONFIG_NET_BUF_RX_COUNT=64
CONFIG_NET_BUF_TX_COUNT=64

CONFIG_NET_IPV6_RA_RDNSS=y
CONFIG_NET_IF_UNICAST_IPV6_ADDR_COUNT=2
CONFIG_NET_IF_MCAST_IPV6_ADDR_COUNT=4

CONFIG_INIT_STACKS=y

CONFIG_SYS_LOG_SHOW_COLOR=y
CONFIG_SYS_LOG_NET_LEVEL=4
#CONFIG_NET_DEBUG_HTTP=y

CONFIG_HTTP_CLIENT=y

CONFIG_NET_IPV6=y
CONFIG_NET_IPV4=y
CONFIG_NET_DHCPV4=y

CONFIG_NET_APP_SETTINGS=y
CONFIG_NET_APP_MY_IPV6_ADDR="2001:db8::1"
CONFIG_NET_APP_PEER_IPV6_ADDR="2001:db8::2"

CONFIG_NET_APP_MY_IPV4_ADDR="192.0.2.1"
CONFIG_NET_APP_PEER_IPV4_ADDR="192.0.2.2"

CONFIG_NET_SHELL=y

CONFIG_DNS_RESOLVER=y
CONFIG_DNS_RESOLVER_ADDITIONAL_BUF_CTR=2
CONFIG_DNS_RESOLVER_ADDITIONAL_QUERIES=2
CONFIG_DNS_RESOLVER_MAX_SERVERS=2
CONFIG_DNS_SERVER_IP_ADDRESSES=y
CONFIG_DNS_NUM_CONCUR_QUERIES=2

CONFIG_NET_MGMT=y
CONFIG_NET_MGMT_EVENT=y

# Example DNS servers running in linux using dnsmasq
CONFIG_DNS_SERVER1="192.0.2.2:5353"
CONFIG_DNS_SERVER2="[2001:db8::2]:5353"
```

## prj_tls.conf
```kconfig
CONFIG_NETWORKING=y
CONFIG_NET_TCP=y
CONFIG_ENTROPY_GENERATOR=y
CONFIG_TEST_RANDOM_GENERATOR=y
CONFIG_NET_LOG=y
CONFIG_LOG=y
CONFIG_INIT_STACKS=y

CONFIG_NET_PKT_RX_COUNT=32
CONFIG_NET_PKT_TX_COUNT=32
CONFIG_NET_BUF_RX_COUNT=32
CONFIG_NET_BUF_TX_COUNT=32

CONFIG_NET_IF_UNICAST_IPV6_ADDR_COUNT=2
CONFIG_NET_IF_MCAST_IPV6_ADDR_COUNT=4

CONFIG_NET_MAX_CONTEXTS=16

CONFIG_HTTP=y
CONFIG_HTTP_CLIENT=y

CONFIG_NET_IPV6=y
CONFIG_NET_IPV4=y
#CONFIG_NET_DHCPV4=y

CONFIG_HTTPS=y
CONFIG_MBEDTLS=y
CONFIG_MBEDTLS_BUILTIN=y
CONFIG_MBEDTLS_CFG_FILE="config-mini-tls1_2.h"
CONFIG_MBEDTLS_SSL_MAX_CONTENT_LEN=2500
CONFIG_MBEDTLS_ENABLE_HEAP=y
CONFIG_MBEDTLS_HEAP_SIZE=30000

CONFIG_NET_APP_TLS=y
CONFIG_NET_CONFIG_SETTINGS=y
CONFIG_NET_CONFIG_MY_IPV6_ADDR="2001:db8::1"
CONFIG_NET_CONFIG_MY_IPV4_ADDR="192.0.2.1"
CONFIG_NET_CONFIG_PEER_IPV6_ADDR="2001:db8::2"
CONFIG_NET_CONFIG_PEER_IPV4_ADDR="192.0.2.2"

CONFIG_NET_CONFIG_NEED_IPV6=y
CONFIG_NET_CONFIG_NEED_IPV4=y

CONFIG_NET_SHELL=y
CONFIG_NET_STATISTICS=y

CONFIG_NET_MGMT=y
CONFIG_NET_MGMT_EVENT=y

CONFIG_MAIN_STACK_SIZE=1504
```

## src/main.c
```c
/*
 * Copyright (c) 2017 Intel Corporation
 *
 * SPDX-License-Identifier: Apache-2.0
 */

#include <logging/log.h>
LOG_MODULE_REGISTER(net_http_client_sample, LOG_LEVEL_DBG);

#include <zephyr.h>
#include <errno.h>

#include <net/net_core.h>
#include <net/net_ip.h>

#include <net/http.h>

#include <net/net_app.h>

#include "config.h"

#define MAX_ITERATIONS	20
#define WAIT_TIME (APP_REQ_TIMEOUT * 2)

/* The OPTIONS method is problematic as the HTTP server might not support
 * it so turn it off by default.
 */
#define SEND_OPTIONS 0

/*
 * Note that the http_ctx is quite large so be careful if that is
 * allocated from stack.
 */
static struct http_ctx http_ctx;

#if defined(CONFIG_HTTPS)
#define HOSTNAME "localhost"   /* for cert verification if that is enabled */

/* The result buf size is set to large enough so that we can receive max size
 * buf back. Note that mbedtls needs also be configured to have equal size
 * value for its buffer size. See MBEDTLS_SSL_MAX_CONTENT_LEN option in TLS
 * config file.
 */
#define RESULT_BUF_SIZE MBEDTLS_SSL_MAX_CONTENT_LEN
static u8_t https_result_buf[RESULT_BUF_SIZE];

#define INSTANCE_INFO "Zephyr HTTPS client #1"

#define HTTPS_STACK_SIZE (8 * 1024)

NET_STACK_DEFINE(HTTPS, https_stack, HTTPS_STACK_SIZE, HTTPS_STACK_SIZE);

NET_APP_TLS_POOL_DEFINE(ssl_pool, 10);
#endif /* CONFIG_HTTPS */

#if defined(CONFIG_NET_CONTEXT_NET_PKT_POOL)
NET_PKT_TX_SLAB_DEFINE(http_cli_tx, 15);
NET_PKT_DATA_POOL_DEFINE(http_cli_data, 30);

static struct k_mem_slab *tx_slab(void)
{
	return &http_cli_tx;
}

static struct net_buf_pool *data_pool(void)
{
	return &http_cli_data;
}
#else
#if defined(CONFIG_NET_L2_BT)
#error "TCP connections over Bluetooth need CONFIG_NET_CONTEXT_NET_PKT_POOL "\
	"defined."
#endif /* CONFIG_NET_L2_BT */

#define tx_slab NULL
#define data_pool NULL
#endif /* CONFIG_NET_CONTEXT_NET_PKT_POOL */

#if !defined(RESULT_BUF_SIZE)
#define RESULT_BUF_SIZE 1600
#endif

/* This will contain the returned HTTP response to a sent request */
static u8_t result[RESULT_BUF_SIZE];

struct waiter {
	struct http_ctx *ctx;
	struct k_sem wait;
	size_t total_len;
	size_t header_len;
};

#if defined(CONFIG_HTTPS)
/* Load the certificates etc. In this sample app, we verify that
 * the server is the test server we are communicating against to.
 */

static const char echo_apps_cert_der[] = {
#include "echo-apps-cert.der.inc"
};

#if defined(MBEDTLS_KEY_EXCHANGE__SOME__PSK_ENABLED)
static const unsigned char client_psk[] = {
	0x00, 0x01, 0x02, 0x03, 0x04, 0x05, 0x06, 0x07,
	0x08, 0x09, 0x0a, 0x0b, 0x0c, 0x0d, 0x0e, 0x0f
};

static const char client_psk_id[] = "Client_identity";
#endif

static int setup_cert(struct net_app_ctx *ctx, void *cert)
{
#if defined(MBEDTLS_KEY_EXCHANGE__SOME__PSK_ENABLED)
	mbedtls_ssl_conf_psk(&ctx->tls.mbedtls.conf,
			     client_psk, sizeof(client_psk),
			     (const unsigned char *)client_psk_id,
			     sizeof(client_psk_id) - 1);
#endif

#if defined(MBEDTLS_X509_CRT_PARSE_C)
	{
		mbedtls_x509_crt *ca_cert = cert;
		int ret;

		ret = mbedtls_x509_crt_parse_der(ca_cert,
						 echo_apps_cert_der,
						 sizeof(echo_apps_cert_der));
		if (ret != 0) {
			NET_ERR("mbedtls_x509_crt_parse_der failed "
				"(-0x%x)", -ret);
			return ret;
		}

		mbedtls_ssl_conf_ca_chain(&ctx->tls.mbedtls.conf,
					  ca_cert, NULL);
		mbedtls_ssl_conf_authmode(&ctx->tls.mbedtls.conf,
					  MBEDTLS_SSL_VERIFY_REQUIRED);

		mbedtls_ssl_conf_cert_profile(&ctx->tls.mbedtls.conf,
					    &mbedtls_x509_crt_profile_default);
	}
#endif /* MBEDTLS_X509_CRT_PARSE_C */

	return 0;
}
#endif /* CONFIG_HTTPS */

static int do_sync_http_req(struct http_ctx *ctx,
			    enum http_method method,
			    const char *url,
			    const char *content_type,
			    const char *payload,
			    int count)
{
	struct http_request req = {};
	int ret;

	req.method = method;
	req.url = url;
	req.protocol = " " HTTP_PROTOCOL;

	NET_INFO("[%d] Send %s", count, url);

	ret = http_client_send_req(ctx, &req, NULL, result, sizeof(result),
				   NULL, APP_REQ_TIMEOUT);
	if (ret < 0) {
		NET_ERR("Cannot send %s request (%d)", http_method_str(method),
			ret);
		goto out;
	}

	if (ctx->http.rsp.data_len > sizeof(result)) {
		NET_ERR("Result buffer overflow by %zd bytes",
		       ctx->http.rsp.data_len - sizeof(result));

		ret = -E2BIG;
	} else {
		NET_INFO("HTTP server response status: %s",
			 ctx->http.rsp.http_status);

		if (ctx->http.parser.http_errno) {
			if (method == HTTP_OPTIONS) {
				/* Ignore error if OPTIONS is not found */
				goto out;
			}

			NET_INFO("HTTP parser status: %s",
			       http_errno_description(
				       ctx->http.parser.http_errno));
			ret = -EINVAL;
			goto out;
		}

		if (method != HTTP_HEAD) {
			if (ctx->http.rsp.body_found) {
				NET_INFO("HTTP body: %zd bytes, "
					 "expected: %zd bytes",
					 ctx->http.rsp.processed,
					 ctx->http.rsp.content_length);
			} else {
				NET_ERR("Error detected during HTTP msg "
					"processing");
			}
		}
	}

out:
	http_close(ctx);

	return ret;
}

void response(struct http_ctx *ctx,
	      u8_t *data, size_t buflen,
	      size_t datalen,
	      enum http_final_call data_end,
	      void *user_data)
{
	struct waiter *waiter = user_data;
	int ret;

	if (data_end == HTTP_DATA_MORE) {
		NET_INFO("Received %zd bytes piece of data", datalen);

		/* Do something with the data here. For this example
		 * we just ignore the received data.
		 */
		waiter->total_len += datalen;

		if (ctx->http.rsp.body_start) {
			/* This fragment contains the start of the body
			 * Note that the header length is not proper if
			 * the header is spanning over multiple recv
			 * fragments.
			 */
			waiter->header_len = ctx->http.rsp.body_start -
				ctx->http.rsp.response_buf;
		}

		return;
	}

	waiter->total_len += datalen;

	NET_INFO("HTTP server response status: %s", ctx->http.rsp.http_status);

	if (ctx->http.parser.http_errno) {
		if (ctx->http.req.method == HTTP_OPTIONS) {
			/* Ignore error if OPTIONS is not found */
			goto out;
		}

		NET_INFO("HTTP parser status: %s",
			 http_errno_description(ctx->http.parser.http_errno));
		ret = -EINVAL;
		goto out;
	}

	if (ctx->http.req.method != HTTP_HEAD &&
	    ctx->http.req.method != HTTP_OPTIONS) {
		if (ctx->http.rsp.body_found) {
			NET_INFO("HTTP body: %zd bytes, expected: %zd bytes",
				 ctx->http.rsp.processed,
				 ctx->http.rsp.content_length);
		} else {
			NET_ERR("Error detected during HTTP msg processing");
		}

		if (waiter->total_len !=
		    waiter->header_len + ctx->http.rsp.content_length) {
			NET_ERR("Error while receiving data, "
				"received %zd expected %zd bytes",
				waiter->total_len, waiter->header_len +
				ctx->http.rsp.content_length);
		}
	}

out:
	k_sem_give(&waiter->wait);
}

static int do_async_http_req(struct http_ctx *ctx,
			     enum http_method method,
			     const char *url,
			     const char *content_type,
			     const char *payload,
			     int count)
{
	struct http_request req = {};
	struct waiter waiter;
	int ret;

	req.method = method;
	req.url = url;
	req.protocol = " " HTTP_PROTOCOL;

	k_sem_init(&waiter.wait, 0, 1);

	waiter.total_len = 0;

	NET_INFO("[%d] Send %s", count, url);

	ret = http_client_send_req(ctx, &req, response, result, sizeof(result),
				   &waiter, APP_REQ_TIMEOUT);
	if (ret < 0 && ret != -EINPROGRESS) {
		NET_ERR("Cannot send %s request (%d)", http_method_str(method),
			ret);
		goto out;
	}

	if (k_sem_take(&waiter.wait, WAIT_TIME)) {
		NET_ERR("Timeout while waiting HTTP response");
		ret = -ETIMEDOUT;
		http_request_cancel(ctx);
		goto out;
	}

	ret = 0;

out:
	http_close(ctx);

	return ret;
}

static inline int do_sync_reqs(struct http_ctx *ctx, int count)
{
	int max_count = count;
	int ret;

	/* These examples use the HTTP client API synchronously so they
	 * do not set the callback parameter.
	 */
	while (count--) {
		ret = do_sync_http_req(&http_ctx, HTTP_GET, "/index.html",
				       NULL, NULL, max_count - count);
		if (ret < 0) {
			goto out;
		}

		ret = do_sync_http_req(&http_ctx, HTTP_HEAD, "/",
				       NULL, NULL, max_count - count);
		if (ret < 0) {
			goto out;
		}

#if SEND_OPTIONS
		ret = do_sync_http_req(&http_ctx, HTTP_OPTIONS, "/index.html",
				       NULL, NULL, max_count - count);
		if (ret < 0) {
			goto out;
		}
#endif

		ret = do_sync_http_req(&http_ctx, HTTP_POST, "/post_test.php",
				       POST_CONTENT_TYPE, POST_PAYLOAD,
				       max_count - count);
		if (ret < 0) {
			goto out;
		}

		/* Note that we cannot receive data bigger than RESULT_BUF_SIZE
		 * if we wait the buffer synchronously. If you want to receive
		 * bigger data, then you need to set the callback when sending
		 * the HTTP request using http_client_send_req()
		 */
	}

out:
	return ret;
}

static inline int do_async_reqs(struct http_ctx *ctx, int count)
{
	int max_count = count;
	int ret;

	/* These examples use the HTTP client API asynchronously so they
	 * do set the callback parameter.
	 */
	while (count--) {
		ret = do_async_http_req(&http_ctx, HTTP_GET, "/index.html",
					NULL, NULL, max_count - count);
		if (ret < 0) {
			goto out;
		}

		ret = do_async_http_req(&http_ctx, HTTP_HEAD, "/",
					NULL, NULL, max_count - count);
		if (ret < 0) {
			goto out;
		}

#if SEND_OPTIONS
		ret = do_async_http_req(&http_ctx, HTTP_OPTIONS, "/index.html",
					NULL, NULL, max_count - count);
		if (ret < 0) {
			goto out;
		}
#endif

		ret = do_async_http_req(&http_ctx, HTTP_POST, "/post_test.php",
					POST_CONTENT_TYPE, POST_PAYLOAD,
					max_count - count);
		if (ret < 0) {
			goto out;
		}

		ret = do_async_http_req(&http_ctx, HTTP_GET, "/big-file.html",
					NULL, NULL, max_count - count);
		if (ret < 0) {
			goto out;
		}
	}

out:
	return ret;
}

static void http_received(struct http_ctx *ctx,
			  struct net_pkt *pkt,
			  int status,
			  u32_t flags,
			  const struct sockaddr *dst,
			  void *user_data)
{
	if (!status) {
		if (pkt) {
			NET_DBG("Received %d bytes data",
				net_pkt_appdatalen(pkt));
			net_pkt_unref(pkt);
		}
	} else {
		NET_ERR("Receive error (%d)", status);

		if (pkt) {
			net_pkt_unref(pkt);
		}
	}
}

void main(void)
{
	int ret;

	ret = http_client_init(&http_ctx, SERVER_ADDR, SERVER_PORT, NULL,
			       K_FOREVER);
	if (ret < 0) {
		NET_ERR("HTTP init failed (%d)", ret);
		goto out;
	}

#if defined(CONFIG_NET_CONTEXT_NET_PKT_POOL)
	net_app_set_net_pkt_pool(&http_ctx.app_ctx, tx_slab, data_pool);
#endif

	http_set_cb(&http_ctx, NULL, http_received, NULL, NULL);

#if defined(CONFIG_HTTPS)
	ret = http_client_set_tls(&http_ctx,
				  https_result_buf,
				  sizeof(https_result_buf),
				  (u8_t *)INSTANCE_INFO,
				  strlen(INSTANCE_INFO),
				  setup_cert,
				  HOSTNAME,
				  NULL,
				  &ssl_pool,
				  https_stack,
				  K_THREAD_STACK_SIZEOF(https_stack));
	if (ret < 0) {
		NET_ERR("HTTPS init failed (%d)", ret);
		goto out;
	}
#endif

	NET_INFO("--------Sending %d sync request--------", MAX_ITERATIONS);

	ret = do_sync_reqs(&http_ctx, MAX_ITERATIONS);
	if (ret < 0) {
		goto out;
	}

	NET_INFO("--------Sending %d async request--------", MAX_ITERATIONS);

	ret = do_async_reqs(&http_ctx, MAX_ITERATIONS);
	if (ret < 0) {
		goto out;
	}

out:
	http_release(&http_ctx);

	NET_INFO("Done!");
}
```

## src/config.h
```c
/*
 * Copyright (c) 2017 Intel Corporation
 *
 * SPDX-License-Identifier: Apache-2.0
 */

#define APP_REQ_TIMEOUT K_SECONDS(10)

/* The startup time needs to be longish if DHCP is enabled as setting
 * DHCP up takes some time.
 */
#define APP_STARTUP_TIME K_SECONDS(20)

#define POST_CONTENT_TYPE "application/x-www-form-urlencoded"
#define POST_PAYLOAD "os=ZephyrRTOS&arch=" CONFIG_ARCH

#if defined(CONFIG_HTTPS)
#define SERVER_PORT  4443
#else
#define SERVER_PORT  8000
#endif

#if defined(CONFIG_NET_IPV6)
#define SERVER_ADDR CONFIG_NET_CONFIG_PEER_IPV6_ADDR
#else
#define SERVER_ADDR CONFIG_NET_CONFIG_PEER_IPV4_ADDR
#endif
```

## src/http_client.c
```c
/*
 * Copyright (c) 2017 Intel Corporation
 *
 * SPDX-License-Identifier: Apache-2.0
 */

#include "http_client.h"
#include "http_client_rcv.h"
#include "http_client_cb.h"
#include "config.h"

#include <misc/printk.h>

int http_init(struct http_client_ctx *http_ctx)
{
	memset(http_ctx, 0, sizeof(struct http_client_ctx));

	http_ctx->settings.on_body = on_body;
	http_ctx->settings.on_chunk_complete = on_chunk_complete;
	http_ctx->settings.on_chunk_header = on_chunk_header;
	http_ctx->settings.on_headers_complete = on_headers_complete;
	http_ctx->settings.on_header_field = on_header_field;
	http_ctx->settings.on_header_value = on_header_value;
	http_ctx->settings.on_message_begin = on_message_begin;
	http_ctx->settings.on_message_complete = on_message_complete;
	http_ctx->settings.on_status = on_status;
	http_ctx->settings.on_url = on_url;

	return 0;
}

int http_reset_ctx(struct http_client_ctx *http_ctx)
{
	http_parser_init(&http_ctx->parser, HTTP_RESPONSE);

	memset(http_ctx->http_status, 0, sizeof(http_ctx->http_status));

	http_ctx->cl_present = 0;
	http_ctx->content_length = 0;
	http_ctx->processed = 0;
	http_ctx->body_found = 0;

	return 0;
}
```

## src/http_client.h
```c
/*
 * Copyright (c) 2017 Intel Corporation
 *
 * SPDX-License-Identifier: Apache-2.0
 */

#ifndef _HTTP_CLIENT_H_
#define _HTTP_CLIENT_H_

#include "http_client_types.h"
#include "http_client_rcv.h"

int http_init(struct http_client_ctx *http_ctx);

int http_reset_ctx(struct http_client_ctx *http_ctx);

#endif
```

## src/http_client_cb.c
```c
/*
 * Copyright (c) 2017 Intel Corporation
 *
 * SPDX-License-Identifier: Apache-2.0
 */

#include "http_client_cb.h"
#include "http_client_types.h"

#include <stdlib.h>
#include <stdio.h>

#define MAX_NUM_DIGITS	16

int on_url(struct http_parser *parser, const char *at, size_t length)
{
	ARG_UNUSED(parser);

	printf("URL: %.*s\n", (int)length, at);

	return 0;
}

int on_status(struct http_parser *parser, const char *at, size_t length)
{
	struct http_client_ctx *ctx;
	u16_t len;

	ARG_UNUSED(parser);

	ctx = CONTAINER_OF(parser, struct http_client_ctx, parser);
	len = min(length, sizeof(ctx->http_status) - 1);
	memcpy(ctx->http_status, at, len);
	ctx->http_status[len] = 0;

	return 0;
}

int on_header_field(struct http_parser *parser, const char *at, size_t length)
{
	char *content_len = "Content-Length";
	struct http_client_ctx *ctx;
	u16_t len;

	ctx = CONTAINER_OF(parser, struct http_client_ctx, parser);

	len = strlen(content_len);
	if (length >= len && memcmp(at, content_len, len) == 0) {
		ctx->cl_present = 1;
	}

	printf("%.*s: ", (int)length, at);

	return 0;
}

int on_header_value(struct http_parser *parser, const char *at, size_t length)
{
	struct http_client_ctx *ctx;
	char str[MAX_NUM_DIGITS];

	ctx = CONTAINER_OF(parser, struct http_client_ctx, parser);

	if (ctx->cl_present) {
		if (length <= MAX_NUM_DIGITS - 1) {
			long int num;

			memcpy(str, at, length);
			str[length] = 0;
			num = strtol(str, NULL, 10);
			if (num == LONG_MIN || num == LONG_MAX) {
				return -EINVAL;
			}

			ctx->content_length = num;
		}

		ctx->cl_present = 0;
	}

	printf("%.*s\n", (int)length, at);

	return 0;
}

int on_body(struct http_parser *parser, const char *at, size_t length)
{
	struct http_client_ctx *ctx;

	ctx = CONTAINER_OF(parser, struct http_client_ctx, parser);

	ctx->body_found = 1;
	ctx->processed += length;

	return 0;
}

int on_headers_complete(struct http_parser *parser)
{
	ARG_UNUSED(parser);

	return 0;
}

int on_message_begin(struct http_parser *parser)
{
	ARG_UNUSED(parser);

	printf("\n--------- HTTP response (headers) ---------\n");

	return 0;
}

int on_message_complete(struct http_parser *parser)
{
	ARG_UNUSED(parser);

	return 0;
}

int on_chunk_header(struct http_parser *parser)
{
	ARG_UNUSED(parser);

	return 0;
}

int on_chunk_complete(struct http_parser *parser)
{
	ARG_UNUSED(parser);

	return 0;
}
```

## src/http_client_cb.h
```c
/*
 * Copyright (c) 2017 Intel Corporation
 *
 * SPDX-License-Identifier: Apache-2.0
 */

#ifndef _HTTP_CLIENT_CB_H_
#define _HTTP_CLIENT_CB_H_

#include <net/http_parser.h>

/*
 * This are the callbacks executed by the parser. Some of them
 * are only useful when parsing requests (or responses).
 * Unused callbacks may be removed.
 */

int on_url(struct http_parser *parser, const char *at, size_t length);

int on_status(struct http_parser *parser, const char *at, size_t length);

int on_header_field(struct http_parser *parser, const char *at, size_t length);

int on_header_value(struct http_parser *parser, const char *at, size_t length);

int on_body(struct http_parser *parser, const char *at, size_t length);

int on_headers_complete(struct http_parser *parser);

int on_message_begin(struct http_parser *parser);

int on_message_complete(struct http_parser *parser);

int on_chunk_header(struct http_parser *parser);

int on_chunk_complete(struct http_parser *parser);

#endif
```

## src/http_client_rcv.c
```c
/*
 * Copyright (c) 2017 Intel Corporation
 *
 * SPDX-License-Identifier: Apache-2.0
 */

#include "http_client_rcv.h"
#include "http_client_types.h"
#include "config.h"

#include <net/net_pkt.h>

#ifdef LINEARIZE_BUFFER

NET_BUF_POOL_DEFINE(http_pool, HTTP_POOL_BUF_CTR, HTTP_POOL_BUF_SIZE, 0, NULL);

void http_receive_cb(struct tcp_client_ctx *tcp_ctx, struct net_pkt *rx)
{
	struct http_client_ctx *http_ctx;
	struct net_buf *data_buf = NULL;
	u16_t data_len;
	u16_t offset;
	int rc;

	if (!rx) {
		return;
	}

	data_buf = net_buf_alloc(&http_pool, tcp_ctx->timeout);
	if (data_buf == NULL) {
		goto lb_exit;
	}

	data_len = min(net_pkt_appdatalen(rx), HTTP_POOL_BUF_SIZE);
	offset = net_pkt_get_len(rx) - data_len;

	rc = net_frag_linear_copy(data_buf, rx->frags, offset, data_len);
	if (rc != 0) {
		rc = -ENOMEM;
		goto lb_exit;
	}

	http_ctx = CONTAINER_OF(tcp_ctx, struct http_client_ctx, tcp_ctx);

	/* The parser's error can be catched outside, reading the
	 * http_errno struct member
	 */
	http_parser_execute(&http_ctx->parser, &http_ctx->settings,
			    data_buf->data, data_buf->len);

lb_exit:
	net_buf_unref(data_buf);
	net_pkt_unref(rx);
}

#else

void http_receive_cb(struct tcp_client_ctx *tcp_ctx, struct net_pkt *rx)
{
	struct http_client_ctx *http_ctx;
	struct net_buf *frag = rx->frags;
	u16_t offset;

	if (!rx) {
		return;
	}

	http_ctx = CONTAINER_OF(tcp_ctx, struct http_client_ctx, tcp_ctx);

	offset = net_pkt_get_len(rx) - net_pkt_appdatalen(rx);

	/* find the fragment */
	while (frag && offset >= frag->len) {
		offset -= frag->len;
		frag = frag->frags;
	}

	while (frag) {
		(void)http_parser_execute(&http_ctx->parser,
					  &http_ctx->settings,
					  frag->data + offset,
					  frag->len - offset);

		/* after the first iteration, we set offset to 0 */
		offset = 0;

		/* The parser's error can be catched outside, reading the
		 * http_errno struct member
		 */
		if (http_ctx->parser.http_errno != HPE_OK) {
			goto lb_exit;
		}

		frag = frag->frags;
	}

lb_exit:
	net_pkt_unref(rx);
}

#endif
```

## src/http_client_rcv.h
```c
/*
 * Copyright (c) 2017 Intel Corporation
 *
 * SPDX-License-Identifier: Apache-2.0
 */

#ifndef _HTTP_CLIENT_RCV_H_
#define _HTTP_CLIENT_RCV_H_

#include "tcp_client.h"

/* HTTP reception callback */
void http_receive_cb(struct tcp_client_ctx *tcp_ctx, struct net_pkt *rx);

#endif
```

## src/http_client_types.h
```c
/*
 * Copyright (c) 2017 Intel Corporation
 *
 * SPDX-License-Identifier: Apache-2.0
 */

#ifndef _HTTP_CLIENT_TYPES_H_
#define _HTTP_CLIENT_TYPES_H_

#include <net/http_parser.h>
#include "tcp_client.h"
#include "config.h"

struct http_client_ctx {
	struct http_parser parser;
	struct http_parser_settings settings;

	struct tcp_client_ctx tcp_ctx;

	u32_t content_length;
	u32_t processed;

	/* https://tools.ietf.org/html/rfc7230#section-3.1.2
	 * The status-code element is a 3-digit integer code
	 *
	 * The reason-phrase element exists for the sole purpose of
	 * providing a textual description associated with the
	 * numeric status code. A client SHOULD ignore the
	 * reason-phrase content.
	 */
	char http_status[HTTP_STATUS_STR_SIZE];

	u8_t cl_present:1;
	u8_t body_found:1;
};

#endif
```

## src/tcp_client.c
```c
/*
 * Copyright (c) 2017 Intel Corporation
 *
 * SPDX-License-Identifier: Apache-2.0
 */

#include "tcp_client.h"
#include "config.h"

#include <net/net_core.h>
#include <net/net_if.h>
#include <net/net_pkt.h>

#include <misc/printk.h>

static
int set_addr(struct sockaddr *sock_addr, const char *addr, u16_t server_port)
{
	void *ptr = NULL;
	int rc;

#ifdef CONFIG_NET_IPV6
	net_sin6(sock_addr)->sin6_port = htons(server_port);
	sock_addr->family = AF_INET6;
	ptr = &(net_sin6(sock_addr)->sin6_addr);
	rc = net_addr_pton(AF_INET6, addr, ptr);
#else
	net_sin(sock_addr)->sin_port = htons(server_port);
	sock_addr->family = AF_INET;
	ptr = &(net_sin(sock_addr)->sin_addr);
	rc = net_addr_pton(AF_INET, addr, ptr);
#endif
	if (rc) {
		printk("Invalid IP address: %s\n", addr);
	}

	return rc;
}

static
int if_addr_add(struct sockaddr *local_sock)
{
	void *p = NULL;

#ifdef CONFIG_NET_IPV6
	p = net_if_ipv6_addr_add(net_if_get_default(),
				 &net_sin6(local_sock)->sin6_addr,
				 NET_ADDR_MANUAL, 0);
#else
	p = net_if_ipv4_addr_add(net_if_get_default(),
				 &net_sin(local_sock)->sin_addr,
				 NET_ADDR_MANUAL, 0);
#endif
	if (p) {
		return 0;
	}

	return -EINVAL;
}

int tcp_set_local_addr(struct tcp_client_ctx *ctx, const char *local_addr)
{
	int  rc;

	rc = set_addr(&ctx->local_sock, local_addr, 0);
	if (rc) {
		printk("set_addr (local) error\n");
		goto lb_exit;
	}

	rc = if_addr_add(&ctx->local_sock);
	if (rc) {
		printk("if_addr_add error\n");
	}

lb_exit:
	return rc;
}

static
void recv_cb(struct net_context *net_ctx, struct net_pkt *rx, int status,
	     void *data)
{
	struct tcp_client_ctx *ctx = (struct tcp_client_ctx *)data;

	ARG_UNUSED(net_ctx);

	if (status) {
		return;
	}

	if (rx == NULL || net_pkt_appdatalen(rx) == 0) {
		goto lb_exit;
	}

	/* receive_cb must take ownership of the rx packet */
	if (ctx->receive_cb) {
		ctx->receive_cb(ctx, rx);
		return;
	}

lb_exit:
	net_pkt_unref(rx);
}

int tcp_connect(struct tcp_client_ctx *ctx, const char *server_addr,
		u16_t server_port)
{
#if CONFIG_NET_IPV6
	socklen_t addr_len = sizeof(struct sockaddr_in6);
	sa_family_t family = AF_INET6;
#else
	socklen_t addr_len = sizeof(struct sockaddr_in);
	sa_family_t family = AF_INET;
#endif
	struct sockaddr server_sock;
	int rc;

	rc = net_context_get(family, SOCK_STREAM, IPPROTO_TCP, &ctx->net_ctx);
	if (rc) {
		printk("net_context_get error\n");
		return rc;
	}

	rc = net_context_bind(ctx->net_ctx, &ctx->local_sock, addr_len);
	if (rc) {
		printk("net_context_bind error\n");
		goto lb_exit;
	}

	rc = set_addr(&server_sock, server_addr, server_port);
	if (rc) {
		printk("set_addr (server) error\n");
		goto lb_exit;
	}

	rc = net_context_connect(ctx->net_ctx, &server_sock, addr_len, NULL,
				 ctx->timeout, NULL);
	if (rc) {
		printk("net_context_connect error\n");
		goto lb_exit;
	}

	(void)net_context_recv(ctx->net_ctx, recv_cb, K_NO_WAIT, ctx);

	return 0;

lb_exit:
	net_context_put(ctx->net_ctx);

	return rc;
}

int tcp_disconnect(struct tcp_client_ctx *ctx)
{
	if (ctx->net_ctx) {
		net_context_put(ctx->net_ctx);
		ctx->net_ctx = NULL;
	}

	return 0;
}
```

## src/tcp_client.h
```c
/*
 * Copyright (c) 2017 Intel Corporation
 *
 * SPDX-License-Identifier: Apache-2.0
 */

#ifndef _TCP_CLIENT_H_
#define _TCP_CLIENT_H_

#include <net/net_context.h>
#include <net/net_ip.h>

struct tcp_client_ctx {
	/* IP stack network context */
	struct net_context *net_ctx;
	/* Local sock address */
	struct sockaddr local_sock;
	/* Network timeout */
	s32_t timeout;
	/* User defined call back*/
	void (*receive_cb)(struct tcp_client_ctx *ctx, struct net_pkt *rx);
};

int tcp_set_local_addr(struct tcp_client_ctx *ctx, const char *local_addr);

int tcp_connect(struct tcp_client_ctx *ctx, const char *server_addr,
		u16_t server_port);

int tcp_disconnect(struct tcp_client_ctx *ctx);

#endif
```
