## samples/net/ethernet/gptp/Kconfig
```kconfig
# Private config options for gPTP sample app

# Copyright (c) 2018 Intel Corporation
# SPDX-License-Identifier: Apache-2.0

mainmenu "gPTP sample application"

if NET_GPTP

config NET_SAMPLE_RUN_DURATION
	int "Run the application this many seconds"
	default 0
	help
	  A value of zero means that the sample application is run forever.

endif


source "Kconfig.zephyr"
```

## samples/net/ethernet/gptp/boards/mr_mcxn_t1_mcxn947_cpu0.conf
```kconfig
# SPDX-FileCopyrightText: Copyright 2026 NXP
#
# SPDX-License-Identifier: Apache-2.0

CONFIG_NET_GPTP_NEIGHBOR_PROP_DELAY_THR=1000000
CONFIG_NET_GPTP_INIT_LOG_PDELAY_REQ_ITV=-4

CONFIG_NET_IF_MAX_IPV6_COUNT=2
CONFIG_NET_IF_MAX_IPV4_COUNT=2

CONFIG_REQUIRES_FLOAT_PRINTF=y
CONFIG_REQUIRES_FULL_LIBC=y

CONFIG_NET_GPTP_MONITOR_SYNC_STATUS=y
```

## samples/net/latmon/Kconfig
```kconfig
# Private config options for Latmon Sample app
# SPDX-License-Identifier: Apache-2.0
# Copyright (c) 2025 Jorge Ramirez-Ortiz <jorge.ramirez@oss.qualcomm.com>

mainmenu "Latmon Sample application"

config LATMON_LOOPBACK_CALIBRATION
	bool "Run the sample code in calibration mode"
	help
	  Run Latmon in calibration mode.

source "Kconfig.zephyr"
```

## samples/net/mqtt_sn_publisher/Kconfig
```kconfig
# Configuration options for MQTT-SN sample

# Copyright (c) 2022 René Beckmann
# SPDX-License-Identifier: Apache-2.0

mainmenu "MQTT-SN sample application"

config NET_SAMPLE_MQTT_SN_STATIC_GATEWAY
	bool "Whether to statically define the Gateway. Will use Search procedure if False."

config NET_SAMPLE_MQTT_SN_GATEWAY_ADDRESS
	string "IP and port of the MQTT-SN gateway"
	depends on NET_SAMPLE_MQTT_SN_STATIC_GATEWAY

config NET_SAMPLE_MQTT_SN_BROADCAST_ADDRESS
	string "IP and port of the Broadcast address"

config NET_SAMPLE_MQTT_SN_BUFFER_SIZE
	int "Size of the TX and RX buffers"
	default 255

config NET_SAMPLE_MQTT_SN_RECONNECT_INITIAL_BACKOFF_MSEC
	int "Delay before the first reconnect attempt, in milliseconds"
	default 1000

config NET_SAMPLE_MQTT_SN_RECONNECT_MAX_BACKOFF_MSEC
	int "Cap on the delay between reconnect attempts, in milliseconds"
	default 60000

config NET_SAMPLE_MQTT_SN_RECONNECT_MAX_ATTEMPTS
	int "Number of reconnect attempts before giving up"
	range 1 4294967295
	default 10

source "Kconfig.zephyr"
```

## samples/net/ocpp/Kconfig
```kconfig
# Config options for OCPP sample application

# Copyright (c) 2025 Linumiz GmbH
# SPDX-License-Identifier: Apache-2.0

mainmenu "OCPP sample application"
config NET_SAMPLE_OCPP_SERVER
	string "OCPP server ip"
	help
	  OCPP central system server ip address

config NET_SAMPLE_OCPP_PORT
	int "OCPP server port"
	help
	  OCPP central system server port

config NET_SAMPLE_OCPP_WS_PATH
	string "OCPP websocket path"
	default "/steve/websocket/CentralSystemService/zephyr"
	help
	  WebSocket URL path (excluding IP address and port) for OCPP connection to the central
	  system server.

config NET_SAMPLE_OCPP_AUTH_USERNAME
	string "OCPP basic authentication username"
	depends on OCPP_BASIC_AUTH
	default "zephyr"
	help
	  Username of the HTTP Basic authentication. It must be equal to the
	  charge point identity, the last element of NET_SAMPLE_OCPP_WS_PATH
	  (A00.FR.204 of the OCPP 1.6 security whitepaper).

config NET_SAMPLE_OCPP_AUTH_PASSWORD
	string "OCPP basic authentication password"
	depends on OCPP_BASIC_AUTH
	help
	  Password of the HTTP Basic authentication, sent as it is. The
	  build fails unless it has 16 to OCPP_BASIC_AUTH_PASSWORD_MAX_LEN
	  characters.

config NET_SAMPLE_SNTP_SERVER
	string "SNTP server ip"
	help
	  SNTP server ip to get the time from network

config NET_SAMPLE_SNTP_SERVER_PORT
	int "SNTP server port"
	help
	  SNTP server port to get the time from network

source "Kconfig.zephyr"
```

## samples/net/openthread/border_router/boards/esp_threadbr_procpu_ethernet.conf
```kconfig
#
# Copyright (c) 2026 Espressif Systems (Shanghai) Co., Ltd.
#

CONFIG_SOC_FAMILY_ESPRESSIF_SPIRAM_HEAP_SIZE=524288
```

## samples/net/openthread/shell/Kconfig
```kconfig
# Copyright 2026 NXP
# SPDX-License-Identifier: Apache-2.0

mainmenu "OpenThread shell sample application"

config OT_SHELL_SAMPLE_RGB_STATUS_LED
	bool "Show the Thread device role on the RGB LED"
	depends on OPENTHREAD
	depends on $(dt_alias_enabled,red-pwm-led)
	depends on $(dt_alias_enabled,green-pwm-led)
	depends on $(dt_alias_enabled,blue-pwm-led)
	select PWM
	help
	  Blink the board RGB LED with a colour that reflects the current
	  OpenThread device role: disabled is white, detached is red, child
	  is yellow, router is green and leader is blue. When the shell is
	  enabled, an "rgb" command is added to control the LED.

if OT_SHELL_SAMPLE_RGB_STATUS_LED

config OT_SHELL_SAMPLE_RGB_STATUS_LED_BLINK_MS
	int "Default RGB LED blink period in milliseconds"
	default 500
	range 10 10000
	help
	  Initial time the LED stays on or off. It can be changed at run
	  time with the "rgb rate" shell command.

endif # OT_SHELL_SAMPLE_RGB_STATUS_LED

source "Kconfig.zephyr"
```

## samples/net/pps_out/boards/nucleo_h563zi.conf
```kconfig
CONFIG_PTP_CLOCK_STM32_HAL_OUTPUT=y
CONFIG_ETH_STM32_HAL_PTP_CLOCK_SRC_HZ=100000000
```

## samples/net/rfc2217_server/Kconfig
```kconfig
# SPDX-FileCopyrightText: Copyright The Zephyr Project Contributors
# SPDX-License-Identifier: Apache-2.0

config SAMPLE_RFC2217_PORT
	int "TCP port of the server the application starts"
	default 2217
	help
	  Without a zephyr,rfc2217-server node in the devicetree, the
	  application starts a server on the UART with the rfc2217-uart
	  alias, on this port.

source "samples/net/common/Kconfig"
source "Kconfig.zephyr"
```

## samples/net/snmp_agent/Kconfig
```kconfig
# SPDX-FileCopyrightText: Copyright The Zephyr Project Contributors
# SPDX-License-Identifier: Apache-2.0

mainmenu "SNMP agent sample application"

config NET_SAMPLE_SNMP_READ_COMMUNITY
	string "Read community"
	default "public"
	help
	  Community string that grants GET, GETNEXT and GETBULK.

config NET_SAMPLE_SNMP_WRITE_COMMUNITY
	string "Write community"
	default "private"
	help
	  Community string that additionally grants SET. Empty disables SET.

config NET_SAMPLE_SNMP_TRAP_RECEIVER
	string "Notification receiver address"
	help
	  IPv4 or IPv6 address of a notification receiver listening on UDP
	  port 162. Empty sends no notifications.

config NET_SAMPLE_SNMP_TRAP_COMMUNITY
	string "Notification community"
	default "public"
	help
	  Community string carried by the notifications.

config NET_SAMPLE_SNMP_TRAP_V1
	bool "Send SNMPv1 traps"
	help
	  Send Trap-PDUs of SNMPv1 instead of SNMPv2-Trap-PDUs.

source "Kconfig.zephyr"
```

## samples/net/sockets/echo_client/Kconfig
```kconfig
# Private config options for echo-client sample app

# Copyright (c) 2018 Intel Corporation
# SPDX-License-Identifier: Apache-2.0

mainmenu "Networking echo-client sample application"

config NET_SAMPLE_PSK_HEADER_FILE
	string "Header file containing PSK"
	default "dummy_psk.h"
	depends on MBEDTLS_KEY_EXCHANGE_PSK_ENABLED
	help
	  Name of a header file containing a
	  pre-shared key.

config NET_SAMPLE_SEND_ITERATIONS
	int "Send sample data this many times"
	default 0
	help
	  Send sample data this many times before exiting. A value of
	  zero means that the sample application is run forever.

source "samples/net/common/Kconfig"
source "Kconfig.zephyr"
```

## samples/net/sockets/packet/Kconfig
```kconfig
# Private config options for packet socket sample app

# Copyright (c) 2020 Intel Corporation
# SPDX-License-Identifier: Apache-2.0

mainmenu "Networking packet socket sample application"

config NET_SAMPLE_SEND_WAIT_TIME
	int "Wait time between sent packets (in ms)"
	default 5000
	help
	  By default the application will send a packet every 5 seconds.
	  If set to 0, then the packets are sent as fast as possible, which
	  will stress test the network stack.

config NET_SAMPLE_ENABLE_PACKET_DGRAM
	bool "Use AF_PACKET with SOCK_DGRAM"
	depends on NET_SOCKETS_PACKET_DGRAM
	default y
	help
	  This will strip Ethernet header from received packets
	  and insert Ethernet header to sent packets.

config NET_SAMPLE_DESTINATION_ADDR
	string "Destination Ethernet MAC address"
	depends on NET_SOCKETS_PACKET_DGRAM
	default "00:11:22:33:44:55"
	help
	  Where to send the Ethernet frames.

config NET_SAMPLE_MCAST_MEMBERSHIP
	bool "Join an Ethernet multicast group"
	select NET_SOCKETS_PACKET_MCAST_MEMBERSHIP
	default y
	help
	  Ask the network interface to also listen to the multicast MAC
	  address set by NET_SAMPLE_MCAST_ADDR. The group is joined with the
	  PACKET_ADD_MEMBERSHIP socket option and left with
	  PACKET_DROP_MEMBERSHIP when the sample stops.

config NET_SAMPLE_MCAST_ADDR
	string "Ethernet multicast MAC address to listen to"
	depends on NET_SAMPLE_MCAST_MEMBERSHIP
	default "01:00:5e:00:00:01"
	help
	  The multicast MAC address the receiving packet socket joins. The
	  default value is the one IPv4 multicast address 224.0.0.1 (all
	  hosts) maps to.

source "Kconfig.zephyr"
```

## samples/net/sockets/sntp_server/Kconfig
```kconfig
# SPDX-FileCopyrightText: Copyright The Zephyr Project Contributors
# SPDX-FileCopyrightText: Copyright Lothar Felten <lothar.felten@gmail.com>
# SPDX-License-Identifier: Apache-2.0

config NET_SAMPLE_SNTP_UPSTREAM_ADDRESS
	string "Upstream SNTP server to synchronize from"
	default ""
	help
	  Name or address of the SNTP server this sample queries in order to
	  set the system clock before it starts serving time itself. There is
	  no default, set it according to your network setup. If left empty,
	  the sample starts the server without setting the clock, and the
	  server will tell its clients that it is not synchronized.

config NET_SAMPLE_SNTP_UPSTREAM_TIMEOUT_MS
	int "Duration to wait for the upstream response"
	default 2000

source "samples/net/common/Kconfig"
source "Kconfig.zephyr"
```

## samples/net/sockets/tls_keygen/Kconfig
```kconfig
# Copyright (c) 2026 Nordic Semiconductor ASA
# SPDX-License-Identifier: Apache-2.0

mainmenu "TLS on-device key generation sample"

config NET_SAMPLE_SEC_TAG
	int "Security tag"
	default 42
	help
	  Security tag of the generated key, the device certificate and the CA certificate.

config NET_SAMPLE_CSR_SUBJECT
	string "Subject of the CSR"
	default "CN=zephyr-device"

config NET_SAMPLE_SERVER_ADDR
	string "IPv4 address of the TLS server"
	default "127.0.0.1"

config NET_SAMPLE_SERVER_PORT
	int "Port of the TLS server"
	default 4433

config NET_SAMPLE_SERVER_HOSTNAME
	string "Hostname of the TLS server"
	default "localhost"
	help
	  Must match the common name or a subject alternative name of the server certificate.

source "Kconfig.zephyr"
```

## samples/net/srtp/Kconfig
```kconfig
# SPDX-FileCopyrightText: 2026 Basalte bv
# SPDX-FileCopyrightText: 2026 Sayed Naser Moravej
# SPDX-License-Identifier: Apache-2.0

choice SRTP_SAMPLE_ROLE
	prompt "SRTP Sample Role"

config SRTP_SAMPLE_ROLE_SINK
	bool "SRTP Sample Role Sink"
	help
	  Build the SRTP sample as a sink

config SRTP_SAMPLE_ROLE_SOURCE
	bool "SRTP Sample Role Source"
	help
	  Build the SRTP sample as a source

endchoice

config RTP_SAMPLE_IPV6
	bool "Use IPv6 for the RTP session"
	depends on NET_IPV6
	help
	  Join the RTP multicast group over IPv6 instead of IPv4.

source "Kconfig.zephyr"
```

## samples/net/stun/Kconfig
```kconfig
# SPDX-FileCopyrightText: Copyright The Zephyr Project Contributors
# SPDX-FileCopyrightText: Copyright (c) 2026 Kirill Shypachov
# SPDX-License-Identifier: Apache-2.0

config NET_SAMPLE_STUN_SERVER
	string "STUN server"
	default "stun.cloudflare.com"
	help
	  Host name or literal address of the STUN server the sample asks
	  for the public address of the device. Any STUN server will do: a
	  public one, or one that runs in the local network.

config NET_SAMPLE_STUN_SERVER_PORT
	int "STUN server port"
	default 3478
	range 1 65535

config NET_SAMPLE_STUN_TIMEOUT_MS
	int "Longest time to wait for the answer, in milliseconds"
	default 5000
	range 1 39500
	help
	  The request is sent again 0.5, 1.5 and 3.5 seconds after the first
	  time, and so on for 39.5 seconds (RFC 8489 section 6.2.1). The
	  default leaves time for four transmissions.

source "Kconfig.zephyr"
```

## samples/net/wifi/apsta_mode/boards/x_nucleo_67w61m1.conf
```kconfig
# Copyright (c) 2026 STMicroelectronics
# SPDX-License-Identifier: Apache-2.0

CONFIG_WIFI_SAMPLE_AP_SSID="ST67_AP"
CONFIG_WIFI_SAMPLE_SSID="SSID"
CONFIG_WIFI_SAMPLE_AP_IP_ADDRESS="192.168.4.1"
CONFIG_WIFI_SAMPLE_AP_NETMASK="255.255.255.0"
```
