/*
 * SPDX-FileCopyrightText: Copyright (c) 2026 Narek Aydinyan
 * SPDX-License-Identifier: Apache-2.0
 */

/ {
	chosen {
		zephyr,uhc = &usbotg_hs;
	};
};

&usbotg_hs {
	dr-mode = "host";

	lan78xx: ethernet {
		compatible = "microchip,lan78xx";
		local-mac-address = [02 00 00 00 00 01];
		status = "okay";
	};
};
