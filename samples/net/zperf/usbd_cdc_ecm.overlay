/*
 * Copyright (c) 2023 Nordic Semiconductor ASA
 *
 * SPDX-License-Identifier: Apache-2.0
 */

/ {
	cdc_ecm_eth0: cdc_ecm_eth0 {
		compatible = "zephyr,cdc-ecm-ethernet";
		remote-mac-address = "00005E005301";
	};
};
