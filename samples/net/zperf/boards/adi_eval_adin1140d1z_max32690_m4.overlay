/*
 * Copyright (c) 2026 Analog Devices, Inc.
 *
 * SPDX-License-Identifier: Apache-2.0
 */

/ {
	chosen {
		/* Use 512KB SRAM for network stack */
		zephyr,sram = &sram0;
	};

	soc {
		/* Combine SRAM banks 0-3 into one contiguous 512KB region */
		sram0: memory@20000000 {
			compatible = "mmio-sram";
			reg = <0x20000000 DT_SIZE_K(512)>;
		};
	};
};
