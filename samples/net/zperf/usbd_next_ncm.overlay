/*
 * Copyright (c) 2024 Nordic Semiconductor ASA
 *
 * SPDX-License-Identifier: Apache-2.0
 */

/ {
	cdc_ncm_eth0: cdc_ncm_eth0 {
		compatible = "zephyr,cdc-ncm-ethernet";
		remote-mac-address = "00005E005301";
	};
};
