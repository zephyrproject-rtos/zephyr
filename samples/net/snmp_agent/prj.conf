## CMakeLists.txt
```
# SPDX-FileCopyrightText: Copyright The Zephyr Project Contributors
# SPDX-License-Identifier: Apache-2.0

cmake_minimum_required(VERSION 3.28.0)
find_package(Zephyr REQUIRED HINTS $ENV{ZEPHYR_BASE})
project(snmp_agent)

target_sources(app PRIVATE src/main.c)
```

## Kconfig
```
# SPDX-FileCopyrightText: Copyright The Zephyr Project Contributors
# SPDX-License-Identifier: Apache-2.0

mainmenu "SNMP agent sample application"

config NET_SAMPLE_SNMP_READ_COMMUNITY
	string "Read community"
	default "public"
	help
	  Community string that grants GET, GETNEXT and GETBULK.

config NET_SAMPLE_SNMP_WRITE_COMMUNITY
	string "Write community"
	default "private"
	help
	  Community string that additionally grants SET. Empty disables SET.

config NET_SAMPLE_SNMP_TRAP_RECEIVER
	string "Notification receiver address"
	help
	  IPv4 or IPv6 address of a notification receiver listening on UDP
	  port 162. Empty sends no notifications.

config NET_SAMPLE_SNMP_TRAP_COMMUNITY
	string "Notification community"
	default "public"
	help
	  Community string carried by the notifications.

config NET_SAMPLE_SNMP_TRAP_V1
	bool "Send SNMPv1 traps"
	help
	  Send Trap-PDUs of SNMPv1 instead of SNMPv2-Trap-PDUs.

source "Kconfig.zephyr"
```

## prj.conf
```kconfig
# Networking
CONFIG_NETWORKING=y
CONFIG_NET_UDP=y
CONFIG_NET_IPV4=y
CONFIG_NET_IPV6=y
CONFIG_NET_SOCKETS=y
CONFIG_ZVFS_POLL_MAX=8

# Boards without an entropy driver, such as mps2/an385, need the test generator
CONFIG_TEST_RANDOM_GENERATOR=y

# Static addresses of the sample, see doc/connectivity/networking/qemu_setup.rst
CONFIG_NET_CONFIG_SETTINGS=y
CONFIG_NET_CONFIG_NEED_IPV4=y
CONFIG_NET_CONFIG_MY_IPV4_ADDR="192.0.2.1"
CONFIG_NET_CONFIG_PEER_IPV4_ADDR="192.0.2.2"
CONFIG_NET_CONFIG_NEED_IPV6=y
CONFIG_NET_CONFIG_MY_IPV6_ADDR="2001:db8::1"
CONFIG_NET_CONFIG_PEER_IPV6_ADDR="2001:db8::2"

# SNMP agent with writable objects
CONFIG_SNMP=y
CONFIG_SNMP_SET_ENABLE=y
CONFIG_SNMP_SYS_NAME="zephyr"
CONFIG_SNMP_SYS_CONTACT="admin@example.com"
CONFIG_SNMP_SYS_LOCATION="Sample board"

# Logging and shell
CONFIG_LOG=y
CONFIG_NET_LOG=y
CONFIG_SHELL=y
CONFIG_NET_SHELL=y

CONFIG_MAIN_STACK_SIZE=2048
```

## src/main.c
```c
/*
 * SPDX-FileCopyrightText: Copyright The Zephyr Project Contributors
 * SPDX-License-Identifier: Apache-2.0
 */

#include <zephyr/logging/log.h>
LOG_MODULE_REGISTER(snmp_sample, LOG_LEVEL_INF);

#include <errno.h>
#include <string.h>

#include <zephyr/kernel.h>
#include <zephyr/net/net_ip.h>
#include <zephyr/net/snmp.h>
#include <zephyr/net/socket.h>
#include <zephyr/sys/util.h>

/* The sample's objects live under the experimental subtree of RFC 2578. A
 * product registers its enterprise number with IANA and places its objects
 * under 1.3.6.1.4.1.<enterprise>.
 */
#define SAMPLE_BASE          1, 3, 6, 1, 3, 9
#define SAMPLE_NOTIFICATIONS SAMPLE_BASE, 0
#define SAMPLE_OBJECTS       SAMPLE_BASE, 1
#define SAMPLE_CAPABILITIES  SAMPLE_BASE, 2

#define LEVEL_MIN 0
#define LEVEL_MAX 100

/* Reported as sysObjectID */
static const uint32_t sample_object_id[] = {SAMPLE_BASE};

static int32_t level = 50;

/* sampleUpTime: seconds since boot, a read-only Counter32 */
static int uptime_get(const struct snmp_object *obj, void *row, struct snmp_value *val)
{
	ARG_UNUSED(obj);
	ARG_UNUSED(row);

	val->type = SNMP_TYPE_COUNTER32;
	val->u32 = (uint32_t)(k_uptime_get() / MSEC_PER_SEC);

	return 0;
}

/* sampleLevel: a writable INTEGER in the range 0..100 */
static int level_get(const struct snmp_object *obj, void *row, struct snmp_value *val)
{
	ARG_UNUSED(obj);
	ARG_UNUSED(row);

	val->type = SNMP_TYPE_INTEGER;
	val->i32 = level;

	return 0;
}

static int level_set(const struct snmp_object *obj, void *row, const struct snmp_value *val,
		     enum snmp_set_phase phase)
{
	/* sampleLevelChanged, sent when a manager changes sampleLevel, carries
	 * the new value of sampleLevel.0 as its OBJECTS clause says.
	 */
	static const uint32_t level_changed[] = {SAMPLE_NOTIFICATIONS, 1};
	static const uint32_t level_instance[] = {SAMPLE_OBJECTS, 2, 0};
	const struct snmp_varbind bindings[] = {
		{.oid = level_instance,
		 .oid_len = ARRAY_SIZE(level_instance),
		 .value = {.type = SNMP_TYPE_INTEGER, .i32 = val->i32}},
	};
	int ret;

	ARG_UNUSED(obj);
	ARG_UNUSED(row);

	/* The check phase validates; nothing may change here. */
	if (val->type != SNMP_TYPE_INTEGER) {
		return -EINVAL;
	}

	if (val->i32 < LEVEL_MIN || val->i32 > LEVEL_MAX) {
		return -ERANGE;
	}

	if (phase == SNMP_SET_CHECK) {
		return 0;
	}

	level = val->i32;
	LOG_INF("sampleLevel set to %d", level);

	/* Tell the receivers; failing to reach them does not fail the SET. */
	ret = snmp_agent_notify(level_changed, ARRAY_SIZE(level_changed), bindings,
				ARRAY_SIZE(bindings));
	if (ret != 0) {
		LOG_WRN("sampleLevelChanged not sent (%d)", ret);
	}

	return 0;
}

SNMP_SCALAR_DEFINE(sample_uptime, uptime_get, NULL, NULL, SAMPLE_OBJECTS, 1);
SNMP_SCALAR_DEFINE(sample_level, level_get, level_set, NULL, SAMPLE_OBJECTS, 2);

/* Listed in sysORTable next to the library's own compliance statement */
SNMP_CAPABILITY_DEFINE(sample_capabilities, "Objects of the Zephyr SNMP agent sample",
		       SAMPLE_CAPABILITIES, 1);

static int add_notification_receiver(void)
{
	const char *host = CONFIG_NET_SAMPLE_SNMP_TRAP_RECEIVER;
	struct net_sockaddr_in addr4 = {.sin_family = NET_AF_INET,
					.sin_port = net_htons(SNMP_TRAP_PORT)};
	struct net_sockaddr_in6 addr6 = {.sin6_family = NET_AF_INET6,
					 .sin6_port = net_htons(SNMP_TRAP_PORT)};
	struct snmp_notification_target target = {
		.version = IS_ENABLED(CONFIG_NET_SAMPLE_SNMP_TRAP_V1) ? SNMP_VERSION_V1
								      : SNMP_VERSION_V2C,
		.community = CONFIG_NET_SAMPLE_SNMP_TRAP_COMMUNITY,
	};

	if (host[0] == '\0') {
		return 0;
	}

	if (IS_ENABLED(CONFIG_NET_IPV4) &&
	    zsock_inet_pton(NET_AF_INET, host, &addr4.sin_addr) == 1) {
		target.addr = (struct net_sockaddr *)&addr4;
		target.addrlen = sizeof(addr4);
	} else if (IS_ENABLED(CONFIG_NET_IPV6) &&
		   zsock_inet_pton(NET_AF_INET6, host, &addr6.sin6_addr) == 1) {
		target.addr = (struct net_sockaddr *)&addr6;
		target.addrlen = sizeof(addr6);
	} else {
		LOG_ERR("Cannot parse notification receiver %s", host);
		return -EINVAL;
	}

	return snmp_agent_add_notification_target(&target);
}

int main(void)
{
	int ret;

	ret = snmp_agent_set_community(SNMP_COMMUNITY_READ, CONFIG_NET_SAMPLE_SNMP_READ_COMMUNITY);
	if (ret == 0) {
		ret = snmp_agent_set_community(SNMP_COMMUNITY_WRITE,
					       CONFIG_NET_SAMPLE_SNMP_WRITE_COMMUNITY);
	}

	if (ret != 0) {
		LOG_ERR("Cannot set community strings (%d)", ret);
		return 0;
	}

	ret = snmp_mib2_system_set_object_id(sample_object_id, ARRAY_SIZE(sample_object_id));
	if (ret != 0) {
		LOG_ERR("Cannot set sysObjectID (%d)", ret);
		return 0;
	}

	/* Receivers added before the start get the coldStart notification. */
	ret = add_notification_receiver();
	if (ret != 0) {
		LOG_ERR("Cannot add notification receiver (%d)", ret);
		return 0;
	}

	ret = snmp_agent_start();
	if (ret != 0) {
		LOG_ERR("Cannot start the SNMP agent (%d)", ret);
		return 0;
	}

	LOG_INF("SNMP agent listening on UDP port %d", CONFIG_SNMP_PORT);

	/* The agent answers from the socket service thread; main is done. */
	return 0;
}
```
