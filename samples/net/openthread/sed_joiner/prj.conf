## CMakeLists.txt
```
# SPDX-License-Identifier: Apache-2.0

cmake_minimum_required(VERSION 3.20.0)

find_package(Zephyr REQUIRED HINTS $ENV{ZEPHYR_BASE})
project(ot_sed_joiner)

target_sources(app PRIVATE src/main.c)
```

## prj.conf
```kconfig
# general project configuration
CONFIG_LOG=y
CONFIG_LOG_MODE_MINIMAL=y
CONFIG_NETWORKING=y
CONFIG_NET_L2_OPENTHREAD=y

# kernel and stdlib heap
CONFIG_HEAP_MEM_POOL_SIZE=1024
CONFIG_COMMON_LIBC_MALLOC_ARENA_SIZE=2048

# SED device with its poll interval
CONFIG_OPENTHREAD_MTD=y
CONFIG_OPENTHREAD_MTD_SED=y
CONFIG_OPENTHREAD_POLL_PERIOD=5000

# thread network credentials
CONFIG_OPENTHREAD_CHANNEL=16
CONFIG_OPENTHREAD_PANID=1419
CONFIG_OPENTHREAD_XPANID="11:11:11:11:22:22:44:44"
CONFIG_OPENTHREAD_NETWORKKEY="ff:ee:dd:cc:bb:aa:99:88:77:66:55:44:33:22:11:00"
```

## src/main.c
```c
/* main.c - OpenThread */

/*
 * Copyright (c) 2023-2024 Telink
 *
 * SPDX-License-Identifier: Apache-2.0
 */

#include <zephyr/logging/log.h>
LOG_MODULE_REGISTER(ot_main, LOG_LEVEL_DBG);

#include <zephyr/net/openthread.h>
#include <openthread/thread.h>

static void ot_satate_changed(otChangedFlags flags,
	struct openthread_context *ot_context, void *user_data)
{
	if (flags & OT_CHANGED_THREAD_ROLE) {
		switch (otThreadGetDeviceRole(ot_context->instance)) {
		case OT_DEVICE_ROLE_CHILD:
			LOG_INF("OT child");
			LOG_INF("OT Short address: %04x",
				otLinkGetShortAddress(ot_context->instance));
			LOG_HEXDUMP_INF(otLinkGetExtendedAddress(ot_context->instance),
				OT_EXT_ADDRESS_SIZE, "OT Extended address:");
			break;
		case OT_DEVICE_ROLE_ROUTER:
			LOG_INF("OT router");
			LOG_INF("OT Short address: %04x",
				otLinkGetShortAddress(ot_context->instance));
			LOG_HEXDUMP_INF(otLinkGetExtendedAddress(ot_context->instance),
				OT_EXT_ADDRESS_SIZE, "OT Extended address:");
			break;
		case OT_DEVICE_ROLE_LEADER:
			LOG_INF("OT leader");
			LOG_INF("OT Short address: %04x",
				otLinkGetShortAddress(ot_context->instance));
			LOG_HEXDUMP_INF(otLinkGetExtendedAddress(ot_context->instance),
				OT_EXT_ADDRESS_SIZE, "OT Extended address:");
			break;
		case OT_DEVICE_ROLE_DISABLED:
			LOG_INF("OT disabled");
			break;
		case OT_DEVICE_ROLE_DETACHED:
			LOG_INF("OT detached");
			break;
		default:
			LOG_INF("OT unknown");
			break;
		}
	}
}

void main(void)
{
	LOG_INF("***** OpenThread CLI on Zephyr *****");
	LOG_INF("OT channel     %u",     CONFIG_OPENTHREAD_CHANNEL);
	LOG_INF("OT pan id      %04x",   CONFIG_OPENTHREAD_PANID);
	LOG_INF("OT pan ext id  %s",     CONFIG_OPENTHREAD_XPANID);
	LOG_INF("OT network key %s",     CONFIG_OPENTHREAD_NETWORKKEY);

	static struct openthread_state_changed_cb ot_state_cahnge = {
		.state_changed_cb = ot_satate_changed
	};

	openthread_state_changed_cb_register(openthread_get_default_context(), &ot_state_cahnge);
}
```
