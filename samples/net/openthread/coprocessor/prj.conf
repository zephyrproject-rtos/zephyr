## CMakeLists.txt
```
# SPDX-License-Identifier: Apache-2.0

cmake_minimum_required(VERSION 3.28.0)

find_package(Zephyr REQUIRED HINTS $ENV{ZEPHYR_BASE})
project(ncp)

target_sources( app
    PRIVATE
        src/main.c
)

include(${ZEPHYR_BASE}/samples/net/common/common.cmake)

set(gen_dir ${ZEPHYR_BINARY_DIR}/include/generated/)
```

## Kconfig
```
# Config options for OpenThread Border Router sample app

# Copyright (c) 2020 Tridonic GmbH & Co KG
# SPDX-License-Identifier: Apache-2.0

mainmenu "OpenThread NCP"

menu "Application configuration"

config NET_SAMPLE_APPLICATION_VERSION
	string "Version number for the application"
	default "v0.0.0"

endmenu

source "Kconfig.zephyr"
```

## sample.yaml
```
common:
  harness: net
  tags:
    - net
    - openthread
  depends_on: openthread
  min_flash: 140
sample:
  description: Runs the OpenThread stack as NCP BR
  name: OpenThread Network Co-Processor
tests:
  sample.net.openthread.coprocessor:
    build_only: true
    platform_allow:
      - nrf52840dk/nrf52840
      - nrf52833dk/nrf52833
      - tlsr9518adk80d
    integration_platforms:
      - nrf52840dk/nrf52840
  sample.net.openthread.coprocessor.usb:
    build_only: true
    platform_allow:
      - nrf52840dk/nrf52840
      - nrf52833dk/nrf52833
    integration_platforms:
      - nrf52840dk/nrf52840
    tags: ci_build
    extra_args:
      - EXTRA_CONF_FILE=overlay-usb-nrf-br.conf
      - DTC_OVERLAY_FILE="usb.overlay"
  sample.openthread.coprocessor.rcp:
    build_only: true
    platform_allow:
      - nrf52840dk/nrf52840
      - nrf52833dk/nrf52833
      - tlsr9518adk80d
    integration_platforms:
      - nrf52840dk/nrf52840
    extra_args: EXTRA_CONF_FILE=overlay-rcp.conf
```

## prj.conf
```kconfig
CONFIG_NETWORKING=y
CONFIG_NET_L2_OPENTHREAD=y

# Disable certain parts of Zephyr IPv6 stack
CONFIG_NET_IPV6_NBR_CACHE=n
CONFIG_NET_IPV6_MLD=n

# Use NVS as settings backend
CONFIG_NVS=y

# Disable boot banner
CONFIG_BOOT_BANNER=n

# Kernel options
CONFIG_MAIN_STACK_SIZE=2560

# Set OpenThread NCP architecture
CONFIG_OPENTHREAD_COPROCESSOR=y
CONFIG_OPENTHREAD_COPROCESSOR_NCP=y

# Add features required for NCP
CONFIG_OPENTHREAD_DIAG=y
CONFIG_OPENTHREAD_DHCP6_SERVER=y
CONFIG_OPENTHREAD_COMMISSIONER=y
CONFIG_OPENTHREAD_BORDER_AGENT=y
CONFIG_OPENTHREAD_BORDER_ROUTER=y
CONFIG_OPENTHREAD_UDP_FORWARD=y
CONFIG_OPENTHREAD_ENABLE_SERVICE=y
```

## debug.conf
```kconfig
# Logging
CONFIG_LOG=y
CONFIG_LOG_MAX_LEVEL=1
CONFIG_LOG_MODE_MINIMAL=n
CONFIG_LOG_BACKEND_SPINEL=y
CONFIG_LOG_BACKEND_RTT=y
CONFIG_LOG_BACKEND_UART=n

# Increase logging thread stack size due to Spinel backend needs
CONFIG_LOG_PROCESS_THREAD_STACK_SIZE=2048

# Kernel options
CONFIG_INIT_STACKS=y
```

## overlay-rcp-usb-telink.conf
```kconfig
# Copyright (c) 2024 Telink Semiconductor
# SPDX-License-Identifier: Apache-2.0

# Telink RCP USB-CDC-ACM

CONFIG_OPENTHREAD_COPROCESSOR_NCP=n
CONFIG_OPENTHREAD_COPROCESSOR_RCP=y

CONFIG_NET_PKT_RX_COUNT=8
CONFIG_NET_PKT_TX_COUNT=8

# Use USB-CDC-ACM for Co-Processor
CONFIG_USB_DEVICE_STACK=y
CONFIG_USB_DEVICE_PRODUCT="OpenThread CoProcessor RCP"
CONFIG_USB_CDC_ACM=y
CONFIG_UART_LINE_CTRL=y
CONFIG_USB_REQUEST_BUFFER_SIZE=2048
```

## overlay-rcp.conf
```kconfig
# This overlay switches from NCP to RCP, use in combination with prj.conf

CONFIG_OPENTHREAD_COPROCESSOR_NCP=n
CONFIG_OPENTHREAD_COPROCESSOR_RCP=y

CONFIG_NET_PKT_RX_COUNT=8
CONFIG_NET_PKT_TX_COUNT=8
```

## overlay-tri-n4m-br.conf
```kconfig
# TRI n4m BR
CONFIG_SHELL_PROMPT_UART="ncp-uart:~$ "

CONFIG_STDOUT_CONSOLE=y
CONFIG_GPIO=y
CONFIG_LOG=y

CONFIG_USB_DEVICE_STACK_NEXT=y
CONFIG_CDC_ACM_SERIAL_INITIALIZE_AT_BOOT=y
CONFIG_CDC_ACM_SERIAL_PRODUCT_STRING="OpenThread Co-Processor K64"
CONFIG_USBD_CDC_ACM_LOG_LEVEL_OFF=y
CONFIG_UART_LINE_CTRL=y

# disable ethernet on K64
CONFIG_ETH_DRIVER=n

CONFIG_ISR_STACK_SIZE=4096
```

## overlay-usb-nrf-br.conf
```kconfig
# Nordic NCP USB CDC-ACM

CONFIG_SHELL_PROMPT_UART="ncp-uart:~$ "

# Use USB-CDC-ACM for Co-Processor
CONFIG_USB_DEVICE_STACK_NEXT=y
CONFIG_CDC_ACM_SERIAL_INITIALIZE_AT_BOOT=y
CONFIG_CDC_ACM_SERIAL_PRODUCT_STRING="OpenThread CoProcessor NRF"
CONFIG_USBD_CDC_ACM_LOG_LEVEL_OFF=y
CONFIG_UART_LINE_CTRL=y

CONFIG_ISR_STACK_SIZE=4096
```

## boards/nucleo_wba65ri.conf
```kconfig
# SPDX-FileCopyrightText: Copyright The Zephyr Project Contributors
# SPDX-License-Identifier: Apache-2.0

CONFIG_UART_ASYNC_API=y
CONFIG_OPENTHREAD_COPROCESSOR_UART_ASYNC=y
CONFIG_OPENTHREAD_THREAD_VERSION_1_4=y
CONFIG_OPENTHREAD_RADIO_WORKQUEUE_STACK_SIZE=1536
# Disable the console subsystem
CONFIG_CONSOLE=n

# Disable UART-based console specifically
CONFIG_UART_CONSOLE=n

# Optional: Disable printk output to save more space
CONFIG_PRINTK=n

CONFIG_LOG=n
```

## app.overlay
```dts
/*
 * Copyright (c) 2021 Nordic Semiconductor ASA
 *
 * SPDX-License-Identifier: Apache-2.0
 */

/ {
	chosen {
		zephyr,ot-uart = &uart0;
		zephyr,console = &uart1;
	};
};
```

## usb.overlay
```dts
/*
 * Copyright (c) 2021 Nordic Semiconductor ASA
 *
 * SPDX-License-Identifier: Apache-2.0
 */

/ {
	chosen {
		zephyr,ot-uart = &cdc_acm_uart0;
	};
};

&zephyr_udc0 {
	cdc_acm_uart0: cdc_acm_uart0 {
		compatible = "zephyr,cdc-acm-uart";
	};
};
```

## boards/cc1352p7_lp.overlay
```dts
/*
 * Copyright (c) 2024 Alexandre Bailon
 *
 * SPDX-License-Identifier: Apache-2.0
 */

/ {
	chosen {
		/* Use XDS110 UART for the NCP */
		zephyr,ot-uart = &uart0;
		/* Use UART1 for debugging / zephyr console */
		zephyr,shell-uart = &uart1;
		zephyr,console = &uart1;
	};
};

&uart1 {
	status = "okay";
};
```

## boards/nrf52833dk_nrf52833.overlay
```dts
/*
 * Copyright (c) 2021 Nordic Semiconductor ASA
 *
 * SPDX-License-Identifier: Apache-2.0
 */

/ {
	chosen {
		zephyr,ot-uart = &uart0;
		zephyr,console = &uart1;
		zephyr,log-uart = &uart1;
	};
};

&uart1 {
	status = "okay";
};
```

## boards/nrf52840dk_nrf52840.overlay
```dts
/*
 * Copyright (c) 2021 Nordic Semiconductor ASA
 *
 * SPDX-License-Identifier: Apache-2.0
 */

/ {
	chosen {
		zephyr,ot-uart = &uart0;
		zephyr,console = &uart1;
	};
};

&uart1 {
	status = "okay";
};
```

## boards/nrf52840dongle_nrf52840.overlay
```dts
/*
 * Copyright (c) 2021 Nordic Semiconductor ASA
 *
 * SPDX-License-Identifier: Apache-2.0
 */

/ {
	chosen {
		zephyr,ot-uart = &board_cdc_acm_uart;
	};
};
```

## src/main.c
```c
/* main.c - OpenThread NCP */

/*
 * Copyright (c) 2020 Tridonic GmbH & Co KG
 *
 * SPDX-License-Identifier: Apache-2.0
 */

#include <zephyr/logging/log.h>
LOG_MODULE_REGISTER(ot_br, LOG_LEVEL_DBG);

#define APP_BANNER "***** OpenThread NCP on Zephyr %s *****"

int main(void)
{
	LOG_INF(APP_BANNER, CONFIG_NET_SAMPLE_APPLICATION_VERSION);
	return 0;
}
```
