/*
 * Copyright (c) 2024 Telink Semiconductor
 *
 * SPDX-License-Identifier: Apache-2.0
 */

/ {
	chosen {
		zephyr,ot-uart = &uart1;
		zephyr,console = &uart0;
	};
};

&uart1 {
	status = "okay";
	current-speed = <115200>;
	pinctrl-0 = <&uart1_tx_pc6_default &uart1_rx_pc7_default
					&uart1_rts_pc5_default &uart1_cts_pc4_default>;
	pinctrl-names = "default";
	hw-flow-control;
};

&uart0 {
	status = "okay";
	current-speed = <115200>;
	pinctrl-0 = <&uart0_tx_pb2_default &uart0_rx_pb3_default>;
	pinctrl-names = "default";
};
