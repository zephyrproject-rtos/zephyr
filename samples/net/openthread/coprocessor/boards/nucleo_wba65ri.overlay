/*
 * Copyright (c) 2025 STMicroelectronics
 *
 * SPDX-License-Identifier: Apache-2.0
 */

ot_uart: &usart1 {
	dmas = <&gpdma1 0 12 STM32_DMA_PERIPH_TX>,
	       <&gpdma1 1 11 (STM32_DMA_PERIPH_RX | STM32_DMA_MODE_CYCLIC)>;
	dma-names = "tx", "rx";
	status = "okay";
	current-speed = <115200>;
};

&gpdma1 {
	status = "okay";
};

/ {
	chosen {
		zephyr,ot-uart = &ot_uart;
	};
};
