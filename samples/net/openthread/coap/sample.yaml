## samples/net/openthread/coap/sample.yaml
```yaml
common:
  harness: net
  tags:
    - net
    - openthread
  depends_on: openthread
  min_flash: 140
  build_only: true
  platform_allow:
    - cc1352p7_lp
    - nrf52840dk/nrf52840
sample:
  description: Runs the OpenThread stack as FTD with CoAP
  name: OpenThread FTD CoAP
tests:
  sample.net.openthread.ftd.coap.client: {}
  sample.net.openthread.ftd.coap.server:
    extra_configs:
      - CONFIG_OT_COAP_SAMPLE_SERVER=y
```

## samples/net/openthread/coprocessor/Kconfig
```kconfig
# Config options for OpenThread Border Router sample app

# Copyright (c) 2020 Tridonic GmbH & Co KG
# SPDX-License-Identifier: Apache-2.0

mainmenu "OpenThread NCP"

menu "Application configuration"

config NET_SAMPLE_APPLICATION_VERSION
	string "Version number for the application"
	default "v0.0.0"

endmenu

source "Kconfig.zephyr"
```

## samples/net/openthread/coprocessor/boards/nucleo_wba65ri.conf
```kconfig
CONFIG_UART_ASYNC_API=y
CONFIG_OPENTHREAD_COPROCESSOR_UART_ASYNC=y
CONFIG_OPENTHREAD_THREAD_VERSION_1_4=y
CONFIG_OPENTHREAD_RADIO_WORKQUEUE_STACK_SIZE=1536
# Disable the console subsystem
CONFIG_CONSOLE=n

# Disable UART-based console specifically
CONFIG_UART_CONSOLE=n

# Optional: Disable printk output to save more space
CONFIG_PRINTK=n

CONFIG_LOG=n
```

## samples/net/openthread/coprocessor/boards/tl7218x.conf
```kconfig
# Telink TL7218X

CONFIG_IEEE802154_TLX_MAC_STATIC=y
CONFIG_IEEE802154_TLX_MAC4=0x01
CONFIG_IEEE802154_TLX_MAC5=0x02
CONFIG_IEEE802154_TLX_MAC6=0x03
CONFIG_IEEE802154_TLX_MAC7=0x04

CONFIG_OPENTHREAD_THREAD_VERSION_1_3=y
CONFIG_OPENTHREAD_FTD=y
CONFIG_OPENTHREAD_MANUAL_START=y
CONFIG_OPENTHREAD_LINK_METRICS_SUBJECT=y
CONFIG_NET_PKT_TXTIME=y
CONFIG_NET_PKT_TIMESTAMP=y
CONFIG_IEEE802154_TELINK_TLX_ENCRYPTION=y
CONFIG_OPENTHREAD_NUM_MESSAGE_BUFFERS=1025
CONFIG_OPENTHREAD_MESSAGE_BUFFER_SIZE=256

CONFIG_LOG_MAX_LEVEL=4
CONFIG_LOG_BACKEND_SPINEL=n
CONFIG_LOG_BACKEND_RTT=n
CONFIG_LOG_BACKEND_UART=y
```

## samples/net/openthread/coprocessor/boards/tlsr9518adk80d.conf
```kconfig
# Telink B91 TLSR9518ADK80D

CONFIG_IEEE802154_B91_RANDOM_MAC=n
CONFIG_IEEE802154_B91_MAC4=0x01
CONFIG_IEEE802154_B91_MAC5=0x02
CONFIG_IEEE802154_B91_MAC6=0x03
CONFIG_IEEE802154_B91_MAC7=0x04
```

## samples/net/openthread/coprocessor/sample.yaml
```yaml
common:
  harness: net
  tags:
    - net
    - openthread
  depends_on: netif
  min_flash: 140
sample:
  description: Runs the OpenThread stack as NCP BR
  name: OpenThread Network Co-Processor
tests:
  sample.net.openthread.coprocessor:
    build_only: true
    platform_allow:
      - nrf52840dk_nrf52840
      - nrf52833dk_nrf52833
      - tlsr9518adk80d
    integration_platforms:
      - nrf52840dk_nrf52840
  sample.net.openthread.coprocessor.usb:
    build_only: true
    platform_allow:
      - nrf52840dk_nrf52840
      - nrf52833dk_nrf52833
    integration_platforms:
      - nrf52840dk_nrf52840
    tags: ci_build
    extra_args:
      - OVERLAY_CONFIG=overlay-usb-nrf-br.conf
      - DTC_OVERLAY_FILE="usb.overlay"
  sample.openthread.coprocessor.rcp:
    build_only: true
    platform_allow:
      - nrf52840dk_nrf52840
      - nrf52833dk_nrf52833
      - tlsr9518adk80d
    integration_platforms:
      - nrf52840dk_nrf52840
    extra_args: OVERLAY_CONFIG=overlay-rcp.conf
```

## samples/net/openthread/ncp/sample.yaml
```yaml
common:
  harness: net
  tags: net
  depends_on: netif
  min_flash: 140
sample:
  description: Runs the OpenThread stack as NCP BR
  name: OpenThread Network Co-Processor
```

## samples/net/openthread/shell/boards/bl704l_dvk.conf
```kconfig
# SPDX-FileCopyrightText: Copyright The Zephyr Project Contributors
# SPDX-License-Identifier: Apache-2.0

# BL704L has only 80 KB RAM; trim the OpenThread shell sample to fit.

# Logging consumes several KB of RAM (buffers + dedicated thread stack).
CONFIG_LOG=n
CONFIG_NET_LOG=n

# Drop the networking shell; keep only the OpenThread shell for the test plan.
CONFIG_NET_SHELL=n

CONFIG_SHELL_STACK_SIZE=4096
CONFIG_HEAP_MEM_POOL_SIZE=2048

# OpenThread message buffers dominate RAM (128 B each); cut the pool.
CONFIG_OPENTHREAD_NUM_MESSAGE_BUFFERS=48

# The default DEVICE_ID_HASH secure-storage key provider relies on
# hwinfo_get_device_eui64()/uuid(), which BL704L doesn't provide, so the AEAD
# key can't be derived and the network key fails to persist (ot networkkey reads
# zero), blocking Thread attach. Use the entry-UID-hash provider instead.
CONFIG_SECURE_STORAGE_ITS_TRANSFORM_AEAD_KEY_PROVIDER_ENTRY_UID_HASH=y

# The mbedTLS AES round tables default to RAM (8 KB); keep them in flash.
CONFIG_MBEDTLS_AES_ROM_TABLES=y
```

## samples/net/openthread/shell/boards/frdm_mcxw71.conf
```kconfig
# Copyright 2025 NXP
# SPDX-License-Identifier: Apache-2.0

# OS
CONFIG_HEAP_MEM_POOL_SIZE=2048
CONFIG_MAIN_STACK_SIZE=2048

#shell
CONFIG_SHELL_STACK_SIZE=2048

# Logging
CONFIG_LOG=n
CONFIG_NET_LOG=n

# Enabling the IEEE802154 CSL endpoint and OpenThread CSL receiver
CONFIG_IEEE802154_CSL_ENDPOINT=y
CONFIG_OPENTHREAD_CSL_RECEIVER=y
```

## samples/net/openthread/shell/boards/frdm_mcxw72.conf
```kconfig
# Copyright 2025 NXP
# SPDX-License-Identifier: Apache-2.0

# OS
CONFIG_HEAP_MEM_POOL_SIZE=4096
CONFIG_MAIN_STACK_SIZE=4096

#shell
CONFIG_SHELL_STACK_SIZE=4096

# Enabling the IEEE802154 CSL endpoint and OpenThread CSL receiver
CONFIG_IEEE802154_CSL_ENDPOINT=y
CONFIG_OPENTHREAD_CSL_RECEIVER=y
```

## samples/net/openthread/shell/boards/frdm_rw612.conf
```kconfig
# Copyright 2025 NXP
# SPDX-License-Identifier: Apache-2.0

# OS
CONFIG_MAIN_STACK_SIZE=4096

#shell
CONFIG_SHELL_STACK_SIZE=5120

# IMU & FW loader
CONFIG_NXP_RF_IMU=y
CONFIG_NXP_FW_LOADER=y

# Enable Openthread RCP host interface
CONFIG_HDLC_RCP_IF=y
```

## samples/net/openthread/shell/boards/m0sense.conf
```kconfig
# SPDX-FileCopyrightText: Copyright The Zephyr Project Contributors
# SPDX-License-Identifier: Apache-2.0

# The crypto-heavy "ot dataset set active" key import runs in the shell thread;
# a 2 KB stack overflows into the secure-storage AES-GCM buffers and corrupts
# the stored network key. Match the BL704L (3r) board's working stack size.
CONFIG_SHELL_STACK_SIZE=4096

# BL702 image-0 slot is 384 KB; trim to fit the OpenThread FTD shell.
CONFIG_LOG=n
CONFIG_NET_LOG=n
CONFIG_NET_SHELL=n

# Console/shell run on UART0; drop the board-default USB CDC-ACM device stack
# to keep the image within the 384 KB code partition.
CONFIG_USBD_CDC_ACM_CLASS=n
CONFIG_USB_DEVICE_STACK_NEXT=n

# Enforce that the linked image stays within the image-0 (slot0) partition so
# it cannot overlap the storage partition used by secure storage / settings.
CONFIG_USE_DT_CODE_PARTITION=y

# Drop shell help strings to keep the image within the 384 KB code partition.
CONFIG_SHELL_HELP=n
```

## samples/net/openthread/shell/boards/mcxw72_evk.conf
```kconfig
# Copyright 2025 NXP
# SPDX-License-Identifier: Apache-2.0

# OS
CONFIG_HEAP_MEM_POOL_SIZE=4096
CONFIG_MAIN_STACK_SIZE=4096

#shell
CONFIG_SHELL_STACK_SIZE=4096
```

## samples/net/openthread/shell/boards/xg24_rb4187c.conf
```kconfig
# Board-specific config for xg24_rb4187c (OpenThread shell)
# Extra stack and ensure console is available early.
# Disable NVS and use RAM-only settings to avoid flash/NVS init hangs on this board.
#
# Power manager: required by RAIL prebuilt (librail_efr32xg24) for
# sl_power_manager_subscribe_em_transition_event and related symbols.
CONFIG_PM=y
#
# If OpenThread state is "disabled" and "ot thread start" returns Error 13 (InvalidState),
# bring the net iface up first so openthread_run() loads the dataset: "net iface up 1"
# (see boards/xg24_rb4187c_README.md).
#
# Stack sizes: the full init chain (net_init -> net_if_up -> openthread_run ->
# ThreadNetif::Up) runs on the main thread. Fault at 0x0801FC0A (ThreadNetif::Up) is often
# stack overflow or bad state; use large stacks so init completes without overflow.

CONFIG_MAIN_STACK_SIZE=16384
CONFIG_DEBUG_OPTIMIZATIONS=y
CONFIG_SYSTEM_WORKQUEUE_STACK_SIZE=16384

# OpenThread: generous stacks for OT thread and radio workqueue (skeleton driver + C++).
CONFIG_OPENTHREAD_THREAD_STACK_SIZE=6144
CONFIG_OPENTHREAD_RADIO_WORKQUEUE_STACK_SIZE=2048

CONFIG_OPENTHREAD_THREAD_VERSION_1_4=y
CONFIG_OPENTHREAD_PING_SENDER=y

# 802.15.4 driver log: use 3 (INFO) to see init success/failure if "net iface up" returns -6.
CONFIG_IEEE802154_SILABS_EFR32_DRIVER_LOG_LEVEL=3

# OpenThread stack logging: enable and set to INFO to verify network operations (attach, rx/tx, etc.).
# Use CONFIG_OPENTHREAD_LOG_LEVEL_DEBG=y (and drop _INFO) for maximum verbosity.
CONFIG_OPENTHREAD_DEBUG=y
CONFIG_OPENTHREAD_LOG_LEVEL_INFO=y
CONFIG_LOG=y

# Ensure console is ready as early as possible
CONFIG_BOOT_BANNER=y
CONFIG_EARLY_CONSOLE=y

# OpenThread: use RAM for OT state (no persistent dataset in flash).
CONFIG_OPENTHREAD_SETTINGS_RAM=y

# Secure storage ITS (required when using PSA crypto) needs a store implementation.
# Enable settings + NVS so ITS store links. If console fails to come up, try
# CONFIG_NVS=n and CONFIG_SETTINGS_NONE=y and use a custom ITS store or ZMS instead.
CONFIG_SETTINGS=y
CONFIG_SETTINGS_NVS=y
CONFIG_NVS=y
CONFIG_SECURE_STORAGE_ITS_STORE_IMPLEMENTATION_SETTINGS=y
```

## samples/net/openthread/shell/sample.yaml
```yaml
common:
  harness: net
  tags:
    - net
    - openthread
  depends_on: openthread
sample:
  description: Test Thread and IEEE 802.15.4 using the OpenThread shell
  name: OpenThread Shell
tests:
  sample.net.openthread.shell:
    build_only: true
    platform_allow:
      - nrf52840dk/nrf52840
      - nrf52840dongle/nrf52840
    integration_platforms:
      - nrf52840dk/nrf52840
  sample.net.openthread.shell.rw612_openthread_rcp_host:
    build_only: true
    extra_args:
      # Disabling monolithic since CI environment doesn't use blobs
      - CONFIG_NXP_MONOLITHIC_NBU=n
    platform_allow:
      - frdm_rw612
      - rd_rw612_bga
  sample.net.openthread.shell.mcxw_openthread_host:
    build_only: true
    extra_args:
      # Disabling monolithic since CI environment doesn't use blobs
      - CONFIG_NXP_MONOLITHIC_NBU=n
    platform_allow:
      - frdm_mcxw71
      - mcxw72_evk/mcxw727c/cpu0
      - frdm_mcxw72/mcxw727c/cpu0
  sample.net.openthread.shell.esp:
    build_only: true
    extra_args:
      - CONFIG_BUILD_ONLY_NO_BLOBS=y
    platform_allow:
      - esp32c6_devkitc/esp32c6/hpcore
      - esp32h2_devkitm
```

## samples/net/pkt_filter/Kconfig
```kconfig
# Private config options for pkt_filter sample app

# Copyright (c) 2025 Nordic Semiconductor ASA
# SPDX-License-Identifier: Apache-2.0

mainmenu "Networking pkt_filter sample application"

config NET_SAMPLE_USE_PACKET_PRIORITIES
	bool "Use network packet priorities"
	help
	  Create multiple traffic class queues in order to test
	  network packet priorities.

source "samples/net/common/Kconfig"
source "Kconfig.zephyr"
```

## samples/net/pkt_filter/sample.yaml
```yaml
sample:
  description: Network packet filtering functionality
  name: Network packet filter sample app
common:
  harness: net
  min_ram: 64
  tags:
    - net
    - statistics
    - net_pkt_filter
  depends_on: netif
  integration_platforms:
    - native_sim
tests:
  sample.net.pkt_filter: {}
  sample.net.pkt_filter_priorities:
    extra_args: EXTRA_CONF_FILE="overlay-priority.conf"
```

## samples/net/prometheus/Kconfig
```kconfig
# Config options for prometheus sample application

# Copyright (c) 2024 Mustafa Abdullah Kus, Sparse Technology
# SPDX-License-Identifier: Apache-2.0

mainmenu "Prometheus sample application"

config NET_SAMPLE_HTTP_SERVICE
	bool "Enable HTTP service"
	default y

config NET_SAMPLE_HTTP_SERVER_SERVICE_PORT
	int "Port number for HTTP service"
	default 80
	depends on NET_SAMPLE_HTTP_SERVICE

config NET_SAMPLE_HTTPS_SERVICE
	bool "Enable HTTPS service"
	depends on NET_SOCKETS_SOCKOPT_TLS || TLS_CREDENTIALS

config NET_SAMPLE_HTTPS_SERVER_SERVICE_PORT
	int "Port number for HTTPS service"
	default 443
	depends on NET_SAMPLE_HTTPS_SERVICE

config NET_SAMPLE_PSK_HEADER_FILE
	string "Header file containing PSK"
	default "dummy_psk.h"
	depends on MBEDTLS_KEY_EXCHANGE_PSK_ENABLED
	help
	  Name of a header file containing a
	  pre-shared key.

config NET_SAMPLE_CERTS_WITH_SC
	bool "Signed certificates"
	depends on NET_SOCKETS_SOCKOPT_TLS
	help
	  Enable this flag, if you are interested to run this
	  application with signed certificates and keys.

source "Kconfig.zephyr"
```

## samples/net/prometheus/sample.yaml
```yaml
sample:
  description: Prometheus Client Sample
  name: prometheus_client_sample
common:
  harness: net
  depends_on: netif
  min_ram: 192
  tags:
    - http
    - net
    - server
    - socket
    - prometheus
  # Exclude CONFIG_HAS_RENESAS_RA_FSP as Renesas RA HAL has build error with mbedtls Socket
  filter: not CONFIG_HAS_RENESAS_RA_FSP
  integration_platforms:
    - qemu_x86
tests:
  sample.net.prometheus: {}
```

## samples/net/promiscuous_mode/sample.yaml
```yaml
sample:
  name: Promiscuous mode sample application
tests:
  sample.net.promiscuous_mode:
    harness: net
    depends_on: netif
    tags:
      - net
      - promisc
```

## samples/net/ptp/Kconfig
```kconfig
# Private config options for PTP sample app

# Copyright (c) 2024 BayLibre SAS
# SPDX-License-Identifier: Apache-2.0

mainmenu "PTP sample application"

if PTP

config NET_SAMPLE_RUN_DURATION
	int "Run the application this many seconds"
	default 0
	help
	  A value of zero means that the sample application is run forever.

endif

source "Kconfig.zephyr"
```

## samples/net/ptp/master/sample.yaml
```yaml
common:
  harness: net
  tags: net ptp
sample:
  description: Test PTP master functionality
  name: PTP master app
tests:
  sample.net.ptp.slave:
    platform_allow: frdm_k64f sam_e70_xplained nucleo_f767zi nucleo_h743zi nucleo_h745zi_q_m7
    depends_on: netif
```

## samples/net/ptp/sample.yaml
```yaml
common:
  harness: net
  tags:
    - net
    - ptp
sample:
  description: Test PTP functionality
  name: PTP sample app
tests:
  sample.net.ptp:
    platform_allow:
      - native_sim
      - native_sim/native/64
      - nucleo_h563zi
      - nucleo_h743zi
      - nucleo_h745zi_q/stm32h745xx/m7
      - qemu_x86
    depends_on: eth
    integration_platforms:
      - nucleo_h563zi
```

## samples/net/ptp/slave/sample.yaml
```yaml
common:
  harness: net
  tags: net ptp
sample:
  description: Test PTP slave functionality
  name: PTP slave app
tests:
  sample.net.ptp.slave:
    platform_allow: frdm_k64f sam_e70_xplained nucleo_f767zi nucleo_h743zi nucleo_h745zi_q_m7
    depends_on: netif
```

## samples/net/quic/echo_client/sample.yaml
```yaml
sample:
  description: echo client using QUIC API
  name: quic_service_echo_client
common:
  harness: net
  depends_on: netif
  filter: CONFIG_FULL_LIBC_SUPPORTED and not CONFIG_NATIVE_LIBC
tests:
  sample.net.quic.service.echo_client:
    tags:
      - net
      - socket
```
