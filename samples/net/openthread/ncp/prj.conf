## CMakeLists.txt
```
# SPDX-License-Identifier: Apache-2.0

cmake_minimum_required(VERSION 3.15.7)

find_package(Zephyr REQUIRED HINTS $ENV{ZEPHYR_BASE})
project(ncp)

target_sources( app
    PRIVATE
        src/main.c
)

include(${ZEPHYR_BASE}/samples/net/common/common.cmake)

set(gen_dir ${ZEPHYR_BINARY_DIR}/include/generated/)
```

## sample.yaml
```
common:
  harness: net
  tags: net
  depends_on: netif
  min_flash: 140
sample:
  description: Runs the OpenThread stack as NCP BR
  name: OpenThread Network Co-Processor
```

## prj.conf
```kconfig
# Generic networking options
CONFIG_NETWORKING=y

CONFIG_NET_CONFIG_NEED_IPV6=y
CONFIG_NET_CONFIG_NEED_IPV4=n

# disable certain parts of Zephyr IPv6 stack
CONFIG_NET_IPV6_NBR_CACHE=n
CONFIG_NET_IPV6_MLD=n

# Kernel options
CONFIG_NEWLIB_LIBC=y
CONFIG_MAIN_STACK_SIZE=4096
CONFIG_TEST_RANDOM_GENERATOR=y
CONFIG_INIT_STACKS=y
#CONFIG_DEBUG_OPTIMIZATIONS=y

# Logging
CONFIG_NET_LOG=y
CONFIG_LOG=y
CONFIG_NET_STATISTICS=y
CONFIG_PRINTK=y

# Network buffers
CONFIG_NET_PKT_RX_COUNT=16
CONFIG_NET_PKT_TX_COUNT=16
CONFIG_NET_BUF_RX_COUNT=80
CONFIG_NET_BUF_TX_COUNT=80
CONFIG_NET_CONTEXT_NET_PKT_POOL=y

# Thread by default registers quite a lot addresses.
CONFIG_NET_MAX_CONTEXTS=10

# Allow monitoring of stacks
# CONFIG_KERNEL_SHELL=y

# mbedTLS tweaks
CONFIG_MBEDTLS_SSL_MAX_CONTENT_LEN=768
# CONFIG_MBEDTLS_DEBUG=y
# CONFIG_MBEDTLS_DEBUG_LEVEL=4

# Enable OpenThread
CONFIG_NET_L2_OPENTHREAD=y

# Configure OpenThread
CONFIG_OPENTHREAD_CHANNEL=26
# Use PANID 0xffff to be able to commission
CONFIG_OPENTHREAD_PANID=65535

# Increase a few stack and other sizes for OpenThread
CONFIG_SYSTEM_WORKQUEUE_STACK_SIZE=2048
CONFIG_SHELL_STACK_SIZE=3072
CONFIG_OPENTHREAD_THREAD_STACK_SIZE=8192
CONFIG_OPENTHREAD_PKT_LIST_SIZE=20

# Settings for the Border Router
# from https://openthread.io/guides/border-router/build#build-and-flash-ncp

# CONFIG_OPENTHREAD_DHCP6_CLIENT is not set
CONFIG_OPENTHREAD_DHCP6_SERVER=y
CONFIG_OPENTHREAD_COMMISSIONER=y
CONFIG_OPENTHREAD_BORDER_AGENT=y
CONFIG_OPENTHREAD_BORDER_ROUTER=y
CONFIG_OPENTHREAD_UDP_FORWARD=y
CONFIG_OPENTHREAD_NCP=y
CONFIG_OPENTHREAD_ENABLE_SERVICE=y

# OpenThread shell interferes with Zephyr shell
CONFIG_OPENTHREAD_SHELL=n
```

## overlay-tri-n4m-br.conf
```kconfig
# TRI n4m BR
# Use UART_0 for Shell/Console
CONFIG_UART_SHELL_ON_DEV_NAME="UART_0"
CONFIG_UART_CONSOLE_ON_DEV_NAME="UART_0"
CONFIG_SHELL_PROMPT_UART="ncp-uart:~$ "

# Use UART_1 for NCP
CONFIG_OPENTHREAD_NCP_SPINEL_ON_UART_DEV_NAME="UART_1"

# Use USB-CDC-ACM for NCP
CONFIG_OPENTHREAD_NCP_SPINEL_ON_UART_ACM=y
CONFIG_OPENTHREAD_NCP_SPINEL_ON_UART_DEV_NAME="CDC_ACM_0"
CONFIG_STDOUT_CONSOLE=y
CONFIG_GPIO=y
CONFIG_USB=y
CONFIG_USB_DEVICE_STACK=y
CONFIG_USB_DEVICE_PRODUCT="OpenThread NCP K64"
CONFIG_LOG=y
CONFIG_USB_DRIVER_LOG_LEVEL_ERR=y
CONFIG_USB_CDC_ACM=y
CONFIG_USB_DEVICE_LOG_LEVEL_ERR=y
CONFIG_SERIAL=y
CONFIG_UART_INTERRUPT_DRIVEN=y
CONFIG_UART_LINE_CTRL=y
CONFIG_USB_REQUEST_BUFFER_SIZE=2048

# disable ethernet on K64
CONFIG_NET_L2_ETHERNET=n
CONFIG_ETH_MCUX=n

CONFIG_IEEE802154_RF2XX=y
CONFIG_NET_CONFIG_IEEE802154_DEV_NAME="RF2XX_0"
CONFIG_ISR_STACK_SIZE=4096
```

## overlay-usb-nrf-br.conf
```kconfig
# Nordic NCP USB CDC-ACM

# Use UART_0 for Shell/Console
CONFIG_UART_SHELL_ON_DEV_NAME="UART_0"
CONFIG_UART_CONSOLE_ON_DEV_NAME="UART_0"
CONFIG_SHELL_PROMPT_UART="ncp-uart:~$ "

# Use USB-CDC-ACM for NCP
CONFIG_OPENTHREAD_NCP_SPINEL_ON_UART_ACM=y
CONFIG_OPENTHREAD_NCP_SPINEL_ON_UART_DEV_NAME="CDC_ACM_0"
CONFIG_USB=y
CONFIG_USB_DEVICE_STACK=y
CONFIG_USB_DEVICE_PRODUCT="OpenThread NCP NRF"
CONFIG_USB_CDC_ACM=y
CONFIG_UART_LINE_CTRL=y
CONFIG_USB_REQUEST_BUFFER_SIZE=2048

CONFIG_ISR_STACK_SIZE=4096
```

## src/main.c
```c
/* main.c - OpenThread NCP */

/*
 * Copyright (c) 2020 Tridonic GmbH & Co KG
 *
 * SPDX-License-Identifier: Apache-2.0
 */

#include <logging/log.h>
LOG_MODULE_REGISTER(ot_br, LOG_LEVEL_DBG);

#include <zephyr.h>
#include <usb/usb_device.h>
#include <drivers/uart.h>

#define APP_BANNER "***** OpenThread NCP on Zephyr %s *****"

void main(void)
{
#if defined(CONFIG_OPENTHREAD_NCP_SPINEL_ON_UART_ACM)
	const struct device *dev;
	uint32_t baudrate = 0U;
	int ret;

	dev = device_get_binding(
		CONFIG_OPENTHREAD_NCP_SPINEL_ON_UART_DEV_NAME);
	if (!dev) {
		LOG_ERR("UART device not found");
		return;
	}

	ret = usb_enable(NULL);
	if (ret != 0) {
		LOG_ERR("Failed to enable USB");
		return;
	}

	LOG_INF("Wait for host to settle");
	k_sleep(K_SECONDS(1));

	ret = uart_line_ctrl_get(dev, UART_LINE_CTRL_BAUD_RATE, &baudrate);
	if (ret) {
		LOG_WRN("Failed to get baudrate, ret code %d", ret);
	} else {
		LOG_INF("Baudrate detected: %d", baudrate);
	}
#endif /* CONFIG_OPENTHREAD_NCP_SPINEL_ON_UART_ACM */

	LOG_INF(APP_BANNER, CONFIG_NET_SAMPLE_APPLICATION_VERSION);
}
```
