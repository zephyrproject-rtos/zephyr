/*
 * Copyright (c) 2026 Espressif Systems (Shanghai) Co., Ltd.
 *
 * SPDX-License-Identifier: Apache-2.0
 */

/ {
	chosen {
		zephyr,hdlc-rcp-if = &hdlc_rcp_if;
		zephyr,ot-uart = &uart1;
	};

	hdlc_rcp_if: hdlc_rcp_if {
		compatible = "uart,hdlc-rcp-if";
	};
};

&psram0 {
	size = <DT_SIZE_M(2)>;
};
