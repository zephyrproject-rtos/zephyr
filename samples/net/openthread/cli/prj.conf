## CMakeLists.txt
```
# SPDX-License-Identifier: Apache-2.0

cmake_minimum_required(VERSION 3.20.0)

find_package(Zephyr REQUIRED HINTS $ENV{ZEPHYR_BASE})
project(ot_cli)

target_sources(app PRIVATE src/main.c)
```

## Kconfig
```
# Copyright (c) 2025 Telink Semiconductor
# SPDX-License-Identifier: Apache-2.0

if SHELL_BACKEND_SERIAL

config SHELL_BACKEND_SERIAL_TX_RING_BUFFER_SIZE
	default 1024

config SHELL_BACKEND_SERIAL_RX_RING_BUFFER_SIZE
	default 1024

endif # SHELL_BACKEND_SERIAL

source "Kconfig.zephyr"
```

## prj.conf
```kconfig
# Copyright (c) 2025 Telink Semiconductor
# SPDX-License-Identifier: Apache-2.0

CONFIG_NETWORKING=y
CONFIG_NET_L2_OPENTHREAD=y

CONFIG_NET_PKT_RX_COUNT=8
CONFIG_NET_PKT_TX_COUNT=8

# Thread v1.3 features
CONFIG_OPENTHREAD_THREAD_VERSION_1_3=y
CONFIG_OPENTHREAD_SRP_CLIENT=y
CONFIG_OPENTHREAD_JOINER=y
CONFIG_OPENTHREAD_LINK_METRICS_SUBJECT=y
CONFIG_OPENTHREAD_BORDER_ROUTER=y
CONFIG_OPENTHREAD_COMMISSIONER=y
CONFIG_OPENTHREAD_PING_SENDER=y
CONFIG_OPENTHREAD_DHCP6_CLIENT=y
CONFIG_OPENTHREAD_DNS_CLIENT=y
CONFIG_OPENTHREAD_SLAAC=y
CONFIG_OPENTHREAD_REFERENCE_DEVICE=y
CONFIG_OPENTHREAD_MLR=y
CONFIG_OPENTHREAD_MAC_FILTER=y
CONFIG_OPENTHREAD_DUA=y
CONFIG_OPENTHREAD_COAP=y
CONFIG_OPENTHREAD_COAPS=y
CONFIG_OPENTHREAD_ENABLE_SERVICE=y
CONFIG_OPENTHREAD_NUM_MESSAGE_BUFFERS=350
CONFIG_OPENTHREAD_CSL_RECEIVE_TIME_AHEAD=480

# Logging & shell
CONFIG_LOG=y
CONFIG_SHELL_VT100_COLORS=n
CONFIG_SHELL_PROMPT_UART=""
CONFIG_NET_SHELL=y
CONFIG_OPENTHREAD_SHELL=y
CONFIG_OPENTHREAD_MANUAL_START=y
CONFIG_SHELL_DEFAULT_TERMINAL_WIDTH=640
CONFIG_SHELL_CMD_BUFF_SIZE=640
CONFIG_OPENTHREAD_CLI_MAX_LINE_LENGTH=640

# thread network credentials
CONFIG_OPENTHREAD_CHANNEL=26
CONFIG_OPENTHREAD_PANID=1234
CONFIG_OPENTHREAD_XPANID="ff:0d:b8:ff:ff:ff:ff:01"
CONFIG_OPENTHREAD_NETWORKKEY="ff:ee:dd:cc:bb:aa:99:88:77:66:55:44:33:22:11:00"

# openthread
CONFIG_MBEDTLS_PEM_CERTIFICATE_FORMAT=y
CONFIG_COMMON_LIBC_MALLOC_ARENA_SIZE=12288
```

## overlay-telink-features.conf
```kconfig
# Telink relative thread features

CONFIG_NET_PKT_TXTIME=y
CONFIG_NET_PKT_TIMESTAMP=y
CONFIG_IEEE802154_2015=y
CONFIG_OPENTHREAD_NUM_MESSAGE_BUFFERS=256
```

## overlay-telink-fixed-mac.conf
```kconfig
# Copyright (c) 2024 Telink Semiconductor
# SPDX-License-Identifier: Apache-2.0

# Telink Fixed mac address from flash

CONFIG_IEEE802154_B9X_MAC_FLASH=y
```

## overlay-thread-mon.conf
```kconfig
# Copyright (c) 2025 Telink Semiconductor
# SPDX-License-Identifier: Apache-2.0

CONFIG_THREAD_ANALYZER=y
CONFIG_THREAD_ANALYZER_USE_LOG=y
CONFIG_THREAD_ANALYZER_AUTO=y
CONFIG_THREAD_ANALYZER_AUTO_INTERVAL=5
CONFIG_THREAD_NAME=y
CONFIG_THREAD_RUNTIME_STATS=y
```

## boards/tl3218.conf
```kconfig
# Telink relative thread features
CONFIG_NET_PKT_TXTIME=y
CONFIG_NET_PKT_TIMESTAMP=y
CONFIG_IEEE802154_TELINK_TLX_ENCRYPTION=y
CONFIG_OPENTHREAD_NUM_MESSAGE_BUFFERS=35

CONFIG_OPENTHREAD_THREAD_VERSION_1_1=y
CONFIG_OPENTHREAD_SRP_CLIENT=n
CONFIG_OPENTHREAD_JOINER=n
CONFIG_OPENTHREAD_LINK_METRICS_SUBJECT=n
CONFIG_OPENTHREAD_BORDER_ROUTER=n
CONFIG_OPENTHREAD_COMMISSIONER=n
CONFIG_OPENTHREAD_PING_SENDER=n
CONFIG_OPENTHREAD_DHCP6_CLIENT=n
CONFIG_OPENTHREAD_DNS_CLIENT=n
CONFIG_OPENTHREAD_SLAAC=n
CONFIG_OPENTHREAD_REFERENCE_DEVICE=n
CONFIG_OPENTHREAD_MLR=n
CONFIG_OPENTHREAD_MAC_FILTER=n
CONFIG_OPENTHREAD_DUA=n
CONFIG_OPENTHREAD_COAP=n
CONFIG_OPENTHREAD_COAPS=n
CONFIG_OPENTHREAD_ENABLE_SERVICE=n
CONFIG_OPENTHREAD_CSL_RECEIVE_TIME_AHEAD=480
CONFIG_OPENTHREAD_MAX_CHILDREN=5
```

## boards/tl3218x.conf
```kconfig
# usb
CONFIG_USB_DEVICE_STACK=y
CONFIG_USB_DEVICE_INITIALIZE_AT_BOOT=n

# Telink relative thread features
CONFIG_NET_PKT_TXTIME=y
CONFIG_NET_PKT_TIMESTAMP=y
CONFIG_OPENTHREAD_NUM_MESSAGE_BUFFERS=35

CONFIG_OPENTHREAD_NUM_MESSAGE_BUFFERS=150
CONFIG_IEEE802154_TLX_MAC_FLASH=y

CONFIG_OPENTHREAD_JOINER=n
CONFIG_OPENTHREAD_LINK_METRICS_SUBJECT=n
CONFIG_OPENTHREAD_BORDER_ROUTER=n
CONFIG_OPENTHREAD_COMMISSIONER=n
CONFIG_OPENTHREAD_DHCP6_CLIENT=n
CONFIG_OPENTHREAD_DNS_CLIENT=n
CONFIG_OPENTHREAD_SLAAC=n
CONFIG_OPENTHREAD_REFERENCE_DEVICE=n
CONFIG_OPENTHREAD_MLR=n
CONFIG_OPENTHREAD_MAC_FILTER=n
CONFIG_OPENTHREAD_DUA=n
CONFIG_OPENTHREAD_COAP=n
CONFIG_OPENTHREAD_ENABLE_SERVICE=n
CONFIG_OPENTHREAD_CSL_RECEIVE_TIME_AHEAD=480
CONFIG_OPENTHREAD_MAX_CHILDREN=5

CONFIG_NET_BUF_TX_COUNT=12
CONFIG_NET_BUF_RX_COUNT=12

CONFIG_OPENTHREAD_COAPS=n
CONFIG_MBEDTLS_PEM_CERTIFICATE_FORMAT=n
CONFIG_COMMON_LIBC_MALLOC_ARENA_SIZE=8192
```

## boards/tl7218.conf
```kconfig
# usb
CONFIG_USB_DEVICE_STACK=y
CONFIG_USB_DEVICE_INITIALIZE_AT_BOOT=n

# Telink relative thread features
CONFIG_NET_PKT_TXTIME=y
CONFIG_NET_PKT_TIMESTAMP=y
CONFIG_IEEE802154_TELINK_TLX_ENCRYPTION=y
CONFIG_OPENTHREAD_NUM_MESSAGE_BUFFERS=350
CONFIG_IEEE802154_TLX_MAC_FLASH=y
```

## boards/tl3218x.overlay
```dts
/*
 * Copyright (c) 2024 Telink Semiconductor
 *
 * SPDX-License-Identifier: Apache-2.0
 */

/ {
	chosen {
		zephyr,shell-uart = &cdc_acm_uart0;
	};
};

&zephyr_udc0 {
	cdc_acm_uart0: cdc_acm_uart0 {
		compatible = "zephyr,cdc-acm-uart";
	};
};
```

## boards/tl7218x.overlay
```dts
/*
 * Copyright (c) 2024 Telink Semiconductor
 *
 * SPDX-License-Identifier: Apache-2.0
 */

/ {
	chosen {
		zephyr,shell-uart = &uart0;
	};
};
```

## boards/tlsr9118bdk40d_v1.overlay
```dts
/*
 * Copyright (c) 2025 Telink Semiconductor
 *
 * SPDX-License-Identifier: Apache-2.0
 */

&ieee802154 {
	status = "okay";
	serial = <&uart2>;
};

&uart2 {
	status = "okay";
	current-speed = <115200>;
	pinctrl-0 = <&uart2_tx_p16_default &uart2_rx_p15_default
				&uart2_rts_p18_default &uart2_cts_p17_default>;
	pinctrl-names = "default";
	hw-flow-control;
};
```

## boards/tlsr9258a.overlay
```dts
/*
 * Copyright (c) 2024 Telink Semiconductor
 *
 * SPDX-License-Identifier: Apache-2.0
 */

/ {
	chosen {
		zephyr,shell-uart = &cdc_acm_uart0;
	};
};

&zephyr_udc0 {
	cdc_acm_uart0: cdc_acm_uart0 {
		compatible = "zephyr,cdc-acm-uart";
 	};
};
```

## boards/tlsr9518adk80d.overlay
```dts
/*
 * Copyright (c) 2023-2024 Telink Semiconductor
 *
 * SPDX-License-Identifier: Apache-2.0
 */

/ {
	chosen {
		zephyr,shell-uart = &uart0;
	};
};
```

## boards/tlsr9528a.overlay
```dts
/*
 * Copyright (c) 2023-2024 Telink Semiconductor
 *
 * SPDX-License-Identifier: Apache-2.0
 */

/ {
	chosen {
		zephyr,shell-uart = &cdc_acm_uart0;
	};
};

&zephyr_udc0 {
	cdc_acm_uart0: cdc_acm_uart0 {
		compatible = "zephyr,cdc-acm-uart";
	};
};
```

## src/main.c
```c
/* main.c - OpenThread */

/*
 * Copyright (c) 2023-2024 Telink
 *
 * SPDX-License-Identifier: Apache-2.0
 */

#include <zephyr/logging/log.h>
LOG_MODULE_REGISTER(ot_main, LOG_LEVEL_DBG);

#include <zephyr/net/openthread.h>
#include <openthread/thread.h>

#ifdef CONFIG_USB_DEVICE_STACK
#include <zephyr/usb/usb_device.h>
#endif /* CONFIG_USB_DEVICE_STACK */

static void ot_satate_changed(otChangedFlags flags,
	struct openthread_context *ot_context, void *user_data)
{
	if (flags & OT_CHANGED_THREAD_ROLE) {
		switch (otThreadGetDeviceRole(ot_context->instance)) {
		case OT_DEVICE_ROLE_CHILD:
			LOG_INF("OT child");
			LOG_INF("OT Short address: %04x",
				otLinkGetShortAddress(ot_context->instance));
			LOG_HEXDUMP_INF(otLinkGetExtendedAddress(ot_context->instance),
				OT_EXT_ADDRESS_SIZE, "OT Extended address:");
			break;
		case OT_DEVICE_ROLE_ROUTER:
			LOG_INF("OT router");
			LOG_INF("OT Short address: %04x",
				otLinkGetShortAddress(ot_context->instance));
			LOG_HEXDUMP_INF(otLinkGetExtendedAddress(ot_context->instance),
				OT_EXT_ADDRESS_SIZE, "OT Extended address:");
			break;
		case OT_DEVICE_ROLE_LEADER:
			LOG_INF("OT leader");
			LOG_INF("OT Short address: %04x",
				otLinkGetShortAddress(ot_context->instance));
			LOG_HEXDUMP_INF(otLinkGetExtendedAddress(ot_context->instance),
				OT_EXT_ADDRESS_SIZE, "OT Extended address:");
			break;
		case OT_DEVICE_ROLE_DISABLED:
			LOG_INF("OT disabled");
			break;
		case OT_DEVICE_ROLE_DETACHED:
			LOG_INF("OT detached");
			break;
		default:
			LOG_INF("OT unknown");
			break;
		}
	}
}

int main(void)
{
#ifdef CONFIG_USB_DEVICE_STACK
	usb_enable(NULL);
#endif /* CONFIG_USB_DEVICE_STACK */
	LOG_INF("***** OpenThread CLI on Zephyr *****");
#ifndef CONFIG_OPENTHREAD_MANUAL_START
	LOG_INF("OT channel     %u",     CONFIG_OPENTHREAD_CHANNEL);
	LOG_INF("OT pan id      %04x",   CONFIG_OPENTHREAD_PANID);
	LOG_INF("OT pan ext id  %s",     CONFIG_OPENTHREAD_XPANID);
	LOG_INF("OT network key %s",     CONFIG_OPENTHREAD_NETWORKKEY);
#endif /* CONFIG_OPENTHREAD_MANUAL_START */
	static struct openthread_state_changed_cb ot_state_cahnge = {
		.state_changed_cb = ot_satate_changed
	};

	openthread_state_changed_cb_register(openthread_get_default_context(), &ot_state_cahnge);

	return 0;
}
```
