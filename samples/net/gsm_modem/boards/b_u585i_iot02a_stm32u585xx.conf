## samples/net/gsm_modem/boards/b_u585i_iot02a_stm32u585xx.conf
```kconfig
CONFIG_TEST_RANDOM_GENERATOR=y
CONFIG_GSM_MUX=y
CONFIG_UART_MUX=y
CONFIG_MODEM_GSM_APN="internet"
CONFIG_MAIN_STACK_SIZE=8192
CONFIG_MODEM_GSM_QUECTEL=y
CONFIG_MODEM_SHELL=n
CONFIG_NET_MGMT_EVENT_INFO=y
CONFIG_NET_MGMT_EVENT_MONITOR=y
CONFIG_NET_MGMT_EVENT_MONITOR_AUTO_START=y
CONFIG_NET_LOG=y
CONFIG_NET_MGMT_EVENT_LOG_LEVEL_DBG=y
```

## samples/net/gsm_modem/sample.yaml
```yaml
common:
  harness: net
  depends_on: serial-net
  tags: net ppp modem gsm
  platform_allow: frdm_k64f
  extra_args: DTC_OVERLAY_FILE="boards/frdm_uart2_dts.overlay"
sample:
  description: Sample for generic GSM modem
  name: Generic GSM modem using PPP
tests:
  sample.net.ppp.gsm.modem:
    extra_configs:
      - CONFIG_TEST_RANDOM_GENERATOR=y
  sample.net.ppp.gsm.modem.mux:
    extra_configs:
      - CONFIG_TEST_RANDOM_GENERATOR=y
      - CONFIG_GSM_MUX=y
      - CONFIG_UART_MUX=y
```

## samples/net/http_client/sample.yaml
```yaml
common:
    harness: net
    tags: net http
sample:
  name: HTTP Client
tests:
  test:
    depends_on: netif
  test_bt:
    extra_args: CONF_FILE="prj_bt.conf"
    platform_whitelist: qemu_x86 qemu_cortex_m3
  test_tls:
    extra_args: CONF_FILE="prj_tls.conf"
    platform_whitelist: qemu_x86 qemu_cortex_m3
```

## samples/net/http_server/sample.yaml
```yaml
sample:
  name: HTTP Server
tests:
  test:
    harness: net
    depends_on: netif
    tags: net http
    min_flash: 140
  test_bt:
    harness: net
    extra_args: CONF_FILE="prj_bt.conf"
    platform_whitelist: qemu_x86
    tags: net http
  test_usbnet_ecm:
    harness: net
    extra_args: OVERLAY_CONFIG="overlay-netusb.conf"
    tags: net usb
    depends_on: usb_device
    min_ram: 64
  test_usbnet_eem:
    harness: net
    extra_args: OVERLAY_CONFIG="overlay-netusb.conf"
    extra_configs:
      - CONFIG_USB_DEVICE_NETWORK_ECM=n
      - CONFIG_USB_DEVICE_NETWORK_EEM=y
    tags: net usb
    depends_on: usb_device
    min_ram: 64
```

## samples/net/https_client/sample.yaml
```yaml
sample:
  name: HTTPS Client
tests:
  - test:
      build_only: true
      depends_on: netif
      platform_exclude: qemu_cortex_m3
      tags: net http
  - test_bt:
      build_only: true
      extra_args: CONF_FILE="prj_bt.conf"
      platform_whitelist: qemu_x86
      tags: net http
```

## samples/net/ieee802154/device1/sample.yaml
```yaml
sample:
  description: Test of native posix 802.15.4 radio_api driver
  name: device1
common:
  harness: net
  tags: posix net
```

## samples/net/ipv4_autoconf/boards/sam_e70_xplained.conf
```kconfig
# sam_e70_xplained board need more buffers, otherwise it fails to build

CONFIG_NET_PKT_RX_COUNT=20
CONFIG_NET_PKT_TX_COUNT=20
CONFIG_NET_BUF_RX_COUNT=30
CONFIG_NET_BUF_TX_COUNT=30
```

## samples/net/ipv4_autoconf/sample.yaml
```yaml
common:
  harness: net
  depends_on: netif
  tags:
    - net
    - ipv4_autoconf
sample:
  description: Test IPv4 autoconf functionality
  name: IPv4 autoconf sample app
tests:
  sample.net.ipv4_autoconf:
    platform_allow:
      - qemu_x86
      - native_sim
      - native_sim/native/64
    integration_platforms:
      - native_sim
  sample.net.ipv4_autoconf.wifi.nrf70dk:
    extra_args:
      - SNIPPET=wifi-ipv4
      - CONFIG_BUILD_ONLY_NO_BLOBS=y
    platform_allow:
      - nrf7002dk/nrf5340/cpuapp
```

## samples/net/irc_bot/sample.yaml
```yaml
sample:
  name: IRC Bot
tests:
  test:
    harness: net
    depends_on: netif gpio
    tags: net irc
```

## samples/net/latmon/dts/bindings/latency-monitor.yaml
```yaml
# Copyright (c) 2024 Jorge Ramirez-Ortiz <jorge.ramirez@oss.qualcomm.com>
# SPDX-License-Identifier: Apache-2.0

description: GPIO latency monitor

compatible: "latency-monitor"

child-binding:
  properties:
    gpios:
      type: phandle-array
      required: true

    pinctrl-0:
      type: phandle
      required: false

    pinctrl-names:
      type: string
      required: false
```

## samples/net/latmon/sample.yaml
```yaml
sample:
  name: Latency Benchmarking Tool
tests:
  sample.basic.latmon
    tags:
      - gpio
      - devicetree
    integration_platforms:
      - frdm_k64f
    depends_on: gpio
    harness: console
```

## samples/net/leds_demo/sample.yaml
```yaml
sample:
  description: Control LEDs using CoAP
  name: LED Demo
tests:
  test:
    depends_on: netif gpio
    harness: net
    tags: net coap
```

## samples/net/lldp/Kconfig
```kconfig
# Kconfig - Private config options for LLDP sample app

#
# Copyright (c) 2018 Intel Corporation
#
# SPDX-License-Identifier: Apache-2.0
#

# This sample application will have three network interfaces.

mainmenu "LLDP sample application"

source "Kconfig.zephyr"

if NET_LLDP

config NET_SAMPLE_IFACE2_MY_IPV6_ADDR
	string "My IPv6 address for second interface"
	help
	  The value depends on your network setup.

config NET_SAMPLE_IFACE2_MY_IPV4_ADDR
	string "My IPv4 address for second interface"
	help
	  The value depends on your network setup.

config NET_SAMPLE_IFACE2_VLAN_TAG
	int "VLAN tag for second interface"
	default 100
	range 0 4094
	depends on NET_VLAN
	help
	  Set VLAN (virtual LAN) tag (id) that is used in the sample
	  application.

config NET_SAMPLE_IFACE3_MY_IPV6_ADDR
	string "My IPv6 address for third interface"
	help
	  The value depends on your network setup.

config NET_SAMPLE_IFACE3_MY_IPV4_ADDR
	string "My IPv4 address for third interface"
	help
	  The value depends on your network setup.

config NET_SAMPLE_IFACE3_VLAN_TAG
	int "VLAN tag for third interface"
	default 200
	range 0 4094
	depends on NET_VLAN
	help
	  Set VLAN (virtual LAN) tag (id) that is used in the sample
	  application.

endif
```

## samples/net/lldp/sample.yaml
```yaml
common:
  harness: net
  tags:
    - net
    - lldp
sample:
  description: Test LLDP functionality
  name: LLDP sample app
tests:
  sample.net.lldp:
    platform_allow:
      - native_posix
      - native_posix/native/64
      - native_sim
      - native_sim/native/64
    integration_platforms:
      - native_sim
    depends_on: eth
```

## samples/net/lwm2m_client/Kconfig
```kconfig
# Private config options for LwM2M client sample

# Copyright (c) 2023 NordicNordic Semiconductor ASA
# SPDX-License-Identifier: Apache-2.0

mainmenu "LwM2M Client sample"

config NET_SAMPLE_LWM2M_ID
	string "LwM2M Client identity"
	default ""
	help
	  This is used as client endpoint name as well as PSK ID.
	  Leave empty for using CONFIG_BOARD

if LWM2M_DTLS_SUPPORT
config NET_SAMPLE_LWM2M_PSK
	string "PSK key"
	default "000102030405060708090a0b0c0d0e0f"
	help
	  PSK key as a hex string.
	  Maximum binary size is CONFIG_LWM2M_SECURITY_KEY_SIZE.

config NET_SAMPLE_LWM2M_TLS_TAG
	int "TLS security tag"
	default 1
	help
	  TLS security tag to use when connecting.
endif

config NET_SAMPLE_MIGHT_HAVE_INTERNET
	bool
	default y if (WIFI || MODEM)

config NET_SAMPLE_LWM2M_SERVER
	string "LwM2M server address"
	default "coap://leshan.eclipseprojects.io:5683" if (NET_SAMPLE_MIGHT_HAVE_INTERNET && !LWM2M_DTLS_SUPPORT)
	default "coaps://leshan.eclipseprojects.io:5684" if (NET_SAMPLE_MIGHT_HAVE_INTERNET && LWM2M_DTLS_SUPPORT)
	default "coap://192.0.2.2:5683" if !LWM2M_DTLS_SUPPORT
	default "coaps://192.0.2.2:5684" if (LWM2M_DTLS_SUPPORT && !LWM2M_RD_CLIENT_SUPPORT_BOOTSTRAP)
	default "coaps://192.0.2.2:5784" if (LWM2M_DTLS_SUPPORT && LWM2M_RD_CLIENT_SUPPORT_BOOTSTRAP)
	help
	  LwM2M server address. Write as a full URI including optional port number.
	  Only accepted protocols are "coap://" and "coaps://"
	  When DNS resolver is enabled, DNS domain names could be used as well.
	  When port number is missing, CONFIG_LWM2M_PEER_PORT is used instead.
	  IPv6 addresses must be enclosed in square brackets, for example "coap://[fd00::1]".

config NET_SAMPLE_LWM2M_WAIT_DNS
	bool "Wait DNS server addition before considering connection to be up"
	depends on MODEM_HL7800 && !DNS_SERVER_IP_ADDRESSES
	help
	  Make sure we get DNS server addresses from the network
	  before considering the connection to be up.

source "Kconfig.zephyr"
```

## samples/net/lwm2m_client/boards/nrf9160dk_nrf52840.conf
```kconfig
CONFIG_UART_ASYNC_API=y
CONFIG_UART_1_ASYNC=y
CONFIG_UART_1_INTERRUPT_DRIVEN=n

# Align with the Serial LTE Modem (SLM) application.
CONFIG_MODEM_CELLULAR_UART_BUFFER_SIZES=6000

# Networking
CONFIG_NETWORKING=y
CONFIG_NET_NATIVE=y
CONFIG_NET_L2_PPP=y
CONFIG_NET_IPV4=y
CONFIG_NET_UDP=y
CONFIG_NET_SOCKETS=y
CONFIG_NET_CONTEXT_RCVTIMEO=y

# DNS
CONFIG_DNS_RESOLVER=y
CONFIG_NET_L2_PPP_OPTION_DNS_USE=y
CONFIG_DNS_SERVER_IP_ADDRESSES=y
CONFIG_DNS_SERVER1="8.8.8.8"
CONFIG_LWM2M_DNS_SUPPORT=y

# Network management
CONFIG_NET_MGMT=y
CONFIG_NET_MGMT_EVENT=y
CONFIG_NET_CONNECTION_MANAGER=y

# Modem driver
CONFIG_MODEM=y
CONFIG_MODEM_CELLULAR=y

# LwM2M client does not use power management
CONFIG_PM_DEVICE=n
```

## samples/net/lwm2m_client/boards/qemu_cortex_m3.conf
```kconfig
CONFIG_NET_L2_ETHERNET=y
CONFIG_ETH_DRIVER=y
CONFIG_ETH_STELLARIS=y
CONFIG_NET_QEMU_ETHERNET=y
```

## samples/net/lwm2m_client/sample.yaml
```yaml
sample:
  description: TBD
  name: TBD
tests:
  sample.net.lwm2m_client:
    harness: net
    depends_on: netif
    platform_allow:
      - qemu_x86
      - frdm_k64f
      - pinnacle_100_dvk
      - mg100
      - native_sim
    integration_platforms:
      - qemu_x86
    tags:
      - net
      - lwm2m
  sample.net.lwm2m_client.all_objects:
    harness: net
    depends_on: netif
    platform_allow:
      - qemu_x86
      - native_sim
    integration_platforms:
      - qemu_x86
    tags:
      - net
      - lwm2m
    extra_configs:
      - CONFIG_LWM2M_CONN_MON_OBJ_SUPPORT=y
      - CONFIG_LWM2M_LOCATION_OBJ_SUPPORT=y
      - CONFIG_LWM2M_IPSO_ACCELEROMETER=y
      - CONFIG_LWM2M_IPSO_BUZZER=y
      - CONFIG_LWM2M_IPSO_ONOFF_SWITCH=y
      - CONFIG_LWM2M_IPSO_PUSH_BUTTON=y
      - CONFIG_LWM2M_IPSO_GENERIC_SENSOR=y
      - CONFIG_LWM2M_IPSO_HUMIDITY_SENSOR=y
      - CONFIG_LWM2M_IPSO_PRESSURE_SENSOR=y
  sample.net.lwm2m_client.dtls:
    harness: net
    depends_on: netif
    extra_args: EXTRA_CONF_FILE=overlay-dtls.conf
    platform_allow:
      - qemu_x86
      - frdm_k64f
      - pinnacle_100_dvk
      - mg100
      - native_sim
    integration_platforms:
      - qemu_x86
    tags:
      - net
      - lwm2m
  sample.net.lwm2m_client.queue_mode:
    harness: net
    depends_on: netif
    extra_args: EXTRA_CONF_FILE=overlay-queue.conf
    platform_allow:
      - qemu_x86
      - native_sim
    integration_platforms:
      - qemu_x86
    tags:
      - net
      - lwm2m
  sample.net.lwm2m_client.wnc_m14a2a:
    harness: net
    extra_args: SHIELD=wnc_m14a2a
    platform_allow:
      - frdm_k64f
      - nrf52840dk/nrf52840
    integration_platforms:
      - frdm_k64f
    tags:
      - net
      - lwm2m
```

## samples/net/mbedtls_dtlsclient/sample.yaml
```yaml
sample:
  name: mBED DTLS Client
tests:
  test:
    harness: net
    depends_on: netif
    tags: net
```

## samples/net/mbedtls_dtlsserver/sample.yaml
```yaml
sample:
  name: DTLS Server
tests:
  test:
    harness: net
    depends_on: netif
    tags: net
```

## samples/net/mbedtls_sslclient/sample.yaml
```yaml
sample:
  name: mbedTLS client
tests:
  test:
    harness: net
    tags: net crypto mbedtls
    depends_on: netif
```

## samples/net/mdns_responder/Kconfig
```kconfig
# Private config options for mDNS responder sample app

# Copyright (c) 2023 NordicNordic Semiconductor ASA
# SPDX-License-Identifier: Apache-2.0

mainmenu "Networking mDNS responder sample application"

source "samples/net/common/Kconfig"
source "Kconfig.zephyr"
```
