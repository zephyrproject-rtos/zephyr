## CMakeLists.txt
```
# SPDX-License-Identifier: Apache-2.0

cmake_minimum_required(VERSION 3.28.0)

find_package(Zephyr REQUIRED HINTS $ENV{ZEPHYR_BASE})
project(mqtt_sn_publisher)

target_sources(app PRIVATE
  src/main.c
  src/udp.c
)

include(${ZEPHYR_BASE}/samples/net/common/common.cmake)
```

## Kconfig
```
# Configuration options for MQTT-SN sample

# Copyright (c) 2022 René Beckmann
# SPDX-License-Identifier: Apache-2.0

mainmenu "MQTT-SN sample application"

config NET_SAMPLE_MQTT_SN_STATIC_GATEWAY
	bool "Whether to statically define the Gateway. Will use Search procedure if False."

config NET_SAMPLE_MQTT_SN_GATEWAY_ADDRESS
	string "IP and port of the MQTT-SN gateway"
	depends on NET_SAMPLE_MQTT_SN_STATIC_GATEWAY

config NET_SAMPLE_MQTT_SN_BROADCAST_ADDRESS
	string "IP and port of the Broadcast address"

config NET_SAMPLE_MQTT_SN_BUFFER_SIZE
	int "Size of the TX and RX buffers"
	default 255

config NET_SAMPLE_MQTT_SN_RECONNECT_INITIAL_BACKOFF_MSEC
	int "Delay before the first reconnect attempt, in milliseconds"
	default 1000

config NET_SAMPLE_MQTT_SN_RECONNECT_MAX_BACKOFF_MSEC
	int "Cap on the delay between reconnect attempts, in milliseconds"
	default 60000

config NET_SAMPLE_MQTT_SN_RECONNECT_MAX_ATTEMPTS
	int "Number of reconnect attempts before giving up"
	range 1 4294967295
	default 10

source "Kconfig.zephyr"
```

## sample.yaml
```
sample:
  description: MQTT-SN publisher sample application
  name: MQTT-SN publisher
common:
  harness: net
  tags:
    - net
    - mqtt
tests:
  sample.net.mqtt_publisher.sn:
    platform_allow:
      - frdm_k64f/mk64f12
      - qemu_x86/atom
      - pinnacle_100_dvk/nrf52840
      - mg100/nrf52840
      - native_sim/native/64
    integration_platforms:
      - qemu_x86/atom
```

## prj.conf
```kconfig
# Generic networking options
CONFIG_NETWORKING=y
CONFIG_NET_UDP=y
CONFIG_NET_IPV4=y
CONFIG_NET_IPV6=y
CONFIG_NET_SOCKETS=y
CONFIG_NET_CONNECTION_MANAGER=y

# Kernel options
CONFIG_MAIN_STACK_SIZE=2048
CONFIG_ENTROPY_GENERATOR=y
CONFIG_TEST_RANDOM_GENERATOR=y
CONFIG_INIT_STACKS=y

# Logging
CONFIG_NET_LOG=y
CONFIG_LOG=y
CONFIG_PRINTK=y

# Network buffers
CONFIG_NET_PKT_RX_COUNT=16
CONFIG_NET_PKT_TX_COUNT=16
CONFIG_NET_BUF_RX_COUNT=64
CONFIG_NET_BUF_TX_COUNT=64
CONFIG_NET_CONTEXT_NET_PKT_POOL=y

# IP address options
CONFIG_NET_MAX_CONTEXTS=10

# Network application options and configuration
CONFIG_NET_CONFIG_SETTINGS=y
CONFIG_NET_CONFIG_NEED_IPV4=y
CONFIG_NET_IPV4_IGMP=y
CONFIG_NET_CONFIG_MY_IPV4_ADDR="192.0.2.1"

# MQTT-SN
CONFIG_MQTT_SN_LIB=y
CONFIG_MQTT_SN_TRANSPORT_UDP=y
CONFIG_MQTT_SN_LIB_BROADCAST_RADIUS=1
CONFIG_NET_SAMPLE_MQTT_SN_STATIC_GATEWAY=y
CONFIG_NET_SAMPLE_MQTT_SN_GATEWAY_ADDRESS="192.0.2.2:10000"
CONFIG_NET_SAMPLE_MQTT_SN_BROADCAST_ADDRESS="225.1.1.1:1883"
```

## boards/native_posix_native.conf
```kconfig
# Configuration options for MQTT-SN sample

# Copyright (c) 2022 René Beckmann
# SPDX-License-Identifier: Apache-2.0

CONFIG_NATIVE_POSIX_SLOWDOWN_TO_REAL_TIME=y
```

## src/main.c
```c
/*
 * Copyright (c) 2022 grandcentrix GmbH
 *
 * SPDX-License-Identifier: Apache-2.0
 */

#include "common.h"

#include <errno.h>
#include <stdio.h>

#include <zephyr/kernel.h>
#include <zephyr/mqtt_sn.h>
#include <zephyr/net/conn_mgr_monitor.h>
#include <zephyr/net/net_mgmt.h>
#include <zephyr/net/socket.h>

#include <zephyr/logging/log.h>
LOG_MODULE_REGISTER(mqtt_sn_publisher_sample, LOG_LEVEL_INF);

#if defined(CONFIG_USERSPACE)
#include <zephyr/app_memory/app_memdomain.h>
K_APPMEM_PARTITION_DEFINE(app_partition);
struct k_mem_domain app_domain;
#endif

#define APP_BANNER "MQTT-SN sample"

K_SEM_DEFINE(run_app, 0, 1);

#define EVENT_MASK (NET_EVENT_L4_CONNECTED | NET_EVENT_L4_DISCONNECTED)

static void net_event_handler(struct net_mgmt_event_callback *cb, uint64_t mgmt_event,
			      struct net_if *iface)
{
	if ((mgmt_event & EVENT_MASK) != mgmt_event) {
		return;
	}

	if (mgmt_event == NET_EVENT_L4_CONNECTED) {
		LOG_INF("Network connected");

		k_sem_give(&run_app);

		return;
	}

	if (mgmt_event == NET_EVENT_L4_DISCONNECTED) {
		LOG_INF("Network disconnected");

		k_sem_reset(&run_app);

		return;
	}
}

static void init_app(void)
{
	static struct net_mgmt_event_callback mgmt_cb;

	LOG_INF(APP_BANNER);

#if defined(CONFIG_USERSPACE)
	int err;
	struct k_mem_partition *parts[] = {
#if Z_LIBC_PARTITION_EXISTS
		&z_libc_partition,
#endif
		&app_partition
	};

	err = k_mem_domain_init(&app_domain, ARRAY_SIZE(parts), parts);
	__ASSERT(err == 0, "k_mem_domain_init() failed %d", err);
	ARG_UNUSED(err);

#endif

	if (IS_ENABLED(CONFIG_NET_CONNECTION_MANAGER)) {
		net_mgmt_init_event_callback(&mgmt_cb, net_event_handler, EVENT_MASK);
		net_mgmt_add_event_callback(&mgmt_cb);

		conn_mgr_mon_resend_status();
	}
}

static void start_client(void *p1, void *p2, void *p3)
{
	ARG_UNUSED(p1);
	ARG_UNUSED(p2);
	ARG_UNUSED(p3);

	/* Wait for connection */
	k_sem_take(&run_app, K_FOREVER);

	start_thread();
}

int main(void)
{
	init_app();

	if (!IS_ENABLED(CONFIG_NET_CONNECTION_MANAGER)) {
		/* If the config library has not been configured to start the
		 * app only after we have a connection, then we can start
		 * it right away.
		 */
		k_sem_give(&run_app);
	}

#if defined(CONFIG_USERSPACE)
	k_thread_access_grant(k_current_get(), &run_app);
	k_mem_domain_add_thread(&app_domain, k_current_get());

	k_thread_user_mode_enter(start_client, NULL, NULL, NULL);
#else
	start_client(NULL, NULL, NULL);
#endif
	return 0;
}
```

## src/common.h
```c
/*
 * Copyright (c) 2022 grandcentrix GmbH
 *
 * SPDX-License-Identifier: Apache-2.0
 */

#define STACK_SIZE 2048

#if defined(CONFIG_USERSPACE)
#include <zephyr/app_memory/app_memdomain.h>
extern struct k_mem_partition app_partition;
extern struct k_mem_domain app_domain;
#define APP_BMEM K_APP_BMEM(app_partition)
#define APP_DMEM K_APP_DMEM(app_partition)
#else
#define APP_BMEM
#define APP_DMEM
#endif

#if defined(CONFIG_NET_TC_THREAD_COOPERATIVE)
#define THREAD_PRIORITY K_PRIO_COOP(CONFIG_NUM_COOP_PRIORITIES - 1)
#else
#define THREAD_PRIORITY K_PRIO_PREEMPT(8)
#endif

void start_thread(void);
```

## src/udp.c
```c
/*
 * Copyright (c) 2022 grandcentrix GmbH
 *
 * SPDX-License-Identifier: Apache-2.0
 */

#include "common.h"

#include <errno.h>
#include <stdio.h>
#include <zephyr/kernel.h>
#include <zephyr/net/mqtt_sn.h>
#include <zephyr/net/conn_mgr_monitor.h>
#include <zephyr/net/net_mgmt.h>
#include <zephyr/net/socket.h>

#include <zephyr/logging/log.h>
LOG_MODULE_DECLARE(mqtt_sn_publisher_sample);

#ifdef CONFIG_NET_SAMPLE_MQTT_SN_STATIC_GATEWAY
#define SAMPLE_GW_ADDRESS CONFIG_NET_SAMPLE_MQTT_SN_GATEWAY_ADDRESS
#else
#define SAMPLE_GW_ADDRESS ""
#endif

static void process_thread(void);

K_THREAD_DEFINE(udp_thread_id, STACK_SIZE, process_thread, NULL, NULL, NULL, THREAD_PRIORITY,
		IS_ENABLED(CONFIG_USERSPACE) ? K_USER : 0, -1);

static APP_BMEM struct mqtt_sn_client mqtt_client;
static APP_BMEM struct mqtt_sn_transport_udp tp;
static APP_DMEM struct mqtt_sn_data client_id = MQTT_SN_DATA_STRING_LITERAL("ZEPHYR");

static APP_BMEM uint8_t tx_buf[CONFIG_NET_SAMPLE_MQTT_SN_BUFFER_SIZE];
static APP_BMEM uint8_t rx_buf[CONFIG_NET_SAMPLE_MQTT_SN_BUFFER_SIZE];

static APP_BMEM bool mqtt_sn_connected;
static APP_BMEM bool subscribed;

static APP_BMEM uint32_t reconnect_attempts;
static APP_BMEM int64_t reconnect_at;

/* Keeps a down gateway from getting hammered with reconnect attempts. */
static void schedule_reconnect(void)
{
	uint32_t delay_ms;

	if (reconnect_attempts >= CONFIG_NET_SAMPLE_MQTT_SN_RECONNECT_MAX_ATTEMPTS) {
		LOG_ERR("Giving up reconnecting after %u attempts", reconnect_attempts);
		reconnect_at = 0;
		return;
	}

	/* Clamp the shift too: reconnect_attempts has no cap, and shifting by 32+ is UB. */
	delay_ms = MIN((uint32_t)CONFIG_NET_SAMPLE_MQTT_SN_RECONNECT_INITIAL_BACKOFF_MSEC
			       << MIN(reconnect_attempts, 31),
		       CONFIG_NET_SAMPLE_MQTT_SN_RECONNECT_MAX_BACKOFF_MSEC);
	reconnect_attempts++;

	LOG_INF("Reconnecting in %u ms (attempt %u/%u)", delay_ms, reconnect_attempts,
		CONFIG_NET_SAMPLE_MQTT_SN_RECONNECT_MAX_ATTEMPTS);
	reconnect_at = k_uptime_get() + delay_ms;
}

static void evt_cb(struct mqtt_sn_client *client, const struct mqtt_sn_evt *evt)
{
	switch (evt->type) {
	case MQTT_SN_EVT_CONNECTED: /* Connected to a gateway */
		LOG_INF("MQTT-SN event EVT_CONNECTED");
		mqtt_sn_connected = true;
		reconnect_attempts = 0;
		break;
	case MQTT_SN_EVT_DISCONNECTED: /* Disconnected */
		LOG_INF("MQTT-SN event EVT_DISCONNECTED");
		mqtt_sn_connected = false;
		subscribed = false;
		schedule_reconnect();
		break;
	case MQTT_SN_EVT_ASLEEP: /* Entered ASLEEP state */
		LOG_INF("MQTT-SN event EVT_ASLEEP");
		break;
	case MQTT_SN_EVT_AWAKE: /* Entered AWAKE state */
		LOG_INF("MQTT-SN event EVT_AWAKE");
		break;
	case MQTT_SN_EVT_PUBLISH: /* Received a PUBLISH message */
		LOG_INF("MQTT-SN event EVT_PUBLISH");
		LOG_HEXDUMP_INF(evt->param.publish.data.data, evt->param.publish.data.size,
				"Published data");
		break;
	case MQTT_SN_EVT_PINGRESP: /* Received a PINGRESP */
		LOG_INF("MQTT-SN event EVT_PINGRESP");
		break;
	case MQTT_SN_EVT_ADVERTISE: /* Received a ADVERTISE */
		LOG_INF("MQTT-SN event EVT_ADVERTISE");
		break;
	case MQTT_SN_EVT_GWINFO: /* Received a GWINFO */
		LOG_INF("MQTT-SN event EVT_GWINFO");
		break;
	case MQTT_SN_EVT_SEARCHGW: /* Received a SEARCHGW */
		LOG_INF("MQTT-SN event EVT_SEARCHGW");
		break;
	default:
		break;
	}
}

static int do_work(void)
{
	static APP_BMEM int64_t ts;
	static APP_DMEM struct mqtt_sn_data topic_p = MQTT_SN_DATA_STRING_LITERAL("/uptime");
	static APP_DMEM struct mqtt_sn_data topic_s = MQTT_SN_DATA_STRING_LITERAL("/number");
	char out[20];
	struct mqtt_sn_data pubdata = {.data = out};
	const int64_t now = k_uptime_get();
	int err;

	err = mqtt_sn_input(&mqtt_client);
	if (err < 0) {
		LOG_ERR("failed: input: %d", err);
		return err;
	}

	/* Runs after mqtt_sn_input() is done, never from evt_cb() itself. */
	if (reconnect_at != 0 && now >= reconnect_at) {
		reconnect_at = 0;
		LOG_INF("Reconnecting to gateway");
		err = mqtt_sn_connect(&mqtt_client, false, true);
		if (err) {
			LOG_ERR("Reconnect failed: %d", err);
		}
	}

	if (mqtt_sn_connected && !subscribed) {
		err = mqtt_sn_subscribe(&mqtt_client, MQTT_SN_QOS_0, &topic_s);
		if (err < 0) {
			return err;
		}
		subscribed = true;
	}

	if (now - ts > 10000 && mqtt_sn_connected) {
		LOG_INF("Publishing timestamp");

		ts = now;

		err = snprintk(out, sizeof(out), "%" PRIi64, ts);
		if (err < 0) {
			LOG_ERR("failed: snprintf");
			return err;
		}

		pubdata.size = MIN(sizeof(out), err);

		err = mqtt_sn_publish(&mqtt_client, MQTT_SN_QOS_0, &topic_p, false, &pubdata);
		if (err < 0) {
			LOG_ERR("failed: publish: %d", err);
			return err;
		}
	}

	return 0;
}

static void process_thread(void)
{
	struct sockaddr bcaddr = {0};
	int err;
	bool success;

	LOG_DBG("Parsing Broadcast Address " CONFIG_NET_SAMPLE_MQTT_SN_BROADCAST_ADDRESS);
	success = net_ipaddr_parse(CONFIG_NET_SAMPLE_MQTT_SN_BROADCAST_ADDRESS,
				   strlen(CONFIG_NET_SAMPLE_MQTT_SN_BROADCAST_ADDRESS), &bcaddr);
	__ASSERT(success, "net_ipaddr_parse() failed");

	LOG_INF("Waiting for connection...");
	LOG_HEXDUMP_DBG(&bcaddr, sizeof(bcaddr), " broadcast address");

	err = mqtt_sn_transport_udp_init(&tp, &bcaddr, sizeof((bcaddr)));
	__ASSERT(err == 0, "mqtt_sn_transport_udp_init() failed %d", err);

	err = mqtt_sn_client_init(&mqtt_client, &client_id, &tp.tp, evt_cb, tx_buf, sizeof(tx_buf),
				  rx_buf, sizeof(rx_buf));
	__ASSERT(err == 0, "mqtt_sn_client_init() failed %d", err);

	if (IS_ENABLED(CONFIG_NET_SAMPLE_MQTT_SN_STATIC_GATEWAY)) {
		LOG_INF("Adding predefined Gateway");
		struct sockaddr gwaddr = {0};

		LOG_DBG("Parsing Gateway address %s", SAMPLE_GW_ADDRESS);
		success = net_ipaddr_parse(SAMPLE_GW_ADDRESS, strlen(SAMPLE_GW_ADDRESS), &gwaddr);
		__ASSERT(success, "net_ipaddr_parse() failed");
		struct mqtt_sn_data gwaddr_data = {.data = (uint8_t *)&gwaddr,
						   .size = sizeof(gwaddr)};
		/* Reduce size to allow this to work with smaller values for
		 * CONFIG_MQTT_SN_LIB_MAX_ADDR_SIZE.
		 */
		switch (gwaddr.sa_family) {
		case AF_INET:
			gwaddr_data.size = sizeof(struct sockaddr_in);
			break;
		case AF_INET6:
			gwaddr_data.size = sizeof(struct sockaddr_in6);
			break;
		}

		err = mqtt_sn_add_gw(&mqtt_client, 0x1f, gwaddr_data);
		__ASSERT(err == 0, "mqtt_sn_add_gw() failed %d", err);
	} else {
		LOG_INF("Searching for Gateway");
		err = mqtt_sn_search(&mqtt_client, 1);
		k_sleep(K_SECONDS(10));
		err = mqtt_sn_input(&mqtt_client);
		__ASSERT(err == 0, "mqtt_sn_search() failed %d", err);
	}

	LOG_INF("Connecting client");
	err = mqtt_sn_connect(&mqtt_client, false, true);
	__ASSERT(err == 0, "mqtt_sn_connect() failed %d", err);

	while (err == 0) {
		k_sleep(K_MSEC(500));
		err = do_work();
	}

	LOG_ERR("Exiting thread: %d", err);
}

void start_thread(void)
{
	int rc;
#if defined(CONFIG_USERSPACE)
	rc = k_mem_domain_add_thread(&app_domain, udp_thread_id);
	if (rc < 0) {
		LOG_ERR("Failed: k_mem_domain_add_thread() %d", rc);
		return;
	}
#endif

	rc = k_thread_name_set(udp_thread_id, "udp");
	if (rc < 0 && rc != -ENOSYS) {
		LOG_ERR("Failed: k_thread_name_set() %d", rc);
		return;
	}

	k_thread_start(udp_thread_id);

	rc = k_thread_join(udp_thread_id, K_FOREVER);

	if (rc != 0) {
		LOG_ERR("Failed: k_thread_join() %d", rc);
	}
}
```
