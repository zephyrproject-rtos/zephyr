## CMakeLists.txt
```
# SPDX-License-Identifier: Apache-2.0

cmake_minimum_required(VERSION 3.20.0)

find_package(Zephyr REQUIRED HINTS $ENV{ZEPHYR_BASE})
project(mqtt_offload_client)
if(USE_DUMMY_CREDS)
  set(creds "src/creds/dummy.c")
else()
  if(NOT EXISTS ${APPLICATION_SOURCE_DIR}/src/creds/key.c OR
     NOT EXISTS ${APPLICATION_SOURCE_DIR}/src/creds/cert.c OR
     NOT EXISTS ${APPLICATION_SOURCE_DIR}/src/creds/ca.c)
    message(FATAL_ERROR
        "Credentials not found. Please run "
        "'python3 src/creds/convert_keys.py' before building"
    )
  endif()

  set(creds "src/creds/ca.c" "src/creds/key.c" "src/creds/cert.c")
endif()

target_sources(app PRIVATE
	src/main.c
	src/mqtt_client.c
	${creds}
)

include(${ZEPHYR_BASE}/samples/net/common/common.cmake)
target_include_directories(app PRIVATE ${ZEPHYR_BASE}/subsys/net/lib/tls_credentials)
```

## Kconfig
```
# Configuration options for MQTT-OFFLOAD sample

# Copyright (c) 2022 René Beckmann
# SPDX-License-Identifier: Apache-2.0
menu "Mqtt Offload"
mainmenu "MQTT-OFFLOAD sample application"

config NET_SAMPLE_MQTT_OFFLOAD_BUFFER_SIZE
	int "Size of the TX and RX buffers"
	default 255
config MQTT_ENDPOINT
	string "MQTT endpoint"
	default ""
	help
	  Endpoint (hostname) of the MQTT broker.
	  Note that the endpoint is different when using AWS Device Advisor.

config MQTT_PORT
	int "MQTT Port"
	default 8883
	help
	  Set port of MQTT broker.

config MQTT_THING_NAME
	string "MQTT Thing name"
	default "myThingName"
	help
	  Set the MQTT Thing name created on IoT Console

config MQTT_SUBSCRIBE_TOPIC
	string "MQTT subscribe topic"
	default "myThingName/downlink"
	help
	  MQTT topic the client should subscribe to.

config MQTT_PUBLISH_TOPIC
	string "MQTT publish topic"
	default "myThingName/data"
	help
	  MQTT topic the client should publish to.

choice MQTT_TEST_SUITE
	prompt "Device Advisor test suite"
	default MQTT_TEST_SUITE_NONE
	help
	  Select the AWS Device Advisor test suite to run.

config MQTT_TEST_SUITE_NONE
	bool "No test suite running"

config MQTT_TEST_SUITE_DQP
	bool "Device Qualification Program (DQP)"
	help
	  Make sure your region supports AWS Device Advisor for DQP

config MQTT_TEST_SUITE_RECV_QOS1
	bool "Test suite for receiving QoS 1 messages"
	help
	  For single test case "MQTT Client Puack QoS1"

endchoice

config MQTT_LIB_CUSTOM_TRANSPORT
	bool "Custom transport support for socket MQTT Library"
	help
	  Enable custom transport support for socket MQTT Library.
	  User must provide implementation for transport procedure.

config MQTT_OFFLOAD_LIB_TLS
	bool "TLS support for socket MQTT Library"
	help
	  Enable TLS support for socket MQTT Library

config MQTT_QOS
	int "MQTT QoS"
	default 0 if MQTT_TEST_SUITE_DQP
	default 1 if MQTT_TEST_SUITE_RECV_QOS1
	default 0
	range 0 1
	help
	  Quality of Service to use for publishing and subscribing to topics.
	  Notes:
	  - Use QoS 0 when passing DQP test suite
	  - QoS 2 is not supported by AWS MQTT broker


config MQTT_EXPONENTIAL_BACKOFF
	bool "enable exponential backoff"
	default n if MQTT_TEST_SUITE_DQP || MQTT_TEST_SUITE_RECV_QOS1
	default y
	help
	  Enable AWS exponential backoff for reconnecting to AWS MQTT broker.

endmenu

source "samples/net/common/Kconfig"
source "Kconfig.zephyr"
```

## sample.yaml
```
sample:
  description: mqtt-offload-client sample application
  name: mqtt-offload-client

common:
  harness: net
  tags:
    - net
    - mqtt
    - modem
    - hl78xx
  filter: dt_alias_exists("modem")
  extra_conf_files:
    - prj.conf
    - overlay-extra.conf
    - overlay-swir_hl78xx-verbose-logging.conf
    - overlay-swir_hl78xx_ev_kit.conf
    - overlay-swir_hl78xx-tls.conf
  extra_args:
    - SHIELD=swir_hl78xx_ev_kit
    - USE_DUMMY_CREDS=1

tests:
  sample.net.mqtt_offload:
    platform_allow:
      - nucleo_u575zi_q
    integration_platforms:
      - nucleo_u575zi_q
    build_only: true
```

## prj.conf
```kconfig
# POSIX API
CONFIG_POSIX_API=y

# Generic networking options
CONFIG_NETWORKING=y
CONFIG_NET_UDP=y
CONFIG_NET_IPV4=y
CONFIG_NET_IPV6=n
CONFIG_NET_SOCKETS=y
CONFIG_ZVFS_OPEN_MAX=6
CONFIG_NET_CONNECTION_MANAGER=y

# Kernel options
CONFIG_MAIN_STACK_SIZE=4096
CONFIG_ENTROPY_GENERATOR=y
CONFIG_TEST_RANDOM_GENERATOR=y
CONFIG_INIT_STACKS=y

# Logging
CONFIG_NET_LOG=y
CONFIG_LOG=y
CONFIG_PRINTK=y

# Network buffers
CONFIG_NET_PKT_RX_COUNT=16
CONFIG_NET_PKT_TX_COUNT=16
CONFIG_NET_BUF_RX_COUNT=64
CONFIG_NET_BUF_TX_COUNT=64
CONFIG_NET_CONTEXT_NET_PKT_POOL=y

# IP address options
CONFIG_NET_MAX_CONTEXTS=10

# DNS Resolver
CONFIG_DNS_RESOLVER=y
CONFIG_DNS_SERVER_IP_ADDRESSES=n


# MQTT-Offloading
CONFIG_MQTT_OFFLOAD_LIB=y
```

## overlay-extra.conf
```kconfig
# AWS/Secure MQTT offload client configuration
CONFIG_MQTT_ENDPOINT="xxxxxxxxxxxxx.iot.eu-west-1.amazonaws.com"
CONFIG_MQTT_PORT=8883

# Unsecure MQTT offload client configuration
# CONFIG_MQTT_ENDPOINT="broker.hivemq.com"
# CONFIG_MQTT_PORT=1883

#Common MQTT offload client configuration
CONFIG_MQTT_THING_NAME="ZEPHYR"
CONFIG_MQTT_PUBLISH_TOPIC="zephyr_sample/data"
CONFIG_MQTT_SUBSCRIBE_TOPIC="zephyr_sample/downlink"
```

## overlay-swir_hl78xx-low-power.conf
```kconfig
# Sierra Wireless HL78XX driver driver options

# Copyright (c) 2025 Netfeasa Ltd.
# SPDX-License-Identifier: Apache-2.0

# The HL78xx driver gets its IP settings from the cell network

#PM
CONFIG_PM_DEVICE=y

#Modem low power configuration
CONFIG_MODEM_HL78XX_LOW_POWER_MODE=y
```

## overlay-swir_hl78xx-tls.conf
```kconfig
# socket tls
CONFIG_NET_SOCKETS_SOCKOPT_TLS=y
CONFIG_MODEM_HL78XX_SOCKETS_SOCKOPT_TLS=y
CONFIG_MQTT_OFFLOAD_LIB_TLS=y

# client certificate
CONFIG_TLS_CREDENTIALS=y
CONFIG_TLS_MAX_CREDENTIALS_NUMBER=4
```

## overlay-swir_hl78xx-verbose-logging.conf
```kconfig
# Logging
CONFIG_LOG_MODE_DEFERRED=y
CONFIG_LOG_BUFFER_SIZE=205536
CONFIG_LOG_PROCESS_THREAD_STACK_SIZE=18192

# For extra verbosity
CONFIG_MODEM_MODULES_LOG_LEVEL_DBG=y
CONFIG_MODEM_LOG_LEVEL_DBG=y
CONFIG_MODEM_CHAT_LOG_BUFFER_SIZE=1024
CONFIG_MODEM_HL78XX_LOG_CONTEXT_VERBOSE_DEBUG=y
CONFIG_MQTT_OFFLOAD_LOG_LEVEL_DBG=y
CONFIG_LOG_BACKEND_NET=y
CONFIG_NET_BUF_LOG=y
CONFIG_NET_LOG=y
```

## overlay-swir_hl78xx_ev_kit.conf
```kconfig
# Sierra Wireless HL78XX driver options

# Copyright (c) 2025 Netfeasa Ltd.
# SPDX-License-Identifier: Apache-2.0

# The HL78xx driver gets its IP settings from the cell network
CONFIG_NET_CONFIG_SETTINGS=n
CONFIG_NET_DHCPV4=n
CONFIG_DNS_SERVER_IP_ADDRESSES=n

#uart
CONFIG_UART_ASYNC_API=y

# Generic networking options
CONFIG_NET_IPV6=n

# SNTP
# CONFIG_NET_CONFIG_SNTP_INIT_SERVER="time.google.com"

# DNS
CONFIG_NET_SOCKETS_DNS_TIMEOUT=15000

# Wait for the network to be ready
CONFIG_NET_SAMPLE_COMMON_WAIT_DNS_SERVER_ADDITION=y

# Network management
CONFIG_NET_MGMT=y
CONFIG_NET_MGMT_EVENT=y
CONFIG_NET_CONNECTION_MANAGER=y

# NB-IoT has large latency, so increase timeouts. It is ok to use this for Cat-M1 as well.
CONFIG_NET_SOCKETS_CONNECT_TIMEOUT=15000

# Network buffers
CONFIG_NET_PKT_RX_COUNT=32
CONFIG_NET_PKT_TX_COUNT=16
CONFIG_NET_BUF_RX_COUNT=64
CONFIG_NET_BUF_TX_COUNT=32

# Modem driver
CONFIG_MODEM=y

#hl78xx modem
CONFIG_MODEM_HL78XX=y

# CONFIG_MODEM_HL78XX_RX_WORKQ_STACK_SIZE=4096

# Statistics
CONFIG_MODEM_STATS=y
CONFIG_SHELL=y
# Don't require device to have time/date
CONFIG_MBEDTLS_HAVE_TIME_DATE=n

#apn source
# CONFIG_MODEM_HL78XX_APN_SOURCE_KCONFIG=y
# CONFIG_MODEM_HL78XX_APN="internet"

CONFIG_MODEM_HL78XX_BOOT_IN_FULLY_FUNCTIONAL_MODE=y

# RAT selection
CONFIG_MODEM_HL78XX_AUTORAT=n
CONFIG_MODEM_HL78XX_RAT_NB1=y

# MQTT Offloading
CONFIG_MODEM_HL78XX_MQTT_OFFLOADING=y
```

## src/main.c
```c
/*
 * Copyright (c) 2025 Netfeasa Ltd.
 *
 * SPDX-License-Identifier: Apache-2.0
 */

#include "common.h"
#include "creds/creds.h"
#include "net_sample_common.h"
#include <errno.h>
#include <stdio.h>

#include <zephyr/kernel.h>
#include <zephyr/net/mqtt_offload.h>
#include <zephyr/net/conn_mgr_monitor.h>
#include <zephyr/net/net_mgmt.h>
#include <zephyr/net/socket.h>
#if defined(CONFIG_PM_DEVICE)
#include <zephyr/pm/device.h>
#include <zephyr/pm/device_runtime.h>
#endif
#include <zephyr/logging/log.h>
LOG_MODULE_REGISTER(mqtt_offload_sample, LOG_LEVEL_DBG);

#if defined(CONFIG_MODEM)
const struct device *modem = DEVICE_DT_GET(DT_ALIAS(modem));
#endif

#define APP_BANNER "MQTT Offload sample"

static void start_client(void *p1, void *p2, void *p3)
{
	ARG_UNUSED(p1);
	ARG_UNUSED(p2);
	ARG_UNUSED(p3);

	start_thread();
}

#if defined(CONFIG_MODEM)
static int modem_init(void)
{
	if (!device_is_ready(modem)) {
		LOG_ERR("Modem device %s is not ready", modem->name);
		return -ENODEV;
	}

	LOG_INF("Modem device %s is ready", modem->name);
	return 0;
}
#endif
#ifdef CONFIG_PM_DEVICE
static int modem_power_on(void)
{
	LOG_INF("Powering on modem\n");
	return pm_device_action_run(modem, PM_DEVICE_ACTION_RESUME);
}
#endif

int main(void)
{
#ifdef CONFIG_MODEM
	modem_init();
#endif
#ifdef CONFIG_PM_DEVICE
	modem_power_on();
#endif
	wait_for_network();
	start_client(NULL, NULL, NULL);
	return 0;
}
```

## src/common.h
```c
/*
 * Copyright (c) 2025 Netfeasa Ltd.
 *
 * SPDX-License-Identifier: Apache-2.0
 */

#define STACK_SIZE 2048

#if defined(CONFIG_NET_TC_THREAD_COOPERATIVE)
#define THREAD_PRIORITY K_PRIO_COOP(CONFIG_NUM_COOP_PRIORITIES - 1)
#else
#define THREAD_PRIORITY K_PRIO_PREEMPT(8)
#endif

void start_thread(void);
```

## src/mqtt_client.c
```c
/*
 * Copyright (c) 2025 Netfeasa Ltd.
 *
 * SPDX-License-Identifier: Apache-2.0
 */

/** @file mqtt_client.c */

#include "common.h"
#include "creds/creds.h"

#include <errno.h>
#include <stdio.h>
#include <zephyr/kernel.h>
#include <zephyr/net/mqtt_offload.h>
#include <zephyr/net/conn_mgr_monitor.h>
#include <zephyr/net/net_mgmt.h>
#include <zephyr/net/socket.h>
#include <zephyr/random/random.h>

#include <zephyr/logging/log.h>
LOG_MODULE_REGISTER(mqtt_client, LOG_LEVEL_DBG);

#define MAX_RETRIES         10u
#define BACKOFF_EXP_BASE_MS 1000u
#define BACKOFF_EXP_MAX_MS  60000u
#define BACKOFF_CONST_MS    5000u

#define MQTT_BROKER_PORT CONFIG_MQTT_PORT
#if defined(CONFIG_MQTT_OFFLOAD_LIB_TLS)

#define TLS_TAG_DEVICE_CERTIFICATE  1
#define TLS_TAG_DEVICE_PRIVATE_KEY  1
#define TLS_TAG_MQTT_CA_CERTIFICATE 2
#endif /* CONFIG_MQTT_OFFLOAD_LIB_TLS */

static void process_thread(void);

K_THREAD_DEFINE(mqtt_offload_thread_id, STACK_SIZE, process_thread, NULL, NULL, NULL,
		THREAD_PRIORITY, IS_ENABLED(CONFIG_USERSPACE) ? K_USER : 0, -1);

static struct mqtt_offload_client mqtt_client;
static struct mqtt_offload_transport_mqtt tp;
static struct mqtt_offload_data client_id =
	MQTT_OFFLOAD_DATA_STRING_LITERAL(CONFIG_MQTT_THING_NAME);
static bool subscribed;
static int64_t ts;
static struct mqtt_offload_data topic_p =
	MQTT_OFFLOAD_DATA_STRING_LITERAL(CONFIG_MQTT_PUBLISH_TOPIC);
static struct mqtt_offload_data topic_s =
	MQTT_OFFLOAD_DATA_STRING_LITERAL(CONFIG_MQTT_SUBSCRIBE_TOPIC);

static uint8_t tx_buf[CONFIG_NET_SAMPLE_MQTT_OFFLOAD_BUFFER_SIZE];
static uint8_t rx_buf[CONFIG_NET_SAMPLE_MQTT_OFFLOAD_BUFFER_SIZE];

static bool mqtt_offload_connected;
static struct sockaddr_in mqtt_broker;
#if defined(CONFIG_MQTT_OFFLOAD_LIB_TLS)
static const sec_tag_t sec_tls_tags[] = {
	TLS_TAG_DEVICE_CERTIFICATE,
	TLS_TAG_MQTT_CA_CERTIFICATE,
};

static int setup_credentials(void)
{
	int ret;

	ret = tls_credential_add(TLS_TAG_DEVICE_CERTIFICATE, TLS_CREDENTIAL_SERVER_CERTIFICATE,
				 public_cert, public_cert_len);
	if (ret < 0) {
		LOG_ERR("Failed to add device certificate: %d", ret);
		goto exit;
	}

	ret = tls_credential_add(TLS_TAG_DEVICE_PRIVATE_KEY, TLS_CREDENTIAL_PRIVATE_KEY,
				 private_key, private_key_len);
	if (ret < 0) {
		LOG_ERR("Failed to add device private key: %d", ret);
		goto exit;
	}

	ret = tls_credential_add(TLS_TAG_MQTT_CA_CERTIFICATE, TLS_CREDENTIAL_CA_CERTIFICATE,
				 ca_cert, ca_cert_len);
	if (ret < 0) {
		LOG_ERR("Failed to add device private key: %d", ret);
		goto exit;
	}

exit:
	return ret;
}
#endif /* CONFIG_MQTT_OFFLOAD_LIB_TLS */

static void evt_cb(struct mqtt_offload_client *client, const struct mqtt_offload_evt *evt)
{
	switch (evt->type) {
	case MQTT_OFFLOAD_EVT_CONNECTED: /* Connected to <broker> */
		LOG_INF("MQTT-OFFLOAD event EVT_CONNECTED");
		mqtt_offload_connected = true;
		break;
	case MQTT_OFFLOAD_EVT_DISCONNECTED: /* Disconnected */
		LOG_INF("MQTT-OFFLOAD event EVT_DISCONNECTED");
		mqtt_offload_connected = false;
		break;
	case MQTT_OFFLOAD_EVT_ASLEEP: /* Entered ASLEEP state */
		LOG_INF("MQTT-OFFLOAD event EVT_ASLEEP");
		break;
	case MQTT_OFFLOAD_EVT_AWAKE: /* Entered AWAKE state */
		LOG_INF("MQTT-OFFLOAD event EVT_AWAKE");
		break;
	case MQTT_OFFLOAD_EVT_PUBLISH: /* Received a PUBLISH message */
		LOG_INF("MQTT-OFFLOAD event EVT_PUBLISH");
		LOG_HEXDUMP_INF(evt->param.publish.topic.data, evt->param.publish.topic.size,
				"Published topic");
		LOG_HEXDUMP_INF(evt->param.publish.data.data, evt->param.publish.data.size,
				"Published data");
		LOG_DBG("%d %d", __LINE__, evt->param.publish.data.size);
		break;
	case MQTT_OFFLOAD_EVT_SUBSCRIBE_ACK: /* Received a SUBSCRIBE ACK message */
		LOG_INF("MQTT-OFFLOAD event EVT_SUBSCRIBE_ACK");
		subscribed = true;
		break;
	case MQTT_OFFLOAD_EVT_UNSUBSCRIBE_ACK: /* Received a UNSUBSCRIBE ACK message */
		LOG_INF("MQTT-OFFLOAD event EVT_UNSUBSCRIBE_ACK");
		subscribed = false;
		break;
	case MQTT_OFFLOAD_EVT_PUBLISH_ACK: /* Received a PUBLISH ACK message */
		if (evt->result != 0) {
			LOG_ERR("MQTT-OFFLOAD event EVT_PUBLISH_ACK failed");
		} else {
			LOG_INF("MQTT-OFFLOAD event EVT_PUBLISH_ACK success");
		}
		break;
	default:
		break;
	}
}

static int do_work(void)
{
	char out[20];
	struct mqtt_offload_data pubdata = {.data = out};
	const int64_t now = k_uptime_get();
	int err;

	err = mqtt_offload_input(&mqtt_client);
	if (err < 0) {
		LOG_ERR("failed: input: %d", err);
		return err;
	}

	if (mqtt_offload_connected && !subscribed) {
		err = mqtt_offload_subscribe(&mqtt_client, MQTT_OFFLOAD_QOS_0, &topic_s);
		if (err < 0) {
			return err;
		}
	}

	if (now - ts > 50000 && mqtt_offload_connected) {
		LOG_INF("Publishing timestamp");

		ts = now;

		err = snprintk(out, sizeof(out), "%" PRIi64, ts);
		if (err < 0) {
			LOG_ERR("failed: snprintf");
			return err;
		}

		pubdata.size = MIN(sizeof(out), err);

		err = mqtt_offload_publish(&mqtt_client, MQTT_OFFLOAD_QOS_0, &topic_p, false,
					   &pubdata);
		if (err < 0) {
			LOG_ERR("failed: publish: %d", err);
			return err;
		}
	}

	return 0;
}

static void mqtt_client_setup(void)
{
	int err = 0;
	struct mqtt_offload_buffers buffers;

#if defined(CONFIG_MQTT_OFFLOAD_LIB_TLS)
	setup_credentials();
	/* setup TLS */
	tp.type = MQTT_OFFLOAD_TRANSPORT_SECURE;
	struct mqtt_sec_config *const tls_config = &tp.mqtt.config;

	tls_config->peer_verify = TLS_PEER_VERIFY_REQUIRED;
	tls_config->cipher_list = NULL;
	tls_config->sec_tag_list = sec_tls_tags;
	tls_config->sec_tag_count = ARRAY_SIZE(sec_tls_tags);
	tls_config->hostname = CONFIG_MQTT_ENDPOINT;
	tls_config->cert_nocopy = TLS_CERT_NOCOPY_NONE;
#else
	tp.type = MQTT_TRANSPORT_NON_SECURE;
#endif
	buffers.tx = tx_buf;
	buffers.txsz = sizeof(tx_buf);
	buffers.rx = rx_buf;
	buffers.rxsz = sizeof(rx_buf);

	err = mqtt_offload_client_init(&mqtt_client, &client_id, &tp, evt_cb, &buffers);

	__ASSERT(err == 0, "mqtt_offload_client_init() failed %d", err);

	mqtt_client.broker = &mqtt_broker;

	mqtt_client.protocol_version = MQTT_VERSION_3_1_1;
}

struct backoff_context {
	uint16_t retries_count;
	uint16_t max_retries;

#if defined(CONFIG_MQTT_EXPONENTIAL_BACKOFF)
	uint32_t attempt_max_backoff; /* ms */
	uint32_t max_backoff;         /* ms */
#endif
};

static void backoff_context_init(struct backoff_context *bo)
{
	__ASSERT_NO_MSG(bo != NULL);

	bo->retries_count = 0u;
	bo->max_retries = MAX_RETRIES;

#if defined(CONFIG_MQTT_EXPONENTIAL_BACKOFF)
	bo->attempt_max_backoff = BACKOFF_EXP_BASE_MS;
	bo->max_backoff = BACKOFF_EXP_MAX_MS;
#endif
}

/* https://aws.amazon.com/blogs/architecture/exponential-backoff-and-jitter/ */
static void backoff_get_next(struct backoff_context *bo, uint32_t *next_backoff_ms)
{
	__ASSERT_NO_MSG(bo != NULL);
	__ASSERT_NO_MSG(next_backoff_ms != NULL);

#if defined(CONFIG_MQTT_EXPONENTIAL_BACKOFF)
	if (bo->retries_count <= bo->max_retries) {
		*next_backoff_ms = sys_rand32_get() % (bo->attempt_max_backoff + 1u);

		/* Calculate max backoff for the next attempt (~ 2**attempt) */
		bo->attempt_max_backoff = MIN(bo->attempt_max_backoff * 2u, bo->max_backoff);
		bo->retries_count++;
	}
#else
	*next_backoff_ms = BACKOFF_CONST_MS;
#endif
}

static int mqtt_client_try_connect(void)
{
	int ret = 0;
	uint32_t backoff_ms;
	struct backoff_context bo;

	backoff_context_init(&bo);

	while (bo.retries_count <= bo.max_retries) {
		LOG_INF("Connecting client");
		ret = mqtt_offload_connect(&mqtt_client, false, true);
		__ASSERT(ret == 0, "mqtt_offload_connect() failed %d", ret);
		if (ret == 0) {
			goto exit;
		}

		backoff_get_next(&bo, &backoff_ms);

		LOG_ERR("Failed to connect: %d backoff delay: %u ms", ret, backoff_ms);
		k_msleep(backoff_ms);
	}

exit:
	return ret;
}

int mqtt_client_loop(struct pollfd *fds)
{
	int rc;

	mqtt_client_setup();

	rc = mqtt_client_try_connect();
	if (rc != 0) {
		return rc;
	}

	fds->fd = tp.mqtt.sock;
	fds->events = POLLIN;
	return 0;
}

static int resolve_broker_addr(struct sockaddr_in *broker)
{
	int ret;
	struct addrinfo *ai = NULL;

	const struct addrinfo hints = {
		.ai_family = AF_INET,
		.ai_socktype = SOCK_STREAM,
		.ai_protocol = 0,
	};
	char port_string[6] = {0};

	sprintf(port_string, "%d", MQTT_BROKER_PORT);
	ret = getaddrinfo(CONFIG_MQTT_ENDPOINT, port_string, &hints, &ai);
	if (ret == 0) {
		char addr_str[INET_ADDRSTRLEN];

		memcpy(broker, ai->ai_addr, MIN(ai->ai_addrlen, sizeof(struct sockaddr_storage)));

		inet_ntop(AF_INET, &broker->sin_addr, addr_str, sizeof(addr_str));
		LOG_INF("Resolved: %s:%u", addr_str, htons(broker->sin_port));
	} else {
		LOG_ERR("failed to resolve hostname err = %d (errno = %d)", ret, errno);
	}

	freeaddrinfo(ai);

	return ret;
}

static void process_thread(void)
{
	int err;
	struct pollfd fds;

	resolve_broker_addr(&mqtt_broker);

	err = mqtt_client_loop(&fds);
	if (err != 0) {
		goto cleanup;
	}

	while (err == 0) {
		k_sleep(K_MSEC(500));

		err = do_work();
	}

cleanup:
	mqtt_offload_disconnect(&mqtt_client);

	close(fds.fd);
	fds.fd = -1;
	LOG_ERR("Exiting thread: %d", err);
}

void start_thread(void)
{
	int rc;
#if defined(CONFIG_USERSPACE)
	rc = k_mem_domain_add_thread(&app_domain, udp_thread_id);
	if (rc < 0) {
		LOG_ERR("Failed: k_mem_domain_add_thread() %d", rc);
		return;
	}
#endif
	rc = k_thread_name_set(mqtt_offload_thread_id, "mqtt_offload");
	if (rc < 0 && rc != -ENOSYS) {
		LOG_ERR("Failed: k_thread_name_set() %d", rc);
		return;
	}

	k_thread_start(mqtt_offload_thread_id);

	rc = k_thread_join(mqtt_offload_thread_id, K_FOREVER);
	if (rc != 0) {
		LOG_ERR("Failed: k_thread_join() %d", rc);
	}
}
```
