## samples/net/quic/echo_service/sample.yaml
```yaml
sample:
  description: echo server using QUIC API
  name: quic_service_echo
common:
  harness: net
  depends_on: netif
  filter: CONFIG_FULL_LIBC_SUPPORTED and not CONFIG_NATIVE_LIBC
  min_ram: 400
tests:
  sample.net.quic.service.echo_service:
    tags:
      - net
      - socket
```

## samples/net/rpl-node/sample.yaml
```yaml
common:
  build_only: true
  depends_on: ieee802154
  tags: net rpl ieee802154
sample:
  description: Can be used to test RPL network. Needs
    to be run in real device. This cannot be run in
    QEMU.
  name: RPL node demo application
tests:
  test_quark_se_c1000_devboard:
    extra_args: CONF_FILE="prj_quark_se_c1000_devboard.conf"
    platform_whitelist: quark_se_c1000_devboard
```

## samples/net/rpl_border_router/sample.yaml
```yaml
common:
  harness: net
  tags: net rpl ieee802154 ethernet
  platform_whitelist: frdm_k64f
sample:
  description: Can be used to form RPL network. Needs
    to be run in real device. This cannot be run in
    QEMU.
  name: RPL Border Router demo application
tests:
  test_frdm_k64f_mcr20a:
    extra_args: CONF_FILE="prj_frdm_k64f_mcr20a.conf"
```

## samples/net/rpl_node/boards/nrf52840_pca10056.conf
```kconfig
CONFIG_IEEE802154_NRF5=y
CONFIG_IEEE802154_NRF5_DRV_NAME="IEEE802154_nrf5"
CONFIG_IEEE802154_NRF5_INIT_PRIO=80
CONFIG_NET_CONFIG_IEEE802154_DEV_NAME="IEEE802154_nrf5"
```

## samples/net/rpl_node/boards/quark_se_c1000_devboard.conf
```kconfig
CONFIG_IEEE802154_CC2520=y

CONFIG_NET_CONFIG_IEEE802154_DEV_NAME="cc2520"

CONFIG_IEEE802154_CC2520_RANDOM_MAC=n
CONFIG_IEEE802154_CC2520_MAC4=0x00
CONFIG_IEEE802154_CC2520_MAC5=0x00
CONFIG_IEEE802154_CC2520_MAC6=0x00
CONFIG_IEEE802154_CC2520_MAC7=0x01
```

## samples/net/rpl_node/sample.yaml
```yaml
common:
  harness: net
  tags: net rpl ieee802154
sample:
  description: Can be used to test RPL network. Needs
    to be run in real device. This cannot be run in
    QEMU.
  name: RPL node demo application
  platforms: all
tests:
  test:
    platform_whitelist: quark_se_c1000_devboard nrf52840_pca10056
```

## samples/net/rtp/Kconfig
```kconfig
# SPDX-FileCopyrightText: 2026 Basalte bv
# SPDX-License-Identifier: Apache-2.0

choice RTP_SAMPLE_ROLE
	prompt "RTP Sample Role"

config RTP_SAMPLE_ROLE_SINK
	bool "RTP Sample Role Sink"
	help
	  Build the RTP sample as a sink

config RTP_SAMPLE_ROLE_SOURCE
	bool "RTP Sample Role Source"
	help
	  Build the RTP sample as a source

endchoice

config RTP_SAMPLE_IPV6
	bool "Use IPv6 for the RTP session"
	depends on NET_IPV6
	help
	  Join the RTP multicast group over IPv6 instead of IPv4.

source "Kconfig.zephyr"
```

## samples/net/rtp/rtp_transmit/boards/native_sim.conf
```kconfig
CONFIG_NET_CONFIG_MY_IPV4_ADDR="192.0.2.101"
CONFIG_NET_CONFIG_MY_IPV4_NETMASK="255.255.255.0"
CONFIG_NET_DHCPV4=n

CONFIG_NATIVE_SIM_SLOWDOWN_TO_REAL_TIME=y
```

## samples/net/secure_mqtt_sensor_actuator/Kconfig
```kconfig
# Copyright (c) 2024 Analog Devices, Inc.
# SPDX-License-Identifier: Apache-2.0

mainmenu "Secure MQTT Sensor Actuator Sample Application"

config NET_SAMPLE_MQTT_BROKER_HOSTNAME
	string "Hostname of MQTT broker"
	default "test.mosquitto.org"
	help
	  MQTT broker's hostname or IP address.

config NET_SAMPLE_MQTT_BROKER_PORT
	string "MQTT Broker Connection Port"
	default "8883"
	help
	  Port through which the application should connect to the MQTT broker.
	  Secure MQTT uses port 8883.

config NET_SAMPLE_MQTT_PUB_TOPIC
	string "The MQTT topic the application should publish data to"
	default "zephyr_sample/sensor"

config NET_SAMPLE_MQTT_SUB_TOPIC_CMD
	string "The MQTT topic the application will receive commands on"
	default "zephyr_sample/command"

config NET_SAMPLE_MQTT_PUBLISH_INTERVAL
	int "Interval between MQTT publishes (in seconds)"
	default 3
	help
	  This config determines the frequency at which MQTT publishes occur.

choice NET_SAMPLE_MQTT_QOS
	prompt "Quality of Service level used for MQTT publish and subscribe"
	default NET_SAMPLE_MQTT_QOS_1_AT_LEAST_ONCE

config NET_SAMPLE_MQTT_QOS_0_AT_MOST_ONCE
	bool "QoS 0 / At most once delivery"
	help
	  No acknowledgment needed for published message.

config NET_SAMPLE_MQTT_QOS_1_AT_LEAST_ONCE
	bool "QoS 1 / At least once delivery"
	help
	  If acknowledgment expected for published message, duplicate messages permitted.

config NET_SAMPLE_MQTT_QOS_2_EXACTLY_ONCE
	bool "QoS 2 / Exactly once delivery"
	help
	   Acknowledgment expected and message shall be published only once.

endchoice

config NET_SAMPLE_MQTT_PAYLOAD_SIZE
	int "Size of MQTT payload in bytes"
	default 128

source "Kconfig.zephyr"
```

## samples/net/secure_mqtt_sensor_actuator/sample.yaml
```yaml
sample:
  name: Secure MQTT Sensor/Actuator Sample
tests:
  sample.net.secure_mqtt_sensor_actuator:
    harness: net
    tags:
      - net
      - mqtt
      - sensors
    filter: dt_alias_exists("ambient-temp0")
    integration_platforms:
      - adi_eval_adin1110ebz
  sample.net.secure_mqtt_sensor_actuator.staticip:
    harness: net
    extra_args: OVERLAY_CONFIG="overlay-static.conf"
    tags:
      - net
      - mqtt
      - sensors
    filter: dt_alias_exists("ambient-temp0")
    integration_platforms:
      - native_sim
  sample.net.secure_mqtt_sensor_actuator.staticip_insecure:
    harness: net
    extra_args: OVERLAY_CONFIG="overlay-static-insecure.conf"
    tags:
      - net
      - mqtt
      - sensors
    filter: dt_alias_exists("ambient-temp0")
    integration_platforms:
      - adi_eval_adin1110ebz
      - native_sim
```

## samples/net/sntp/sample.yaml
```yaml
sample:
  description: Simple Network Time Protocol sample application
  name: SNTP
common:
  harness: net
  tags:
    - net
    - sntp
tests:
  net.sntp.native:
    platform_allow:
      - native_sim
    integration_platforms:
      - native_sim
    extra_configs:
      - CONFIG_NATIVE_SIM_SLOWDOWN_TO_REAL_TIME=y
    extra_args:
      - OVERLAY_CONFIG="overlay-nsos.conf"
```

## samples/net/sntp_client/sample.yaml
```yaml
sample:
  description: SNTP client sample
  name: sntp_client
tests:
  test:
    harness: net
    platform_whitelist: qemu_x86
    tags: net
```

## samples/net/sockets/big_http_download/Kconfig
```kconfig
# Private config options for big_http_download sample

# Copyright (c) 2020 Linaro Limited
# SPDX-License-Identifier: Apache-2.0

mainmenu "big_http_download sample application"

config SAMPLE_BIG_HTTP_DL_URL
	string "Download URL"
	default "http://archive.ubuntu.com/ubuntu/dists/xenial/main/installer-amd64/current/images/hd-media/vmlinuz"
	help
	  URL to download.

config SAMPLE_BIG_HTTP_DL_MAX_URL_LENGTH
	int "Maximum length of the download URL"
	default 256

config SAMPLE_BIG_HTTP_DL_NUM_ITER
	int "Limit number of iterations"
	default 0
	help
	  Number of download iterations (0 - unlimited).

source "Kconfig.zephyr"
```

## samples/net/sockets/big_http_download/sample.yaml
```yaml
sample:
  description: BSD Sockets big HTTP download example
  name: big_http_download
common:
  filter: CONFIG_FULL_LIBC_SUPPORTED and not CONFIG_NATIVE_LIBC
  harness: net
  depends_on: netif
  min_ram: 32
  min_flash: 128
  tags:
    - net
    - socket
tests:
  sample.net.sockets.big_http_download: {}
  sample.net.sockets.big_http_download.ci:
    extra_args: EXTRA_CONF_FILE=overlay-ci.conf
```

## samples/net/sockets/can/Kconfig
```kconfig
# Private config options for can sample app

# Copyright (c) 2018 Alexander Wachter
# SPDX-License-Identifier: Apache-2.0

mainmenu "SocketCAN sample application"

config SAMPLE_SOCKETCAN_LOOPBACK_MODE
	bool "Loopback mode"
	default y
	help
	  Set the controller to loopback mode.
	  This allows testing without a second board.

source "Kconfig.zephyr"
```

## samples/net/sockets/can/boards/stm32f072b_disco.conf
```kconfig
# SPDX-FileCopyrightText: Copyright The Zephyr Project Contributors
# SPDX-License-Identifier: Apache-2.0

# The board has very limited amount of memory so use limited resources
CONFIG_NET_PKT_RX_COUNT=10
CONFIG_NET_PKT_TX_COUNT=10
CONFIG_NET_BUF_RX_COUNT=10
CONFIG_NET_BUF_TX_COUNT=10

CONFIG_NET_SHELL=n
CONFIG_NET_MAX_CONTEXTS=2
```

## samples/net/sockets/can/sample.yaml
```yaml
sample:
  name: SocketCAN sample
common:
  tags: net socket can
  filter: dt_chosen_enabled("zephyr,canbus") and not dt_compat_enabled("kvaser,pcican")
  depends_on: can
  harness: console
tests:
  sample.net.sockets.can.one_socket:
    extra_configs:
      - CONFIG_NET_SOCKETS_CAN_RECEIVERS=1
    harness_config:
      type: multi_line
      ordered: true
      regex:
        - "(.*)\\[0\\] CAN frame: IDE 0x0 RTR 0x0 ID 0x1 DLC 0x8"
        - "(.*)f0 f1 f2 f3 f4 f5 f6 f7"
  sample.net.sockets.can.two_sockets:
    extra_configs:
      - CONFIG_NET_SOCKETS_CAN_RECEIVERS=2
    harness_config:
      type: multi_line
      ordered: true
      regex:
        - "(.*)\\[0\\] CAN frame: IDE 0x0 RTR 0x0 ID 0x1 DLC 0x8"
        - "(.*)f0 f1 f2 f3 f4 f5 f6 f7"
        - "(.*)\\[1\\] CAN frame: IDE 0x0 RTR 0x0 ID 0x1 DLC 0x8"
        - "(.*)f0 f1 f2 f3 f4 f5 f6 f7"
```

## samples/net/sockets/civetweb/sample.yaml
```yaml
sample:
  description: Civetweb HTTP API sample
  name: civetweb
tests:
  sample.net.sockets.civetweb:
    platform_allow: sam_e70_xplained
```

## samples/net/sockets/civetweb_websocket_server/sample.yaml
```yaml
sample:
  description: Civetweb WebSocket Server sample
  name: civetweb_websocket_server
tests:
  sample.net.sockets.civetweb_websocket_server:
    platform_allow: nucleo_h745zi_q_m7
```

## samples/net/sockets/coap_client/Kconfig
```kconfig
# Copyright (c) 2025 Netfeasa Ltd.
# SPDX-License-Identifier: Apache-2.0

mainmenu "CoAP client sample application"

config NET_SAMPLE_COAP_CLIENT_PEER
	string "CoAP server peer"
	help
	  Peer address of the CoAP server. The value may be an IPv4 literal,
	  an IPv6 literal, or a hostname. If no port is specified, UDP port
	  5683 is used.
	  Syntax examples:
	     192.0.2.1:5683
	     192.0.2.42
	     [2001:db8::1]:5683
	     [2001:db8::2]
	     example.com:5683
	     example.com

config NET_SAMPLE_COAP_CLIENT_REPLY_TIMEOUT_MS
	int "CoAP reply timeout in milliseconds"
	default 0
	range 0 600000
	help
	  Time to wait for a CoAP reply before giving up.
	  Set to 0 to wait forever.

config NET_SAMPLE_COAP_CLIENT_BLOCKWISE_MAX_RETRIES
	int "Maximum block-wise retries after timeout"
	default 0
	range 0 10
	help
	  Number of times to retry a block-wise GET request when waiting for
	  the next block times out. This only has an effect when
	  NET_SAMPLE_COAP_CLIENT_REPLY_TIMEOUT_MS is non-zero.

source "samples/net/common/Kconfig"
source "Kconfig.zephyr"
```

## samples/net/sockets/coap_client/sample.yaml
```yaml
common:
  filter: CONFIG_FULL_LIBC_SUPPORTED and not CONFIG_NATIVE_LIBC
sample:
  description: TBD
  name: TBD
tests:
  sample.net.sockets.coap_client:
    harness: net
    tags:
      - net
      - socket
    platform_allow: qemu_x86
  sample.net.sockets.coap_client.802154.subg:
    extra_args: EXTRA_CONF_FILE="overlay-802154-subg.conf"
    platform_allow: beagleconnect_freedom
```

## samples/net/sockets/coap_download/Kconfig
```kconfig
# Copyright (c) 2024 Witekio
# SPDX-License-Identifier: Apache-2.0

mainmenu "CoAP Download Sample Application"

config NET_SAMPLE_COAP_SERVER_PORT
	int "CoAP server port"
	default 5683
	help
	  CoAP server port that the application should send requests to.

config NET_SAMPLE_COAP_RESOURCE_PATH
	string "The CoAP resource path to download"
	default "test.txt"
	help
	  The path (relative to server's root directory) of the CoAP resource
	  the application should download.

source "Kconfig.zephyr"
```

## samples/net/sockets/coap_download/sample.yaml
```yaml
sample:
  name: CoAP Download Sample
tests:
  sample.net.sockets.coap_download:
    harness: net
    filter: CONFIG_ENTROPY_HAS_DRIVER
    depends_on: netif
    tags:
      - net
      - coap
    integration_platforms:
      - native_sim
      - nucleo_h753zi
```
