/*
 * Copyright (c) 2020 Phytec Messtechnik GmbH
 *
 * SPDX-License-Identifier: Apache-2.0
 */

&spi3 {
	status = "ok";
	cs-gpios = <&gpio1 3 GPIO_ACTIVE_LOW>;
	sck-pin = <36>;
	mosi-pin = <37>;
	miso-pin = <38>;

	winc1500@0 {
		status = "ok";
		compatible = "atmel,winc1500";
		reg = <0x0>;
		label = "winc1500";
		spi-max-frequency = <4000000>;
		irq-gpios = <&gpio1 7 1>;
		reset-gpios = <&gpio1 8 1>;
		enable-gpios = <&gpio1 12 0>;

	};
};
