## samples/net/wifi/shell/boards/frdm_imx91_mimx9131.conf
```kconfig
#
# Copyright 2026 NXP
#
# SPDX-License-Identifier: Apache-2.0
#

#
# Enable NXP Wi-Fi
#
CONFIG_WIFI_NXP=y

#firmware
CONFIG_NXP_MONOLITHIC_WIFI=y

# Wi-Fi driver task priority
CONFIG_NXP_WIFI_TX_TASK_PRIO=3

# Net thread priorities
CONFIG_NET_TC_THREAD_PRIO_CUSTOM=y
CONFIG_NET_TC_THREAD_PREEMPTIVE=y
CONFIG_NET_TCP_WORKER_PRIO=-16
CONFIG_NET_TC_TX_THREAD_BASE_PRIO=3
CONFIG_NET_TC_RX_THREAD_BASE_PRIO=3
CONFIG_ZPERF_WORK_Q_STACK_SIZE=8192
CONFIG_ZPERF_WORK_Q_THREAD_PRIORITY=3
CONFIG_NET_SOCKETS_SERVICE_THREAD_PRIO=3
CONFIG_NET_CONTEXT_PRIORITY=y
CONFIG_NET_MGMT_THREAD_PRIO_CUSTOM=y
CONFIG_NET_MGMT_THREAD_PRIORITY=3

# Network buffer tuning for TCP throughput (zperf)
CONFIG_NET_BUF_DATA_SIZE=1600

# Stack sizes
CONFIG_IDLE_STACK_SIZE=1024
CONFIG_SHELL_STACK_SIZE=16384
CONFIG_MAIN_STACK_SIZE=8192
CONFIG_SYSTEM_WORKQUEUE_STACK_SIZE=4096
CONFIG_NXP_WIFI_TX_TASK_STACK_SIZE=8192
CONFIG_NXP_WIFI_CORE_TASK_STACK_SIZE=16384
CONFIG_NXP_WIFI_SCAN_TASK_STACK_SIZE=8192
CONFIG_NXP_WIFI_MON_TASK_STACK_SIZE=8192
CONFIG_NXP_WIFI_POWERSAVE_TASK_STACK_SIZE=4096
CONFIG_NXP_WIFI_DRIVER_TASK_STACK_SIZE=8192
CONFIG_NXP_WIFI_WLCMGR_TASK_STACK_SIZE=8192
CONFIG_NET_MGMT_EVENT_STACK_SIZE=16384
CONFIG_NET_TCP_WORKQ_STACK_SIZE=2048
CONFIG_NET_SOCKETS_SERVICE_STACK_SIZE=4096
CONFIG_NET_TX_STACK_SIZE=16384
CONFIG_NET_RX_STACK_SIZE=16384

# Speed optimization
CONFIG_SPEED_OPTIMIZATIONS=y
```

## samples/net/wifi/shell/boards/rd_rw612_bga.conf
```kconfig
CONFIG_NXP_RW610=y

CONFIG_SYS_HEAP_VALIDATE=y
CONFIG_SYS_HEAP_RUNTIME_STATS=y
CONFIG_ASSERT=y

# optimization level
CONFIG_SPEED_OPTIMIZATIONS=y

CONFIG_LOG_MODE_IMMEDIATE=y
CONFIG_WIFI_LOG_LEVEL_DBG=y
```

## samples/net/zperf/boards/esp32s31_function_coreboard_hpcore.conf
```kconfig
CONFIG_NET_BUF_DATA_SIZE=1536
CONFIG_NET_BUF_RX_COUNT=40
CONFIG_NET_BUF_TX_COUNT=40
CONFIG_NET_TCP_MAX_RECV_WINDOW_SIZE=32768
CONFIG_NET_TCP_MAX_SEND_WINDOW_SIZE=32768
```

## samples/net/zperf/boards/esp32s3_devkitc_esp32s3_procpu.conf
```kconfig
# Copyright (c) 2026 Henry Zhang
# SPDX-License-Identifier: Apache-2.0

CONFIG_WIFI=y
CONFIG_NET_L2_WIFI_MGMT=y
CONFIG_NET_L2_WIFI_SHELL=y
CONFIG_NET_DHCPV4=y

CONFIG_ESP32_WIFI_IRAM_OPT=y
CONFIG_NET_BUF_RX_COUNT=384

CONFIG_ESP32_WIFI_RX_IRAM_OPT=y
```

## samples/net/zperf/boards/frdm_mcxn236.conf
```kconfig
CONFIG_USB_HOST_STACK=y
CONFIG_USBH_CDC_ECM_CLASS=y
CONFIG_USBH_CDC_ECM_TX_PIPELINE_DEPTH=4
CONFIG_USBH_CDC_ECM_RX_PIPELINE_DEPTH=4
# CONFIG_USBH_CDC_NCM_CLASS=y

CONFIG_NET_DHCPV4=y
CONFIG_NET_CONFIG_SETTINGS=n
CONFIG_NET_IPV6=n
CONFIG_NET_STATISTICS=y
CONFIG_NET_PKT_RX_COUNT=16
CONFIG_NET_PKT_TX_COUNT=16
CONFIG_NET_BUF_RX_COUNT=64
CONFIG_NET_BUF_TX_COUNT=64
```

## samples/net/zperf/boards/max32690fthr_max32690_m4.conf
```kconfig
# Copyright (c) 2026 Analog Devices, Inc.
# SPDX-License-Identifier: Apache-2.0

CONFIG_NET_PKT_RX_COUNT=80
CONFIG_NET_PKT_TX_COUNT=40
CONFIG_NET_BUF_RX_COUNT=120
CONFIG_NET_BUF_TX_COUNT=40
CONFIG_NET_BUF_DATA_SIZE=1515
CONFIG_NET_BUF_FIXED_DATA_SIZE=y

CONFIG_NET_IPV6=n
CONFIG_NET_CONFIG_NEED_IPV6=n

CONFIG_NET_TCP_MAX_RECV_WINDOW_SIZE=14140

CONFIG_NET_IPV4_FRAGMENT=y
CONFIG_NET_IPV4_FRAGMENT_MAX_COUNT=16
CONFIG_NET_IPV4_FRAGMENT_MAX_PKT=100
CONFIG_NET_IPV4_FRAGMENT_TIMEOUT=1

CONFIG_ETHERNET_LOG_LEVEL_WRN=y
```

## samples/net/zperf/boards/rpi_4b.conf
```kconfig
CONFIG_ETH_DRIVER=y
CONFIG_NET_BUF_DATA_SIZE=1536
CONFIG_NET_BUF_RX_COUNT=45
CONFIG_NET_BUF_TX_COUNT=26
CONFIG_NET_ZPERF_MAX_PACKET_SIZE=1470
```

## samples/net/zperf/boards/x_nucleo_67w61m1.conf
```kconfig
# Copyright (c) 2026 STMicroelectronics
# SPDX-License-Identifier: Apache-2.0

CONFIG_WIFI=y
CONFIG_WIFI_LOG_LEVEL_ERR=y
CONFIG_NET_L2_WIFI_SHELL=y

CONFIG_NET_DHCPV4=y
# Needed for the zperf download server
CONFIG_NET_DHCPV4_SERVER=y
CONFIG_ZVFS_POLL_MAX=10

CONFIG_NET_MGMT_EVENT_QUEUE_TIMEOUT=6000
CONFIG_NET_MGMT_EVENT_QUEUE_SIZE=32

# Needed for SoftAP
CONFIG_WIFI_SHELL_MAX_AP_STA=4
CONFIG_SYSTEM_WORKQUEUE_STACK_SIZE=2048
```

## samples/sensor/accel_trig/Kconfig
```kconfig
#
#  Copyright (c) 2025 Pierrick Curt
#
# SPDX-License-Identifier: Apache-2.0
#

mainmenu "Accelerometer trigger sample application"

config SAMPLE_TAP_DETECTION
	bool "Set tap detection as trigger in the sample"

config ACTIVITY_DETECTION
	bool "Set activity detection as trigger in the sample"

source "Kconfig.zephyr"
```

## samples/sensor/lis2dh_fifo/Kconfig
```kconfig
# Copyright The Zephyr Project Contributors
# SPDX-License-Identifier: Apache-2.0

source "Kconfig.zephyr"

menu "LIS2DH FIFO sample"

config LIS2DH_FIFO_HW_TEST
	bool "Enable the finite hardware FIFO self-test"
	help
	  Validate decoded frame counts and timestamp ordering while the sample
	  runs. The test prints PASS after ten valid FIFO batches.

endmenu
```
