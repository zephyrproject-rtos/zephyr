## samples/net/wifi/apsta_mode/Kconfig
```kconfig
# Copyright 2025 NXP
# SPDX-License-Identifier: Apache-2.0

mainmenu "Network Wi-Fi apsta_mode application"

config WIFI_SAMPLE_AP_SSID
	string "SSID of soft AP"
	help
	  SSID of the soft AP created by the sample.
	  Fox example: "SOFT-AP"

config WIFI_SAMPLE_AP_PSK
	string "Pre-shared key for soft AP"
	help
	  WPA2 password used by the soft AP for client authentication.
	  For example: "PSK"

config WIFI_SAMPLE_SSID
	string "SSID of the target AP"
	help
	  SSID of the access point to connect to in station mode.
	  For example: "TARGET-AP"

config WIFI_SAMPLE_PSK
	string "Pre-shared key for target AP"
	help
	  WPA2 password used to connect to the target AP.
	  For example: "PSK"

config WIFI_SAMPLE_DHCPV4_START
	bool "Start DHCPv4 server in application layer."
	default y
	help
	  Enable this option to start the DHCPv4 server from the application layer,
	  typically before the Soft AP is initialized.

	  When disabled, the DHCPv4 server startup timing is determined by the vendor's
	  implementation. In some cases, the server may be started after the AP is up,
	  using the vendor's default IP address, gateway, subnet mask.


if WIFI_SAMPLE_DHCPV4_START

# Some vendors start the DHCPv4 server after Soft AP initialization,
# using default IP address and subnet mask. In such cases, manual
# configuration of gateway and netmask may not be necessary.
# The following options are used only if the DHCPv4 server is started
# by the application.

config WIFI_SAMPLE_AP_IP_ADDRESS
	string "IP address of soft AP"
	help
	  IP address assigned to the soft AP interface.
	  For example: "192.168.4.1"

config WIFI_SAMPLE_AP_NETMASK
	string "Netmask of soft AP"
	help
	  Subnet mask for the soft AP interface.
	  For example: "255.255.255.0"
endif # WIFI_SAMPLE_DHCPV4_START

source "Kconfig.zephyr"
```

## samples/net/wifi/apsta_mode/boards/frdm_rw612.conf
```kconfig
CONFIG_WIFI_NXP=y
CONFIG_NXP_RW610=y
CONFIG_ETH_DRIVER=n
CONFIG_WIFI_NM=y
CONFIG_NXP_WIFI_SOFTAP_SUPPORT=y

# stack size
CONFIG_SHELL_STACK_SIZE=6144
CONFIG_SYSTEM_WORKQUEUE_STACK_SIZE=2048
CONFIG_NET_MGMT_EVENT_STACK_SIZE=4608
CONFIG_NET_TCP_WORKQ_STACK_SIZE=2048
CONFIG_MAIN_STACK_SIZE=4096
CONFIG_IDLE_STACK_SIZE=1024
```

## samples/net/wifi/ble_provisioning/Kconfig
```kconfig
# Copyright (c) 2026 Espressif Systems (Shanghai) Co., Ltd.
# SPDX-License-Identifier: Apache-2.0

mainmenu "Wi-Fi provisioning over BLE"

config WIFI_BLE_PROV_KEEP_BLE_AFTER_CONNECT
	bool "Keep BLE advertising after Wi-Fi connects"
	default y
	help
	  Keep BLE advertising after Wi-Fi is connected so the device
	  remains reachable for re-provisioning.

choice WIFI_BLE_PROV_SECURITY
	prompt "BLE security for provisioning writes"
	default WIFI_BLE_PROV_SECURITY_NONE
	help
	  Security level required to write the provisioning
	  characteristics.

config WIFI_BLE_PROV_SECURITY_NONE
	bool "No pairing (plaintext)"
	help
	  Credentials are exchanged in plaintext. Evaluation only.

config WIFI_BLE_PROV_SECURITY_ENCRYPT
	bool "Encrypted link (LESC, no MITM protection)"
	select BT_SMP
	select BT_BONDABLE
	select BT_SMP_ALLOW_UNAUTH_OVERWRITE
	help
	  Writes require an encrypted link. No user interaction is
	  required for pairing.

config WIFI_BLE_PROV_SECURITY_AUTH
	bool "Authenticated pairing (LESC, passkey on console)"
	select BT_SMP
	select BT_BONDABLE
	select BT_SMP_SC_ONLY
	help
	  Writes require authenticated LESC pairing. The device prints
	  a 6-digit passkey on the console that the central must enter.

endchoice

source "Kconfig.zephyr"
```

## samples/net/wifi/boards/cc3220sf_launchxl.conf
```kconfig
# Conf file to test the net_wifi shell module with the cc3220sf WiFi driver
# cmake .. -DBOARD=cc3220sf_launchxl
CONFIG_WIFI_SIMPLELINK=y
# Debugging
CONFIG_SYS_LOG_WIFI_LEVEL=4
CONFIG_DEBUG=y
```

## samples/net/wifi/boards/cy8cproto_062_4343w.conf
```kconfig
CONFIG_NET_IF_MAX_IPV4_COUNT=2
CONFIG_NET_MGMT_EVENT_QUEUE_TIMEOUT=20
CONFIG_SYSTEM_WORKQUEUE_STACK_SIZE=2048
```

## samples/net/wifi/boards/esp32_devkitc_wroom.conf
```kconfig
CONFIG_WIFI=y
CONFIG_HEAP_MEM_POOL_SIZE=98304

CONFIG_NETWORKING=y
CONFIG_NET_L2_ETHERNET=y

CONFIG_NET_IPV6=n
CONFIG_NET_IPV4=y
CONFIG_NET_DHCPV4=y
CONFIG_ESP32_WIFI_STA_AUTO_DHCPV4=y

CONFIG_NET_LOG=y
```

## samples/net/wifi/boards/esp32s2_saola.conf
```kconfig
CONFIG_WIFI=y
CONFIG_HEAP_MEM_POOL_SIZE=34816

CONFIG_NET_PKT_RX_COUNT=7
CONFIG_NET_PKT_TX_COUNT=7
CONFIG_NET_BUF_RX_COUNT=7
CONFIG_NET_BUF_TX_COUNT=7

CONFIG_ESP32_WIFI_IRAM_OPT=n
CONFIG_ESP32_WIFI_RX_IRAM_OPT=n

CONFIG_NETWORKING=y
CONFIG_NET_L2_ETHERNET=y

CONFIG_NET_IPV6=n
CONFIG_NET_IPV4=y
CONFIG_NET_DHCPV4=y
CONFIG_ESP32_WIFI_STA_AUTO_DHCPV4=y

CONFIG_LOG_MODE_MINIMAL=y
CONFIG_NET_LOG=y

CONFIG_ESP32_WIFI_ENABLE_WPA3_SAE=y

# Enable SPIRAM to handle RAM overflow
CONFIG_ESP_SPIRAM=y
CONFIG_ESP32_WIFI_NET_ALLOC_SPIRAM=y
```

## samples/net/wifi/boards/frdm_rw612.conf
```kconfig
CONFIG_WIFI_NXP=y
CONFIG_RW610=y
CONFIG_NXP_WIFI_SHELL=y

# C Library
#CONFIG_NEWLIB_LIBC=y
CONFIG_CBPRINTF_FP_SUPPORT=y
CONFIG_COMMON_LIBC_MALLOC_ARENA_SIZE=80000

# log
CONFIG_WIFI_LOG_LEVEL_DBG=y
CONFIG_THREAD_LOCAL_STORAGE=y
CONFIG_ASSERT=y
CONFIG_ASSERT_LEVEL=2
CONFIG_LOG_MODE_IMMEDIATE=y
CONFIG_LOG_PRINTK=n

# os
CONFIG_EVENTS=y
CONFIG_SYS_HEAP_AUTO=y
CONFIG_HEAP_MEM_POOL_SIZE=122880
CONFIG_SCHED_MULTIQ=y
CONFIG_ZVFS_OPEN_MAX=30

# shell
CONFIG_SHELL_ARGC_MAX=48
CONFIG_WIFI_SHELL_MAX_AP_STA=8

# net
CONFIG_ETH_MCUX=n
CONFIG_NET_ZPERF=y
CONFIG_NET_ZPERF_MAX_PACKET_SIZE=1500
CONFIG_NET_BUF_LOG=y
CONFIG_NET_PKT_RX_COUNT=60
CONFIG_NET_PKT_TX_COUNT=40
CONFIG_NET_BUF_RX_COUNT=60
CONFIG_NET_BUF_TX_COUNT=80
CONFIG_NET_BUF_DATA_SIZE=1744
CONFIG_NET_TC_TX_COUNT=1
CONFIG_NET_TC_RX_COUNT=1
CONFIG_NET_MGMT_EVENT_QUEUE_SIZE=20
CONFIG_NET_IF_MAX_IPV4_COUNT=2
CONFIG_NET_IF_MAX_IPV6_COUNT=2
CONFIG_DNS_RESOLVER=y
CONFIG_DNS_RESOLVER_MAX_SERVERS=2
CONFIG_NET_SOCKETS_POLL_MAX=14
CONFIG_NET_ZPERF_MAX_SESSIONS=6
CONFIG_NET_IPV4_FRAGMENT_MAX_COUNT=3
CONFIG_NET_IPV4_FRAGMENT_MAX_PKT=7
CONFIG_NET_IPV4_FRAGMENT_TIMEOUT=3
CONFIG_NET_IPV6_FRAGMENT_MAX_COUNT=3
CONFIG_NET_IPV6_FRAGMENT_MAX_PKT=8
CONFIG_NET_IPV6_FRAGMENT_TIMEOUT=3
CONFIG_NET_MAX_CONN=10
CONFIG_ETH_DRIVER=n

# net threads priority
CONFIG_NET_TC_THREAD_PRIO_CUSTOM=y
CONFIG_NET_TC_THREAD_PREEMPTIVE=y
CONFIG_NET_TCP_WORKER_PRIO=-16
CONFIG_NET_TC_TX_THREAD_BASE_PRIO=3
CONFIG_NET_TC_RX_THREAD_BASE_PRIO=3
CONFIG_ZPERF_WORK_Q_THREAD_PRIORITY=3
CONFIG_NET_SOCKETS_SERVICE_THREAD_PRIO=3

# supplicant
CONFIG_WIFI_NM_WPA_SUPPLICANT=y
CONFIG_WIFI_NM_WPA_SUPPLICANT_CLI=y
CONFIG_WIFI_NM_WPA_SUPPLICANT_CRYPTO_ALT=y
CONFIG_WIFI_NM_WPA_SUPPLICANT_CRYPTO_ENTERPRISE=y
CONFIG_WIFI_NM_WPA_SUPPLICANT_DPP=y
CONFIG_WIFI_NM_WPA_SUPPLICANT_EAPOL=y
CONFIG_WIFI_NM_WPA_SUPPLICANT_CRYPTO_MBEDTLS_PSA=y
CONFIG_WIFI_NM_WPA_SUPPLICANT_INF_MON=n
CONFIG_WIFI_NM_HOSTAPD_AP=y
CONFIG_WIFI_NM_WPA_SUPPLICANT_WPS=y
CONFIG_WIFI_NM_WPA_SUPPLICANT_LOG_LEVEL_INF=y
CONFIG_WIFI_NM_WPA_SUPPLICANT_WQ_PRIO=3
CONFIG_WIFI_NM_WPA_SUPPLICANT_PRIO=3
CONFIG_WIFI_NM_HOSTAPD_WPS=y

# Enable mbedtls
CONFIG_MBEDTLS=y
CONFIG_MBEDTLS_BUILTIN=y
CONFIG_MBEDTLS_USER_CONFIG_ENABLE=y
CONFIG_MBEDTLS_USER_CONFIG_FILE="wpa_supp_els_pkc_mbedtls_config.h"
CONFIG_MBEDTLS_HAVE_TIME_DATE=y

# Include els_pkc in build
CONFIG_MCUX_ELS_PKC=y
CONFIG_MCUX_PSA_CRYPTO_DRIVER_ELS_PKC=y
CONFIG_MCUX_PSA_CRYPTO_DRIVER_ELS_PKC_THREAD=y
CONFIG_ENTROPY_GENERATOR=y
CONFIG_MBEDTLS_PSA_CRYPTO_C=y
CONFIG_MBEDTLS_ENTROPY_ENABLED=y
CONFIG_MBEDTLS_ZEPHYR_ENTROPY=y
CONFIG_MBEDTLS_SSL_MAX_CONTENT_LEN=8192

# power management
CONFIG_PM=y
CONFIG_PM_DEVICE=y
CONFIG_PM_LOG_LEVEL_OFF=y
CONFIG_PM_DEVICE_LOG_LEVEL_OFF=y
CONFIG_IDLE_STACK_SIZE=1024

# stack size
CONFIG_SHELL_STACK_SIZE=6144
CONFIG_SYSTEM_WORKQUEUE_STACK_SIZE=2048
CONFIG_NET_MGMT_EVENT_STACK_SIZE=2048
CONFIG_NET_TCP_WORKQ_STACK_SIZE=2048
CONFIG_MAIN_STACK_SIZE=4096
CONFIG_NET_SOCKETS_SERVICE_STACK_SIZE=4096
CONFIG_WIFI_NM_WPA_SUPPLICANT_WQ_STACK_SIZE=12288
CONFIG_WIFI_NM_WPA_SUPPLICANT_THREAD_STACK_SIZE=12288

# optimization level
# refer to Kconfig.zephyr for Optimizations Level
CONFIG_SPEED_OPTIMIZATIONS=y
#CONFIG_SIZE_OPTIMIZATIONS=y
#CONFIG_DEBUG_OPTIMIZATIONS=y
#CONFIG_NO_OPTIMIZATIONS=y

# debug & stats
CONFIG_SYS_HEAP_VALIDATE=y
CONFIG_SYS_HEAP_RUNTIME_STATS=y
#CONFIG_NET_PKT_TXTIME_STATS=y
#CONFIG_NET_PKT_TXTIME_STATS_DETAIL=y
CONFIG_NET_STATISTICS_WIFI=y
CONFIG_NET_STATISTICS_USER_API=y
#CONFIG_NET_STATISTICS_PERIODIC_OUTPUT=y
#CONFIG_NET_BUF_POOL_USAGE=y
#CONFIG_NET_DEBUG_NET_PKT_ALLOC=y

# stack size for -O0
#CONFIG_SHELL_STACK_SIZE=8192
#CONFIG_NET_TCP_WORKQ_STACK_SIZE=4096
#CONFIG_NET_TX_STACK_SIZE=4096
#CONFIG_NET_RX_STACK_SIZE=4096
#CONFIG_SYSTEM_WORKQUEUE_STACK_SIZE=4096
#CONFIG_ZPERF_WORK_Q_STACK_SIZE=4096
#CONFIG_MAIN_STACK_SIZE=4096
#CONFIG_WIFI_NM_WPA_SUPPLICANT_WQ_STACK_SIZE=16384
#CONFIG_WIFI_NM_WPA_SUPPLICANT_THREAD_STACK_SIZE=16384
#CONFIG_IDLE_STACK_SIZE=2048

# comment out for -O0
CONFIG_CODE_DATA_RELOCATION_SRAM=y
```

## samples/net/wifi/boards/nrf9160dk_nrf9160.conf
```kconfig
CONFIG_GPIO=y
CONFIG_SPI=y
CONFIG_NET_ARP=y
CONFIG_NET_UDP=y
CONFIG_NET_TCP=y
CONFIG_NET_DHCPV4=y

CONFIG_WIFI_OFFLOAD=y
CONFIG_NET_L2_ETHERNET=y
CONFIG_NET_L2_WIFI_MGMT=y

CONFIG_WIFI_WFX200=y
CONFIG_WIFI_WFX200_SLEEP=y
```

## samples/net/wifi/boards/quark_se_c1000_devboard.conf
```kconfig
CONFIG_GPIO=y
CONFIG_SPI=y

CONFIG_SPI_DW=y

CONFIG_WIFI_WINC1500=y
CONFIG_WIFI_WINC1500_REGION_EUROPE=y
CONFIG_WIFI_WINC1500_GPIO_SPI_CS=y
```

## samples/net/wifi/boards/reel_board.conf
```kconfig
CONFIG_GPIO=y
CONFIG_SPI=y
CONFIG_SPI_3=y

CONFIG_WIFI_WINC1500=y
CONFIG_WIFI_WINC1500_REGION_EUROPE=y
```

## samples/net/wifi/sample.yaml
```yaml
common:
  harness: net
  tags:
    - net
    - wifi
sample:
  description: Test wifi driver and APIs functionality
  name: WiFi sample app
tests:
  sample.net.wifi:
    platform_allow:
      - cc3220sf_launchxl
      - disco_l475_iot1
      - reel_board
      - rd_rw612_bga
    integration_platforms:
      - cc3220sf_launchxl
  sample.net.wifi.mikroe_wifi_bt_click:
    extra_args: SHIELD=mikroe_wifi_bt_click_mikrobus
    platform_allow: lpcxpresso55s69/lpc55s69/cpu0
  sample.net.wifi.esp_8266:
    extra_args: SHIELD=esp_8266
    platform_allow: sam4e_xpro
  sample.net.wifi.esp_8266_arduino:
    extra_args: SHIELD=esp_8266_arduino
    platform_allow:
      - frdm_k64f
      - disco_l475_iot1
    integration_platforms:
      - frdm_k64f
  sample.net.wifi.inventek_eswifi_arduino_uart:
    extra_args: SHIELD=inventek_eswifi_arduino_uart
    platform_allow:
      - frdm_k64f
      - nucleo_f767zi
    integration_platforms:
      - frdm_k64f
  sample.net.wifi.inventek_eswifi_arduino_spi:
    extra_args: SHIELD=inventek_eswifi_arduino_spi
    platform_allow:
      - frdm_k64f
      - nucleo_f767zi
    integration_platforms:
      - frdm_k64f
  sample.net.wifi.nrf70dk:
    extra_args: CONFIG_NRF_WIFI_BUILD_ONLY_MODE=y
    platform_allow:
      - nrf7002dk/nrf5340/cpuapp
      - nrf7002dk/nrf5340/cpuapp/nrf7001
    integration_platforms:
      - nrf7002dk/nrf5340/cpuapp
      - nrf7002dk/nrf5340/cpuapp/nrf7001
  sample.net.wifi.nrf7002ek:
    extra_args:
      - CONFIG_NRF_WIFI_BUILD_ONLY_MODE=y
      - SHIELD=nrf7002ek
    platform_allow:
      - nrf5340dk/nrf5340/cpuapp
      - nucleo_h723zg
    integration_platforms:
      - nrf5340dk/nrf5340/cpuapp
      - nucleo_h723zg
  sample.net.wifi.nrf7002eb:
    extra_args:
      - CONFIG_NRF_WIFI_BUILD_ONLY_MODE=y
      - SHIELD=nrf7002eb
    platform_allow:
      - thingy53/nrf5340/cpuapp
    integration_platforms:
      - thingy53/nrf5340/cpuapp
```

## samples/net/wifi/shell/boards/kit_pse84_eval_pse846gps2dbzc4a_m55.conf
```kconfig
# SPDX-FileCopyrightText: <text>Copyright (c) 2026 Infineon Technologies AG,
# or an affiliate of Infineon Technologies AG. All rights reserved.</text>
#
# SPDX-License-Identifier: Apache-2.0

CONFIG_SHELL_STACK_SIZE=6144
CONFIG_SYSTEM_WORKQUEUE_STACK_SIZE=2048
CONFIG_NET_MGMT_EVENT_STACK_SIZE=4608
CONFIG_NET_TCP_WORKQ_STACK_SIZE=2048
CONFIG_IDLE_STACK_SIZE=1024
```

## samples/net/wifi/shell/boards/mimxrt1060_evk_mimxrt1062_qspi_C.conf
```kconfig
#
# Enable NXP Wi-Fi
#
CONFIG_WIFI_NXP=y

#firmware
CONFIG_NXP_MONOLITHIC_WIFI=y

# wifi driver
CONFIG_NXP_WIFI_TX_TASK_PRIO=3

# net
CONFIG_NET_PKT_RX_COUNT=80
CONFIG_NET_PKT_TX_COUNT=80
CONFIG_NET_BUF_RX_COUNT=160
CONFIG_NET_BUF_TX_COUNT=160

# net threads priority
CONFIG_NET_TC_THREAD_PRIO_CUSTOM=y
CONFIG_NET_TC_THREAD_PREEMPTIVE=y
CONFIG_NET_TCP_WORKER_PRIO=-16
CONFIG_NET_TC_TX_THREAD_BASE_PRIO=3
CONFIG_NET_TC_RX_THREAD_BASE_PRIO=3
CONFIG_ZPERF_WORK_Q_THREAD_PRIORITY=3
CONFIG_NET_SOCKETS_SERVICE_THREAD_PRIO=3
CONFIG_NET_CONTEXT_PRIORITY=y
CONFIG_NET_MGMT_THREAD_PRIO_CUSTOM=y
CONFIG_NET_MGMT_THREAD_PRIORITY=3
CONFIG_IDLE_STACK_SIZE=1024

# stack size
CONFIG_SHELL_STACK_SIZE=6144
CONFIG_SYSTEM_WORKQUEUE_STACK_SIZE=2048
CONFIG_NET_MGMT_EVENT_STACK_SIZE=4608
CONFIG_NET_TCP_WORKQ_STACK_SIZE=2048
CONFIG_MAIN_STACK_SIZE=4096
CONFIG_NET_SOCKETS_SERVICE_STACK_SIZE=4096
CONFIG_NXP_WIFI_TX_TASK_STACK_SIZE=4096

# optimization level
# refer to Kconfig.zephyr for Optimizations Level
CONFIG_SPEED_OPTIMIZATIONS=y

# comment out for -O0
CONFIG_CODE_DATA_RELOCATION_SRAM=y
```
