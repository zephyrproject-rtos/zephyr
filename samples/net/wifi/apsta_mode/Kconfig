## samples/net/wifi/shell/boards/mimxrt1170_evk_mimxrt1176_cm7_A.conf
```kconfig
# Early Console and Debug Configuration
CONFIG_EARLY_CONSOLE=y
CONFIG_LOG=y
CONFIG_LOG_MODE_IMMEDIATE=y
# CONFIG_WIFI_LOG_LEVEL_DBG=y
# CONFIG_NET_LOG=y
# CONFIG_NET_SOCKETS_LOG_LEVEL_DBG=y
# CONFIG_NET_MGMT_EVENT_LOG_LEVEL_DBG=y
CONFIG_INIT_STACKS=y
CONFIG_TEST_RANDOM_GENERATOR=y

# OS and Memory Configuration
CONFIG_THREAD_CUSTOM_DATA=y
CONFIG_EVENTS=y
CONFIG_SYS_HEAP_AUTO=y
CONFIG_HEAP_MEM_POOL_SIZE=307200
CONFIG_SCHED_MULTIQ=y
CONFIG_ZVFS_OPEN_MAX=30
CONFIG_POSIX_API=y
CONFIG_BUILD_OUTPUT_HEX=y

# Stack Size Configuration
CONFIG_MAIN_STACK_SIZE=5200
CONFIG_SHELL_STACK_SIZE=8192
CONFIG_NET_TX_STACK_SIZE=4096
CONFIG_NET_RX_STACK_SIZE=4096
CONFIG_SYSTEM_WORKQUEUE_STACK_SIZE=4096
CONFIG_NET_MGMT_EVENT_STACK_SIZE=4096
CONFIG_NET_SOCKETS_SERVICE_STACK_SIZE=4096

# WiFi Core Configuration
CONFIG_WIFI=y
CONFIG_WIFI_LOG_LEVEL_ERR=y
CONFIG_WIFI_NXP=y

CONFIG_NXP_88W8987=y
CONFIG_NXP_88W8987_MURATA_1ZM_M2=y
# CONFIG_NXP_88W8987_MURATA_1ZM_USD=y
# CONFIG_NXP_88W8987_AW_CM358_USD=y
# CONFIG_NXP_88W8987_AW_CM358MA_M2=y

# CONFIG_NXP_IW416=y
# CONFIG_NXP_IW416_AW_AM457MA_M2=y
# CONFIG_NXP_IW416_AW_AM457_USD=y
# CONFIG_NXP_IW416_AW_AM510_USD=y
# CONFIG_NXP_IW416_AW_AM510MA_M2=y
# CONFIG_NXP_IW416_MURATA_1XK_USD=y
# CONFIG_NXP_IW416_MURATA_1XK_M2=y

# CONFIG_NXP_IW61X=y
# CONFIG_NXP_IW612_MURATA_2EL_USD=y
# CONFIG_NXP_IW612_MURATA_2EL_M2=y
# CONFIG_NXP_IW611_MURATA_2DL_USD=y
# CONFIG_NXP_IW611_MURATA_2DL_M2=y

# CONFIG_NXP_88W8801=y
# CONFIG_NXP_88W8801_AW_NM191_USD=y
# CONFIG_NXP_88W8801_AW_NM191MA_M2=y
# CONFIG_NXP_88W8801_MURATA_2DS_USD=y
# CONFIG_NXP_88W8801_MURATA_2DS_M2=y


# WiFi Task Stack Configuration
CONFIG_NXP_WIFI_MON_TASK_STACK_SIZE=2048
CONFIG_NXP_WIFI_WLCMGR_TASK_STACK_SIZE=8192
CONFIG_NXP_WIFI_POWERSAVE_TASK_STACK_SIZE=1024
CONFIG_NXP_WIFI_TX_TASK_STACK_SIZE=4096
CONFIG_NXP_WIFI_DRIVER_TASK_STACK_SIZE=4096
CONFIG_NXP_WIFI_SCAN_TASK_STACK_SIZE=4096

# Disable WMM feature
# CONFIG_NXP_WIFI_WMM=n
# CONFIG_NXP_WIFI_WMM_UAPSD=n
# CONFIG_NXP_WIFI_SDIO_MULTI_PORT_TX_AGGR=n
# CONFIG_NXP_WIFI_TURBO_MODE=n
# CONFIG_NXP_WIFI_11AX=n
# CONFIG_NXP_WIFI_11AC=n

# SDIO Configuration
CONFIG_SDHC=y
CONFIG_SDIO_STACK=y

# Network Core Configuration
CONFIG_NETWORKING=y
CONFIG_NET_IPV4=y
CONFIG_NET_IPV6=y
CONFIG_NET_TCP=y
CONFIG_NET_L2_ETHERNET=y
# CONFIG_NET_L2_ETHERNET_MGMT=y
# CONFIG_NET_MGMT=y
# CONFIG_NET_MGMT_EVENT=y

# Network Buffer Configuration
# CONFIG_NET_BUF=y
CONFIG_NET_BUF_LOG=y
CONFIG_NET_BUF_DATA_SIZE=2048
CONFIG_NET_PKT_RX_COUNT=32
CONFIG_NET_PKT_TX_COUNT=32
CONFIG_NET_BUF_RX_COUNT=64
CONFIG_NET_BUF_TX_COUNT=64
CONFIG_NET_MAX_CONTEXTS=16

# Network Thread Priority Configuration
CONFIG_NET_TC_THREAD_PRIO_CUSTOM=y
CONFIG_NET_TC_THREAD_PREEMPTIVE=y
CONFIG_NET_TCP_WORKER_PRIO=-16
CONFIG_NET_TCP_WORKQ_STACK_SIZE=2048
CONFIG_NET_TC_TX_THREAD_BASE_PRIO=3
CONFIG_NET_TC_RX_THREAD_BASE_PRIO=3
CONFIG_ZPERF_WORK_Q_THREAD_PRIORITY=3
CONFIG_NET_SOCKETS_SERVICE_THREAD_PRIO=3
CONFIG_NET_TC_SKIP_FOR_HIGH_PRIO=y
CONFIG_NET_CONTEXT_PRIORITY=y
CONFIG_NET_MGMT_THREAD_PRIO_CUSTOM=y
CONFIG_NET_MGMT_THREAD_PRIORITY=3

# Network Protocol Configuration
CONFIG_NET_TC_TX_COUNT=1
CONFIG_NET_TC_RX_COUNT=1
CONFIG_NET_MGMT_EVENT_QUEUE_SIZE=32
CONFIG_NET_MGMT_EVENT_QUEUE_TIMEOUT=5000
CONFIG_NET_IF_MAX_IPV4_COUNT=4
CONFIG_NET_IF_MAX_IPV6_COUNT=4
CONFIG_NET_MAX_CONN=10

# DHCP Configuration
CONFIG_NET_DHCPV4=y
# CONFIG_NET_DHCPV4_INITIAL_DELAY_MAX=10
CONFIG_NET_DHCPV4_SERVER_ADDR_COUNT=32
CONFIG_NET_DHCPV4_SERVER_ICMP_PROBE_TIMEOUT=100

# DNS Configuration
CONFIG_DNS_RESOLVER=y
CONFIG_DNS_RESOLVER_MAX_SERVERS=2
CONFIG_NET_SOCKETS_POLL_MAX=14

# Network Features
CONFIG_NET_IPV4_FRAGMENT=y
CONFIG_NET_IPV4_FRAGMENT_MAX_COUNT=3
CONFIG_NET_IPV4_FRAGMENT_MAX_PKT=7
CONFIG_NET_IPV4_FRAGMENT_TIMEOUT=3
CONFIG_NET_IPV6_FRAGMENT=y
CONFIG_NET_IPV6_FRAGMENT_MAX_COUNT=3
CONFIG_NET_IPV6_FRAGMENT_MAX_PKT=8
CONFIG_NET_IPV6_FRAGMENT_TIMEOUT=3

# Shell Configuration
CONFIG_NET_SHELL=y
CONFIG_NXP_WIFI_SHELL=y
CONFIG_NET_L2_WIFI_SHELL=y
CONFIG_SHELL=y
# CONFIG_SHELL_BACKEND_SERIAL=y
CONFIG_SHELL_CMD_BUFF_SIZE=512
CONFIG_SHELL_ARGC_MAX=48
CONFIG_WIFI_SHELL_MAX_AP_STA=8
CONFIG_WIFI_MGMT_AP_MAX_NUM_STA=8

# Network Statistics
CONFIG_NET_STATISTICS=y
CONFIG_NET_STATISTICS_PERIODIC_OUTPUT=n
CONFIG_NET_STATISTICS_WIFI=y
CONFIG_NET_STATISTICS_USER_API=y


# Performance Testing
CONFIG_NET_ZPERF=y
CONFIG_NET_ZPERF_MAX_PACKET_SIZE=1500
CONFIG_NET_ZPERF_MAX_SESSIONS=6
```

## samples/net/wifi/shell/boards/native_sim_64.conf
```kconfig
# Copyright (c) 2026 Nordic Semiconductor ASA
# SPDX-License-Identifier: Apache-2.0
#
# Same as native_sim.conf for 64-bit native_sim build.
#

CONFIG_SHELL_TAB_AUTOCOMPLETION=y
CONFIG_SHELL_HISTORY=y
CONFIG_SHELL_HISTORY_BUFFER=256

CONFIG_WIFI_HWSIM=y
CONFIG_WIFI_HWSIM_NUM_RADIOS=2
CONFIG_NET_L2_ETHERNET=y
CONFIG_NET_L2_WIFI_MGMT=y
CONFIG_NET_MGMT_EVENT_INFO=y
CONFIG_NET_IF_MAX_IPV4_COUNT=3
CONFIG_WIFI_NM_WPA_SUPPLICANT=y
CONFIG_WIFI_NM_WPA_SUPPLICANT_AP=y
CONFIG_WIFI_NM_WPA_SUPPLICANT_CRYPTO_NONE=y
CONFIG_WIFI_NM_MAX_MANAGED_INTERFACES=4

# All hwsim radios share a single IP stack, so each radio's address is a
# local address. Disable the "destination is my own address" short-circuit
# so inter-radio data frames (e.g. ping) traverse the simulated medium.
CONFIG_NET_IP_ADDR_CHECK=n
```

## samples/net/wifi/shell/boards/rtl8721f_evb.conf
```kconfig
# Copyright (c) 2026 Realtek Semiconductor Corp.
# SPDX-License-Identifier: Apache-2.0

CONFIG_WIFI_AMEBA=y
CONFIG_ZVFS_POLL_MAX=32
CONFIG_HEAP_MEM_POOL_SIZE=65536

# Required by NET_L2_WIFI_SHELL on Ameba
CONFIG_NEWLIB_LIBC=y

# AP mode DHCP server support
CONFIG_NET_DHCPV4_SERVER=y
CONFIG_NET_DHCPV4_SERVER_ADDR_COUNT=10
CONFIG_NET_MAX_CONN=10
CONFIG_ZVFS_OPEN_MAX=6
CONFIG_NET_DHCPV4_INIT_REBOOT=n
```

## samples/net/wireguard/Kconfig
```kconfig
# Private config options for Zephyr Wireguard demo app

# Copyright (c) 2025 Jukka Rissanen
# SPDX-License-Identifier: Apache-2.0

mainmenu "Wireguard demo application"

config NET_SAMPLE_COMMON_VPN_MY_PRIVATE_KEY
	string "My private key in base64 format"
	default ""
	depends on WIREGUARD
	help
	  The public key will be calculated from the private one.

config NET_SAMPLE_COMMON_VPN_PEER_PUBLIC_KEY
	string "Peer public key in base64 format"
	default ""
	depends on WIREGUARD
	help
	  This specifies the public key of the peer that we are being
	  connected from.

config NET_SAMPLE_COMMON_VPN_PEER_IP_ADDR
	string "Peer IP address to connect to"
	default ""
	depends on WIREGUARD
	help
	  This specifies the IP address of VPN service we are trying to
	  connect to. You can also set the port number also here like
	  this: 192.0.2.2:51821 or [2001:db8::2]:51822
	  if using non standard Wireguard port which is 51820.

config NET_SAMPLE_COMMON_VPN_ALLOWED_PEER_ADDR
	string "Allowed peer IP addresses"
	depends on WIREGUARD
	help
	  What peer IP address is allowed to connect.
	  Format is: ip/masklen
	  Multiple addresses can be given and must be separated by "," or space
	  characters.
	  Example: 192.0.2.0/24,2001:db9::/64

config NET_SAMPLE_COMMON_VPN_MY_ADDR
	string "My addresses for VPN connections"
	depends on WIREGUARD
	help
	  The value depends on your network setup. Can contain multiple
	  network addresses separated by comma.
	  Example: 198.51.100.1/24,2001:db8:100::1/64

config NET_SAMPLE_COMMON_VPN_KEEPALIVE_INTERVAL
	int "Keepalive message period in seconds"
	default 0
	depends on WIREGUARD
	help
	  The value depends on your network setup. If set to 0, keepalive
	  messages are not sent. If value is > 0, then a Wireguard keepalive
	  message is sent periodically. Sensible value is 25 sec.

source "Kconfig.zephyr"
```

## samples/net/wireless/coex/shell/sample.yaml
```yaml
common:
  harness: net
  tags:
    - net
    - bluetooth
    - wifi
    - openthread
    - coex
  depends_on: openthread
sample:
  description: Test Bluetooth, Wi-Fi, and OpenThread coexistence shell functionality
  name: Wireless coexistence shell
tests:
  sample.net.wireless.coex.shell.nxp:
    build_only: true
    harness: bluetooth
    platform_allow:
      - frdm_rw612
      - rd_rw612_bga
      - mimxrt1060_evk@C/mimxrt1062/qspi
    integration_platforms:
      - rd_rw612_bga
    extra_args: >
      board:mimxrt1060_evk@C/mimxrt1062/qspi:SHIELD=nxp_m2_2ll_wifi_bt
      board:frdm_rw612:CONFIG_NXP_MONOLITHIC_WIFI=n
      board:frdm_rw612:CONFIG_NXP_MONOLITHIC_NBU=n
      board:rd_rw612_bga:CONFIG_NXP_MONOLITHIC_WIFI=n
      board:rd_rw612_bga:CONFIG_NXP_MONOLITHIC_NBU=n
```

## samples/net/wpan_serial/sample.yaml
```yaml
sample:
  description: Test wpan_serial sample
  name: wpan_serial
common:
  depends_on: usb_device
  harness: net
  tags:
    - usb
    - ieee802154
  platform_exclude: pinnacle_100_dvk
tests:
  sample.net.wpan.serial:
    filter: dt_chosen_enabled("zephyr,ieee802154")
    platform_exclude:
      - thingy53/nrf5340/cpuapp/ns
      - raytac_mdbt53_db_40/nrf5340/cpuapp/ns
      - raytac_mdbt53_db_40/nrf5340/cpuapp
  sample.net.wpan_serial.frdm_cr20a:
    extra_args: SHIELD=frdm_cr20a
    platform_allow: frdm_k64f
```

## samples/net/wpanusb/Kconfig
```kconfig
# Copyright (c) 2020 PHYTEC Messtechnik GmbH
# SPDX-License-Identifier: Apache-2.0

config USB_DEVICE_PID
	default USB_PID_WPANUSB_SAMPLE

source "Kconfig.zephyr"
```

## samples/net/wpanusb/boards/sam4e_xpro.conf
```kconfig
CONFIG_SPI=y
CONFIG_SPI_0=y
CONFIG_SPI_0_OP_MODES=1
CONFIG_SPI_SAM_PORT_0=y
CONFIG_SPI_SAM4_PORT_0_PIN_CS1_PB14=y
CONFIG_IEEE802154_RF2XX=y
# my_dev_name (defined on overlay not Kconfig)
CONFIG_NET_CONFIG_IEEE802154_DEV_NAME="my_dev_name"
```
