## CMakeLists.txt
```
# Copyright (c) 2026 Espressif Systems (Shanghai) Co., Ltd.
# SPDX-License-Identifier: Apache-2.0

cmake_minimum_required(VERSION 3.28.0)
find_package(Zephyr REQUIRED HINTS $ENV{ZEPHYR_BASE})
project(wifi_ble_provisioning)

target_sources(app PRIVATE
  src/main.c
  src/gatt_svc.c
  src/wifi_prov.c
)
```

## Kconfig
```
# Copyright (c) 2026 Espressif Systems (Shanghai) Co., Ltd.
# SPDX-License-Identifier: Apache-2.0

mainmenu "Wi-Fi provisioning over BLE"

config WIFI_BLE_PROV_KEEP_BLE_AFTER_CONNECT
	bool "Keep BLE advertising after Wi-Fi connects"
	default y
	help
	  Keep BLE advertising after Wi-Fi is connected so the device
	  remains reachable for re-provisioning.

choice WIFI_BLE_PROV_SECURITY
	prompt "BLE security for provisioning writes"
	default WIFI_BLE_PROV_SECURITY_NONE
	help
	  Security level required to write the provisioning
	  characteristics.

config WIFI_BLE_PROV_SECURITY_NONE
	bool "No pairing (plaintext)"
	help
	  Credentials are exchanged in plaintext. Evaluation only.

config WIFI_BLE_PROV_SECURITY_ENCRYPT
	bool "Encrypted link (LESC, no MITM protection)"
	select BT_SMP
	select BT_BONDABLE
	select BT_SMP_ALLOW_UNAUTH_OVERWRITE
	help
	  Writes require an encrypted link. No user interaction is
	  required for pairing.

config WIFI_BLE_PROV_SECURITY_AUTH
	bool "Authenticated pairing (LESC, passkey on console)"
	select BT_SMP
	select BT_BONDABLE
	select BT_SMP_SC_ONLY
	help
	  Writes require authenticated LESC pairing. The device prints
	  a 6-digit passkey on the console that the central must enter.

endchoice

source "Kconfig.zephyr"
```

## prj.conf
```kconfig
# Wi-Fi
CONFIG_WIFI=y
CONFIG_NETWORKING=y
CONFIG_NET_IPV4=y
CONFIG_NET_IPV6=n
CONFIG_NET_DHCPV4=y
CONFIG_NET_MGMT=y
CONFIG_NET_MGMT_EVENT=y
CONFIG_NET_L2_WIFI_MGMT=y

# Wi-Fi credentials library (storage + connect-stored helper)
CONFIG_WIFI_NM=y
CONFIG_WIFI_CREDENTIALS=y
CONFIG_WIFI_CREDENTIALS_BACKEND_SETTINGS=y
CONFIG_WIFI_CREDENTIALS_CONNECT_STORED=y

# BLE peripheral
CONFIG_BT=y
CONFIG_BT_PERIPHERAL=y
CONFIG_BT_DEVICE_NAME="Zephyr Wi-Fi Provisioning"
CONFIG_BT_MAX_CONN=1
CONFIG_BT_MAX_PAIRED=2
CONFIG_BT_GATT_DYNAMIC_DB=y
CONFIG_BT_SETTINGS=y

# Raise ATT MTU so 64-byte PSK writes fit in a single write request.
CONFIG_BT_L2CAP_TX_MTU=128
CONFIG_BT_BUF_ACL_RX_SIZE=132
CONFIG_BT_BUF_ACL_TX_SIZE=132

# Persistence backend
CONFIG_SETTINGS=y
CONFIG_FLASH=y
CONFIG_FLASH_MAP=y
CONFIG_NVS=y
CONFIG_SETTINGS_NVS=y

# Logging
CONFIG_LOG=y
CONFIG_LOG_DEFAULT_LEVEL=3

CONFIG_MAIN_STACK_SIZE=4096
CONFIG_SYSTEM_WORKQUEUE_STACK_SIZE=2048
CONFIG_INIT_STACKS=y
```

## src/main.c
```c
/*
 * Copyright (c) 2026 Espressif Systems (Shanghai) Co., Ltd.
 *
 * SPDX-License-Identifier: Apache-2.0
 */

#include <string.h>

#include <zephyr/bluetooth/bluetooth.h>
#include <zephyr/bluetooth/conn.h>
#include <zephyr/bluetooth/hci.h>
#include <zephyr/kernel.h>
#include <zephyr/logging/log.h>
#include <zephyr/settings/settings.h>
#include <zephyr/sys/atomic.h>

#include "gatt_svc.h"
#include "wifi_prov.h"

LOG_MODULE_REGISTER(wifi_ble_prov, LOG_LEVEL_INF);

#if defined(CONFIG_WIFI_BLE_PROV_SECURITY_AUTH)
#define PROV_SECURITY_ENABLED 1
#define PROV_MIN_SEC          BT_SECURITY_L4
#elif defined(CONFIG_WIFI_BLE_PROV_SECURITY_ENCRYPT)
#define PROV_SECURITY_ENABLED 1
#define PROV_MIN_SEC          BT_SECURITY_L2
#else
#define PROV_SECURITY_ENABLED 0
#endif

#define ADV_RESTART_DELAY_MS 200

static struct wifi_prov_creds pending;
static K_MUTEX_DEFINE(pending_lock);
static struct k_work connect_work;
static struct k_work erase_work;
static struct k_work_delayable adv_restart_work;
static atomic_t adv_stopped_for_provisioning;

static void connected(struct bt_conn *conn, uint8_t err)
{
	if (err) {
		LOG_ERR("connection to %s failed (0x%02x %s)", bt_conn_dst_str(conn), err,
			bt_hci_err_to_str(err));
		return;
	}

	LOG_INF("%s: %s", __func__, bt_conn_dst_str(conn));

#if PROV_SECURITY_ENABLED
	{
		int sec_err = bt_conn_set_security(conn, PROV_MIN_SEC);

		if (sec_err && sec_err != -EBUSY) {
			LOG_WRN("bt_conn_set_security (%d)", sec_err);
		}
	}
#endif
}

static void disconnected(struct bt_conn *conn, uint8_t reason)
{
	LOG_INF("%s: %s (reason 0x%02x %s)", __func__, bt_conn_dst_str(conn), reason,
		bt_hci_err_to_str(reason));

	/* Clear pending staging so partial SSID/PSK from a disconnected
	 * central doesn't mix with the next peer's writes.
	 */
	k_mutex_lock(&pending_lock, K_FOREVER);
	memset(&pending, 0, sizeof(pending));
	pending.security = WIFI_PROV_SECURITY_AUTO;
	k_mutex_unlock(&pending_lock);

	if (atomic_get(&adv_stopped_for_provisioning)) {
		return;
	}

	/* Zephyr stops advertising on connect. Restart it on the work
	 * queue after the host has released the connection resources,
	 * otherwise bt_le_adv_start() can return -ENOMEM.
	 */
	(void)k_work_schedule(&adv_restart_work, K_MSEC(ADV_RESTART_DELAY_MS));
}

#if PROV_SECURITY_ENABLED
static void security_changed(struct bt_conn *conn, bt_security_t level, enum bt_security_err err)
{
	if (err) {
		LOG_ERR("security failed: %s level %u err %d", bt_conn_dst_str(conn), level, err);
	} else {
		LOG_INF("security changed: %s level %u", bt_conn_dst_str(conn), level);
	}
}
#endif

BT_CONN_CB_DEFINE(conn_callbacks) = {
	.connected = connected,
	.disconnected = disconnected,
#if PROV_SECURITY_ENABLED
	.security_changed = security_changed,
#endif
};

#if defined(CONFIG_WIFI_BLE_PROV_SECURITY_AUTH)
static void auth_passkey_display(struct bt_conn *conn, unsigned int passkey)
{
	LOG_INF("passkey for %s: %06u", bt_conn_dst_str(conn), passkey);
}

static void auth_cancel(struct bt_conn *conn)
{
	LOG_WRN("pairing cancelled: %s", bt_conn_dst_str(conn));
}

static void pairing_complete(struct bt_conn *conn, bool bonded)
{
	LOG_INF("paired with %s (bonded=%d)", bt_conn_dst_str(conn), bonded);
}

static void pairing_failed(struct bt_conn *conn, enum bt_security_err reason)
{
	LOG_ERR("pairing failed with %s (reason %u)", bt_conn_dst_str(conn), reason);
}

static const struct bt_conn_auth_cb auth_cb = {
	.passkey_display = auth_passkey_display,
	.cancel = auth_cancel,
};

static struct bt_conn_auth_info_cb auth_info_cb = {
	.pairing_complete = pairing_complete,
	.pairing_failed = pairing_failed,
};
#endif /* CONFIG_WIFI_BLE_PROV_SECURITY_AUTH */

static void try_connect(void)
{
	struct wifi_prov_creds snapshot;
	int err;

	k_mutex_lock(&pending_lock, K_FOREVER);
	snapshot = pending;
	k_mutex_unlock(&pending_lock);

	if (!wifi_prov_creds_valid(&snapshot)) {
		LOG_WRN("SSID missing; cannot connect");
		gatt_svc_set_status(GATT_SVC_STATUS_FAILED);
		return;
	}

	err = wifi_prov_creds_save(&snapshot);
	if (err) {
		LOG_ERR("save creds failed (%d)", err);
		gatt_svc_set_status(GATT_SVC_STATUS_FAILED);
		return;
	}

	gatt_svc_set_status(GATT_SVC_STATUS_CONNECTING);

	err = wifi_prov_connect_stored();
	if (err) {
		LOG_ERR("connect dispatch failed (%d)", err);
		gatt_svc_set_status(GATT_SVC_STATUS_FAILED);
	}
}

static void connect_work_handler(struct k_work *w)
{
	ARG_UNUSED(w);
	try_connect();
}

static void erase_work_handler(struct k_work *w)
{
	int err;

	ARG_UNUSED(w);

	wifi_prov_creds_erase();

	k_mutex_lock(&pending_lock, K_FOREVER);
	memset(&pending, 0, sizeof(pending));
	pending.security = WIFI_PROV_SECURITY_AUTO;
	k_mutex_unlock(&pending_lock);

	err = bt_unpair(BT_ID_DEFAULT, BT_ADDR_LE_ANY);
	if (err && err != -ENOENT) {
		LOG_WRN("bt_unpair (%d)", err);
	}

	/* If advertising was stopped after a successful Wi-Fi connect
	 * (KEEP_BLE_AFTER_CONNECT=n), re-enable it so the device stays
	 * reachable for re-provisioning.
	 */
	if (atomic_cas(&adv_stopped_for_provisioning, 1, 0)) {
		err = gatt_svc_adv_start();
		if (err) {
			LOG_ERR("adv restart failed (%d)", err);
		}
	}

	LOG_INF("credentials erased");

	gatt_svc_set_status(GATT_SVC_STATUS_IDLE);
}

static void adv_restart_work_handler(struct k_work *w)
{
	ARG_UNUSED(w);
	(void)gatt_svc_adv_start();
}

static void on_ssid_written(const uint8_t *data, size_t len)
{
	if (len == 0 || len > WIFI_PROV_SSID_MAX_LEN) {
		LOG_WRN("SSID length out of range (%zu)", len);
		return;
	}

	k_mutex_lock(&pending_lock, K_FOREVER);
	memset(pending.ssid, 0, sizeof(pending.ssid));
	memcpy(pending.ssid, data, len);
	k_mutex_unlock(&pending_lock);

	LOG_INF("SSID set (%zu B)", len);
}

static void on_password_written(const uint8_t *data, size_t len)
{
	if (len > WIFI_PROV_PSK_MAX_LEN) {
		LOG_WRN("PSK length out of range (%zu)", len);
		return;
	}

	k_mutex_lock(&pending_lock, K_FOREVER);
	memset(pending.psk, 0, sizeof(pending.psk));
	if (len > 0) {
		memcpy(pending.psk, data, len);
	}
	k_mutex_unlock(&pending_lock);

	LOG_INF("PSK set (%zu B)", len);
}

static void on_security_written(uint8_t security)
{
	k_mutex_lock(&pending_lock, K_FOREVER);
	pending.security = security;
	k_mutex_unlock(&pending_lock);

	LOG_INF("security set to %u", security);
}

static void on_control_written(uint8_t cmd)
{
	switch (cmd) {
	case GATT_SVC_CTRL_CONNECT:
		k_work_submit(&connect_work);
		break;
	case GATT_SVC_CTRL_ERASE:
		k_work_submit(&erase_work);
		break;
	default:
		LOG_WRN("unknown control command 0x%02x", cmd);
		break;
	}
}

static void wifi_result(bool connected_ok)
{
	gatt_svc_set_status(connected_ok ? GATT_SVC_STATUS_CONNECTED : GATT_SVC_STATUS_FAILED);

	if (connected_ok && !IS_ENABLED(CONFIG_WIFI_BLE_PROV_KEEP_BLE_AFTER_CONNECT)) {
		atomic_set(&adv_stopped_for_provisioning, 1);
		(void)k_work_cancel_delayable(&adv_restart_work);
		(void)gatt_svc_adv_stop();
	}
}

int main(void)
{
	const struct gatt_svc_callbacks cbs = {
		.ssid_written = on_ssid_written,
		.password_written = on_password_written,
		.security_written = on_security_written,
		.control_written = on_control_written,
	};
	int err;

	LOG_INF("Wi-Fi BLE provisioning starting");

	pending.security = WIFI_PROV_SECURITY_AUTO;

	k_work_init(&connect_work, connect_work_handler);
	k_work_init(&erase_work, erase_work_handler);
	k_work_init_delayable(&adv_restart_work, adv_restart_work_handler);

	err = wifi_prov_init(wifi_result);
	if (err) {
		LOG_ERR("wifi_prov_init (%d)", err);
		return err;
	}

	err = bt_enable(NULL);
	if (err) {
		LOG_ERR("bt_enable (%d)", err);
		return err;
	}

	if (IS_ENABLED(CONFIG_SETTINGS)) {
		(void)settings_load();
	}

#if defined(CONFIG_WIFI_BLE_PROV_SECURITY_AUTH)
	err = bt_conn_auth_cb_register(&auth_cb);
	if (err) {
		LOG_ERR("bt_conn_auth_cb_register (%d)", err);
		return err;
	}
	err = bt_conn_auth_info_cb_register(&auth_info_cb);
	if (err) {
		LOG_ERR("bt_conn_auth_info_cb_register (%d)", err);
		return err;
	}

	LOG_INF("security: authenticated pairing (passkey)");
#elif defined(CONFIG_WIFI_BLE_PROV_SECURITY_ENCRYPT)
	LOG_INF("security: encrypted link");
#else
	LOG_INF("security: none (plaintext)");
#endif

	gatt_svc_init(&cbs);

	err = gatt_svc_adv_start();
	if (err) {
		LOG_ERR("initial advertising failed (%d)", err);
	}

	if (wifi_prov_has_stored_creds()) {
		LOG_INF("stored credentials found, connecting");
		gatt_svc_set_status(GATT_SVC_STATUS_CONNECTING);

		err = wifi_prov_connect_stored();
		if (err) {
			LOG_ERR("auto-connect failed (%d)", err);
			gatt_svc_set_status(GATT_SVC_STATUS_FAILED);
		}
	} else {
		LOG_INF("no stored credentials; waiting for provisioning over BLE");
		gatt_svc_set_status(GATT_SVC_STATUS_IDLE);
	}

	return 0;
}
```

## src/gatt_svc.c
```c
/*
 * Copyright (c) 2026 Espressif Systems (Shanghai) Co., Ltd.
 *
 * SPDX-License-Identifier: Apache-2.0
 */

#include <zephyr/kernel.h>
#include <zephyr/bluetooth/bluetooth.h>
#include <zephyr/bluetooth/conn.h>
#include <zephyr/bluetooth/gatt.h>
#include <zephyr/bluetooth/uuid.h>
#include <zephyr/logging/log.h>
#include <zephyr/net/wifi.h>

#include "gatt_svc.h"
#include "wifi_prov.h"

LOG_MODULE_REGISTER(gatt_svc, LOG_LEVEL_INF);

/*
 * Custom 128-bit service: 8b84xxxx-f6fa-4e33-9a0c-e14d9f35f201
 *   0001 -> service
 *   0002 -> SSID (write)
 *   0003 -> Password (write)
 *   0004 -> Security type (write, 1 byte: see enum wifi_security_type)
 *   0005 -> Control (write, 1 byte: 0x01 connect, 0x02 erase)
 *   0006 -> Status (read, notify)
 */
#define PROV_UUID_16(short16)                                                                      \
	BT_UUID_128_ENCODE(0x8b840000 | (short16), 0xf6fa, 0x4e33, 0x9a0c, 0xe14d9f35f201)

#if defined(CONFIG_WIFI_BLE_PROV_SECURITY_AUTH)
#define PROV_WRITE_PERM BT_GATT_PERM_WRITE_AUTHEN
#define PROV_READ_PERM  BT_GATT_PERM_READ_AUTHEN
#define PROV_CCC_PERM   (BT_GATT_PERM_READ_AUTHEN | BT_GATT_PERM_WRITE_AUTHEN)
#elif defined(CONFIG_WIFI_BLE_PROV_SECURITY_ENCRYPT)
#define PROV_WRITE_PERM BT_GATT_PERM_WRITE_ENCRYPT
#define PROV_READ_PERM  BT_GATT_PERM_READ_ENCRYPT
#define PROV_CCC_PERM   (BT_GATT_PERM_READ_ENCRYPT | BT_GATT_PERM_WRITE_ENCRYPT)
#else /* CONFIG_WIFI_BLE_PROV_SECURITY_NONE */
#define PROV_WRITE_PERM BT_GATT_PERM_WRITE
#define PROV_READ_PERM  BT_GATT_PERM_READ
#define PROV_CCC_PERM   (BT_GATT_PERM_READ | BT_GATT_PERM_WRITE)
#endif

static const struct bt_uuid_128 svc_uuid = BT_UUID_INIT_128(PROV_UUID_16(0x0001));
static const struct bt_uuid_128 ssid_uuid = BT_UUID_INIT_128(PROV_UUID_16(0x0002));
static const struct bt_uuid_128 pass_uuid = BT_UUID_INIT_128(PROV_UUID_16(0x0003));
static const struct bt_uuid_128 sec_uuid = BT_UUID_INIT_128(PROV_UUID_16(0x0004));
static const struct bt_uuid_128 ctrl_uuid = BT_UUID_INIT_128(PROV_UUID_16(0x0005));
static const struct bt_uuid_128 stat_uuid = BT_UUID_INIT_128(PROV_UUID_16(0x0006));

static struct gatt_svc_callbacks user_cb;
static uint8_t current_status = GATT_SVC_STATUS_IDLE;

static const struct bt_data ad[] = {
	BT_DATA_BYTES(BT_DATA_FLAGS, (BT_LE_AD_GENERAL | BT_LE_AD_NO_BREDR)),
	BT_DATA(BT_DATA_NAME_COMPLETE, CONFIG_BT_DEVICE_NAME, sizeof(CONFIG_BT_DEVICE_NAME) - 1),
};

static ssize_t write_ssid(struct bt_conn *conn, const struct bt_gatt_attr *attr, const void *buf,
			  uint16_t len, uint16_t offset, uint8_t flags)
{
	ARG_UNUSED(conn);
	ARG_UNUSED(attr);
	ARG_UNUSED(flags);

	if (offset != 0) {
		return BT_GATT_ERR(BT_ATT_ERR_INVALID_OFFSET);
	}

	if (len == 0 || len > WIFI_PROV_SSID_MAX_LEN) {
		return BT_GATT_ERR(BT_ATT_ERR_INVALID_ATTRIBUTE_LEN);
	}

	if (user_cb.ssid_written) {
		user_cb.ssid_written(buf, len);
	}

	return len;
}

static ssize_t write_password(struct bt_conn *conn, const struct bt_gatt_attr *attr,
			      const void *buf, uint16_t len, uint16_t offset, uint8_t flags)
{
	ARG_UNUSED(conn);
	ARG_UNUSED(attr);
	ARG_UNUSED(flags);

	if (offset != 0) {
		return BT_GATT_ERR(BT_ATT_ERR_INVALID_OFFSET);
	}

	if (len > WIFI_PROV_PSK_MAX_LEN) {
		return BT_GATT_ERR(BT_ATT_ERR_INVALID_ATTRIBUTE_LEN);
	}

	if (user_cb.password_written) {
		user_cb.password_written(buf, len);
	}

	return len;
}

static ssize_t write_security(struct bt_conn *conn, const struct bt_gatt_attr *attr,
			      const void *buf, uint16_t len, uint16_t offset, uint8_t flags)
{
	uint8_t sec;

	ARG_UNUSED(conn);
	ARG_UNUSED(attr);
	ARG_UNUSED(flags);

	if (offset != 0 || len != 1) {
		return BT_GATT_ERR(BT_ATT_ERR_INVALID_ATTRIBUTE_LEN);
	}

	sec = ((const uint8_t *)buf)[0];

	if (sec != WIFI_PROV_SECURITY_AUTO && sec > WIFI_SECURITY_TYPE_MAX) {
		return BT_GATT_ERR(BT_ATT_ERR_VALUE_NOT_ALLOWED);
	}

	if (user_cb.security_written) {
		user_cb.security_written(sec);
	}

	return len;
}

static ssize_t write_control(struct bt_conn *conn, const struct bt_gatt_attr *attr, const void *buf,
			     uint16_t len, uint16_t offset, uint8_t flags)
{
	ARG_UNUSED(conn);
	ARG_UNUSED(attr);
	ARG_UNUSED(flags);

	if (offset != 0 || len != 1) {
		return BT_GATT_ERR(BT_ATT_ERR_INVALID_ATTRIBUTE_LEN);
	}

	if (user_cb.control_written) {
		user_cb.control_written(((const uint8_t *)buf)[0]);
	}

	return len;
}

static ssize_t read_status(struct bt_conn *conn, const struct bt_gatt_attr *attr, void *buf,
			   uint16_t len, uint16_t offset)
{
	return bt_gatt_attr_read(conn, attr, buf, len, offset, &current_status,
				 sizeof(current_status));
}

/* clang-format off */
BT_GATT_SERVICE_DEFINE(prov_svc,
	BT_GATT_PRIMARY_SERVICE(&svc_uuid),
	BT_GATT_CHARACTERISTIC(&ssid_uuid.uuid,
			       BT_GATT_CHRC_WRITE,
			       PROV_WRITE_PERM,
			       NULL, write_ssid, NULL),
	BT_GATT_CHARACTERISTIC(&pass_uuid.uuid,
			       BT_GATT_CHRC_WRITE,
			       PROV_WRITE_PERM,
			       NULL, write_password, NULL),
	BT_GATT_CHARACTERISTIC(&sec_uuid.uuid,
			       BT_GATT_CHRC_WRITE,
			       PROV_WRITE_PERM,
			       NULL, write_security, NULL),
	BT_GATT_CHARACTERISTIC(&ctrl_uuid.uuid,
			       BT_GATT_CHRC_WRITE,
			       PROV_WRITE_PERM,
			       NULL, write_control, NULL),
	BT_GATT_CHARACTERISTIC(&stat_uuid.uuid,
			       BT_GATT_CHRC_READ | BT_GATT_CHRC_NOTIFY,
			       PROV_READ_PERM,
			       read_status, NULL, &current_status),
	BT_GATT_CCC(NULL, PROV_CCC_PERM),
);
/* clang-format on */

int gatt_svc_init(const struct gatt_svc_callbacks *cb)
{
	if (cb) {
		user_cb = *cb;
	}

	return 0;
}

void gatt_svc_set_status(enum gatt_svc_status status)
{
	current_status = (uint8_t)status;

	LOG_INF("status -> %u", current_status);

	(void)bt_gatt_notify_uuid(NULL, &stat_uuid.uuid, prov_svc.attrs, &current_status,
				  sizeof(current_status));
}

int gatt_svc_adv_start(void)
{
	int err = bt_le_adv_start(BT_LE_ADV_CONN_FAST_1, ad, ARRAY_SIZE(ad), NULL, 0);

	if (err == -EALREADY) {
		return 0;
	}

	if (err) {
		LOG_ERROR("adv start failed (%d)", err);
		return err;
	}

	LOG_INF("advertising as '%s'", CONFIG_BT_DEVICE_NAME);

	return 0;
}

int gatt_svc_adv_stop(void)
{
	int err = bt_le_adv_stop();

	if (err && err != -EALREADY) {
		LOG_ERROR("adv stop failed (%d)", err);
		return err;
	}

	return 0;
}
```

## src/gatt_svc.h
```c
/*
 * Copyright (c) 2026 Espressif Systems (Shanghai) Co., Ltd.
 *
 * SPDX-License-Identifier: Apache-2.0
 */

#ifndef GATT_SVC_H_
#define GATT_SVC_H_

#include <stddef.h>
#include <stdint.h>

#define GATT_SVC_CTRL_CONNECT 0x01
#define GATT_SVC_CTRL_ERASE   0x02

enum gatt_svc_status {
	GATT_SVC_STATUS_IDLE = 0,
	GATT_SVC_STATUS_PROVISIONED,
	GATT_SVC_STATUS_CONNECTING,
	GATT_SVC_STATUS_CONNECTED,
	GATT_SVC_STATUS_FAILED,
};

struct gatt_svc_callbacks {
	void (*ssid_written)(const uint8_t *data, size_t len);
	void (*password_written)(const uint8_t *data, size_t len);
	void (*security_written)(uint8_t security);
	void (*control_written)(uint8_t cmd);
};

int gatt_svc_init(const struct gatt_svc_callbacks *cb);

void gatt_svc_set_status(enum gatt_svc_status status);

int gatt_svc_adv_start(void);
int gatt_svc_adv_stop(void);

#endif
```

## src/wifi_prov.c
```c
/*
 * Copyright (c) 2026 Espressif Systems (Shanghai) Co., Ltd.
 *
 * SPDX-License-Identifier: Apache-2.0
 */

#include <string.h>

#include <zephyr/kernel.h>
#include <zephyr/logging/log.h>
#include <zephyr/net/net_if.h>
#include <zephyr/net/net_mgmt.h>
#include <zephyr/net/wifi.h>
#include <zephyr/net/wifi_credentials.h>
#include <zephyr/net/wifi_mgmt.h>
#include <zephyr/sys/atomic.h>

#include "wifi_prov.h"

LOG_MODULE_REGISTER(wifi_prov, LOG_LEVEL_INF);

#define WIFI_MGMT_EVENTS (NET_EVENT_WIFI_CONNECT_RESULT | NET_EVENT_WIFI_DISCONNECT_RESULT)

static struct net_mgmt_event_callback mgmt_cb;
static wifi_prov_result_cb result_cb;
static atomic_t connect_in_progress;

static enum wifi_security_type map_security(uint8_t s, size_t psk_len)
{
	if (s == WIFI_PROV_SECURITY_AUTO) {
		return psk_len ? WIFI_SECURITY_TYPE_PSK : WIFI_SECURITY_TYPE_NONE;
	}

	return (enum wifi_security_type)s;
}

static void wifi_event(struct net_mgmt_event_callback *cb, uint64_t mgmt_event,
		       struct net_if *iface)
{
	const struct wifi_status *st = (const struct wifi_status *)cb->info;

	ARG_UNUSED(iface);

	switch (mgmt_event) {
	case NET_EVENT_WIFI_CONNECT_RESULT:
		if (!atomic_cas(&connect_in_progress, 1, 0)) {
			break;
		}

		if (st && st->status == 0) {
			LOG_INF("Wi-Fi connected");
			if (result_cb) {
				result_cb(true);
			}
		} else {
			LOG_ERR("Wi-Fi connect failed (%d)", st ? st->status : -1);
			if (result_cb) {
				result_cb(false);
			}
		}
		break;
	case NET_EVENT_WIFI_DISCONNECT_RESULT:
		LOG_INF("Wi-Fi disconnected");
		break;
	default:
		break;
	}
}

int wifi_prov_init(wifi_prov_result_cb cb)
{
	result_cb = cb;

	net_mgmt_init_event_callback(&mgmt_cb, wifi_event, WIFI_MGMT_EVENTS);
	net_mgmt_add_event_callback(&mgmt_cb);

	return 0;
}

bool wifi_prov_creds_valid(const struct wifi_prov_creds *creds)
{
	return creds && creds->ssid[0] != '\0';
}

bool wifi_prov_has_stored_creds(void)
{
	return !wifi_credentials_is_empty();
}

int wifi_prov_creds_save(const struct wifi_prov_creds *creds)
{
	enum wifi_security_type type;
	size_t ssid_len;
	size_t psk_len;

	if (!wifi_prov_creds_valid(creds)) {
		return -EINVAL;
	}

	ssid_len = strlen(creds->ssid);
	psk_len = strlen(creds->psk);
	type = map_security(creds->security, psk_len);

	if (type == WIFI_SECURITY_TYPE_NONE && psk_len > 0) {
		LOG_WRN("PSK provided but security is open; dropping PSK");
		psk_len = 0;
	} else if (type != WIFI_SECURITY_TYPE_NONE && psk_len == 0) {
		LOG_ERR("security=%u requires a non-empty PSK", type);
		return -EINVAL;
	}

	/* Single-slot provisioning: clear previous entries before storing a new one. */
	(void)wifi_credentials_delete_all();

	return wifi_credentials_set_personal(creds->ssid, ssid_len, type, NULL, 0, creds->psk,
					     psk_len, 0, 0, 0);
}

int wifi_prov_creds_erase(void)
{
	return wifi_credentials_delete_all();
}

int wifi_prov_connect_stored(void)
{
	struct net_if *iface = net_if_get_wifi_sta();
	int err;

	if (!iface) {
		LOG_ERR("no Wi-Fi STA interface");
		return -ENODEV;
	}

	if (wifi_credentials_is_empty()) {
		return -ENOENT;
	}

	LOG_INF("connecting using stored credentials");

	atomic_set(&connect_in_progress, 1);

	err = net_mgmt(NET_REQUEST_WIFI_CONNECT_STORED, iface, NULL, 0);
	if (err) {
		atomic_set(&connect_in_progress, 0);
	}

	return err;
}
```

## src/wifi_prov.h
```c
/*
 * Copyright (c) 2026 Espressif Systems (Shanghai) Co., Ltd.
 *
 * SPDX-License-Identifier: Apache-2.0
 */

#ifndef WIFI_PROV_H_
#define WIFI_PROV_H_

#include <stdbool.h>
#include <stddef.h>
#include <stdint.h>

#define WIFI_PROV_SSID_MAX_LEN 32
#define WIFI_PROV_PSK_MAX_LEN  64

/* Sentinel value for an unset security type: falls back to auto-detect
 * (open if PSK empty, WPA2-PSK otherwise).
 */
#define WIFI_PROV_SECURITY_AUTO 0xFF

struct wifi_prov_creds {
	char ssid[WIFI_PROV_SSID_MAX_LEN + 1];
	char psk[WIFI_PROV_PSK_MAX_LEN + 1];
	uint8_t security;
};

typedef void (*wifi_prov_result_cb)(bool connected);

int wifi_prov_init(wifi_prov_result_cb cb);

bool wifi_prov_creds_valid(const struct wifi_prov_creds *creds);
bool wifi_prov_has_stored_creds(void);

int wifi_prov_creds_save(const struct wifi_prov_creds *creds);
int wifi_prov_creds_erase(void);

int wifi_prov_connect_stored(void);

#endif
```
