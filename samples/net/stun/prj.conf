## CMakeLists.txt
```
# SPDX-FileCopyrightText: Copyright The Zephyr Project Contributors
# SPDX-FileCopyrightText: Copyright (c) 2026 Kirill Shypachov
# SPDX-License-Identifier: Apache-2.0

cmake_minimum_required(VERSION 3.28.0)
find_package(Zephyr REQUIRED HINTS $ENV{ZEPHYR_BASE})
project(stun_client)

target_sources(app PRIVATE src/main.c)

include(${ZEPHYR_BASE}/samples/net/common/common.cmake)
```

## Kconfig
```
# SPDX-FileCopyrightText: Copyright The Zephyr Project Contributors
# SPDX-FileCopyrightText: Copyright (c) 2026 Kirill Shypachov
# SPDX-License-Identifier: Apache-2.0

config NET_SAMPLE_STUN_SERVER
	string "STUN server"
	default "stun.cloudflare.com"
	help
	  Host name or literal address of the STUN server the sample asks
	  for the public address of the device. Any STUN server will do: a
	  public one, or one that runs in the local network.

config NET_SAMPLE_STUN_SERVER_PORT
	int "STUN server port"
	default 3478
	range 1 65535

config NET_SAMPLE_STUN_TIMEOUT_MS
	int "Longest time to wait for the answer, in milliseconds"
	default 5000
	range 1 39500
	help
	  The request is sent again 0.5, 1.5 and 3.5 seconds after the first
	  time, and so on for 39.5 seconds (RFC 8489 section 6.2.1). The
	  default leaves time for four transmissions.

source "Kconfig.zephyr"
```

## prj.conf
```kconfig
# SPDX-FileCopyrightText: Copyright The Zephyr Project Contributors
# SPDX-FileCopyrightText: Copyright (c) 2026 Kirill Shypachov
# SPDX-License-Identifier: Apache-2.0

# Networking
CONFIG_NETWORKING=y
CONFIG_NET_IPV4=y
CONFIG_NET_IPV6=y
CONFIG_NET_UDP=y
CONFIG_NET_SOCKETS=y

# The address of the device and its DNS servers come from DHCP, and the sample
# waits until the network is up.
CONFIG_NET_CONFIG_SETTINGS=y
CONFIG_NET_DHCPV4=y
CONFIG_NET_CONNECTION_MANAGER=y
CONFIG_DNS_RESOLVER=y

# STUN: the client, and the "net stun" shell commands to ask other servers
CONFIG_STUN=y
CONFIG_STUN_CLIENT=y
CONFIG_NET_SHELL=y
CONFIG_STUN_SHELL=y

# A query takes some 2.5 KB of the stack of the thread that makes it.
CONFIG_MAIN_STACK_SIZE=4096

CONFIG_LOG=y
CONFIG_NET_LOG=y
```

## overlay-nsos.conf
```kconfig
# SPDX-FileCopyrightText: Copyright The Zephyr Project Contributors
# SPDX-FileCopyrightText: Copyright (c) 2026 Kirill Shypachov
# SPDX-License-Identifier: Apache-2.0

# native_sim with the sockets of the host: no network interface to set up, the
# sample talks through the network connection the host has.
CONFIG_ETH_NATIVE_TAP=n
CONFIG_NET_DRIVERS=y
CONFIG_NET_SOCKETS_OFFLOAD=y
CONFIG_NET_NATIVE_OFFLOADED_SOCKETS=y

# The host has the address and resolves the names.
CONFIG_NET_DHCPV4=n
CONFIG_NET_IPV6_DAD=n
```

## src/main.c
```c
/*
 * SPDX-FileCopyrightText: Copyright The Zephyr Project Contributors
 * SPDX-FileCopyrightText: Copyright (c) 2026 Kirill Shypachov
 * SPDX-License-Identifier: Apache-2.0
 */

#include <zephyr/logging/log.h>
LOG_MODULE_REGISTER(net_stun_sample, LOG_LEVEL_INF);

#include <errno.h>

#include <zephyr/kernel.h>
#include <zephyr/net/net_ip.h>
#include <zephyr/net/stun_client.h>

#include "net_sample_common.h"

int main(void)
{
	char text[NET_IPV6_ADDR_LEN];
	struct net_sockaddr mapped;
	const void *addr;
	int rc;

	wait_for_network();

	LOG_INF("Asking %s port %d", CONFIG_NET_SAMPLE_STUN_SERVER,
		CONFIG_NET_SAMPLE_STUN_SERVER_PORT);

	rc = stun_client_simple(CONFIG_NET_SAMPLE_STUN_SERVER, CONFIG_NET_SAMPLE_STUN_SERVER_PORT,
				CONFIG_NET_SAMPLE_STUN_TIMEOUT_MS, &mapped);
	switch (rc) {
	case 0:
		break;
	case -EHOSTUNREACH:
		LOG_ERR("Cannot resolve the name of the server");
		return 0;
	case -ETIMEDOUT:
		LOG_ERR("No answer from the server");
		return 0;
	default:
		LOG_ERR("STUN query failed (%d)", rc);
		return 0;
	}

	addr = &net_sin(&mapped)->sin_addr;
#if defined(CONFIG_NET_IPV6)
	if (mapped.sa_family == NET_AF_INET6) {
		addr = &net_sin6(&mapped)->sin6_addr;
	}
#endif
	LOG_INF("Public address: %s", net_addr_ntop(mapped.sa_family, addr, text, sizeof(text)));

	return 0;
}
```
