## samples/net/sockets/echo_server/boards/atsamr21_xpro.conf
```kconfig
#
# Copyright (c) 2020-2021, Gerson Fernando Budke
# Copyright (c) 2019, Benjamin Valentin
#
# SPDX-License-Identifier: Apache-2.0
#

# Reduced buffers to fit into SAMR21 SoC
CONFIG_CPP=n

CONFIG_NET_PKT_RX_COUNT=6
CONFIG_NET_PKT_TX_COUNT=6
CONFIG_NET_BUF_RX_COUNT=6
CONFIG_NET_BUF_TX_COUNT=6
CONFIG_NET_MAX_CONTEXTS=4
CONFIG_NET_MAX_CONN=1
CONFIG_NET_MAX_ROUTES=1
CONFIG_NET_MAX_NEXTHOPS=1

CONFIG_SHELL_STACK_SIZE=768
CONFIG_SHELL_CMD_BUFF_SIZE=64
CONFIG_SHELL_ARGC_MAX=6
CONFIG_SHELL_HISTORY_BUFFER=64
```

## samples/net/sockets/echo_server/boards/frdm_mcxw71.conf
```kconfig
CONFIG_COUNTER=y

CONFIG_OPENTHREAD_MAX_IP_ADDR_PER_CHILD=4
CONFIG_OPENTHREAD_MAX_CHILDREN=30
```

## samples/net/sockets/echo_server/boards/intel_socfpga_agilex5_socdk.conf
```kconfig
# Copyright (c) 2024, Intel Corporation.
# SPDX-License-Identifier: Apache-2.0

CONFIG_MDIO=y
CONFIG_NET_L2_ETHERNET=y

CONFIG_NET_PKT_RX_COUNT=64
CONFIG_NET_PKT_TX_COUNT=64
CONFIG_NET_BUF_RX_COUNT=1024
CONFIG_NET_BUF_TX_COUNT=512
```
