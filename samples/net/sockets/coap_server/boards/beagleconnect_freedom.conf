## samples/net/sockets/coap_server/boards/beagleconnect_freedom.conf
```kconfig
CONFIG_IEEE802154=y
CONFIG_IEEE802154_CC13XX_CC26XX_SUB_GHZ=y
CONFIG_NET_IPV4=n
CONFIG_NET_IPV4_MAPPING_TO_IPV6=n
CONFIG_NET_IPV6=y
CONFIG_NET_L2_IEEE802154=y
CONFIG_NET_L2_IEEE802154_SHELL=y
CONFIG_NET_CONFIG_MY_IPV4_ADDR=""
CONFIG_NET_CONFIG_IEEE802154_RADIO_TX_POWER=20
# Uncomment for 868 MHz
#CONFIG_NET_CONFIG_IEEE802154_CHANNEL=0
# Uncomment for 906 MHz:
CONFIG_NET_CONFIG_IEEE802154_CHANNEL=1

# Memory considerations
CONFIG_MAIN_STACK_SIZE=8192
CONFIG_SYSTEM_WORKQUEUE_STACK_SIZE=8192
CONFIG_NET_RX_STACK_SIZE=2048
CONFIG_NET_TX_STACK_SIZE=2048
CONFIG_NET_PKT_RX_COUNT=64
CONFIG_NET_PKT_TX_COUNT=64
CONFIG_NET_BUF_RX_COUNT=160
CONFIG_NET_BUF_TX_COUNT=160
CONFIG_NET_BUF_DATA_SIZE=128

# Logging / Debugging
CONFIG_NET_LOG=y
CONFIG_NET_STATISTICS=y
CONFIG_NET_PKT_LOG_LEVEL_INF=y
CONFIG_NET_BUF_LOG_LEVEL_INF=y
CONFIG_NET_ICMPV6_LOG_LEVEL_INF=y
CONFIG_NET_DEBUG_NET_PKT_ALLOC=y
```

## samples/net/sockets/coap_server/boards/native_posix.conf
```kconfig
CONFIG_NET_L2_ETHERNET=y
CONFIG_NATIVE_POSIX_SLOWDOWN_TO_REAL_TIME=y
CONFIG_NATIVE_UART_0_ON_STDINOUT=y
```

## samples/net/sockets/coap_server/boards/native_sim.conf
```kconfig
CONFIG_NET_L2_ETHERNET=y
CONFIG_NATIVE_SIM_SLOWDOWN_TO_REAL_TIME=y
CONFIG_UART_NATIVE_PTY_0_ON_STDINOUT=y
CONFIG_PICOLIBC=y
```

## samples/net/sockets/coap_server/sample.yaml
```yaml
common:
  harness: net
  tags:
    - net
    - socket
  filter: CONFIG_FULL_LIBC_SUPPORTED and not CONFIG_NATIVE_LIBC
sample:
  description: BSD Sockets API CoAP server example
  name: socket_coap_server
tests:
  sample.net.sockets.coap_server:
    platform_allow:
      - native_sim
      - qemu_x86
  sample.net.sockets.coap_server.wifi.nrf70dk:
    extra_args:
      - SNIPPET=wifi-ipv4
      - CONFIG_BUILD_ONLY_NO_BLOBS=y
    platform_allow:
      - nrf7002dk/nrf5340/cpuapp
```

## samples/net/sockets/coap_upload/Kconfig
```kconfig
# Copyright (c) 2025 Nordic Semiconductor ASA
# SPDX-License-Identifier: Apache-2.0

mainmenu "CoAP Upload Sample Application"

config NET_SAMPLE_COAP_SERVER_PORT
	int "CoAP server port"
	default 5683
	help
	  CoAP server port that the application should send requests to.

source "Kconfig.zephyr"
```

## samples/net/sockets/dumb_http_server/sample.yaml
```yaml
sample:
  description: BSD Sockets API dumb HTTP server example
  name: socket_dumb_http_server
common:
  filter: CONFIG_FULL_LIBC_SUPPORTED and not CONFIG_NATIVE_LIBC
  harness: net
  min_ram: 32
  min_flash: 96
  tags:
    - net
    - socket
  platform_exclude: intel_adsp/cavs25
tests:
  sample.net.sockets.dumb_http_server:
    extra_configs:
      - CONFIG_POSIX_API=y
```

## samples/net/sockets/dumb_http_server_mt/Kconfig
```kconfig
# Private config options for this sample app

# Copyright (c) 2019 Intel Corporation
# SPDX-License-Identifier: Apache-2.0

mainmenu "Networking dumb-http-server-mt sample application"

config NET_SAMPLE_NUM_HANDLERS
	int "How many connections to serve at the same time"
	default 2
	help
	  Each connection is served by a thread which needs
	  memory. Only increase the value here if really needed.

config NET_SAMPLE_SERVE_LARGE_FILE
	bool "Send large file to peer when queried"
	help
	  If set, then send 100KB file to peer. Default is to send
	  a 2KB file to peer.

source "Kconfig.zephyr"
```

## samples/net/sockets/dumb_http_server_mt/sample.yaml
```yaml
sample:
  description: BSD Sockets API multithreaded dumb HTTP server example
  name: socket_dumb_http_server_mt
common:
  harness: net
  depends_on: netif
  min_ram: 128
  min_flash: 128
  tags:
    - net
    - socket
    - http
tests:
  sample.net.sockets.dumb_http_server_mt:
    extra_configs:
      - CONFIG_POSIX_API=y
    platform_exclude: esp32s2_saola
```

## samples/net/sockets/echo/Kconfig
```kconfig
#  Copyright (c) 2024 Steve Boylan <stephen.boylan@beechwoods.com>
#  SPDX-License-Identifier: Apache-2.0

mainmenu "Sample app Configuration"

if WIFI
config NET_SAMPLE_WIFI_SSID
	string "WIFI SSID - Network name"
	default "my_network"

config NET_SAMPLE_WIFI_PSK
	string "WIFI PSK - Network password key"
	default "secret_passwd"
endif

source "Kconfig.zephyr"
```

## samples/net/sockets/echo/boards/rpi_pico_rp2040_w.conf
```kconfig
CONFIG_EARLY_CONSOLE=y

CONFIG_MAIN_STACK_SIZE=5200
CONFIG_SHELL_STACK_SIZE=5200
CONFIG_NET_TX_STACK_SIZE=2048
CONFIG_NET_RX_STACK_SIZE=2048
CONFIG_HEAP_MEM_POOL_SIZE=16384
CONFIG_SHELL_STACK_SIZE=2560

CONFIG_WIFI=y
CONFIG_WIFI_LOG_LEVEL_ERR=y
CONFIG_NET_L2_WIFI_SHELL=y
# printing of scan results puts pressure on queues in new locking
# design in net_mgmt. So, use a higher timeout for a crowded
# environment.
CONFIG_NET_MGMT_EVENT_QUEUE_TIMEOUT=5000
CONFIG_NET_MGMT_EVENT_QUEUE_SIZE=16

CONFIG_NETWORKING=y
CONFIG_NET_L2_ETHERNET=y

CONFIG_NET_IPV6=n
CONFIG_NET_IPV4=y
CONFIG_NET_DHCPV4=y
CONFIG_NET_CONFIG_MY_IPV4_ADDR=""
CONFIG_NET_CONFIG_PEER_IPV4_ADDR=""

CONFIG_NET_LOG=y
CONFIG_INIT_STACKS=y

CONFIG_NET_SHELL=y

CONFIG_NET_STATISTICS=y
CONFIG_NET_STATISTICS_PERIODIC_OUTPUT=n

CONFIG_COMPILER_SAVE_TEMPS=y

CONFIG_LOG=y
CONFIG_LOG_MODE_IMMEDIATE=y
CONFIG_LOG_BACKEND_SHOW_COLOR=n

CONFIG_NET_SOCKETS_LOG_LEVEL_DBG=y
CONFIG_NET_CONN_LOG_LEVEL_DBG=y
CONFIG_NET_CONTEXT_LOG_LEVEL_DBG=y

CONFIG_NET_TCP_LOG_LEVEL_DBG=y

CONFIG_NET_SAMPLE_WIFI_SSID="<YOUR SSID HERE>"
CONFIG_NET_SAMPLE_WIFI_PSK="<YOUR WIFI PASSWORD HERE>"
```

## samples/net/sockets/echo/boards/s32k3x4evb_t172.conf
```kconfig
# Network address config
CONFIG_NET_CONFIG_MY_IPV4_ADDR="192.168.10.10"
CONFIG_NET_CONFIG_PEER_IPV4_ADDR="192.168.10.1"
```

## samples/net/sockets/echo/sample.yaml
```yaml
sample:
  description: BSD Sockets API TCP echo server sample
  name: socket_echo
common:
  harness: net
  depends_on: netif
  filter: TOOLCHAIN_HAS_NEWLIB == 1
tests:
  sample.net.sockets.echo:
    tags: net socket
  sample.net.sockets.echo.offload.simplelink:
    platform_allow: cc3220sf_launchxl
    tags: net socket offload simplelink
```

## samples/net/sockets/echo_async/sample.yaml
```yaml
sample:
  description: BSD Sockets API TCP echo server sample using non-blocking sockets
  name: socket_echo_async
common:
  filter: CONFIG_FULL_LIBC_SUPPORTED and not CONFIG_NATIVE_LIBC
  harness: net
  platform_allow: qemu_x86
  tags:
    - net
    - socket
tests:
  sample.net.sockets.echo_async:
    extra_configs:
      - CONFIG_POSIX_API=y
```

## samples/net/sockets/echo_async_select/boards/cc3235sf_launchxl.conf
```kconfig
# Networking Config:
CONFIG_NET_NATIVE=n

# Enable SimpleLink WiFi Driver and Socket Offload
CONFIG_WIFI=y
CONFIG_WIFI_SIMPLELINK=y
CONFIG_NET_SOCKETS_OFFLOAD=y

# Disable unneeded settings from the base prj.conf:
CONFIG_NET_CONFIG_SETTINGS=n
CONFIG_NET_CONFIG_MY_IPV4_ADDR=""
CONFIG_NET_CONFIG_PEER_IPV4_ADDR=""
CONFIG_NET_CONFIG_MY_IPV6_ADDR=""
CONFIG_NET_CONFIG_PEER_IPV6_ADDR=""

# Debugging
CONFIG_NET_LOG=y
CONFIG_WIFI_LOG_LEVEL_DBG=y
CONFIG_DEBUG=y
CONFIG_ASSERT=y
```

## samples/net/sockets/echo_async_select/sample.yaml
```yaml
sample:
  description: BSD Sockets API TCP echo server sample using non-blocking sockets
  name: socket_echo_async
common:
  harness: net
  platform_allow: qemu_x86
  tags:
    - net
    - socket
  filter: CONFIG_FULL_LIBC_SUPPORTED and not CONFIG_NATIVE_LIBC
tests:
  sample.net.sockets.echo_async_select:
    extra_configs:
      - CONFIG_POSIX_API=y
```

## samples/net/sockets/echo_client/Kconfig.sysbuild
```kconfig
#
# Copyright (c) 2024 Nordic Semiconductor ASA
#
# SPDX-License-Identifier: Apache-2.0
#

config WIFI_NRF70
	default y if BOARD_NRF7002DK_NRF5340_CPUAPP || \
		     BOARD_NRF7002DK_NRF5340_CPUAPP_NS || \
		     BOARD_NRF7002DK_NRF5340_CPUAPP_NRF7001 || \
		     BOARD_NRF7002DK_NRF5340_CPUAPP_NRF7001_NS

source "${ZEPHYR_BASE}/share/sysbuild/Kconfig"
```

## samples/net/sockets/echo_client/boards/atsamr21_xpro.conf
```kconfig
#
# Copyright (c) 2020, Gerson Fernando Budke
# Copyright (c) 2019, Benjamin Valentin
#
# SPDX-License-Identifier: Apache-2.0
#

CONFIG_NET_CONFIG_IEEE802154_DEV_NAME="RF2XX_0"

# Reduced buffers to fit into SAMR21 SoC
CONFIG_CPLUSPLUS=n

CONFIG_NET_PKT_RX_COUNT=6
CONFIG_NET_PKT_TX_COUNT=6
CONFIG_NET_BUF_RX_COUNT=6
CONFIG_NET_BUF_TX_COUNT=6
CONFIG_NET_MAX_CONTEXTS=4
CONFIG_NET_MAX_CONN=2
CONFIG_NET_MAX_ROUTES=2
CONFIG_NET_MAX_NEXTHOPS=2

CONFIG_SHELL_STACK_SIZE=768
CONFIG_SHELL_CMD_BUFF_SIZE=80
CONFIG_SHELL_ARGC_MAX=6
CONFIG_SHELL_HISTORY_BUFFER=64
```

## samples/net/sockets/echo_client/boards/nrf52_bsim.conf
```kconfig
# Workaround for a build assert in nrf_802154_sl_timer_module_init
# (nrf_802154_sl_timer.c)
CONFIG_SYS_CLOCK_TICKS_PER_SEC=32768
```

## samples/net/sockets/echo_client/boards/qemu_cortext_m3.conf
```kconfig
# The addresses are selected so that qemu<->qemu connectivity works ok.
# For linux<->qemu connectivity, create a new conf file and swap the
# addresses (so that peer address is ending to 2).
CONFIG_NET_CONFIG_MY_IPV6_ADDR="2001:db8::2"
CONFIG_NET_CONFIG_PEER_IPV6_ADDR="2001:db8::1"
CONFIG_NET_CONFIG_MY_IPV4_ADDR="192.0.2.2"
CONFIG_NET_CONFIG_PEER_IPV4_ADDR="192.0.2.1"
```

## samples/net/sockets/echo_client/sample.yaml
```yaml
common:
  harness: net
  tags:
    - net
    - socket
  depends_on: netif
  min_flash: 140
sample:
  description: Test network sockets using a client/server sample
  name: Socket Echo Client
tests:
  sample.net.sockets.echo_client:
    platform_allow:
      - qemu_x86
      - frdm_k64f
      - sam_e70_xplained/same70q21
      - qemu_cortex_m3
      - frdm_kw41z
    integration_platforms:
      - qemu_x86
  sample.net.sockets.echo_client.802154:
    extra_args: EXTRA_CONF_FILE="overlay-qemu_802154.conf"
    platform_allow: qemu_x86
  sample.net.sockets.echo_client.802154.rf2xx:
    extra_args: EXTRA_CONF_FILE="overlay-802154.conf"
    platform_allow: samr21_xpro
  sample.net.sockets.echo_client.802154.rf2xx.xplained:
    extra_args:
      - SHIELD=atmel_rf2xx_xplained
      - EXTRA_CONF_FILE="overlay-802154.conf"
    platform_allow: sam4s_xplained
  sample.net.sockets.echo_client.802154.rf2xx.xpro:
    extra_args:
      - SHIELD=atmel_rf2xx_xpro
      - EXTRA_CONF_FILE="overlay-802154.conf"
    platform_allow:
      - sam4e_xpro
      - sam_v71_xult/samv71q21
    integration_platforms:
      - sam_v71_xult/samv71q21
  sample.net.sockets.echo_client.802154.rf2xx.legacy:
    extra_args:
      - SHIELD=atmel_rf2xx_legacy
      - EXTRA_CONF_FILE="overlay-802154.conf"
    platform_allow:
      - sam4e_xpro
      - sam_v71_xult/samv71q21
    integration_platforms:
      - sam_v71_xult/samv71q21
  sample.net.sockets.echo_client.802154.rf2xx.arduino:
    extra_args:
      - SHIELD=atmel_rf2xx_arduino
      - EXTRA_CONF_FILE="overlay-802154.conf"
    platform_allow:
      - sam_v71_xult/samv71q21
      - frdm_k64f
      - nucleo_f767zi
    integration_platforms:
      - sam_v71_xult/samv71q21
  sample.net.sockets.echo_client.802154.rf2xx.mikrobus:
    extra_args:
      - SHIELD=atmel_rf2xx_mikrobus
      - EXTRA_CONF_FILE="overlay-802154.conf"
    platform_allow: lpcxpresso55s69/lpc55s69/cpu0/ns
  sample.net.sockets.echo_client.mcr20a:
    extra_args:
      - SHIELD=frdm_cr20a
      - EXTRA_CONF_FILE=overlay-802154.conf
    platform_allow: frdm_k64f
  sample.net.sockets.echo_client.nrf_802154:
    extra_args: EXTRA_CONF_FILE="overlay-802154.conf"
    platform_allow: nrf52840dk/nrf52840
  sample.net.sockets.echo_client.openthread:
    extra_args: EXTRA_CONF_FILE="overlay-ot.conf"
    slow: true
    tags:
      - net
      - openthread
    platform_allow:
      - frdm_kw41z
      - frdm_mcxw71
      - nrf52840dk/nrf52840
      - tlsr9518adk80d
    filter: CONFIG_FULL_LIBC_SUPPORTED and not CONFIG_NATIVE_LIBC
  sample.net.sockets.echo_client.b91_802154:
    extra_args: EXTRA_CONF_FILE="overlay-802154.conf"
    platform_allow: tlsr9518adk80d
  sample.net.sockets.echo_client.rw612_openthread_rcp_host:
    build_only: true
    extra_args:
      # Disabling monolithic since CI environment doesn't use blobs
      - CONFIG_NXP_MONOLITHIC_NBU=n
      - EXTRA_CONF_FILE="overlay-ot-rcp-host-nxp.conf"
    slow: true
    tags:
      - net
      - openthread
    platform_allow:
      - frdm_rw612
      - rd_rw612_bga
    filter: CONFIG_FULL_LIBC_SUPPORTED and not CONFIG_NATIVE_LIBC
  sample.net.sockets.echo_client.userspace:
    extra_args:
      - CONFIG_USERSPACE=y
      - EXTRA_CONF_FILE="overlay-e1000.conf"
    platform_allow:
      - qemu_x86
      - qemu_x86_64
    integration_platforms:
      - qemu_x86
  sample.net.sockets.echo_client.802154.subg:
    extra_args: EXTRA_CONF_FILE="overlay-802154-subg.conf"
    platform_allow: beagleconnect_freedom
```

## samples/net/sockets/echo_server/Kconfig
```kconfig
# Private config options for echo-server sample app

# Copyright (c) 2018 Intel Corporation
# SPDX-License-Identifier: Apache-2.0

mainmenu "Networking echo-server sample application"

config NET_SAMPLE_NUM_HANDLERS
	int "How many connections to serve at the same time"
	default 1
	help
	  Each connection is served by a thread which needs
	  memory. Only increase the value here if really needed.

config NET_SAMPLE_IFACE2_MY_IPV6_ADDR
	string "My IPv6 address for second interface"
	help
	  The value depends on your network setup.

config NET_SAMPLE_IFACE2_MY_IPV4_ADDR
	string "My IPv4 address for second interface"
	help
	  The value depends on your network setup.

config NET_SAMPLE_IFACE2_MY_IPV4_NETMASK
	string "My IPv4 netmask for second interface"
	help
	  The value depends on your network setup.

config NET_SAMPLE_IFACE2_VLAN_TAG
	int "VLAN tag for second interface"
	default 100
	range 0 4094
	depends on NET_VLAN
	help
	  Set VLAN (virtual LAN) tag (id) that is used in the sample
	  application.

config NET_SAMPLE_IFACE3_MY_IPV6_ADDR
	string "My IPv6 address for third interface"
	help
	  The value depends on your network setup.

config NET_SAMPLE_IFACE3_MY_IPV4_ADDR
	string "My IPv4 address for third interface"
	help
	  The value depends on your network setup.

config NET_SAMPLE_IFACE3_MY_IPV4_NETMASK
	string "My IPv4 netmask for third interface"
	help
	  The value depends on your network setup.

config NET_SAMPLE_IFACE3_VLAN_TAG
	int "VLAN tag for third interface"
	default 200
	range 0 4094
	depends on NET_VLAN
	help
	  Set VLAN (virtual LAN) tag (id) that is used in the sample
	  application.

config NET_SAMPLE_TUNNEL_PEER_ADDR
	string "Remote IP address of the tunnel interface"
	depends on NET_L2_IPIP
	help
	  Use overlay-tunnel.conf to setup the tunnel support.

config NET_SAMPLE_TUNNEL_MY_ADDR
	string "My address for tunnel interface"
	depends on NET_L2_IPIP
	help
	  The value depends on your network setup.

config NET_SAMPLE_PSK_HEADER_FILE
	string "Header file containing PSK"
	default "dummy_psk.h"
	depends on MBEDTLS_KEY_EXCHANGE_PSK_ENABLED
	help
	  Name of a header file containing a
	  pre-shared key.

config NET_SAMPLE_CERTS_WITH_SC
	bool "Signed certificates"
	depends on NET_SOCKETS_SOCKOPT_TLS
	help
	  Enable this flag, if you are interested to run this
	  application with signed certificates and keys.

config NET_SAMPLE_WEBSOCKET_CONSOLE
	bool "Websocket console support"
	default y if WEBSOCKET_CONSOLE
	help
	  Enable this flag, if you are interested to enable websocket console.
	  You can use the overlay-ws-console.conf to set websocket options.

config NET_SAMPLE_HTTPS_SERVICE
	bool "Enable HTTPS service for the Webconsole"
	default y if NET_SAMPLE_WEBSOCKET_CONSOLE
	depends on NET_SOCKETS_SOCKOPT_TLS || TLS_CREDENTIALS

config NET_SAMPLE_HTTPS_SERVER_SERVICE_PORT
	int "Port number for HTTPS service"
	default 443
	depends on NET_SAMPLE_HTTPS_SERVICE

if USB_DEVICE_STACK_NEXT
# Source common USB sample options used to initialize new experimental USB
# device stack. The scope of these options is limited to USB samples in project
# tree, you cannot use them in your own application.
	source "samples/subsys/usb/common/Kconfig.sample_usbd"
endif

source "Kconfig.zephyr"
```
