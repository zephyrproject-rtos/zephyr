## prj.conf
```kconfig
# General config
CONFIG_NEWLIB_LIBC=y
CONFIG_NEWLIB_LIBC_NANO=n

# eventfd() implementation only makes sense for networking APIs.
CONFIG_NETWORKING=y
CONFIG_NET_SOCKETS=y
CONFIG_NET_SOCKETS_POSIX_NAMES=y
CONFIG_NET_EVENTFD=y
CONFIG_NET_SLIP_TAP=n
CONFIG_TEST_RANDOM_GENERATOR=y
```

## src/main.c
```c
/*
 * Copyright (c) 2020 Linaro Limited
 *
 * SPDX-License-Identifier: Apache-2.0
 *
 * This sample application is roughly based on the sample code in Linux
 * manpage for eventfd().
 */
#include <stdlib.h>
#include <stdio.h>
#include <stdint.h>
#include <net/socket.h>

#define fatal(msg) \
	do { perror(msg); exit(EXIT_FAILURE); } while (0)

/* As Zephyr doesn't provide command-line args, emulate them. */
char *input_argv[] = {"argv0", "1", "2", "3", "4"};

int efd;
int g_argc;
char **g_argv;

void writer(void)
{
	int j;
	uint64_t u;
	ssize_t s;

	for (j = 1; j < g_argc; j++) {
		printf("Writing %s to efd\n", g_argv[j]);
		u = strtoull(g_argv[j], NULL, 0);
		s = eventfd_write(efd, u);
		if (s != 0) {
			fatal("write");
		}
	}
	printf("Completed write loop\n");
}

void reader(void)
{
	uint64_t u;
	ssize_t s;

	k_sleep(K_MSEC(1000));

	printf("About to read\n");
	s = eventfd_read(efd, &u);
	if (s != 0) {
		fatal("read");
	}
	printf("Read %llu (0x%llx) from efd\n",
	       (unsigned long long)u, (unsigned long long)u);
}

void main(void)
{
	char **argv = input_argv;
	int argc = sizeof(input_argv) / sizeof(input_argv[0]);

	if (argc < 2) {
		fprintf(stderr, "Usage: %s <num>...\n", argv[0]);
		exit(EXIT_FAILURE);
	}

	g_argc = argc;
	g_argv = argv;

	efd = eventfd(0, 0);
	if (efd == -1) {
		fatal("eventfd");
	}

	writer();
	reader();

	printf("Finished\n");
}
```
