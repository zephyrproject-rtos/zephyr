/*
 * Copyright (c) 2020 Gerson Fernando Budke
 *
 * SPDX-License-Identifier: Apache-2.0
 */

&spi0 {
        status = "okay";
        label = "SPI_RF2XX";
        cs-gpios = <&piob 14 (GPIO_PULL_UP | GPIO_ACTIVE_LOW)>;
        pinctrl-0 = <&pa12a_spi_miso &pa13a_spi_mosi &pa14a_spi_spck &pb14a_spi_npcs1>;

        rf2xx@0 {
                compatible = "atmel,rf2xx";
                reg = <0x0>;
                label = "RF2XX_0";
                spi-max-frequency = <6000000>;
                irq-gpios = <&pioa 21 (GPIO_PULL_DOWN | GPIO_ACTIVE_HIGH)>;
                reset-gpios = <&pioa 3 GPIO_ACTIVE_LOW>;
                slptr-gpios = <&pioa 22 GPIO_ACTIVE_HIGH>;
                status = "okay";
        };
};
