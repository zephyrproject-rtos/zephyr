/*
 * Copyright (c) 2020 Gerson Fernando Budke
 *
 * SPDX-License-Identifier: Apache-2.0
 */

&spi0 {
        status = "okay";
        label = "SPI_RF2XX";
        pinctrl-0 = <&pc26c_spi1_miso &pc27c_spi1_mosi &pc24c_spi1_spck &pd25b_spi0_npcs1>;
        cs-gpios = <&piod 25 (GPIO_PULL_UP | GPIO_ACTIVE_LOW)>;

        rf2xx@0 {
                compatible = "atmel,rf2xx";
                reg = <0x0>;
                label = "RF2XX_0";
                spi-max-frequency = <6000000>;
                irq-gpios = <&piob 0 (GPIO_PULL_DOWN | GPIO_ACTIVE_HIGH)>;
                reset-gpios = <&pioa 3 GPIO_ACTIVE_LOW>;
                slptr-gpios = <&piob 1 GPIO_ACTIVE_HIGH>;
                status = "okay";
        };
};
