## samples/net/sockets/echo_server/boards/max78000fthr_max78000_m4.conf
```kconfig
# Copyright (c) 2026 Analog Devices, Inc.
# SPDX-License-Identifier: Apache-2.0

CONFIG_NET_L2_ETHERNET=y

# Memory optimization - 96KB RAM
CONFIG_MAIN_STACK_SIZE=768
CONFIG_SYSTEM_WORKQUEUE_STACK_SIZE=768
CONFIG_IDLE_STACK_SIZE=256
CONFIG_ISR_STACK_SIZE=512
CONFIG_NET_PKT_RX_COUNT=2
CONFIG_NET_PKT_TX_COUNT=2
CONFIG_NET_BUF_RX_COUNT=4
CONFIG_NET_BUF_TX_COUNT=4
CONFIG_NET_MAX_CONTEXTS=2
CONFIG_NET_IF_UNICAST_IPV6_ADDR_COUNT=1
CONFIG_NET_IF_MCAST_IPV6_ADDR_COUNT=1
CONFIG_HEAP_MEM_POOL_SIZE=1024
CONFIG_NET_BUF_DATA_SIZE=128
CONFIG_ETH_ADIN1140_RX_THREAD_STACK_SIZE=768

# Enable logging for debug
CONFIG_LOG=y
CONFIG_PRINTK=y
CONFIG_NET_LOG=n
CONFIG_LOG_DEFAULT_LEVEL=3
CONFIG_LOG_MODE_DEFERRED=y
CONFIG_LOG_BUFFER_SIZE=4096
CONFIG_LOG_PROCESS_THREAD_SLEEP_MS=10
CONFIG_LOG_PROCESS_THREAD_STACK_SIZE=2048

# Disable heavy features
CONFIG_NET_SHELL=y
CONFIG_SHELL=y
CONFIG_NET_STATISTICS=n
CONFIG_LOG_BACKEND_SHOW_COLOR=y
CONFIG_LOG_BACKEND_FORMAT_TIMESTAMP=n

# Use only IPv4 to save memory
CONFIG_NET_IPV6=n
CONFIG_NET_CONFIG_NEED_IPV6=n
```

## samples/net/sockets/echo_server/boards/nrf52_bsim.conf
```kconfig
# The nrf52 HW models do not have a flash model yet. Even though it is possible to use different
# replacements, the easiest one is to disable the flash, so when configured with openthread
# it will use the OPENTHREAD_SETTINGS_RAM
CONFIG_FLASH=n
```

## samples/net/sockets/echo_server/boards/nucleo_g474re.conf
```kconfig
#
# Copyright (c) 2026, Łukasz Majewski
#
# SPDX-License-Identifier: Apache-2.0
#

# Generic networking options
CONFIG_NET_TCP=n
CONFIG_POSIX_SYSCONF_IMPL_MACRO=y

# Kernel options - adjustments
CONFIG_HEAP_MEM_POOL_SIZE=2048
CONFIG_ISR_STACK_SIZE=1024
CONFIG_MAIN_STACK_SIZE=3584

# Network buffers
CONFIG_NET_PKT_RX_COUNT=6
CONFIG_NET_PKT_TX_COUNT=20
CONFIG_NET_BUF_RX_COUNT=64
CONFIG_NET_BUF_TX_COUNT=64

# Shell
CONFIG_SHELL_ARGC_MAX=5
CONFIG_SHELL_HISTORY_BUFFER=128

# IP address options
CONFIG_NET_IF_UNICAST_IPV6_ADDR_COUNT=3
CONFIG_NET_IF_MCAST_IPV6_ADDR_COUNT=4
# For bigger networks aka stacked version (default is 8)
CONFIG_NET_IPV6_MAX_NEIGHBORS=16

# LAN865x T1S driver specific
CONFIG_NET_L2_ETHERNET=y
CONFIG_ETH_LAN865X=y
CONFIG_NET_BUF_DATA_SIZE=128

# Log
CONFIG_LOG_BUFFER_SIZE=4096

# Debugging
CONFIG_DEBUG_OPTIMIZATIONS=y
CONFIG_DEBUG_THREAD_INFO=y

CONFIG_NET_DEBUG_NET_PKT_ALLOC=y
CONFIG_NET_BUF_POOL_USAGE=y
CONFIG_NET_ICMPV4_LOG_LEVEL_INF=y
CONFIG_NET_ICMPV6_LOG_LEVEL_INF=y

# Use UDPPERF stress test program
# As it is an external Zephyr 'module'
CONFIG_CPP=y
CONFIG_STD_CPP17=y
CONFIG_REQUIRES_FULL_LIBCPP=y
```

## samples/net/sockets/echo_server/boards/sam_v71_xult.conf
```kconfig
CONFIG_IEEE802154_RF2XX=y

CONFIG_NET_6LO=y
CONFIG_NET_L2_IEEE802154_FRAGMENT=y
CONFIG_NET_L2_IEEE802154_FRAGMENT_REASS_CACHE_SIZE=2
CONFIG_NET_L2_IEEE802154_SECURITY=n

CONFIG_NET_CONFIG_MY_IPV6_ADDR="2001:db8::1"
CONFIG_NET_CONFIG_PEER_IPV6_ADDR="2001:db8::2"
CONFIG_NET_CONFIG_IEEE802154_DEV_NAME="RF2XX_0"

CONFIG_DEVICE_SHELL=y
CONFIG_CPLUSPLUS=n

CONFIG_ETH_SAM_GMAC=n
CONFIG_I2C=n
CONFIG_GPIO_SAM=y
CONFIG_GPIO=y
```

## samples/net/sockets/echo_server/boards/samr21_xpro_samr21g18a.conf
```kconfig
#
# Copyright (c) 2019, Benjamin Valentin
# Copyright (c) 2020-2024, Gerson Fernando Budke
#
# SPDX-License-Identifier: Apache-2.0
#

# Reduced configs to fit into SAMR21 SoC
CONFIG_CPP=n

CONFIG_NET_PKT_RX_COUNT=5
CONFIG_NET_PKT_TX_COUNT=5
CONFIG_NET_BUF_RX_COUNT=5
CONFIG_NET_BUF_TX_COUNT=5
CONFIG_NET_MAX_CONTEXTS=2
CONFIG_NET_MAX_CONN=1
CONFIG_NET_MAX_ROUTES=1
CONFIG_NET_MAX_NEXTHOPS=1

CONFIG_SHELL_STACK_SIZE=768
CONFIG_SHELL_CMD_BUFF_SIZE=32
CONFIG_SHELL_ARGC_MAX=6
CONFIG_SHELL_HISTORY_BUFFER=4

CONFIG_LOG_MODE_MINIMAL=y
CONFIG_NET_IP_DSCP_ECN=n
CONFIG_NET_STATISTICS=n
CONFIG_NET_MGMT_EVENT_STACK_SIZE=512
CONFIG_IEEE802154_RF2XX_RX_STACK_SIZE=512

CONFIG_UART_USE_RUNTIME_CONFIGURE=n
CONFIG_NET_CONTEXT_REUSEADDR=n
CONFIG_NET_CONTEXT_REUSEPORT=n
```

## samples/net/sockets/echo_server/sample.yaml
```yaml
common:
  harness: net
  tags:
    - net
    - socket
  depends_on: netif
  min_flash: 140
sample:
  description: Test network sockets using a client/server sample
  name: Socket Echo Server
tests:
  sample.net.sockets.echo_server:
    platform_allow:
      - qemu_x86
      - qemu_x86_64
      - sam_e70_xplained/same70q21
      - frdm_k64f
      - qemu_cortex_m3
      - frdm_kw41z
      - qemu_cortex_a53
      - native_sim
    integration_platforms:
      - qemu_x86
  sample.net.sockets.echo_server.802154:
    extra_args: EXTRA_CONF_FILE="overlay-qemu_802154.conf"
    platform_allow: qemu_x86
    integration_platforms:
      - qemu_x86
  sample.net.sockets.echo_server.802154.rf2xx.xplained:
    extra_args:
      - SHIELD=atmel_rf2xx_xplained
      - EXTRA_CONF_FILE="overlay-802154.conf"
    platform_allow: sam4s_xplained
  sample.net.sockets.echo_server.802154.rf2xx.xpro:
    extra_args:
      - SHIELD=atmel_rf2xx_xpro
      - EXTRA_CONF_FILE="overlay-802154.conf"
    platform_allow:
      - sam4e_xpro
      - sam_v71_xult/samv71q21
    integration_platforms:
      - sam_v71_xult/samv71q21
  sample.net.sockets.echo_server.802154.rf2xx.legacy:
    extra_args:
      - SHIELD=atmel_rf2xx_legacy
      - EXTRA_CONF_FILE="overlay-802154.conf"
    platform_allow:
      - sam4e_xpro
      - sam_v71_xult/samv71q21
    integration_platforms:
      - sam_v71_xult/samv71q21
  sample.net.sockets.echo_server.802154.rf2xx.arduino:
    extra_args:
      - SHIELD=atmel_rf2xx_arduino
      - EXTRA_CONF_FILE="overlay-802154.conf"
    platform_allow:
      - sam_v71_xult/samv71q21
      - frdm_k64f
      - nucleo_f767zi
    integration_platforms:
      - sam_v71_xult/samv71q21
  sample.net.sockets.echo_server.802154.rf2xx.mikrobus:
    extra_args:
      - SHIELD=atmel_rf2xx_mikrobus
      - EXTRA_CONF_FILE="overlay-802154.conf"
    platform_allow: lpcxpresso55s69/lpc55s69/cpu0/ns
  sample.net.sockets.echo_server.mcr20a:
    extra_args:
      - SHIELD=frdm_cr20a
      - EXTRA_CONF_FILE=overlay-802154.conf
    platform_allow: frdm_k64f
  sample.net.sockets.echo_server.nrf_802154:
    extra_args: EXTRA_CONF_FILE="overlay-802154.conf"
    platform_allow: nrf52840dk/nrf52840
  sample.net.sockets.echo_server.b91_802154:
    extra_args: EXTRA_CONF_FILE="overlay-802154.conf"
    platform_allow: tlsr9518adk80d
  sample.net.sockets.echo_server.usbnet:
    depends_on: usb_device
    harness: net
    extra_args: EXTRA_CONF_FILE="overlay-netusb.conf"
    tags:
      - net
      - usb
    # native_sim usb driver does not work with CONFIG_POSIX_API
    platform_exclude:
      - native_sim
      - native_sim/native/64
      - native_posix
      - native_posix/native/64
  sample.net.sockets.echo_server.nrf_openthread:
    extra_args: EXTRA_CONF_FILE="overlay-ot.conf"
    slow: true
    tags:
      - net
      - openthread
    platform_allow: nrf52840dk/nrf52840
    filter: CONFIG_FULL_LIBC_SUPPORTED and not CONFIG_NATIVE_LIBC
  sample.net.sockets.echo_server.b91_openthread:
    extra_args: EXTRA_CONF_FILE="overlay-ot.conf"
    slow: true
    tags:
      - net
      - openthread
    platform_allow: tlsr9518adk80d
    filter: CONFIG_FULL_LIBC_SUPPORTED and not CONFIG_NATIVE_LIBC
  sample.net.sockets.echo_server.kw41z_openthread:
    extra_args: EXTRA_CONF_FILE="overlay-ot.conf"
    slow: true
    tags:
      - net
      - openthread
    platform_allow: frdm_kw41z
    filter: CONFIG_FULL_LIBC_SUPPORTED and not CONFIG_NATIVE_LIBC
  sample.net.sockets.echo_server.e1000:
    extra_args: EXTRA_CONF_FILE="overlay-e1000.conf"
    tags: net
    platform_allow:
      - qemu_x86
      - qemu_x86_64
  sample.net.sockets.echo_server.stellaris:
    extra_args: EXTRA_CONF_FILE="overlay-qemu_cortex_m3_eth.conf"
    tags: net
    platform_allow: qemu_cortex_m3
  sample.net.sockets.echo_server.smsc911x:
    extra_args: EXTRA_CONF_FILE="overlay-smsc911x.conf"
    tags: net
    platform_allow: mps2/an385
  sample.net.sockets.echo_server.userspace:
    extra_args:
      - CONFIG_USERSPACE=y
      - EXTRA_CONF_FILE="overlay-e1000.conf"
      - CONFIG_MAX_THREAD_BYTES=3
    platform_allow:
      - qemu_x86
      - qemu_x86_64
    integration_platforms:
      - qemu_x86
  sample.net.sockets.echo_server.nsos:
    platform_allow:
      - native_sim
      - native_sim/native/64
    extra_args:
      - EXTRA_CONF_FILE="overlay-nsos.conf"
  sample.net.sockets.echo_server.802154.subg:
    extra_args: EXTRA_CONF_FILE="overlay-802154-subg.conf"
    platform_allow: beagleconnect_freedom
```

## samples/net/sockets/echo_service/sample.yaml
```yaml
sample:
  description: echo server using socket service API
  name: socket_service_echo
common:
  harness: net
  depends_on: netif
  filter: CONFIG_FULL_LIBC_SUPPORTED and not CONFIG_NATIVE_LIBC
  # eventfd does not work properly with native_posix so exclude it here
  platform_exclude:
    - native_posix
    - native_posix/native/64
tests:
  sample.net.sockets.service.echo:
    tags:
      - net
      - socket
```

## samples/net/sockets/http_client/Kconfig
```kconfig
# Private config options for http-client sample app

# Copyright (c) 2020 Intel Corporation
# SPDX-License-Identifier: Apache-2.0

mainmenu "Networking http-client sample application"

config NET_SAMPLE_SEND_ITERATIONS
	int "Send a sample HTTP query this many times"
	default 0
	help
	  Send a sample HTTP query this many times before exiting. A value of
	  zero means that the sample application in default way.

source "Kconfig.zephyr"
```

## samples/net/sockets/http_client/sample.yaml
```yaml
common:
  tags:
    - net
    - http
    - http_client
  min_ram: 32
  depends_on: netif
sample:
  description: HTTP client sample
  name: http_client
tests:
  sample.net.sockets.http_client:
    harness: net
```

## samples/net/sockets/http_get/Kconfig
```kconfig
#
# Copyright (c) 2025 Ezurio
#
# SPDX-License-Identifier: Apache-2.0
#

config NET_SAMPLE_TLS_SESSION_CACHE
	bool "Enable TLS session caching"
	depends on NET_SOCKETS_SOCKOPT_TLS
	help
	  Enable TLS client session caching for the http_get sample.
	  Sessions are cached in RAM and reused on reconnect.
	  Combine with CONFIG_NET_SOCKETS_TLS_SESSION_CACHE_PERSISTENT
	  to persist sessions across reboots.

source "samples/net/common/Kconfig"
source "Kconfig.zephyr"
```

## samples/net/sockets/http_get/boards/cc3235sf_launchxl.conf
```kconfig
# Networking Config:
CONFIG_NETWORKING=y
CONFIG_NET_NATIVE=n
CONFIG_NET_IPV4=y
CONFIG_NET_IPV6=n
CONFIG_NET_SOCKETS=y

# Enable SimpleLink WiFi Driver and Socket Offload
CONFIG_WIFI=y
CONFIG_WIFI_SIMPLELINK=y
CONFIG_NET_SOCKETS_OFFLOAD=y

# Disable unneeded settings from the base prj.conf:
CONFIG_DNS_RESOLVER=n
CONFIG_DNS_SERVER_IP_ADDRESSES=n
CONFIG_DNS_SERVER1=""
CONFIG_TEST_RANDOM_GENERATOR=n
CONFIG_NET_CONFIG_SETTINGS=n
CONFIG_NET_CONFIG_MY_IPV4_ADDR=""
CONFIG_NET_CONFIG_MY_IPV4_GW=""
CONFIG_NET_CONFIG_PEER_IPV4_ADDR=""

# Debugging
CONFIG_NET_LOG=y
CONFIG_WIFI_LOG_LEVEL_DBG=y
CONFIG_DEBUG=y
CONFIG_ASSERT=y
```

## samples/net/sockets/http_get/sample.yaml
```yaml
sample:
  description: BSD Sockets API HTTP GET example
  name: socket_http_get
common:
  filter: CONFIG_FULL_LIBC_SUPPORTED
  depends_on: netif
  min_ram: 32
  min_flash: 80
  tags:
    - net
    - socket
  platform_exclude:
    - native_posix
    - native_posix/native/64
tests:
  sample.net.sockets.http_get:
    filter: not CONFIG_NET_SOCKETS_OFFLOAD and not CONFIG_NATIVE_LIBC
    harness: net
    platform_exclude:
      - cc3220sf_launchxl
      - cc3235sf_launchxl
    extra_configs:
      - CONFIG_POSIX_API=y
  sample.net.sockets.http_get.offload.simplelink:
    platform_allow: cc3220sf_launchxl
    harness: net
    tags:
      - net
      - socket
      - offload
      - simplelink
  sample.net.sockets.http_get.nsos.http:
    harness: console
    harness_config:
      type: multi_line
      ordered: true
      regex:
        - "(.*)<BODY>(.*)"
        - "The document has moved"
        - "(.*)</BODY>(.*)"
    platform_allow:
      - native_sim
      - native_sim/native/64
    extra_args: OVERLAY_CONFIG="overlay-nsos.conf"
  sample.net.sockets.http_get.nsos.https:
    harness: console
    harness_config:
      type: multi_line
      ordered: true
      regex:
        - "(.*)<BODY>(.*)"
        - "The document has moved"
        - "(.*)</BODY>(.*)"
    platform_allow:
      - native_sim
      - native_sim/native/64
    extra_args: OVERLAY_CONFIG="overlay-nsos.conf;overlay-tls.conf"
  sample.net.sockets.http_get.wifi.nrf70dk:
    extra_args:
      - SNIPPET=wifi-ipv4
      - CONFIG_NRF_WIFI_BUILD_ONLY_MODE=y
    platform_allow:
      - nrf7002dk/nrf5340/cpuapp
```

## samples/net/sockets/http_server/Kconfig
```kconfig
# Config options for http2 server sample application

# Copyright (c) 2023, Emna Rekik
# SPDX-License-Identifier: Apache-2.0

mainmenu "HTTP2 server sample application"

config NET_SAMPLE_HTTP_SERVICE
	bool "Enable http service"
	default y

config NET_SAMPLE_HTTP_SERVER_SERVICE_PORT
	int "Port number for http service"
	default 80
	depends on NET_SAMPLE_HTTP_SERVICE

config NET_SAMPLE_HTTPS_SERVICE
	bool "Enable https service"
	depends on NET_SOCKETS_SOCKOPT_TLS || TLS_CREDENTIALS
	imply MBEDTLS_PSA_CRYPTO_C if !BUILD_WITH_TFM

if NET_SAMPLE_HTTPS_SERVICE

config NET_SAMPLE_HTTPS_SERVER_SERVICE_PORT
	int "Port number for https service"
	default 443
	depends on NET_SAMPLE_HTTPS_SERVICE

config NET_SAMPLE_HTTPS_USE_ALPN
	bool "Allow HTTP2 connectivity with web browsers by using ALPN"
	select MBEDTLS_SSL_ALPN
	select HTTP_SERVER_TLS_USE_ALPN
	help
	  Web browsers only use HTTP/2 over HTTPS, and use ALPN to determine if a
	  server supports HTTP/2. If this option is enabled, web browsers can use
	  HTTP/2 to communicate with the server. However web browsers are stricter
	  with security when using HTTP/2, at a minimum you will need to add the CA
	  certificate used to sign the server certificate into your web browser's
	  trusted authorities. Otherwise the connection can fail with a security
	  error, without giving an option to ignore this and proceed anyway.

endif # NET_SAMPLE_HTTPS_SERVICE

config NET_SAMPLE_PSK_HEADER_FILE
	string "Header file containing PSK"
	default "dummy_psk.h"
	depends on MBEDTLS_KEY_EXCHANGE_PSK_ENABLED
	help
	  Name of a header file containing a
	  pre-shared key.

config NET_SAMPLE_WEBSOCKET_SERVICE
	bool "Enable websocket service"
	default y if HTTP_SERVER_WEBSOCKET

config NET_SAMPLE_NUM_WEBSOCKET_HANDLERS
	int "How many websocket connections to serve at the same time"
	depends on NET_SAMPLE_WEBSOCKET_SERVICE
	default 1
	help
	  Each websocket connection is served by a thread which needs
	  memory. Only increase the value here if really needed.

config NET_SAMPLE_WEBSOCKET_STATS_INTERVAL
	int "Interval in milliseconds to send network stats over websocket"
	depends on NET_SAMPLE_WEBSOCKET_SERVICE
	default 200
	help
	  This interval controls how often the net stats data shown on the web page
	  will be updated.

source "Kconfig.zephyr"
```

## samples/net/sockets/http_server/sample.yaml
```yaml
sample:
  description: HTTP Server Sample
  name: http_server_sample
common:
  harness: net
  depends_on: netif
  min_ram: 192
  tags:
    - http
    - net
    - server
    - socket
  platform_exclude:
    - nrf5340dk/nrf5340/cpuapp/ns # Excluding due to ROM overflow.
tests:
  sample.net.sockets.http.server: {}
  sample.net.sockets.https.server:
    extra_args: EXTRA_CONF_FILE="overlay-tls.conf"
```

## samples/net/sockets/net_mgmt/sample.yaml
```yaml
common:
  harness: net
  depends_on: netif
  min_flash: 210
  tags:
    - net
    - socket
    - mgmt
sample:
  description: Test network management socket sample
  name: net_mgmt socket
tests:
  sample.net.sockets.net_mgmt.kernelmode:
    extra_configs:
      - CONFIG_USERSPACE=n
  sample.net.sockets.net_mgmt.usermode:
    tags: userspace
    extra_configs:
      - CONFIG_USERSPACE=y
      - CONFIG_MAX_THREAD_BYTES=3
    platform_exclude:
      - ip_k66f
```
