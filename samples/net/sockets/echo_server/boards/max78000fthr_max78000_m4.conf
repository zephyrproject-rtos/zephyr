## samples/net/sockets/packet/sample.yaml
```yaml
sample:
  description: Packet socket sample
  name: packet-socket
tests:
  sample.net.sockets.packet:
    harness: net
    platform_allow:
      - native_posix
      - native_posix/native/64
      - native_sim
      - native_sim/native/64
    integration_platforms:
      - native_sim
    tags:
      - net
      - sockets
      - packet-socket
```

## samples/net/sockets/sntp_client/Kconfig
```kconfig
# Copyright (c) 2024 Embeint Inc

config NET_SAMPLE_SNTP_SERVER_ADDRESS
	string "SNTP server address"
	default "pool.ntp.org"

config NET_SAMPLE_SNTP_SERVER_PORT
	int "SNTP server port"
	default 123

config NET_SAMPLE_SNTP_SERVER_TIMEOUT_MS
	int "Duration to wait for response"
	default 2000

source "Kconfig.zephyr"
```

## samples/net/sockets/sntp_client/sample.yaml
```yaml
sample:
  description: SNTP client sample
  name: sntp_client
common:
  harness: net
  tags: net
tests:
  sample.net.sockets.sntp_client:
    platform_allow:
      - qemu_x86
      - native_sim
  sample.net.sockets.sntp_client.native:
    platform_allow:
      - native_sim
    integration_platforms:
      - native_sim
    extra_configs:
      - CONFIG_NATIVE_SIM_SLOWDOWN_TO_REAL_TIME=y
    extra_args:
      - EXTRA_CONF_FILE="overlay-nsos.conf"
  sample.net.sockets.sntp_client.wifi.nrf70dk:
    extra_args:
      - SNIPPET=wifi-ipv4
      - CONFIG_BUILD_ONLY_NO_BLOBS=y
    platform_allow:
      - nrf7002dk/nrf5340/cpuapp
```

## samples/net/sockets/sntp_server/sample.yaml
```yaml
sample:
  description: SNTP server sample
  name: sntp_server
common:
  harness: net
  tags: net
tests:
  sample.net.sockets.sntp_server:
    platform_allow:
      - qemu_x86
      - native_sim
  sample.net.sockets.sntp_server.native:
    platform_allow:
      - native_sim
    integration_platforms:
      - native_sim
    extra_configs:
      - CONFIG_NATIVE_SIM_SLOWDOWN_TO_REAL_TIME=y
    extra_args:
      - EXTRA_CONF_FILE="overlay-nsos.conf"
```

## samples/net/sockets/socketpair/sample.yaml
```yaml
sample:
  description: Socketpair sample
  name: socketpair
common:
  tags:
    - net
    - socket
    - posix
  harness: net
  arch_exclude: posix
  integration_platforms:
    - qemu_x86
tests:
  sample.net.sockets.socketpair:
    platform_exclude: s32k148_evb/s32k148
  sample.net.sockets.socketpair.s32k148_evb:
    extra_args: SHIELD=nxp_adtja1101
    platform_allow: s32k148_evb/s32k148
```

## samples/net/sockets/tcp/sample.yaml
```yaml
sample:
  description: A sample for running TTCN-3 based sanity check for TCP
  name: tcp
tests:
  sample.net.socket.tcp:
    filter: TOOLCHAIN_HAS_NEWLIB == 1
    harness: net
    platform_allow: qemu_x86
    tags:
      - socket
      - net
      - tcp
    integration_platforms:
      - qemu_x86
```

## samples/net/sockets/txtime/Kconfig
```kconfig
# Private config options for txtime sample app

# Copyright (c) 2020 Intel Corporation
# SPDX-License-Identifier: Apache-2.0

mainmenu "Networking TXTIME sample application"

config NET_SAMPLE_PEER
	string "Peer IP address we are sending packets to"
	help
	  The value depends on your network setup. This could be
	  a multicast address if needed. If port is not specified,
	  then 4242 is used. Currently the port value is only used
	  when selecting UDP socket type.
	  Syntax of the IP address string:
	     192.0.2.1:80
	     192.0.2.42
	     [2001:db8::1]:8080
	     [2001:db8::2]
	     2001:db::42

choice
	prompt "Socket type to use"
	help
	  Can be used to select whether the application will use UDP
	  socket to send data, or if it uses AF_PACKET (raw) socket.

config NET_SAMPLE_UDP_SOCKET
	bool "UDP socket"
	help
	  Use UDP socket.

config NET_SAMPLE_PACKET_SOCKET
	bool "Packet socket"
	select NET_SOCKETS_PACKET
	help
	  Use AF_PACKET socket. Note that currently the application sends
	  dummy data that is not a valid Ethernet frame. We want to measure
	  how long it takes to send data so the actual data content is not
	  important for this sample application.

endchoice

config NET_SAMPLE_PACKET_INTERVAL
	int "How long to wait between sent packets (in milliseconds)"
	default 1000
	range 1 10000
	help
	  The application will send network packets between this
	  interval. The value is in milliseconds.

config NET_SAMPLE_PACKET_TXTIME
	int "What is the TXTIME (in microseconds)"
	default 1000
	range 1 10000
	help
	  This tells what is the expected sending time of the network
	  packet by the network device driver. The value is in microseconds.
	  This value should be smaller than the interval time
	  (NET_SAMPLE_PACKET_INTERVAL). This value is added to current
	  time from PTP clock, to set the expected transmit time. Note that
	  the actual TXTIME given to Ethernet driver, is set in nanoseconds,
	  but for purpose of this sample application, we set the time in
	  microseconds in this config option.

source "samples/net/common/Kconfig"
source "Kconfig.zephyr"
```
