## CMakeLists.txt
```
# SPDX-FileCopyrightText: Copyright The Zephyr Project Contributors
# SPDX-FileCopyrightText: Copyright Lothar Felten <lothar.felten@gmail.com>
# SPDX-License-Identifier: Apache-2.0

cmake_minimum_required(VERSION 3.20.0)
find_package(Zephyr REQUIRED HINTS $ENV{ZEPHYR_BASE})
project(sntp_server)

file(GLOB app_sources src/*.c)
target_sources(app PRIVATE ${app_sources})

include(${ZEPHYR_BASE}/samples/net/common/common.cmake)
```

## Kconfig
```
# SPDX-FileCopyrightText: Copyright The Zephyr Project Contributors
# SPDX-FileCopyrightText: Copyright Lothar Felten <lothar.felten@gmail.com>
# SPDX-License-Identifier: Apache-2.0

config NET_SAMPLE_SNTP_UPSTREAM_ADDRESS
	string "Upstream SNTP server to synchronize from"
	default ""
	help
	  Name or address of the SNTP server this sample queries in order to
	  set the system clock before it starts serving time itself. There is
	  no default, set it according to your network setup. If left empty,
	  the sample starts the server without setting the clock, and the
	  server will tell its clients that it is not synchronized.

config NET_SAMPLE_SNTP_UPSTREAM_TIMEOUT_MS
	int "Duration to wait for the upstream response"
	default 2000

source "samples/net/common/Kconfig"
source "Kconfig.zephyr"
```

## sample.yaml
```
sample:
  description: SNTP server sample
  name: sntp_server
common:
  harness: net
  tags: net
tests:
  sample.net.sockets.sntp_server:
    platform_allow:
      - qemu_x86
      - native_sim
  sample.net.sockets.sntp_server.native:
    platform_allow:
      - native_sim
    integration_platforms:
      - native_sim
    extra_configs:
      - CONFIG_NATIVE_SIM_SLOWDOWN_TO_REAL_TIME=y
    extra_args:
      - EXTRA_CONF_FILE="overlay-nsos.conf"
```

## prj.conf
```kconfig
# SPDX-FileCopyrightText: Copyright The Zephyr Project Contributors
# SPDX-FileCopyrightText: Copyright Lothar Felten <lothar.felten@gmail.com>
# SPDX-License-Identifier: Apache-2.0

# General config
CONFIG_REQUIRES_FULL_LIBC=y
CONFIG_MAIN_STACK_SIZE=2048

# Networking config
CONFIG_NETWORKING=y
CONFIG_NET_IPV4=y
CONFIG_NET_IPV6=y
CONFIG_NET_UDP=y
CONFIG_NET_SHELL=y
CONFIG_NET_CONNECTION_MANAGER=y

# Sockets
CONFIG_NET_SOCKETS=y
CONFIG_NET_SOCKETS_SERVICE=y
CONFIG_ZVFS_POLL_MAX=6

# Network driver config
CONFIG_TEST_RANDOM_GENERATOR=y

# Network address config
CONFIG_NET_CONFIG_SETTINGS=y
CONFIG_NET_CONFIG_NEED_IPV4=y
CONFIG_NET_CONFIG_NEED_IPV6=y
CONFIG_NET_DHCPV4=y

# DNS, to resolve the name of the upstream SNTP server
CONFIG_DNS_RESOLVER=y
CONFIG_NET_SOCKETS_DNS_TIMEOUT=12000

# SNTP client, used to set the system clock at startup
CONFIG_SNTP=y

# SNTP server
CONFIG_SNTP_SERVER=y

# Network debug config
CONFIG_NET_LOG=y
CONFIG_LOG=y
CONFIG_NET_SOCKETS_LOG_LEVEL_DBG=n
CONFIG_SNTP_LOG_LEVEL_DBG=n
```

## overlay-nsos.conf
```kconfig
# SPDX-FileCopyrightText: Copyright (c) 2025 Embeint Inc
# SPDX-FileCopyrightText: Copyright Lothar Felten <lothar.felten@gmail.com>
# SPDX-FileCopyrightText: Copyright The Zephyr Project Contributors
# SPDX-License-Identifier: Apache-2.0

CONFIG_ETH_NATIVE_TAP=n
CONFIG_NET_DRIVERS=y
CONFIG_NET_SOCKETS=y
CONFIG_NET_SOCKETS_OFFLOAD=y
CONFIG_NET_NATIVE_OFFLOADED_SOCKETS=y
CONFIG_HEAP_MEM_POOL_SIZE=4096

# IPv6 DAD requires lower level network interface access, below exposed socket-level access
CONFIG_NET_IPV6_DAD=n

# Sockets are offloaded to the host, so there is no L2 to run DHCP on, no
# address for net_config to wait for and no connectivity state for the
# connection manager to report.
CONFIG_NET_DHCPV4=n
CONFIG_NET_CONFIG_NEED_IPV4=n
CONFIG_NET_CONFIG_NEED_IPV6=n
CONFIG_NET_CONNECTION_MANAGER=n

# Note that the host refuses to bind the SNTP port to an unprivileged process,
# so the server side of this sample only builds here, it does not serve.
```

## src/main.c
```c
/*
 * SPDX-FileCopyrightText: Copyright The Zephyr Project Contributors
 * SPDX-FileCopyrightText: Copyright 2025 L. Felten <lothar.felten@gmail.com>
 * SPDX-License-Identifier: Apache-2.0
 */

#include <zephyr/logging/log.h>
LOG_MODULE_REGISTER(sntp_demo, LOG_LEVEL_DBG);

#include <zephyr/net/sntp.h>
#include <zephyr/net/sntp_server.h>
#include <zephyr/sys/clock.h>
#include <zephyr/net/conn_mgr_monitor.h>
#include "net_sample_common.h"

#define FRAC2NS(x) (uint32_t)((((uint64_t)(x)) * NSEC_PER_SEC) >> 32)

/* Reference identifier of our clock source, RFC5905 Fig.12. Four ASCII
 * characters, left justified and zero padded.
 */
static const uint8_t sntp_ref_id[4] = {'X', 'D', 'E', 'V'};

int main(void)
{
	struct sntp_time t;
	struct timespec tp;
	int ret;

	LOG_INF("Waiting for network...");
	(void)conn_mgr_wait_ready(CONN_MGR_READY_IP_ANY, NULL, K_FOREVER);
	LOG_INF("Network ready");

	/* Empty string literal, so the option was left at its default */
	if (sizeof(CONFIG_NET_SAMPLE_SNTP_UPSTREAM_ADDRESS) == 1) {
		LOG_WRN("No upstream SNTP server configured, serving unsynchronized time. "
			"Set CONFIG_NET_SAMPLE_SNTP_UPSTREAM_ADDRESS to synchronize.");
		return 0;
	}

	ret = sntp_simple(CONFIG_NET_SAMPLE_SNTP_UPSTREAM_ADDRESS,
			  CONFIG_NET_SAMPLE_SNTP_UPSTREAM_TIMEOUT_MS, &t);
	if (ret < 0) {
		LOG_ERR("SNTP client error (%d)", ret);
		return 0;
	}

	tp.tv_sec = t.seconds;
	tp.tv_nsec = FRAC2NS(t.fraction);
	ret = sys_clock_settime(SYS_CLOCK_REALTIME, &tp);
	if (ret < 0) {
		LOG_ERR("SNTP unable to set system time (%d)", ret);
		return 0;
	}

	/* We are one hop away from the server we just queried, so we serve
	 * time at its stratum + 1. Assume a stratum 1 upstream here.
	 */
	sntp_server_clock_source(sntp_ref_id, 2, -6);
	LOG_INF("SNTP service ready");

	return 0;
}
```
