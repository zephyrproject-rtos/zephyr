## CMakeLists.txt
```
# SPDX-License-Identifier: Apache-2.0

cmake_minimum_required(VERSION 3.20.0)

find_package(Zephyr REQUIRED HINTS $ENV{ZEPHYR_BASE})
project(http_get_mtls)

FILE(GLOB app_sources src/*.c)
target_sources(app PRIVATE ${app_sources})

include(${ZEPHYR_BASE}/samples/net/common/common.cmake)
```

## sample.yaml
```
sample:
  description: BSD Sockets API HTTP GET example with mTLS
  name: socket_mtls_http_get
common:
  filter: TOOLCHAIN_HAS_NEWLIB == 1
  harness: net
  min_ram: 32
  min_flash: 80
  tags: net socket mtls
tests:
  sample.net.sockets.http_get:
    extra_configs:
      - CONFIG_NET_SOCKETS_POSIX_NAMES=y
    # Forcibly defines CONFIG_POSIX_API, which is incompatible with
    # CONFIG_NET_SOCKETS_POSIX_NAMES.
  sample.net.sockets.http_get.posix:
    filter: not CONFIG_NET_SOCKETS_OFFLOAD
    platform_exclude: cc3220sf_launchxl cc3235sf_launchxl
    extra_configs:
      - CONFIG_NET_SOCKETS_POSIX_NAMES=n
      - CONFIG_POSIX_API=y
  sample.net.sockets.http_get.offload.simplelink:
    platform_allow: cc3220sf_launchxl
    tags: net socket offload simplelink
```

## prj.conf
```kconfig
# General config
CONFIG_MAIN_STACK_SIZE=4096
CONFIG_NEWLIB_LIBC=y

# Networking config
CONFIG_NETWORKING=y
CONFIG_NET_IPV4=y
CONFIG_NET_IPV6=y
CONFIG_NET_TCP=y
CONFIG_NET_SOCKETS=y
CONFIG_NET_SOCKETS_POSIX_NAMES=y
CONFIG_NET_SOCKETS_SOCKOPT_TLS=y

# Network debug config
CONFIG_NET_LOG=y

CONFIG_DNS_RESOLVER=y
CONFIG_DNS_SERVER_IP_ADDRESSES=y
CONFIG_DNS_SERVER1="192.0.2.2"

# Network driver config
CONFIG_TEST_RANDOM_GENERATOR=y

# Network address config
CONFIG_NET_CONFIG_SETTINGS=y
CONFIG_NET_CONFIG_NEED_IPV4=y
CONFIG_NET_CONFIG_MY_IPV4_ADDR="192.0.2.1"
CONFIG_NET_CONFIG_PEER_IPV4_ADDR="192.0.2.2"
CONFIG_NET_CONFIG_MY_IPV4_GW="192.0.2.2"

# TLS configuration
CONFIG_MBEDTLS=y
CONFIG_MBEDTLS_PEM_CERTIFICATE_FORMAT=y
CONFIG_MBEDTLS_KEY_EXCHANGE_ECDHE_RSA_ENABLED=y
CONFIG_MBEDTLS_ECP_ALL_ENABLED=y
CONFIG_MBEDTLS_CIPHER_GCM_ENABLED=y
CONFIG_MBEDTLS_BUILTIN=y
CONFIG_MBEDTLS_ENABLE_HEAP=y
CONFIG_MBEDTLS_HEAP_SIZE=20000
CONFIG_MBEDTLS_SSL_MAX_CONTENT_LEN=7168
```

## src/ca.crt.c
```c
unsigned char ca_crt[] = {
  0x30, 0x82, 0x03, 0x01, 0x30, 0x82, 0x01, 0xe9, 0xa0, 0x03, 0x02, 0x01,
  0x02, 0x02, 0x14, 0x58, 0x94, 0x79, 0xf4, 0x5c, 0x29, 0x1d, 0x8f, 0x33,
  0x56, 0xec, 0xe1, 0xff, 0x7d, 0x7e, 0xee, 0x6d, 0xda, 0x41, 0x59, 0x30,
  0x0d, 0x06, 0x09, 0x2a, 0x86, 0x48, 0x86, 0xf7, 0x0d, 0x01, 0x01, 0x0b,
  0x05, 0x00, 0x30, 0x10, 0x31, 0x0e, 0x30, 0x0c, 0x06, 0x03, 0x55, 0x04,
  0x03, 0x0c, 0x05, 0x6d, 0x79, 0x2d, 0x63, 0x61, 0x30, 0x1e, 0x17, 0x0d,
  0x32, 0x31, 0x31, 0x31, 0x31, 0x37, 0x32, 0x32, 0x34, 0x38, 0x32, 0x35,
  0x5a, 0x17, 0x0d, 0x32, 0x32, 0x31, 0x31, 0x31, 0x37, 0x32, 0x32, 0x34,
  0x38, 0x32, 0x35, 0x5a, 0x30, 0x10, 0x31, 0x0e, 0x30, 0x0c, 0x06, 0x03,
  0x55, 0x04, 0x03, 0x0c, 0x05, 0x6d, 0x79, 0x2d, 0x63, 0x61, 0x30, 0x82,
  0x01, 0x22, 0x30, 0x0d, 0x06, 0x09, 0x2a, 0x86, 0x48, 0x86, 0xf7, 0x0d,
  0x01, 0x01, 0x01, 0x05, 0x00, 0x03, 0x82, 0x01, 0x0f, 0x00, 0x30, 0x82,
  0x01, 0x0a, 0x02, 0x82, 0x01, 0x01, 0x00, 0xdc, 0x90, 0x51, 0x90, 0x7e,
  0x1e, 0xf1, 0x6e, 0xeb, 0xd5, 0x2c, 0x08, 0xd0, 0xdf, 0x72, 0xdf, 0x32,
  0x50, 0xe7, 0x27, 0x85, 0x51, 0xaf, 0xa3, 0xb9, 0xb1, 0x8c, 0x5a, 0xa5,
  0x92, 0x77, 0xda, 0x80, 0xd5, 0xe0, 0x50, 0x9e, 0x59, 0x67, 0xc0, 0x34,
  0xa9, 0xd0, 0x61, 0xed, 0x62, 0x1e, 0x64, 0xcb, 0x8c, 0xc4, 0x39, 0x4d,
  0x31, 0x53, 0xdc, 0xf4, 0x79, 0x6f, 0x3a, 0x1b, 0xa2, 0xa2, 0x04, 0x4d,
  0xaa, 0x36, 0x8f, 0x65, 0xf6, 0x04, 0xf9, 0x4c, 0x92, 0x75, 0x28, 0x9c,
  0xa7, 0x0f, 0x62, 0x03, 0xf9, 0xa9, 0x00, 0x28, 0x49, 0x70, 0xba, 0x1b,
  0xb5, 0x69, 0x39, 0x10, 0x39, 0x74, 0xfa, 0x31, 0xfa, 0x8e, 0x39, 0x30,
  0xc0, 0x43, 0xaa, 0x75, 0xa1, 0xc5, 0x55, 0x27, 0xe0, 0xfa, 0x26, 0xcd,
  0xbf, 0xd8, 0x37, 0xc5, 0x79, 0x79, 0xd9, 0xe2, 0x93, 0xd7, 0x95, 0x27,
  0x6a, 0x8e, 0xbd, 0x1e, 0x8f, 0xf9, 0xd5, 0x40, 0x18, 0x6c, 0x5a, 0xb9,
  0x00, 0x75, 0x8d, 0x62, 0xc5, 0x8a, 0xb2, 0x68, 0x6b, 0x01, 0xcb, 0xa3,
  0xbd, 0xc0, 0x33, 0x75, 0x98, 0x03, 0x1e, 0xfe, 0x7a, 0x69, 0x5f, 0xf1,
  0x0d, 0x25, 0x93, 0xa2, 0xe1, 0x28, 0xce, 0xbe, 0x57, 0x50, 0xcf, 0xab,
  0xb8, 0x1b, 0xfe, 0xf2, 0xd4, 0x93, 0x5d, 0x9e, 0x97, 0xfe, 0xa6, 0xd4,
  0xf7, 0x5d, 0xb1, 0x4c, 0xbc, 0x37, 0xbd, 0xc0, 0x15, 0x39, 0xce, 0x17,
  0x52, 0xa8, 0x8d, 0x8f, 0x2d, 0x2d, 0x7f, 0x85, 0x94, 0x4c, 0x60, 0x28,
  0xb9, 0xfd, 0x7e, 0xd3, 0x28, 0x6a, 0x3a, 0xdf, 0x93, 0xf9, 0xd3, 0x8b,
  0x76, 0xf0, 0xca, 0xca, 0xe6, 0x88, 0x33, 0xf4, 0x0d, 0x20, 0x75, 0x3b,
  0xee, 0x46, 0x4b, 0xf5, 0x2b, 0x85, 0x92, 0x1c, 0x68, 0xd3, 0xee, 0x11,
  0x60, 0xdc, 0xc1, 0x77, 0x85, 0xe1, 0xe5, 0x65, 0x1c, 0x03, 0x2d, 0x02,
  0x03, 0x01, 0x00, 0x01, 0xa3, 0x53, 0x30, 0x51, 0x30, 0x1d, 0x06, 0x03,
  0x55, 0x1d, 0x0e, 0x04, 0x16, 0x04, 0x14, 0x5b, 0xf6, 0x60, 0x5d, 0x2b,
  0x81, 0x87, 0x2d, 0xad, 0x93, 0xc0, 0x5b, 0x3e, 0xb9, 0xe2, 0x9a, 0xc5,
  0xfc, 0x1d, 0x67, 0x30, 0x1f, 0x06, 0x03, 0x55, 0x1d, 0x23, 0x04, 0x18,
  0x30, 0x16, 0x80, 0x14, 0x5b, 0xf6, 0x60, 0x5d, 0x2b, 0x81, 0x87, 0x2d,
  0xad, 0x93, 0xc0, 0x5b, 0x3e, 0xb9, 0xe2, 0x9a, 0xc5, 0xfc, 0x1d, 0x67,
  0x30, 0x0f, 0x06, 0x03, 0x55, 0x1d, 0x13, 0x01, 0x01, 0xff, 0x04, 0x05,
  0x30, 0x03, 0x01, 0x01, 0xff, 0x30, 0x0d, 0x06, 0x09, 0x2a, 0x86, 0x48,
  0x86, 0xf7, 0x0d, 0x01, 0x01, 0x0b, 0x05, 0x00, 0x03, 0x82, 0x01, 0x01,
  0x00, 0x1d, 0x1c, 0x9b, 0xdb, 0xd2, 0x59, 0xb4, 0xc9, 0x54, 0x82, 0x0d,
  0x65, 0x93, 0x50, 0x43, 0xab, 0x1f, 0x1a, 0x43, 0xef, 0xc0, 0x64, 0x6c,
  0x42, 0x59, 0x9c, 0x97, 0x9a, 0x88, 0x11, 0x57, 0xa9, 0xae, 0x43, 0x80,
  0x5d, 0x86, 0x6c, 0x60, 0x4f, 0x7f, 0x34, 0xc5, 0xbd, 0xe8, 0x00, 0xe7,
  0x9e, 0xd2, 0x51, 0x14, 0x14, 0x9d, 0xf3, 0xa3, 0xc3, 0x2c, 0x10, 0xac,
  0xad, 0x49, 0xac, 0x44, 0x91, 0x9d, 0x68, 0x83, 0x66, 0x6a, 0xee, 0xd2,
  0x13, 0x74, 0x90, 0x99, 0xd2, 0xf8, 0xda, 0x37, 0xc8, 0x47, 0x54, 0x7c,
  0x54, 0x24, 0x62, 0xa1, 0x44, 0xfe, 0x5e, 0x8e, 0xe8, 0xf9, 0xd4, 0xa9,
  0x22, 0x98, 0x1c, 0xc5, 0x4c, 0xaa, 0x28, 0xf1, 0x04, 0xbb, 0x73, 0x03,
  0x7a, 0xad, 0x8a, 0xbd, 0x92, 0x70, 0x11, 0x70, 0xfa, 0xd9, 0xa7, 0x1c,
  0x0e, 0x62, 0x61, 0xba, 0x6a, 0xc4, 0x2c, 0xa6, 0x7b, 0x03, 0xcb, 0x44,
  0x7a, 0xb9, 0x0a, 0xcc, 0xbc, 0x0d, 0x1e, 0xb3, 0x7c, 0x0a, 0xf7, 0xc4,
  0x2d, 0x6d, 0xb1, 0x9d, 0x45, 0x37, 0x1b, 0xf1, 0x23, 0x3d, 0x4e, 0xf5,
  0x33, 0x6f, 0xe7, 0x03, 0xce, 0xd7, 0x34, 0x99, 0x63, 0xd0, 0xb1, 0x66,
  0x04, 0xd6, 0xef, 0xac, 0x6c, 0x54, 0x39, 0x6f, 0x8f, 0x2a, 0x6e, 0xa2,
  0x09, 0x6d, 0x9a, 0x2d, 0xb8, 0xea, 0x52, 0xc9, 0xe9, 0xa9, 0x55, 0x5a,
  0xe5, 0x4b, 0x9b, 0xd6, 0x82, 0x85, 0x6c, 0xbd, 0x6e, 0x37, 0x09, 0x83,
  0x14, 0xbc, 0xa5, 0xc8, 0x6e, 0x49, 0xfe, 0x81, 0xe6, 0xbd, 0xbf, 0xc2,
  0x97, 0xe7, 0x0a, 0xad, 0x44, 0x99, 0x2c, 0x0b, 0x3d, 0xf2, 0x82, 0xa3,
  0x35, 0x40, 0xf0, 0x2a, 0x3e, 0x56, 0x85, 0x31, 0x7a, 0xec, 0x3c, 0x3f,
  0x67, 0xf0, 0xc6, 0x32, 0x7c, 0x84, 0xb1, 0xfc, 0x4d, 0x80, 0xcd, 0x35,
  0x4d, 0x5d, 0xae, 0x38, 0x4d
};
unsigned int ca_crt_len = 773;
```

## src/ca_certificate.h
```c
/*
 * Copyright (c) 2018 Nordic Semiconductor ASA
 *
 * SPDX-License-Identifier: Apache-2.0
 */

#ifndef __CA_CERTIFICATE_H__
#define __CA_CERTIFICATE_H__

#define CA_CERTIFICATE_TAG 1

/* By default only certificates in DER format are supported. If you want to use
 * certificate in PEM format, you can enable support for it in Kconfig.
 */

extern const unsigned char ca_crt[];
extern const unsigned int ca_crt_len;
extern const unsigned char client_crt[];
extern const unsigned int client_crt_len;
extern const unsigned char client_key[];
extern const unsigned int client_key_len;

#endif /* __CA_CERTIFICATE_H__ */
```

## src/client.crt.c
```c
unsigned char client_crt[] = {
  0x30, 0x82, 0x02, 0xf1, 0x30, 0x82, 0x01, 0xd9, 0xa0, 0x03, 0x02, 0x01,
  0x02, 0x02, 0x14, 0x60, 0xa9, 0x9a, 0x3c, 0x1a, 0x39, 0x58, 0xac, 0xdf,
  0xa0, 0xf0, 0x41, 0x26, 0x14, 0xf0, 0x7b, 0x59, 0xb7, 0x84, 0x82, 0x30,
  0x0d, 0x06, 0x09, 0x2a, 0x86, 0x48, 0x86, 0xf7, 0x0d, 0x01, 0x01, 0x0b,
  0x05, 0x00, 0x30, 0x10, 0x31, 0x0e, 0x30, 0x0c, 0x06, 0x03, 0x55, 0x04,
  0x03, 0x0c, 0x05, 0x6d, 0x79, 0x2d, 0x63, 0x61, 0x30, 0x1e, 0x17, 0x0d,
  0x32, 0x31, 0x31, 0x31, 0x31, 0x37, 0x32, 0x32, 0x34, 0x38, 0x32, 0x35,
  0x5a, 0x17, 0x0d, 0x32, 0x32, 0x31, 0x31, 0x31, 0x37, 0x32, 0x32, 0x34,
  0x38, 0x32, 0x35, 0x5a, 0x30, 0x11, 0x31, 0x0f, 0x30, 0x0d, 0x06, 0x03,
  0x55, 0x04, 0x03, 0x0c, 0x06, 0x63, 0x6c, 0x69, 0x65, 0x6e, 0x74, 0x30,
  0x82, 0x01, 0x22, 0x30, 0x0d, 0x06, 0x09, 0x2a, 0x86, 0x48, 0x86, 0xf7,
  0x0d, 0x01, 0x01, 0x01, 0x05, 0x00, 0x03, 0x82, 0x01, 0x0f, 0x00, 0x30,
  0x82, 0x01, 0x0a, 0x02, 0x82, 0x01, 0x01, 0x00, 0xd6, 0x6a, 0x6c, 0x47,
  0x7c, 0x5b, 0xf8, 0xd1, 0x0e, 0x0b, 0xb2, 0x82, 0x1a, 0x2a, 0xaa, 0x38,
  0xe6, 0x59, 0x0d, 0xcf, 0x6d, 0xfe, 0xff, 0xde, 0xca, 0x9c, 0x30, 0x83,
  0x6f, 0x13, 0x49, 0x85, 0xdd, 0x68, 0xbc, 0x88, 0x3e, 0x88, 0x94, 0x29,
  0x43, 0x84, 0x8d, 0x59, 0xda, 0x8d, 0xe2, 0x3d, 0x82, 0x34, 0x49, 0x70,
  0x46, 0x81, 0x05, 0x7b, 0x4d, 0xac, 0xad, 0xb9, 0xc6, 0x54, 0x5f, 0x0c,
  0xe7, 0x55, 0xe2, 0x89, 0xd3, 0xa7, 0xa4, 0x4d, 0xa8, 0x22, 0x6b, 0x49,
  0xb4, 0x47, 0xad, 0xbd, 0x2e, 0x2e, 0xcd, 0xc0, 0xcf, 0x72, 0xfc, 0xf8,
  0xe9, 0x4b, 0xd4, 0xec, 0x3f, 0x78, 0x94, 0x88, 0x2a, 0x4c, 0xec, 0x17,
  0xb7, 0x56, 0xb2, 0x19, 0xc6, 0x18, 0xd8, 0xbe, 0x4b, 0xca, 0xd6, 0x6f,
  0x0a, 0xd4, 0x77, 0x9d, 0x8b, 0x48, 0x00, 0x8e, 0x74, 0xa2, 0x27, 0x83,
  0xd0, 0x9d, 0xd6, 0x23, 0xa6, 0xa8, 0xea, 0x19, 0xae, 0x3a, 0xa3, 0xf6,
  0xcc, 0xe0, 0xcf, 0x26, 0xd5, 0x2a, 0x86, 0x26, 0x96, 0xb7, 0xdc, 0x36,
  0x98, 0x4d, 0xe0, 0x3c, 0x9e, 0xc2, 0xfe, 0x7d, 0xd4, 0x09, 0x83, 0xda,
  0xb5, 0xf9, 0x79, 0xcf, 0xf8, 0x47, 0xe3, 0xc1, 0x84, 0x20, 0xa8, 0x41,
  0x8c, 0xb6, 0x2b, 0xb3, 0xc1, 0x86, 0x55, 0x74, 0x02, 0x22, 0x72, 0x09,
  0x64, 0x4a, 0xd4, 0x64, 0x93, 0x74, 0x3e, 0x8a, 0xe1, 0xcd, 0xfa, 0xb1,
  0x94, 0x8b, 0x06, 0x8e, 0xa2, 0x81, 0x7d, 0x71, 0x03, 0x83, 0xd4, 0xa1,
  0x62, 0x0a, 0x52, 0x46, 0x22, 0x3d, 0x9e, 0x17, 0x02, 0xb4, 0x5b, 0x45,
  0xe3, 0xf5, 0x4c, 0x73, 0x20, 0x8a, 0x30, 0xc8, 0xb8, 0x61, 0x58, 0x70,
  0x58, 0x9b, 0x98, 0xa7, 0x7b, 0x47, 0xca, 0x7a, 0xf6, 0xdd, 0x37, 0xb6,
  0x72, 0x11, 0x33, 0x99, 0x91, 0xbb, 0xcf, 0xaa, 0x01, 0x55, 0xf3, 0xeb,
  0x02, 0x03, 0x01, 0x00, 0x01, 0xa3, 0x42, 0x30, 0x40, 0x30, 0x1d, 0x06,
  0x03, 0x55, 0x1d, 0x0e, 0x04, 0x16, 0x04, 0x14, 0x46, 0xc5, 0x92, 0x32,
  0x2d, 0x69, 0x7b, 0x28, 0xe4, 0xff, 0x02, 0x88, 0x21, 0x6c, 0xd5, 0xa0,
  0x95, 0x39, 0xd5, 0x29, 0x30, 0x1f, 0x06, 0x03, 0x55, 0x1d, 0x23, 0x04,
  0x18, 0x30, 0x16, 0x80, 0x14, 0x5b, 0xf6, 0x60, 0x5d, 0x2b, 0x81, 0x87,
  0x2d, 0xad, 0x93, 0xc0, 0x5b, 0x3e, 0xb9, 0xe2, 0x9a, 0xc5, 0xfc, 0x1d,
  0x67, 0x30, 0x0d, 0x06, 0x09, 0x2a, 0x86, 0x48, 0x86, 0xf7, 0x0d, 0x01,
  0x01, 0x0b, 0x05, 0x00, 0x03, 0x82, 0x01, 0x01, 0x00, 0x15, 0x04, 0x17,
  0xca, 0xa3, 0x3b, 0xbf, 0xc8, 0x48, 0xe2, 0xbf, 0xe9, 0x4e, 0x2a, 0x04,
  0xcd, 0xb4, 0x8f, 0xae, 0x6f, 0x8d, 0x12, 0x5f, 0xf0, 0x2b, 0x8e, 0xcb,
  0xe1, 0x78, 0x44, 0x68, 0x02, 0xea, 0x9d, 0x94, 0x68, 0x6e, 0xdd, 0x03,
  0x73, 0x5b, 0x0b, 0x77, 0x8b, 0xf9, 0x7f, 0x89, 0x2a, 0xb3, 0xcd, 0x91,
  0x5b, 0x07, 0x09, 0x36, 0x2f, 0xdf, 0x60, 0x3c, 0x77, 0x24, 0xeb, 0x48,
  0x49, 0x9f, 0x8c, 0x3e, 0x34, 0x06, 0xa0, 0xb0, 0x9f, 0xda, 0xce, 0x3f,
  0x84, 0xc5, 0xad, 0x64, 0x5f, 0x91, 0x6e, 0x92, 0x72, 0xe9, 0x15, 0x8e,
  0xb8, 0x26, 0x25, 0x44, 0x15, 0x9e, 0x67, 0x22, 0x89, 0x0c, 0x6e, 0x09,
  0x35, 0x7b, 0x33, 0x7d, 0x5b, 0x99, 0xf9, 0x24, 0xdd, 0xa5, 0x12, 0x52,
  0x7c, 0xab, 0xc4, 0x26, 0x44, 0x90, 0x1f, 0x04, 0x3e, 0x21, 0x25, 0xd1,
  0xb2, 0x84, 0xa1, 0x11, 0xcd, 0x68, 0x61, 0xb8, 0x3d, 0xdc, 0x88, 0x72,
  0x63, 0x04, 0x3e, 0x98, 0x22, 0x88, 0xf6, 0x9d, 0xb2, 0x74, 0x0c, 0x49,
  0x4b, 0xcf, 0x66, 0x35, 0x2f, 0x77, 0xbe, 0xec, 0xbc, 0x74, 0x86, 0x64,
  0xa6, 0x8f, 0xfe, 0x7d, 0x6a, 0x66, 0x33, 0xc5, 0x6b, 0x8c, 0xec, 0xf0,
  0xc8, 0x52, 0xd9, 0x8c, 0xb6, 0x94, 0x08, 0x20, 0x4e, 0x5b, 0xcc, 0x5b,
  0xeb, 0x4c, 0xbe, 0x10, 0x7b, 0xc6, 0x7d, 0x83, 0x30, 0x30, 0x9e, 0xa3,
  0x99, 0x13, 0x91, 0xe0, 0x33, 0x98, 0xc9, 0x97, 0x25, 0xfb, 0x6a, 0xbd,
  0xe0, 0x61, 0xfa, 0x39, 0x4c, 0x65, 0xc9, 0xd3, 0x85, 0x8f, 0xf8, 0x8b,
  0x6c, 0xe3, 0xe2, 0x1b, 0x5d, 0x5e, 0x09, 0xa8, 0xde, 0xc5, 0xd4, 0xfb,
  0x19, 0xd5, 0xe5, 0xac, 0x22, 0x41, 0x19, 0x15, 0x5a, 0x5f, 0x29, 0xdf,
  0x40, 0x48, 0xff, 0xa0, 0x5d, 0x35, 0x02, 0xb4, 0x41, 0x72, 0x1e, 0x7d,
  0x7b
};
unsigned int client_crt_len = 757;
```

## src/client.key.c
```c
unsigned char client_key[] = {
  0x30, 0x82, 0x04, 0xa4, 0x02, 0x01, 0x00, 0x02, 0x82, 0x01, 0x01, 0x00,
  0xd6, 0x6a, 0x6c, 0x47, 0x7c, 0x5b, 0xf8, 0xd1, 0x0e, 0x0b, 0xb2, 0x82,
  0x1a, 0x2a, 0xaa, 0x38, 0xe6, 0x59, 0x0d, 0xcf, 0x6d, 0xfe, 0xff, 0xde,
  0xca, 0x9c, 0x30, 0x83, 0x6f, 0x13, 0x49, 0x85, 0xdd, 0x68, 0xbc, 0x88,
  0x3e, 0x88, 0x94, 0x29, 0x43, 0x84, 0x8d, 0x59, 0xda, 0x8d, 0xe2, 0x3d,
  0x82, 0x34, 0x49, 0x70, 0x46, 0x81, 0x05, 0x7b, 0x4d, 0xac, 0xad, 0xb9,
  0xc6, 0x54, 0x5f, 0x0c, 0xe7, 0x55, 0xe2, 0x89, 0xd3, 0xa7, 0xa4, 0x4d,
  0xa8, 0x22, 0x6b, 0x49, 0xb4, 0x47, 0xad, 0xbd, 0x2e, 0x2e, 0xcd, 0xc0,
  0xcf, 0x72, 0xfc, 0xf8, 0xe9, 0x4b, 0xd4, 0xec, 0x3f, 0x78, 0x94, 0x88,
  0x2a, 0x4c, 0xec, 0x17, 0xb7, 0x56, 0xb2, 0x19, 0xc6, 0x18, 0xd8, 0xbe,
  0x4b, 0xca, 0xd6, 0x6f, 0x0a, 0xd4, 0x77, 0x9d, 0x8b, 0x48, 0x00, 0x8e,
  0x74, 0xa2, 0x27, 0x83, 0xd0, 0x9d, 0xd6, 0x23, 0xa6, 0xa8, 0xea, 0x19,
  0xae, 0x3a, 0xa3, 0xf6, 0xcc, 0xe0, 0xcf, 0x26, 0xd5, 0x2a, 0x86, 0x26,
  0x96, 0xb7, 0xdc, 0x36, 0x98, 0x4d, 0xe0, 0x3c, 0x9e, 0xc2, 0xfe, 0x7d,
  0xd4, 0x09, 0x83, 0xda, 0xb5, 0xf9, 0x79, 0xcf, 0xf8, 0x47, 0xe3, 0xc1,
  0x84, 0x20, 0xa8, 0x41, 0x8c, 0xb6, 0x2b, 0xb3, 0xc1, 0x86, 0x55, 0x74,
  0x02, 0x22, 0x72, 0x09, 0x64, 0x4a, 0xd4, 0x64, 0x93, 0x74, 0x3e, 0x8a,
  0xe1, 0xcd, 0xfa, 0xb1, 0x94, 0x8b, 0x06, 0x8e, 0xa2, 0x81, 0x7d, 0x71,
  0x03, 0x83, 0xd4, 0xa1, 0x62, 0x0a, 0x52, 0x46, 0x22, 0x3d, 0x9e, 0x17,
  0x02, 0xb4, 0x5b, 0x45, 0xe3, 0xf5, 0x4c, 0x73, 0x20, 0x8a, 0x30, 0xc8,
  0xb8, 0x61, 0x58, 0x70, 0x58, 0x9b, 0x98, 0xa7, 0x7b, 0x47, 0xca, 0x7a,
  0xf6, 0xdd, 0x37, 0xb6, 0x72, 0x11, 0x33, 0x99, 0x91, 0xbb, 0xcf, 0xaa,
  0x01, 0x55, 0xf3, 0xeb, 0x02, 0x03, 0x01, 0x00, 0x01, 0x02, 0x82, 0x01,
  0x00, 0x4a, 0xe7, 0xac, 0xe2, 0x20, 0x58, 0xc5, 0x08, 0xcb, 0x7e, 0x5c,
  0xa3, 0x44, 0xde, 0xe8, 0xce, 0xad, 0xf2, 0x28, 0x77, 0xf1, 0xb6, 0x66,
  0xce, 0xff, 0x3b, 0x27, 0x5b, 0x93, 0x3f, 0x4a, 0xad, 0x20, 0x57, 0x49,
  0x9d, 0xd3, 0x32, 0xc5, 0x87, 0xd0, 0xd5, 0x8a, 0xc7, 0xfc, 0x29, 0x1b,
  0x03, 0x5f, 0xec, 0x42, 0x47, 0x9d, 0xe9, 0xce, 0xef, 0x6f, 0x88, 0x46,
  0xbc, 0xa2, 0xc3, 0xb0, 0xdd, 0x02, 0x28, 0x27, 0xd6, 0xfc, 0x81, 0x11,
  0x4e, 0x2b, 0xd1, 0xb2, 0x67, 0x72, 0x3a, 0xa4, 0x40, 0x75, 0xd4, 0xd5,
  0xfe, 0x68, 0xba, 0x84, 0x13, 0xb4, 0xf4, 0xcf, 0xf2, 0xa4, 0x8d, 0xcc,
  0x5d, 0xf1, 0x61, 0x24, 0x0d, 0x78, 0xf8, 0x29, 0x8a, 0x05, 0x81, 0x82,
  0x9e, 0xa0, 0x3d, 0xc1, 0x41, 0xd3, 0xa7, 0xbc, 0x0d, 0xe6, 0xad, 0x85,
  0xbc, 0x3e, 0x94, 0xb3, 0x77, 0x42, 0x37, 0x11, 0xaa, 0x88, 0xfa, 0x7e,
  0xdd, 0xd2, 0xa5, 0xda, 0x9a, 0x94, 0x18, 0x3f, 0xa4, 0x22, 0xa7, 0x9a,
  0x84, 0xde, 0x5d, 0xe6, 0x3b, 0x55, 0x0e, 0x0c, 0xfd, 0x27, 0xb8, 0xe7,
  0xf5, 0xd0, 0x72, 0x76, 0x32, 0xd3, 0x52, 0x13, 0x76, 0x43, 0x30, 0x92,
  0x75, 0xb3, 0x39, 0xb5, 0xd3, 0x6d, 0xec, 0xa4, 0xc4, 0xed, 0x1d, 0xa3,
  0x5f, 0x88, 0xb9, 0x45, 0xf1, 0x47, 0xed, 0xfa, 0x98, 0xad, 0x71, 0xa2,
  0x89, 0x09, 0xaa, 0xcb, 0x66, 0x48, 0x3f, 0x16, 0x48, 0xd1, 0xcb, 0xa9,
  0x45, 0xa4, 0x19, 0x48, 0xa4, 0x18, 0x74, 0x3f, 0x64, 0xf3, 0x12, 0x38,
  0x0b, 0xb5, 0xff, 0xd0, 0xc8, 0x54, 0xfd, 0xdf, 0xf4, 0xf2, 0x90, 0x77,
  0xbb, 0x93, 0x05, 0xf6, 0x7a, 0xea, 0x1a, 0xd3, 0x4a, 0x5f, 0xde, 0xe6,
  0x71, 0xfe, 0xcd, 0x12, 0x83, 0x27, 0x30, 0x3e, 0x35, 0xe4, 0xe9, 0x56,
  0xa8, 0x90, 0xed, 0x0e, 0xf9, 0x02, 0x81, 0x81, 0x00, 0xf0, 0x92, 0xbd,
  0x4e, 0xf1, 0x91, 0x62, 0x7c, 0xc8, 0x93, 0x55, 0xbb, 0x97, 0x7a, 0x35,
  0x59, 0x5e, 0xec, 0x2a, 0x11, 0xed, 0x52, 0x7c, 0x79, 0x48, 0x16, 0xf0,
  0xf5, 0x37, 0x8f, 0x2e, 0xe3, 0x4d, 0x00, 0x35, 0xea, 0x6e, 0xe4, 0x88,
  0xca, 0xc5, 0xc6, 0x45, 0xbb, 0x96, 0x84, 0xf2, 0x1c, 0x90, 0x47, 0xf7,
  0x44, 0x04, 0x27, 0xdd, 0x03, 0x85, 0x54, 0x1f, 0x63, 0x84, 0xd1, 0x42,
  0x3a, 0xd0, 0x3a, 0x1f, 0xa2, 0x8f, 0x13, 0xc1, 0xc0, 0xa9, 0xd4, 0xd7,
  0xce, 0xc9, 0xac, 0xf8, 0x80, 0x2a, 0x2e, 0x3a, 0x5b, 0x7e, 0x97, 0x05,
  0x43, 0x8d, 0x5b, 0x1f, 0x06, 0x69, 0x23, 0x40, 0xec, 0xd5, 0xfe, 0xbd,
  0xac, 0x47, 0xc7, 0x87, 0x4b, 0x57, 0xde, 0xe5, 0x98, 0x07, 0x68, 0x43,
  0x81, 0xe7, 0x7e, 0x9b, 0xe7, 0x76, 0x00, 0x63, 0x01, 0x8c, 0x43, 0xfe,
  0x5b, 0x4d, 0xdb, 0xf9, 0x4d, 0x02, 0x81, 0x81, 0x00, 0xe4, 0x2a, 0x47,
  0xef, 0xe0, 0x47, 0x1c, 0xf3, 0xfc, 0xde, 0x6f, 0x18, 0x17, 0x98, 0xaa,
  0x34, 0x16, 0xbe, 0xee, 0x5d, 0x35, 0x9d, 0xec, 0x57, 0xaf, 0xbe, 0x39,
  0xf0, 0x3c, 0x95, 0x17, 0xd8, 0x63, 0x06, 0xb8, 0x0e, 0xa7, 0xa5, 0xa4,
  0x9f, 0xd8, 0x38, 0xf0, 0xc2, 0xe7, 0x4f, 0x15, 0x3b, 0xb4, 0xee, 0xcb,
  0x87, 0x7c, 0x71, 0x8b, 0xae, 0x21, 0x9d, 0x14, 0xe3, 0xa0, 0x87, 0x74,
  0xff, 0x86, 0xb4, 0x98, 0x25, 0xd8, 0xc2, 0x19, 0xb9, 0x2f, 0x22, 0x4f,
  0x18, 0xca, 0x4b, 0x2f, 0x09, 0x44, 0x33, 0x44, 0x14, 0xc9, 0xc9, 0xf6,
  0x73, 0x07, 0x5f, 0x71, 0x89, 0x89, 0x88, 0x72, 0xf7, 0x68, 0x8d, 0x19,
  0xe7, 0x9f, 0x0a, 0xef, 0x33, 0xa4, 0xe2, 0x57, 0xd4, 0x13, 0xc1, 0x0b,
  0x01, 0x46, 0x92, 0x60, 0x18, 0xce, 0xe0, 0x7b, 0xe7, 0x5d, 0x20, 0xd4,
  0x9b, 0x66, 0x45, 0xc6, 0x17, 0x02, 0x81, 0x81, 0x00, 0xb3, 0xe7, 0xe8,
  0xae, 0x4a, 0xb4, 0xc0, 0x84, 0x34, 0xb3, 0x09, 0xe0, 0x19, 0xad, 0x88,
  0x8b, 0xe7, 0x12, 0x91, 0x7b, 0x8a, 0x90, 0xaf, 0x09, 0x3b, 0xc1, 0xfc,
  0x3c, 0x45, 0x6a, 0x4c, 0x54, 0x2b, 0x57, 0x46, 0xfa, 0xa4, 0x27, 0x3f,
  0xac, 0xf4, 0x2e, 0x0c, 0x23, 0xf6, 0xb2, 0x41, 0x24, 0xdf, 0x39, 0x12,
  0x4e, 0xc9, 0x14, 0xce, 0x91, 0x3d, 0x79, 0xe5, 0x67, 0x55, 0x01, 0xf0,
  0x97, 0x6e, 0xf4, 0xa8, 0x87, 0xb6, 0x9b, 0xbd, 0xbf, 0x48, 0xc2, 0x25,
  0x09, 0x3d, 0x84, 0x9e, 0xe9, 0xa9, 0xa1, 0x9c, 0x7e, 0xa3, 0xb2, 0x68,
  0x7b, 0x56, 0x10, 0x98, 0xa9, 0x00, 0xa3, 0x1e, 0x80, 0x7e, 0x9f, 0xdc,
  0x54, 0x23, 0xf1, 0xb0, 0xd9, 0xc5, 0x42, 0xa9, 0x4c, 0x01, 0xee, 0x14,
  0xdd, 0xe6, 0xb2, 0xa6, 0x00, 0x78, 0x1c, 0x5d, 0xed, 0xe0, 0x69, 0x50,
  0xa4, 0x13, 0x1b, 0xb7, 0xd9, 0x02, 0x81, 0x80, 0x4f, 0xad, 0x4c, 0x2d,
  0xc2, 0x5e, 0x53, 0x08, 0x09, 0x18, 0x0c, 0x27, 0x97, 0xa5, 0xe2, 0x5a,
  0x0a, 0x4f, 0x66, 0xa1, 0xfa, 0x25, 0x49, 0xf1, 0x5d, 0x17, 0xca, 0xd7,
  0xcf, 0xf0, 0x28, 0xc1, 0x91, 0xe3, 0x38, 0xc7, 0x35, 0x58, 0x2c, 0xe2,
  0xfc, 0xf8, 0xf5, 0x6a, 0xba, 0xa7, 0xed, 0x3c, 0x4a, 0x74, 0xd1, 0x72,
  0x60, 0xcc, 0xae, 0x00, 0x83, 0x10, 0x7d, 0xc8, 0xf7, 0xb8, 0x15, 0xed,
  0x5d, 0xb7, 0x17, 0x22, 0xb0, 0x4d, 0x27, 0xfa, 0x79, 0x31, 0x3b, 0xf9,
  0xe6, 0x3a, 0xd7, 0x14, 0x1f, 0x52, 0xdf, 0xc5, 0x7a, 0xaa, 0x22, 0x7c,
  0x0c, 0xe9, 0x11, 0x96, 0xfc, 0x06, 0x40, 0x4f, 0x91, 0x9d, 0x24, 0x9c,
  0xb3, 0xf7, 0x77, 0x8c, 0xcb, 0x59, 0x97, 0x5e, 0x21, 0xff, 0xd9, 0xbd,
  0xfa, 0x4d, 0x07, 0x6d, 0xe2, 0x60, 0x96, 0x24, 0x37, 0x6b, 0x4d, 0x93,
  0x6e, 0xe5, 0x92, 0xc5, 0x02, 0x81, 0x81, 0x00, 0x87, 0xdb, 0x22, 0x67,
  0xda, 0x42, 0x13, 0x93, 0xd3, 0x66, 0x46, 0x17, 0x80, 0x4a, 0x09, 0x91,
  0xe8, 0xc9, 0x91, 0x71, 0xc7, 0xce, 0xed, 0xca, 0xe8, 0xa5, 0x3e, 0x89,
  0xef, 0x51, 0x19, 0x96, 0x70, 0xa5, 0x83, 0x83, 0x27, 0x21, 0x04, 0x27,
  0x1c, 0xf4, 0x26, 0xff, 0xb1, 0x16, 0x23, 0xcc, 0x8b, 0xe9, 0xd0, 0xf9,
  0x50, 0x0b, 0x16, 0xdb, 0x37, 0x4b, 0x97, 0x4c, 0xf4, 0xbb, 0x64, 0x39,
  0x7c, 0x27, 0x82, 0xca, 0x8e, 0xf4, 0x64, 0x20, 0x4b, 0x01, 0x4b, 0xd0,
  0xfc, 0xe9, 0xe0, 0x6e, 0x08, 0x2c, 0x68, 0xf4, 0x5d, 0x84, 0xb8, 0x26,
  0x08, 0x6e, 0x53, 0x39, 0x00, 0xe5, 0xeb, 0x94, 0xb6, 0x73, 0x73, 0xc0,
  0x8a, 0x05, 0x53, 0x52, 0x59, 0x61, 0xf4, 0xb8, 0x58, 0x88, 0x54, 0xe5,
  0x09, 0x3f, 0x68, 0x4c, 0xcd, 0xce, 0x14, 0x24, 0x26, 0x0f, 0x29, 0x8f,
  0x59, 0xeb, 0xa1, 0x78
};
unsigned int client_key_len = 1192;
```

## src/http_get.c
```c
/*
 * Copyright (c) 2017 Linaro Limited
 *
 * SPDX-License-Identifier: Apache-2.0
 */

#include <stdio.h>
#include <stdlib.h>

#if !defined(__ZEPHYR__) || defined(CONFIG_POSIX_API)

#include <netinet/in.h>
#include <sys/socket.h>
#include <arpa/inet.h>
#include <unistd.h>
#include <netdb.h>

#else

#include <net/socket.h>
#include <kernel.h>

#include <net/tls_credentials.h>
#include "ca_certificate.h"

#endif

/* HTTP server to connect to */
#define HTTP_HOST "192.0.2.2"
/* Port to connect to, as string */
#define HTTP_PORT "8443"
/* HTTP path to request */
#define HTTP_PATH "/"


#define SSTRLEN(s) (sizeof(s) - 1)
#define CHECK(r) { if (r == -1) { printf("Error: " #r "\n"); exit(1); } }

#define REQUEST "GET " HTTP_PATH " HTTP/1.0\r\nHost: " HTTP_HOST "\r\n\r\n"

static char response[1024];

void dump_addrinfo(const struct addrinfo *ai)
{
	printf("addrinfo @%p: ai_family=%d, ai_socktype=%d, ai_protocol=%d, "
	       "sa_family=%d, sin_port=%x\n",
	       ai, ai->ai_family, ai->ai_socktype, ai->ai_protocol,
	       ai->ai_addr->sa_family,
	       ((struct sockaddr_in *)ai->ai_addr)->sin_port);
}

void main(void)
{
	static struct addrinfo hints;
	struct addrinfo *res;
	int st, sock;

	tls_credential_add(CA_CERTIFICATE_TAG, TLS_CREDENTIAL_CA_CERTIFICATE,
			   ca_certificate, sizeof(ca_certificate));
	tls_credential_add(CA_CERTIFICATE_TAG, TLS_CREDENTIAL_SERVER_CERTIFICATE,
			   self_certificate, sizeof(self_certificate));
	tls_credential_add(CA_CERTIFICATE_TAG, TLS_CREDENTIAL_PRIVATE_KEY,
			   self_key, sizeof(self_key));

	printf("Preparing HTTP GET request for https://" HTTP_HOST
	       ":" HTTP_PORT HTTP_PATH "\n");

	hints.ai_family = AF_INET;
	hints.ai_socktype = SOCK_STREAM;
	st = getaddrinfo(HTTP_HOST, HTTP_PORT, &hints, &res);
	printf("getaddrinfo status: %d\n", st);

	if (st != 0) {
		printf("Unable to resolve address, quitting\n");
		return;
	}

	dump_addrinfo(res);

	sock = socket(res->ai_family, res->ai_socktype, IPPROTO_TLS_1_2);
	CHECK(sock);
	printf("sock = %d\n", sock);

	sec_tag_t sec_tag_opt[] = {
		CA_CERTIFICATE_TAG,
	};
	CHECK(setsockopt(sock, SOL_TLS, TLS_SEC_TAG_LIST,
			 sec_tag_opt, sizeof(sec_tag_opt)));

	CHECK(connect(sock, res->ai_addr, res->ai_addrlen));
	CHECK(send(sock, REQUEST, SSTRLEN(REQUEST), 0));

	printf("Response:\n\n");

	while (1) {
		int len = recv(sock, response, sizeof(response) - 1, 0);

		if (len < 0) {
			printf("Error reading response\n");
			return;
		}

		if (len == 0) {
			break;
		}

		response[len] = 0;
		printf("%s", response);
	}

	printf("\n");

	(void)close(sock);
}
```
