## CMakeLists.txt
```
# SPDX-License-Identifier: Apache-2.0

cmake_minimum_required(VERSION 3.20.0)
find_package(Zephyr REQUIRED HINTS $ENV{ZEPHYR_BASE})
project(http_client)

FILE(GLOB app_sources src/*.c)
target_sources(app PRIVATE ${app_sources})

set(gen_dir ${ZEPHYR_BINARY_DIR}/include/generated/)

generate_inc_file_for_target(
    app
    src/https-cert.der
    ${gen_dir}/https-cert.der.inc
    )
```

## Kconfig
```
# Private config options for http-client sample app

# Copyright (c) 2020 Intel Corporation
# SPDX-License-Identifier: Apache-2.0

mainmenu "Networking http-client sample application"

config NET_SAMPLE_SEND_ITERATIONS
	int "Send a sample HTTP query this many times"
	default 0
	help
	  Send a sample HTTP query this many times before exiting. A value of
	  zero means that the sample application in default way.

source "Kconfig.zephyr"
```

## sample.yaml
```
common:
  tags:
    - net
    - http
    - http_client
    - fdtable
  min_ram: 32
  depends_on: netif
sample:
  description: HTTP client sample
  name: http_client
tests:
  sample.net.sockets.http_client:
    harness: net
```

## prj.conf
```kconfig
# General config
CONFIG_MAIN_STACK_SIZE=3072
CONFIG_SYSTEM_WORKQUEUE_STACK_SIZE=2048

# Networking config
CONFIG_NETWORKING=y
CONFIG_NET_IPV4=y
CONFIG_NET_IPV6=y
CONFIG_NET_TCP=y
CONFIG_NET_SHELL=y

# Sockets
CONFIG_NET_SOCKETS=y
CONFIG_ZVFS_POLL_MAX=4
CONFIG_POSIX_AEP_CHOICE_NETAPP=y

# Network driver config
CONFIG_TEST_RANDOM_GENERATOR=y

# Network buffers
CONFIG_NET_PKT_RX_COUNT=16
CONFIG_NET_PKT_TX_COUNT=16
CONFIG_NET_BUF_RX_COUNT=128
CONFIG_NET_BUF_TX_COUNT=128
CONFIG_NET_CONTEXT_NET_PKT_POOL=y

# Network address config
CONFIG_NET_CONFIG_SETTINGS=y
CONFIG_NET_CONFIG_NEED_IPV4=y
CONFIG_NET_CONFIG_NEED_IPV6=y
CONFIG_NET_CONFIG_MY_IPV4_ADDR="192.0.2.1"
CONFIG_NET_CONFIG_MY_IPV4_GW="192.0.2.2"
# Address of HTTP IPv4 server
CONFIG_NET_CONFIG_PEER_IPV4_ADDR="192.0.2.2"
CONFIG_NET_CONFIG_MY_IPV6_ADDR="2001:db8::1"
# Address of HTTP IPv6 server
CONFIG_NET_CONFIG_PEER_IPV6_ADDR="2001:db8::2"

# HTTP
CONFIG_HTTP_CLIENT=y

# Network debug config
CONFIG_LOG=y
CONFIG_NET_LOG=y
CONFIG_NET_SOCKETS_LOG_LEVEL_DBG=n
CONFIG_NET_HTTP_LOG_LEVEL_DBG=n
CONFIG_NET_IPV6_LOG_LEVEL_DBG=n
CONFIG_NET_IPV6_ND_LOG_LEVEL_DBG=n
```

## ieee802154-overlay.conf
```kconfig
CONFIG_NET_L2_IEEE802154=y
CONFIG_NET_L2_IEEE802154_SHELL=y
CONFIG_NET_L2_IEEE802154_LOG_LEVEL_INF=y

# 2.4G by default, SubG bands require additional driver support,
# see *-enable-subg.overlay
# Uncomment for 868 MHz
#CONFIG_NET_CONFIG_IEEE802154_CHANNEL=0
# Uncomment for 906 MHz:
#CONFIG_NET_CONFIG_IEEE802154_CHANNEL=1

CONFIG_NET_MGMT_EVENT_STACK_SIZE=2048
CONFIG_NET_L2_IEEE802154_FRAGMENT_REASS_CACHE_SIZE=3

#Debugging
CONFIG_NET_L2_IEEE802154_LOG_LEVEL_DBG=n
```

## overlay-tls.conf
```kconfig
CONFIG_MAIN_STACK_SIZE=3072
CONFIG_NET_BUF_RX_COUNT=80
CONFIG_NET_BUF_TX_COUNT=80

# TLS configuration
CONFIG_MBEDTLS=y
CONFIG_MBEDTLS_ENABLE_HEAP=y
CONFIG_MBEDTLS_HEAP_SIZE=60000
CONFIG_MBEDTLS_SSL_IN_CONTENT_LEN=2048
CONFIG_MBEDTLS_SSL_OUT_CONTENT_LEN=2048
CONFIG_MBEDTLS_CIPHERSUITE_TLS_ECDHE_RSA_WITH_AES_128_CBC_SHA256=y

CONFIG_NET_SOCKETS_SOCKOPT_TLS=y
CONFIG_NET_SOCKETS_TLS_MAX_CONTEXTS=6
```

## cc1352-enable-subg.overlay
```dts
/*
 * SPDX-License-Identifier: Apache-2.0
 */

/**
 * Overlay to enable for CC1352R1 / CC1352P1-based boards.
 */

/ {
	chosen {
		zephyr,ieee802154 = &ieee802154g;
	};
};

&ieee802154 {
	status = "disabled";
};

&ieee802154g {
	status = "okay";
};
```

## src/main.c
```c
/*
 * Copyright (c) 2019 Intel Corporation
 *
 * SPDX-License-Identifier: Apache-2.0
 */

#include <zephyr/logging/log.h>
LOG_MODULE_REGISTER(net_http_client_sample, LOG_LEVEL_DBG);

#include <zephyr/posix/sys/socket.h>
#include <zephyr/posix/unistd.h>
#include <zephyr/posix/arpa/inet.h>

#include <zephyr/net/net_ip.h>
#include <zephyr/net/socket.h>
#include <zephyr/net/tls_credentials.h>
#include <zephyr/net/http/client.h>

#include "ca_certificate.h"

#define HTTP_PORT 8000
#define HTTPS_PORT 4443

#if defined(CONFIG_NET_CONFIG_PEER_IPV6_ADDR)
#define SERVER_ADDR6  CONFIG_NET_CONFIG_PEER_IPV6_ADDR
#else
#define SERVER_ADDR6 ""
#endif

#if defined(CONFIG_NET_CONFIG_PEER_IPV4_ADDR)
#define SERVER_ADDR4  CONFIG_NET_CONFIG_PEER_IPV4_ADDR
#else
#define SERVER_ADDR4 ""
#endif

#define MAX_RECV_BUF_LEN 512

static uint8_t recv_buf_ipv4[MAX_RECV_BUF_LEN];
static uint8_t recv_buf_ipv6[MAX_RECV_BUF_LEN];

static int setup_socket(sa_family_t family, const char *server, int port,
			int *sock, struct sockaddr *addr, socklen_t addr_len)
{
	const char *family_str = family == AF_INET ? "IPv4" : "IPv6";
	int ret = 0;

	memset(addr, 0, addr_len);

	if (family == AF_INET) {
		net_sin(addr)->sin_family = AF_INET;
		net_sin(addr)->sin_port = htons(port);
		inet_pton(family, server, &net_sin(addr)->sin_addr);
	} else {
		net_sin6(addr)->sin6_family = AF_INET6;
		net_sin6(addr)->sin6_port = htons(port);
		inet_pton(family, server, &net_sin6(addr)->sin6_addr);
	}

	if (IS_ENABLED(CONFIG_NET_SOCKETS_SOCKOPT_TLS)) {
		sec_tag_t sec_tag_list[] = {
			CA_CERTIFICATE_TAG,
		};

		*sock = socket(family, SOCK_STREAM, IPPROTO_TLS_1_2);
		if (*sock >= 0) {
			ret = setsockopt(*sock, SOL_TLS, TLS_SEC_TAG_LIST,
					 sec_tag_list, sizeof(sec_tag_list));
			if (ret < 0) {
				LOG_ERROR("Failed to set %s secure option (%d)", family_str,
					  -errno);
				ret = -errno;
			}

			ret = setsockopt(*sock, SOL_TLS, TLS_HOSTNAME,
					 TLS_PEER_HOSTNAME,
					 sizeof(TLS_PEER_HOSTNAME));
			if (ret < 0) {
				LOG_ERROR("Failed to set %s TLS_HOSTNAME "
					  "option (%d)",
					  family_str, -errno);
				ret = -errno;
			}
		}
	} else {
		*sock = socket(family, SOCK_STREAM, IPPROTO_TCP);
	}

	if (*sock < 0) {
		LOG_ERROR("Failed to create %s HTTP socket (%d)", family_str, -errno);
	}

	return ret;
}

static int payload_cb(int sock, struct http_request *req, void *user_data)
{
	const char *content[] = {
		"foobar",
		"chunked",
		"last"
	};
	char tmp[64];
	int i, pos = 0;

	for (i = 0; i < ARRAY_SIZE(content); i++) {
		pos += snprintk(tmp + pos, sizeof(tmp) - pos,
				"%x\r\n%s\r\n",
				(unsigned int)strlen(content[i]),
				content[i]);
	}

	pos += snprintk(tmp + pos, sizeof(tmp) - pos, "0\r\n\r\n");

	(void)send(sock, tmp, pos, 0);

	return pos;
}

static int response_cb(struct http_response *rsp,
		       enum http_final_call final_data,
		       void *user_data)
{
	if (final_data == HTTP_DATA_MORE) {
		LOG_INF("Partial data received (%zd bytes)", rsp->data_len);
	} else if (final_data == HTTP_DATA_FINAL) {
		LOG_INF("All the data received (%zd bytes)", rsp->data_len);
	}

	LOG_INF("Response to %s", (const char *)user_data);
	LOG_INF("Response status %s", rsp->http_status);

	return 0;
}

static int connect_socket(sa_family_t family, const char *server, int port,
			  int *sock, struct sockaddr *addr, socklen_t addr_len)
{
	int ret;

	ret = setup_socket(family, server, port, sock, addr, addr_len);
	if (ret < 0 || *sock < 0) {
		return -1;
	}

	ret = connect(*sock, addr, addr_len);
	if (ret < 0) {
		LOG_ERROR("Cannot connect to %s remote (%d)", family == AF_INET ? "IPv4" : "IPv6",
			  -errno);
		close(*sock);
		*sock = -1;
		ret = -errno;
	}

	return ret;
}

static int run_queries(void)
{
	struct sockaddr_in6 addr6;
	struct sockaddr_in addr4;
	int sock4 = -1, sock6 = -1;
	int32_t timeout = 3 * MSEC_PER_SEC;
	int ret = 0;
	int port = HTTP_PORT;
	struct http_request req;

	if (IS_ENABLED(CONFIG_NET_SOCKETS_SOCKOPT_TLS)) {
		ret = tls_credential_add(CA_CERTIFICATE_TAG,
					 TLS_CREDENTIAL_CA_CERTIFICATE,
					 ca_certificate,
					 sizeof(ca_certificate));
		if (ret < 0) {
			LOG_ERROR("Failed to register public certificate: %d", ret);
			return ret;
		}

		port = HTTPS_PORT;
	}

	if (IS_ENABLED(CONFIG_NET_IPV4)) {
		(void)connect_socket(AF_INET, SERVER_ADDR4, port,
				     &sock4, (struct sockaddr *)&addr4,
				     sizeof(addr4));
		if (sock4 < 0) {
			LOG_ERROR("Cannot create HTTP IPv4 connection.");
			return -ECONNABORTED;
		}

		memset(&req, 0, sizeof(req));

		req.method = HTTP_GET;
		req.url = "/";
		req.host = SERVER_ADDR4;
		req.protocol = "HTTP/1.1";
		req.response = response_cb;
		req.recv_buf = recv_buf_ipv4;
		req.recv_buf_len = sizeof(recv_buf_ipv4);

		ret = http_client_req(sock4, &req, timeout, "IPv4 GET");
		if (ret < 0) {
			LOG_ERROR("Client error %d", ret);
		}

		close(sock4);
	}

	if (IS_ENABLED(CONFIG_NET_IPV6)) {
		(void)connect_socket(AF_INET6, SERVER_ADDR6, port,
				     &sock6, (struct sockaddr *)&addr6,
				     sizeof(addr6));
		if (sock6 < 0) {
			LOG_ERROR("Cannot create HTTP IPv6 connection.");
			return -ECONNABORTED;
		}

		memset(&req, 0, sizeof(req));

		req.method = HTTP_GET;
		req.url = "/";
		req.host = SERVER_ADDR6;
		req.protocol = "HTTP/1.1";
		req.response = response_cb;
		req.recv_buf = recv_buf_ipv6;
		req.recv_buf_len = sizeof(recv_buf_ipv6);

		ret = http_client_req(sock6, &req, timeout, "IPv6 GET");
		if (ret < 0) {
			LOG_ERROR("Client error %d", ret);
		}

		close(sock6);
	}

	sock4 = -1;
	sock6 = -1;

	if (IS_ENABLED(CONFIG_NET_IPV4)) {
		(void)connect_socket(AF_INET, SERVER_ADDR4, port,
				     &sock4, (struct sockaddr *)&addr4,
				     sizeof(addr4));
		if (sock4 < 0) {
			LOG_ERROR("Cannot create HTTP IPv4 connection.");
			return -ECONNABORTED;
		}

		memset(&req, 0, sizeof(req));

		req.method = HTTP_POST;
		req.url = "/foobar";
		req.host = SERVER_ADDR4;
		req.protocol = "HTTP/1.1";
		req.payload = "foobar";
		req.payload_len = strlen(req.payload);
		req.response = response_cb;
		req.recv_buf = recv_buf_ipv4;
		req.recv_buf_len = sizeof(recv_buf_ipv4);

		ret = http_client_req(sock4, &req, timeout, "IPv4 POST");
		if (ret < 0) {
			LOG_ERROR("Client error %d", ret);
		}

		close(sock4);
	}

	if (IS_ENABLED(CONFIG_NET_IPV6)) {
		(void)connect_socket(AF_INET6, SERVER_ADDR6, port,
				     &sock6, (struct sockaddr *)&addr6,
				     sizeof(addr6));
		if (sock6 < 0) {
			LOG_ERROR("Cannot create HTTP IPv6 connection.");
			return -ECONNABORTED;
		}

		memset(&req, 0, sizeof(req));

		req.method = HTTP_POST;
		req.url = "/";
		req.host = SERVER_ADDR6;
		req.protocol = "HTTP/1.1";
		req.payload = "foobar";
		req.payload_len = strlen(req.payload);
		req.response = response_cb;
		req.recv_buf = recv_buf_ipv6;
		req.recv_buf_len = sizeof(recv_buf_ipv6);

		ret = http_client_req(sock6, &req, timeout, "IPv6 POST");
		if (ret < 0) {
			LOG_ERROR("Client error %d", ret);
		}

		close(sock6);
	}

	/* Do a chunked POST request */

	sock4 = -1;
	sock6 = -1;

	if (IS_ENABLED(CONFIG_NET_IPV4)) {
		const char *headers[] = {
			"Transfer-Encoding: chunked\r\n",
			NULL
		};

		(void)connect_socket(AF_INET, SERVER_ADDR4, port,
				     &sock4, (struct sockaddr *)&addr4,
				     sizeof(addr4));
		if (sock4 < 0) {
			LOG_ERROR("Cannot create HTTP IPv4 connection.");
			return -ECONNABORTED;
		}

		memset(&req, 0, sizeof(req));

		req.method = HTTP_POST;
		req.url = "/chunked-test";
		req.host = SERVER_ADDR4;
		req.protocol = "HTTP/1.1";
		req.payload_cb = payload_cb;
		req.header_fields = headers;
		req.response = response_cb;
		req.recv_buf = recv_buf_ipv4;
		req.recv_buf_len = sizeof(recv_buf_ipv4);

		ret = http_client_req(sock4, &req, timeout, "IPv4 POST");
		if (ret < 0) {
			LOG_ERROR("Client error %d", ret);
		}

		close(sock4);
	}

	if (IS_ENABLED(CONFIG_NET_IPV6)) {
		const char *headers[] = {
			"Transfer-Encoding: chunked\r\n",
			NULL
		};

		(void)connect_socket(AF_INET6, SERVER_ADDR6, port,
				     &sock6, (struct sockaddr *)&addr6,
				     sizeof(addr6));
		if (sock6 < 0) {
			LOG_ERROR("Cannot create HTTP IPv6 connection.");
			return -ECONNABORTED;
		}

		memset(&req, 0, sizeof(req));

		req.method = HTTP_POST;
		req.url = "/chunked-test";
		req.host = SERVER_ADDR6;
		req.protocol = "HTTP/1.1";
		req.payload_cb = payload_cb;
		req.header_fields = headers;
		req.response = response_cb;
		req.recv_buf = recv_buf_ipv6;
		req.recv_buf_len = sizeof(recv_buf_ipv6);

		ret = http_client_req(sock6, &req, timeout, "IPv6 POST");
		if (ret < 0) {
			LOG_ERROR("Client error %d", ret);
		}

		close(sock6);
	}

	return ret;
}

int main(void)
{
	int iterations = CONFIG_NET_SAMPLE_SEND_ITERATIONS;
	int i = 0;
	int ret = 0;

	while (iterations == 0 || i < iterations) {
		ret = run_queries();
		if (ret < 0) {
			ret = 1;
			break;
		}

		if (iterations > 0) {
			i++;
			if (i >= iterations) {
				ret = 0;
				break;
			}
		} else {
			ret = 0;
			break;
		}
	}

	if (iterations == 0) {
		k_sleep(K_FOREVER);
	}

	exit(ret);
	return ret;
}
```

## src/log.h
```c
/*
 * SPDX-License-Identifier: Apache-2.0
 */

#ifndef __DEMO_LOG_H__
#define __DEMO_LOG_H__


#ifdef __cplusplus
extern "C" {
#endif

#include <logging/log.h>

#ifdef __cplusplus
}
#endif


#endif /* __DEMO_LOG_H__ */
```

## src/shell.c
```c
#include "log.h"
#define LOG_MODULE_NAME demo_shell
#define LOG_LEVEL CONFIG_DEMO_SHELL_LOG_LEVEL

LOG_MODULE_REGISTER(LOG_MODULE_NAME);

#include <zephyr.h>
#include <misc/printk.h>
#include <shell/shell.h>
#include <stdlib.h>
#include <version.h>

#include <net/http_client.h>

#define HTTP_CONTENT_RANGE	"Content-Range"
#define HTTP_VERSION "V1.0.0"
#define APP_BUFF_MAX_SIZE	4096

static struct http_ctx ctx;
char app_buf[APP_BUFF_MAX_SIZE];
int app_buf_len;

static int cmd_version(const struct shell *shell, size_t argc, char **argv)
{
	ARG_UNUSED(argc);
	ARG_UNUSED(argv);

	shell_fprintf(shell, SHELL_NORMAL,
			"http version %s\n", HTTP_VERSION);
	return 0;
}


static int cmd_http_init(const struct shell *shell, size_t argc, char **argv)
{
	shell_fprintf(shell, SHELL_NORMAL,
			"Create New Http client, %s:%s\n", argv[1], argv[2]);
	http_client_init(&ctx, argv[1], argv[2], false);

	return 0;
}

static int cmd_http_post(const struct shell *shell, size_t argc, char **argv)
{
	return 0;
}

void http_resp_callback(struct http_ctx *pctx,
					const char *body,
					int body_len,
					enum http_final_call final_data)
{
	/** body can't receive commplete*/
	if (final_data == HTTP_DATA_MORE) {
		/** copy the body to app buff*/
		if ((app_buf_len + body_len) < APP_BUFF_MAX_SIZE) {
			memcpy(&app_buf[app_buf_len], body, body_len);
			app_buf_len += body_len;
			printk("Got Http Body (%d) bytes, except (%d) bytes.\n",
				app_buf_len, pctx->rsp.content_length);
		} else {
			printk("app_buff was not enough, (app_buf_len+body_len)=%d\n",
				(app_buf_len + body_len));
		}
	} else {
		/** the body of http response has received complete*/
		if (pctx->rsp.message_complete) {
			printk("*****Response Body Received Complete******\n");
			/**printk("%s\r\n", app_buf);*/
		}
	}
}

void http_fv_callback(struct http_ctx *pctx,
					const char *at,
					int at_len,
					enum http_header_field_val f_v)
{
	int len;
	static bool http_has_content_range;
	char http_content_range_val[32];
	int file_len;
	char *p;

	if (f_v == HTTP_HEADER_FIELD) {
		len = strlen(HTTP_CONTENT_RANGE);
		if (at_len >= len && memcmp(at, HTTP_CONTENT_RANGE, len) == 0) {
			http_has_content_range = true;
		}
	} else {
		if (http_has_content_range) {
			memcpy(http_content_range_val, at, at_len);
			http_content_range_val[at_len] = 0;

			p = strstr(http_content_range_val, "/");
			file_len = strtol(p + 1, NULL, 10);
			http_has_content_range = false;
			printk("http request resource size: (%zd)\n", file_len);
		}
	}
}

static int cmd_http_get(const struct shell *shell, size_t argc, char **argv)
{
	int ret;

	shell_fprintf(shell, SHELL_NORMAL,
			"Http Get: %s\n", argv[1]);

	if (argc > 3) {
		http_add_header_field(&ctx, argv[3]);
		shell_fprintf(shell, SHELL_NORMAL,
			"Http header fields: %s\n", argv[3]);
	}

	memset(app_buf, 0, APP_BUFF_MAX_SIZE);
	app_buf_len = 0;

	http_set_resp_callback(&ctx, http_resp_callback);

	http_add_header_field(&ctx, "Range: bytes=0-99\r\n");
	http_set_fv_callback(&ctx, http_fv_callback);

	ret = http_client_get(&ctx, argv[1], true, NULL);
	LOG_INF("http_client_get ret=%d", ret);

	return 0;
}

static int cmd_http_close(const struct shell *shell, size_t argc, char **argv)
{
	return http_client_close(&ctx);
}

SHELL_CREATE_STATIC_SUBCMD_SET(sub_app)
{
	SHELL_CMD(version, NULL, "Show http version.", cmd_version),
	SHELL_CMD(new, NULL, "http new client.\n"
			"Usage: new <host> <port>", cmd_http_init),
	SHELL_CMD(post, NULL, "http post requestion.\n"
			"Usage: post <host> <url_path>", cmd_http_post),
	SHELL_CMD(get, NULL, "http get requestion.\n"
			"Usage: get <url_path>", cmd_http_get),
	SHELL_CMD(close, NULL, "http close client.\n"
			"Usage: close ", cmd_http_close),
	SHELL_SUBCMD_SET_END /* Array terminated. */
};

/* Creating root (level 0) command "app" */
SHELL_CMD_REGISTER(http, &sub_app, "Function test commands", NULL);
```
