## CMakeLists.txt
```
# SPDX-License-Identifier: Apache-2.0

cmake_minimum_required(VERSION 3.28.0)
find_package(Zephyr REQUIRED HINTS $ENV{ZEPHYR_BASE})
project(sntp_client)

FILE(GLOB app_sources src/*.c)
target_sources(app PRIVATE ${app_sources})

include(${ZEPHYR_BASE}/samples/net/common/common.cmake)
```

## Kconfig
```
# Copyright (c) 2024 Embeint Inc

config NET_SAMPLE_SNTP_SERVER_ADDRESS
	string "SNTP server address"
	default "pool.ntp.org"

config NET_SAMPLE_SNTP_SERVER_PORT
	int "SNTP server port"
	default 123

config NET_SAMPLE_SNTP_SERVER_TIMEOUT_MS
	int "Duration to wait for response"
	default 2000

source "samples/net/common/Kconfig"
source "Kconfig.zephyr"
```

## sample.yaml
```
sample:
  description: SNTP client sample
  name: sntp_client
common:
  harness: net
  tags: net
tests:
  sample.net.sockets.sntp_client:
    platform_allow:
      - qemu_x86
      - native_sim
  sample.net.sockets.sntp_client.native:
    platform_allow:
      - native_sim
    integration_platforms:
      - native_sim
    extra_configs:
      - CONFIG_NATIVE_SIM_SLOWDOWN_TO_REAL_TIME=y
    extra_args:
      - EXTRA_CONF_FILE="overlay-nsos.conf"
  sample.net.sockets.sntp_client.wifi.nrf70dk:
    extra_args:
      - SNIPPET=wifi-ipv4
      - CONFIG_BUILD_ONLY_NO_BLOBS=y
    platform_allow:
      - nrf7002dk/nrf5340/cpuapp
```

## prj.conf
```kconfig
# General config
CONFIG_REQUIRES_FULL_LIBC=y
CONFIG_POSIX_AEP_CHOICE_NETAPP=y

# Networking config
CONFIG_NETWORKING=y
CONFIG_NET_IPV4=y
CONFIG_NET_IPV6=y
CONFIG_NET_UDP=y
CONFIG_NET_SHELL=y

# Sockets
CONFIG_NET_SOCKETS=y
CONFIG_NET_SOCKETS_SERVICE=y
CONFIG_ZVFS_POLL_MAX=4

# Network driver config
CONFIG_TEST_RANDOM_GENERATOR=y

# Network address config
CONFIG_NET_CONFIG_SETTINGS=y
CONFIG_NET_CONFIG_NEED_IPV4=y
CONFIG_NET_CONFIG_NEED_IPV6=y
CONFIG_NET_CONFIG_MY_IPV4_ADDR="192.0.2.1"
CONFIG_NET_CONFIG_MY_IPV6_ADDR="2001:db8::1"

# SNTP
CONFIG_SNTP=y

CONFIG_MAIN_STACK_SIZE=2048
# Network debug config
CONFIG_NET_LOG=y
CONFIG_LOG=y
CONFIG_NET_SOCKETS_LOG_LEVEL_DBG=n
CONFIG_SNTP_LOG_LEVEL_DBG=n
```

## overlay-nsos.conf
```kconfig
# Copyright (c) 2025 Embeint Inc

CONFIG_ETH_NATIVE_TAP=n
CONFIG_NET_DRIVERS=y
CONFIG_NET_SOCKETS=y
CONFIG_NET_SOCKETS_OFFLOAD=y
CONFIG_NET_NATIVE_OFFLOADED_SOCKETS=y

# IPv6 DAD requires lower level network interface access, below exposed socket-level access
CONFIG_NET_IPV6_DAD=n
```

## boards/cc3220sf_launchxl.conf
```kconfig
# Networking Config:
CONFIG_NET_NATIVE=n
CONFIG_NET_IPV6=n
CONFIG_NET_CONFIG_NEED_IPV6=n

# Enable SimpleLink WiFi Driver and Socket Offload
CONFIG_WIFI=y
CONFIG_WIFI_SIMPLELINK=y
# The SimpleLink driver is deprecated, keep the build going until it is removed
CONFIG_WARN_DEPRECATED=n
CONFIG_NET_SOCKETS_OFFLOAD=y

# Disable unneeded settings from the base prj.conf:
CONFIG_NET_CONFIG_SETTINGS=n
CONFIG_NET_CONFIG_MY_IPV4_ADDR=""
CONFIG_NET_CONFIG_PEER_IPV4_ADDR=""
CONFIG_NET_CONFIG_MY_IPV6_ADDR=""
CONFIG_NET_CONFIG_PEER_IPV6_ADDR=""

# Debugging
CONFIG_WIFI_LOG_LEVEL_DBG=y
CONFIG_DEBUG=y
CONFIG_ASSERT=y
```

## src/main.c
```c
/*
 * Copyright (c) 2017 Linaro Limited
 * Copyright (c) 2019 Intel Corporation
 *
 * SPDX-License-Identifier: Apache-2.0
 */

#include <zephyr/logging/log.h>
LOG_MODULE_REGISTER(net_sntp_client_sample, LOG_LEVEL_DBG);

#include <zephyr/net/socket.h>
#include <zephyr/net/socket_service.h>
#include <zephyr/net/sntp.h>
#include <arpa/inet.h>
#include <netdb.h>

#include <zephyr/net/conn_mgr_monitor.h>
#include "net_sample_common.h"

static K_SEM_DEFINE(sntp_async_received, 0, 1);
static void sntp_service_handler(struct net_socket_service_event *pev);

NET_SOCKET_SERVICE_SYNC_DEFINE_STATIC(service_sntp_async, sntp_service_handler, 1);

int dns_query(const char *host, uint16_t port, int family, int socktype, struct sockaddr *addr,
			  socklen_t *addrlen)
{
	struct addrinfo hints = {
		.ai_family = family,
		.ai_socktype = socktype,
	};
	struct addrinfo *res = NULL;
	char addr_str[INET6_ADDRSTRLEN] = {0};
	int rv;

	/* Perform DNS query */
	rv = getaddrinfo(host, NULL, &hints, &res);
	if (rv < 0) {
		LOG_ERR("getaddrinfo failed (%d, errno %d)", rv, errno);
		return rv;
	}
	/* Store the first result */
	*addr = *res->ai_addr;
	*addrlen = res->ai_addrlen;
	/* Free the allocated memory */
	freeaddrinfo(res);
	/* Store the port */
	net_sin(addr)->sin_port = htons(port);
	/* Print the found address */
	inet_ntop(addr->sa_family, &net_sin(addr)->sin_addr, addr_str, sizeof(addr_str));
	LOG_INF("%s -> %s", host, addr_str);
	return 0;
}

static void sntp_service_handler(struct net_socket_service_event *pev)
{
	struct sntp_time s_time;
	int rc;

	/* Read the response from the socket */
	rc = sntp_read_async(pev, &s_time);
	if (rc != 0) {
		LOG_ERR("Failed to read SNTP response (%d)", rc);
		return;
	}

	/* Close the service */
	sntp_close_async(&service_sntp_async);

	LOG_INF("SNTP Time: %llu (async)", s_time.seconds);

	/* Notify test thread */
	k_sem_give(&sntp_async_received);
}

static void do_sntp(int family)
{
	char *family_str = family == AF_INET ? "IPv4" : "IPv6";
	struct sntp_time s_time;
	struct sntp_ctx ctx;
	struct sockaddr addr;
	socklen_t addrlen;
	int rv;

	/* Get SNTP server */
	rv = dns_query(CONFIG_NET_SAMPLE_SNTP_SERVER_ADDRESS, CONFIG_NET_SAMPLE_SNTP_SERVER_PORT,
				   family, SOCK_DGRAM, &addr, &addrlen);
	if (rv != 0) {
		LOG_ERR("Failed to lookup %s SNTP server (%d)", family_str, rv);
		return;
	}

	rv = sntp_init(&ctx, &addr, addrlen);
	if (rv < 0) {
		LOG_ERR("Failed to init SNTP %s ctx: %d", family_str, rv);
		goto end;
	}

	LOG_INF("Sending SNTP %s request...", family_str);
	rv = sntp_query(&ctx, 4 * MSEC_PER_SEC, &s_time);
	if (rv < 0) {
		LOG_ERR("SNTP %s request failed: %d", family_str, rv);
		goto end;
	}

	LOG_INF("SNTP Time: %llu", s_time.seconds);

	sntp_close(&ctx);

	rv = sntp_init_async(&ctx, &addr, addrlen, &service_sntp_async);
	if (rv < 0) {
		LOG_ERR("Failed to initialise SNTP context (%d)", rv);
		goto end;
	}

	rv = sntp_send_async(&ctx);
	if (rv < 0) {
		LOG_ERR("Failed to send SNTP query (%d)", rv);
		goto end;
	}

	/* Wait for the response to be received asynchronously */
	rv = k_sem_take(&sntp_async_received, K_MSEC(CONFIG_NET_SAMPLE_SNTP_SERVER_TIMEOUT_MS));
	if (rv < 0) {
		LOG_INF("SNTP response timed out (%d)", rv);
	}

end:
	sntp_close(&ctx);
}

int main(void)
{
	uint32_t mask = CONN_MGR_READY_IP_ANY;
	uint32_t ready;

	/* A hostname server also needs a DNS server */
	if (IS_ENABLED(CONFIG_NET_SAMPLE_COMMON_WAIT_DNS) &&
	    is_hostname(CONFIG_NET_SAMPLE_SNTP_SERVER_ADDRESS)) {
		mask |= CONN_MGR_READY_DNS;
	}

	LOG_INF("Waiting for network...");
	/* Wait for any family, then skip the ones that are not ready */
	(void)conn_mgr_wait_ready(mask, NULL, K_FOREVER);
	LOG_INF("Network ready");
	ready = conn_mgr_get_readiness();

	if ((ready & CONN_MGR_READY_IPV4) != 0U) {
		do_sntp(AF_INET);
	}

#if defined(CONFIG_NET_IPV6)
	if ((ready & CONN_MGR_READY_IPV6) != 0U) {
		do_sntp(AF_INET6);
	}
#endif

	return 0;
}
```

## src/config.h
```c
/*
 * Copyright (c) 2019 Linaro Limited
 *
 * SPDX-License-Identifier: Apache-2.0
 */

#ifndef __CONFIG_H__
#define __CONFIG_H__

#ifdef CONFIG_NET_CONFIG_SETTINGS
#ifdef CONFIG_NET_IPV6
#define SERVER_ADDR6		CONFIG_NET_CONFIG_PEER_IPV6_ADDR
#endif
#define SERVER_ADDR		CONFIG_NET_CONFIG_PEER_IPV4_ADDR
#else
#ifdef CONFIG_NET_IPV6
#define SERVER_ADDR6		"2001:db8::2"
#endif
#define SERVER_ADDR		"192.0.2.2"
#endif

#endif
```
