## CMakeLists.txt
```
# SPDX-License-Identifier: Apache-2.0

cmake_minimum_required(VERSION 3.28.0)
find_package(Zephyr REQUIRED HINTS $ENV{ZEPHYR_BASE})
project(coap_client)

FILE(GLOB app_sources src/*.c)
target_sources(app PRIVATE ${app_sources})
target_include_directories(app PRIVATE ${ZEPHYR_BASE}/subsys/net/ip)
include(${ZEPHYR_BASE}/samples/net/common/common.cmake)
```

## Kconfig
```
# Copyright (c) 2025 Netfeasa Ltd.
# SPDX-License-Identifier: Apache-2.0

mainmenu "CoAP client sample application"

config NET_SAMPLE_COAP_CLIENT_PEER
	string "CoAP server peer"
	help
	  Peer address of the CoAP server. The value may be an IPv4 literal,
	  an IPv6 literal, or a hostname. If no port is specified, UDP port
	  5683 is used.
	  Syntax examples:
	     192.0.2.1:5683
	     192.0.2.42
	     [2001:db8::1]:5683
	     [2001:db8::2]
	     example.com:5683
	     example.com

config NET_SAMPLE_COAP_CLIENT_REPLY_TIMEOUT_MS
	int "CoAP reply timeout in milliseconds"
	default 0
	range 0 600000
	help
	  Time to wait for a CoAP reply before giving up.
	  Set to 0 to wait forever.

config NET_SAMPLE_COAP_CLIENT_BLOCKWISE_MAX_RETRIES
	int "Maximum block-wise retries after timeout"
	default 0
	range 0 10
	help
	  Number of times to retry a block-wise GET request when waiting for
	  the next block times out. This only has an effect when
	  NET_SAMPLE_COAP_CLIENT_REPLY_TIMEOUT_MS is non-zero.

source "samples/net/common/Kconfig"
source "Kconfig.zephyr"
```

## sample.yaml
```
common:
  filter: CONFIG_FULL_LIBC_SUPPORTED and not CONFIG_NATIVE_LIBC
sample:
  description: TBD
  name: TBD
tests:
  sample.net.sockets.coap_client:
    harness: net
    tags:
      - fdtable
      - net
      - socket
    platform_allow: qemu_x86
  sample.net.sockets.coap_client.802154.subg:
    extra_args: EXTRA_CONF_FILE="overlay-802154-subg.conf"
    platform_allow: beagleconnect_freedom
```

## prj.conf
```kconfig
# Generic networking options
CONFIG_NETWORKING=y
CONFIG_REQUIRES_FULL_LIBC=y
CONFIG_NET_IPV6=y
CONFIG_NET_IPV4=y
CONFIG_NET_UDP=y

CONFIG_NET_SOCKETS=y
CONFIG_ZVFS_POLL_MAX=4
CONFIG_POSIX_AEP_CHOICE_NETAPP=y

CONFIG_COAP=y

# Kernel options
CONFIG_ENTROPY_GENERATOR=y
CONFIG_TEST_RANDOM_GENERATOR=y

# Logging
CONFIG_PRINTK=y
CONFIG_NET_LOG=y

# Network Shell
CONFIG_NET_SHELL=y

CONFIG_NET_CONFIG_SETTINGS=y
CONFIG_NET_CONFIG_NEED_IPV6=y
CONFIG_NET_CONFIG_NEED_IPV4=y
CONFIG_NET_CONFIG_MY_IPV6_ADDR="2001:db8::1"
CONFIG_NET_CONFIG_MY_IPV4_ADDR="192.0.2.1"

# Where should the application send packets
CONFIG_NET_SAMPLE_COAP_CLIENT_PEER="[2001:db8::2]:4242"
#CONFIG_NET_SAMPLE_COAP_CLIENT_PEER="192.0.2.2:4242"

CONFIG_NET_SAMPLE_COAP_CLIENT_REPLY_TIMEOUT_MS=15000
CONFIG_NET_SAMPLE_COAP_CLIENT_BLOCKWISE_MAX_RETRIES=3

CONFIG_HEAP_MEM_POOL_SIZE=2048
```

## overlay-802154-subg.conf
```kconfig
CONFIG_BT=n

# Disable IPv4
CONFIG_NET_IPV4=n

CONFIG_NET_CONFIG_NEED_IPV6=y
CONFIG_NET_CONFIG_NEED_IPV4=n
CONFIG_NET_CONFIG_MY_IPV4_ADDR=""
CONFIG_NET_CONFIG_PEER_IPV4_ADDR=""

CONFIG_NET_L2_IEEE802154=y
CONFIG_NET_L2_IEEE802154_SHELL=y
CONFIG_NET_L2_IEEE802154_LOG_LEVEL_INF=y

# Uncomment for 868 MHz
#CONFIG_NET_CONFIG_IEEE802154_CHANNEL=0
# Uncomment for 906 MHz:
CONFIG_NET_CONFIG_IEEE802154_CHANNEL=1
```

## overlay-nrf700x.conf
```kconfig
CONFIG_HEAP_MEM_POOL_SIZE=153000

# Wi-Fi
CONFIG_WIFI=y
CONFIG_WIFI_NRF700X=y
CONFIG_WPA_SUPP=y
CONFIG_NET_L2_ETHERNET=y

# Connection manager
CONFIG_NET_CONNECTION_MANAGER=y

# Credentials
CONFIG_WIFI_CREDENTIALS=y
CONFIG_WIFI_CREDENTIALS_STATIC=y
CONFIG_WIFI_CREDENTIALS_STATIC_SSID=""
CONFIG_WIFI_CREDENTIALS_STATIC_PASSWORD=""
```

## overlay-swir_hl78xx_ev_kit.conf
```kconfig
# Sierra Wireless HL78XX driver options

# Copyright (c) 2025 Netfeasa Ltd.
# SPDX-License-Identifier: Apache-2.0

# The HL78xx driver gets its IP settings from the cell network
CONFIG_NET_CONFIG_SETTINGS=n
CONFIG_NET_DHCPV4=n
CONFIG_DNS_SERVER_IP_ADDRESSES=n

#PM
# CONFIG_PM_DEVICE=y

#uart
CONFIG_UART_ASYNC_API=y

# Runtime sizing for full libc + DNS resolution on HL78XX
CONFIG_MAIN_STACK_SIZE=4096
CONFIG_SYSTEM_WORKQUEUE_STACK_SIZE=4096

# Generic networking options
CONFIG_NET_IPV6=n
CONFIG_NET_IPV4=y

# DNS
CONFIG_DNS_RESOLVER=y
CONFIG_NET_SOCKETS_DNS_TIMEOUT=15000
# Wait for DNS server to be added before starting the sample
CONFIG_NET_SAMPLE_COMMON_WAIT_DNS_SERVER_ADDITION=y

# POSIX API
CONFIG_POSIX_AEP_CHOICE_NETAPP=y
CONFIG_REQUIRES_FULL_LIBC=y

# Network management
CONFIG_NET_MGMT=y
CONFIG_NET_MGMT_EVENT=y
CONFIG_NET_CONNECTION_MANAGER=y

# NB-IoT has large latency, so increase timeouts. It is ok to use this for Cat-M1 as well.
CONFIG_NET_SOCKETS_CONNECT_TIMEOUT=15000

# Network buffers
CONFIG_NET_PKT_RX_COUNT=32
CONFIG_NET_PKT_TX_COUNT=16
CONFIG_NET_BUF_RX_COUNT=64
CONFIG_NET_BUF_TX_COUNT=32

# Modem driver
CONFIG_MODEM=y

#hl78xx modem
CONFIG_MODEM_HL78XX=y

# Statistics
CONFIG_MODEM_STATS=y
CONFIG_SHELL=y
# Don't require device to have time/date
CONFIG_MBEDTLS_HAVE_TIME_DATE=n

#apn source
# CONFIG_MODEM_HL78XX_APN_SOURCE_KCONFIG=y
# CONFIG_MODEM_HL78XX_APN="internet"

# RAT selection
CONFIG_MODEM_HL78XX_AUTORAT=n

#  Monitor modem events
CONFIG_HL78XX_EVT_MONITOR=y

# CoAP client options
CONFIG_NET_SAMPLE_COAP_CLIENT_PEER="*****.duckdns.org:5683"

# Logging
CONFIG_LOG_BUFFER_SIZE=65535
```

## swir_hl78xx_ev_kit.conf
```kconfig
# Sierra Wireless HL78XX driver options

# Copyright (c) 2025 Netfeasa Ltd.
# SPDX-License-Identifier: Apache-2.0

# The HL78xx driver gets its IP settings from the cell network
CONFIG_NET_CONFIG_SETTINGS=n
CONFIG_NET_DHCPV4=n
CONFIG_DNS_SERVER_IP_ADDRESSES=n

#PM
# CONFIG_PM_DEVICE=y

#uart
CONFIG_UART_ASYNC_API=y

# Runtime sizing for full libc + DNS resolution on HL78XX
CONFIG_MAIN_STACK_SIZE=4096
CONFIG_SYSTEM_WORKQUEUE_STACK_SIZE=4096

# Generic networking options
CONFIG_NET_IPV6=n
CONFIG_NET_IPV4=y

# DNS
CONFIG_DNS_RESOLVER=y
CONFIG_NET_SOCKETS_DNS_TIMEOUT=15000

# POSIX API
CONFIG_POSIX_AEP_CHOICE_NETAPP=y
CONFIG_REQUIRES_FULL_LIBC=y

# Network management
CONFIG_NET_MGMT=y
CONFIG_NET_MGMT_EVENT=y
CONFIG_NET_CONNECTION_MANAGER=y

# NB-IoT has large latency, so increase timeouts. It is ok to use this for Cat-M1 as well.
CONFIG_NET_SOCKETS_CONNECT_TIMEOUT=15000

# Network buffers
CONFIG_NET_PKT_RX_COUNT=32
CONFIG_NET_PKT_TX_COUNT=16
CONFIG_NET_BUF_RX_COUNT=64
CONFIG_NET_BUF_TX_COUNT=32

# Modem driver
CONFIG_MODEM=y

#hl78xx modem
CONFIG_MODEM_HL78XX=y

# Statistics
CONFIG_MODEM_STATS=y
CONFIG_SHELL=y
# Don't require device to have time/date
CONFIG_MBEDTLS_HAVE_TIME_DATE=n

#apn source
# CONFIG_MODEM_HL78XX_APN_SOURCE_KCONFIG=y
# CONFIG_MODEM_HL78XX_APN="internet"

# RAT selection
CONFIG_MODEM_HL78XX_AUTORAT=n

#  Monitor modem events
CONFIG_HL78XX_EVT_MONITOR=y

# CoAP client options
CONFIG_NET_SAMPLE_COAP_CLIENT_PEER="*****.duckdns.org:5683"

# Logging
CONFIG_LOG_BUFFER_SIZE=65535
```

## src/coap-client.c
```c
/*
 * Copyright (c) 2018 Intel Corporation
 *
 * SPDX-License-Identifier: Apache-2.0
 */

#include <errno.h>
#include <string.h>
#include <zephyr/sys/printk.h>
#include <zephyr/sys/byteorder.h>
#include <zephyr/kernel.h>
#include <zephyr/logging/log.h>

#include <zephyr/posix/poll.h>
#include <zephyr/posix/sys/socket.h>
#include <zephyr/posix/netinet/in.h>
#include <zephyr/posix/arpa/inet.h>
#include <zephyr/posix/netdb.h>
#include <zephyr/posix/unistd.h>

#include <zephyr/net/socket.h>
#include <zephyr/net/net_mgmt.h>
#include <zephyr/net/net_ip.h>
#include <zephyr/net/udp.h>
#include <zephyr/net/coap.h>

#include <zephyr/net/conn_mgr_monitor.h>
#include "net_sample_common.h"

LOG_MODULE_REGISTER(net_coap_client_sample, LOG_LEVEL_DBG);

#include "net_private.h"

#define MAX_COAP_MSG_LEN 256
#define COAP_DEFAULT_PORT 5683
#define COAP_DEFAULT_PORT_STR STRINGIFY(COAP_DEFAULT_PORT)
#define COAP_PEER_HOST_MAX_LEN 128
#define COAP_PEER_PORT_MAX_LEN 6

/* CoAP socket fd */
static int sock;

struct pollfd fds[1];
static int nfds;

/* CoAP Options */
static const char * const test_path[] = { "test", NULL };

static const char * const large_path[] = { "large", NULL };

static const char * const obs_path[] = { "obs", NULL };

#define BLOCK_WISE_TRANSFER_SIZE_GET 2048

static struct coap_block_context blk_ctx;

static int wait_for_reply(void)
{
	int timeout_ms = -1;
	int ret;

#if CONFIG_NET_SAMPLE_COAP_CLIENT_REPLY_TIMEOUT_MS > 0
	timeout_ms = CONFIG_NET_SAMPLE_COAP_CLIENT_REPLY_TIMEOUT_MS;
#endif

	ret = poll(fds, nfds, timeout_ms);
	if (ret < 0) {
		LOG_ERR("Error in poll:%d", errno);
		return -errno;
	}

	if (ret == 0) {
		LOG_WRN("Timed out waiting for CoAP reply");
		return -ETIMEDOUT;
	}

	return 0;
}

static void prepare_fds(void)
{
	fds[nfds].fd = sock;
	fds[nfds].events = POLLIN;
	nfds++;
}

static int resolve_peer_addr(struct sockaddr_storage *addr, socklen_t *addrlen)
{
	const char *peer = CONFIG_NET_SAMPLE_COAP_CLIENT_PEER;
	struct sockaddr_storage parsed_addr = { 0 };
	struct addrinfo hints = {
		.ai_family = conn_mgr_get_ready_addr_family(),
		.ai_socktype = SOCK_DGRAM,
		.ai_protocol = IPPROTO_UDP,
	};
	struct addrinfo *res = NULL;
	struct addrinfo *entry;
	char host[COAP_PEER_HOST_MAX_LEN];
	char port[COAP_PEER_PORT_MAX_LEN];
	const char *host_name = peer;
	const char *port_ptr;
	const char *last_colon;
	int ret;
	size_t host_len;

	if (net_ipaddr_parse(peer, strlen(peer), net_sad(&parsed_addr))) {
		switch (net_sad(&parsed_addr)->sa_family) {
		case AF_INET:
			if (!IS_ENABLED(CONFIG_NET_IPV4)) {
				return -EAFNOSUPPORT;
			}

			if (net_sin(net_sad(&parsed_addr))->sin_port == 0U) {
				net_sin(net_sad(&parsed_addr))->sin_port =
					htons(COAP_DEFAULT_PORT);
			}

			*addrlen = sizeof(struct sockaddr_in);
			break;
		case AF_INET6:
			if (!IS_ENABLED(CONFIG_NET_IPV6)) {
				return -EAFNOSUPPORT;
			}

			if (net_sin6(net_sad(&parsed_addr))->sin6_port == 0U) {
				net_sin6(net_sad(&parsed_addr))->sin6_port =
					htons(COAP_DEFAULT_PORT);
			}

			*addrlen = sizeof(struct sockaddr_in6);
			break;
		default:
			return -EINVAL;
		}

		memcpy(addr, &parsed_addr, *addrlen);
		return 0;
	}

	memcpy(port, COAP_DEFAULT_PORT_STR, sizeof(COAP_DEFAULT_PORT_STR));

	port_ptr = strstr(peer, ":");
	last_colon = strrchr(peer, ':');
	if (port_ptr != NULL) {
		if (port_ptr != last_colon || port_ptr == peer || port_ptr[1] == '\0') {
			LOG_ERR("Invalid peer %s", peer);
			return -EINVAL;
		}

		host_len = port_ptr - peer;
		if (host_len >= sizeof(host)) {
			LOG_ERR("Invalid peer %s", peer);
			return -EINVAL;
		}

		memcpy(host, peer, host_len);
		host[host_len] = '\0';
		host_name = host;

		if (strlen(port_ptr + 1) >= sizeof(port)) {
			LOG_ERR("Invalid peer %s", peer);
			return -EINVAL;
		}

		memcpy(port, port_ptr + 1, strlen(port_ptr + 1) + 1);
	}

	ret = getaddrinfo(host_name, port, &hints, &res);
	if (ret != 0) {
		LOG_ERR("Cannot resolve %s (%d)", peer, ret);
		return -ENOENT;
	}

	ret = -EAFNOSUPPORT;

	for (entry = res; entry != NULL; entry = entry->ai_next) {
		if (entry->ai_addrlen > sizeof(*addr)) {
			continue;
		}

		memcpy(addr, entry->ai_addr, entry->ai_addrlen);
		*addrlen = entry->ai_addrlen;
		ret = 0;
		break;
	}

	freeaddrinfo(res);

	return ret;
}

static int start_coap_client(void)
{
	int ret = 0;
	struct sockaddr_storage peer_addr;
	socklen_t peer_addrlen;

	ret = resolve_peer_addr(&peer_addr, &peer_addrlen);
	if (ret < 0) {
		return ret;
	}

	sock = socket((net_sad(&peer_addr))->sa_family,
		      SOCK_DGRAM, IPPROTO_UDP);
	if (sock < 0) {
		LOG_ERR("Failed to create UDP socket %d", errno);
		return -errno;
	}

	ret = connect(sock, net_sad(&peer_addr), peer_addrlen);
	if (ret < 0) {
		LOG_ERR("Cannot connect to UDP remote : %d", errno);
		return -errno;
	}

	prepare_fds();

	return 0;
}

static int process_simple_coap_reply(void)
{
	struct coap_packet reply;
	uint8_t *data = NULL;
	int rcvd;
	int ret;

	ret = wait_for_reply();
	if (ret < 0) {
		goto end;
	}

	data = (uint8_t *)k_malloc(MAX_COAP_MSG_LEN);
	if (!data) {
		return -ENOMEM;
	}

	rcvd = recv(sock, data, MAX_COAP_MSG_LEN, MSG_DONTWAIT);
	if (rcvd == 0) {
		ret = -EIO;
		goto end;
	}

	if (rcvd < 0) {
		if (errno == EAGAIN || errno == EWOULDBLOCK) {
			ret = 0;
		} else {
			ret = -errno;
		}

		goto end;
	}

	net_hexdump("Response", data, rcvd);

	ret = coap_packet_parse(&reply, data, rcvd, NULL, 0);
	if (ret < 0) {
		LOG_ERR("Invalid data received");
	}

end:
	k_free(data);

	return ret;
}

static int send_simple_coap_request(uint8_t method)
{
	uint8_t payload[] = "payload";
	struct coap_packet request;
	const char * const *p;
	uint8_t *data;
	int r;

	data = (uint8_t *)k_malloc(MAX_COAP_MSG_LEN);
	if (!data) {
		return -ENOMEM;
	}

	r = coap_packet_init(&request, data, MAX_COAP_MSG_LEN,
			     COAP_VERSION_1, COAP_TYPE_CON,
			     COAP_TOKEN_MAX_LEN, coap_next_token(),
			     method, coap_next_id());
	if (r < 0) {
		LOG_ERR("Failed to init CoAP message");
		goto end;
	}

	for (p = test_path; p && *p; p++) {
		r = coap_packet_append_option(&request, COAP_OPTION_URI_PATH,
					      *p, strlen(*p));
		if (r < 0) {
			LOG_ERR("Unable add option to request");
			goto end;
		}
	}

	switch (method) {
	case COAP_METHOD_GET:
	case COAP_METHOD_DELETE:
		break;

	case COAP_METHOD_PUT:
	case COAP_METHOD_POST:
		r = coap_packet_append_payload_marker(&request);
		if (r < 0) {
			LOG_ERR("Unable to append payload marker");
			goto end;
		}

		r = coap_packet_append_payload(&request, (uint8_t *)payload,
					       sizeof(payload) - 1);
		if (r < 0) {
			LOG_ERR("Not able to append payload");
			goto end;
		}

		break;
	default:
		r = -EINVAL;
		goto end;
	}

	net_hexdump("Request", request.data, request.offset);

	r = send(sock, request.data, request.offset, 0);

end:
	k_free(data);

	return r;
}

static int send_simple_coap_msgs_and_wait_for_reply(void)
{
	uint8_t test_type = 0U;
	int r;

	while (1) {
		switch (test_type) {
		case 0:
			/* Test CoAP GET method */
			printk("\nCoAP client GET\n");
			r = send_simple_coap_request(COAP_METHOD_GET);
			if (r < 0) {
				return r;
			}

			break;
		case 1:
			/* Test CoAP PUT method */
			printk("\nCoAP client PUT\n");
			r = send_simple_coap_request(COAP_METHOD_PUT);
			if (r < 0) {
				return r;
			}

			break;
		case 2:
			/* Test CoAP POST method*/
			printk("\nCoAP client POST\n");
			r = send_simple_coap_request(COAP_METHOD_POST);
			if (r < 0) {
				return r;
			}

			break;
		case 3:
			/* Test CoAP DELETE method*/
			printk("\nCoAP client DELETE\n");
			r = send_simple_coap_request(COAP_METHOD_DELETE);
			if (r < 0) {
				return r;
			}

			break;
		default:
			return 0;
		}

		r = process_simple_coap_reply();
		if (r < 0) {
			return r;
		}

		test_type++;
	}

	return 0;
}

static int process_large_coap_reply(void)
{
	struct coap_packet reply;
	uint8_t *data = NULL;
	bool last_block;
	int rcvd;
	int ret;

	ret = wait_for_reply();
	if (ret < 0) {
		goto end;
	}

	data = (uint8_t *)k_malloc(MAX_COAP_MSG_LEN);
	if (!data) {
		return -ENOMEM;
	}

	rcvd = recv(sock, data, MAX_COAP_MSG_LEN, MSG_DONTWAIT);
	if (rcvd == 0) {
		ret = -EIO;
		goto end;
	}

	if (rcvd < 0) {
		if (errno == EAGAIN || errno == EWOULDBLOCK) {
			ret = 0;
		} else {
			ret = -errno;
		}

		goto end;
	}

	net_hexdump("Response", data, rcvd);

	ret = coap_packet_parse(&reply, data, rcvd, NULL, 0);
	if (ret < 0) {
		LOG_ERR("Invalid data received");
		goto end;
	}

	ret = coap_update_from_block(&reply, &blk_ctx);
	if (ret < 0) {
		goto end;
	}

	last_block = coap_next_block(&reply, &blk_ctx);
	if (!last_block) {
		ret = 1;
		goto end;
	}

	ret = 0;

end:
	k_free(data);

	return ret;
}

static int send_large_coap_request(void)
{
	struct coap_packet request;
	const char * const *p;
	uint8_t *data;
	int r;

	if (blk_ctx.total_size == 0) {
		coap_block_transfer_init(&blk_ctx, COAP_BLOCK_64,
					 BLOCK_WISE_TRANSFER_SIZE_GET);
	}

	data = (uint8_t *)k_malloc(MAX_COAP_MSG_LEN);
	if (!data) {
		return -ENOMEM;
	}

	r = coap_packet_init(&request, data, MAX_COAP_MSG_LEN,
			     COAP_VERSION_1, COAP_TYPE_CON,
			     COAP_TOKEN_MAX_LEN, coap_next_token(),
			     COAP_METHOD_GET, coap_next_id());
	if (r < 0) {
		LOG_ERR("Failed to init CoAP message");
		goto end;
	}

	for (p = large_path; p && *p; p++) {
		r = coap_packet_append_option(&request, COAP_OPTION_URI_PATH,
					      *p, strlen(*p));
		if (r < 0) {
			LOG_ERR("Unable add option to request");
			goto end;
		}
	}

	r = coap_append_block2_option(&request, &blk_ctx);
	if (r < 0) {
		LOG_ERR("Unable to add block2 option.");
		goto end;
	}

	net_hexdump("Request", request.data, request.offset);

	r = send(sock, request.data, request.offset, 0);

end:
	k_free(data);

	return r;
}

static int get_large_coap_msgs(void)
{
	int retries = 0;
	int r;

	while (1) {
		/* Test CoAP Large GET method */
		printk("\nCoAP client Large GET (block %zd)\n",
		       blk_ctx.current / 64 /*COAP_BLOCK_64*/);
		r = send_large_coap_request();
		if (r < 0) {
			return r;
		}

		r = process_large_coap_reply();
		if (r < 0) {
			if (r == -ETIMEDOUT &&
			    retries < CONFIG_NET_SAMPLE_COAP_CLIENT_BLOCKWISE_MAX_RETRIES) {
				retries++;
				LOG_WRN("Timed out waiting for block %zd, retry %d/%d",
					blk_ctx.current / 64 /* COAP_BLOCK_64 */,
					retries,
					CONFIG_NET_SAMPLE_COAP_CLIENT_BLOCKWISE_MAX_RETRIES);
				continue;
			}
			return r;
		}

		retries = 0;

		/* Received last block */
		if (r == 1) {
			memset(&blk_ctx, 0, sizeof(blk_ctx));
			return 0;
		}
	}

	return 0;
}

static void send_obs_reply_ack(uint16_t id)
{
	struct coap_packet request;
	uint8_t *data;
	int r;

	data = (uint8_t *)k_malloc(MAX_COAP_MSG_LEN);
	if (!data) {
		return;
	}

	r = coap_packet_init(&request, data, MAX_COAP_MSG_LEN,
			     COAP_VERSION_1, COAP_TYPE_ACK, 0, NULL, 0, id);
	if (r < 0) {
		LOG_ERR("Failed to init CoAP message");
		goto end;
	}

	net_hexdump("ACK", request.data, request.offset);

	r = send(sock, request.data, request.offset, 0);
	if (r < 0) {
		LOG_ERR("Failed to send CoAP ACK");
	}
end:
	k_free(data);
}

static int obs_notification_cb(const struct coap_packet *response,
			       struct coap_reply *reply,
			       const struct sockaddr *from)
{
	uint16_t id = coap_header_get_id(response);
	uint8_t type = coap_header_get_type(response);
	uint8_t *counter = (uint8_t *)reply->user_data;

	ARG_UNUSED(from);

	printk("\nCoAP OBS Notification\n");

	(*counter)++;

	if (type == COAP_TYPE_CON) {
		send_obs_reply_ack(id);
	}

	return 0;
}

static int process_obs_coap_reply(struct coap_reply *reply)
{
	struct coap_packet reply_msg;
	uint8_t *data = NULL;
	int rcvd;
	int ret;

	ret = wait_for_reply();
	if (ret < 0) {
		goto end;
	}

	data = (uint8_t *)k_malloc(MAX_COAP_MSG_LEN);
	if (!data) {
		return -ENOMEM;
	}

	rcvd = recv(sock, data, MAX_COAP_MSG_LEN, MSG_DONTWAIT);
	if (rcvd == 0) {
		ret = -EIO;
		goto end;
	}

	if (rcvd < 0) {
		if (errno == EAGAIN || errno == EWOULDBLOCK) {
			ret = 0;
		} else {
			ret = -errno;
		}

		goto end;
	}

	net_hexdump("Response", data, rcvd);

	ret = coap_packet_parse(&reply_msg, data, rcvd, NULL, 0);
	if (ret < 0) {
		LOG_ERR("Invalid data received");
		goto end;
	}

	if (coap_response_received(&reply_msg, NULL, reply, 1) == NULL) {
		LOG_DBG("Ignoring unrelated CoAP response");
	}

end:
	k_free(data);

	return ret;
}

static int send_obs_coap_request(struct coap_reply *reply, void *user_data)
{
	struct coap_packet request;
	const char * const *p;
	uint8_t *data;
	int r;

	data = (uint8_t *)k_malloc(MAX_COAP_MSG_LEN);
	if (!data) {
		return -ENOMEM;
	}

	r = coap_packet_init(&request, data, MAX_COAP_MSG_LEN,
			     COAP_VERSION_1, COAP_TYPE_CON,
			     COAP_TOKEN_MAX_LEN, coap_next_token(),
			     COAP_METHOD_GET, coap_next_id());
	if (r < 0) {
		LOG_ERR("Failed to init CoAP message");
		goto end;
	}

	r = coap_append_option_int(&request, COAP_OPTION_OBSERVE, 0);
	if (r < 0) {
		LOG_ERR("Failed to append Observe option");
		goto end;
	}

	for (p = obs_path; p && *p; p++) {
		r = coap_packet_append_option(&request, COAP_OPTION_URI_PATH,
					      *p, strlen(*p));
		if (r < 0) {
			LOG_ERR("Unable add option to request");
			goto end;
		}
	}

	net_hexdump("Request", request.data, request.offset);

	coap_reply_init(reply, &request);
	reply->reply = obs_notification_cb;
	reply->user_data = user_data;

	r = send(sock, request.data, request.offset, 0);

end:
	k_free(data);

	return r;
}

static int send_obs_reset_coap_request(struct coap_reply *reply)
{
	struct coap_packet request;
	const char * const *p;
	uint8_t *data;
	int r;

	data = (uint8_t *)k_malloc(MAX_COAP_MSG_LEN);
	if (!data) {
		return -ENOMEM;
	}

	r = coap_packet_init(&request, data, MAX_COAP_MSG_LEN,
			     COAP_VERSION_1, COAP_TYPE_CON,
			     reply->tkl, reply->token,
			     COAP_METHOD_GET, coap_next_id());
	if (r < 0) {
		LOG_ERR("Failed to init CoAP message");
		goto end;
	}

	r = coap_append_option_int(&request, COAP_OPTION_OBSERVE, 1);
	if (r < 0) {
		LOG_ERR("Failed to append Observe option");
		goto end;
	}

	for (p = obs_path; p && *p; p++) {
		r = coap_packet_append_option(&request, COAP_OPTION_URI_PATH,
					      *p, strlen(*p));
		if (r < 0) {
			LOG_ERR("Unable add option to request");
			goto end;
		}
	}

	net_hexdump("Request", request.data, request.offset);

	r = send(sock, request.data, request.offset, 0);

end:
	k_free(data);

	return r;
}

static int register_observer(void)
{
	struct coap_reply reply;
	uint8_t counter = 0;
	int r;

	printk("\nCoAP client OBS GET\n");
	r = send_obs_coap_request(&reply, &counter);
	if (r < 0) {
		return r;
	}

	while (1) {
		r = process_obs_coap_reply(&reply);
		if (r < 0) {
			return r;
		}

		if (counter >= 5) {
			/* TODO: Functionality can be verified byt waiting for
			 * some time and make sure client shouldn't receive
			 * any notifications. If client still receives
			 * notifications means, Observer is not removed.
			 */
			r = send_obs_reset_coap_request(&reply);
			if (r < 0) {
				return r;
			}

			/* Wait for the final ACK */
			r = process_obs_coap_reply(&reply);
			if (r < 0) {
				return r;
			}

			break;
		}
	}

	return 0;
}

int main(void)
{
	int r;

	LOG_DBG("Start CoAP-client sample");
	uint32_t ready_mask = CONN_MGR_READY_IP_ANY;

	/* A hostname peer also needs a DNS server */
	if (IS_ENABLED(CONFIG_NET_SAMPLE_COMMON_WAIT_DNS) &&
	    is_hostname(CONFIG_NET_SAMPLE_COAP_CLIENT_PEER)) {
		ready_mask |= CONN_MGR_READY_DNS;
	}

	LOG_INF("Waiting for network...");
	(void)conn_mgr_wait_ready(ready_mask, NULL, K_FOREVER);
	LOG_INF("Network ready");

	r = start_coap_client();
	if (r < 0) {
		goto quit;
	}

	/* GET, PUT, POST, DELETE */
	r = send_simple_coap_msgs_and_wait_for_reply();
	if (r < 0) {
		goto quit;
	}

	/* Block-wise transfer */
	r = get_large_coap_msgs();
	if (r < 0) {
		goto quit;
	}

	/* Register observer, get notifications and unregister */
	r = register_observer();
	if (r < 0) {
		goto quit;
	}

	/* Close the socket */
	(void)close(sock);

	LOG_DBG("Done");

	return 0;

quit:
	(void)close(sock);

	LOG_ERR("quit");
	return 0;
}
```
