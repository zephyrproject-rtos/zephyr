## samples/net/sockets/txtime/sample.yaml
```yaml
common:
  harness: net
  depends_on: netif
  # We can only run this in platforms that support PTP clock and TXTIME
  platform_allow:
    - native_sim
    - native_sim/native/64
    - qemu_x86
    - qemu_x86_64
  integration_platforms:
    - native_sim
sample:
  description: Socket SO_TXTIME sample
  name: txtime-socket
tests:
  sample.net.sockets.txtime:
    tags:
      - net
      - socket
      - so_txtime
      - tsn
```

## samples/net/sockets/websocket_client/sample.yaml
```yaml
common:
  tags:
    - net
    - http
    - http_client
    - websocket_client
    - websocket
  min_ram: 35
  depends_on: netif
  # native_posix does not work with CONFIG_POSIX_API
  platform_exclude:
    - native_posix
    - native_posix/native/64
sample:
  description: Websocket client sample
  name: websocket_client
tests:
  sample.net.sockets.websocket_client:
    platform_exclude: intel_adsp/cavs25
    harness: net
```

## samples/net/ssh/Kconfig
```kconfig
# Private config options for ssh sample app

# Copyright (c) 2026 Nordic Semiconductor ASA
# SPDX-License-Identifier: Apache-2.0

mainmenu "SSH sample application"

config NET_SAMPLE_SSH_USERNAME
	string "Default SSH server username"
	default "root"
	help
	  The value depends on your network setup.

config NET_SAMPLE_SSH_USE_PASSWORD
	bool "Use password authentication"
	depends on SSH_SERVER
	help
	  Enable this flag if you want to use password authentication.

config NET_SAMPLE_SSH_PASSWORD
	string "Default SSH server password"
	# Generate a random default password at build time (see gen_random_password.py).
	default "$(shell,python3 $(ZEPHYR_BASE)/samples/net/ssh/gen_random_password.py)"
	depends on NET_SAMPLE_SSH_USE_PASSWORD
	help
	  The value depends on your network setup.

if USB_DEVICE_STACK_NEXT

# Source common USB sample options used to initialize new experimental USB
# device stack. The scope of these options is limited to USB samples in project
# tree, you cannot use them in your own application.
source "samples/subsys/usb/common/Kconfig.sample_usbd"

endif

source "samples/net/common/Kconfig"
source "Kconfig.zephyr"
```

## samples/net/ssh/boards/nucleo_f767zi.conf
```kconfig
# RSA-2048 key generation runs on the shell thread and needs significant stack
CONFIG_SHELL_STACK_SIZE=8192

# STM32F767 has 256KB flash sectors in single-bank mode which exceed
# NVS's UINT16_MAX sector size limit. Use ZMS instead.
CONFIG_SETTINGS_NVS=n
CONFIG_NVS=n
CONFIG_NVS_INIT_BAD_MEMORY_REGION=n
CONFIG_ZMS=y
CONFIG_SETTINGS_ZMS=y
CONFIG_SETTINGS_ZMS_FORCE_MOUNT=y
```

## samples/net/stats/Kconfig
```kconfig
# Kconfig - Private config options for network statistics sample app

#
# Copyright (c) 2018 Intel Corporation
#
# SPDX-License-Identifier: Apache-2.0
#

mainmenu "Network statistics sample application"

config SAMPLE_PERIOD
	int "How often to print statistics (in seconds)"
	default 30
	range 1 3600
	depends on NET_STATISTICS
	help
	  Print statistics after every n. seconds


source "Kconfig.zephyr"
```

## samples/net/stats/sample.yaml
```yaml
sample:
  description: Test network statistics functionality
  name: Network statistics sample app
tests:
  sample.net.stats:
    harness: net
    min_ram: 64
    tags: net statistics
    pre-filter: subsys_dt_compat_enabled("ethernet")
```

## samples/net/syslog_net/Kconfig
```kconfig
# Private config options for syslog-net sample app

# Copyright (c) 2020 Intel Corporation
# SPDX-License-Identifier: Apache-2.0

mainmenu "Networking syslog sample application"

config NET_SAMPLE_SEND_ITERATIONS
	int "Send sample data this many times"
	default 0
	help
	  Send sample data this many times before exiting. A value of
	  zero means that the defaults in the application are used.


config NET_SAMPLE_SERVER_RUNTIME
	string "Syslog server IP address set at runtime"
	help
	  Server address for the syslog server.
	  This server address gets set at rumtime by the sample
	  app defore the backend is initialized. This can be
	  either IPv4 or IPv6 address. Server listen UDP port
	  number can be configured here too.
	  Following syntax is supported:
	  192.0.2.1:514
	  192.0.2.42
	  [2001:db8::1]:514
	  [2001:db8::2]
	  2001:db::42

source "Kconfig.zephyr"
```

## samples/net/syslog_net/boards/native_posix.conf
```kconfig
# To avoid flood of missing log_strdup messages
CONFIG_LOG_DETECT_MISSED_STRDUP=n
```

## samples/net/syslog_net/sample.yaml
```yaml
common:
  harness: net
  depends_on: netif
  tags:
    - net
    - syslog
sample:
  description: syslog network backend
  name: syslog_net
tests:
  sample.net.syslog.with_timefuncs:
    filter: CONFIG_FULL_LIBC_SUPPORTED
    extra_configs:
      - CONFIG_REQUIRES_FULL_LIBC=y
  sample.net.syslog.ipv4_only:
    filter: CONFIG_FULL_LIBC_SUPPORTED
    extra_configs:
      - CONFIG_NET_IPV6=n
      - CONFIG_NET_CONFIG_NEED_IPV6=n
      - CONFIG_NET_CONFIG_MY_IPV6_ADDR=""
      - CONFIG_NET_CONFIG_PEER_IPV6_ADDR=""
      - CONFIG_LOG_BACKEND_NET_SERVER="192.0.2.1:514"
  sample.net.syslog.ipv6_only:
    filter: CONFIG_FULL_LIBC_SUPPORTED
    extra_configs:
      - CONFIG_NET_IPV4=n
      - CONFIG_NET_CONFIG_NEED_IPV4=n
      - CONFIG_NET_CONFIG_MY_IPV4_ADDR=""
      - CONFIG_NET_CONFIG_PEER_IPV4_ADDR=""
  sample.net.syslog.no_autostart:
    filter: CONFIG_FULL_LIBC_SUPPORTED
    extra_configs:
      - CONFIG_LOG_BACKEND_NET_AUTOSTART=n
  sample.net.syslog.runtime_srv_addr:
    filter: CONFIG_FULL_LIBC_SUPPORTED
    extra_configs:
      - CONFIG_LOG_BACKEND_NET_AUTOSTART=n
      - CONFIG_LOG_BACKEND_NET_SERVER=""
      - CONFIG_NET_SAMPLE_SERVER_RUNTIME="192.0.2.2:514"
```

## samples/net/telnet/sample.yaml
```yaml
common:
  harness: net
  depends_on: netif
  tags:
    - net
    - telnet
sample:
  name: Telnet Server
tests:
  sample.net.telnet:
    platform_exclude:
      - native_posix
      - native_posix/native/64
  sample.net.telnet.wifi.nrf70dk:
    extra_args:
      - SNIPPET=wifi-ipv4
      - CONFIG_BUILD_ONLY_NO_BLOBS=y
    platform_allow:
      - nrf7002dk/nrf5340/cpuapp
```

## samples/net/tftp_client/Kconfig
```kconfig
# Private config options for TFTP client sample

# Copyright (c) 2023 Kickmaker
# SPDX-License-Identifier: Apache-2.0

mainmenu "TFTP Client sample"

config TFTP_APP_PORT
	string "TFTP port used"
	default "69"
	help
	  TFTP port used.

config TFTP_APP_SERVER
	string "TFTP server address"
	default "192.0.2.2"
	help
	  TFTP server address. Write as a full URI including optional port number.
	  When DNS resolver is enabled, DNS domain names could be used as well.

source "Kconfig.zephyr"
```

## samples/net/tftp_client/boards/native_sim.conf
```kconfig
CONFIG_DNS_RESOLVER=y
CONFIG_DNS_SERVER_IP_ADDRESSES=y
CONFIG_DNS_SERVER1="192.0.2.2"
```

## samples/net/tftp_client/sample.yaml
```yaml
sample:
  description: Test TFTP client get and put methods
  name: TFTP client sample app
tests:
  sample.net.tftp_client:
    harness: net
    depends_on: netif
    platform_allow:
      - native_sim
    integration_platforms:
      - native_sim
    tags:
      - net
      - tftp
```

## samples/net/tftp_server/sample.yaml
```yaml
sample:
  description: Demonstrate TFTP server initialization and passive operation
  name: TFTP server sample app
tests:
  sample.net.tftp_server:
    harness: build
    depends_on: netif
    platform_allow:
      - native_sim
    integration_platforms:
      - native_sim
    tags:
      - net
      - tftp
      - server
```

## samples/net/throughput_server/sample.yaml
```yaml
common:
  harness: net
  tags: net
sample:
  description: Test packet receival throughput.
  name: Throughput Server
tests:
  test_frdm_k64f:
    platform_whitelist: frdm_k64f
    extra_args: CONF_FILE="prj_frdm_k64f.conf"
```

## samples/net/traffic_class/Kconfig
```kconfig
# Kconfig - Private config options for traffic class sample app

#
# Copyright (c) 2018 Intel Corporation
#
# SPDX-License-Identifier: Apache-2.0
#

mainmenu "Networking traffic class sample application"

config SAMPLE_VLAN_TAG
	int "Virtual lan tag used in sample app"
	default 100
	range 0 4094
	depends on NET_VLAN
	help
	  Set virtual lan tag (id) that is used in sample application.

config SAMPLE_VLAN_TAG_2
	int "Second VLAN tag used in sample app"
	default 200
	range 0 4094
	depends on NET_VLAN
	help
	  Set virtual lan tag (id) that is used in sample application.

config SAMPLE_IPV6_ADDR_2
	string "My IPv6 address for second interface"
	help
	  The value depends on your network setup.

config SAMPLE_IPV4_ADDR_2
	string "My IPv4 address for second interface"
	help
	  The value depends on your network setup.

config SAMPLE_PEER_IPV6_ADDR_2
	string "Peer IPv6 address for second interface"
	help
	  The value depends on your network setup.

config SAMPLE_PEER_IPV4_ADDR_2
	string "Peer IPv4 address for second interface"
	help
	  The value depends on your network setup.


source "$(ZEPHYR_BASE)/Kconfig.zephyr"
```

## samples/net/traffic_class/sample.yaml
```yaml
common:
  harness: net
  tags: net vlan traffic_class
sample:
  description: Test traffic class functionality
  name: Traffic class sample app
tests:
  test:
    depends_on: netif
    min_ram: 170
```

## samples/net/updatehub/Kconfig
```kconfig
#
#  Copyright (c) 2018 O.S.Systems
#
#  SPDX-License-Identifier: Apache-2.0
#
mainmenu "Sample app Configuration"

config UPDATEHUB_MANUAL
	bool "UpdateHub manual mode"
	help
	  Manual mode requires the user to call the server probe and then, if
	  there is an available update, also requires the user to decide if
	  it is appropriate to update now or later.

if !UPDATEHUB_MANUAL
config UPDATEHUB_POLLING
	bool "UpdateHub polling mode"
	default y
	help
	  Polling mode runs automatically on a predefined period, probing the
	  server for updates and installing them without requiring user
	  intervention.
endif #!UPDATEHUB_MANUAL

source "$ZEPHYR_BASE/Kconfig.zephyr"
```

## samples/net/virtual/Kconfig
```kconfig
# Private config options for virtual network interface sample app

# Copyright (c) 2021 Intel Corporation
# SPDX-License-Identifier: Apache-2.0

mainmenu "Networking virtual network interface sample application"

config NET_SAMPLE_IFACE2_MY_IPV6_ADDR
	string "My IPv6 address for second interface"
	help
	  The value depends on your network setup.

config NET_SAMPLE_IFACE2_MY_IPV4_ADDR
	string "My IPv4 address for second interface"
	help
	  The value depends on your network setup.

config NET_SAMPLE_IFACE2_MY_IPV4_NETMASK
	string "My IPv4 netmask for second interface"
	default "255.255.255.0"
	help
	  Static netmask to use if not overridden by DHCP. Use empty value to
	  skip setting static value.

config NET_SAMPLE_IFACE3_MY_IPV6_ADDR
	string "My IPv6 address for third interface"
	help
	  The value depends on your network setup.

config NET_SAMPLE_IFACE3_MY_IPV4_ADDR
	string "My IPv4 address for third interface"
	help
	  The value depends on your network setup.

config NET_SAMPLE_IFACE3_MY_IPV4_NETMASK
	string "My IPv4 netmask for third interface"
	default "255.255.255.0"
	help
	  Static netmask to use if not overridden by DHCP. Use empty value to
	  skip setting static value.

source "Kconfig.zephyr"
```

## samples/net/virtual/sample.yaml
```yaml
common:
  harness: net
  tags: net virtual tunnel
sample:
  description: Test virtual network interface functionality
  name: Virtual network interface sample app
tests:
  sample.net.virtual:
    depends_on: netif
```

## samples/net/vlan/Kconfig
```kconfig
# Kconfig - Private config options for VLAN sample app

#
# Copyright (c) 2018 Intel Corporation
#
# SPDX-License-Identifier: Apache-2.0
#

mainmenu "Networking VLAN sample application"

config SAMPLE_VLAN_TAG
	int "Virtual lan tag used in VLAN sample app"
	default 100
	range 0 4094
	depends on NET_VLAN
	help
	  Set virtual lan tag (id) that is used in VLAN sample application.

config SAMPLE_VLAN_TAG_2
	int "Second VLAN tag used in VLAN sample app"
	default 200
	range 0 4094
	depends on NET_VLAN
	help
	  Set virtual lan tag (id) that is used in VLAN sample application.

config SAMPLE_IPV6_ADDR_2
	string "My IPv6 address for second interface"
	help
	  The value depends on your network setup.

config SAMPLE_IPV4_ADDR_2
	string "My IPv4 address for second interface"
	help
	  The value depends on your network setup.


source "$(ZEPHYR_BASE)/Kconfig.zephyr"
```

## samples/net/vlan/sample.yaml
```yaml
common:
  harness: net
  tags: net vlan
sample:
  description: Test VLAN functionality
  name: VLAN sample app
tests:
  sample.net.vlan:
    pre-filter: subsys_dt_compat_enabled("ethernet")
```

## samples/net/wifi/Kconfig
```kconfig
mainmenu "Wi-Fi sample"

if WIFI_WINC1500

config WINC1500_GPIO_DRV_NAME
	string "GPIO device name"

config WINC1500_GPIO_CHIP_EN
	int "Pin number for Winc1500 CHIP_EN signal"

config WINC1500_GPIO_IRQN
	int "Pin number for Winc1500 IRQn signal"

config WINC1500_GPIO_RESET_N
	int "Pin number for Winc1500 RESET_N signal"

endif # WIFI_WINC1500


source "$(ZEPHYR_BASE)/Kconfig.zephyr"
```
