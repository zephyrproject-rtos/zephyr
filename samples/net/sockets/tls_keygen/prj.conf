## CMakeLists.txt
```
# SPDX-License-Identifier: Apache-2.0

cmake_minimum_required(VERSION 3.20.0)

find_package(Zephyr REQUIRED HINTS $ENV{ZEPHYR_BASE})
project(tls_keygen)

target_sources(app PRIVATE src/main.c)
```

## Kconfig
```
# Copyright (c) 2026 Nordic Semiconductor ASA
# SPDX-License-Identifier: Apache-2.0

mainmenu "TLS on-device key generation sample"

config NET_SAMPLE_SEC_TAG
	int "Security tag"
	default 42
	help
	  Security tag of the generated key, the device certificate and the CA certificate.

config NET_SAMPLE_CSR_SUBJECT
	string "Subject of the CSR"
	default "CN=zephyr-device"

config NET_SAMPLE_SERVER_ADDR
	string "IPv4 address of the TLS server"
	default "127.0.0.1"

config NET_SAMPLE_SERVER_PORT
	int "Port of the TLS server"
	default 4433

config NET_SAMPLE_SERVER_HOSTNAME
	string "Hostname of the TLS server"
	default "localhost"
	help
	  Must match the common name or a subject alternative name of the server certificate.

source "Kconfig.zephyr"
```

## prj.conf
```kconfig
CONFIG_MAIN_STACK_SIZE=8192
CONFIG_HEAP_MEM_POOL_SIZE=16384

CONFIG_NETWORKING=y
CONFIG_NET_IPV4=y
CONFIG_NET_IPV6=n
CONFIG_NET_TCP=y
CONFIG_NET_SOCKETS=y
CONFIG_NET_SOCKETS_SOCKOPT_TLS=y

# PSA crypto and TLS 1.2 with ECDSA.
CONFIG_MBEDTLS=y
CONFIG_MBEDTLS_ENABLE_HEAP=y
CONFIG_MBEDTLS_HEAP_SIZE=60000
CONFIG_MBEDTLS_SSL_IN_CONTENT_LEN=4096
CONFIG_MBEDTLS_SSL_OUT_CONTENT_LEN=4096
CONFIG_PSA_CRYPTO=y
CONFIG_MBEDTLS_CIPHERSUITE_TLS_ECDHE_ECDSA_WITH_AES_128_GCM_SHA256=y

# Secure storage keeps the key and the TLS credentials.
CONFIG_SECURE_STORAGE=y
CONFIG_SECURE_STORAGE_PS_IMPLEMENTATION_ITS=y
CONFIG_SECURE_STORAGE_ITS_STORE_IMPLEMENTATION_SETTINGS=y
CONFIG_SECURE_STORAGE_ITS_MAX_DATA_SIZE=1024
CONFIG_SETTINGS=y
CONFIG_SETTINGS_NVS=y
CONFIG_NVS=y
CONFIG_FLASH=y
CONFIG_FLASH_MAP=y

CONFIG_TLS_CREDENTIALS=y
CONFIG_TLS_CREDENTIALS_BACKEND_PROTECTED_STORAGE=y
CONFIG_TLS_CREDENTIALS_KEYGEN=y

# Shell to add the certificates.
CONFIG_SHELL=y
CONFIG_SHELL_CMD_BUFF_SIZE=2048
CONFIG_BASE64=y
CONFIG_TLS_CREDENTIALS_SHELL=y
CONFIG_TLS_CREDENTIALS_SHELL_CRED_BUF_SIZE=2048

CONFIG_LOG=y
```

## boards/native_sim.conf
```kconfig
# Use the sockets of the host, so the sample can connect to a server on the host.
CONFIG_ETH_NATIVE_TAP=n
CONFIG_NET_DRIVERS=y
CONFIG_NET_SOCKETS_OFFLOAD=y
CONFIG_NET_NATIVE_OFFLOADED_SOCKETS=y

# Not secure. Only for the simulation.
CONFIG_ENTROPY_GENERATOR=y
CONFIG_TEST_RANDOM_GENERATOR=y
CONFIG_MBEDTLS_PSA_CRYPTO_EXTERNAL_RNG=y
CONFIG_MBEDTLS_PSA_CRYPTO_EXTERNAL_RNG_ALLOW_NON_CSPRNG=y

# Logs already go to stdout, so do not print them a second time through the shell.
CONFIG_SHELL_LOG_BACKEND=n
```

## src/main.c
```c
/*
 * Copyright (c) 2026 Nordic Semiconductor ASA
 *
 * SPDX-License-Identifier: Apache-2.0
 */

#include <stdio.h>
#include <zephyr/kernel.h>
#include <zephyr/logging/log.h>
#include <zephyr/net/socket.h>
#include <zephyr/net/tls_credentials.h>
#include <zephyr/net/tls_credentials_keygen.h>
#include <zephyr/sys/base64.h>

LOG_MODULE_REGISTER(tls_keygen_sample, LOG_LEVEL_INF);

#define SEC_TAG CONFIG_NET_SAMPLE_SEC_TAG
#define MESSAGE "Hello from Zephyr\n"

/* PEM has 64 characters per line, that is 48 bytes of DER. */
#define PEM_LINE_BYTES 48

static uint8_t csr[TLS_CREDENTIAL_KEYGEN_CSR_SIZE(sizeof(CONFIG_NET_SAMPLE_CSR_SUBJECT) - 1)];

static void pem_print(const char *label, const uint8_t *der, size_t len)
{
	char line[64 + 1];
	size_t olen;

	printk("-----BEGIN %s-----\n", label);

	for (size_t i = 0; i < len; i += PEM_LINE_BYTES) {
		(void)base64_encode(line, sizeof(line), &olen, der + i,
				    MIN(PEM_LINE_BYTES, len - i));
		printk("%s\n", line);
	}

	printk("-----END %s-----\n", label);
}

/* The key is persistent, so it is generated only on the first boot. */
static int key_ensure(void)
{
	psa_key_id_t key_id;
	int err;

	err = tls_credential_keygen_key_id_get(SEC_TAG, &key_id);
	if (err == 0) {
		LOG_INF("Using the key of sec tag %d", SEC_TAG);
		return 0;
	}

	if (err != -ENOENT) {
		return err;
	}

	LOG_INF("Generating a key for sec tag %d", SEC_TAG);

	return tls_credential_keygen_generate(SEC_TAG, TLS_CREDENTIAL_KEYGEN_ECDSA_SECP256R1);
}

static int csr_print(void)
{
	uint8_t pubkey[TLS_CREDENTIAL_KEYGEN_PUBKEY_MAX_SIZE];
	size_t len;
	int err;

	err = tls_credential_keygen_pubkey_get(SEC_TAG, pubkey, sizeof(pubkey), &len);
	if (err) {
		return err;
	}

	pem_print("PUBLIC KEY", pubkey, len);

	err = tls_credential_keygen_csr(SEC_TAG, CONFIG_NET_SAMPLE_CSR_SUBJECT, csr, sizeof(csr),
					&len);
	if (err) {
		return err;
	}

	pem_print("CERTIFICATE REQUEST", csr, len);

	return 0;
}

static bool credential_exists(enum tls_credential_type type)
{
	uint8_t buf;
	size_t len = sizeof(buf);
	int err;

	err = tls_credential_get(SEC_TAG, type, &buf, &len);

	return err == 0 || err == -EFBIG;
}

static void certificates_wait(void)
{
	if (credential_exists(TLS_CREDENTIAL_PUBLIC_CERTIFICATE) &&
	    credential_exists(TLS_CREDENTIAL_CA_CERTIFICATE)) {
		return;
	}

	LOG_INF("Waiting for the certificates. Add them in the shell:");
	LOG_INF("  cred add %d CLIENT_CERT DEFAULT BIN <base64 DER>", SEC_TAG);
	LOG_INF("  cred add %d CA_CERT DEFAULT BIN <base64 DER>", SEC_TAG);

	while (!credential_exists(TLS_CREDENTIAL_PUBLIC_CERTIFICATE) ||
	       !credential_exists(TLS_CREDENTIAL_CA_CERTIFICATE)) {
		k_sleep(K_SECONDS(1));
	}
}

static int server_talk(void)
{
	static const sec_tag_t tags[] = {SEC_TAG};
	struct net_sockaddr_in addr = {
		.sin_family = NET_AF_INET,
		.sin_port = net_htons(CONFIG_NET_SAMPLE_SERVER_PORT),
	};
	char buf[64];
	int ret;
	int fd;

	if (zsock_inet_pton(NET_AF_INET, CONFIG_NET_SAMPLE_SERVER_ADDR, &addr.sin_addr) != 1) {
		return -EINVAL;
	}

	fd = zsock_socket(NET_AF_INET, NET_SOCK_STREAM, NET_IPPROTO_TLS_1_2);
	if (fd < 0) {
		return -errno;
	}

	/* The sec tag gives the device certificate, the generated key and the CA certificate. */
	ret = zsock_setsockopt(fd, ZSOCK_SOL_TLS, ZSOCK_TLS_SEC_TAG_LIST, tags, sizeof(tags));
	if (ret < 0) {
		goto out;
	}

	ret = zsock_setsockopt(fd, ZSOCK_SOL_TLS, ZSOCK_TLS_HOSTNAME,
			       CONFIG_NET_SAMPLE_SERVER_HOSTNAME,
			       sizeof(CONFIG_NET_SAMPLE_SERVER_HOSTNAME));
	if (ret < 0) {
		goto out;
	}

	LOG_INF("Connecting to %s:%d", CONFIG_NET_SAMPLE_SERVER_ADDR,
		CONFIG_NET_SAMPLE_SERVER_PORT);

	ret = zsock_connect(fd, (struct net_sockaddr *)&addr, sizeof(addr));
	if (ret < 0) {
		goto out;
	}

	LOG_INF("TLS handshake done");

	ret = zsock_send(fd, MESSAGE, sizeof(MESSAGE) - 1, 0);
	if (ret < 0) {
		goto out;
	}

	ret = zsock_recv(fd, buf, sizeof(buf) - 1, 0);
	if (ret < 0) {
		goto out;
	}

	buf[ret] = '\0';
	LOG_INF("Received: %s", buf);
	ret = 0;

out:
	if (ret < 0) {
		ret = -errno;
	}

	(void)zsock_close(fd);

	return ret;
}

int main(void)
{
	int err;

	err = key_ensure();
	if (err) {
		LOG_ERR("Key generation failed: %d", err);
		return 0;
	}

	err = csr_print();
	if (err) {
		LOG_ERR("CSR generation failed: %d", err);
		return 0;
	}

	certificates_wait();

	err = server_talk();
	if (err) {
		LOG_ERR("Connection failed: %d", err);
		return 0;
	}

	LOG_INF("Done");

	return 0;
}
```
