/*
 * Copyright (c) 2020 Gerson Fernando Budke
 *
 * SPDX-License-Identifier: Apache-2.0
 */

&spi0 {
        status = "okay";
        label = "SPI_RF2XX";
        cs-gpios = <&porta 31 (GPIO_PULL_UP | GPIO_ACTIVE_LOW)>;

        rf2xx@0 {
                compatible = "atmel,rf2xx";
                reg = <0x0>;
                label = "RF2XX_0";
                spi-max-frequency = <6000000>;
                irq-gpios = <&portb 2 (GPIO_PULL_DOWN | GPIO_ACTIVE_HIGH)>;
                reset-gpios = <&porta 3 GPIO_ACTIVE_LOW>;
                slptr-gpios = <&portb 3 GPIO_ACTIVE_HIGH>;
                status = "okay";
        };
};
