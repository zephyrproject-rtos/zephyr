## CMakeLists.txt
```
# SPDX-License-Identifier: Apache-2.0

cmake_minimum_required(VERSION 3.28.0)

find_package(Zephyr REQUIRED HINTS $ENV{ZEPHYR_BASE})
project(sockets_socketpair)

FILE(GLOB app_sources src/*.c)
target_sources(app PRIVATE ${app_sources})

include(${ZEPHYR_BASE}/samples/net/common/common.cmake)
```

## sample.yaml
```
sample:
  description: Socketpair sample
  name: socketpair
common:
  tags:
    - net
    - socket
    - posix
  harness: net
  arch_exclude: posix
tests:
  sample.net.sockets.socketpair:
    integration_platforms:
      - qemu_x86
    platform_exclude: s32k148_evb/s32k148
  sample.net.sockets.socketpair.s32k148_evb:
    extra_args: SHIELD=nxp_adtja1101
    platform_allow: s32k148_evb/s32k148
```

## prj.conf
```kconfig
# Provide some heap space
CONFIG_HEAP_MEM_POOL_SIZE=2048

# socketpair dependencies
CONFIG_POSIX_AEP_CHOICE_NETAPP=y
CONFIG_NET_SOCKETPAIR=y

# Networking config (network subsystem dependencies)
CONFIG_NETWORKING=y
CONFIG_NET_SOCKETS=y
CONFIG_TEST_RANDOM_GENERATOR=y
```

## src/main.c
```c
/*
 * Copyright (c) 2020 Friedt Professional Engineering Services, Inc
 *
 * SPDX-License-Identifier: Apache-2.0
 */
#include <errno.h>
#include <poll.h>
#include <pthread.h>
#include <stdbool.h>
#include <stdio.h>
#include <string.h>
#include <sys/socket.h>
#include <unistd.h>

#ifdef __ZEPHYR__
#include <zephyr/kernel.h>
#endif

#define NUM_SOCKETPAIRS 3
#define NUM_REPITITIONS 3

struct context {
	int spair[2];
	pthread_t thread;
	const char *name;
};

static const char *const names[] = {
	"Alpha",
	"Bravo",
	"Charlie",
};

#ifdef __ZEPHYR__
#define STACK_SIZE (1024)
K_THREAD_STACK_ARRAY_DEFINE(stack, NUM_SOCKETPAIRS, STACK_SIZE);
#endif

static int hello(int fd, const char *name)
{
	int res;
	char buf[32] = {0};

	/* check for an echo of what is written */
	res = write(fd, name, strlen(name));
	if (res < 0) {
		perror("write");
	} else if (res != strlen(name)) {
		printf("only wrote %d/%d bytes", res, (int)strlen(name));
		return -EIO;
	}

	res = read(fd, buf, sizeof(buf) - 1);
	if (res < 0) {
		perror("read");
	} else if (res != strlen(name)) {
		printf("only read %d/%d bytes", res, (int)strlen(name));
		return -EIO;
	}

	if (strncmp(buf, name, sizeof(buf)) != 0) {
		printf("expected %s\n", name);
		return -EINVAL;
	}

	return 0;
}

static void *fun(void *arg)
{
	struct context *ctx = (struct context *)arg;
	int fd = ctx->spair[1];
	const char *name = ctx->name;

	for (size_t i = 0; i < NUM_REPITITIONS; ++i) {
		if (hello(fd, name) < 0) {
			break;
		}
	}

	return NULL;
}

static int fd_to_idx(int fd, const struct context *ctx, size_t n)
{
	int res = -1;
	size_t i;

	for (i = 0; i < n; ++i) {
		if (ctx[i].spair[0] == fd) {
			res = i;
			break;
		}
	}

	return res;
}

static int setup(struct context *ctx, size_t n)
{
	int res;
#ifdef __ZEPHYR__
	pthread_attr_t attr;
	pthread_attr_t *attrp = &attr;
#else
	pthread_attr_t *attrp = NULL;
#endif

	for (size_t i = 0; i < n; ++i) {
		ctx[i].name = (char *)names[i];
		res = socketpair(AF_UNIX, SOCK_STREAM, 0, ctx[i].spair);
		if (res < 0) {
			perror("socketpair");
			return res;
		}

#ifdef __ZEPHYR__
		/* Zephyr requires a non-NULL attribute for pthread_create */
		res = pthread_attr_init(attrp);
		if (res != 0) {
			errno = res;
			perror("pthread_attr_init");
			return -res;
		}

		res = pthread_attr_setstack(&attr, &stack[i], STACK_SIZE);
		if (res != 0) {
			errno = res;
			perror("pthread_attr_setstack");
			return -res;
		}
#endif

		res = pthread_create(&ctx[i].thread, attrp, fun, &ctx[i]);
		if (res != 0) {
			errno = res;
			perror("pthread_create");
			return -res;
		}

		printf("%s: socketpair: %d <=> %d\n",
			ctx[i].name, ctx[i].spair[0], ctx[i].spair[1]);
	}

	return 0;
}

static void teardown(struct context *ctx, size_t n)
{
	void *unused;

	for (size_t i = 0; i < n; ++i) {
		pthread_join(ctx[i].thread, &unused);

		close(ctx[i].spair[0]);
		ctx[i].spair[0] = -1;

		close(ctx[i].spair[1]);
		ctx[i].spair[1] = -1;
	}
}

static void setup_poll(const struct context *ctx, struct pollfd *fds, size_t n)
{
	for (size_t i = 0; i < n; ++i) {
		fds[i].fd = ctx[i].spair[0];
		fds[i].events = POLLIN;
		fds[i].revents = 0;
	}
}

static int handle_poll_events(const struct context *ctx, struct pollfd *fds, size_t n,
			      size_t n_events)
{
	int res;
	int idx;
	char buf[32];
	size_t event = 0;

	for (size_t i = 0; event < n_events && i < n; ++i) {
		idx = fd_to_idx(fds[i].fd, ctx, n);
		if (idx < 0) {
			printf("failed to find fd %d in any active context\n", fds[i].fd);
			continue;
		}

		if ((fds[i].revents & POLLERR) != 0) {
			printf("fd: %d: error\n", fds[i].fd);
			return -EIO;
		} else if ((fds[i].revents & POLLIN) != 0) {
			memset(buf, '\0', sizeof(buf));

			/* echo back the same thing that was read */
			res = read(fds[i].fd, buf, sizeof(buf));
			if (res < 0) {
				perror("read");
				return -errno;
			}

			printf("main: read '%s' on fd %d\n", buf, fds[i].fd);
			if (strncmp(ctx[idx].name, buf, sizeof(buf)) != 0) {
				printf("main: expected: '%s' actual: '%s'\n", ctx[idx].name, buf);
				return -EINVAL;
			}

			res = write(fds[i].fd, buf, res);
			if (res < 0) {
				perror("write");
				return -errno;
			}

			++event;
		}
	}

	if (event != n_events) {
		printf("main: unhandled events remaining\n");
		return -EINVAL;
	}

	return n_events;
}

int main(void)
{
	int res;
	struct context ctx[NUM_SOCKETPAIRS] = {};
	struct pollfd fds[NUM_SOCKETPAIRS] = {};

	printf("setting-up\n");
	res = setup(ctx, NUM_SOCKETPAIRS);
	if (res < 0) {
		goto out;
	}

	for (size_t n_events = NUM_SOCKETPAIRS * NUM_REPITITIONS; n_events > 0; n_events -= res) {

		setup_poll(ctx, fds, NUM_SOCKETPAIRS);
		res = poll(fds, NUM_SOCKETPAIRS, -1);
		if (res < 0) {
			perror("poll");
			goto out;
		}

		res = handle_poll_events(ctx, fds, NUM_SOCKETPAIRS, res);
		if (res < 0) {
			goto out;
		}
	}

	res = 0;

out:
	printf("tearing-down\n");
	teardown(ctx, NUM_SOCKETPAIRS);

	printf("%s\n", res == 0 ? "SUCCESS" : "FAILURE");

	return res;
}
```

## src/socketpair_example.c
```c
/*
 * Copyright (c) 2020 Friedt Professional Engineering Services, Inc
 *
 * SPDX-License-Identifier: Apache-2.0
 */
#if defined(__ZEPHYR__) && !defined(CONFIG_ARCH_POSIX)

#include <zephyr/net/socket.h>
#include <zephyr/posix/pthread.h>
#include <zephyr/sys/util.h>
#include <zephyr/posix/unistd.h>

#else

#include <poll.h>
#include <pthread.h>
#include <sys/socket.h>
#include <sys/types.h>
#include <unistd.h>

#define ARRAY_SIZE(x) (sizeof(x)/sizeof((x)[0]))

#endif

#include <errno.h>
#include <stdbool.h>
#include <stdio.h>
#include <string.h>

#define NUM_SOCKETPAIRS 3
#define NUM_REPITITIONS 3

struct ctx {
	int spair[2];
	pthread_t thread;
	char *name;
};

static const char *const names[] = {
	"Alpha",
	"Bravo",
	"Charlie",
};

#if defined(__ZEPHYR__) && !defined(CONFIG_ARCH_POSIX)

#define STACK_SIZE (1024)
static pthread_attr_t attr[NUM_SOCKETPAIRS];
K_THREAD_STACK_ARRAY_DEFINE(stack, NUM_SOCKETPAIRS, STACK_SIZE);

#endif

static void hello(int fd, const char *name)
{
	/* write(2) should be used after #25443 */
	int res = send(fd, name, strlen(name), 0);

	if (res != strlen(name)) {
		printf("%s(): send: expected: %d actual: %d errno: %d\n",
			__func__, (int)strlen(name), res, errno);
	}
}

static void *fun(void *arg)
{
	struct ctx *const ctx = (struct ctx *)arg;
	int fd = ctx->spair[1];
	const char *name = ctx->name;

	for (size_t i = 0; i < NUM_REPITITIONS; ++i) {
		hello(fd, name);
	}

	close(fd);
	printf("%s closed fd %d\n", name, fd);
	ctx->spair[1] = -1;

	return NULL;
}

static int fd_to_idx(int fd, struct ctx *ctx, size_t n)
{
	int r = -1;
	size_t i;

	for (i = 0; i < n; ++i) {
		if (ctx[i].spair[0] == fd) {
			r = i;
			break;
		}
	}

	return r;
}

#ifdef __ZEPHYR__
void zephyr_app_main(void)
{
#else
int main(int argc, char *argv[])
{
	(void) argc;
	(void) argv;
#endif

	int r;
	int fd;
	int idx;
	size_t i;
	size_t num_active;
	char buf[32];
	struct ctx ctx[NUM_SOCKETPAIRS] = {};
	struct pollfd fds[NUM_SOCKETPAIRS] = {};
	void *unused;
	pthread_attr_t *attrp = NULL;

	for (i = 0; i < ARRAY_SIZE(ctx); ++i) {
		ctx[i].name = (char *)names[i];
		r = socketpair(AF_UNIX, SOCK_STREAM, 0, ctx[i].spair);
		if (r != 0) {
			printf("socketpair failed: %d\n", errno);
			goto out;
		}

#if defined(__ZEPHYR__) && !defined(CONFIG_ARCH_POSIX)
		/* Zephyr requires a non-NULL attribute for pthread_create */
		attrp = &attr[i];
		r = pthread_attr_init(attrp);
		if (r != 0) {
			printf("pthread_attr_init() failed: %d", r);
			goto out;
		}

		r = pthread_attr_setstack(attrp, &stack[i], STACK_SIZE);
		if (r != 0) {
			printf("pthread_attr_setstack() failed: %d", r);
			goto out;
		}
#endif

		r = pthread_create(&ctx[i].thread, attrp, fun, &ctx[i]);
		if (r != 0) {
			printf("pthread_create failed: %d\n", r);
			goto out;
		}

		printf("%s: socketpair: %d <=> %d\n",
			ctx[i].name, ctx[i].spair[0], ctx[i].spair[1]);
	}

	/* loop until all threads are done */
	for (;;) {

		/* count threads that are still running and fill in pollfds */
		for (i = 0, num_active = 0; i < ARRAY_SIZE(ctx); ++i) {
			if (ctx[i].spair[0] == -1) {
				continue;
			}
			fds[num_active].fd = ctx[i].spair[0];
			fds[num_active].events = POLLIN;
			fds[num_active].revents = 0;
			num_active++;
		}

		if (num_active == 0) {
			/* all threads are done */
			break;
		}

		(void)poll(fds, num_active, -1);

		for (size_t i = 0; i < num_active; ++i) {

			fd = fds[i].fd;
			idx = fd_to_idx(fd, ctx, ARRAY_SIZE(ctx));
			if (idx < 0) {
				printf("failed to map fd %d to index\n", fd);
				continue;
			}

			if ((fds[i].revents & POLLIN) != 0) {

				memset(buf, '\0', sizeof(buf));

				/* read(2) should be used after #25443 */
				r = recv(fd, buf, sizeof(buf), 0);
				printf("fd: %d: read %d bytes\n", fd, r);
			}

			if ((fds[i].revents & POLLERR) != 0) {
				printf("fd: %d: error\n", fd);
			}

			if ((fds[i].revents & POLLHUP) != 0) {
				printf("fd: %d: hung up\n", fd);
				close(ctx[idx].spair[0]);
				printf("%s: closed fd %d\n", __func__,
					ctx[idx].spair[0]);
				pthread_join(ctx[idx].thread, &unused);
				printf("joined %s\n", ctx[idx].name);
				ctx[idx].spair[0] = -1;
			}
		}
	}

	printf("finished!\n");

out:
#ifndef __ZEPHYR__
	return 0;
#else
	return;
#endif
}
```
