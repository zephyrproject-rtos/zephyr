## CMakeLists.txt
```
# SPDX-License-Identifier: Apache-2.0

cmake_minimum_required(VERSION 3.28.0)

find_package(Zephyr REQUIRED HINTS $ENV{ZEPHYR_BASE})
project(http_get)

FILE(GLOB app_sources src/*.c)
target_sources(app PRIVATE ${app_sources})

include(${ZEPHYR_BASE}/samples/net/common/common.cmake)

set(gen_dir ${ZEPHYR_BINARY_DIR}/include/generated/)

generate_inc_file_for_target(
    app
    src/globalsign_r1.der
    ${gen_dir}/globalsign_r1.der.inc
    )
```

## Kconfig
```
#
# Copyright (c) 2025 Ezurio
#
# SPDX-License-Identifier: Apache-2.0
#

config NET_SAMPLE_TLS_SESSION_CACHE
	bool "Enable TLS session caching"
	depends on NET_SOCKETS_SOCKOPT_TLS
	help
	  Enable TLS client session caching for the http_get sample.
	  Sessions are cached in RAM and reused on reconnect.
	  Combine with CONFIG_NET_SOCKETS_TLS_SESSION_CACHE_PERSISTENT
	  to persist sessions across reboots.

source "samples/net/common/Kconfig"
source "Kconfig.zephyr"
```

## sample.yaml
```
sample:
  description: BSD Sockets API HTTP GET example
  name: socket_http_get
common:
  filter: CONFIG_FULL_LIBC_SUPPORTED
  depends_on: netif
  min_ram: 32
  min_flash: 80
  tags:
    - net
    - socket
tests:
  sample.net.sockets.http_get:
    filter: not CONFIG_NET_SOCKETS_OFFLOAD and not CONFIG_NATIVE_LIBC
    harness: net
    platform_exclude:
      - cc3220sf_launchxl
      - cc3235sf_launchxl
    extra_configs:
      - CONFIG_POSIX_API=y
  sample.net.sockets.http_get.offload.simplelink:
    platform_allow: cc3220sf_launchxl
    harness: net
    tags:
      - net
      - socket
      - offload
      - simplelink
  sample.net.sockets.http_get.nsos.http:
    harness: console
    harness_config:
      type: multi_line
      ordered: true
      regex:
        - "(.*)<BODY>(.*)"
        - "The document has moved"
        - "(.*)</BODY>(.*)"
    platform_allow:
      - native_sim
      - native_sim/native/64
    extra_args: EXTRA_CONF_FILE="overlay-nsos.conf"
  sample.net.sockets.http_get.nsos.https:
    harness: console
    harness_config:
      type: multi_line
      ordered: true
      regex:
        - "(.*)<BODY>(.*)"
        - "The document has moved"
        - "(.*)</BODY>(.*)"
    platform_allow:
      - native_sim
      - native_sim/native/64
    extra_args: EXTRA_CONF_FILE="overlay-nsos.conf;overlay-tls.conf"
  sample.net.sockets.http_get.tls_session_cache:
    harness: net
    platform_allow:
      - native_sim
      - native_sim/native/64
    extra_args: EXTRA_CONF_FILE="overlay-tls.conf;overlay-tls-session-cache.conf"
  sample.net.sockets.http_get.wifi.nrf70dk:
    extra_args:
      - SNIPPET=wifi-ipv4
      - CONFIG_BUILD_ONLY_NO_BLOBS=y
    platform_allow:
      - nrf7002dk/nrf5340/cpuapp
```

## prj.conf
```kconfig
# General config
CONFIG_MAIN_STACK_SIZE=1536
CONFIG_REQUIRES_FULL_LIBC=y

# Networking config
CONFIG_NETWORKING=y
CONFIG_NET_IPV4=y
CONFIG_NET_IPV6=y
CONFIG_NET_TCP=y
CONFIG_NET_SOCKETS=y

CONFIG_POSIX_AEP_CHOICE_PSE52=y
CONFIG_POSIX_NETWORKING=y

CONFIG_DNS_RESOLVER=y
CONFIG_DNS_SERVER_IP_ADDRESSES=y
CONFIG_DNS_SERVER1="192.0.2.2"

# Network driver config
CONFIG_TEST_RANDOM_GENERATOR=y

# Network address config
CONFIG_NET_CONFIG_SETTINGS=y
CONFIG_NET_CONFIG_NEED_IPV4=y
CONFIG_NET_CONFIG_MY_IPV4_ADDR="192.0.2.1"
CONFIG_NET_CONFIG_PEER_IPV4_ADDR="192.0.2.2"
CONFIG_NET_CONFIG_MY_IPV4_GW="192.0.2.2"

# Network debug config
CONFIG_NET_LOG=y
```

## hl7800.conf
```kconfig
# The HL7800 driver gets its IP settings from the cell network
CONFIG_DNS_SERVER_IP_ADDRESSES=n
CONFIG_NET_CONFIG_SETTINGS=n
# Wait for the network to be ready
CONFIG_NET_CONNECTION_MANAGER=y
# NB-IoT has large latency, so increase timeouts. It is ok to use this for Cat-M1 as well.
CONFIG_NET_SOCKETS_DNS_TIMEOUT=12000
CONFIG_NET_SOCKETS_CONNECT_TIMEOUT=15000

# CONFIG_MODEM_LOG_LEVEL_DBG=y
# CONFIG_LOG_PROCESS_THREAD_SLEEP_MS=1
# CONFIG_LOG_BUFFER_SIZE=20000
# CONFIG_MODEM_HL7800_SET_APN_NAME_ON_STARTUP=y
# CONFIG_MODEM_HL7800_APN_NAME="VZWINTERNET"
```

## overlay-hl7800.conf
```kconfig
# The HL7800 driver gets its IP settings from the cell network
CONFIG_DNS_SERVER_IP_ADDRESSES=n
CONFIG_NET_CONFIG_SETTINGS=n
# Wait for the network to be ready
CONFIG_NET_CONNECTION_MANAGER=y
CONFIG_NET_SAMPLE_COMMON_WAIT_DNS_SERVER_ADDITION=y
# NB-IoT has large latency, so increase timeouts. It is ok to use this for Cat-M1 as well.
CONFIG_NET_SOCKETS_DNS_TIMEOUT=12000
CONFIG_NET_SOCKETS_CONNECT_TIMEOUT=15000

# CONFIG_MODEM_LOG_LEVEL_DBG=y
# CONFIG_LOG_PROCESS_THREAD_SLEEP_MS=1
# CONFIG_LOG_BUFFER_SIZE=20000
# CONFIG_MODEM_HL7800_SET_APN_NAME_ON_STARTUP=y
# CONFIG_MODEM_HL7800_APN_NAME="VZWINTERNET"
```

## overlay-nsos.conf
```kconfig
CONFIG_ETH_NATIVE_TAP=n
CONFIG_NET_DRIVERS=y
CONFIG_NET_SOCKETS=y
CONFIG_NET_SOCKETS_OFFLOAD=y
CONFIG_NET_NATIVE_OFFLOADED_SOCKETS=y
```

## overlay-tls-offload.conf
```kconfig
CONFIG_NET_SOCKETS_SOCKOPT_TLS=y

# Enable TLS credential filenames for secure socket offload
CONFIG_TLS_CREDENTIAL_FILENAMES=y
```

## overlay-tls-session-cache.conf
```kconfig
# Persistent TLS session cache
# Usage: west build -b <board> samples/net/sockets/http_get -- \
#   -DEXTRA_CONF_FILE="overlay-tls.conf;overlay-tls-session-cache.conf"

CONFIG_NET_SAMPLE_TLS_SESSION_CACHE=y

CONFIG_SETTINGS=y
CONFIG_NET_SOCKETS_TLS_SESSION_CACHE_PERSISTENT=y
CONFIG_FLASH=y
CONFIG_FLASH_MAP=y
CONFIG_FLASH_PAGE_LAYOUT=y
CONFIG_NVS=y
CONFIG_SETTINGS_NVS=y
```

## overlay-tls.conf
```kconfig
CONFIG_MAIN_STACK_SIZE=4096

# TLS configuration
CONFIG_MBEDTLS=y
CONFIG_MBEDTLS_ENABLE_HEAP=y
CONFIG_MBEDTLS_HEAP_SIZE=60000
CONFIG_MBEDTLS_SSL_IN_CONTENT_LEN=7168
CONFIG_MBEDTLS_SSL_OUT_CONTENT_LEN=7168
CONFIG_MBEDTLS_HASH_ALL_ENABLED=y
CONFIG_PSA_WANT_ALG_CMAC=y

CONFIG_NET_SOCKETS_SOCKOPT_TLS=y
CONFIG_MBEDTLS_CIPHERSUITE_TLS_ECDHE_RSA_WITH_AES_128_CBC_SHA256=y
CONFIG_PSA_WANT_ALG_SHA_1=y

# Debugging options
#CONFIG_MBEDTLS_DEBUG=y
#CONFIG_MBEDTLS_LOG_LEVEL_DBG=y
```

## src/ca_certificate.h
```c
/*
 * Copyright (c) 2018 Nordic Semiconductor ASA
 *
 * SPDX-License-Identifier: Apache-2.0
 */

#ifndef __CA_CERTIFICATE_H__
#define __CA_CERTIFICATE_H__

#define CA_CERTIFICATE_TAG 1

/* By default only certificates in DER format are supported. If you want to use
 * certificate in PEM format, you can enable support for it in Kconfig.
 */

/* GlobalSign Root CA - R1 for https://google.com */
#if defined(CONFIG_TLS_CREDENTIAL_FILENAMES)
static const unsigned char ca_certificate[] = "globalsign_r1.der";
#else
static const unsigned char ca_certificate[] = {
#include <globalsign_r1.der.inc>
};
#endif

#endif /* __CA_CERTIFICATE_H__ */
```

## src/http_get.c
```c
/*
 * Copyright (c) 2017 Linaro Limited
 *
 * SPDX-License-Identifier: Apache-2.0
 */

#include <stdio.h>
#include <stdlib.h>

#if !defined(__ZEPHYR__)

#include <netinet/in.h>
#include <sys/socket.h>
#include <arpa/inet.h>
#include <unistd.h>
#include <netdb.h>

#else

#include <zephyr/posix/netinet/in.h>
#include <zephyr/posix/sys/socket.h>
#include <zephyr/posix/arpa/inet.h>
#include <zephyr/posix/unistd.h>
#include <zephyr/posix/netdb.h>

#include <zephyr/net/socket.h>
#include <zephyr/kernel.h>

#if defined(CONFIG_NET_SOCKETS_SOCKOPT_TLS)
#include <zephyr/net/tls_credentials.h>
#include "ca_certificate.h"
#endif

#include <zephyr/net/conn_mgr_monitor.h>
#include "net_sample_common.h"

#endif

/* HTTP server to connect to */
#define HTTP_HOST "google.com"
/* Port to connect to, as string */
#if defined(CONFIG_NET_SOCKETS_SOCKOPT_TLS)
#define HTTP_PORT "443"
#else
#define HTTP_PORT "80"
#endif
/* HTTP path to request */
#define HTTP_PATH "/"

#define SSTRLEN(s) (sizeof(s) - 1)
#define CHECK(r) { if (r < 0) { printf("Error: %d\n", (int)r); exit(1); } }

#define REQUEST "GET " HTTP_PATH " HTTP/1.1\r\nHost: " HTTP_HOST "\r\n\r\n"

static char response[1024];

void dump_addrinfo(const struct addrinfo *ai)
{
	printf("addrinfo @%p: ai_family=%d, ai_socktype=%d, ai_protocol=%d, "
	       "sa_family=%d, sin_port=%x\n",
	       ai, ai->ai_family, ai->ai_socktype, ai->ai_protocol, ai->ai_addr->sa_family,
	       ntohs(((struct sockaddr_in *)ai->ai_addr)->sin_port));
}

int main(void)
{
	static struct addrinfo hints;
	struct addrinfo *res;
	int st, sock;

#if defined(__ZEPHYR__)
	printf("Waiting for network...\n");
	(void)conn_mgr_wait_ready(CONN_MGR_READY_IPV4 | CONN_MGR_READY_DNS, NULL, K_FOREVER);
	printf("Network ready\n");
#endif

#if defined(CONFIG_NET_SOCKETS_SOCKOPT_TLS)
	tls_credential_add(CA_CERTIFICATE_TAG, TLS_CREDENTIAL_CA_CERTIFICATE,
			   ca_certificate, sizeof(ca_certificate));
#endif

	printf("Preparing HTTP GET request for http://" HTTP_HOST
	       ":" HTTP_PORT HTTP_PATH "\n");

	memset(&hints, 0, sizeof(hints));
	hints.ai_family = AF_INET;
	hints.ai_socktype = SOCK_STREAM;
	st = getaddrinfo(HTTP_HOST, HTTP_PORT, &hints, &res);
	printf("getaddrinfo status: %d\n", st);

	if (st != 0) {
		printf("Unable to resolve address, quitting\n");
		return 0;
	}

#if 0
	struct addrinfo *temp_res = res;

	for (; temp_res; temp_res = temp_res->ai_next) {
		dump_addrinfo(temp_res);
	}
#endif

	dump_addrinfo(res);

#if defined(CONFIG_NET_SOCKETS_SOCKOPT_TLS)
	sock = socket(res->ai_family, res->ai_socktype, IPPROTO_TLS_1_2);
#else
	sock = socket(res->ai_family, res->ai_socktype, res->ai_protocol);
#endif
	CHECK(sock);
	printf("sock = %d\n", sock);

#if defined(CONFIG_NET_SOCKETS_SOCKOPT_TLS)
	sec_tag_t sec_tag_opt[] = {
		CA_CERTIFICATE_TAG,
	};
	CHECK(setsockopt(sock, SOL_TLS, TLS_SEC_TAG_LIST,
			 sec_tag_opt, sizeof(sec_tag_opt)));

	CHECK(setsockopt(sock, SOL_TLS, TLS_HOSTNAME,
			 HTTP_HOST, sizeof(HTTP_HOST)))

#if defined(CONFIG_NET_SAMPLE_TLS_SESSION_CACHE)
	int session_cache = TLS_SESSION_CACHE_ENABLED;

	CHECK(setsockopt(sock, SOL_TLS, TLS_SESSION_CACHE, &session_cache, sizeof(session_cache)));
#endif

#endif

	printf("Connecting to server...\n");
	CHECK(connect(sock, res->ai_addr, res->ai_addrlen));
	printf("Connected!\r\nSending request...\n");
	CHECK(send(sock, REQUEST, SSTRLEN(REQUEST), 0));

	printf("Response:\n\n");

	while (1) {
		int len = recv(sock, response, sizeof(response) - 1, 0);

		if (len < 0) {
			printf("Error reading response\n");
			return 0;
		}

		if (len == 0) {
			break;
		}

		response[len] = 0;
		printf("%s", response);
	}

	printf("\nClose socket\n");

	(void)close(sock);
	freeaddrinfo(res);

	return 0;
}
```

## src/tls_default_credentials.h
```c
/*
 * Copyright (c) 2018 Nordic Semiconductor ASA
 *
 * SPDX-License-Identifier: Apache-2.0
 */

#ifndef __TLS_DEFAULT_CREDENTIALS_H__
#define __TLS_DEFAULT_CREDENTIALS_H__

#define NET_TLS_DEFAULT_CA_CERTIFICATE_TAG 1
#define NET_TLS_DEFAULT_PSK_TAG 2

#if defined(MBEDTLS_X509_CRT_PARSE_C)

/* By default only certificates in DER format are supported. If you want to use
 * certificate in PEM format, you can enable support for it in Kconfig.
 */

/* GlobalSign Root CA - R2 */
static const unsigned char ca_certificate[] = {
	0x30, 0x82, 0x03, 0xba, 0x30, 0x82, 0x02, 0xa2,
	0xa0, 0x03, 0x02, 0x01, 0x02, 0x02, 0x0b, 0x04,
	0x00, 0x00, 0x00, 0x00, 0x01, 0x0f, 0x86, 0x26,
	0xe6, 0x0d, 0x30, 0x0d, 0x06, 0x09, 0x2a, 0x86,
	0x48, 0x86, 0xf7, 0x0d, 0x01, 0x01, 0x05, 0x05,
	0x00, 0x30, 0x4c, 0x31, 0x20, 0x30, 0x1e, 0x06,
	0x03, 0x55, 0x04, 0x0b, 0x13, 0x17, 0x47, 0x6c,
	0x6f, 0x62, 0x61, 0x6c, 0x53, 0x69, 0x67, 0x6e,
	0x20, 0x52, 0x6f, 0x6f, 0x74, 0x20, 0x43, 0x41,
	0x20, 0x2d, 0x20, 0x52, 0x32, 0x31, 0x13, 0x30,
	0x11, 0x06, 0x03, 0x55, 0x04, 0x0a, 0x13, 0x0a,
	0x47, 0x6c, 0x6f, 0x62, 0x61, 0x6c, 0x53, 0x69,
	0x67, 0x6e, 0x31, 0x13, 0x30, 0x11, 0x06, 0x03,
	0x55, 0x04, 0x03, 0x13, 0x0a, 0x47, 0x6c, 0x6f,
	0x62, 0x61, 0x6c, 0x53, 0x69, 0x67, 0x6e, 0x30,
	0x1e, 0x17, 0x0d, 0x30, 0x36, 0x31, 0x32, 0x31,
	0x35, 0x30, 0x38, 0x30, 0x30, 0x30, 0x30, 0x5a,
	0x17, 0x0d, 0x32, 0x31, 0x31, 0x32, 0x31, 0x35,
	0x30, 0x38, 0x30, 0x30, 0x30, 0x30, 0x5a, 0x30,
	0x4c, 0x31, 0x20, 0x30, 0x1e, 0x06, 0x03, 0x55,
	0x04, 0x0b, 0x13, 0x17, 0x47, 0x6c, 0x6f, 0x62,
	0x61, 0x6c, 0x53, 0x69, 0x67, 0x6e, 0x20, 0x52,
	0x6f, 0x6f, 0x74, 0x20, 0x43, 0x41, 0x20, 0x2d,
	0x20, 0x52, 0x32, 0x31, 0x13, 0x30, 0x11, 0x06,
	0x03, 0x55, 0x04, 0x0a, 0x13, 0x0a, 0x47, 0x6c,
	0x6f, 0x62, 0x61, 0x6c, 0x53, 0x69, 0x67, 0x6e,
	0x31, 0x13, 0x30, 0x11, 0x06, 0x03, 0x55, 0x04,
	0x03, 0x13, 0x0a, 0x47, 0x6c, 0x6f, 0x62, 0x61,
	0x6c, 0x53, 0x69, 0x67, 0x6e, 0x30, 0x82, 0x01,
	0x22, 0x30, 0x0d, 0x06, 0x09, 0x2a, 0x86, 0x48,
	0x86, 0xf7, 0x0d, 0x01, 0x01, 0x01, 0x05, 0x00,
	0x03, 0x82, 0x01, 0x0f, 0x00, 0x30, 0x82, 0x01,
	0x0a, 0x02, 0x82, 0x01, 0x01, 0x00, 0xa6, 0xcf,
	0x24, 0x0e, 0xbe, 0x2e, 0x6f, 0x28, 0x99, 0x45,
	0x42, 0xc4, 0xab, 0x3e, 0x21, 0x54, 0x9b, 0x0b,
	0xd3, 0x7f, 0x84, 0x70, 0xfa, 0x12, 0xb3, 0xcb,
	0xbf, 0x87, 0x5f, 0xc6, 0x7f, 0x86, 0xd3, 0xb2,
	0x30, 0x5c, 0xd6, 0xfd, 0xad, 0xf1, 0x7b, 0xdc,
	0xe5, 0xf8, 0x60, 0x96, 0x09, 0x92, 0x10, 0xf5,
	0xd0, 0x53, 0xde, 0xfb, 0x7b, 0x7e, 0x73, 0x88,
	0xac, 0x52, 0x88, 0x7b, 0x4a, 0xa6, 0xca, 0x49,
	0xa6, 0x5e, 0xa8, 0xa7, 0x8c, 0x5a, 0x11, 0xbc,
	0x7a, 0x82, 0xeb, 0xbe, 0x8c, 0xe9, 0xb3, 0xac,
	0x96, 0x25, 0x07, 0x97, 0x4a, 0x99, 0x2a, 0x07,
	0x2f, 0xb4, 0x1e, 0x77, 0xbf, 0x8a, 0x0f, 0xb5,
	0x02, 0x7c, 0x1b, 0x96, 0xb8, 0xc5, 0xb9, 0x3a,
	0x2c, 0xbc, 0xd6, 0x12, 0xb9, 0xeb, 0x59, 0x7d,
	0xe2, 0xd0, 0x06, 0x86, 0x5f, 0x5e, 0x49, 0x6a,
	0xb5, 0x39, 0x5e, 0x88, 0x34, 0xec, 0xbc, 0x78,
	0x0c, 0x08, 0x98, 0x84, 0x6c, 0xa8, 0xcd, 0x4b,
	0xb4, 0xa0, 0x7d, 0x0c, 0x79, 0x4d, 0xf0, 0xb8,
	0x2d, 0xcb, 0x21, 0xca, 0xd5, 0x6c, 0x5b, 0x7d,
	0xe1, 0xa0, 0x29, 0x84, 0xa1, 0xf9, 0xd3, 0x94,
	0x49, 0xcb, 0x24, 0x62, 0x91, 0x20, 0xbc, 0xdd,
	0x0b, 0xd5, 0xd9, 0xcc, 0xf9, 0xea, 0x27, 0x0a,
	0x2b, 0x73, 0x91, 0xc6, 0x9d, 0x1b, 0xac, 0xc8,
	0xcb, 0xe8, 0xe0, 0xa0, 0xf4, 0x2f, 0x90, 0x8b,
	0x4d, 0xfb, 0xb0, 0x36, 0x1b, 0xf6, 0x19, 0x7a,
	0x85, 0xe0, 0x6d, 0xf2, 0x61, 0x13, 0x88, 0x5c,
	0x9f, 0xe0, 0x93, 0x0a, 0x51, 0x97, 0x8a, 0x5a,
	0xce, 0xaf, 0xab, 0xd5, 0xf7, 0xaa, 0x09, 0xaa,
	0x60, 0xbd, 0xdc, 0xd9, 0x5f, 0xdf, 0x72, 0xa9,
	0x60, 0x13, 0x5e, 0x00, 0x01, 0xc9, 0x4a, 0xfa,
	0x3f, 0xa4, 0xea, 0x07, 0x03, 0x21, 0x02, 0x8e,
	0x82, 0xca, 0x03, 0xc2, 0x9b, 0x8f, 0x02, 0x03,
	0x01, 0x00, 0x01, 0xa3, 0x81, 0x9c, 0x30, 0x81,
	0x99, 0x30, 0x0e, 0x06, 0x03, 0x55, 0x1d, 0x0f,
	0x01, 0x01, 0xff, 0x04, 0x04, 0x03, 0x02, 0x01,
	0x06, 0x30, 0x0f, 0x06, 0x03, 0x55, 0x1d, 0x13,
	0x01, 0x01, 0xff, 0x04, 0x05, 0x30, 0x03, 0x01,
	0x01, 0xff, 0x30, 0x1d, 0x06, 0x03, 0x55, 0x1d,
	0x0e, 0x04, 0x16, 0x04, 0x14, 0x9b, 0xe2, 0x07,
	0x57, 0x67, 0x1c, 0x1e, 0xc0, 0x6a, 0x06, 0xde,
	0x59, 0xb4, 0x9a, 0x2d, 0xdf, 0xdc, 0x19, 0x86,
	0x2e, 0x30, 0x36, 0x06, 0x03, 0x55, 0x1d, 0x1f,
	0x04, 0x2f, 0x30, 0x2d, 0x30, 0x2b, 0xa0, 0x29,
	0xa0, 0x27, 0x86, 0x25, 0x68, 0x74, 0x74, 0x70,
	0x3a, 0x2f, 0x2f, 0x63, 0x72, 0x6c, 0x2e, 0x67,
	0x6c, 0x6f, 0x62, 0x61, 0x6c, 0x73, 0x69, 0x67,
	0x6e, 0x2e, 0x6e, 0x65, 0x74, 0x2f, 0x72, 0x6f,
	0x6f, 0x74, 0x2d, 0x72, 0x32, 0x2e, 0x63, 0x72,
	0x6c, 0x30, 0x1f, 0x06, 0x03, 0x55, 0x1d, 0x23,
	0x04, 0x18, 0x30, 0x16, 0x80, 0x14, 0x9b, 0xe2,
	0x07, 0x57, 0x67, 0x1c, 0x1e, 0xc0, 0x6a, 0x06,
	0xde, 0x59, 0xb4, 0x9a, 0x2d, 0xdf, 0xdc, 0x19,
	0x86, 0x2e, 0x30, 0x0d, 0x06, 0x09, 0x2a, 0x86,
	0x48, 0x86, 0xf7, 0x0d, 0x01, 0x01, 0x05, 0x05,
	0x00, 0x03, 0x82, 0x01, 0x01, 0x00, 0x99, 0x81,
	0x53, 0x87, 0x1c, 0x68, 0x97, 0x86, 0x91, 0xec,
	0xe0, 0x4a, 0xb8, 0x44, 0x0b, 0xab, 0x81, 0xac,
	0x27, 0x4f, 0xd6, 0xc1, 0xb8, 0x1c, 0x43, 0x78,
	0xb3, 0x0c, 0x9a, 0xfc, 0xea, 0x2c, 0x3c, 0x6e,
	0x61, 0x1b, 0x4d, 0x4b, 0x29, 0xf5, 0x9f, 0x05,
	0x1d, 0x26, 0xc1, 0xb8, 0xe9, 0x83, 0x00, 0x62,
	0x45, 0xb6, 0xa9, 0x08, 0x93, 0xb9, 0xa9, 0x33,
	0x4b, 0x18, 0x9a, 0xc2, 0xf8, 0x87, 0x88, 0x4e,
	0xdb, 0xdd, 0x71, 0x34, 0x1a, 0xc1, 0x54, 0xda,
	0x46, 0x3f, 0xe0, 0xd3, 0x2a, 0xab, 0x6d, 0x54,
	0x22, 0xf5, 0x3a, 0x62, 0xcd, 0x20, 0x6f, 0xba,
	0x29, 0x89, 0xd7, 0xdd, 0x91, 0xee, 0xd3, 0x5c,
	0xa2, 0x3e, 0xa1, 0x5b, 0x41, 0xf5, 0xdf, 0xe5,
	0x64, 0x43, 0x2d, 0xe9, 0xd5, 0x39, 0xab, 0xd2,
	0xa2, 0xdf, 0xb7, 0x8b, 0xd0, 0xc0, 0x80, 0x19,
	0x1c, 0x45, 0xc0, 0x2d, 0x8c, 0xe8, 0xf8, 0x2d,
	0xa4, 0x74, 0x56, 0x49, 0xc5, 0x05, 0xb5, 0x4f,
	0x15, 0xde, 0x6e, 0x44, 0x78, 0x39, 0x87, 0xa8,
	0x7e, 0xbb, 0xf3, 0x79, 0x18, 0x91, 0xbb, 0xf4,
	0x6f, 0x9d, 0xc1, 0xf0, 0x8c, 0x35, 0x8c, 0x5d,
	0x01, 0xfb, 0xc3, 0x6d, 0xb9, 0xef, 0x44, 0x6d,
	0x79, 0x46, 0x31, 0x7e, 0x0a, 0xfe, 0xa9, 0x82,
	0xc1, 0xff, 0xef, 0xab, 0x6e, 0x20, 0xc4, 0x50,
	0xc9, 0x5f, 0x9d, 0x4d, 0x9b, 0x17, 0x8c, 0x0c,
	0xe5, 0x01, 0xc9, 0xa0, 0x41, 0x6a, 0x73, 0x53,
	0xfa, 0xa5, 0x50, 0xb4, 0x6e, 0x25, 0x0f, 0xfb,
	0x4c, 0x18, 0xf4, 0xfd, 0x52, 0xd9, 0x8e, 0x69,
	0xb1, 0xe8, 0x11, 0x0f, 0xde, 0x88, 0xd8, 0xfb,
	0x1d, 0x49, 0xf7, 0xaa, 0xde, 0x95, 0xcf, 0x20,
	0x78, 0xc2, 0x60, 0x12, 0xdb, 0x25, 0x40, 0x8c,
	0x6a, 0xfc, 0x7e, 0x42, 0x38, 0x40, 0x64, 0x12,
	0xf7, 0x9e, 0x81, 0xe1, 0x93, 0x2e,
};

#endif /* MBEDTLS_X509_CRT_PARSE_C */

#if defined(MBEDTLS_KEY_EXCHANGE__SOME__PSK_ENABLED)
static const unsigned char client_psk[] = {
	0x00, 0x01, 0x02, 0x03, 0x04, 0x05, 0x06, 0x07,
	0x08, 0x09, 0x0a, 0x0b, 0x0c, 0x0d, 0x0e, 0x0f
};

static const char client_psk_id[] = "Client_identity";
#endif

#endif /* __TLS_DEFAULT_CREDENTIALS_H__ */
```

## src/wifi.c
```c
/*
 * Copyright (c) 2022 Nuvoton Technology Corporation
 *
 * SPDX-License-Identifier: Apache-2.0
 */

#include <stdio.h>
#include <stdlib.h>

#include <zephyr/net/net_if.h>
#include <zephyr/net/wifi_mgmt.h>

#include "wifi.h"

// NOTE: Though doc says we can register multiple event ID in single net_mgmt_init_event_callback(),
//		 actually it doesn't. Still one event ID for one net_mgmt_init_event_callback().
K_SEM_DEFINE(wifi_iface_up_sem, 0, 1);
K_SEM_DEFINE(wifi_connect_sem, 0, 1);
static struct net_mgmt_event_callback wifi_iface_up_cb;
static struct net_mgmt_event_callback wifi_connect_cb;
static bool wifi_connected;

static void wifi_mgmt_event_handler(struct net_mgmt_event_callback *cb,
							uint32_t mgmt_event,
							struct net_if *iface)
{
	if (iface != net_if_get_default()) {
		printf("Found Interface %d (%p) not being default\n", net_if_get_by_iface(iface), iface);
		return;
	}

	if (mgmt_event == NET_EVENT_IF_UP) {
		k_sem_give(&wifi_iface_up_sem);
	} else if (mgmt_event == NET_EVENT_WIFI_CONNECT_RESULT) {
		const struct wifi_status *status = (const struct wifi_status *) cb->info;

		if (status->status) {
			printf("Connection request failed (%d)\n", status->status);
			wifi_connected = false;
		} else {
			printf("WIFI Connected\n");
			wifi_connected = true;
		}

		k_sem_give(&wifi_connect_sem);
	}
}

void wifi_connect(const char *ssid, const char *psk, uint32_t conn_timeout_ms)
{
	struct net_if *iface = net_if_get_default();
	printf("WiFi connecting thru default Interface %d (%p)\n", net_if_get_by_iface(iface), iface);

	// Prepare for waiting on WiFi interface up
	k_sem_reset(&wifi_iface_up_sem);

	// Register event callback for WiFi interface up
	//
	// NOTE: Register event callback first, then check interface up, so that we can catch
	//		 both cases: interface has been up or not.
	net_mgmt_init_event_callback(&wifi_iface_up_cb,
								 wifi_mgmt_event_handler,
								 NET_EVENT_IF_UP);
	net_mgmt_add_event_callback(&wifi_iface_up_cb);

	if (iface && net_if_is_up(iface)) {
		k_sem_give(&wifi_iface_up_sem);
	}

	// Wait on WiFi interface up
	if (k_sem_take(&wifi_iface_up_sem, K_MSEC(conn_timeout_ms))) {
		printf("WiFi interface up timeout\n");
		net_mgmt_del_event_callback(&wifi_iface_up_cb);
		exit(EXIT_FAILURE);
	}

	// Prepare for waiting on WiFi connect
	k_sem_reset(&wifi_connect_sem);

	// Register event callback for WiFi connect
	net_mgmt_init_event_callback(&wifi_connect_cb,
								 wifi_mgmt_event_handler,
								 NET_EVENT_WIFI_CONNECT_RESULT);
	net_mgmt_add_event_callback(&wifi_connect_cb);

	int rc = 0;

	static struct wifi_connect_req_params cnx_params = {
		.channel = 0,
		.security = WIFI_SECURITY_TYPE_PSK,
	};
	cnx_params.ssid = ssid;
	cnx_params.ssid_length = strlen(ssid);
	cnx_params.psk = psk;
	cnx_params.psk_length = strlen(psk);

	rc = net_mgmt(NET_REQUEST_WIFI_CONNECT, iface, &cnx_params, sizeof(struct wifi_connect_req_params));
	if (rc) {
		printf("NET_REQUEST_WIFI_CONNECT failed (%d)\n", rc);
		exit(EXIT_FAILURE);
	}

	// Wait on WiFi connected
	if (k_sem_take(&wifi_connect_sem, K_MSEC(conn_timeout_ms))) {
		printf("WiFi connect timeout\n");
		net_mgmt_del_event_callback(&wifi_connect_cb);
		exit(EXIT_FAILURE);
	}

	if (!wifi_connected) {
		printf("WiFi connect failed\n");
		exit(EXIT_FAILURE);
	}
}
```

## src/wifi.h
```c
/*
 * Copyright (c) 2022 Nuvoton Technology Corporation
 *
 * SPDX-License-Identifier: Apache-2.0
 */

void wifi_connect(const char *ssid, const char *psk, uint32_t conn_timeout_ms);
```
