## CMakeLists.txt
```
# SPDX-License-Identifier: Apache-2.0

cmake_minimum_required(VERSION 3.28.0)
find_package(Zephyr REQUIRED HINTS $ENV{ZEPHYR_BASE})
project(big_http_download)

FILE(GLOB app_sources src/*.c)
target_sources(app PRIVATE ${app_sources})

include(${ZEPHYR_BASE}/samples/net/common/common.cmake)
```

## Kconfig
```
# Private config options for big_http_download sample

# Copyright (c) 2020 Linaro Limited
# SPDX-License-Identifier: Apache-2.0

mainmenu "big_http_download sample application"

config SAMPLE_BIG_HTTP_DL_URL
	string "Download URL"
	default "http://archive.ubuntu.com/ubuntu/dists/xenial/main/installer-amd64/current/images/hd-media/vmlinuz"
	help
	  URL to download.

config SAMPLE_BIG_HTTP_DL_MAX_URL_LENGTH
	int "Maximum length of the download URL"
	default 256

config SAMPLE_BIG_HTTP_DL_NUM_ITER
	int "Limit number of iterations"
	default 0
	help
	  Number of download iterations (0 - unlimited).

source "Kconfig.zephyr"
```

## sample.yaml
```
sample:
  description: BSD Sockets big HTTP download example
  name: big_http_download
common:
  filter: CONFIG_FULL_LIBC_SUPPORTED and not CONFIG_NATIVE_LIBC
  harness: net
  depends_on: netif
  min_ram: 32
  min_flash: 128
  tags:
    - net
    - socket
tests:
  sample.net.sockets.big_http_download: {}
  sample.net.sockets.big_http_download.ci:
    extra_args: EXTRA_CONF_FILE=overlay-ci.conf
```

## prj.conf
```kconfig
# General config
CONFIG_REQUIRES_FULL_LIBC=y
CONFIG_PSA_CRYPTO=y
CONFIG_MBEDTLS_ENABLE_HEAP=y
CONFIG_PSA_WANT_ALG_SHA_256=y
CONFIG_MAIN_STACK_SIZE=2536

# Networking config
CONFIG_NETWORKING=y
CONFIG_NET_IPV4=y
CONFIG_NET_IPV6=y
CONFIG_NET_TCP=y
CONFIG_NET_SOCKETS=y
CONFIG_POSIX_AEP_CHOICE_NETAPP=y
CONFIG_NET_CONTEXT_RCVTIMEO=y
CONFIG_NET_CONTEXT_SNDTIMEO=y

CONFIG_NET_TCP_MAX_RECV_WINDOW_SIZE=5120

CONFIG_NET_PKT_TX_COUNT=6
CONFIG_NET_BUF_RX_COUNT=64

CONFIG_DNS_RESOLVER=y
CONFIG_DNS_SERVER_IP_ADDRESSES=y
CONFIG_DNS_SERVER1="192.0.2.2"

# Network driver config
CONFIG_TEST_RANDOM_GENERATOR=y

# Network address config
CONFIG_NET_CONFIG_SETTINGS=y
CONFIG_NET_CONFIG_NEED_IPV4=y
CONFIG_NET_CONFIG_MY_IPV4_ADDR="192.0.2.1"
CONFIG_NET_CONFIG_PEER_IPV4_ADDR="192.0.2.2"
CONFIG_NET_CONFIG_MY_IPV4_GW="192.0.2.2"
# DHCP configuration. Until DHCP address is assigned,
# static configuration above is used instead.
CONFIG_NET_DHCPV4=y

# Network debug config
CONFIG_NET_LOG=y
```

## overlay-ci.conf
```kconfig
# CI-friendly config, using local host machine as
# a server and finite number of iterations.
CONFIG_SAMPLE_BIG_HTTP_DL_URL="http://192.0.2.2:8980/static/vmlinuz"
CONFIG_SAMPLE_BIG_HTTP_DL_NUM_ITER=1
```

## overlay-tls.conf
```kconfig
CONFIG_MAIN_STACK_SIZE=4096
CONFIG_NET_PKT_TX_COUNT=10

# TLS configuration
CONFIG_MBEDTLS=y
CONFIG_MBEDTLS_ENABLE_HEAP=y
CONFIG_MBEDTLS_HEAP_SIZE=65000
CONFIG_MBEDTLS_SSL_IN_CONTENT_LEN=16384
CONFIG_MBEDTLS_SSL_OUT_CONTENT_LEN=16384
CONFIG_MBEDTLS_PEM_PARSE_C=y
CONFIG_MBEDTLS_PEM_WRITE_C=y

CONFIG_NET_SOCKETS_SOCKOPT_TLS=y

CONFIG_SAMPLE_BIG_HTTP_DL_URL="https://launchpad.net/ubuntu/+archive/primary/+sourcefiles/git/1:2.34.1-1ubuntu1/git_2.34.1.orig.tar.xz"
```

## overlay-wifi.conf
```kconfig
# SPDX -License-Identifier: Apache-2.0

# Disable default configurations
CONFIG_NET_CONFIG_SETTINGS=n
CONFIG_NET_CONFIG_MY_IPV4_ADDR=""
CONFIG_NET_CONFIG_PEER_IPV4_ADDR=""
CONFIG_NET_CONFIG_MY_IPV4_GW=""

# Enable WIFI
CONFIG_WIFI=y
CONFIG_SAMPLE_BIG_HTTP_DL_WIFI_SSID="SSID"
CONFIG_SAMPLE_BIG_HTTP_DL_WIFI_PSK="PASSWORD"

# Add DNS Server
CONFIG_DNS_SERVER_IP_ADDRESSES=y
CONFIG_DNS_SERVER1="8.8.8.8"
```

## prj_tls.conf
```kconfig
# General config
CONFIG_NEWLIB_LIBC=y

# Networking config
CONFIG_NETWORKING=y
CONFIG_NET_IPV4=y
CONFIG_NET_IPV6=y
CONFIG_NET_TCP=y
CONFIG_NET_SOCKETS=y
CONFIG_NET_SOCKETS_POSIX_NAMES=y

CONFIG_NET_PKT_TX_COUNT=10

CONFIG_DNS_RESOLVER=y
CONFIG_DNS_SERVER_IP_ADDRESSES=y
CONFIG_DNS_SERVER1="192.0.2.2"

# Network driver config
CONFIG_TEST_RANDOM_GENERATOR=y

# Network address config
CONFIG_NET_CONFIG_SETTINGS=y
CONFIG_NET_CONFIG_NEED_IPV4=y
CONFIG_NET_CONFIG_MY_IPV4_ADDR="192.0.2.1"
CONFIG_NET_CONFIG_PEER_IPV4_ADDR="192.0.2.2"
CONFIG_NET_CONFIG_MY_IPV4_GW="192.0.2.2"
# DHCP configuration. Until DHCP address is assigned,
# static configuration above is used instead.
CONFIG_NET_DHCPV4=y

# Network debug config
CONFIG_NET_LOG=y
CONFIG_NET_LOG_GLOBAL=y
CONFIG_SYS_LOG_NET_LEVEL=2
#CONFIG_NET_DEBUG_SOCKETS=y
#CONFIG_NET_SHELL=y

# TLS configuration
CONFIG_MBEDTLS=y
CONFIG_MBEDTLS_BUILTIN=y
CONFIG_MBEDTLS_ENABLE_HEAP=y
CONFIG_MBEDTLS_HEAP_SIZE=60000
CONFIG_MBEDTLS_SSL_MAX_CONTENT_LEN=16384

CONFIG_MAIN_STACK_SIZE=4096
CONFIG_NET_SOCKETS_SOCKOPT_TLS=y
```

## src/big_http_download.c
```c
/*
 * Copyright (c) 2018 Linaro Limited
 *
 * SPDX-License-Identifier: Apache-2.0
 */

#include <stdbool.h>
#include <stdio.h>
#include <stdlib.h>
#include <string.h>
#include <ctype.h>
#include <errno.h>

#include <psa/crypto.h>

#include <netinet/in.h>
#include <sys/socket.h>
#include <arpa/inet.h>
#include <unistd.h>
#include <netdb.h>

#if defined(__ZEPHYR__)

#include <zephyr/kernel.h>

#if defined(CONFIG_NET_SOCKETS_SOCKOPT_TLS)
#include <zephyr/net/tls_credentials.h>
#include "ca_certificate.h"
#endif

#define sleep(x) k_sleep(K_MSEC((x) * MSEC_PER_SEC))

#endif

#define bytes2KiB(Bytes)	(Bytes / (1024u))
#define bytes2MiB(Bytes)	(Bytes / (1024u * 1024u))

#if defined(CONFIG_SAMPLE_BIG_HTTP_DL_MAX_URL_LENGTH)
#define MAX_URL_LENGTH CONFIG_SAMPLE_BIG_HTTP_DL_MAX_URL_LENGTH
#else
#define MAX_URL_LENGTH 256
#endif

#if defined(CONFIG_SAMPLE_BIG_HTTP_DL_NUM_ITER)
#define NUM_ITER CONFIG_SAMPLE_BIG_HTTP_DL_NUM_ITER
#else
#define NUM_ITER 0
#endif

/* This URL is parsed in-place, so buffer must be non-const. */
static char download_url[MAX_URL_LENGTH] =
#if defined(CONFIG_SAMPLE_BIG_HTTP_DL_URL)
    CONFIG_SAMPLE_BIG_HTTP_DL_URL;
#else
    "http://archive.ubuntu.com/ubuntu/dists/xenial/main/installer-amd64/current/images/hd-media/vmlinuz";
#endif /* defined(CONFIG_SAMPLE_BIG_HTTP_DL_URL) */
/* Quick testing. */
/*    "http://google.com/foo";*/

/* print("".join(["\\x%02x" % x for x in list(binascii.unhexlify("hash"))])) */
static uint8_t download_hash[32] =
#if !defined(CONFIG_NET_SOCKETS_SOCKOPT_TLS)
"\x33\x7c\x37\xd7\xec\x00\x34\x84\x14\x22\x4b\xaa\x6b\xdb\x2d\x43\xf2\xa3\x4e\xf5\x67\x6b\xaf\xcd\xca\xd9\x16\xf1\x48\xb5\xb3\x17";
#else
"\x3a\x07\x55\xdd\x1c\xfa\xb7\x1a\x24\xdd\x96\xdf\x34\x98\xc2\x9c"
"\xd0\xac\xd1\x3b\x04\xf3\xd0\x8b\xf9\x33\xe8\x12\x86\xdb\x80\x2c";
#endif /* !defined(CONFIG_NET_SOCKETS_SOCKOPT_TLS) */

#define SSTRLEN(s) (sizeof(s) - 1)
#define CHECK(r) { if (r == -1) { printf("Error: " #r "\n"); exit(1); } }

const char *host;
const char *port;
const char *uri_path = "";
static char response[1024];
static char response_hash[32];
unsigned int cur_bytes;

void dump_addrinfo(const struct addrinfo *ai)
{
	printf("addrinfo @%p: ai_family=%d, ai_socktype=%d, ai_protocol=%d, "
	       "sa_family=%d, sin_port=%x\n",
	       ai, ai->ai_family, ai->ai_socktype, ai->ai_protocol,
	       ai->ai_addr->sa_family,
	       ((struct sockaddr_in *)ai->ai_addr)->sin_port);
}

void fatal(const char *msg)
{
	printf("Error: %s\n", msg);
	exit(1);
}

ssize_t sendall(int sock, const void *buf, size_t len)
{
	while (len) {
		ssize_t out_len = send(sock, buf, len, 0);
		if (out_len < 0) {
			return out_len;
		}
		buf = (const char *)buf + out_len;
		len -= out_len;
	}

	return 0;
}

static int parse_status(bool *redirect)
{
	char *ptr;
	int code;

	ptr = strstr(response, "HTTP");
	if (ptr == NULL) {
		return -1;
	}

	ptr = strstr(response, " ");
	if (ptr == NULL) {
		return -1;
	}

	ptr++;

	code = atoi(ptr);
	if (code >= 300 && code < 400) {
		*redirect = true;
	}

	return 0;
}

static int parse_header(bool *location_found)
{
	char *ptr;

	ptr = strstr(response, ":");
	if (ptr == NULL) {
		return 0;
	}

	*ptr = '\0';
	ptr = response;

	while (*ptr != '\0') {
		*ptr = tolower(*ptr);
		ptr++;
	}

	if (strcmp(response, "location") != 0) {
		return 0;
	}

	/* Skip whitespace */
	while (*(++ptr) == ' ') {
		;
	}

	strncpy(download_url, ptr, sizeof(download_url));
	download_url[sizeof(download_url) - 1] = '\0';

	/* Trim LF. */
	ptr = strstr(download_url, "\n");
	if (ptr == NULL) {
		printf("Redirect URL too long or malformed\n");
		return -1;
	}

	*ptr = '\0';

	/* Trim CR if present. */
	ptr = strstr(download_url, "\r");
	if (ptr != NULL) {
		*ptr = '\0';
	}

	*location_found = true;

	return 0;
}

int skip_headers(int sock, bool *redirect)
{
	int state = 0;
	int i = 0;
	bool status_line = true;
	bool redirect_code = false;
	bool location_found = false;

	while (1) {
		int st;

		st = recv(sock, response + i, 1, 0);
		if (st <= 0) {
			return st;
		}

		if (state == 0 && response[i] == '\r') {
			state++;
		} else if ((state == 0 || state == 1) && response[i] == '\n') {
			state = 2;
			response[i + 1] = '\0';
			i = 0;

			if (status_line) {
				if (parse_status(&redirect_code) < 0) {
					return -1;
				}

				status_line = false;
			} else {
				if (parse_header(&location_found) < 0) {
					return -1;
				}
			}

			continue;
		} else if (state == 2 && response[i] == '\r') {
			state++;
		} else if ((state == 2 || state == 3) && response[i] == '\n') {
			break;
		} else {
			state = 0;
		}

		i++;
		if (i >= sizeof(response) - 1) {
			i = 0;
		}
	}

	if (redirect_code && location_found) {
		*redirect = true;
	}

	return 1;
}

void print_hex(const unsigned char *p, int len)
{
	while (len--) {
		printf("%02x", *p++);
	}
}

bool download(struct addrinfo *ai, bool is_tls, bool *redirect)
{
	int sock;
	struct timeval timeout = {
		.tv_sec = 5
	};
	psa_hash_operation_t hash_op = PSA_HASH_OPERATION_INIT;
	psa_status_t psa_status;
	size_t hash_len;

	cur_bytes = 0U;
	*redirect = false;

	if (is_tls) {
#if defined(CONFIG_NET_SOCKETS_SOCKOPT_TLS)
		sock = socket(ai->ai_family, ai->ai_socktype, IPPROTO_TLS_1_2);
# else
		printf("TLS not supported\n");
		return false;
#endif
	} else {
		sock = socket(ai->ai_family, ai->ai_socktype, ai->ai_protocol);
	}

	CHECK(sock);
	printf("sock = %d\n", sock);

#if defined(CONFIG_NET_SOCKETS_SOCKOPT_TLS)
	if (is_tls) {
		sec_tag_t sec_tag_opt[ARRAY_SIZE(ca_certificates)];

		for (int i = 0; i < ARRAY_SIZE(ca_certificates); i++) {
			sec_tag_opt[i] = CA_CERTIFICATE_TAG + i;
		};

		CHECK(setsockopt(sock, SOL_TLS, TLS_SEC_TAG_LIST,
				 sec_tag_opt, sizeof(sec_tag_opt)));

		CHECK(setsockopt(sock, SOL_TLS, TLS_HOSTNAME,
				 host, strlen(host) + 1));
	}
#endif

	CHECK(setsockopt(sock, SOL_SOCKET, SO_RCVTIMEO, &timeout,
			 sizeof(timeout)));
	CHECK(setsockopt(sock, SOL_SOCKET, SO_SNDTIMEO, &timeout,
			 sizeof(timeout)));

	CHECK(connect(sock, ai->ai_addr, ai->ai_addrlen));
	sendall(sock, "GET /", SSTRLEN("GET /"));
	sendall(sock, uri_path, strlen(uri_path));
	sendall(sock, " HTTP/1.0\r\n", SSTRLEN(" HTTP/1.0\r\n"));
	sendall(sock, "Host: ", SSTRLEN("Host: "));
	sendall(sock, host, strlen(host));
	sendall(sock, "\r\n\r\n", SSTRLEN("\r\n\r\n"));

	if (skip_headers(sock, redirect) <= 0) {
		printf("EOF or error in response headers\n");
		goto error;
	}

	if (*redirect) {
		printf("Server requested redirection to %s\n", download_url);
		goto error;
	}

	psa_status = psa_hash_setup(&hash_op, PSA_ALG_SHA_256);
	if (psa_status != PSA_SUCCESS) {
		printf("Failed to setup PSA hash operation %d\n", psa_status);
		goto error;
	}

	while (1) {
		int len = recv(sock, response, sizeof(response) - 1, 0);

		if (len < 0) {
			if (errno == EAGAIN || errno == EWOULDBLOCK) {
				printf("Timeout on reading response\n");
			} else {
				printf("Error reading response\n");
			}

			goto error;
		}

		if (len == 0) {
			break;
		}

		psa_status = psa_hash_update(&hash_op, response, len);
		if (psa_status != PSA_SUCCESS) {
			printf("Failed to update PSA operation %d\n", psa_status);
			goto error;
		}

		cur_bytes += len;
		printf("Download progress: %u Bytes; %u KiB; %u MiB\r",
			cur_bytes, bytes2KiB(cur_bytes), bytes2MiB(cur_bytes));

		response[len] = 0;
		/*printf("%s\n", response);*/
	}

	printf("\n");

	psa_status = psa_hash_finish(&hash_op, response_hash, sizeof(response_hash), &hash_len);
	if (psa_status != PSA_SUCCESS) {
		printf("Failed to terminate PSA operation %d\n", psa_status);
		goto error;
	}

	printf("Hash: ");
	print_hex(response_hash, hash_len);
	printf("\n");

	if (memcmp(response_hash, download_hash, hash_len) != 0) {
		printf("HASH MISMATCH!\n");
	}

error:
	psa_hash_abort(&hash_op);
	(void)close(sock);

	return redirect;
}

int main(void)
{
	static struct addrinfo hints;
	struct addrinfo *res;
	int st;
	char *p;
	unsigned int total_bytes = 0U;
	int resolve_attempts = 10;
	bool is_tls = false;
	unsigned int num_iterations = NUM_ITER;
	bool redirect = false;

#if defined(CONFIG_NET_SOCKETS_SOCKOPT_TLS)
	for (int i = 0; i < ARRAY_SIZE(ca_certificates); i++) {
		tls_credential_add(CA_CERTIFICATE_TAG + i,
				   TLS_CREDENTIAL_CA_CERTIFICATE,
				   ca_certificates[i],
				   strlen(ca_certificates[i]) + 1);
	}
#endif

	setbuf(stdout, NULL);

redirect:
	if (strncmp(download_url, "http://", SSTRLEN("http://")) == 0) {
		port = "80";
		p = download_url + SSTRLEN("http://");
#if defined(CONFIG_NET_SOCKETS_SOCKOPT_TLS)
	} else if (strncmp(download_url, "https://",
		   SSTRLEN("https://")) == 0) {
		is_tls = true;
		port = "443";
		p = download_url + SSTRLEN("https://");
#endif /* defined(CONFIG_NET_SOCKETS_SOCKOPT_TLS) */
	} else {
		fatal("Only http: "
#if defined(CONFIG_NET_SOCKETS_SOCKOPT_TLS)
		      "and https: "
#endif
		      "URLs are supported");
	}

	/* Parse host part */
	host = p;
	while (*p && *p != ':' && *p != '/') {
		p++;
	}

	/* Store optional port part */
	if (*p == ':') {
		*p++ = 0;
		port = p;
	}

	/* Parse path part */
	while (*p && *p != '/') {
		p++;
	}

	if (*p == '/') {
		*p++ = 0;
		uri_path = p;
	}

	printf("Preparing HTTP GET request for http%s://%s:%s/%s\n",
		       (is_tls ? "s" : ""), host, port, uri_path);

	memset(&hints, 0, sizeof(hints));
	hints.ai_family = AF_INET;
	hints.ai_socktype = SOCK_STREAM;

	while (resolve_attempts--) {
		st = getaddrinfo(host, port, &hints, &res);

		if (st == 0) {
			break;
		}

		printf("getaddrinfo status: %d, retrying\n", st);
		sleep(2);
	}

	if (st != 0) {
		fatal("Unable to resolve address");
	}

	dump_addrinfo(res);

	const uint32_t total_iterations = num_iterations;
	uint32_t current_iteration = 1;
	do {
		if (total_iterations == 0) {
			printf("\nIteration %u of INF\n", current_iteration);
		} else {
			printf("\nIteration %u of %u:\n",
				current_iteration, total_iterations);
		}

		download(res, is_tls, &redirect);
		if (redirect) {
			goto redirect;
		}

		total_bytes += cur_bytes;
		printf("Total downloaded so far: %u MiB\n",
			bytes2MiB(total_bytes));

		sleep(3);
		current_iteration++;
	} while (--num_iterations != 0);

	printf("Finished downloading.\n");

	freeaddrinfo(res);

	return 0;
}
```

## src/ca_certificate.h
```c
/*
 * Copyright (c) 2018 Nordic Semiconductor ASA
 *
 * SPDX-License-Identifier: Apache-2.0
 */

#ifndef __CA_CERTIFICATE_H__
#define __CA_CERTIFICATE_H__

#define CA_CERTIFICATE_TAG 1

/* By default only certificates in DER format are supported. If you want to use
 * certificate in PEM format, you can enable support for it in Kconfig.
 */

/* ISRG Root X1 for https://launchpad.net/ubuntu
 * DigiCert Global Root G2 for possible redirects
 */
static const unsigned char *ca_certificates[] = {
#include "isrgrootx1.pem"
,
#include "DigiCertGlobalRootG2.crt.pem"
};


#endif /* __CA_CERTIFICATE_H__ */
```

## src/tls_default_credentials.h
```c
/*
 * Copyright (c) 2018 Nordic Semiconductor ASA
 *
 * SPDX-License-Identifier: Apache-2.0
 */

#ifndef __TLS_DEFAULT_CREDENTIALS_H__
#define __TLS_DEFAULT_CREDENTIALS_H__

#define NET_TLS_DEFAULT_CA_CERTIFICATE_TAG 1
#define NET_TLS_DEFAULT_PSK_TAG 2

#if defined(MBEDTLS_X509_CRT_PARSE_C)

/* By default only certificates in DER format are supported. If you want to use
 * certificate in PEM format, you can enable support for it in Kconfig.
 */

/* Let’s Encrypt Authority X3 */
static const unsigned char ca_certificate[] = {
	0x30, 0x82, 0x04, 0x92, 0x30, 0x82, 0x03, 0x7a,
	0xa0, 0x03, 0x02, 0x01, 0x02, 0x02, 0x10, 0x0a,
	0x01, 0x41, 0x42, 0x00, 0x00, 0x01, 0x53, 0x85,
	0x73, 0x6a, 0x0b, 0x85, 0xec, 0xa7, 0x08, 0x30,
	0x0d, 0x06, 0x09, 0x2a, 0x86, 0x48, 0x86, 0xf7,
	0x0d, 0x01, 0x01, 0x0b, 0x05, 0x00, 0x30, 0x3f,
	0x31, 0x24, 0x30, 0x22, 0x06, 0x03, 0x55, 0x04,
	0x0a, 0x13, 0x1b, 0x44, 0x69, 0x67, 0x69, 0x74,
	0x61, 0x6c, 0x20, 0x53, 0x69, 0x67, 0x6e, 0x61,
	0x74, 0x75, 0x72, 0x65, 0x20, 0x54, 0x72, 0x75,
	0x73, 0x74, 0x20, 0x43, 0x6f, 0x2e, 0x31, 0x17,
	0x30, 0x15, 0x06, 0x03, 0x55, 0x04, 0x03, 0x13,
	0x0e, 0x44, 0x53, 0x54, 0x20, 0x52, 0x6f, 0x6f,
	0x74, 0x20, 0x43, 0x41, 0x20, 0x58, 0x33, 0x30,
	0x1e, 0x17, 0x0d, 0x31, 0x36, 0x30, 0x33, 0x31,
	0x37, 0x31, 0x36, 0x34, 0x30, 0x34, 0x36, 0x5a,
	0x17, 0x0d, 0x32, 0x31, 0x30, 0x33, 0x31, 0x37,
	0x31, 0x36, 0x34, 0x30, 0x34, 0x36, 0x5a, 0x30,
	0x4a, 0x31, 0x0b, 0x30, 0x09, 0x06, 0x03, 0x55,
	0x04, 0x06, 0x13, 0x02, 0x55, 0x53, 0x31, 0x16,
	0x30, 0x14, 0x06, 0x03, 0x55, 0x04, 0x0a, 0x13,
	0x0d, 0x4c, 0x65, 0x74, 0x27, 0x73, 0x20, 0x45,
	0x6e, 0x63, 0x72, 0x79, 0x70, 0x74, 0x31, 0x23,
	0x30, 0x21, 0x06, 0x03, 0x55, 0x04, 0x03, 0x13,
	0x1a, 0x4c, 0x65, 0x74, 0x27, 0x73, 0x20, 0x45,
	0x6e, 0x63, 0x72, 0x79, 0x70, 0x74, 0x20, 0x41,
	0x75, 0x74, 0x68, 0x6f, 0x72, 0x69, 0x74, 0x79,
	0x20, 0x58, 0x33, 0x30, 0x82, 0x01, 0x22, 0x30,
	0x0d, 0x06, 0x09, 0x2a, 0x86, 0x48, 0x86, 0xf7,
	0x0d, 0x01, 0x01, 0x01, 0x05, 0x00, 0x03, 0x82,
	0x01, 0x0f, 0x00, 0x30, 0x82, 0x01, 0x0a, 0x02,
	0x82, 0x01, 0x01, 0x00, 0x9c, 0xd3, 0x0c, 0xf0,
	0x5a, 0xe5, 0x2e, 0x47, 0xb7, 0x72, 0x5d, 0x37,
	0x83, 0xb3, 0x68, 0x63, 0x30, 0xea, 0xd7, 0x35,
	0x26, 0x19, 0x25, 0xe1, 0xbd, 0xbe, 0x35, 0xf1,
	0x70, 0x92, 0x2f, 0xb7, 0xb8, 0x4b, 0x41, 0x05,
	0xab, 0xa9, 0x9e, 0x35, 0x08, 0x58, 0xec, 0xb1,
	0x2a, 0xc4, 0x68, 0x87, 0x0b, 0xa3, 0xe3, 0x75,
	0xe4, 0xe6, 0xf3, 0xa7, 0x62, 0x71, 0xba, 0x79,
	0x81, 0x60, 0x1f, 0xd7, 0x91, 0x9a, 0x9f, 0xf3,
	0xd0, 0x78, 0x67, 0x71, 0xc8, 0x69, 0x0e, 0x95,
	0x91, 0xcf, 0xfe, 0xe6, 0x99, 0xe9, 0x60, 0x3c,
	0x48, 0xcc, 0x7e, 0xca, 0x4d, 0x77, 0x12, 0x24,
	0x9d, 0x47, 0x1b, 0x5a, 0xeb, 0xb9, 0xec, 0x1e,
	0x37, 0x00, 0x1c, 0x9c, 0xac, 0x7b, 0xa7, 0x05,
	0xea, 0xce, 0x4a, 0xeb, 0xbd, 0x41, 0xe5, 0x36,
	0x98, 0xb9, 0xcb, 0xfd, 0x6d, 0x3c, 0x96, 0x68,
	0xdf, 0x23, 0x2a, 0x42, 0x90, 0x0c, 0x86, 0x74,
	0x67, 0xc8, 0x7f, 0xa5, 0x9a, 0xb8, 0x52, 0x61,
	0x14, 0x13, 0x3f, 0x65, 0xe9, 0x82, 0x87, 0xcb,
	0xdb, 0xfa, 0x0e, 0x56, 0xf6, 0x86, 0x89, 0xf3,
	0x85, 0x3f, 0x97, 0x86, 0xaf, 0xb0, 0xdc, 0x1a,
	0xef, 0x6b, 0x0d, 0x95, 0x16, 0x7d, 0xc4, 0x2b,
	0xa0, 0x65, 0xb2, 0x99, 0x04, 0x36, 0x75, 0x80,
	0x6b, 0xac, 0x4a, 0xf3, 0x1b, 0x90, 0x49, 0x78,
	0x2f, 0xa2, 0x96, 0x4f, 0x2a, 0x20, 0x25, 0x29,
	0x04, 0xc6, 0x74, 0xc0, 0xd0, 0x31, 0xcd, 0x8f,
	0x31, 0x38, 0x95, 0x16, 0xba, 0xa8, 0x33, 0xb8,
	0x43, 0xf1, 0xb1, 0x1f, 0xc3, 0x30, 0x7f, 0xa2,
	0x79, 0x31, 0x13, 0x3d, 0x2d, 0x36, 0xf8, 0xe3,
	0xfc, 0xf2, 0x33, 0x6a, 0xb9, 0x39, 0x31, 0xc5,
	0xaf, 0xc4, 0x8d, 0x0d, 0x1d, 0x64, 0x16, 0x33,
	0xaa, 0xfa, 0x84, 0x29, 0xb6, 0xd4, 0x0b, 0xc0,
	0xd8, 0x7d, 0xc3, 0x93, 0x02, 0x03, 0x01, 0x00,
	0x01, 0xa3, 0x82, 0x01, 0x7d, 0x30, 0x82, 0x01,
	0x79, 0x30, 0x12, 0x06, 0x03, 0x55, 0x1d, 0x13,
	0x01, 0x01, 0xff, 0x04, 0x08, 0x30, 0x06, 0x01,
	0x01, 0xff, 0x02, 0x01, 0x00, 0x30, 0x0e, 0x06,
	0x03, 0x55, 0x1d, 0x0f, 0x01, 0x01, 0xff, 0x04,
	0x04, 0x03, 0x02, 0x01, 0x86, 0x30, 0x7f, 0x06,
	0x08, 0x2b, 0x06, 0x01, 0x05, 0x05, 0x07, 0x01,
	0x01, 0x04, 0x73, 0x30, 0x71, 0x30, 0x32, 0x06,
	0x08, 0x2b, 0x06, 0x01, 0x05, 0x05, 0x07, 0x30,
	0x01, 0x86, 0x26, 0x68, 0x74, 0x74, 0x70, 0x3a,
	0x2f, 0x2f, 0x69, 0x73, 0x72, 0x67, 0x2e, 0x74,
	0x72, 0x75, 0x73, 0x74, 0x69, 0x64, 0x2e, 0x6f,
	0x63, 0x73, 0x70, 0x2e, 0x69, 0x64, 0x65, 0x6e,
	0x74, 0x72, 0x75, 0x73, 0x74, 0x2e, 0x63, 0x6f,
	0x6d, 0x30, 0x3b, 0x06, 0x08, 0x2b, 0x06, 0x01,
	0x05, 0x05, 0x07, 0x30, 0x02, 0x86, 0x2f, 0x68,
	0x74, 0x74, 0x70, 0x3a, 0x2f, 0x2f, 0x61, 0x70,
	0x70, 0x73, 0x2e, 0x69, 0x64, 0x65, 0x6e, 0x74,
	0x72, 0x75, 0x73, 0x74, 0x2e, 0x63, 0x6f, 0x6d,
	0x2f, 0x72, 0x6f, 0x6f, 0x74, 0x73, 0x2f, 0x64,
	0x73, 0x74, 0x72, 0x6f, 0x6f, 0x74, 0x63, 0x61,
	0x78, 0x33, 0x2e, 0x70, 0x37, 0x63, 0x30, 0x1f,
	0x06, 0x03, 0x55, 0x1d, 0x23, 0x04, 0x18, 0x30,
	0x16, 0x80, 0x14, 0xc4, 0xa7, 0xb1, 0xa4, 0x7b,
	0x2c, 0x71, 0xfa, 0xdb, 0xe1, 0x4b, 0x90, 0x75,
	0xff, 0xc4, 0x15, 0x60, 0x85, 0x89, 0x10, 0x30,
	0x54, 0x06, 0x03, 0x55, 0x1d, 0x20, 0x04, 0x4d,
	0x30, 0x4b, 0x30, 0x08, 0x06, 0x06, 0x67, 0x81,
	0x0c, 0x01, 0x02, 0x01, 0x30, 0x3f, 0x06, 0x0b,
	0x2b, 0x06, 0x01, 0x04, 0x01, 0x82, 0xdf, 0x13,
	0x01, 0x01, 0x01, 0x30, 0x30, 0x30, 0x2e, 0x06,
	0x08, 0x2b, 0x06, 0x01, 0x05, 0x05, 0x07, 0x02,
	0x01, 0x16, 0x22, 0x68, 0x74, 0x74, 0x70, 0x3a,
	0x2f, 0x2f, 0x63, 0x70, 0x73, 0x2e, 0x72, 0x6f,
	0x6f, 0x74, 0x2d, 0x78, 0x31, 0x2e, 0x6c, 0x65,
	0x74, 0x73, 0x65, 0x6e, 0x63, 0x72, 0x79, 0x70,
	0x74, 0x2e, 0x6f, 0x72, 0x67, 0x30, 0x3c, 0x06,
	0x03, 0x55, 0x1d, 0x1f, 0x04, 0x35, 0x30, 0x33,
	0x30, 0x31, 0xa0, 0x2f, 0xa0, 0x2d, 0x86, 0x2b,
	0x68, 0x74, 0x74, 0x70, 0x3a, 0x2f, 0x2f, 0x63,
	0x72, 0x6c, 0x2e, 0x69, 0x64, 0x65, 0x6e, 0x74,
	0x72, 0x75, 0x73, 0x74, 0x2e, 0x63, 0x6f, 0x6d,
	0x2f, 0x44, 0x53, 0x54, 0x52, 0x4f, 0x4f, 0x54,
	0x43, 0x41, 0x58, 0x33, 0x43, 0x52, 0x4c, 0x2e,
	0x63, 0x72, 0x6c, 0x30, 0x1d, 0x06, 0x03, 0x55,
	0x1d, 0x0e, 0x04, 0x16, 0x04, 0x14, 0xa8, 0x4a,
	0x6a, 0x63, 0x04, 0x7d, 0xdd, 0xba, 0xe6, 0xd1,
	0x39, 0xb7, 0xa6, 0x45, 0x65, 0xef, 0xf3, 0xa8,
	0xec, 0xa1, 0x30, 0x0d, 0x06, 0x09, 0x2a, 0x86,
	0x48, 0x86, 0xf7, 0x0d, 0x01, 0x01, 0x0b, 0x05,
	0x00, 0x03, 0x82, 0x01, 0x01, 0x00, 0xdd, 0x33,
	0xd7, 0x11, 0xf3, 0x63, 0x58, 0x38, 0xdd, 0x18,
	0x15, 0xfb, 0x09, 0x55, 0xbe, 0x76, 0x56, 0xb9,
	0x70, 0x48, 0xa5, 0x69, 0x47, 0x27, 0x7b, 0xc2,
	0x24, 0x08, 0x92, 0xf1, 0x5a, 0x1f, 0x4a, 0x12,
	0x29, 0x37, 0x24, 0x74, 0x51, 0x1c, 0x62, 0x68,
	0xb8, 0xcd, 0x95, 0x70, 0x67, 0xe5, 0xf7, 0xa4,
	0xbc, 0x4e, 0x28, 0x51, 0xcd, 0x9b, 0xe8, 0xae,
	0x87, 0x9d, 0xea, 0xd8, 0xba, 0x5a, 0xa1, 0x01,
	0x9a, 0xdc, 0xf0, 0xdd, 0x6a, 0x1d, 0x6a, 0xd8,
	0x3e, 0x57, 0x23, 0x9e, 0xa6, 0x1e, 0x04, 0x62,
	0x9a, 0xff, 0xd7, 0x05, 0xca, 0xb7, 0x1f, 0x3f,
	0xc0, 0x0a, 0x48, 0xbc, 0x94, 0xb0, 0xb6, 0x65,
	0x62, 0xe0, 0xc1, 0x54, 0xe5, 0xa3, 0x2a, 0xad,
	0x20, 0xc4, 0xe9, 0xe6, 0xbb, 0xdc, 0xc8, 0xf6,
	0xb5, 0xc3, 0x32, 0xa3, 0x98, 0xcc, 0x77, 0xa8,
	0xe6, 0x79, 0x65, 0x07, 0x2b, 0xcb, 0x28, 0xfe,
	0x3a, 0x16, 0x52, 0x81, 0xce, 0x52, 0x0c, 0x2e,
	0x5f, 0x83, 0xe8, 0xd5, 0x06, 0x33, 0xfb, 0x77,
	0x6c, 0xce, 0x40, 0xea, 0x32, 0x9e, 0x1f, 0x92,
	0x5c, 0x41, 0xc1, 0x74, 0x6c, 0x5b, 0x5d, 0x0a,
	0x5f, 0x33, 0xcc, 0x4d, 0x9f, 0xac, 0x38, 0xf0,
	0x2f, 0x7b, 0x2c, 0x62, 0x9d, 0xd9, 0xa3, 0x91,
	0x6f, 0x25, 0x1b, 0x2f, 0x90, 0xb1, 0x19, 0x46,
	0x3d, 0xf6, 0x7e, 0x1b, 0xa6, 0x7a, 0x87, 0xb9,
	0xa3, 0x7a, 0x6d, 0x18, 0xfa, 0x25, 0xa5, 0x91,
	0x87, 0x15, 0xe0, 0xf2, 0x16, 0x2f, 0x58, 0xb0,
	0x06, 0x2f, 0x2c, 0x68, 0x26, 0xc6, 0x4b, 0x98,
	0xcd, 0xda, 0x9f, 0x0c, 0xf9, 0x7f, 0x90, 0xed,
	0x43, 0x4a, 0x12, 0x44, 0x4e, 0x6f, 0x73, 0x7a,
	0x28, 0xea, 0xa4, 0xaa, 0x6e, 0x7b, 0x4c, 0x7d,
	0x87, 0xdd, 0xe0, 0xc9, 0x02, 0x44, 0xa7, 0x87,
	0xaf, 0xc3, 0x34, 0x5b, 0xb4, 0x42,
};

#endif /* MBEDTLS_X509_CRT_PARSE_C */

#if defined(MBEDTLS_KEY_EXCHANGE__SOME__PSK_ENABLED)
static const unsigned char client_psk[] = {
	0x00, 0x01, 0x02, 0x03, 0x04, 0x05, 0x06, 0x07,
	0x08, 0x09, 0x0a, 0x0b, 0x0c, 0x0d, 0x0e, 0x0f
};

static const char client_psk_id[] = "Client_identity";
#endif

#endif /* TLS_DEFAULT_CA_CERTIFICATE_TAG */
```
