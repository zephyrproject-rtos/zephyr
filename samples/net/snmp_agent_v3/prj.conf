## CMakeLists.txt
```
# Copyright (c) 2026 StructCore Embedded
#
# SPDX-License-Identifier: Apache-2.0

cmake_minimum_required(VERSION 3.20.0)
find_package(Zephyr REQUIRED HINTS $ENV{ZEPHYR_BASE})
project(snmp_agent_v3_sample)

target_sources(app PRIVATE
    src/main.c
    src/app_led.c
    src/app_sensor.c
    src/app_button.c
    src/app_mib.c
)
```

## prj.conf
```kconfig
# =============================================================================
# SNMPv3 validation sample configuration
#
# Every credential below is a **public test value** that ships in this repository.
# They exist so that a developer can reproduce an authenticated, encrypted SNMPv3
# exchange without generating keys first. Never copy them into a product image.
# =============================================================================

# Networking configuration
CONFIG_NETWORKING=y
CONFIG_NET_UDP=y
CONFIG_NET_SOCKETS=y
CONFIG_NET_SOCKETS_SERVICE=y
CONFIG_NET_IPV4=y
CONFIG_NET_CONFIG_SETTINGS=y
CONFIG_NET_CONFIG_NEED_IPV4=y
CONFIG_NET_CONFIG_MY_IPV4_ADDR="192.168.68.102"
CONFIG_NET_CONFIG_MY_IPV4_NETMASK="255.255.255.0"
CONFIG_NET_CONFIG_INIT_TIMEOUT=0

# DHCPv4 client (dynamic IP with the static address above as fallback)
CONFIG_NET_DHCPV4=y
CONFIG_NET_IF_UNICAST_IPV4_ADDR_COUNT=2

# Network management & logging
CONFIG_NET_MGMT=y
CONFIG_NET_MGMT_EVENT=y
CONFIG_NET_MGMT_EVENT_STACK_SIZE=4096

# Hardware peripherals (LED & user button)
CONFIG_GPIO=y

# SNMP subsystem configuration
CONFIG_SNMP=y
CONFIG_SNMP_AGENT_PORT=161
CONFIG_SNMP_COMMUNITY_READ="public"
CONFIG_SNMP_COMMUNITY_WRITE="private"

# v3 is the point of this sample; v2c stays enabled so the same build can be used
# to compare v2c and v3 behaviour against one agent instance.
CONFIG_SNMP_VERSION_3=y
CONFIG_SNMP_VERSION_2C=y
CONFIG_SNMP_RATE_LIMIT=n

# --- Test-only USM identity -------------------------------------------------
# authPriv user: HMAC-SHA-256 authentication + AES-128-CFB privacy.
# This user maps to VACM group "admin" (fullView) in src/snmp_vacm.c.
CONFIG_SNMP_V3_USER_NAME="v3test"
CONFIG_SNMP_V3_AUTH_PASS="v3-auth-passphrase-test-only"
CONFIG_SNMP_V3_PRIV_PASS="v3-priv-passphrase-test-only"
# 0=none 1=SHA-1 2=MD5 3=SHA-256
CONFIG_SNMP_V3_AUTH_PROTOCOL_SHA256=y
# 0=none 1=AES-128-CFB
CONFIG_SNMP_V3_PRIV_PROTOCOL=1
CONFIG_SNMP_V3_ENGINE_BOOTS=1
CONFIG_SNMP_V3_MAX_USERS=4

# --- Notifications ----------------------------------------------------------
CONFIG_SNMP_TRAP_ENABLED=y
CONFIG_SNMP_TRAP_PORT=162
CONFIG_SNMP_TRAP_FORMAT_V3=y
CONFIG_SNMP_TRAP_V3_USER="v3test"

# Sample application options
CONFIG_SNMP_SAMPLE_ENTERPRISE_ID=54321
CONFIG_SNMP_SAMPLE_SENSOR_OBJECT=y
CONFIG_SNMP_SAMPLE_LED_OBJECT=y
CONFIG_SNMP_SAMPLE_BUTTON_TRAP=y
CONFIG_SNMP_SAMPLE_TRAP_DEST="192.168.68.103"
CONFIG_SNMP_SAMPLE_V3_MONITOR_USER="v3monitor"
CONFIG_SNMP_SAMPLE_V3_MONITOR_AUTH_PASS="v3-monitor-auth-passphrase-test-only"

# --- Stack sizing -----------------------------------------------------------
# The v3 receive path runs inside the socket-service thread and holds one decoded
# struct snmp_v3_msg (plus the AES plaintext/ciphertext buffers) on its stack, so
# 4 KiB is not enough. Kconfig asks for >= 12 KiB whenever v3 or GetBulk is on.
# The shell and workqueue threads also need >= 16 KiB to send v3 traps safely.
CONFIG_NET_SOCKETS_SERVICE_STACK_SIZE=16384
CONFIG_MAIN_STACK_SIZE=8192
CONFIG_SYSTEM_WORKQUEUE_STACK_SIZE=16384
CONFIG_SHELL_STACK_SIZE=16384

CONFIG_LOG=y
CONFIG_LOG_MODE_IMMEDIATE=y
CONFIG_SNMP_LOG_LEVEL_INF=y

# Interactive shell over UART
CONFIG_SHELL=y
CONFIG_SHELL_BACKENDS=y
CONFIG_SHELL_BACKEND_SERIAL=y
CONFIG_NET_SHELL=y
```

## src/main.c
```c
/*
 * Copyright (c) 2026 Zephyr SNMP Contributors
 *
 * SPDX-License-Identifier: Apache-2.0
 */

#include <zephyr/kernel.h>
#include <zephyr/logging/log.h>
#include <zephyr/net/net_if.h>
#include <zephyr/net/net_mgmt.h>
#include <zephyr/net/net_event.h>
#include <zephyr/net/net_ip.h>
#include <errno.h>
#include <stdio.h>
#include <string.h>
#include <zephyr/net/snmp/snmp.h>
#include <zephyr/net/snmp/snmp_mib.h>
#include <zephyr/net/snmp/snmp_trap.h>
#include <zephyr/net/snmp/snmp_usm.h>
#include <zephyr/net/snmp/snmp_vacm.h>
#include "app_led.h"
#include "app_sensor.h"
#include "app_button.h"
#include "app_mib.h"

LOG_MODULE_REGISTER(main, LOG_LEVEL_INF);

#ifndef CONFIG_SNMP_SAMPLE_ENTERPRISE_ID
#define CONFIG_SNMP_SAMPLE_ENTERPRISE_ID 54321
#endif

#ifndef CONFIG_SNMP_SAMPLE_TRAP_DEST
#define CONFIG_SNMP_SAMPLE_TRAP_DEST "192.168.16.100"
#endif

#ifndef CONFIG_SNMP_SAMPLE_V3_MONITOR_USER
#define CONFIG_SNMP_SAMPLE_V3_MONITOR_USER "v3monitor"
#endif

#ifndef CONFIG_SNMP_SAMPLE_V3_MONITOR_AUTH_PASS
#define CONFIG_SNMP_SAMPLE_V3_MONITOR_AUTH_PASS "v3-monitor-auth-passphrase-test-only"
#endif

#ifndef CONFIG_SNMP_AGENT_PORT
#define CONFIG_SNMP_AGENT_PORT 161
#endif

#ifndef CONFIG_SNMP_COMMUNITY_READ
#define CONFIG_SNMP_COMMUNITY_READ "public"
#endif

#ifndef CONFIG_SNMP_COMMUNITY_WRITE
#define CONFIG_SNMP_COMMUNITY_WRITE "private"
#endif

static struct net_mgmt_event_callback s_mgmt_cb;
static K_SEM_DEFINE(s_ip_ready_sem, 0, 1);
static struct net_if *s_snmp_iface;

/*
 * Caller-owned agent storage (decision #1 of the design contract): one instance is
 * always present; the optional second one demonstrates true multi-instance operation
 * on another UDP port with its own identity and its own MIB tree.
 */
static struct snmp_agent g_agent_lan;
#if defined(CONFIG_SNMP_SAMPLE_SECOND_INSTANCE)
static struct snmp_agent g_agent_wan;
#endif

static void print_banner(const char *ip_str)
{
	LOG_INF("================================================================");
	LOG_INF("       SNMPv3 VALIDATION SAMPLE ON ZEPHYR RTOS (NUCLEO-H743ZI)   ");
	LOG_INF("================================================================");
	LOG_INF("Protocol Support:");
	LOG_INF("  - SNMPv1  : %s", IS_ENABLED(CONFIG_SNMP_VERSION_1) ? "ENABLED" : "DISABLED");
	LOG_INF("  - SNMPv2c : %s", IS_ENABLED(CONFIG_SNMP_VERSION_2C) ? "ENABLED" : "DISABLED");
	LOG_INF("  - SNMPv3  : %s", IS_ENABLED(CONFIG_SNMP_VERSION_3) ? "ENABLED" : "DISABLED");
	LOG_INF("Security & Network:");
	LOG_INF("  - Agent IP / Port : %s : %d", ip_str, CONFIG_SNMP_AGENT_PORT);
	LOG_INF("  - Read Community  : \"%s\" (v1/v2c)", CONFIG_SNMP_COMMUNITY_READ);
	LOG_INF("  - Write Community : \"%s\" (v1/v2c)", CONFIG_SNMP_COMMUNITY_WRITE);
#if defined(CONFIG_SNMP_VERSION_3)
	LOG_INF("  - v3 authPriv user: \"%s\" (SHA-256 / AES-128-CFB)", CONFIG_SNMP_V3_USER_NAME);
	LOG_INF("  - v3 authNoPriv   : \"%s\" (SHA-1, read-only VACM group)",
		CONFIG_SNMP_SAMPLE_V3_MONITOR_USER);
	LOG_INF("  - engineBoots     : %u (persisted when CONFIG_SETTINGS is on)",
		(unsigned int)CONFIG_SNMP_V3_ENGINE_BOOTS);
	LOG_INF("  -- All credentials above are public test values. Never ship them. --");
#endif
#if defined(CONFIG_SNMP_SAMPLE_SECOND_INSTANCE)
	LOG_INF("  - Second instance: %s : %d (sysName \"%s\")", ip_str,
		CONFIG_SNMP_SAMPLE_WAN_PORT, "NUCLEO-H743ZI-WAN");
#endif
#if defined(CONFIG_SNMP_TRAP_ENABLED)
	LOG_INF("  - Trap Destination: %s : %d", CONFIG_SNMP_SAMPLE_TRAP_DEST,
		CONFIG_SNMP_TRAP_PORT);
#endif
	LOG_INF("Private MIB Structure (1.3.6.1.4.1.%d.1):", CONFIG_SNMP_SAMPLE_ENTERPRISE_ID);
	LOG_INF("  .1.1.1.0 sensorValue       (INTEGER, temp in C)   [R/W]");
	LOG_INF("  .1.1.2.0 ledState          (INTEGER, 0=OFF, 1=ON) [R/W]");
	LOG_INF("  .1.1.3.0 buttonCounter     (Counter32, press cnt) [RO]");
	LOG_INF("  .1.1.4.0 sensorHumidity    (Gauge32, %% relative)  [RO]");
	LOG_INF("  .1.1.5.0 sensorDescription (OCTET STRING)          [RO]");
	LOG_INF("  .1.1.6.0 sensorStatusOid   (OBJECT IDENTIFIER)    [RO]");
	LOG_INF("  .1.3.1 sensorTable       (Columns: idx, name, val)");
	LOG_INF("  .1.2.1 buttonPressed     (Notification/Trap)");
	LOG_INF("v3 validation commands (net-snmp):");
	LOG_INF("  snmpget -v3 -u %s -l authPriv -a SHA-256 -A '%s' -x AES -X '%s' %s \\",
		CONFIG_SNMP_V3_USER_NAME, CONFIG_SNMP_V3_AUTH_PASS, CONFIG_SNMP_V3_PRIV_PASS,
		ip_str);
	LOG_INF("          1.3.6.1.4.1.%d.1.1.1.0", CONFIG_SNMP_SAMPLE_ENTERPRISE_ID);
	LOG_INF("  snmpwalk -v3 -u %s -l authNoPriv -a SHA -A '%s' %s 1.3.6.1.2.1.1",
		CONFIG_SNMP_SAMPLE_V3_MONITOR_USER, CONFIG_SNMP_SAMPLE_V3_MONITOR_AUTH_PASS,
		ip_str);
	LOG_INF("  snmpset -v3 -u %s -l authPriv -a SHA-256 -A '%s' -x AES -X '%s' %s \\",
		CONFIG_SNMP_V3_USER_NAME, CONFIG_SNMP_V3_AUTH_PASS, CONFIG_SNMP_V3_PRIV_PASS,
		ip_str);
	LOG_INF("          1.3.6.1.4.1.%d.1.1.2.0 i 1", CONFIG_SNMP_SAMPLE_ENTERPRISE_ID);
	LOG_INF("  snmptrap -v3 -u %s -l authPriv -a SHA-256 -A '%s' -x AES -X '%s' %s '' \\",
		CONFIG_SNMP_V3_USER_NAME, CONFIG_SNMP_V3_AUTH_PASS, CONFIG_SNMP_V3_PRIV_PASS,
		ip_str);
	LOG_INF("          1.3.6.1.6.3.1.1.5.1 1.3.6.1.2.1.1.3.0 t 0");
	LOG_INF("Expected v3 behaviour to verify:");
	LOG_INF("  - unknown engineID / user / wrong digest answers with a Report PDU");
	LOG_INF("  - 'v3monitor' can read 1.3.6.1.2.1.1 but not the private MIB subtree");
	LOG_INF("  - plain v2c still works on the same instance with the communities above");
	LOG_INF("================================================================");
}

#if defined(CONFIG_SNMP_VERSION_3)
/*
 * Register the second demo user at run time. It is authNoPriv on purpose: the same
 * agent then serves an authPriv account (the compile-time default user) and an
 * authNoPriv one, which is what a validation sample has to exercise. snmp_vacm_init()
 * already mapped this name to group "readonly", so the account can read the system
 * group and nothing else.
 *
 * RFC 3414 section 11.2 requires >= 8-octet pass phrases; snmp_usm_add_user() rejects
 * anything shorter, so a Kconfig typo shows up here instead of as a silent auth failure.
 */
static int register_monitor_user(struct snmp_agent *agent)
{
	struct snmp_usm_user monitor = {
		.auth_protocol = SNMP_USM_AUTH_SHA1,
		.priv_protocol = SNMP_USM_PRIV_NONE,
	};

	if (strlen(CONFIG_SNMP_SAMPLE_V3_MONITOR_USER) >= sizeof(monitor.user_name) ||
	    strlen(CONFIG_SNMP_SAMPLE_V3_MONITOR_AUTH_PASS) >= sizeof(monitor.auth_pass)) {
		return -EINVAL;
	}

	strcpy(monitor.user_name, CONFIG_SNMP_SAMPLE_V3_MONITOR_USER);
	strcpy(monitor.auth_pass, CONFIG_SNMP_SAMPLE_V3_MONITOR_AUTH_PASS);

	int ret = snmp_usm_add_user(agent, &monitor);
	if (ret < 0) {

		return ret;
	}

	return snmp_vacm_add_group_mapping(agent, SNMP_SEC_MODEL_USM,
					   CONFIG_SNMP_SAMPLE_V3_MONITOR_USER, "readonly");
}
#endif /* CONFIG_SNMP_VERSION_3 */

static void net_event_handler(struct net_mgmt_event_callback *cb, uint64_t mgmt_event,
			      struct net_if *iface)
{
	ARG_UNUSED(cb);
	if (mgmt_event == NET_EVENT_IPV4_ADDR_ADD && iface == s_snmp_iface) {
		k_sem_give(&s_ip_ready_sem);
	}
}

#if defined(CONFIG_SHELL)
#include <zephyr/shell/shell.h>
#include <stdlib.h>

static int cmd_app_button(const struct shell *sh, size_t argc, char **argv)
{
	ARG_UNUSED(argc);
	ARG_UNUSED(argv);
	shell_print(sh, "Simulating User Button press...");
	app_button_simulate_press();
	shell_print(sh, "Button count now: %u", app_button_get_counter());
	return 0;
}

static int cmd_app_led(const struct shell *sh, size_t argc, char **argv)
{
	if (argc < 2) {
		shell_print(sh, "User LED state: %s (%d)", app_led_get_state() ? "ON" : "OFF",
			    app_led_get_state());
		return 0;
	}
	int val = atoi(argv[1]);
	if (val != 0 && val != 1) {

		shell_error(sh, "Invalid value %d. Must be 0 (OFF) or 1 (ON).", val);
		return -EINVAL;
	}
	app_led_set_state(val);
	shell_print(sh, "User LED set to: %s (%d)", val ? "ON" : "OFF", val);
	return 0;
}

static int cmd_app_sensor(const struct shell *sh, size_t argc, char **argv)
{
	ARG_UNUSED(argc);
	ARG_UNUSED(argv);
	shell_print(sh, "Sensor Readings:");
	shell_print(sh, "  Temperature : %d C", app_sensor_get_temp());
	shell_print(sh, "  Humidity    : %u %%", app_sensor_get_humidity());
	shell_print(sh, "  Description : %s", app_sensor_get_description());
	shell_print(sh, "  Button Count: %u", app_button_get_counter());
	shell_print(sh, "  LED State   : %d", app_led_get_state());
	return 0;
}

SHELL_STATIC_SUBCMD_SET_CREATE(
	sub_app,
	SHELL_CMD(button, NULL, "Simulate User Button press and send SNMP Trap", cmd_app_button),
	SHELL_CMD_ARG(led, NULL, "Get or set User LED [0|1]", cmd_app_led, 1, 1),
	SHELL_CMD(sensor, NULL, "Display current sensor and device values", cmd_app_sensor),
	SHELL_SUBCMD_SET_END);

SHELL_CMD_REGISTER(app, &sub_app, "SNMP validation sample commands", NULL);
#endif

int main(void)
{
	LOG_INF("Booting SNMP Validation Sample...");

	s_snmp_iface = net_if_get_first_ethernet();
	if (!s_snmp_iface) {
		LOG_ERR("No Ethernet network interface found");
		return -ENODEV;
	}

	/* 1. Initialize hardware drivers that do not need the agent */
	app_led_init();
	app_sensor_init();

	/* 2. Register network management event listener */
	net_mgmt_init_event_callback(&s_mgmt_cb, net_event_handler,
				     NET_EVENT_IPV4_ADDR_ADD | NET_EVENT_IPV4_ADDR_DEL);
	net_mgmt_add_event_callback(&s_mgmt_cb);

	/* 3. Create the LAN agent instance on caller-owned static storage.
	 *    snmp_agent_init() only builds the domain state (MIB-II groups, identity,
	 *    communities); the UDP listener is opened later by snmp_agent_start().
	 */
	const struct snmp_agent_cfg cfg_lan = {
		.port = CONFIG_SNMP_AGENT_PORT,
		.iface = s_snmp_iface,
		.read_community = CONFIG_SNMP_COMMUNITY_READ,
		.write_community = CONFIG_SNMP_COMMUNITY_WRITE,
		.sys_descr = "Zephyr RTOS SNMP Validation Node (STM32H743ZI)",
		.sys_contact = "admin@example.com",
		.sys_name = "NUCLEO-H743ZI-SNMP",
		.sys_location = "Lab Bench 1",
		.settings_prefix = "snmp/lan",
	};
	int ret = snmp_agent_init(&g_agent_lan, &cfg_lan);
	if (ret < 0) {

		LOG_ERR("Failed to initialize LAN SNMP agent: %d", ret);
		return ret;
	}

#if defined(CONFIG_SNMP_VERSION_3)
	/* 3b. Add the authNoPriv demo account next to the compiled-in authPriv one. */
	ret = register_monitor_user(&g_agent_lan);
	if (ret < 0) {
		LOG_ERR("Failed to register USM monitor user \"%s\": %d",
			CONFIG_SNMP_SAMPLE_V3_MONITOR_USER, ret);
		return ret;
	}
	LOG_INF("Registered USM users: \"%s\" (authPriv), \"%s\" (authNoPriv)",
		CONFIG_SNMP_V3_USER_NAME, CONFIG_SNMP_SAMPLE_V3_MONITOR_USER);

	/*
	 * The collector's createUser line needs this engine ID (RFC 3411 §5). Printing
	 * it once at boot removes the guessing that used to require trace output.
	 */
	{
		uint8_t engine_id[32];
		uint8_t engine_id_len = sizeof(engine_id);
		char engine_hex[2 * 32 + 3] = "?";
		int hex_pos = 0;

		if (snmp_usm_get_engine_id(&g_agent_lan, engine_id, &engine_id_len) == 0) {
			hex_pos = snprintf(engine_hex, sizeof(engine_hex), "0x");
			for (uint8_t i = 0;
			     i < engine_id_len && hex_pos < (int)sizeof(engine_hex) - 2; i++) {
				hex_pos +=
					snprintf(&engine_hex[hex_pos], sizeof(engine_hex) - hex_pos,
						 "%02X", engine_id[i]);
			}
		}
		LOG_INF("snmpEngineID: %s (use as -e in snmptrapd createUser)", engine_hex);
	}
#endif

	/* Button traps fire from a workqueue: hand it the agent to notify through. */
	app_button_init(&g_agent_lan);

	/* 4. Register Private MIB on the LAN agent */
	ret = app_mib_init(&g_agent_lan);
	if (ret < 0) {
		LOG_ERR("Failed to initialize Private MIB: %d", ret);
		return ret;
	}

#if defined(CONFIG_SNMP_TRAP_ENABLED)
	/* 5. Configure trap destination */
	snmp_trap_add_destination(&g_agent_lan, CONFIG_SNMP_SAMPLE_TRAP_DEST);
	LOG_INF("Configured SNMP Trap destination: %s", CONFIG_SNMP_SAMPLE_TRAP_DEST);
#endif

#if defined(CONFIG_SNMP_SAMPLE_SECOND_INSTANCE)
	/*
	 * 6. Second instance: same interface, different UDP port (two RUNNING agents
	 * cannot share :161 without an interface binding — plain socket semantics)
	 * and a distinct sysName. Its MIB tree, counters and community set are fully
	 * independent of g_agent_lan.
	 */
	const struct snmp_agent_cfg cfg_wan = {
		.port = CONFIG_SNMP_SAMPLE_WAN_PORT,
		.iface = s_snmp_iface,
		.read_community = CONFIG_SNMP_COMMUNITY_READ,
		.write_community = CONFIG_SNMP_COMMUNITY_WRITE,
		.sys_descr = "Zephyr RTOS SNMP Validation Node (WAN instance)",
		.sys_contact = "admin@example.com",
		.sys_name = "NUCLEO-H743ZI-WAN",
		.sys_location = "Lab Bench 1",
		.settings_prefix = "snmp/wan",
	};
	ret = snmp_agent_init(&g_agent_wan, &cfg_wan);
	if (ret < 0) {
		LOG_ERR("Failed to initialize WAN SNMP agent: %d", ret);
		return ret;
	}
	ret = app_mib_init(&g_agent_wan);
	if (ret < 0) {
		LOG_ERR("Failed to register Private MIB on WAN agent: %d", ret);
		return ret;
	}
#endif

	/* Check if interface already has IP assigned; if not, wait for DHCP */
	struct net_if *iface = s_snmp_iface;
	bool has_ip = false;
	char ip_buf[NET_IPV4_ADDR_LEN] = "192.0.2.1";

	if (iface && iface->config.ip.ipv4) {
		for (int i = 0; i < NET_IF_MAX_IPV4_ADDR; i++) {
			if (iface->config.ip.ipv4->unicast[i].ipv4.is_used &&
			    iface->config.ip.ipv4->unicast[i].ipv4.address.in_addr.s_addr != 0) {
				net_addr_ntop(
					AF_INET,
					&iface->config.ip.ipv4->unicast[i].ipv4.address.in_addr,
					ip_buf, sizeof(ip_buf));
				has_ip = true;
				break;
			}
		}
	}

	if (!has_ip) {
		LOG_INF("Waiting for DHCP lease...");
		k_sem_take(&s_ip_ready_sem, K_FOREVER);
		if (iface && iface->config.ip.ipv4) {
			for (int i = 0; i < NET_IF_MAX_IPV4_ADDR; i++) {
				if (iface->config.ip.ipv4->unicast[i].ipv4.is_used) {
					net_addr_ntop(AF_INET,
						      &iface->config.ip.ipv4->unicast[i]
							       .ipv4.address.in_addr,
						      ip_buf, sizeof(ip_buf));
					break;
				}
			}
		}
	}

	print_banner(ip_buf);

	/* 7. Open the UDP listeners only now that the interface has an address.
	 *    The coldStart trap stays ordered exactly like the old transport facade
	 *    documented it (former snmp_service.c): first an assigned IPv4 address,
	 *    then the listener, then the notification.
	 */
	ret = snmp_agent_start(&g_agent_lan);
	if (ret < 0) {
		LOG_ERR("Failed to start LAN SNMP agent: %d", ret);
		return ret;
	}
#if defined(CONFIG_SNMP_SAMPLE_SECOND_INSTANCE)
	ret = snmp_agent_start(&g_agent_wan);
	if (ret < 0) {
		LOG_ERR("Failed to start WAN SNMP agent: %d", ret);
		return ret;
	}
#endif

#if defined(CONFIG_SNMP_TRAP_ENABLED)
	snmp_trap_send_coldstart(&g_agent_lan);
	LOG_INF("ColdStart Trap dispatched to %s", CONFIG_SNMP_SAMPLE_TRAP_DEST);
#endif

	/* 8. Main loop: periodically update sensor values */
	while (1) {
		k_sleep(K_SECONDS(2));
		app_sensor_update_periodic();
	}

	return 0;
}
```

## src/app_button.h
```c
/*
 * Copyright (c) 2026 Zephyr SNMP Contributors
 *
 * SPDX-License-Identifier: Apache-2.0
 */

#ifndef APP_BUTTON_H_
#define APP_BUTTON_H_

#include <stdint.h>

struct snmp_agent;

#ifdef __cplusplus
extern "C" {
#endif

/**
 * @brief Initialize user button hardware (sw0 alias) with GPIO interrupt and workqueue.
 *
 * @param agent Agent through which a button press dispatches its SNMP notification.
 *              The caller owns the storage; it must outlive the module.
 * @return 0 on success, negative errno on failure.
 */
int app_button_init(struct snmp_agent *agent);

/**
 * @brief Get total user button press count.
 */
uint32_t app_button_get_counter(void);

/**
 * @brief Explicitly trigger the buttonPressed SNMP Trap/Notification.
 *        Can be called by button ISR or from shell / test code.
 * @return 0 on success, negative errno on failure.
 */
int app_button_trigger_notification(void);

/**
 * @brief Simulate button press (increments counter and triggers notification).
 * @return 0 on success, negative errno on failure.
 */
int app_button_simulate_press(void);

#ifdef __cplusplus
}
#endif

#endif /* APP_BUTTON_H_ */
```

## src/app_led.c
```c
/*
 * Copyright (c) 2026 Zephyr SNMP Contributors
 *
 * SPDX-License-Identifier: Apache-2.0
 */

#include "app_led.h"
#include <zephyr/kernel.h>
#include <zephyr/drivers/gpio.h>
#include <zephyr/logging/log.h>

LOG_MODULE_REGISTER(app_led, LOG_LEVEL_INF);

#if DT_NODE_EXISTS(DT_ALIAS(led0))
static const struct gpio_dt_spec s_led = GPIO_DT_SPEC_GET(DT_ALIAS(led0), gpios);
static bool s_hardware_available;
#endif

static int s_led_state;

int app_led_init(void)
{
#if DT_NODE_EXISTS(DT_ALIAS(led0))
	if (!gpio_is_ready_dt(&s_led)) {
		LOG_WRN("User LED device %s not ready", s_led.port->name);
		return -ENODEV;
	}

	int ret = gpio_pin_configure_dt(&s_led, GPIO_OUTPUT_INACTIVE);
	if (ret < 0) {

		LOG_ERR("Failed to configure User LED pin: %d", ret);
		return ret;
	}

	s_hardware_available = true;
	s_led_state = 0;
	LOG_INF("User LED initialized on %s pin %d", s_led.port->name, s_led.pin);
	return 0;
#else
	LOG_WRN("No 'led0' alias found in DeviceTree; simulating LED in software");
	s_led_state = 0;
	return 0;
#endif
}

int app_led_get_state(void)
{
	return s_led_state;
}

int app_led_set_state(int state)
{
	if (state != 0 && state != 1) {
		LOG_WRN("Invalid LED state requested: %d (must be 0 or 1)", state);
		return -EINVAL;
	}

	s_led_state = state;

#if DT_NODE_EXISTS(DT_ALIAS(led0))
	if (s_hardware_available) {
		int ret = gpio_pin_set_dt(&s_led, state);
		if (ret < 0) {

			LOG_ERR("Failed to set physical LED pin: %d", ret);
			return ret;
		}
	}
#endif

	LOG_INF("Physical User LED changed to: %s (%d)", state ? "ON" : "OFF", state);
	return 0;
}
```

## src/app_led.h
```c
/*
 * Copyright (c) 2026 Zephyr SNMP Contributors
 *
 * SPDX-License-Identifier: Apache-2.0
 */

#ifndef APP_LED_H_
#define APP_LED_H_

#include <stdbool.h>

#ifdef __cplusplus
extern "C" {
#endif

/**
 * @brief Initialize the user LED hardware (led0 alias).
 * @return 0 on success, negative errno on failure.
 */
int app_led_init(void);

/**
 * @brief Get the current state of the LED.
 * @return 1 if ON, 0 if OFF, negative errno on error.
 */
int app_led_get_state(void);

/**
 * @brief Set the LED state.
 * @param state 0 to turn OFF, 1 to turn ON.
 * @return 0 on success, -EINVAL if state is invalid, negative errno on hardware error.
 */
int app_led_set_state(int state);

#ifdef __cplusplus
}
#endif

#endif /* APP_LED_H_ */
```

## src/app_mib.c
```c
/*
 * Copyright (c) 2026 Zephyr SNMP Contributors
 *
 * SPDX-License-Identifier: Apache-2.0
 */

#include "app_mib.h"
#include "app_led.h"
#include "app_sensor.h"
#include "app_button.h"
#include <zephyr/kernel.h>
#include <zephyr/logging/log.h>
#include <zephyr/net/snmp/snmp.h>
#include <zephyr/net/snmp/snmp_mib.h>
#include <string.h>
#include <errno.h>

LOG_MODULE_REGISTER(app_mib, LOG_LEVEL_INF);

#ifndef CONFIG_SNMP_SAMPLE_ENTERPRISE_ID
#define CONFIG_SNMP_SAMPLE_ENTERPRISE_ID 54321
#endif

/* -------------------------------------------------------------------------- */
/* Scalar Node Callbacks                                                      */
/* -------------------------------------------------------------------------- */

/* 1. sensorValue (1.3.6.1.4.1.<enterprise>.1.1.1.0) - INTEGER */
static int cb_get_sensor_value(struct snmp_agent *agent, const struct snmp_mib_node *node,
			       struct snmp_varbind *vb)
{
	ARG_UNUSED(agent);
	ARG_UNUSED(node);
	vb->type = ASN1_TAG_INTEGER;
	vb->val.int_val = app_sensor_get_temp();
	return 0;
}

static int cb_set_sensor_value(struct snmp_agent *agent, struct snmp_mib_node *node,
			       const struct snmp_varbind *vb)
{
	ARG_UNUSED(agent);
	ARG_UNUSED(node);
	if (vb->type != ASN1_TAG_INTEGER) {
		return -EINVAL;
	}
	app_sensor_set_temp(vb->val.int_val);
	return 0;
}

/* 2. ledState (1.3.6.1.4.1.<enterprise>.1.1.2.0) - INTEGER (0=OFF, 1=ON) */
static int cb_get_led_state(struct snmp_agent *agent, const struct snmp_mib_node *node,
			    struct snmp_varbind *vb)
{
	ARG_UNUSED(agent);
	ARG_UNUSED(node);
	vb->type = ASN1_TAG_INTEGER;
	vb->val.int_val = app_led_get_state();
	return 0;
}

static int cb_set_led_state(struct snmp_agent *agent, struct snmp_mib_node *node,
			    const struct snmp_varbind *vb)
{
	ARG_UNUSED(agent);
	ARG_UNUSED(node);
	if (vb->type != ASN1_TAG_INTEGER) {
		LOG_WRN("SNMP SET ledState rejected: invalid ASN.1 type 0x%02X", vb->type);
		return -EINVAL;
	}
	int ret = app_led_set_state(vb->val.int_val);
	if (ret < 0) {

		LOG_WRN("SNMP SET ledState rejected invalid value: %d", vb->val.int_val);
		return -EINVAL; /* Maps to badValue in SNMP response */
	}
	return 0;
}

/* 3. buttonCounter (1.3.6.1.4.1.<enterprise>.1.1.3.0) - Counter32 */
static int cb_get_button_counter(struct snmp_agent *agent, const struct snmp_mib_node *node,
				 struct snmp_varbind *vb)
{
	ARG_UNUSED(agent);
	ARG_UNUSED(node);
	vb->type = SNMP_TAG_COUNTER32;
	vb->val.uint_val = app_button_get_counter();
	return 0;
}

/* 4. sensorHumidity (1.3.6.1.4.1.<enterprise>.1.1.4.0) - Gauge32 */
static int cb_get_sensor_humidity(struct snmp_agent *agent, const struct snmp_mib_node *node,
				  struct snmp_varbind *vb)
{
	ARG_UNUSED(agent);
	ARG_UNUSED(node);
	vb->type = SNMP_TAG_GAUGE32;
	vb->val.uint_val = app_sensor_get_humidity();
	return 0;
}

/* 5. sensorDescription (1.3.6.1.4.1.<enterprise>.1.1.5.0) - OCTET STRING */
static int cb_get_sensor_desc(struct snmp_agent *agent, const struct snmp_mib_node *node,
			      struct snmp_varbind *vb)
{
	ARG_UNUSED(agent);
	ARG_UNUSED(node);
	vb->type = ASN1_TAG_OCTET_STRING;
	const char *desc = app_sensor_get_description();
	size_t len = strlen(desc);
	if (len > sizeof(vb->val.octet_str.data)) {

		len = sizeof(vb->val.octet_str.data);
	}
	memcpy(vb->val.octet_str.data, desc, len);
	vb->val.octet_str.len = (uint16_t)len;
	return 0;
}

/* 6. sensorStatusOid (1.3.6.1.4.1.<enterprise>.1.1.6.0) - OBJECT IDENTIFIER */
static int cb_get_sensor_status_oid(struct snmp_agent *agent, const struct snmp_mib_node *node,
				    struct snmp_varbind *vb)
{
	ARG_UNUSED(agent);
	ARG_UNUSED(node);
	vb->type = ASN1_TAG_OID;
	/* Points to sensorValue: 1.3.6.1.4.1.<enterprise>.1.1.1.0 */
	vb->val.oid.len = 11;
	vb->val.oid.ids[0] = 1;
	vb->val.oid.ids[1] = 3;
	vb->val.oid.ids[2] = 6;
	vb->val.oid.ids[3] = 1;
	vb->val.oid.ids[4] = 4;
	vb->val.oid.ids[5] = 1;
	vb->val.oid.ids[6] = CONFIG_SNMP_SAMPLE_ENTERPRISE_ID;
	vb->val.oid.ids[7] = 1;
	vb->val.oid.ids[8] = 1;
	vb->val.oid.ids[9] = 1;
	vb->val.oid.ids[10] = 0;
	return 0;
}

/* -------------------------------------------------------------------------- */
/* Table Node Callbacks: sensorTable (1.3.6.1.4.1.<enterprise>.1.3.1)         */
/* -------------------------------------------------------------------------- */

static int cb_table_col1_get(struct snmp_agent *agent, const struct snmp_table_row *row,
			     uint8_t column, struct snmp_varbind *vb)
{
	ARG_UNUSED(agent);
	ARG_UNUSED(column);
	vb->type = ASN1_TAG_INTEGER;
	vb->val.int_val = (int32_t)row->index;
	return 0;
}

static int cb_table_col2_get(struct snmp_agent *agent, const struct snmp_table_row *row,
			     uint8_t column, struct snmp_varbind *vb)
{
	ARG_UNUSED(agent);
	ARG_UNUSED(column);
	const char *name = NULL;
	int ret = app_sensor_get_table_entry(row->index, &name, NULL);
	if (ret < 0 || !name) {

		return -ENOENT;
	}

	vb->type = ASN1_TAG_OCTET_STRING;
	size_t len = strlen(name);
	if (len > sizeof(vb->val.octet_str.data)) {

		len = sizeof(vb->val.octet_str.data);
	}
	memcpy(vb->val.octet_str.data, name, len);
	vb->val.octet_str.len = (uint16_t)len;
	return 0;
}

static int cb_table_col3_get(struct snmp_agent *agent, const struct snmp_table_row *row,
			     uint8_t column, struct snmp_varbind *vb)
{
	ARG_UNUSED(agent);
	ARG_UNUSED(column);
	int32_t val = 0;
	int ret = app_sensor_get_table_entry(row->index, NULL, &val);
	if (ret < 0) {

		return -ENOENT;
	}

	vb->type = ASN1_TAG_INTEGER;
	vb->val.int_val = val;
	return 0;
}

static const uint8_t s_sensor_cols[] = {1, 2, 3};
static const uint8_t s_sensor_types[] = {ASN1_TAG_INTEGER, ASN1_TAG_OCTET_STRING, ASN1_TAG_INTEGER};
static snmp_table_get_cb_t s_sensor_get_cbs[] = {cb_table_col1_get, cb_table_col2_get,
						 cb_table_col3_get};

static struct snmp_table_row s_sensor_rows[3] = {{.index = 1}, {.index = 2}, {.index = 3}};

static struct snmp_mib_table s_sensor_table = {
	.table_oid = {.len = 10,
		      .ids = {1, 3, 6, 1, 4, 1, CONFIG_SNMP_SAMPLE_ENTERPRISE_ID, 1, 3, 1}},
	.column_cnt = 3,
	.column_subids = s_sensor_cols,
	.column_types = s_sensor_types,
	.get_cbs = s_sensor_get_cbs,
	.set_cbs = NULL,
};

int app_mib_init(struct snmp_agent *agent)
{
	int ret;

	/* Configure Enterprise OID for sysObjectID and Traps */
	struct snmp_oid ent_oid = {.len = 7,
				   .ids = {1, 3, 6, 1, 4, 1, CONFIG_SNMP_SAMPLE_ENTERPRISE_ID}};
	snmp_set_device_enterprise_oid(agent, &ent_oid);

#if defined(CONFIG_SNMP_SAMPLE_SENSOR_OBJECT) || !defined(CONFIG_SNMP_SAMPLE_SENSOR_OBJECT)
	/* 1. Register sensorValue (1.3.6.1.4.1.<enterprise>.1.1.1.0) */
	static const struct snmp_mib_node node_sensor_val = {
		.oid = {.len = 11,
			.ids = {1, 3, 6, 1, 4, 1, CONFIG_SNMP_SAMPLE_ENTERPRISE_ID, 1, 1, 1, 0}},
		.type = ASN1_TAG_INTEGER,
		.get_cb = cb_get_sensor_value,
		.set_cb = cb_set_sensor_value,
	};
	ret = snmp_mib_register(agent, &node_sensor_val);
	if (ret < 0) {
		LOG_ERR("Failed to register sensorValue node: %d", ret);
		return ret;
	}

	/* 4. Register sensorHumidity (1.3.6.1.4.1.<enterprise>.1.1.4.0) */
	static const struct snmp_mib_node node_humidity = {
		.oid = {.len = 11,
			.ids = {1, 3, 6, 1, 4, 1, CONFIG_SNMP_SAMPLE_ENTERPRISE_ID, 1, 1, 4, 0}},
		.type = SNMP_TAG_GAUGE32,
		.get_cb = cb_get_sensor_humidity,
		.set_cb = NULL,
	};
	ret = snmp_mib_register(agent, &node_humidity);
	if (ret < 0) {
		LOG_ERR("Failed to register sensorHumidity node: %d", ret);
		return ret;
	}

	/* 5. Register sensorDescription (1.3.6.1.4.1.<enterprise>.1.1.5.0) */
	static const struct snmp_mib_node node_desc = {
		.oid = {.len = 11,
			.ids = {1, 3, 6, 1, 4, 1, CONFIG_SNMP_SAMPLE_ENTERPRISE_ID, 1, 1, 5, 0}},
		.type = ASN1_TAG_OCTET_STRING,
		.get_cb = cb_get_sensor_desc,
		.set_cb = NULL,
	};
	ret = snmp_mib_register(agent, &node_desc);
	if (ret < 0) {
		LOG_ERR("Failed to register sensorDescription node: %d", ret);
		return ret;
	}

	/* 6. Register sensorStatusOid (1.3.6.1.4.1.<enterprise>.1.1.6.0) */
	static const struct snmp_mib_node node_status_oid = {
		.oid = {.len = 11,
			.ids = {1, 3, 6, 1, 4, 1, CONFIG_SNMP_SAMPLE_ENTERPRISE_ID, 1, 1, 6, 0}},
		.type = ASN1_TAG_OID,
		.get_cb = cb_get_sensor_status_oid,
		.set_cb = NULL,
	};
	ret = snmp_mib_register(agent, &node_status_oid);
	if (ret < 0) {
		LOG_ERR("Failed to register sensorStatusOid node: %d", ret);
		return ret;
	}
#endif

#if defined(CONFIG_SNMP_SAMPLE_LED_OBJECT) || !defined(CONFIG_SNMP_SAMPLE_LED_OBJECT)
	/* 2. Register ledState (1.3.6.1.4.1.<enterprise>.1.1.2.0) */
	static const struct snmp_mib_node node_led = {
		.oid = {.len = 11,
			.ids = {1, 3, 6, 1, 4, 1, CONFIG_SNMP_SAMPLE_ENTERPRISE_ID, 1, 1, 2, 0}},
		.type = ASN1_TAG_INTEGER,
		.get_cb = cb_get_led_state,
		.set_cb = cb_set_led_state,
	};
	ret = snmp_mib_register(agent, &node_led);
	if (ret < 0) {
		LOG_ERR("Failed to register ledState node: %d", ret);
		return ret;
	}
#endif

#if defined(CONFIG_SNMP_SAMPLE_BUTTON_TRAP) || !defined(CONFIG_SNMP_SAMPLE_BUTTON_TRAP)
	/* 3. Register buttonCounter (1.3.6.1.4.1.<enterprise>.1.1.3.0) */
	static const struct snmp_mib_node node_btn = {
		.oid = {.len = 11,
			.ids = {1, 3, 6, 1, 4, 1, CONFIG_SNMP_SAMPLE_ENTERPRISE_ID, 1, 1, 3, 0}},
		.type = SNMP_TAG_COUNTER32,
		.get_cb = cb_get_button_counter,
		.set_cb = NULL,
	};
	ret = snmp_mib_register(agent, &node_btn);
	if (ret < 0) {
		LOG_ERR("Failed to register buttonCounter node: %d", ret);
		return ret;
	}
#endif

	/* 7. Register sensorTable (1.3.6.1.4.1.<enterprise>.1.3.1) */
	ret = snmp_mib_register_table(agent, &s_sensor_table);
	if (ret == 0) {
		/*
		 * The row list belongs to the shared, application-owned table, so it
		 * is linked once — by the first agent that registers it — while every
		 * instance is still INITIALIZED and no MIB walk can run concurrently.
		 */
		if (s_sensor_table.rows == NULL) {
			snmp_mib_table_add_row(agent, &s_sensor_table, &s_sensor_rows[0]);
			snmp_mib_table_add_row(agent, &s_sensor_table, &s_sensor_rows[1]);
			snmp_mib_table_add_row(agent, &s_sensor_table, &s_sensor_rows[2]);
		}
	} else {
		LOG_WRN("Failed to register sensorTable: %d", ret);
	}

	LOG_INF("Private MIB registered under 1.3.6.1.4.1.%d.1 (nucleoH743)",
		CONFIG_SNMP_SAMPLE_ENTERPRISE_ID);
	return 0;
}
```

## src/app_sensor.h
```c
/*
 * Copyright (c) 2026 Zephyr SNMP Contributors
 *
 * SPDX-License-Identifier: Apache-2.0
 */

#ifndef APP_SENSOR_H_
#define APP_SENSOR_H_

#include <stdint.h>
#include <stddef.h>

#ifdef __cplusplus
extern "C" {
#endif

/**
 * @brief Initialize sensor simulation module.
 */
int app_sensor_init(void);

/**
 * @brief Get simulated temperature (INTEGER, in °C).
 */
int32_t app_sensor_get_temp(void);

/**
 * @brief Set temperature (allows SNMP SET testing on sensor if enabled).
 */
void app_sensor_set_temp(int32_t temp);

/**
 * @brief Get simulated relative humidity (GAUGE32, 0-100%).
 */
uint32_t app_sensor_get_humidity(void);

/**
 * @brief Get sensor node description string (OCTET STRING).
 */
const char *app_sensor_get_description(void);

/**
 * @brief Get sensor table row information by 1-based index.
 * @param index 1 to 3
 * @param name Output pointer for sensor name
 * @param value Output pointer for sensor value
 * @return 0 on success, -ENOENT if index out of range.
 */
int app_sensor_get_table_entry(uint32_t index, const char **name, int32_t *value);

/**
 * @brief Periodic update function to simulate sensor readings variation.
 */
void app_sensor_update_periodic(void);

#ifdef __cplusplus
}
#endif

#endif /* APP_SENSOR_H_ */
```
