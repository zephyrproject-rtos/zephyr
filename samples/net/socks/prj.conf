## CMakeLists.txt
```
cmake_minimum_required(VERSION 3.8.2)
macro(set_conf_file)
  if(EXISTS ${APPLICATION_SOURCE_DIR}/prj_${BOARD}.conf)
    set(CONF_FILE "${APPLICATION_SOURCE_DIR}/prj_${BOARD}.conf")
  elseif(EXISTS ${APPLICATION_SOURCE_DIR}/boards/${BOARD}.conf)
    set(CONF_FILE
      "prj.conf ${APPLICATION_SOURCE_DIR}/boards/${BOARD}.conf")
  else()
    set(CONF_FILE "prj.conf")
  endif()
endmacro()

include($ENV{ZEPHYR_BASE}/cmake/app/boilerplate.cmake NO_POLICY_SCOPE)
project(socks)

target_sources(app PRIVATE src/main.c)
```

## prj.conf
```kconfig
CONFIG_NETWORKING=y
CONFIG_NET_LOG=y
CONFIG_LOG=y
CONFIG_NET_IPV6=y
CONFIG_NET_IPV4=y
CONFIG_NET_DHCPV4=n
CONFIG_NET_UDP=y
CONFIG_NET_TCP=y

CONFIG_NET_SHELL=y
CONFIG_NET_L2_ETHERNET=y

# CONFIG_NET_CONFIG_NEED_IPV6 is not set
# CONFIG_NET_IPV6 is not set

CONFIG_NET_CONFIG_NEED_IPV4=y

CONFIG_NET_SHELL=y
CONFIG_NET_TCP=y
CONFIG_NET_MAX_CONN=10
CONFIG_NET_MAX_CONTEXTS=20

CONFIG_SOCKS=y

CONFIG_NET_CONFIG_NEED_IPV4=y
CONFIG_NET_CONFIG_SETTINGS=y
CONFIG_NET_CONFIG_MY_IPV4_ADDR="192.168.0.150"
CONFIG_NET_CONFIG_MY_IPV4_GW="192.168.0.1"


# TO RECONSIDER
CONFIG_ETHERNET_LOG_LEVEL_INF=y
CONFIG_SYS_LOG=y
CONFIG_LOG_INPLACE_PROCESS=y
CONFIG_LOG_STRDUP_MAX_STRING=60
CONFIG_LOG_STRDUP_BUF_COUNT=9
CONFIG_NET_TCP_LOG_LEVEL_WRN=y
CONFIG_NET_TCP_BACKLOG_SIZE=5
# CONFIG_UART_INTERRUPT_DRIVEN is not set
```

## src/main.c
```c
/*
 * Copyright (c) 2018 Antmicro Ltd
 *
 * SPDX-License-Identifier: Apache-2.0
 */

#include <stdio.h>
#include <net/socks.h>

#define SOCKS_PROXY_SERVER_PORT 1080

static struct socks_ctx socks_ctx;

int main(void)
{
	printf("Starting SOCKS5 proxy server sample");

	socks_init(&socks_ctx, SOCKS_PROXY_SERVER_PORT);

	return 0;
}
```
