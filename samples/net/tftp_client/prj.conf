## CMakeLists.txt
```
# SPDX-License-Identifier: Apache-2.0

cmake_minimum_required(VERSION 3.28.0)
find_package(Zephyr REQUIRED HINTS $ENV{ZEPHYR_BASE})
project(tftp_client)

FILE(GLOB app_sources src/*.c)
target_sources(app PRIVATE ${app_sources})

include(${ZEPHYR_BASE}/samples/net/common/common.cmake)
```

## Kconfig
```
# Private config options for TFTP client sample

# Copyright (c) 2023 Kickmaker
# SPDX-License-Identifier: Apache-2.0

mainmenu "TFTP Client sample"

config TFTP_APP_PORT
	string "TFTP port used"
	default "69"
	help
	  TFTP port used.

config TFTP_APP_SERVER
	string "TFTP server address"
	default "192.0.2.2"
	help
	  TFTP server address. Write as a full URI including optional port number.
	  When DNS resolver is enabled, DNS domain names could be used as well.

source "Kconfig.zephyr"
```

## sample.yaml
```
sample:
  description: Test TFTP client get and put methods
  name: TFTP client sample app
tests:
  sample.net.tftp_client:
    harness: net
    depends_on: netif
    platform_allow:
      - native_sim
    integration_platforms:
      - native_sim
    tags:
      - net
      - tftp
```

## prj.conf
```kconfig
CONFIG_NETWORKING=y
CONFIG_LOG=y
CONFIG_NET_IPV4=y
CONFIG_NET_IPV6=y
CONFIG_NET_PKT_RX_COUNT=10
CONFIG_NET_PKT_TX_COUNT=10
CONFIG_NET_BUF_RX_COUNT=10
CONFIG_NET_BUF_TX_COUNT=10
CONFIG_NET_MAX_CONTEXTS=2

CONFIG_NET_LOG=y
CONFIG_NET_SHELL=y

CONFIG_NET_CONFIG_SETTINGS=y
CONFIG_NET_CONFIG_NEED_IPV6=y
CONFIG_NET_CONFIG_MY_IPV6_ADDR="2001:db8::1"
CONFIG_NET_CONFIG_NEED_IPV4=y
CONFIG_NET_CONFIG_MY_IPV4_ADDR="192.0.2.1"

CONFIG_DNS_RESOLVER=n
CONFIG_TFTP_LIB=y
CONFIG_POSIX_AEP_CHOICE_NETAPP=y

CONFIG_MAIN_STACK_SIZE=2048
```

## boards/native_sim.conf
```kconfig
CONFIG_DNS_RESOLVER=y
CONFIG_DNS_SERVER_IP_ADDRESSES=y
CONFIG_DNS_SERVER1="192.0.2.2"
```

## boards/qemu_cortex_m3.conf
```kconfig
CONFIG_NET_QEMU_ETHERNET=y
CONFIG_TEST_RANDOM_GENERATOR=y
```

## src/tftp-client.c
```c
/*
 * Copyright (c) 2023 Kickmaker
 *
 * SPDX-License-Identifier: Apache-2.0
 */

#define LOG_MODULE_NAME net_tftp_client_app
#define LOG_LEVEL LOG_LEVEL_DBG

#include <zephyr/logging/log.h>
LOG_MODULE_REGISTER(LOG_MODULE_NAME);

#include <zephyr/net/tftp.h>
#include <zephyr/posix/netdb.h>

#define APP_BANNER		"Run TFTP client"
#define TFTP_SAMPLE_DATA	"Lorem ipsum dolor sit amet, consectetur adipiscing elit"

static struct tftpc client;

static void tftp_event_callback(const struct tftp_evt *evt)
{
	switch (evt->type) {
	case TFTP_EVT_DATA:
		LOG_HEXDUMP_INF(evt->param.data.data_ptr,
				evt->param.data.len,
				"Received data: ");
		break;
	case TFTP_EVT_ERROR:
		LOG_ERR("Error code %d msg: %s",
			evt->param.error.code,
			evt->param.error.msg);
	default:
		break;
	}
}

static int tftp_init(const char *hostname)
{
	struct sockaddr_storage remote_addr;
	struct addrinfo *res, hints = {0};
	int ret;

	/* Setup TFTP server address */
	hints.ai_socktype = SOCK_DGRAM;

	ret = getaddrinfo(hostname, CONFIG_TFTP_APP_PORT, &hints, &res);
	if (ret != 0) {
		LOG_ERR("Unable to resolve address");
		/* DNS error codes don't align with normal errors */
		return -ENOENT;
	}

	if (res->ai_addrlen > sizeof(remote_addr)) {
		LOG_DBG("Resolved address does not fit (%u > %zu)", res->ai_addrlen,
			sizeof(remote_addr));
		freeaddrinfo(res);
		return -EINVAL;
	}

	memcpy(&remote_addr, res->ai_addr, res->ai_addrlen);
	freeaddrinfo(res);

	/* Save sockaddr into TFTP client handler */
	memcpy(&client.server_addr, &remote_addr, sizeof(client.server_addr));

	/* Register TFTP client callback */
	client.callback = tftp_event_callback;

	return 0;
}

int main(void)
{
	int ret;

	LOG_INF(APP_BANNER);

	ret = tftp_init(CONFIG_TFTP_APP_SERVER);
	if (ret < 0) {
		LOG_ERR("Unable to initialize TFTP client");
		return ret;
	}

	/* Get file1.bin in octet mode */
	ret = tftp_get(&client, "file1.bin", "octet");
	if (ret < 0) {
		LOG_ERR("Error while getting file (%d)", ret);
		return ret;
	}

	LOG_INF("TFTP client get done");

	/* Put TFTP sample data into newfile.bin to server in octet mode */
	ret = tftp_put(&client, "newfile.bin", "octet",
			TFTP_SAMPLE_DATA, sizeof(TFTP_SAMPLE_DATA));
	if (ret < 0 || ret != sizeof(TFTP_SAMPLE_DATA)) {
		LOG_ERR("Error while putting file (%d)", ret);
		return ret;
	}

	LOG_INF("TFTP client put done");

	return 0;
}
```
