## samples/net/cellular_modem/boards/nrf9160dk_nrf9160_ns.conf
```kconfig
CONFIG_UART_ASYNC_API=y
CONFIG_UART_1_ASYNC=y
CONFIG_UART_1_INTERRUPT_DRIVEN=n

# Align with the Serial LTE Modem (SLM) application.
CONFIG_MODEM_CELLULAR_UART_BUFFER_SIZES=6000

# Prevent sockets getting offloaded to the modem.
CONFIG_NET_SOCKETS_OFFLOAD=n

# Print logs and printk() output on uart0.
CONFIG_LOG_BACKEND_UART=y

CONFIG_MODEM_LOG_LEVEL_DBG=y

# Disable AT shell as SLM application has no AT mode user pipes
CONFIG_MODEM_AT_SHELL=n
```

## samples/net/cellular_modem/sample.yaml
```yaml
sample:
  description: Sample for cellular modem
  name: Sample for cellular modem using native networking
common:
  tags:
    - cellular
    - modem
  filter: dt_alias_exists("modem")
tests:
  sample.net.cellular_modem:
    platform_allow:
      - b_u585i_iot02a
    integration_platforms:
      - b_u585i_iot02a
  sample.net.cellular_modem.mikroe_lte_iot10_click:
    extra_args:
      - SHIELD=mikroe_lte_iot10_click
    platform_allow: ek_ra6m4
```

## samples/net/civetweb/http_server/sample.yaml
```yaml
sample:
  description: Civetweb HTTP API sample
  name: http_server
tests:
  sample.net.civetweb.http_server:
    harness: net
    arch_exclude: posix
    depends_on: netif
    filter: CONFIG_ENTROPY_DEVICE_RANDOM_GENERATOR
    integration_platforms:
      - sam_e70_xplained
```

## samples/net/civetweb/websocket_server/sample.yaml
```yaml
sample:
  description: Civetweb WebSocket Server sample
  name: websocket_server
tests:
  sample.net.civetweb.websocket_server:
    modules:
      - civetweb
    platform_allow: nucleo_h745zi_q_m7
```

## samples/net/cloud/aws_iot_mqtt/Kconfig
```kconfig
#
# Copyright (c) 2023 Lucas Dietrich <ld.adecy@gmail.com>
#
# SPDX-License-Identifier: Apache-2.0
#

menu "AWS"
mainmenu "AWS IoT Core MQTT sample application"

config AWS_ENDPOINT
	string "AWS endpoint"
	default ""
	help
	  Endpoint (hostname) of the AWS MQTT broker.
	  Note that the endpoint is different when using AWS Device Advisor.

config AWS_THING_NAME
	string "AWS Thing name"
	default "myThingName"
	help
	  Set the AWS Thing name created on IoT Console

config AWS_SUBSCRIBE_TOPIC
	string "MQTT subscribe topic"
	default "myThingName/downlink"
	help
	  MQTT topic the client should subscribe to.

config AWS_PUBLISH_TOPIC
	string "MQTT publish topic"
	default "myThingName/data"
	help
	  MQTT topic the client should publish to.

choice AWS_TEST_SUITE
	prompt "Device Advisor test suite"
	default AWS_TEST_SUITE_NONE
	help
	  Select the AWS Device Advisor test suite to run.

config AWS_TEST_SUITE_NONE
	bool "No test suite running"

config AWS_TEST_SUITE_DQP
	bool "Device Qualification Program (DQP)"
	help
	  Make sure your region supports AWS Device Advisor for DQP

config AWS_TEST_SUITE_RECV_QOS1
	bool "Test suite for receiving QoS 1 messages"
	help
	  For single test case "MQTT Client Puack QoS1"

endchoice

config AWS_QOS
	int "MQTT QoS"
	default 0 if AWS_TEST_SUITE_DQP
	default 1 if AWS_TEST_SUITE_RECV_QOS1
	default 0
	range 0 1
	help
	  Quality of Service to use for publishing and subscribing to topics.
	  Notes:
	  	- Use QoS 0 when passing DQP test suite
	  	- QoS 2 is not supported by AWS MQTT broker


config AWS_EXPONENTIAL_BACKOFF
	bool "enable exponential backoff"
	default n if AWS_TEST_SUITE_DQP || AWS_TEST_SUITE_RECV_QOS1
	default y
	help
	  Enable AWS exponential backoff for reconnecting to AWS MQTT broker.

endmenu

source "Kconfig.zephyr"
```

## samples/net/cloud/aws_iot_mqtt/boards/nucleo_f429zi_stm32f429xx.conf
```kconfig
CONFIG_ENTROPY_DEVICE_RANDOM_GENERATOR=y

CONFIG_NET_DHCPV4=y
CONFIG_NET_DHCPV4_INITIAL_DELAY_MAX=2
```

## samples/net/cloud/aws_iot_mqtt/boards/pinnacle_100_dvk.conf
```kconfig
# The HL7800 driver gets its IP settings from the cell network
CONFIG_NET_CONFIG_SETTINGS=n
CONFIG_NET_DHCPV4=n
CONFIG_DNS_SERVER_IP_ADDRESSES=n
# NB-IoT has large latency, so increase timeouts. It is ok to use this for Cat-M1 as well.
CONFIG_NET_SOCKETS_DNS_TIMEOUT=12000
CONFIG_NET_SOCKETS_CONNECT_TIMEOUT=15000
# Wait for the network to be ready
CONFIG_NET_CONNECTION_MANAGER=y
CONFIG_NET_SAMPLE_COMMON_WAIT_DNS_SERVER_ADDITION=y
# Don't require device to have time/date
CONFIG_MBEDTLS_HAVE_TIME_DATE=n
```

## samples/net/cloud/aws_iot_mqtt/boards/qemu_x86.conf
```kconfig
CONFIG_QEMU_ICOUNT=n

# QEMU networking configuration
CONFIG_NET_CONFIG_NEED_IPV6=y
CONFIG_NET_CONFIG_MY_IPV6_ADDR="2001:db8::1"
CONFIG_NET_CONFIG_PEER_IPV6_ADDR="2001:db8::2"
CONFIG_NET_DHCPV4=n
CONFIG_NET_CONFIG_MY_IPV4_ADDR="192.0.2.1"
CONFIG_NET_CONFIG_PEER_IPV4_ADDR="192.0.2.2"
CONFIG_NET_CONFIG_MY_IPV4_GW="192.0.2.2"
```

## samples/net/cloud/aws_iot_mqtt/sample.yaml
```yaml
sample:
  description: MQTT sample app to AWS IoT Core
  name: aws_iot_mqtt
common:
  tags: net mqtt cloud
  harness: net
  filter: TOOLCHAIN_HAS_NEWLIB == 1
  extra_args: USE_DUMMY_CREDS=1
tests:
  sample.net.cloud.aws_iot_mqtt:
    depends_on: netif
    platform_allow: qemu_x86 nucleo_f429zi
    integration_platforms:
      - qemu_x86
```

## samples/net/cloud/aws_mqtt/sample.yaml
```yaml
sample:
  description: MQTT sample app to AWS IoT cloud
  name: aws-mqtt
tests:
  sample.net.cloud.aws_mqtt:
    harness: net
    platform_whitelist: sam_e70_xplained
    tags: net mqtt cloud
```

## samples/net/cloud/google_iot_mqtt/sample.yaml
```yaml
sample:
  description: MQTT sample app to Google IoT cloud
  name: google_iot_mqtt
common:
  tags: net mqtt cloud
  harness: net
  filter: TOOLCHAIN_HAS_NEWLIB == 1
  extra_args: USE_DUMMY_KEY=1
tests:
  sample.net.cloud.google_iot_mqtt:
    depends_on: netif
    platform_allow: frdm_k64f qemu_x86
    integration_platforms:
      - qemu_x86
```

## samples/net/cloud/mqtt_azure/Kconfig
```kconfig
# Private config options for mqtt-azure sample app

# Copyright (c) 2019 Intel Corporation
# SPDX-License-Identifier: Apache-2.0

mainmenu "Networking mqtt-azure sample application"

config SAMPLE_CLOUD_AZURE_USERNAME
	string "Azure cloud username"
	help
	  Username of your Azure account.

config SAMPLE_CLOUD_AZURE_PASSWORD
	string "Azure cloud password"
	help
	  Password of your Azure account.

config SAMPLE_CLOUD_AZURE_CLIENT_ID
	string "Azure cloud IoT hub MQTT client ID"
	help
	  Device ID which you have setup in IoT hub account.

config SAMPLE_CLOUD_AZURE_HOSTNAME
	string "Azure cloud IoT hub hostname"
	help
	  Hostname of your Azure cloud IoT hub.

config SAMPLE_CLOUD_AZURE_SERVER_ADDR
	string "Azure cloud server address"
	help
	  Azure cloud server address.

config SAMPLE_CLOUD_AZURE_SERVER_PORT
	int "Azure cloud server port number"
	default 8883
	help
	  Azure cloud server port number.

config SAMPLE_SOCKS_ADDR
	string "Proxy address"
	depends on SOCKS
	help
	  Provide proxy address if you are running this application
	  behind proxy.

config SAMPLE_SOCKS_PORT
	int "Proxy port"
	depends on SOCKS
	help
	  Provide proxy port if you are running this application
	  behind proxy.

source "Kconfig.zephyr"
```

## samples/net/cloud/mqtt_azure/sample.yaml
```yaml
common:
  filter: CONFIG_FULL_LIBC_SUPPORTED
sample:
  description: MQTT sample app to Azure cloud
  name: mqtt-azure
tests:
  sample.net.cloud.mqtt_azure:
    harness: net
    platform_allow:
      - sam_e70_xplained/same70q21
      - frdm_k64f/mk64f12
      - qemu_x86/atom
    integration_platforms:
      - qemu_x86/atom
    tags:
      - net
      - mqtt
      - cloud
```

## samples/net/cloud/tagoio_http_post/Kconfig
```kconfig
#  Copyright (c) 2020 Gerson Fernando Budke <nandojve@gmail.com>
#  SPDX-License-Identifier: Apache-2.0

mainmenu "TagoIO IoT Cloud Platform (HTTP Post) Client Configuration"

menu "TagoIO IoT Cloud Configuration"

config TAGOIO_MANUAL_SERVER
	bool "Disable DNS lookup"

config TAGOIO_API_SERVER_IP
	string "TagoIO Main Server"
	depends on TAGOIO_MANUAL_SERVER
	default "75.2.65.153"

config TAGOIO_DEVICE_TOKEN
	string "The Device Identification Token"
	default "device_token"

config TAGOIO_HTTP_PUSH_INTERVAL
	int "Configure data push interval in seconds"
	range 1 512
	default 10

config TAGOIO_HTTP_CONN_TIMEOUT
	int "Configure http request timeout in seconds"
	range 1 120
	default 10

if WIFI

config TAGOIO_HTTP_WIFI_SSID
	string "WIFI SSID - Network name"
	default "my_network"

config TAGOIO_HTTP_WIFI_PSK
	string "WIFI PSK - Network password key"
	default "secret_passwd"

endif # WIFI

module = TAGOIO_HTTP_POST
module-str = TagoIO IoT Cloud Platform
module-help = Enables logging for TagoIO IoT Cloud Platform.
source "subsys/logging/Kconfig.template.log_config"

endmenu

source "Kconfig.zephyr"
```

## samples/net/cloud/tagoio_http_post/sample.yaml
```yaml
common:
  tags:
    - net
    - cloud
    - dns
    - http
    - wifi
  min_ram: 64
  harness: net
sample:
  description: TagoIO HTTP(S) client sample
  name: tagoio_http_post
tests:
  sample.net.cloud.tagoio_http_post:
    platform_allow:
      - frdm_k64f
      - nucleo_f767zi
    integration_platforms:
      - frdm_k64f
  sample.net.cloud.tagoio_http_post.wifi:
    extra_args: EXTRA_CONF_FILE="overlay-wifi.conf"
    platform_allow: disco_l475_iot1
  sample.net.cloud.tagoio_http_post.wifi.esp:
    extra_args:
      - SHIELD=esp_8266_arduino
      - EXTRA_CONF_FILE="overlay-wifi.conf"
    platform_allow:
      - frdm_k64f
      - nucleo_f767zi
    integration_platforms:
      - frdm_k64f
```

## samples/net/coap/coap_client/sample.yaml
```yaml
common:
  filter: CONFIG_FULL_LIBC_SUPPORTED and not CONFIG_NATIVE_LIBC
sample:
  description: TBD
  name: TBD
tests:
  sample.net.sockets.coap_client:
    harness: net
    tags:
      - net
      - socket
    platform_allow: qemu_x86
  sample.net.sockets.coap_client.802154.subg:
    extra_args: EXTRA_CONF_FILE="overlay-802154-subg.conf"
    platform_allow: beagleconnect_freedom
  sample.net.sockets.coap_client.oscore:
    harness: net
    extra_args: EXTRA_CONF_FILE="overlay-oscore.conf"
    tags:
      - net
      - socket
      - oscore
    platform_allow:
      - native_sim
      - qemu_x86
  sample.net.sockets.coap_client.oscore.ipv4:
    harness: net
    extra_args: EXTRA_CONF_FILE="overlay-oscore-ipv4.conf"
    tags:
      - net
      - socket
      - oscore
    platform_allow:
      - native_sim
      - qemu_x86
```

## samples/net/coap/coap_server/Kconfig
```kconfig
# Copyright (c) 2023, Emna Rekik
# Copyright (c) 2025, Basalte bv
# SPDX-License-Identifier: Apache-2.0

# Config options for CoAP server sample application

mainmenu "CoAP server sample application"

config NET_SAMPLE_COAPS_SERVICE
	bool "Enable CoAP secure service"
	depends on NET_SOCKETS_ENABLE_DTLS || TLS_CREDENTIALS

config NET_SAMPLE_COAP_SERVER_SERVICE_PORT
	int "Port number for CoAP service"
	default 5684 if NET_SAMPLE_COAPS_SERVICE
	default 5683

if NET_SAMPLE_COAPS_SERVICE

config NET_SAMPLE_PSK_HEADER_FILE
	string "Header file containing PSK"
	default "dummy_psk.h"
	depends on MBEDTLS_KEY_EXCHANGE_PSK_ENABLED
	help
	  Name of a header file containing a pre-shared key.

config NET_SAMPLE_CERTS_WITH_SC
	bool "Signed Certificates"
	depends on NET_SOCKETS_SOCKOPT_TLS
	help
	  Enable this flag, if you are interested to run this
	  application with certificates.

endif

source "Kconfig.zephyr"
```

## samples/net/coap/coap_upload/sample.yaml
```yaml
sample:
  description: CoAP client upload example
  name: socket_coap_upload
common:
  harness: net
  depends_on: netif
  tags:
    - net
    - coap
tests:
  sample.net.sockets.coap_upload:
    platform_allow:
      - native_sim
      - qemu_x86
```

## samples/net/coap_client/sample.yaml
```yaml
sample:
  description: TBD
  name: TBD
tests:
  test:
    harness: net
    platform_whitelist: qemu_x86 native_posix
    tags: net coap
```

## samples/net/coap_server/sample.yaml
```yaml
sample:
  description: TBD
  name: TBD
tests:
  test:
    arch_whitelist: x86
    harness: net
    tags: net
  test_bt:
    harness: net
    extra_args: CONF_FILE="prj_bt.conf"
    platform_whitelist: qemu_x86
    tags: net bluetooth
  test_net:
    harness: net
    extra_args: CONF_FILE="prj_cc2520.conf"
    platform_whitelist: quark_se_c1000_devboard
    tags: net
```

## samples/net/coaps_client/sample.yaml
```yaml
sample:
  name: COAP Client with DTLS
tests:
  test:
    harness: net
    depends_on: netif
    tags: net coap dtls
```
