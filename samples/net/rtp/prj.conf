## CMakeLists.txt
```
# SPDX-License-Identifier: Apache-2.0

cmake_minimum_required(VERSION 3.28.0)
find_package(Zephyr REQUIRED HINTS $ENV{ZEPHYR_BASE})
project(rtp)

target_sources(app PRIVATE src/main.c)

include(${ZEPHYR_BASE}/samples/net/common/common.cmake)
```

## Kconfig
```
# SPDX-FileCopyrightText: 2026 Basalte bv
# SPDX-License-Identifier: Apache-2.0

choice RTP_SAMPLE_ROLE
	prompt "RTP Sample Role"

config RTP_SAMPLE_ROLE_SINK
	bool "RTP Sample Role Sink"
	help
	  Build the RTP sample as a sink

config RTP_SAMPLE_ROLE_SOURCE
	bool "RTP Sample Role Source"
	help
	  Build the RTP sample as a source

endchoice

config RTP_SAMPLE_IPV6
	bool "Use IPv6 for the RTP session"
	depends on NET_IPV6
	help
	  Join the RTP multicast group over IPv6 instead of IPv4.

source "Kconfig.zephyr"
```

## prj.conf
```kconfig
CONFIG_LOG=y
CONFIG_MAIN_STACK_SIZE=4096

CONFIG_NETWORKING=y
CONFIG_NET_L2_ETHERNET=y
CONFIG_NET_IPV4=y
CONFIG_NET_IPV6=n
CONFIG_NET_TCP=n
CONFIG_NET_UDP=y
CONFIG_NET_DHCPV4=n
CONFIG_NET_CONFIG_SETTINGS=y
CONFIG_NET_IPV4_IGMP=y

CONFIG_NET_CONFIG_SETTINGS=y
CONFIG_NET_CONFIG_MY_IPV4_ADDR="192.0.2.1"
CONFIG_NET_CONFIG_MY_IPV4_NETMASK="255.255.255.0"

CONFIG_ZVFS_POLL_MAX=5
CONFIG_NET_RX_STACK_SIZE=4096

CONFIG_RTP=y

CONFIG_NET_LOG=y
CONFIG_RTP_LOG_LEVEL_DBG=y

CONFIG_NET_BUF_DATA_SIZE=1500
```

## ipv6.conf
```kconfig
CONFIG_NET_IPV6=y
CONFIG_RTP_SAMPLE_IPV6=y
```

## net_pkt.conf
```kconfig
CONFIG_RTP_TRANSPORT_NET_PKT=y
CONFIG_RTP_TRANSPORT_SOCKET=n
```

## sink.conf
```kconfig
CONFIG_RTP_SAMPLE_ROLE_SINK=y

CONFIG_NET_SOCKETS_SERVICE_STACK_SIZE=4096

CONFIG_NET_CONFIG_MY_IPV4_ADDR="192.0.2.101"
CONFIG_NET_CONFIG_MY_IPV4_NETMASK="255.255.255.0"
```

## source.conf
```kconfig
CONFIG_RTP_SAMPLE_ROLE_SOURCE=y

CONFIG_NET_CONFIG_MY_IPV4_ADDR="192.0.2.102"
CONFIG_NET_CONFIG_MY_IPV4_NETMASK="255.255.255.0"
```

## srtp.conf
```kconfig
CONFIG_SRTP=y
CONFIG_ENTROPY_GENERATOR=y
```

## src/main.c
```c
/*
 *  SPDX-FileCopyrightText: 2026 Basalte bv
 *
 *  SPDX-License-Identifier: Apache-2.0
 */

#include <zephyr/kernel.h>
#include <zephyr/net/rtp.h>
#include <zephyr/logging/log.h>
#include <zephyr/sys/util_macro.h>

#include <zephyr/net/conn_mgr_monitor.h>
#include "net_sample_common.h"
#ifdef CONFIG_RTP_SAMPLE_ROLE_SOURCE
#include "sine.h"
#endif
#ifdef CONFIG_SRTP
#include <zephyr/net/srtp.h>
#endif

LOG_MODULE_REGISTER(main);

#if defined(CONFIG_RTP_TRANSPORT_NET_PKT)
#define TRANSPORT_TYPE RTP_TRANSPORT_NET_PKT
#elif defined(CONFIG_RTP_TRANSPORT_SOCKET)
#define TRANSPORT_TYPE RTP_TRANSPORT_SOCKET
#endif

#define MCAST_ADDR  "239.0.1.1"
#define MCAST_ADDR6 "ff02::5004"
#define MCAST_PORT  5004

static RTP_SESSION_DEFINE(my_rtp_session, 0);

#ifdef CONFIG_SRTP
/* Static demonstration key material; real applications must provision master
 * keys over a secure channel (e.g. DTLS-SRTP, SDES over TLS).
 */
/* clang-format off */
static const uint8_t srtp_master_key[SRTP_AES_128_KEY_LEN] = {
	0x10, 0x11, 0x12, 0x13, 0x14, 0x15, 0x16, 0x17,
	0x18, 0x19, 0x1a, 0x1b, 0x1c, 0x1d, 0x1e, 0x1f,
};
static const uint8_t srtp_master_salt[SRTP_MASTER_SALT_LEN] = {
	0x30, 0x31, 0x32, 0x33, 0x34, 0x35, 0x36, 0x37,
	0x38, 0x39, 0x3a, 0x3b, 0x3c, 0x3d,
};
/* clang-format on */
static struct srtp_session_ctx srtp_ctx;

static int session_enable_srtp(struct rtp_session *session)
{
	const struct srtp_policy policy = {
		.cipher = SRTP_CIPHER_AES_128_CM,
		.auth = SRTP_AUTH_HMAC_SHA1_80,
		.master_key = srtp_master_key,
		.master_key_len = sizeof(srtp_master_key),
		.master_salt = srtp_master_salt,
		.master_salt_len = sizeof(srtp_master_salt),
	};

	return rtp_session_set_srtp(session, &policy, &policy, &srtp_ctx);
}
#endif /* CONFIG_SRTP */

#ifdef CONFIG_RTP_SAMPLE_ROLE_SINK
static uint32_t n_received;

static void timeout_worker(struct k_work *work)
{
	ARG_UNUSED(work);

	n_received = 0;
	LOG_WRN("Timeout occurred");
}

K_WORK_DELAYABLE_DEFINE(timeout_work, timeout_worker);

static void my_rtp_session_recv_cb(struct rtp_session *session, struct rtp_packet *packet,
				   void *user_data)
{
	ARG_UNUSED(session);
	ARG_UNUSED(packet);
	ARG_UNUSED(user_data);

	if (n_received++ == 0) {
		LOG_INF("Start receiving");
	} else if (n_received % 100 == 0) {
		LOG_INF("Received %u packets", n_received);
	}

	k_work_reschedule(&timeout_work, K_MSEC(500));
}

static void rtp_sink(struct rtp_session *session, struct net_sockaddr *sockaddress)
{
	int ret;

	ret = rtp_session_init_rx(session, net_if_get_default(), sockaddress,
				  my_rtp_session_recv_cb, NULL, TRANSPORT_TYPE);
	if (ret < 0) {
		LOG_ERR("Failed to init rtp session (%d)", ret);
		return;
	}

#ifdef CONFIG_SRTP
	ret = session_enable_srtp(session);
	if (ret < 0) {
		LOG_ERR("Failed to enable SRTP (%d)", ret);
		return;
	}
#endif /* CONFIG_SRTP */

	n_received = 0;
	ret = rtp_session_start(session);
	if (ret < 0) {
		LOG_ERR("Failed to start rtp session (%d)", ret);
		return;
	}
}
#endif /* CONFIG_RTP_SAMPLE_ROLE_SINK */

#ifdef CONFIG_RTP_SAMPLE_ROLE_SOURCE
#define PAYLOAD_TYPE 97

static void rtp_source(struct rtp_session *session, struct net_sockaddr *sockaddress)
{
	int64_t deadline_ms;
	void *payload;
	int period_ms;
	int delta_ts;
	size_t size;
	int ret;

	ret = rtp_session_init_tx(session, net_if_get_default(), sockaddress, PAYLOAD_TYPE,
				  TRANSPORT_TYPE);
	if (ret < 0) {
		LOG_ERR("Failed to init rtp session (%d)", ret);
		return;
	}

#ifdef CONFIG_SRTP
	ret = session_enable_srtp(session);
	if (ret < 0) {
		LOG_ERR("Failed to enable SRTP (%d)", ret);
		return;
	}
#endif /* CONFIG_SRTP */

	ret = rtp_session_start(session);
	if (ret < 0) {
		LOG_ERR("Failed to start rtp session (%d)", ret);
		return;
	}

	ARRAY_FOR_EACH(sine_100_8000_16_mono, i) {
		sine_100_8000_16_mono[i] = sys_cpu_to_be16(sine_100_8000_16_mono[i]);
	}
	payload = (void *)sine_100_8000_16_mono;
	size = sizeof(sine_100_8000_16_mono);
	period_ms = 50;
	delta_ts = size / sizeof(uint16_t);

	LOG_INF("Start sending RTP packets");
	deadline_ms = k_uptime_get();
	while (true) {
		ret = rtp_session_send_simple(session, payload, size, delta_ts);
		if (ret < 0) {
			LOG_ERR("Failed to send rtp (%d)", ret);
			return;
		}

		/* Sleep until an absolute deadline so the stream keeps real time */
		deadline_ms += period_ms;
		k_sleep(K_TIMEOUT_ABS_MS(deadline_ms));
	}
}
#endif /* CONFIG_RTP_SAMPLE_ROLE_SOURCE */

int main(void)
{
	struct net_sockaddr_storage sockaddress = {};

#if defined(CONFIG_RTP_SAMPLE_ROLE_SINK)
	LOG_INF("RTP sink on %s", CONFIG_BOARD);
#elif defined(CONFIG_RTP_SAMPLE_ROLE_SOURCE)
	LOG_INF("RTP source on %s", CONFIG_BOARD);
#endif

	LOG_INF("Waiting for network...");
	(void)conn_mgr_wait_ready(IS_ENABLED(CONFIG_RTP_SAMPLE_IPV6) ? CONN_MGR_READY_IPV6
								    : CONN_MGR_READY_IPV4,
				  NULL, K_FOREVER);
	LOG_INF("Network ready");

	if (IS_ENABLED(CONFIG_RTP_SAMPLE_IPV6)) {
		struct net_sockaddr_in6 *sockaddress_in6 = net_sin6(net_sad(&sockaddress));
		struct net_in6_addr in6_address;

		if (net_addr_pton(NET_AF_INET6, MCAST_ADDR6, &in6_address) != 0) {
			LOG_ERR("Invalid address: %s", MCAST_ADDR6);
			return -EINVAL;
		}

		sockaddress_in6->sin6_family = NET_AF_INET6;
		sockaddress_in6->sin6_addr = in6_address;
		sockaddress_in6->sin6_port = net_htons(MCAST_PORT);
	} else {
		struct net_sockaddr_in *sockaddress_in = net_sin(net_sad(&sockaddress));
		struct net_in_addr in_address;

		if (net_addr_pton(NET_AF_INET, MCAST_ADDR, &in_address) != 0) {
			LOG_ERR("Invalid address: %s", MCAST_ADDR);
			return -EINVAL;
		}

		sockaddress_in->sin_family = NET_AF_INET;
		sockaddress_in->sin_addr = in_address;
		sockaddress_in->sin_port = net_htons(MCAST_PORT);
	}

#if defined(CONFIG_RTP_SAMPLE_ROLE_SINK)
	rtp_sink(&my_rtp_session, net_sad(&sockaddress));
#elif defined(CONFIG_RTP_SAMPLE_ROLE_SOURCE)
	rtp_source(&my_rtp_session, net_sad(&sockaddress));
#endif

	return 0;
}
```

## src/sine.h
```c
/*
 *  SPDX-FileCopyrightText: 2026 Basalte bv
 *
 *  SPDX-License-Identifier: Apache-2.0
 */

#ifndef RTP_TRANSMIT_SINE_H_
#define RTP_TRANSMIT_SINE_H_

#include <zephyr/kernel.h>

/** 100Hz @ 8000samples/s mono 16bit (400 samples, 800 bytes) */
static int16_t sine_100_8000_16_mono[] = {
	0,      2570,   5125,   7649,   10125,  12539,  14875,  17120,  19259,  21280,  23169,
	24916,  26509,  27938,  29195,  30272,  31163,  31861,  32363,  32665,  32767,  32665,
	32363,  31861,  31163,  30272,  29195,  27938,  26509,  24916,  23169,  21280,  19259,
	17120,  14875,  12539,  10125,  7649,   5125,   2570,   0,      -2570,  -5125,  -7649,
	-10125, -12539, -14875, -17120, -19259, -21280, -23169, -24916, -26509, -27938, -29195,
	-30272, -31163, -31861, -32363, -32665, -32767, -32665, -32363, -31861, -31163, -30272,
	-29195, -27938, -26509, -24916, -23169, -21280, -19259, -17120, -14875, -12539, -10125,
	-7649,  -5125,  -2570,  0,      2570,   5125,   7649,   10125,  12539,  14875,  17120,
	19259,  21280,  23169,  24916,  26509,  27938,  29195,  30272,  31163,  31861,  32363,
	32665,  32767,  32665,  32363,  31861,  31163,  30272,  29195,  27938,  26509,  24916,
	23169,  21280,  19259,  17120,  14875,  12539,  10125,  7649,   5125,   2570,   0,
	-2570,  -5125,  -7649,  -10125, -12539, -14875, -17120, -19259, -21280, -23169, -24916,
	-26509, -27938, -29195, -30272, -31163, -31861, -32363, -32665, -32767, -32665, -32363,
	-31861, -31163, -30272, -29195, -27938, -26509, -24916, -23169, -21280, -19259, -17120,
	-14875, -12539, -10125, -7649,  -5125,  -2570,  0,      2570,   5125,   7649,   10125,
	12539,  14875,  17120,  19259,  21280,  23169,  24916,  26509,  27938,  29195,  30272,
	31163,  31861,  32363,  32665,  32767,  32665,  32363,  31861,  31163,  30272,  29195,
	27938,  26509,  24916,  23169,  21280,  19259,  17120,  14875,  12539,  10125,  7649,
	5125,   2570,   0,      -2570,  -5125,  -7649,  -10125, -12539, -14875, -17120, -19259,
	-21280, -23169, -24916, -26509, -27938, -29195, -30272, -31163, -31861, -32363, -32665,
	-32767, -32665, -32363, -31861, -31163, -30272, -29195, -27938, -26509, -24916, -23169,
	-21280, -19259, -17120, -14875, -12539, -10125, -7649,  -5125,  -2570,  0,      2570,
	5125,   7649,   10125,  12539,  14875,  17120,  19259,  21280,  23169,  24916,  26509,
	27938,  29195,  30272,  31163,  31861,  32363,  32665,  32767,  32665,  32363,  31861,
	31163,  30272,  29195,  27938,  26509,  24916,  23169,  21280,  19259,  17120,  14875,
	12539,  10125,  7649,   5125,   2570,   0,      -2570,  -5125,  -7649,  -10125, -12539,
	-14875, -17120, -19259, -21280, -23169, -24916, -26509, -27938, -29195, -30272, -31163,
	-31861, -32363, -32665, -32767, -32665, -32363, -31861, -31163, -30272, -29195, -27938,
	-26509, -24916, -23169, -21280, -19259, -17120, -14875, -12539, -10125, -7649,  -5125,
	-2570,  0,      2570,   5125,   7649,   10125,  12539,  14875,  17120,  19259,  21280,
	23169,  24916,  26509,  27938,  29195,  30272,  31163,  31861,  32363,  32665,  32767,
	32665,  32363,  31861,  31163,  30272,  29195,  27938,  26509,  24916,  23169,  21280,
	19259,  17120,  14875,  12539,  10125,  7649,   5125,   2570,   0,      -2570,  -5125,
	-7649,  -10125, -12539, -14875, -17120, -19259, -21280, -23169, -24916, -26509, -27938,
	-29195, -30272, -31163, -31861, -32363, -32665, -32767, -32665, -32363, -31861, -31163,
	-30272, -29195, -27938, -26509, -24916, -23169, -21280, -19259, -17120, -14875, -12539,
	-10125, -7649,  -5125,  -2570};

#endif /* RTP_TRANSMIT_SINE_H_ */
```
