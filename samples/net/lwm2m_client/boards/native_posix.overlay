/*
 * Copyright (c) 2019 Jan Van Winkel <jan.van_winkel@dxplore.eu>
 *
 * SPDX-License-Identifier: Apache-2.0
 */

&flash0 {

	partitions {
		compatible = "fixed-partitions";
		#address-cells = <1>;
		#size-cells = <1>;

		lwm2m_notif_storage: partition@100000 {
			label = "lwm2m_notif_storage";
			reg = <0x00100000 0x10000>;
		};
	};
};
