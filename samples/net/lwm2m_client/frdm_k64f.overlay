/*
 * Copyright (c) 2018 Intel Corporation
 *
 * SPDX-License-Identifier: Apache-2.0
 */
&uart2 {
	current-speed = <115200>;
	hw-flow-control;
	status = "ok";

	wncm14a2a {
		compatible = "wnc,m14a2a";
		label = "wncm14a2a";
		mdm-boot-mode-sel-gpios = <&gpioc 17 0>;
		mdm-power-gpios = <&gpiob 9 0>;
		mdm-keep-awake-gpios = <&gpioc 2 0>;
		mdm-reset-gpios = <&gpioc 12 0>;
		mdm-shld-trans-ena-gpios = <&gpioc 4 0>;
		status = "ok";
	};
};
