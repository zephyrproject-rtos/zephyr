/*
 * Copyright (c) 2018 Linaro Limited
 *
 * SPDX-License-Identifier: Apache-2.0
 */

&uart1 {
	current-speed = <115200>;
	status = "ok";
	tx-pin = <16>;
	rx-pin = <15>;
	rts-pin = <14>;
	cts-pin = <17>;

	wncm14a2a {
		compatible = "wnc,m14a2a";
		label = "wncm14a2a";
		mdm-boot-mode-sel-gpios = <&gpio1 2 0>;
		mdm-power-gpios = <&gpio1 3 0>;
		mdm-keep-awake-gpios = <&gpio1 7 0>;
		mdm-reset-gpios = <&gpio1 10 0>;
		mdm-shld-trans-ena-gpios = <&gpio1 11 0>;
		status = "ok";
	};
};
