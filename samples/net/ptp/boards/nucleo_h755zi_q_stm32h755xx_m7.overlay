/*
 * SPDX-FileCopyrightText: Copyright The Zephyr Project Contributors
 *
 * SPDX-License-Identifier: Apache-2.0
 */

/* SPI1 MOSI shares PB5. */
&spi1 {
	status = "disabled";
};

&ptp_clock {
	pinctrl-0 = <&eth_pps_out_pb5>;
	pinctrl-names = "default";
};
