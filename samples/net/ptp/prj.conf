## CMakeLists.txt
```
# SPDX-License-Identifier: Apache-2.0

cmake_minimum_required(VERSION 3.28.0)

find_package(Zephyr REQUIRED HINTS $ENV{ZEPHYR_BASE})

target_include_directories(app PRIVATE ${ZEPHYR_BASE}/subsys/net/lib)

project(ptp)
target_sources(app PRIVATE src/main.c)
```

## Kconfig
```
# Private config options for PTP sample app

# Copyright (c) 2024 BayLibre SAS
# SPDX-License-Identifier: Apache-2.0

mainmenu "PTP sample application"

if PTP

config NET_SAMPLE_RUN_DURATION
	int "Run the application this many seconds"
	default 0
	help
	  A value of zero means that the sample application is run forever.

endif

source "Kconfig.zephyr"
```

## sample.yaml
```
common:
  harness: net
  tags:
    - net
    - ptp
sample:
  description: Test PTP functionality
  name: PTP sample app
tests:
  sample.net.ptp:
    platform_allow:
      - native_sim
      - native_sim/native/64
      - nucleo_h563zi
      - nucleo_h743zi
      - nucleo_h753zi
      - nucleo_h745zi_q/stm32h745xx/m7
      - qemu_x86
    depends_on: eth
    integration_platforms:
      - nucleo_h563zi
```

## prj.conf
```kconfig
CONFIG_NETWORKING=y
CONFIG_NET_LOG=y
CONFIG_LOG=y
CONFIG_NET_IPV4=y
CONFIG_NET_IPV6=n
CONFIG_NET_DHCPV4=n
CONFIG_NET_UDP=y

CONFIG_TEST_RANDOM_GENERATOR=y

CONFIG_NET_PKT_RX_COUNT=32
CONFIG_NET_PKT_TX_COUNT=32
CONFIG_NET_BUF_RX_COUNT=32
CONFIG_NET_BUF_TX_COUNT=32
CONFIG_NET_MAX_CONTEXTS=10

CONFIG_INIT_STACKS=y
CONFIG_PRINTK=y
CONFIG_NET_SHELL=y
CONFIG_LOG_MODE_DEFERRED=y

# Ethernet is needed for PTP
CONFIG_ETH_DRIVER=y

CONFIG_NET_CONFIG_NEED_IPV4=y
CONFIG_NET_CONFIG_SETTINGS=y

# First ethernet interface will use these settings
CONFIG_NET_CONFIG_MY_IPV4_ADDR="192.0.2.1"
CONFIG_NET_CONFIG_PEER_IPV4_ADDR="192.0.2.2"

# PTP settings
CONFIG_PTP_CLOCK=y
CONFIG_PTP=y
CONFIG_PTP_ANNOUNCE_RECV_TIMEOUT=5
CONFIG_PTP_LOG_LEVEL_DBG=y
CONFIG_PTP_DSCP_HIGH_PRIORITY=y
CONFIG_PTP_NETWORK_MODE_HYBRID=y
CONFIG_PTP_SYSTEM_CLOCK_SYNC=y

# Timestamp log messages with the PTP synchronized system clock
CONFIG_LOG_TIMESTAMP_USE_REALTIME=y
CONFIG_POSIX_C_LANG_SUPPORT_R=y
CONFIG_LOG_OUTPUT_FORMAT_DATE_TIMESTAMP=y

# PTP sample settings
CONFIG_NET_SHELL_PTP_SUPPORTED=y
CONFIG_PTP_CLOCK_SHELL=y
CONFIG_NET_SAMPLE_RUN_DURATION=0
```

## boards/native_sim.conf
```kconfig
# Assume 1 ms accuracy for native_sim simulated clock
CONFIG_PTP_CLOCK_ACCURACY_1MS=y
```

## boards/native_sim_native_64.conf
```kconfig
# Settings for native_sim / native_tap ethernet driver
#CONFIG_ETH_NATIVE_TAP_RANDOM_MAC=y
CONFIG_ETH_NATIVE_TAP_MAC_ADDR="00:00:5e:00:53:2a"

# Assume 1 ms accuracy for native_sim simulated clock
CONFIG_PTP_CLOCK_ACCURACY_1MS=y
```

## boards/nucleo_c5a3zg.overlay
```dts
/*
 * SPDX-FileCopyrightText: Copyright The Zephyr Project Contributors
 *
 * SPDX-License-Identifier: Apache-2.0
 */

/* SPI1 chip select shares PB5. */
&spi1 {
	status = "disabled";
};

&ptp_clock {
	pinctrl-0 = <&eth1_pps_out_pb5>;
	pinctrl-names = "default";
};
```

## boards/nucleo_f207zg.overlay
```dts
/*
 * SPDX-FileCopyrightText: Copyright The Zephyr Project Contributors
 *
 * SPDX-License-Identifier: Apache-2.0
 */

/* CAN2 RX shares PB5. */
&can2 {
	status = "disabled";
};

&ptp_clock {
	pinctrl-0 = <&eth_pps_out_pb5>;
	pinctrl-names = "default";
};
```

## boards/nucleo_f756zg.overlay
```dts
/*
 * SPDX-FileCopyrightText: Copyright The Zephyr Project Contributors
 *
 * SPDX-License-Identifier: Apache-2.0
 */

&ptp_clock {
	pinctrl-0 = <&eth_pps_out_pb5>;
	pinctrl-names = "default";
};
```

## boards/nucleo_h755zi_q_stm32h755xx_m7.overlay
```dts
/*
 * SPDX-FileCopyrightText: Copyright The Zephyr Project Contributors
 *
 * SPDX-License-Identifier: Apache-2.0
 */

/* SPI1 MOSI shares PB5. */
&spi1 {
	status = "disabled";
};

&ptp_clock {
	pinctrl-0 = <&eth_pps_out_pb5>;
	pinctrl-names = "default";
};
```

## boards/stm32h573i_dk.overlay
```dts
/*
 * SPDX-FileCopyrightText: Copyright The Zephyr Project Contributors
 *
 * SPDX-License-Identifier: Apache-2.0
 */

/* TIM3 channel 2 shares PB5. */
&pwm3 {
	status = "disabled";
};

&ptp_clock {
	pinctrl-0 = <&eth_pps_out_pb5>;
	pinctrl-names = "default";
};
```

## boards/stm32mp135f_dk.overlay
```dts
/*
 * SPDX-FileCopyrightText: Copyright The Zephyr Project Contributors
 *
 * SPDX-License-Identifier: Apache-2.0
 */

&ptp_clock0 {
	pinctrl-0 = <&eth1_pps_out_pa4>;
	pinctrl-names = "default";
};

&ptp_clock1 {
	pinctrl-0 = <&eth2_pps_out_pa5>;
	pinctrl-names = "default";
};
```

## src/main.c
```c
/*
 * Copyright (c) 2024 BayLibre SAS
 * Copyright (c) 2026 Philipp Steiner
 *
 * SPDX-License-Identifier: Apache-2.0
 */

#include <zephyr/logging/log.h>
LOG_MODULE_REGISTER(net_ptp_sample, LOG_LEVEL_DBG);

#include <zephyr/kernel.h>

#include <errno.h>
#include <stdlib.h>

#include "ptp/clock.h"
#include "ptp/port.h"

static int run_duration = CONFIG_NET_SAMPLE_RUN_DURATION;
static struct k_work_delayable stop_sample;
static struct k_sem quit_lock;

static void stop_handler(struct k_work *work)
{
	ARG_UNUSED(work);

	k_sem_give(&quit_lock);
}

static int get_current_status(void)
{
	struct ptp_port *port;
	sys_slist_t *ports_list = ptp_clock_ports_list();

	if (!ports_list || sys_slist_len(ports_list) == 0) {
		return -EINVAL;
	}

	port = CONTAINER_OF(sys_slist_peek_head(ports_list), struct ptp_port, node);

	if (!port) {
		return -EINVAL;
	}

	switch (ptp_port_state(port)) {
	case PTP_PS_INITIALIZING:
	case PTP_PS_FAULTY:
	case PTP_PS_DISABLED:
	case PTP_PS_LISTENING:
	case PTP_PS_PRE_TIME_TRANSMITTER:
	case PTP_PS_PASSIVE:
	case PTP_PS_UNCALIBRATED:
		LOG_INF("FAIL");
		return 0;
	case PTP_PS_TIME_RECEIVER:
		LOG_INF("TIME RECEIVER");
		return 2;
	case PTP_PS_TIME_TRANSMITTER:
	case PTP_PS_GRAND_MASTER:
		LOG_INF("TIME TRANSMITTER");
		return 1;
	}

	return -1;
}

void init_testing(void)
{
	uint32_t uptime = k_uptime_get_32();
	int ret;

	if (run_duration == 0) {
		LOG_INF("Runs forever");
		return;
	}

	LOG_INF("Stopping after %u seconds", run_duration);

	k_sem_init(&quit_lock, 0, K_SEM_MAX_LIMIT);

	k_work_init_delayable(&stop_sample, stop_handler);
	k_work_reschedule(&stop_sample, K_SECONDS(run_duration));

	k_sem_take(&quit_lock, K_FOREVER);

	LOG_INF("Stopped after %u seconds", (k_uptime_get_32() - uptime) / 1000);

	/* Try to figure out what is the sync state.
	 * Return:
	 *  <0 - configuration error
	 *   0 - not time sync
	 *   1 - we are TimeTransmitter
	 *   2 - we are TimeReceiver
	 */
	ret = get_current_status();

	/* sleep gives deferred logs time to flush */
	k_msleep(2000);
	exit(ret);
}

int main(void)
{
	init_testing();
	return 0;
}
```
