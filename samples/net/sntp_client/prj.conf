## CMakeLists.txt
```
cmake_minimum_required(VERSION 3.13.1)
include($ENV{ZEPHYR_BASE}/cmake/app/boilerplate.cmake NO_POLICY_SCOPE)
project(sntp_client)

FILE(GLOB app_sources src/*.c)
target_sources(app PRIVATE ${app_sources})
```

## sample.yaml
```
sample:
  description: SNTP client sample
  name: sntp_client
tests:
  test:
    harness: net
    platform_whitelist: qemu_x86
    tags: net
```

## prj.conf
```kconfig
# General config
CONFIG_NEWLIB_LIBC=y

# Networking config
CONFIG_NETWORKING=y
CONFIG_NET_IPV4=y
CONFIG_NET_IPV6=y
CONFIG_NET_UDP=y
CONFIG_NET_SHELL=y

# Network driver config
CONFIG_TEST_RANDOM_GENERATOR=y

# Network address config
CONFIG_NET_CONFIG_SETTINGS=y
CONFIG_NET_CONFIG_NEED_IPV4=y
CONFIG_NET_CONFIG_NEED_IPV6=y
CONFIG_NET_CONFIG_MY_IPV4_ADDR="192.0.2.1"
CONFIG_NET_CONFIG_PEER_IPV4_ADDR="192.0.2.2"
CONFIG_NET_CONFIG_MY_IPV6_ADDR="2001:db8::1"
CONFIG_NET_CONFIG_PEER_IPV6_ADDR="2001:db8::2"

# Network debug config
CONFIG_NET_LOG=y
CONFIG_LOG=y

# SNTP
CONFIG_SNTP=y
```

## src/main.c
```c
/*
 * Copyright (c) 2017 Linaro Limited
 *
 * SPDX-License-Identifier: Apache-2.0
 */

#include <logging/log.h>
LOG_MODULE_REGISTER(net_sntp_client_sample, LOG_LEVEL_DBG);

#include <zephyr.h>
#include <misc/printk.h>
#include <net/sntp.h>

#define SNTP_PORT 123

void resp_callback(struct sntp_ctx *ctx,
		   int status,
		   u64_t epoch_time,
		   void *user_data)
{
	printk("time: %lld\n", epoch_time);
	printk("status: %d\n", status);
	printk("user_data: %p\n", user_data);
}

void main(void)
{
	struct sntp_ctx ctx;
	int rv;

	/* ipv4 */
	rv = sntp_init(&ctx,
		       CONFIG_NET_CONFIG_PEER_IPV4_ADDR,
		       SNTP_PORT,
		       K_FOREVER);
	if (rv < 0) {
		printk("Failed to init sntp ctx: %d\n", rv);
		goto end;
	}

	rv = sntp_request(&ctx, K_FOREVER, resp_callback, NULL);
	if (rv < 0) {
		printk("Failed to send sntp request: %d\n", rv);
		goto end;
	}

	sntp_close(&ctx);

	/* ipv6 */
	rv = sntp_init(&ctx,
		       CONFIG_NET_CONFIG_PEER_IPV6_ADDR,
		       SNTP_PORT,
		       K_NO_WAIT);
	if (rv < 0) {
		printk("Failed to initi sntp ctx: %d\n", rv);
		goto end;
	}

	rv = sntp_request(&ctx, K_NO_WAIT, resp_callback, NULL);
	if (rv < 0) {
		printk("Failed to send sntp request: %d\n", rv);
		goto end;
	}

end:
	sntp_close(&ctx);
}
```
