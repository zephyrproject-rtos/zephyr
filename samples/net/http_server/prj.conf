## CMakeLists.txt
```
cmake_minimum_required(VERSION 3.13.1)
include($ENV{ZEPHYR_BASE}/cmake/app/boilerplate.cmake NO_POLICY_SCOPE)
project(http_server)

FILE(GLOB app_sources src/*.c)
target_sources(app PRIVATE ${app_sources})

include($ENV{ZEPHYR_BASE}/samples/net/common/common.cmake)

# List of files that are used to generate .h file that can be included
# into .c file.
foreach(inc_file
	echo-apps-cert.der
	echo-apps-key.der
	index.html
    )
  generate_inc_file_for_target(
    app
    src/${inc_file}
    ${ZEPHYR_BINARY_DIR}/include/generated/${inc_file}.inc
    )
endforeach()
```

## sample.yaml
```
sample:
  name: HTTP Server
tests:
  test:
    harness: net
    depends_on: netif
    tags: net http
    min_flash: 140
  test_bt:
    harness: net
    extra_args: CONF_FILE="prj_bt.conf"
    platform_whitelist: qemu_x86
    tags: net http
  test_usbnet_ecm:
    harness: net
    extra_args: OVERLAY_CONFIG="overlay-netusb.conf"
    tags: net usb
    depends_on: usb_device
    min_ram: 64
  test_usbnet_eem:
    harness: net
    extra_args: OVERLAY_CONFIG="overlay-netusb.conf"
    extra_configs:
      - CONFIG_USB_DEVICE_NETWORK_ECM=n
      - CONFIG_USB_DEVICE_NETWORK_EEM=y
    tags: net usb
    depends_on: usb_device
    min_ram: 64
```

## prj.conf
```kconfig
CONFIG_NETWORKING=y
CONFIG_NET_TCP=y
CONFIG_ENTROPY_GENERATOR=y
CONFIG_TEST_RANDOM_GENERATOR=y
CONFIG_NET_LOG=y
CONFIG_LOG=y
CONFIG_INIT_STACKS=y

CONFIG_NET_PKT_RX_COUNT=32
CONFIG_NET_PKT_TX_COUNT=32
CONFIG_NET_BUF_RX_COUNT=32
CONFIG_NET_BUF_TX_COUNT=32

CONFIG_NET_IF_UNICAST_IPV6_ADDR_COUNT=2
CONFIG_NET_IF_MCAST_IPV6_ADDR_COUNT=4

CONFIG_NET_MAX_CONTEXTS=16

CONFIG_HTTP=y
CONFIG_HTTP_SERVER=y
# Allow two concurrent connections
CONFIG_NET_TCP_BACKLOG_SIZE=2
CONFIG_NET_APP_SERVER_NUM_CONN=2

CONFIG_NET_IPV6=y
CONFIG_NET_IPV4=y
#CONFIG_NET_DHCPV4=y

CONFIG_HTTPS=n
CONFIG_MBEDTLS=n

CONFIG_NET_CONFIG_SETTINGS=y
CONFIG_NET_CONFIG_MY_IPV6_ADDR="2001:db8::1"
CONFIG_NET_CONFIG_MY_IPV4_ADDR="192.0.2.1"

CONFIG_NET_CONFIG_NEED_IPV6=y
CONFIG_NET_CONFIG_NEED_IPV4=y

CONFIG_NET_SHELL=y
CONFIG_NET_STATISTICS=y

CONFIG_NET_MGMT=y
CONFIG_NET_MGMT_EVENT=y
```

## overlay-netusb.conf
```kconfig
# USB Device settings
CONFIG_USB=y
CONFIG_USB_DEVICE_STACK=y

# Select USB Configurations
CONFIG_USB_DEVICE_NETWORK_ECM=y

# Logging
CONFIG_USB_DRIVER_LOG_LEVEL_INF=y
CONFIG_USB_DEVICE_LOG_LEVEL_INF=y

# Zero Configuration
# Remove hardcoded addresses
CONFIG_NET_CONFIG_SETTINGS=n

CONFIG_NET_IF_MCAST_IPV4_ADDR_COUNT=2
CONFIG_NET_IPV4_AUTO=y
CONFIG_NET_HOSTNAME_ENABLE=y
CONFIG_DNS_RESOLVER=y
CONFIG_LLMNR_RESOLVER=y
CONFIG_LLMNR_RESPONDER=y

# Reduce image size
CONFIG_NET_STATISTICS=n
CONFIG_NET_CONFIG_NEED_IPV6=n
CONFIG_NET_IPV6=n
```

## prj_arduino_101.conf
```kconfig
CONFIG_NETWORKING=y
CONFIG_NET_TCP=y
CONFIG_RANDOM_GENERATOR=y
CONFIG_NET_ARP=y
CONFIG_NET_L2_ETHERNET=y
CONFIG_NET_LOG=y
CONFIG_INIT_STACKS=y

CONFIG_NET_PKT_RX_COUNT=16
CONFIG_NET_PKT_TX_COUNT=16
CONFIG_NET_BUF_RX_COUNT=16
CONFIG_NET_BUF_TX_COUNT=16

CONFIG_NET_IF_UNICAST_IPV6_ADDR_COUNT=2
CONFIG_NET_IF_MCAST_IPV6_ADDR_COUNT=4

CONFIG_NET_MAX_CONTEXTS=16

CONFIG_TEST_RANDOM_GENERATOR=y

CONFIG_STDOUT_CONSOLE=y

CONFIG_SYS_LOG_SHOW_COLOR=y
CONFIG_SYS_LOG_NET_LEVEL=4
CONFIG_NET_DEBUG_HTTP=y

CONFIG_HTTP_SERVER=y

CONFIG_NET_IPV6=y
CONFIG_NET_IPV4=y
#CONFIG_NET_DHCPV4=y

CONFIG_HTTPS=y
CONFIG_MBEDTLS=y
CONFIG_MBEDTLS_BUILTIN=y
CONFIG_MBEDTLS_CFG_FILE="config-mini-tls1_2.h"

CONFIG_NET_APP_SETTINGS=y
CONFIG_NET_APP_MY_IPV6_ADDR="2001:db8::1"
CONFIG_NET_APP_MY_IPV4_ADDR="192.0.2.1"

CONFIG_NET_SHELL=y

CONFIG_NET_MGMT=y
CONFIG_NET_MGMT_EVENT=y

# ENC28J60 Ethernet Device
CONFIG_ETH_ENC28J60=y
CONFIG_ETH_ENC28J60_0=y
CONFIG_ETH_ENC28J60_0_SPI_PORT_NAME="SPI_1"
CONFIG_ETH_ENC28J60_0_MAC3=0x2D
CONFIG_ETH_ENC28J60_0_MAC4=0x30
CONFIG_ETH_ENC28J60_0_MAC5=0x36

# Arduino 101
CONFIG_SPI=y
```

## prj_bt.conf
```kconfig
CONFIG_NETWORKING=y
CONFIG_NET_TCP=y
CONFIG_ENTROPY_GENERATOR=y
CONFIG_NET_LOG=y
CONFIG_LOG=y
CONFIG_INIT_STACKS=y

CONFIG_NET_PKT_RX_COUNT=16
CONFIG_NET_PKT_TX_COUNT=16
CONFIG_NET_BUF_RX_COUNT=16
CONFIG_NET_BUF_TX_COUNT=16

CONFIG_NET_IF_UNICAST_IPV6_ADDR_COUNT=3
CONFIG_NET_IF_MCAST_IPV6_ADDR_COUNT=4

CONFIG_STDOUT_CONSOLE=y

CONFIG_HTTP=y
CONFIG_HTTP_SERVER=y

CONFIG_NET_IPV6=y
CONFIG_NET_IPV4=n

CONFIG_HTTPS=y
CONFIG_MBEDTLS=y
CONFIG_MBEDTLS_BUILTIN=y
CONFIG_MBEDTLS_CFG_FILE="config-mini-tls1_2.h"
CONFIG_MBEDTLS_SSL_MAX_CONTENT_LEN=2500
CONFIG_MBEDTLS_ENABLE_HEAP=y
CONFIG_MBEDTLS_HEAP_SIZE=12000

CONFIG_NET_CONFIG_SETTINGS=y
CONFIG_NET_CONFIG_MY_IPV6_ADDR="2001:db8::1"
CONFIG_NET_CONFIG_BT_NODE=y

CONFIG_NET_SHELL=y

CONFIG_NET_MGMT=y
CONFIG_NET_MGMT_EVENT=y

CONFIG_BT=y
CONFIG_BT_DEBUG_LOG=y
CONFIG_BT_SMP=y
CONFIG_BT_PERIPHERAL=y
CONFIG_BT_L2CAP_DYNAMIC_CHANNEL=y
CONFIG_BT_DEVICE_NAME="Test Http_Server"
CONFIG_NET_UDP=y
CONFIG_TEST_RANDOM_GENERATOR=y
CONFIG_NET_L2_BT=y
CONFIG_NET_STATISTICS=y
```

## prj_frdm_k64f.conf
```kconfig
CONFIG_NETWORKING=y
CONFIG_NET_TCP=y
CONFIG_RANDOM_GENERATOR=y
CONFIG_NET_ARP=y
CONFIG_NET_L2_ETHERNET=y
CONFIG_NET_LOG=y
CONFIG_INIT_STACKS=y

CONFIG_NET_PKT_RX_COUNT=16
CONFIG_NET_PKT_TX_COUNT=16
CONFIG_NET_BUF_RX_COUNT=16
CONFIG_NET_BUF_TX_COUNT=16

CONFIG_NET_IF_UNICAST_IPV6_ADDR_COUNT=2
CONFIG_NET_IF_MCAST_IPV6_ADDR_COUNT=4

CONFIG_NET_MAX_CONTEXTS=16

CONFIG_STDOUT_CONSOLE=y

CONFIG_SYS_LOG_SHOW_COLOR=y
CONFIG_SYS_LOG_NET_LEVEL=4
CONFIG_NET_DEBUG_HTTP=y

CONFIG_HTTP_SERVER=y

CONFIG_NET_IPV6=y
CONFIG_NET_IPV4=y
CONFIG_NET_DHCPV4=y

CONFIG_HTTPS=y
CONFIG_MBEDTLS=y
CONFIG_MBEDTLS_BUILTIN=y
CONFIG_MBEDTLS_CFG_FILE="config-mini-tls1_2.h"
CONFIG_MBEDTLS_ENABLE_HEAP=y
CONFIG_MBEDTLS_HEAP_SIZE=12000

CONFIG_NET_APP_SETTINGS=y
CONFIG_NET_APP_MY_IPV6_ADDR="2001:db8::1"
CONFIG_NET_APP_MY_IPV4_ADDR="192.0.2.1"

CONFIG_NET_SHELL=y

CONFIG_NET_MGMT=y
CONFIG_NET_MGMT_EVENT=y
```

## prj_netusb.conf
```kconfig
CONFIG_NETWORKING=y
CONFIG_NET_TCP=y
CONFIG_ENTROPY_GENERATOR=y
CONFIG_TEST_RANDOM_GENERATOR=y
CONFIG_NET_LOG=y
CONFIG_INIT_STACKS=y

CONFIG_NET_PKT_RX_COUNT=16
CONFIG_NET_PKT_TX_COUNT=16
CONFIG_NET_BUF_RX_COUNT=16
CONFIG_NET_BUF_TX_COUNT=16

CONFIG_NET_IF_UNICAST_IPV6_ADDR_COUNT=2
CONFIG_NET_IF_MCAST_IPV6_ADDR_COUNT=4

CONFIG_NET_MAX_CONTEXTS=16

CONFIG_HTTP=y
CONFIG_HTTP_SERVER=y

CONFIG_NET_IPV6=y
CONFIG_NET_IPV4=y
#CONFIG_NET_DHCPV4=y

# Disable HTTPS because of low memory
CONFIG_HTTPS=n
CONFIG_MBEDTLS=n

CONFIG_NET_CONFIG_SETTINGS=y
CONFIG_NET_CONFIG_MY_IPV6_ADDR="2001:db8::1"
CONFIG_NET_CONFIG_MY_IPV4_ADDR="192.0.2.1"

CONFIG_NET_CONFIG_NEED_IPV6=y
CONFIG_NET_CONFIG_NEED_IPV4=y

CONFIG_NET_SHELL=y
CONFIG_NET_STATISTICS=y

CONFIG_NET_MGMT=y
CONFIG_NET_MGMT_EVENT=y

# USB Device settings
CONFIG_USB=y
CONFIG_USB_DEVICE_STACK=y
CONFIG_LOG=y
CONFIG_USB_DRIVER_LOG_LEVEL_INF=y
CONFIG_SYS_LOG_USB_DEVICE_LEVEL=3

# Select USB Configurations
CONFIG_USB_DEVICE_NETWORK_ECM=y
```

## prj_olimex_stm32_e407.conf
```kconfig
CONFIG_NETWORKING=y
CONFIG_NET_TCP=y
CONFIG_RANDOM_GENERATOR=y
CONFIG_NET_ARP=y
CONFIG_NET_L2_ETHERNET=y
CONFIG_NET_LOG=y
CONFIG_INIT_STACKS=y

CONFIG_NET_PKT_RX_COUNT=16
CONFIG_NET_PKT_TX_COUNT=16
CONFIG_NET_BUF_RX_COUNT=16
CONFIG_NET_BUF_TX_COUNT=16

CONFIG_NET_IF_UNICAST_IPV6_ADDR_COUNT=2
CONFIG_NET_IF_MCAST_IPV6_ADDR_COUNT=4

CONFIG_NET_MAX_CONTEXTS=16

CONFIG_STDOUT_CONSOLE=y

CONFIG_SYS_LOG_SHOW_COLOR=y
CONFIG_SYS_LOG_NET_LEVEL=4
CONFIG_NET_DEBUG_HTTP=y

CONFIG_HTTP_SERVER=y

CONFIG_NET_IPV6=y
CONFIG_NET_IPV4=y
CONFIG_NET_DHCPV4=y

CONFIG_HTTPS=y
CONFIG_MBEDTLS=y
CONFIG_MBEDTLS_BUILTIN=y
CONFIG_MBEDTLS_CFG_FILE="config-mini-tls1_2.h"
CONFIG_MBEDTLS_ENABLE_HEAP=y
CONFIG_MBEDTLS_HEAP_SIZE=12000

CONFIG_NET_APP_SETTINGS=y
CONFIG_NET_APP_MY_IPV6_ADDR="2001:db8::1"
CONFIG_NET_APP_MY_IPV4_ADDR="192.0.2.1"

CONFIG_NET_SHELL=y

CONFIG_NET_MGMT=y
CONFIG_NET_MGMT_EVENT=y

CONFIG_ETH_STM32_HAL=y
CONFIG_RANDOM_STM32_RNG=y
```

## src/main.c
```c
/*
 * Copyright (c) 2017 Intel Corporation
 *
 * SPDX-License-Identifier: Apache-2.0
 */

#if defined(CONFIG_HTTPS)
#define LOG_MODULE_NAME net_https_server_sample
#else
#define LOG_MODULE_NAME net_http_server_sample
#endif

#include <logging/log.h>
LOG_MODULE_REGISTER(LOG_MODULE_NAME, LOG_LEVEL_DBG);

#include <zephyr.h>
#include <stdio.h>

#include <net/net_context.h>

#include <net/http.h>

#include "config.h"

/* Sets the network parameters */

#if defined(CONFIG_NET_CONTEXT_NET_PKT_POOL)
NET_PKT_TX_SLAB_DEFINE(http_srv_tx, 15);
NET_PKT_DATA_POOL_DEFINE(http_srv_data, 30);

static struct k_mem_slab *tx_slab(void)
{
	return &http_srv_tx;
}

static struct net_buf_pool *data_pool(void)
{
	return &http_srv_data;
}
#else
#if defined(CONFIG_NET_L2_BT)
#error "TCP connections over Bluetooth need CONFIG_NET_CONTEXT_NET_PKT_POOL "\
	"defined."
#endif /* CONFIG_NET_L2_BT */

#define tx_slab NULL
#define data_pool NULL
#endif /* CONFIG_NET_CONTEXT_NET_PKT_POOL */

#define RESULT_BUF_SIZE 1500
static u8_t http_result[RESULT_BUF_SIZE];

#if defined(CONFIG_HTTPS)
#if !defined(CONFIG_HTTPS_STACK_SIZE)
#define CONFIG_HTTPS_STACK_SIZE		8192
#endif /* CONFIG_HTTPS_STACK_SIZE */

#define APP_BANNER "Run HTTPS server"
#define INSTANCE_INFO "Zephyr HTTPS example server #1"

/* Note that each HTTPS context needs its own stack as there will be
 * a separate thread for each HTTPS context.
 */
NET_STACK_DEFINE(HTTPS, https_stack, CONFIG_NET_APP_TLS_STACK_SIZE,
		 CONFIG_NET_APP_TLS_STACK_SIZE);

#define RX_FIFO_DEPTH 4
K_MEM_POOL_DEFINE(ssl_rx_pool, 4, 64, RX_FIFO_DEPTH, 4);

#else /* CONFIG_HTTPS */
#define APP_BANNER "Run HTTP server"
#endif /* CONFIG_HTTPS */

/*
 * Note that the http_server_ctx and http_server_urls are quite large so be
 * careful if those are allocated from stack.
 */
static struct http_ctx http_ctx;
static struct http_server_urls http_urls;

void panic(const char *msg)
{
	if (msg) {
		LOG_ERR("%s", msg);
	}

	for (;;) {
		k_sleep(K_FOREVER);
	}
}

#define HTTP_STATUS_200_OK	"HTTP/1.1 200 OK\r\n" \
				"Content-Type: text/html\r\n" \
				"Transfer-Encoding: chunked\r\n"

#define HTTP_STATUS_200_OK_GZ	"HTTP/1.1 200 OK\r\n" \
				"Content-Type: text/html\r\n" \
				"Transfer-Encoding: chunked\r\n" \
				"Content-Encoding: gzip\r\n"

#define HTML_HEADER		"<html><head>" \
				"<title>Zephyr HTTP Server</title>" \
				"</head><body><h1>" \
				"<center>Zephyr HTTP server</center></h1>\r\n"

#define HTML_FOOTER		"</body></html>\r\n"

static int http_response(struct http_ctx *ctx, const char *header,
			 const char *payload, size_t payload_len,
			 char *str, const struct sockaddr *dst)
{
	int ret;

	ret = http_add_header(ctx, header, dst, str);
	if (ret < 0) {
		LOG_ERR("Cannot add HTTP header (%d)", ret);
		return ret;
	}

	ret = http_add_header(ctx, HTTP_CRLF, dst, str);
	if (ret < 0) {
		return ret;
	}

	ret = http_send_chunk(ctx, payload, payload_len, dst, str);
	if (ret < 0) {
		LOG_ERR("Cannot send data to peer (%d)", ret);
		return ret;
	}

	ret = http_send_chunk(ctx, NULL, 0, dst, NULL);
	if (ret < 0) {
		LOG_ERR("Cannot send data to peer (%d)", ret);
		return ret;
	}

	return http_send_flush(ctx, str);
}

static int http_response_soft_404(struct http_ctx *ctx,
				  const struct sockaddr *dst)
{
	static const char *not_found =
		HTML_HEADER
		"<h2><center>404 Not Found</center></h2>"
		HTML_FOOTER;

	return http_response(ctx, HTTP_STATUS_200_OK, not_found,
			     strlen(not_found), "Error", dst);
}

/* Prints the received HTTP header fields as an HTML list */
static void print_http_headers(struct http_ctx *ctx,
			       char *str, int size)
{
	int offset;
	int ret;

	ret = snprintf(str, size,
		       HTML_HEADER
		       "<h2>HTTP Header Fields</h2>\r\n<ul>\r\n");
	if (ret < 0 || ret >= size) {
		return;
	}

	offset = ret;

	for (u8_t i = 0; i < ctx->http.field_values_ctr; i++) {
		struct http_field_value *kv = &ctx->http.field_values[i];

		ret = snprintf(str + offset, size - offset,
			       "<li>%.*s: %.*s</li>\r\n",
			       kv->key_len, kv->key,
			       kv->value_len, kv->value);
		if (ret < 0 || ret >= size) {
			return;
		}

		offset += ret;
	}

	ret = snprintf(str + offset, size - offset, "</ul>\r\n");
	if (ret < 0 || ret >= size) {
		return;
	}

	offset += ret;

	ret = snprintf(str + offset, size - offset,
		       "<h2>HTTP Method: %s</h2>\r\n",
		       http_method_str(ctx->http.parser.method));
	if (ret < 0 || ret >= size) {
		return;
	}

	offset += ret;

	ret = snprintf(str + offset, size - offset,
		       "<h2>URL: %.*s</h2>\r\n",
		       ctx->http.url_len, ctx->http.url);
	if (ret < 0 || ret >= size) {
		return;
	}

	offset += ret;

	snprintf(str + offset, size - offset,
		 "<h2>Server: %s</h2>"HTML_FOOTER, CONFIG_ARCH);
}

int http_serve_headers(struct http_ctx *ctx,
		       const struct sockaddr *dst)
{
#define HTTP_MAX_BODY_STR_SIZE		1024
	static char html_body[HTTP_MAX_BODY_STR_SIZE];

	print_http_headers(ctx, html_body, HTTP_MAX_BODY_STR_SIZE);

	return http_response(ctx, HTTP_STATUS_200_OK, html_body,
			     strlen(html_body), "Headers", dst);
}

static int http_serve_index_html(struct http_ctx *ctx,
				 const struct sockaddr *dst)
{
	static const char index_html[] = {
#include "index.html.inc"
	};

	LOG_DBG("Sending index.html (%zd bytes) to client",
		sizeof(index_html));

	return http_response(ctx, HTTP_STATUS_200_OK, index_html,
			     sizeof(index_html), "Index", dst);
}

static void http_connected(struct http_ctx *ctx,
			   enum http_connection_type type,
			   const struct sockaddr *dst,
			   void *user_data)
{
	char url[32];
	int len = min(sizeof(url) - 1, ctx->http.url_len);

	memcpy(url, ctx->http.url, len);
	url[len] = '\0';

	LOG_DBG("%s connect attempt URL %s",
		type == HTTP_CONNECTION ? "HTTP" : "WS", url);

	if (type == HTTP_CONNECTION) {
		if (strncmp(ctx->http.url, "/",
			    ctx->http.url_len) == 0) {
			http_serve_index_html(ctx, dst);
			http_close(ctx);
			return;
		}

		if (strncmp(ctx->http.url, "/index.html",
			    ctx->http.url_len) == 0) {
			http_serve_index_html(ctx, dst);
			http_close(ctx);
			return;
		}

		if (strncmp(ctx->http.url, "/headers",
			    ctx->http.url_len) == 0) {
			http_serve_headers(ctx, dst);
			http_close(ctx);
			return;
		}
	}

	/* Give 404 error for all the other URLs we do not want to handle
	 * right now.
	 */
	http_response_soft_404(ctx, dst);
	http_close(ctx);
}

static void http_received(struct http_ctx *ctx,
			  struct net_pkt *pkt,
			  int status,
			  u32_t flags,
			  const struct sockaddr *dst,
			  void *user_data)
{
	if (!status) {
		if (pkt) {
			LOG_DBG("Received %d bytes data",
				net_pkt_appdatalen(pkt));
			net_pkt_unref(pkt);
		}
	} else {
		LOG_ERR("Receive error (%d)", status);

		if (pkt) {
			net_pkt_unref(pkt);
		}
	}
}

static void http_sent(struct http_ctx *ctx,
		      int status,
		      void *user_data_send,
		      void *user_data)
{
	LOG_DBG("%s sent", (char *)user_data_send);
}

static void http_closed(struct http_ctx *ctx,
			int status,
			void *user_data)
{
	LOG_DBG("Connection %p closed", ctx);
}

static const char *get_string(int str_len, const char *str)
{
	static char buf[64];
	int len = min(str_len, sizeof(buf) - 1);

	memcpy(buf, str, len);
	buf[len] = '\0';

	return buf;
}

static enum http_verdict default_handler(struct http_ctx *ctx,
					 enum http_connection_type type,
					 const struct sockaddr *dst)
{
	LOG_DBG("No handler for %s URL %s",
		type == HTTP_CONNECTION ? "HTTP" : "WS",
		get_string(ctx->http.url_len, ctx->http.url));

	if (type == HTTP_CONNECTION) {
		http_response_soft_404(ctx, dst);
	}

	return HTTP_VERDICT_DROP;
}


#if defined(CONFIG_HTTPS)
/* Load the certificates and private RSA key. */

static const char echo_apps_cert_der[] = {
#include "echo-apps-cert.der.inc"
};

static const char echo_apps_key_der[] = {
#include "echo-apps-key.der.inc"
};

static int setup_cert(struct net_app_ctx *app_ctx,
		      mbedtls_x509_crt *cert,
		      mbedtls_pk_context *pkey)
{
	int ret;

	ret = mbedtls_x509_crt_parse(cert, echo_apps_cert_der,
				     sizeof(echo_apps_cert_der));
	if (ret != 0) {
		LOG_ERR("mbedtls_x509_crt_parse returned %d", ret);
		return ret;
	}

	ret = mbedtls_pk_parse_key(pkey, echo_apps_key_der,
				   sizeof(echo_apps_key_der),
				   NULL, 0);
	if (ret != 0) {
		LOG_ERR("mbedtls_pk_parse_key returned %d", ret);
		return ret;
	}

	return 0;
}
#endif /* CONFIG_HTTPS */

void main(void)
{
	struct sockaddr addr, *server_addr;
	int ret;

	/*
	 * There are several options here for binding to local address.
	 * 1) The server address can be left empty in which case the
	 *    library will bind to both IPv4 and IPv6 addresses and to
	 *    port 80 which is the default.
	 * 2) The server address can be partially filled, meaning that
	 *    the address can be left to 0 and port can be set if a value
	 *    other than 80 is desired. If the protocol family in sockaddr
	 *    is set to AF_UNSPEC, then both IPv4 and IPv6 socket is bound.
	 * 3) The address can be set to some real value. There is a helper
	 *    function that can be used to fill the socket address struct.
	 */
#define ADDR_OPTION 1

#if ADDR_OPTION == 1
	server_addr = NULL;

	ARG_UNUSED(addr);

#elif ADDR_OPTION == 2
	/* Accept any local listening address */
	(void)memset(&addr, 0, sizeof(addr));

	net_sin(&addr)->sin_port = htons(ZEPHYR_PORT);

	/* In this example, listen only IPv4 */
	addr.family = AF_INET;

	server_addr = &addr;

#elif ADDR_OPTION == 3
	/* Set the bind address according to your configuration */
	(void)memset(&addr, 0, sizeof(addr));

	/* In this example, listen only IPv6 */
	addr.family = AF_INET6;

	ret = http_server_set_local_addr(&addr, ZEPHYR_ADDR, ZEPHYR_PORT);
	if (ret < 0) {
		LOG_ERR("Cannot set local address (%d)", ret);
		panic(NULL);
	}

	server_addr = &addr;

#else
	server_addr = NULL;

	ARG_UNUSED(addr);
#endif

	http_server_add_default(&http_urls, default_handler);
	http_server_add_url(&http_urls, "/headers", HTTP_URL_STANDARD);
	http_server_add_url(&http_urls, "/index.html", HTTP_URL_STANDARD);
	http_server_add_url(&http_urls, "/", HTTP_URL_STANDARD);

	ret = http_server_init(&http_ctx, &http_urls, server_addr, http_result,
			       sizeof(http_result), "Zephyr HTTP Server",
			       NULL);
	if (ret < 0) {
		LOG_ERR("Cannot initialize HTTP server (%d)", ret);
		panic(NULL);
	}

#if defined(CONFIG_NET_CONTEXT_NET_PKT_POOL)
	net_app_set_net_pkt_pool(&http_ctx.app_ctx, tx_slab, data_pool);
#endif

	http_set_cb(&http_ctx, http_connected, http_received,
		    http_sent, http_closed);

#if defined(CONFIG_HTTPS)
	ret = http_server_set_tls(&http_ctx,
				  APP_BANNER,
				  INSTANCE_INFO,
				  strlen(INSTANCE_INFO),
				  setup_cert,
				  NULL,
				  &ssl_rx_pool,
				  https_stack,
				  K_THREAD_STACK_SIZEOF(https_stack));
	if (ret < 0) {
		LOG_ERR("Cannot enable TLS support (%d)", ret);
	}
#endif

	/*
	 * If needed, the HTTP parser callbacks can be set according to
	 * applications own needs before enabling the server. In this example
	 * we use the default callbacks defined in HTTP server API.
	 */

	http_server_enable(&http_ctx);
}
```

## src/config.h
```c
/*
 * Copyright (c) 2017 Intel Corporation
 *
 * SPDX-License-Identifier: Apache-2.0
 */

#ifndef _CONFIG_H_
#define _CONFIG_H_

/* The startup time needs to be longish if DHCP is enabled as setting
 * DHCP up takes some time.
 */
#define APP_STARTUP_TIME K_SECONDS(20)

#ifdef CONFIG_NET_CONFIG_SETTINGS
#ifdef CONFIG_NET_IPV6
#define ZEPHYR_ADDR            CONFIG_NET_CONFIG_MY_IPV6_ADDR
#else
#define ZEPHYR_ADDR            CONFIG_NET_CONFIG_MY_IPV4_ADDR
#endif
#else
#ifdef CONFIG_NET_IPV6
#define ZEPHYR_ADDR            "2001:db8::1"
#else
#define ZEPHYR_ADDR            "192.0.2.1"
#endif
#endif

#ifndef ZEPHYR_PORT
#define ZEPHYR_PORT		8080
#endif

#define HTTP_AUTH_URL		"/auth"
#define HTTP_AUTH_TYPE		"Basic"

/* HTTP Basic Auth, see https://tools.ietf.org/html/rfc7617 */
#define HTTP_AUTH_REALM		"Zephyr"
#define HTTP_AUTH_USERNAME	"zephyr"
#define HTTP_AUTH_PASSWORD	"0123456789"

#endif
```

## src/http_server.c
```c
/*
 * Copyright (c) 2017 Intel Corporation
 *
 * SPDX-License-Identifier: Apache-2.0
 */

#include "http_types.h"
#include "http_server.h"
#include "http_utils.h"
#include "http_write_utils.h"
#include "config.h"

#include <net/http_parser.h>
#include <net/net_pkt.h>
#include <stdio.h>


#define HTTP_BUF_CTR	HTTP_MAX_NUMBER_SERVER_CTX
#define HTTP_BUF_SIZE	1024

/**
 * @brief parser_parse_request	Parses an HTTP REQUEST
 * @param ctx		HTTP server context
 * @param rx		Input buffer
 * @return		0 on success
 * @return		-EINVAL on error
 */
static
int parser_parse_request(struct http_server_ctx *ctx, struct net_buf *rx);

static struct http_root_url *http_url_find(struct http_server_ctx *http_ctx);

static int http_url_cmp(const char *url, u16_t url_len,
			const char *root_url, u16_t root_url_len);

static void http_tx(struct http_server_ctx *http_ctx);


/**
 * @brief server_collection	This is a collection of server ctx structs
 */
static struct http_server_ctx server_ctx[CONFIG_HTTP_SERVER_CONNECTIONS];

/**
 * @brief http_url_ctx	Just one URL context per application
 */
static struct http_url_ctx url_ctx;

int http_auth(struct http_server_ctx *ctx)
{
	const char *auth_str = "Authorization: Basic "HTTP_AUTH_CREDENTIALS;

	if (strstr(ctx->field_values[0].key, auth_str)) {
		return http_response_auth(ctx);
	}

	return http_response_401(ctx);
}
```

## src/http_server.h
```c
/*
 * Copyright (c) 2017 Intel Corporation
 *
 * SPDX-License-Identifier: Apache-2.0
 */

#ifndef _HTTP_SERVER_H_
#define _HTTP_SERVER_H_

#include <net/net_context.h>

/* Callback executed when a new connection is accepted */
void http_accept_cb(struct net_context *net_ctx, struct sockaddr *addr,
		    socklen_t addr_len, int status, void *data);

/**
 * @brief http_rx_tx	Reads the HTTP request from the `rx` buffer
 *			and writes an HTTP 1.1 200 OK response with client
 *			header fields or an error message
 * @param ctx		The network context
 * @param rx		The received packet
 * @param status	Connection status, see `net_context_recv_cb_t`
 * @param user_data	User-provided data
 */
void http_rx_tx(struct net_context *ctx, struct net_pkt *rx, int status,
		void *user_data);

/**
 * @brief http_ctx_init	Initializes the HTTP server contexts collection
 * @return		0, future versions may return error codes
 */
int http_ctx_init(void);

/**
 * @brief http_ctx_get	Gets an HTTP server context struct
 * @return		A valid HTTP server ctx on success
 * @return		NULL on error
 */
struct http_server_ctx *http_ctx_get(void);

/**
 * @brief http_ctx_set		Assigns the net_ctx pointer to the HTTP ctx
 * @param http_ctx		HTTP server context struct
 * @param net_ctx		Network context
 * @return			0 on success
 * @return			-EINVAL on error
 */
int http_ctx_set(struct http_server_ctx *http_ctx, struct net_context *net_ctx);

int http_url_default_handler(int (*write_cb)(struct http_server_ctx *));

int http_url_add(const char *url, u8_t flags,
		 int (*write_cb)(struct http_server_ctx *http_ctx));

int http_auth(struct http_server_ctx *ctx);

#endif
```

## src/http_types.h
```c
/*
 * Copyright (c) 2017 Intel Corporation
 *
 * SPDX-License-Identifier: Apache-2.0
 */

#ifndef _HTTP_TYPES_H_
#define _HTTP_TYPES_H_

#include <net/net_context.h>
#include <net/http.h>

/* Max number of HTTP header field-value pairs */
#define HTTP_PARSER_MAX_FIELD_VALUES	CONFIG_HTTP_HEADER_FIELD_ITEMS

/* Max number of HTTP server context available to this app */
#define HTTP_MAX_NUMBER_SERVER_CTX	CONFIG_NET_MAX_CONTEXTS

/* Max number of URLs this server will handle */
#define HTTP_MAX_NUMBER_URL		16

enum HTTP_URL_FLAGS {
	HTTP_URL_STANDARD = 0
};

/**
 * @brief http_root_url		HTTP root URL struct, used for pattern matching
 */
struct http_root_url {
	const char *root;
	u16_t root_len;

	u8_t flags;
	int (*write_cb)(struct http_server_ctx *http_ctx);
};

/**
 * @brief http_url_ctx		Collection of URLs that this server will handle
 */
struct http_url_ctx {
	struct http_root_url urls[HTTP_MAX_NUMBER_URL];
	u8_t urls_ctr;
};

#endif
```

## src/http_utils.c
```c
/*
 * Copyright (c) 2017 Intel Corporation
 *
 * SPDX-License-Identifier: Apache-2.0
 */

#include "http_utils.h"
#include <stdio.h>

#include "config.h"

#define IP6_SIZE	16
#define IP4_SIZE	4

#define STR_IP6_ADDR	64
#define STR_IP4_ADDR	16

static
void print_ipaddr(const struct sockaddr *ip_addr)
{
#ifdef CONFIG_NET_IPV6
	struct sockaddr_in6 *addr = (struct sockaddr_in6 *)ip_addr;
	void *raw = (void *)&addr->sin6_addr;
	u16_t port = addr->sin6_port;
	sa_family_t family = AF_INET6;
	char str[STR_IP6_ADDR];
#else
	struct sockaddr_in *addr = (struct sockaddr_in *)ip_addr;
	void *raw = (void *)&addr->sin_addr;
	u16_t port = addr->sin_port;
	sa_family_t family = AF_INET;
	char str[STR_IP4_ADDR];
#endif

	net_addr_ntop(family, raw, str, sizeof(str));
	printf("Address: %s, port: %d\n", str, ntohs(port));
}

void print_client_banner(const struct sockaddr *addr)
{
	printf("\n----------------------------------------------------\n");
	printf("[%s:%d] Connection accepted\n", __func__, __LINE__);
	print_ipaddr(addr);
}


void print_server_banner(const struct sockaddr *addr)
{
	printf("Zephyr HTTP Server\n");
	print_ipaddr(addr);
}
```

## src/http_utils.h
```c
/*
 * Copyright (c) 2017 Intel Corporation
 *
 * SPDX-License-Identifier: Apache-2.0
 */

#ifndef __HTTP_UTILS_H__
#define __HTTP_UTILS_H__

#include <net/net_ip.h>

#define RC_STR(rc)	(rc == 0 ? "OK" : "ERROR")

void print_client_banner(const struct sockaddr *addr);

void print_server_banner(const struct sockaddr *addr);

#endif
```

## src/http_write_utils.c
```c
/*
 * Copyright (c) 2017 Intel Corporation
 *
 * SPDX-License-Identifier: Apache-2.0
 */

#include "http_write_utils.h"
#include "http_types.h"
#include "http_utils.h"
#include "config.h"

#include <stdio.h>

int http_response_401(struct http_server_ctx *ctx)
{
	return http_response(ctx, HTTP_401_STATUS_US, NULL);
}

int http_response_auth(struct http_server_ctx *ctx)
{
	return http_response(ctx, HTTP_STATUS_200_OK,
			     HTML_HEADER"<h2><center>user: "HTTP_AUTH_USERNAME
			     ", password: "HTTP_AUTH_PASSWORD"</center></h2>"
			     HTML_FOOTER);
}
```

## src/http_write_utils.h
```c
/*
 * Copyright (c) 2017 Intel Corporation
 *
 * SPDX-License-Identifier: Apache-2.0
 */

#ifndef _HTTP_WRITE_UTILS_H
#define _HTTP_WRITE_UTILS_H

#include "http_types.h"
#include <net/http.h>

/* Writes the received HTTP header fields to the client */
int http_response_header_fields(struct http_server_ctx *ctx);

/* Writes an elementary It Works! HTML web page to the client */
int http_response_it_works(struct http_server_ctx *ctx);

int http_response_401(struct http_server_ctx *ctx);

/* Writes a 200 OK HTTP status code with a 404 Not Found HTML msg */
int http_response_soft_404(struct http_server_ctx *ctx);

int http_response_auth(struct http_server_ctx *ctx);

#endif
```

## src/https_server.c
```c
/*  Minimal TLS server.
 *
 *  Copyright (C) 2006-2015, ARM Limited, All Rights Reserved
 *
 *  SPDX-License-Identifier: Apache-2.0
 *
 *  This file is part of mbed TLS (https://tls.mbed.org)
 */

#include <zephyr.h>
#include <stdio.h>

#include <errno.h>
#include <misc/printk.h>

#if !defined(CONFIG_MBEDTLS_CFG_FILE)
#include "mbedtls/config.h"
#else
#include CONFIG_MBEDTLS_CFG_FILE
#endif

#if defined(MBEDTLS_PLATFORM_C)
#include "mbedtls/platform.h"
#else
#include <stdlib.h>
#define mbedtls_time_t       time_t
#define MBEDTLS_EXIT_SUCCESS EXIT_SUCCESS
#define MBEDTLS_EXIT_FAILURE EXIT_FAILURE
#endif

#include <string.h>
#include <net/net_context.h>
#include <net/net_if.h>
#include "config.h"
#include "ssl_utils.h"
#include "test_certs.h"

#include "mbedtls/ssl_cookie.h"
#include "mbedtls/entropy.h"
#include "mbedtls/ctr_drbg.h"
#include "mbedtls/net_sockets.h"
#include "mbedtls/x509.h"
#include "mbedtls/ssl.h"
#include "mbedtls/error.h"
#include "mbedtls/debug.h"

#if defined(MBEDTLS_DEBUG_C)
#include "mbedtls/debug.h"
#define DEBUG_THRESHOLD 0
#endif

#if defined(MBEDTLS_MEMORY_BUFFER_ALLOC_C)
#include "mbedtls/memory_buffer_alloc.h"
static unsigned char heap[12000];
#endif

/*
 * Hardcoded values for server host and port
 */

static const char *pers = "tls_server";

#if defined(CONFIG_NET_IPV6)
static struct in6_addr server_addr;
#else
static struct in_addr server_addr;
#endif

struct parsed_url {
	const char *url;
	u16_t url_len;
};

#define HTTP_RESPONSE \
	"HTTP/1.0 200 OK\r\nContent-Type: text/html\r\n\r\n" \
	"<h2>Zephyr TLS Test Server</h2>\r\n" \
	"<p>Successful connection</p>\r\n"

#define HTTP_NOT_FOUND \
	"HTTP/1.0 404 NOT FOUND\r\nContent-Type: text/html\r\n\r\n" \
	"<h2>Zephyr TLS page not found </h2>\r\n" \
	"<p>Successful connection</p>\r\n"

static void my_debug(void *ctx, int level,
		     const char *file, int line, const char *str)
{
	const char *p, *basename;

	ARG_UNUSED(ctx);

	/* Extract basename from file */
	for (p = basename = file; *p != '\0'; p++) {
		if (*p == '/' || *p == '\\') {
			basename = p + 1;
		}

	}

	mbedtls_printf("%s:%04d: |%d| %s", basename, line, level, str);
}

static int entropy_source(void *data, unsigned char *output, size_t len,
			  size_t *olen)
{
	u32_t seed;

	ARG_UNUSED(data);

	seed = sys_rand32_get();

	if (len > sizeof(seed)) {
		len = sizeof(seed);
	}

	memcpy(output, &seed, len);

	*olen = len;
	return 0;
}

static
int on_url(struct http_parser *parser, const char *at, size_t length)
{
	struct parsed_url *req = (struct parsed_url *)parser->data;

	req->url = at;
	req->url_len = length;

	return 0;
}

static unsigned char payload[256];

void https_server(void)
{
	struct ssl_context ctx;
	struct parsed_url request;
	int ret, len = 0;

	mbedtls_entropy_context entropy;
	mbedtls_ctr_drbg_context ctr_drbg;
	mbedtls_ssl_context ssl;
	mbedtls_ssl_config conf;
	mbedtls_x509_crt srvcert;
	mbedtls_pk_context pkey;

	mbedtls_platform_set_printf(printk);

#if defined(MBEDTLS_MEMORY_BUFFER_ALLOC_C)
	mbedtls_memory_buffer_alloc_init(heap, sizeof(heap));
#endif

#if defined(MBEDTLS_DEBUG_C)
	mbedtls_debug_set_threshold(DEBUG_THRESHOLD);
	mbedtls_ssl_conf_dbg(&conf, my_debug, NULL);
#endif
	mbedtls_x509_crt_init(&srvcert);
	mbedtls_pk_init(&pkey);
	mbedtls_ssl_init(&ssl);
	mbedtls_ssl_config_init(&conf);
	mbedtls_entropy_init(&entropy);
	mbedtls_ctr_drbg_init(&ctr_drbg);

	/*
	 * 1. Load the certificates and private RSA key
	 */

	ret = mbedtls_x509_crt_parse(&srvcert, rsa_example_cert_der,
				     rsa_example_cert_der_len);
	if (ret != 0) {
		mbedtls_printf(" failed\n  !"
			       "  mbedtls_x509_crt_parse returned %d\n\n", ret);
		goto exit;
	}

	ret = mbedtls_pk_parse_key(&pkey, rsa_example_keypair_der,
				   rsa_example_keypair_der_len, NULL, 0);
	if (ret != 0) {
		mbedtls_printf(" failed\n  !"
			       "  mbedtls_pk_parse_key returned %d\n\n", ret);
		goto exit;
	}

	/*
	 * 3. Seed the RNG
	 */

	mbedtls_entropy_add_source(&entropy, entropy_source, NULL,
				   MBEDTLS_ENTROPY_MAX_GATHER,
				   MBEDTLS_ENTROPY_SOURCE_STRONG);

	ret = mbedtls_ctr_drbg_seed(&ctr_drbg, mbedtls_entropy_func, &entropy,
				    (const unsigned char *)pers, strlen(pers));
	if (ret != 0) {
		mbedtls_printf(" failed\n  !"
			       " mbedtls_ctr_drbg_seed returned %d\n", ret);
		goto exit;
	}

	/*
	 * 4. Setup stuff
	 */
	ret = mbedtls_ssl_config_defaults(&conf,
					  MBEDTLS_SSL_IS_SERVER,
					  MBEDTLS_SSL_TRANSPORT_STREAM,
					  MBEDTLS_SSL_PRESET_DEFAULT);
	if (ret != 0) {
		mbedtls_printf(" failed\n  !"
			       " mbedtls_ssl_config_defaults returned %d\n\n",
			       ret);
		goto exit;
	}

	mbedtls_ssl_conf_rng(&conf, mbedtls_ctr_drbg_random, &ctr_drbg);
	mbedtls_ssl_conf_dbg(&conf, my_debug, NULL);

	mbedtls_ssl_conf_ca_chain(&conf, srvcert.next, NULL);
	ret = mbedtls_ssl_conf_own_cert(&conf, &srvcert, &pkey);
	if (ret != 0) {
		mbedtls_printf(" failed\n  !"
			       " mbedtls_ssl_conf_own_cert returned %d\n\n",
			       ret);
		goto exit;
	}

	ret = mbedtls_ssl_setup(&ssl, &conf);
	if (ret != 0) {
		mbedtls_printf(" failed\n  !"
			       " mbedtls_ssl_setup returned %d\n\n", ret);
		goto exit;
	}

	/*
	 * 3. Wait until a client connects
	 */
	ret = ssl_init(&ctx, &server_addr);
	if (ret != 0) {
		mbedtls_printf(" failed\n  ! ssl_init returned %d\n\n", ret);
		goto exit;

	}

	/*
	 * 4. Prepare http parser
	 */
	http_parser_init(&ctx.parser, HTTP_REQUEST);
	http_parser_settings_init(&ctx.parser_settings);
	ctx.parser.data = &request;
	ctx.parser_settings.on_url = on_url;

	mbedtls_printf("Zephyr HTTPS Server\n");
	mbedtls_printf("Address: %s, port: %d\n", ZEPHYR_ADDR, SERVER_PORT);
reset:
	mbedtls_ssl_session_reset(&ssl);
	mbedtls_ssl_set_bio(&ssl, &ctx, ssl_tx, ssl_rx, NULL);
	/*
	 * 5. Handshake
	 */
	do {
		ret = mbedtls_ssl_handshake(&ssl);
		if (ret != MBEDTLS_ERR_SSL_WANT_READ &&
		    ret != MBEDTLS_ERR_SSL_WANT_WRITE) {
			if (ret < 0) {
				mbedtls_printf(" failed\n  !"
					       " mbedtls_ssl_handshake returned %d\n\n",
					       ret);
				goto reset;
			}
		}
	} while (ret != 0);

	/*
	 * 6. Read the HTTPS Request
	 */
	mbedtls_printf("Read HTTPS request\n");
	do {
		len = sizeof(payload) - 1;
		memset(payload, 0, sizeof(payload));
		ret = mbedtls_ssl_read(&ssl, payload, len);

		if (ret == MBEDTLS_ERR_SSL_WANT_READ ||
		    ret == MBEDTLS_ERR_SSL_WANT_WRITE) {
			continue;
		}

		if (ret <= 0) {
			switch (ret) {
			case MBEDTLS_ERR_SSL_PEER_CLOSE_NOTIFY:
				mbedtls_printf(" connection was"
					       " closed gracefully\n");
				goto close;

			case MBEDTLS_ERR_NET_CONN_RESET:
				mbedtls_printf(" connection was"
					       " reset by peer\n");
				break;

			default:
				mbedtls_printf
				    (" mbedtls_ssl_read returned -0x%x\n",
				     -ret);
				break;
			}

			break;
		}

		len = ret;
		ret = http_parser_execute(&ctx.parser, &ctx.parser_settings,
					  payload, len);
		if (ret < 0) {
		}
	} while (ret < 0);

	/*
	 * 7. Write the Response
	 */
	mbedtls_printf("Write HTTPS response\n");

	if (!strncmp("/index.html", request.url, request.url_len)) {
		len = snprintf((char *)payload, sizeof(payload),
				HTTP_RESPONSE);
	} else {

		len = snprintf((char *)payload, sizeof(payload),
				HTTP_NOT_FOUND);
	}

	do {
		ret = mbedtls_ssl_write(&ssl, payload, len);
		if (ret == MBEDTLS_ERR_NET_CONN_RESET) {
			mbedtls_printf(" failed\n  !"
				       " peer closed the connection\n");
			goto reset;
		}

		if (ret != MBEDTLS_ERR_SSL_WANT_READ &&
		    ret != MBEDTLS_ERR_SSL_WANT_WRITE) {
			if (ret < 0) {
				mbedtls_printf(" failed\n  !"
					       " mbedtls_ssl_write"
					       " returned %d\n", ret);
				goto exit;
			}
		}
	} while (ret <= 0);

close:

	mbedtls_ssl_close_notify(&ssl);
	ret = 0;
	goto reset;

exit:
#ifdef MBEDTLS_ERROR_C
	if (ret != 0) {
		mbedtls_strerror(ret, payload, 100);
		mbedtls_printf("Last error was: %d - %s\n", ret, payload);
	}
#endif

	mbedtls_ssl_free(&ssl);
	mbedtls_ssl_config_free(&conf);
	mbedtls_ctr_drbg_free(&ctr_drbg);
	mbedtls_entropy_free(&entropy);
}

#define STACK_SIZE		8192
u8_t stack[STACK_SIZE];
struct k_thread https_thread;

static inline int init_app(void)
{
#if defined(CONFIG_NET_IPV6)
	if (net_addr_pton(AF_INET6, ZEPHYR_ADDR, &server_addr) < 0) {
		mbedtls_printf("Invalid IPv6 address %s", ZEPHYR_ADDR);
	}

	if (!net_if_ipv6_addr_add(net_if_get_default(), &server_addr,
				  NET_ADDR_MANUAL, 0)) {
		return -EIO;
	}
#else
	if (net_addr_pton(AF_INET, ZEPHYR_ADDR, &server_addr) < 0) {
		mbedtls_printf("Invalid IPv4 address %s", ZEPHYR_ADDR);
	}

	if (!net_if_ipv4_addr_add(net_if_get_default(), &server_addr,
				  NET_ADDR_MANUAL, 0)) {
		return -EIO;
	}
#endif

	return 0;
}

void https_server_start(void)
{
	if (init_app() != 0) {
		printk("Cannot initialize network\n");
		return;
	}

	k_thread_create(&https_thread, stack, STACK_SIZE,
			(k_thread_entry_t) https_server,
			NULL, NULL, NULL, K_PRIO_COOP(7), 0, 0);
}
```

## src/ssl_utils.c
```c
/*
 * Copyright (c) 2017 Intel Corporation
 *
 * SPDX-License-Identifier: Apache-2.0
 */

#include <zephyr.h>
#include <net/net_core.h>
#include <net/net_context.h>
#include <net/net_pkt.h>
#include <net/net_if.h>
#include <string.h>
#include <errno.h>
#include <misc/printk.h>

#if !defined(CONFIG_MBEDTLS_CFG_FILE)
#include "mbedtls/config.h"
#else
#include CONFIG_MBEDTLS_CFG_FILE
#endif

#include "mbedtls/ssl.h"

#include "config.h"
#include "ssl_utils.h"

#define RX_FIFO_DEPTH 4

K_MEM_POOL_DEFINE(rx_pkts, 4, 64, RX_FIFO_DEPTH, 4);

static void ssl_received(struct net_context *context,
			 struct net_buf *buf, int status, void *user_data)
{
	struct ssl_context *ctx = user_data;
	struct rx_fifo_block *rx_data = NULL;
	struct k_mem_block block;

	ARG_UNUSED(context);
	ARG_UNUSED(status);

	if (!net_pkt_appdatalen(buf)) {
		net_pkt_unref(buf);
		return;
	}

	k_mem_pool_alloc(&rx_pkts, &block,
			 sizeof(struct rx_fifo_block), K_FOREVER);
	rx_data = block.data;
	rx_data->buf = buf;

	/* For freeing memory later */
	memcpy(&rx_data->block, &block, sizeof(struct k_mem_block));
	k_fifo_put(&ctx->rx_fifo, (void *)rx_data);
}

static inline void ssl_sent(struct net_context *context,
			    int status, void *token, void *user_data)
{
	struct ssl_context *ctx = user_data;

	k_sem_give(&ctx->tx_sem);
}

int ssl_tx(void *context, const unsigned char *buf, size_t size)
{
	struct ssl_context *ctx = context;
	struct net_context *net_ctx;
	struct net_buf *send_buf;

	int rc, len;

	net_ctx = ctx->net_ctx;

	send_buf = net_pkt_get_tx(net_ctx, K_NO_WAIT);
	if (!send_buf) {
		return MBEDTLS_ERR_SSL_ALLOC_FAILED;
	}

	len = net_pkt_append(send_buf, size, (u8_t *) buf, K_FOREVER);

	rc = net_context_send(send_buf, ssl_sent, K_NO_WAIT, NULL, ctx);

	if (rc < 0) {
		net_pkt_unref(send_buf);
		return MBEDTLS_ERR_SSL_INTERNAL_ERROR;
	}

	k_sem_take(&ctx->tx_sem, K_FOREVER);
	return len;
}

int ssl_rx(void *context, unsigned char *buf, size_t size)
{
	struct ssl_context *ctx = context;
	u16_t read_bytes;
	struct rx_fifo_block *rx_data;
	u8_t *ptr;
	int pos;
	int len;
	int rc = 0;

	if (ctx->frag == NULL) {
		rx_data = k_fifo_get(&ctx->rx_fifo, K_FOREVER);
		ctx->rx_pkt = rx_data->buf;
		k_mem_pool_free(&rx_data->block);

		read_bytes = net_pkt_appdatalen(ctx->rx_pkt);

		ctx->remaining = read_bytes;
		ctx->frag = ctx->rx_pkt->frags;
		ptr = net_pkt_appdata(ctx->rx_pkt);

		len = ptr - ctx->frag->data;
		net_buf_pull(ctx->frag, len);
	} else {
		read_bytes = ctx->remaining;
		ptr = ctx->frag->data;
	}

	len = ctx->frag->len;
	pos = 0;
	if (read_bytes > size) {
		while (ctx->frag) {
			read_bytes = len < (size - pos) ? len : (size - pos);
			memcpy(buf + pos, ptr, read_bytes);
			pos += read_bytes;
			if (pos < size) {
				ctx->frag = ctx->frag->frags;
				ptr = ctx->frag->data;
				len = ctx->frag->len;
			} else {
				if (read_bytes == len) {
					ctx->frag = ctx->frag->frags;
				} else {
					net_buf_pull(ctx->frag, read_bytes);
				}

				ctx->remaining -= size;
				return size;
			}
		}
	} else {
		while (ctx->frag) {
			memcpy(buf + pos, ptr, len);
			pos += len;
			ctx->frag = ctx->frag->frags;
			if (!ctx->frag) {
				break;
			}

			ptr = ctx->frag->data;
			len = ctx->frag->len;
		}

		net_pkt_unref(ctx->rx_pkt);
		ctx->rx_pkt = NULL;
		ctx->frag = NULL;
		ctx->remaining = 0;

		if (read_bytes != pos) {
			return -EIO;
		}

		rc = read_bytes;
	}

	return rc;
}

static void ssl_accepted(struct net_context *context,
			 struct sockaddr *addr,
			 socklen_t addrlen, int error, void *user_data)
{
	int ret;
	struct ssl_context *ctx = user_data;

	ctx->net_ctx = context;
	ret = net_context_recv(context, ssl_received, 0, user_data);
	if (ret < 0) {
		printk("Cannot receive TCP packet (family %d)",
		       net_context_get_family(context));
	}

}

#if defined(CONFIG_NET_IPV6)
int ssl_init(struct ssl_context *ctx, void *addr)
{
	struct net_context *tcp_ctx = { 0 };
	struct sockaddr_in6 my_addr = { 0 };
	struct in6_addr *server_addr = addr;
	int rc;

	k_sem_init(&ctx->tx_sem, 0, UINT_MAX);
	k_fifo_init(&ctx->rx_fifo);

	my_mcast_addr.sin6_family = AF_INET6;

	net_ipaddr_copy(&my_addr.sin6_addr, server_addr);
	my_addr.sin6_family = AF_INET6;
	my_addr.sin6_port = htons(SERVER_PORT);

	rc = net_context_get(AF_INET6, SOCK_STREAM, IPPROTO_TCP, &tcp_ctx);
	if (rc < 0) {
		printk("Cannot get network context for IPv6 TCP (%d)", rc);
		return -EIO;
	}

	rc = net_context_bind(tcp_ctx, (struct sockaddr *)&my_addr,
			      sizeof(struct sockaddr_in6));
	if (rc < 0) {
		printk("Cannot bind IPv6 TCP port %d (%d)", SERVER_PORT, rc);
		goto error;
	}

	ctx->rx_pkt = NULL;
	ctx->remaining = 0;
	ctx->net_ctx = tcp_ctx;

	rc = net_context_listen(ctx->net_ctx, 0);
	if (rc < 0) {
		printk("Cannot listen IPv6 TCP (%d)", rc);
		return -EIO;
	}

	rc = net_context_accept(ctx->net_ctx, ssl_accepted, 0, ctx);
	if (rc < 0) {
		printk("Cannot accept IPv4 (%d)", rc);
		return -EIO;
	}

	return 0;

error:
	net_context_put(tcp_ctx);
	return -EINVAL;
}

#else
int ssl_init(struct ssl_context *ctx, void *addr)
{
	struct net_context *tcp_ctx = { 0 };
	struct sockaddr_in my_addr4 = { 0 };
	struct in_addr *server_addr = addr;
	int rc;

	k_sem_init(&ctx->tx_sem, 0, UINT_MAX);
	k_fifo_init(&ctx->rx_fifo);

	net_ipaddr_copy(&my_addr4.sin_addr, server_addr);
	my_addr4.sin_family = AF_INET;
	my_addr4.sin_port = htons(SERVER_PORT);

	rc = net_context_get(AF_INET, SOCK_STREAM, IPPROTO_TCP, &tcp_ctx);
	if (rc < 0) {
		printk("Cannot get network context for IPv4 TCP (%d)", rc);
		return -EIO;
	}

	rc = net_context_bind(tcp_ctx, (struct sockaddr *)&my_addr4,
			      sizeof(struct sockaddr_in));
	if (rc < 0) {
		printk("Cannot bind IPv4 TCP port %d (%d)", SERVER_PORT, rc);
		goto error;
	}

	ctx->rx_pkt = NULL;
	ctx->remaining = 0;
	ctx->net_ctx = tcp_ctx;

	rc = net_context_listen(ctx->net_ctx, 0);
	if (rc < 0) {
		printk("Cannot listen IPv4 (%d)", rc);
		return -EIO;
	}

	rc = net_context_accept(ctx->net_ctx, ssl_accepted, 0, ctx);
	if (rc < 0) {
		printk("Cannot accept IPv4 (%d)", rc);
		return -EIO;
	}

	return 0;

error:
	net_context_put(tcp_ctx);
	return -EINVAL;
}
#endif
```

## src/ssl_utils.h
```c
/*
 * Copyright (c) 2017 Intel Corporation
 *
 * SPDX-License-Identifier: Apache-2.0
 */

#ifndef _SSL_UTILS_H_
#define _SSL_UTILS_H_

#include <net/net_core.h>
#include <net/http_parser.h>

struct rx_fifo_block {
	sys_snode_t snode;
	struct k_mem_block block;
	struct net_buf *buf;
};

struct ssl_context {
	struct net_context *net_ctx;
	struct net_buf *rx_pkt;
	struct net_buf *frag;
	struct k_sem tx_sem;
	struct k_fifo rx_fifo;
	struct http_parser_settings parser_settings;
	struct http_parser parser;

	int remaining;
};

int ssl_init(struct ssl_context *ctx, void *addr);
int ssl_tx(void *ctx, const unsigned char *buf, size_t size);
int ssl_rx(void *ctx, unsigned char *buf, size_t size);

void https_server_start(void);

#endif
```

## src/test_certs.h
```c
/*
 * Copyright (c) 2016 Intel Corporation
 *
 * SPDX-License-Identifier: Apache-2.0
 */

#ifndef __TEST_CERTS_H__
#define __TEST_CERTS_H__

static const unsigned char rsa_example_keypair_der[] = {
	0x30, 0x82, 0x01, 0x3b, 0x02, 0x01, 0x00, 0x02, 0x41, 0x00, 0x9b, 0xfc,
	0x66, 0x90, 0x79, 0x84, 0x42, 0xbb, 0xab, 0x13, 0xfd, 0x2b, 0x7b, 0xf8,
	0xde, 0x15, 0x12, 0xe5, 0xf1, 0x93, 0xe3, 0x06, 0x8a, 0x7b, 0xb8, 0xb1,
	0xe1, 0x9e, 0x26, 0xbb, 0x95, 0x01, 0xbf, 0xe7, 0x30, 0xed, 0x64, 0x85,
	0x02, 0xdd, 0x15, 0x69, 0xa8, 0x34, 0xb0, 0x06, 0xec, 0x3f, 0x35, 0x3c,
	0x1e, 0x1b, 0x2b, 0x8f, 0xfa, 0x8f, 0x00, 0x1b, 0xdf, 0x07, 0xc6, 0xac,
	0x53, 0x07, 0x02, 0x03, 0x01, 0x00, 0x01, 0x02, 0x40, 0x1b, 0x4a, 0xf7,
	0x7b, 0x31, 0xf7, 0xe5, 0x61, 0x46, 0xd6, 0xd1, 0x86, 0x69, 0x43, 0xab,
	0x40, 0x0e, 0xb5, 0x73, 0x26, 0x88, 0x23, 0x9d, 0xd9, 0x76, 0x00, 0x91,
	0xd4, 0x85, 0x3c, 0x6f, 0x1e, 0xc0, 0x51, 0xeb, 0xe6, 0x90, 0x5b, 0x41,
	0x7f, 0xe6, 0xaa, 0x31, 0x6b, 0xac, 0x59, 0x53, 0x96, 0x26, 0xf1, 0xae,
	0xda, 0xbe, 0x55, 0xa4, 0x75, 0x40, 0x22, 0x5f, 0x27, 0x17, 0xa0, 0xd2,
	0x91, 0x02, 0x21, 0x00, 0xc8, 0xc4, 0x27, 0x7c, 0xd5, 0x61, 0xad, 0xbf,
	0x32, 0x8e, 0x1e, 0xcb, 0xe8, 0x94, 0xf4, 0x9f, 0x55, 0x77, 0xe5, 0xa8,
	0xc9, 0x70, 0xd0, 0x0f, 0x81, 0x04, 0xb7, 0x09, 0xb2, 0x1b, 0x53, 0xe9,
	0x02, 0x21, 0x00, 0xc6, 0xe6, 0x65, 0xbe, 0x10, 0xc8, 0x6d, 0xb7, 0x1e,
	0xee, 0x8e, 0x41, 0xbc, 0xe8, 0x67, 0x09, 0x9d, 0x8d, 0xee, 0x46, 0x1b,
	0xd5, 0x90, 0xb9, 0xee, 0x0d, 0xc5, 0xf9, 0xc6, 0xc9, 0xc9, 0x6f, 0x02,
	0x21, 0x00, 0x9b, 0xb0, 0x31, 0x87, 0x06, 0xda, 0x36, 0xa8, 0x9c, 0x85,
	0xc5, 0xb0, 0x0e, 0xee, 0xe4, 0x3c, 0x63, 0x45, 0x15, 0x1d, 0xad, 0x09,
	0x04, 0xef, 0xe0, 0xf7, 0x4d, 0x12, 0x01, 0xc2, 0x5b, 0x71, 0x02, 0x20,
	0x46, 0xd1, 0x25, 0x8c, 0x84, 0xa1, 0x38, 0x1f, 0x29, 0x0e, 0x3a, 0xec,
	0x40, 0xfc, 0x66, 0x23, 0x50, 0x4b, 0x86, 0x78, 0xc3, 0xd4, 0x48, 0x51,
	0x4a, 0xe6, 0xf0, 0x84, 0x3c, 0x39, 0x00, 0x55, 0x02, 0x21, 0x00, 0x8d,
	0x03, 0x6e, 0x29, 0x0e, 0xd7, 0x4e, 0x1f, 0x27, 0x70, 0xb5, 0x20, 0x79,
	0xfb, 0x31, 0x6a, 0x14, 0xb7, 0xe6, 0x55, 0x9a, 0x65, 0x40, 0xcf, 0xe0,
	0xe6, 0x46, 0xf8, 0xb2, 0x8e, 0xf4, 0x63, 0x0a
};

static const unsigned int rsa_example_keypair_der_len = 320;

static const unsigned char rsa_example_cert_der[] = {
	0x30, 0x82, 0x02, 0x12, 0x30, 0x82, 0x01, 0x7b, 0x02, 0x02, 0x0d, 0xfa,
	0x30, 0x0d, 0x06, 0x09, 0x2a, 0x86, 0x48, 0x86, 0xf7, 0x0d, 0x01, 0x01,
	0x05, 0x05, 0x00, 0x30, 0x81, 0x9b, 0x31, 0x0b, 0x30, 0x09, 0x06, 0x03,
	0x55, 0x04, 0x06, 0x13, 0x02, 0x4a, 0x50, 0x31, 0x0e, 0x30, 0x0c, 0x06,
	0x03, 0x55, 0x04, 0x08, 0x13, 0x05, 0x54, 0x6f, 0x6b, 0x79, 0x6f, 0x31,
	0x10, 0x30, 0x0e, 0x06, 0x03, 0x55, 0x04, 0x07, 0x13, 0x07, 0x43, 0x68,
	0x75, 0x6f, 0x2d, 0x6b, 0x75, 0x31, 0x11, 0x30, 0x0f, 0x06, 0x03, 0x55,
	0x04, 0x0a, 0x13, 0x08, 0x46, 0x72, 0x61, 0x6e, 0x6b, 0x34, 0x44, 0x44,
	0x31, 0x18, 0x30, 0x16, 0x06, 0x03, 0x55, 0x04, 0x0b, 0x13, 0x0f, 0x57,
	0x65, 0x62, 0x43, 0x65, 0x72, 0x74, 0x20, 0x53, 0x75, 0x70, 0x70, 0x6f,
	0x72, 0x74, 0x31, 0x18, 0x30, 0x16, 0x06, 0x03, 0x55, 0x04, 0x03, 0x13,
	0x0f, 0x46, 0x72, 0x61, 0x6e, 0x6b, 0x34, 0x44, 0x44, 0x20, 0x57, 0x65,
	0x62, 0x20, 0x43, 0x41, 0x31, 0x23, 0x30, 0x21, 0x06, 0x09, 0x2a, 0x86,
	0x48, 0x86, 0xf7, 0x0d, 0x01, 0x09, 0x01, 0x16, 0x14, 0x73, 0x75, 0x70,
	0x70, 0x6f, 0x72, 0x74, 0x40, 0x66, 0x72, 0x61, 0x6e, 0x6b, 0x34, 0x64,
	0x64, 0x2e, 0x63, 0x6f, 0x6d, 0x30, 0x1e, 0x17, 0x0d, 0x31, 0x32, 0x30,
	0x38, 0x32, 0x32, 0x30, 0x35, 0x32, 0x36, 0x35, 0x34, 0x5a, 0x17, 0x0d,
	0x31, 0x37, 0x30, 0x38, 0x32, 0x31, 0x30, 0x35, 0x32, 0x36, 0x35, 0x34,
	0x5a, 0x30, 0x4a, 0x31, 0x0b, 0x30, 0x09, 0x06, 0x03, 0x55, 0x04, 0x06,
	0x13, 0x02, 0x4a, 0x50, 0x31, 0x0e, 0x30, 0x0c, 0x06, 0x03, 0x55, 0x04,
	0x08, 0x0c, 0x05, 0x54, 0x6f, 0x6b, 0x79, 0x6f, 0x31, 0x11, 0x30, 0x0f,
	0x06, 0x03, 0x55, 0x04, 0x0a, 0x0c, 0x08, 0x46, 0x72, 0x61, 0x6e, 0x6b,
	0x34, 0x44, 0x44, 0x31, 0x18, 0x30, 0x16, 0x06, 0x03, 0x55, 0x04, 0x03,
	0x0c, 0x0f, 0x77, 0x77, 0x77, 0x2e, 0x65, 0x78, 0x61, 0x6d, 0x70, 0x6c,
	0x65, 0x2e, 0x63, 0x6f, 0x6d, 0x30, 0x5c, 0x30, 0x0d, 0x06, 0x09, 0x2a,
	0x86, 0x48, 0x86, 0xf7, 0x0d, 0x01, 0x01, 0x01, 0x05, 0x00, 0x03, 0x4b,
	0x00, 0x30, 0x48, 0x02, 0x41, 0x00, 0x9b, 0xfc, 0x66, 0x90, 0x79, 0x84,
	0x42, 0xbb, 0xab, 0x13, 0xfd, 0x2b, 0x7b, 0xf8, 0xde, 0x15, 0x12, 0xe5,
	0xf1, 0x93, 0xe3, 0x06, 0x8a, 0x7b, 0xb8, 0xb1, 0xe1, 0x9e, 0x26, 0xbb,
	0x95, 0x01, 0xbf, 0xe7, 0x30, 0xed, 0x64, 0x85, 0x02, 0xdd, 0x15, 0x69,
	0xa8, 0x34, 0xb0, 0x06, 0xec, 0x3f, 0x35, 0x3c, 0x1e, 0x1b, 0x2b, 0x8f,
	0xfa, 0x8f, 0x00, 0x1b, 0xdf, 0x07, 0xc6, 0xac, 0x53, 0x07, 0x02, 0x03,
	0x01, 0x00, 0x01, 0x30, 0x0d, 0x06, 0x09, 0x2a, 0x86, 0x48, 0x86, 0xf7,
	0x0d, 0x01, 0x01, 0x05, 0x05, 0x00, 0x03, 0x81, 0x81, 0x00, 0x14, 0xb6,
	0x4c, 0xbb, 0x81, 0x79, 0x33, 0xe6, 0x71, 0xa4, 0xda, 0x51, 0x6f, 0xcb,
	0x08, 0x1d, 0x8d, 0x60, 0xec, 0xbc, 0x18, 0xc7, 0x73, 0x47, 0x59, 0xb1,
	0xf2, 0x20, 0x48, 0xbb, 0x61, 0xfa, 0xfc, 0x4d, 0xad, 0x89, 0x8d, 0xd1,
	0x21, 0xeb, 0xd5, 0xd8, 0xe5, 0xba, 0xd6, 0xa6, 0x36, 0xfd, 0x74, 0x50,
	0x83, 0xb6, 0x0f, 0xc7, 0x1d, 0xdf, 0x7d, 0xe5, 0x2e, 0x81, 0x7f, 0x45,
	0xe0, 0x9f, 0xe2, 0x3e, 0x79, 0xee, 0xd7, 0x30, 0x31, 0xc7, 0x20, 0x72,
	0xd9, 0x58, 0x2e, 0x2a, 0xfe, 0x12, 0x5a, 0x34, 0x45, 0xa1, 0x19, 0x08,
	0x7c, 0x89, 0x47, 0x5f, 0x4a, 0x95, 0xbe, 0x23, 0x21, 0x4a, 0x53, 0x72,
	0xda, 0x2a, 0x05, 0x2f, 0x2e, 0xc9, 0x70, 0xf6, 0x5b, 0xfa, 0xfd, 0xdf,
	0xb4, 0x31, 0xb2, 0xc1, 0x4a, 0x9c, 0x06, 0x25, 0x43, 0xa1, 0xe6, 0xb4,
	0x1e, 0x7f, 0x86, 0x9b, 0x16, 0x40, 0x0a
};

static const unsigned int rsa_example_cert_der_len = 535;

#endif
```
