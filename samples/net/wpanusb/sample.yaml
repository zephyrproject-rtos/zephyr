## samples/net/wpanusb/sample.yaml
```yaml
sample:
  description: Test wpanusb sample
  name: wpanusb
common:
  depends_on: usb_device
  tags: net ieee802154 usb
  harness: net
  platform_exclude: pinnacle_100_dvk
tests:
  sample.net.wpanusb:
    filter: dt_chosen_enabled("zephyr,ieee802154")
    platform_exclude: thingy53/nrf5340/cpuapp/ns raytac_mdbt53_db_40/nrf5340/cpuapp/ns
                      raytac_mdbt53_db_40/nrf5340/cpuapp
  sample.net.wpanusb_frdm_cr20a:
    extra_args: SHIELD=frdm_cr20a
    platform_allow: frdm_k64f
```

## samples/net/ws_console/sample.yaml
```yaml
sample:
    name: Websocket console
tests:
   test:
        build_only: true
        platform_whitelist: qemu_x86 native_posix
        tags: net websocket
```

## samples/net/ws_echo_server/sample.yaml
```yaml
sample:
    name: Websocket echo-server
tests:
   test:
        build_only: true
        platform_whitelist: qemu_x86 qemu_cortex_m3 native_posix
        tags: net websocket
```

## samples/net/zperf/Kconfig
```kconfig
# Copyright 2023 NXP
# SPDX-License-Identifier: Apache-2.0

config NET_SAMPLE_CODE_RELOCATE
	bool "Relocate networking code into RAM"
	select CODE_DATA_RELOCATION
	help
	  Relocate networking code into RAM when running the zperf
	  sample. Can improve performance on platforms with fast code
	  RAM.

if NET_SAMPLE_CODE_RELOCATE

config NET_SAMPLE_CODE_RAM_NAME
	string "Networking code RAM location"
	default "RAM"
	help
	  Region to relocate networking code to

endif # NET_SAMPLE_CODE_RELOCATE

if USB_DEVICE_STACK_NEXT

# Source common USB sample options used to initialize new experimental USB
# device stack. The scope of these options is limited to USB samples in project
# tree, you cannot use them in your own application.
source "samples/subsys/usb/common/Kconfig.sample_usbd"

endif

configdefault NRF_WIFI_DATA_HEAP_SIZE
	default 30000 if NRF_WIFI_ZERO_COPY_TX
	default 50000

config ZPERF_LOOPBACK_SELFTEST
	bool "Self-driven loopback throughput run"
	depends on NET_ZPERF && NET_ZPERF_SERVER
	help
	  When enabled, the sample does not wait for shell input. Instead it
	  starts an in-guest UDP and TCP receiver on the loopback interface,
	  runs a client upload against it, and prints machine-parseable
	  throughput results ("ZPERF-RESULT ...") followed by a "ZPERF-DONE"
	  marker. Combined with QEMU icount mode this yields a deterministic,
	  host-speed-independent throughput regression metric.

if ZPERF_LOOPBACK_SELFTEST

config ZPERF_LOOPBACK_SELFTEST_DURATION_MS
	int "Loopback selftest transfer duration (ms)"
	default 1000
	help
	  Duration of each (UDP and TCP) upload run.

config ZPERF_LOOPBACK_SELFTEST_PACKET_SIZE
	int "Loopback selftest packet size (bytes)"
	default 1220
	range 1 16384
	help
	  Payload size used for each upload. Keep it small enough that the IP
	  packet (payload + IP + UDP headers) fits within CONFIG_NET_LOOPBACK_MTU
	  unless IP fragmentation is enabled, and below
	  CONFIG_NET_ZPERF_MAX_PACKET_SIZE. The default of 1220 is the IPv6 TCP
	  MSS at a 1280 byte MTU (1280 - 40 IPv6 - 20 TCP): with it every write
	  is one full-sized segment for both IPv4 and IPv6, so TCP throughput is
	  comparable across families. Larger values (e.g. 1232) still fit the
	  IPv4 MSS but exceed the IPv6 MSS, which splits each IPv6 write into a
	  full segment plus a tiny runt and roughly halves IPv6 TCP throughput.
	  Near-MTU packets also better expose data-touching costs (checksums,
	  buffer walking) than tiny packets.

config ZPERF_LOOPBACK_SELFTEST_FRAG_PACKET_SIZE
	int "Loopback selftest fragmented-run payload size (bytes)"
	default 2000
	range 1 16384
	help
	  Payload size for the extra UDP runs that intentionally exceed
	  CONFIG_NET_LOOPBACK_MTU to exercise IP fragmentation and reassembly.
	  These runs are only performed when CONFIG_NET_IPV4_FRAGMENT /
	  CONFIG_NET_IPV6_FRAGMENT are enabled. Keep it above the MTU (so the
	  datagram actually fragments) and below CONFIG_NET_ZPERF_MAX_PACKET_SIZE.

config ZPERF_LOOPBACK_SELFTEST_RATE_KBPS
	int "Loopback selftest target rate (kbps)"
	default 0
	help
	  Target upload rate in kbps. Use 0 to send as fast as possible (best
	  for measuring the maximum throughput / catching CPU-cost regressions).

config ZPERF_LOOPBACK_SELFTEST_PORT
	int "Loopback selftest server port"
	default 5001

endif # ZPERF_LOOPBACK_SELFTEST

source "Kconfig.zephyr"
```

## samples/net/zperf/boards/am62l_evm.conf
```kconfig
# Network support
CONFIG_NET_BUF_DATA_SIZE=1520
CONFIG_NET_L2_ETHERNET_MGMT=y

# IPv4 and IPv6 slots for two MAC Ports of CPSW3G
CONFIG_NET_IF_MAX_IPV4_COUNT=2
CONFIG_NET_IF_MAX_IPV6_COUNT=2

# Default KERNEL_VM_SIZE of 2 MB is insufficient
CONFIG_KERNEL_VM_SIZE=0x1000000

# Since 14 XLAT_TABLES are used by this sample, the default
# MAX_XLAT_TABLES value of 16 throws a warning.
# Increase it to 20 to future-proof the sample, since other
# peripherals may be added to the board later on and could
# require more tables.
CONFIG_MAX_XLAT_TABLES=20
```

## samples/net/zperf/boards/esp32p4x_function_ev_board_hpcore.conf
```kconfig
# Pin TCP windows - biggest single perf knob
CONFIG_NET_TCP_MAX_RECV_WINDOW_SIZE=32768
CONFIG_NET_TCP_MAX_SEND_WINDOW_SIZE=32768
```

## samples/net/zperf/boards/frdm_rw612.conf
```kconfig
CONFIG_WIFI_NXP=y
CONFIG_NXP_RW610=y
CONFIG_NXP_WIFI_SHELL=y

CONFIG_WIFI_NM_WPA_SUPPLICANT=y

# stack size
CONFIG_SHELL_STACK_SIZE=6144
CONFIG_SYSTEM_WORKQUEUE_STACK_SIZE=2048
CONFIG_NET_MGMT_EVENT_STACK_SIZE=4608
CONFIG_NET_TCP_WORKQ_STACK_SIZE=2048
CONFIG_MAIN_STACK_SIZE=4096
CONFIG_NET_SOCKETS_SERVICE_STACK_SIZE=4096
CONFIG_WIFI_NM_WPA_SUPPLICANT_WQ_STACK_SIZE=12288
CONFIG_WIFI_NM_WPA_SUPPLICANT_THREAD_STACK_SIZE=12288
```

## samples/net/zperf/boards/fvp_base_revc_2xaem_v8a.conf
```kconfig
CONFIG_NET_DHCPV4=y
CONFIG_NET_IPV6=n
CONFIG_NET_CONFIG_MY_IPV4_ADDR=""
CONFIG_NET_CONFIG_PEER_IPV4_ADDR=""
CONFIG_NET_BUF_RX_COUNT=56
CONFIG_NET_BUF_TX_COUNT=56
```

## samples/net/zperf/boards/fvp_base_revc_2xaemv8a.conf
```kconfig
CONFIG_NET_DHCPV4=y
CONFIG_MDIO=y
CONFIG_MDIO_SHELL=n
CONFIG_NET_IPV6=n
CONFIG_NET_CONFIG_MY_IPV4_ADDR=""
CONFIG_NET_CONFIG_PEER_IPV4_ADDR=""
CONFIG_MDIO_INIT_PRIORITY=81
CONFIG_PHY_INIT_PRIORITY=82
CONFIG_NET_BUF_RX_COUNT=56
CONFIG_NET_BUF_TX_COUNT=56
```

## samples/net/zperf/boards/fvp_baser_aemv8r_fvp_aemv8r_aarch64.conf
```kconfig
CONFIG_NET_DHCPV4=y
CONFIG_NET_IPV6=n
CONFIG_NET_CONFIG_MY_IPV4_ADDR=""
CONFIG_NET_CONFIG_PEER_IPV4_ADDR=""
```

## samples/net/zperf/boards/intel_adl_crb.conf
```kconfig
#
# Ethernet Drivers
#
CONFIG_ETH_INTEL_PLAT=y
CONFIG_ETH_INTEL_IGC=y

#
# Link layer options
#
CONFIG_NET_L2_ETHERNET=y

CONFIG_NET_PKT_RX_COUNT=512
CONFIG_NET_PKT_TX_COUNT=512
CONFIG_NET_BUF_RX_COUNT=512
CONFIG_NET_BUF_TX_COUNT=512
CONFIG_NET_BUF_DATA_SIZE=1024

#
# Increase stack usage for stability
#
CONFIG_NET_TX_STACK_SIZE=8192
CONFIG_NET_RX_STACK_SIZE=8192
CONFIG_NET_TCP_WORKQ_STACK_SIZE=8192
CONFIG_NET_MGMT_EVENT_STACK_SIZE=8192
CONFIG_NET_SOCKETS_SERVICE=y
CONFIG_NET_SOCKETS_SERVICE_STACK_SIZE=8192

#
# IP stack
#
CONFIG_NET_IPV4_FRAGMENT=y
CONFIG_NET_STATISTICS_ETHERNET=n

# Disable VTD_ICTL until have IOMMU support.
CONFIG_INTEL_VTD_ICTL=n
```

## samples/net/zperf/boards/kit_pse84_eval_pse846gps2dbzc4a_m55.conf
```kconfig
# SPDX-FileCopyrightText: Copyright (c) 2026 Infineon Technologies AG
# SPDX-License-Identifier: Apache-2.0

# WiFi driver + shell (connect via: wifi connect -s <SSID> -p <PSK> -k 1)
CONFIG_WIFI=y
CONFIG_NET_L2_WIFI_SHELL=y

# DHCP: override prj.conf static-IP default; auto-restart on STA connect
CONFIG_NET_DHCPV4=y
CONFIG_WIFI_STA_AUTO_DHCPV4=y
CONFIG_NET_CONFIG_MY_IPV4_ADDR=""

# M55 stack sizes
CONFIG_SHELL_STACK_SIZE=6144
CONFIG_SYSTEM_WORKQUEUE_STACK_SIZE=2048
CONFIG_NET_MGMT_EVENT_STACK_SIZE=4608
CONFIG_NET_TCP_WORKQ_STACK_SIZE=2048
CONFIG_IDLE_STACK_SIZE=1024

# Packet/buffer sizing: 1514-byte bufs fit one Ethernet frame; reduce counts
# to stay within M55 heap budget.
CONFIG_NET_BUF_DATA_SIZE=1514
CONFIG_NET_ZPERF_MAX_PACKET_SIZE=1514
CONFIG_NET_PKT_RX_COUNT=20
CONFIG_NET_BUF_RX_COUNT=20
CONFIG_NET_PKT_TX_COUNT=20
CONFIG_NET_BUF_TX_COUNT=20

# TCP window sizing for WiFi throughput
CONFIG_NET_TCP_MAX_SEND_WINDOW_SIZE=32120
CONFIG_NET_TCP_MAX_RECV_WINDOW_SIZE=36500

# Socket service thread must be preemptible so WHD RX thread can run
CONFIG_NET_SOCKETS_SERVICE_THREAD_PRIO=15

# WiFi + general stats for monitoring
CONFIG_NET_STATISTICS_WIFI=y
CONFIG_NET_STATISTICS_USER_API=y
```

## samples/net/zperf/boards/max78000fthr_max78000_m4.conf
```kconfig
# Copyright (c) 2026 Analog Devices, Inc.
# SPDX-License-Identifier: Apache-2.0

CONFIG_NET_PKT_RX_COUNT=14
CONFIG_NET_PKT_TX_COUNT=8
CONFIG_NET_BUF_RX_COUNT=20
CONFIG_NET_BUF_TX_COUNT=12
CONFIG_NET_BUF_DATA_SIZE=1515
CONFIG_NET_BUF_FIXED_DATA_SIZE=y

CONFIG_NET_IPV6=n
CONFIG_NET_CONFIG_NEED_IPV6=n

CONFIG_NET_TCP_MAX_RECV_WINDOW_SIZE=14140

# Fragmentation only properly working on max78000fth at <= 8.5 Mbits/s,
# because of the limited RAM availability; disabled by default

# CONFIG_NET_IPV4_FRAGMENT=y
# CONFIG_NET_IPV4_FRAGMENT_MAX_COUNT=8
# CONFIG_NET_IPV4_FRAGMENT_MAX_PKT=2
# CONFIG_NET_IPV4_FRAGMENT_TIMEOUT=2

CONFIG_ETHERNET_LOG_LEVEL_WRN=y
```

## samples/net/zperf/boards/mimxrt1050_evk.conf
```kconfig
# Note: HW accleration does not support IPV6
CONFIG_ETH_MCUX_HW_ACCELERATION=y
CONFIG_NET_CODE_RELOCATE=y
```

## samples/net/zperf/boards/mimxrt1050_evk_mimxrt1052_hyperflash.conf
```kconfig
# Note: HW accleration does not support IPV6
CONFIG_ETH_NXP_ENET_HW_ACCELERATION=y
CONFIG_NET_SAMPLE_CODE_RELOCATE=y
CONFIG_NET_SAMPLE_CODE_RAM_NAME="ITCM"
```

## samples/net/zperf/boards/mimxrt1060_evk.conf
```kconfig
# Note: HW accleration does not support IPV6
CONFIG_ETH_MCUX_HW_ACCELERATION=y
CONFIG_NET_SAMPLE_CODE_RELOCATE=y
CONFIG_NET_SAMPLE_CODE_RAM_NAME="ITCM"
```

## samples/net/zperf/boards/mr_canhubk3.conf
```kconfig
# Copyright 2023 NXP
# SPDX-License-Identifier: Apache-2.0

CONFIG_ASSERT=n
CONFIG_LOG=n
CONFIG_NET_LOG=n
CONFIG_NET_IP_ADDR_CHECK=n
CONFIG_SPEED_OPTIMIZATIONS=y
CONFIG_NET_ZPERF_MAX_PACKET_SIZE=1470
```

## samples/net/zperf/boards/nucleo_g474re.conf
```kconfig
#
# Copyright (c) 2026, Łukasz Majewski
#
# SPDX-License-Identifier: Apache-2.0
#

# Generic
CONFIG_CACHE_MANAGEMENT=n

# Generic networking options
CONFIG_NET_CONNECTION_MANAGER=y

# Kernel options
CONFIG_HEAP_MEM_POOL_SIZE=512
CONFIG_ISR_STACK_SIZE=1024
CONFIG_MAIN_STACK_SIZE=3584

# Network buffers
CONFIG_NET_PKT_RX_COUNT=8
CONFIG_NET_PKT_TX_COUNT=16
CONFIG_NET_BUF_RX_COUNT=64
CONFIG_NET_BUF_TX_COUNT=128
CONFIG_NET_CONTEXT_NET_PKT_POOL=y

# Shell
CONFIG_SHELL=y
CONFIG_SHELL_ARGC_MAX=8
CONFIG_SHELL_HISTORY_BUFFER=128

# LAN865x T1S driver specific
CONFIG_ETH_LAN865X=y
CONFIG_NET_BUF_DATA_SIZE=128

# Debugging
CONFIG_DEBUG_OPTIMIZATIONS=y
CONFIG_DEBUG_THREAD_INFO=y

CONFIG_NET_DEBUG_NET_PKT_ALLOC=y
CONFIG_NET_BUF_POOL_USAGE=y
CONFIG_NET_ICMPV4_LOG_LEVEL_INF=y
```

## samples/net/zperf/boards/quark_se_c1000_devboard.conf
```kconfig
CONFIG_NET_L2_IEEE802154=y
CONFIG_IEEE802154_CC2520=y
CONFIG_NET_6LO_CONTEXT=y

CONFIG_NET_PKT_RX_COUNT=24
CONFIG_NET_PKT_TX_COUNT=24
CONFIG_NET_BUF_RX_COUNT=48
CONFIG_NET_BUF_TX_COUNT=48
CONFIG_NET_BUF_DATA_SIZE=128

CONFIG_SHELL_CMDS_RESIZE=n
```

## samples/net/zperf/boards/siwx917_rb4338a.conf
```kconfig
# Use the socket service thread low-priority and preemptive.
# The default (-1) is cooperative and can starve lower-layer Wi-Fi/network
# processing under heavy RX load, which reduces zperf TCP/UDP throughput.
CONFIG_NET_SOCKETS_SERVICE_THREAD_PRIO=15

#shell stack size
CONFIG_SHELL_STACK_SIZE=3072

# Wi-Fi
CONFIG_WIFI=y
CONFIG_NET_L2_WIFI_SHELL=y
CONFIG_WIFI_SILABS_SIWX91X_MFP=n

# Buffer / TCP tuning
CONFIG_NET_BUF_DATA_SIZE=1514
CONFIG_NET_TCP_MAX_SEND_WINDOW_SIZE=32120
CONFIG_NET_TCP_MAX_RECV_WINDOW_SIZE=36500
CONFIG_NET_PKT_RX_COUNT=30
CONFIG_NET_BUF_RX_COUNT=30
CONFIG_NET_PKT_TX_COUNT=30
CONFIG_NET_BUF_TX_COUNT=30
CONFIG_NET_BUF_POOL_USAGE=y
CONFIG_NET_ZPERF_MAX_PACKET_SIZE=1514

CONFIG_SILABS_SIWX91X_SLOW_FLASH_DATA=y
# `CONFIG_SILABS_SIWX91X_SLOW_FLASH_DATA` improves SiWx91x performance by using
# `-mslow-flash-data`, but with the current Arm GCC toolchain that is not fully
# compatible with thread-local storage accesses. Hence, disable it.
CONFIG_THREAD_LOCAL_STORAGE=n

# Performance (logging / asserts off)
CONFIG_ASSERT=n
CONFIG_LOG=n
CONFIG_NET_LOG=n
CONFIG_SRAM_SW_ISR_TABLE=y
CONFIG_SRAM_VECTOR_TABLE=y
```

## samples/net/zperf/sample.yaml
```yaml
common:
  tags:
    - net
    - zperf
  platform_exclude:
    - sam_e70_xplained/same70q21
  min_ram: 64
sample:
  description: Network performance measurement tool for Zephyr
  name: zperf
tests:
  sample.net.zperf:
    harness: net
    platform_allow: qemu_x86
  sample.net.zperf_no_server:
    harness: net
    platform_allow: qemu_x86
    extra_configs:
      - CONFIG_NET_ZPERF_SERVER=n
  sample.net.zperf_st:
    harness: console
    harness_config:
      type: multi_line
      regex:
        - "coming up"
    platform_allow:
      - nucleo_h563zi
      - nucleo_h743zi
      - nucleo_f429zi
      - nucleo_f746zg
      - stm32h573i_dk
    integration_platforms:
      - stm32h573i_dk
  sample.net.zperf_no_shell:
    harness: net
    extra_configs:
      - CONFIG_NET_SHELL=n
    platform_allow: qemu_x86
  sample.net.zperf_concurrent_upload:
    harness: net
    extra_configs:
      - CONFIG_ZPERF_SESSION_PER_THREAD=y
    platform_allow: qemu_x86
  sample.net.zperf.usbd_cdc_ecm:
    harness: net
    extra_args:
      - EXTRA_CONF_FILE="overlay-usbd.conf"
      - DTC_OVERLAY_FILE="usbd_cdc_ecm.overlay"
    platform_allow:
      - nrf52840dk/nrf52840
      - frdm_k64f
    tags:
      - usb
      - net
      - zperf
    depends_on: usbd
  sample.net.zperf.usbd_cdc_ncm:
    harness: net
    extra_args:
      - EXTRA_CONF_FILE="overlay-usbd.conf"
      - DTC_OVERLAY_FILE="usbd_cdc_ncm.overlay"
    platform_allow:
      - nrf52840dk/nrf52840
      - frdm_k64f
    tags:
      - usb
      - net
      - zperf
    depends_on: usbd
  sample.net.zperf.shield:
    harness: net
    platform_allow: reel_board
    extra_args: SHIELD=link_board_eth
    tags:
      - shield
      - net
      - zperf
    depends_on:
      - arduino_spi
      - arduino_gpio
  sample.net.zperf.nxp_enet1g:
    extra_args: EXTRA_DTC_OVERLAY_FILE="nxp,enet1g.overlay"
    tags:
      - net
      - zperf
    platform_allow:
      - mimxrt1170_evk/mimxrt1176/cm7
  sample.net.zperf.802154.subg:
    extra_args: EXTRA_CONF_FILE="overlay-802154-subg.conf"
    platform_allow: beagleconnect_freedom
  sample.net.zperf.nrf7002dk:
    extra_args: SNIPPET=wifi-ipv4
    extra_configs:
      - CONFIG_BUILD_ONLY_NO_BLOBS=y
    platform_allow: nrf7002dk/nrf5340/cpuapp
```

## samples/net/zstream/big_http_download/sample.yaml
```yaml
sample:
  description: Zstream API big HTTP download example
  name: big_http_download
tests:
  test:
    harness: net
    min_ram: 110
    min_flash: 192
    # Even with lots of RAM/flash, runs out of it
    platform_exclude: minnowboard
    tags: net
```

## samples/nfc/nfc_hello/sample.yaml
```yaml
sample:
  description: Test an elementary signal-through with NFC module connected to the second UART.
  name: NFC Sample
tests:
  sample.nfc.hello:
    filter: CONFIG_SERIAL_SUPPORT_INTERRUPT
    tags: nfc
    integration:
      - frdm_k64f
    harness: nfc
```
