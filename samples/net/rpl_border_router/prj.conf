## CMakeLists.txt
```
cmake_minimum_required(VERSION 3.13.1)
include($ENV{ZEPHYR_BASE}/cmake/app/boilerplate.cmake NO_POLICY_SCOPE)
project(rpl_border_router)

FILE(GLOB app_sources src/*.c)
target_sources(app PRIVATE ${app_sources})

include($ENV{ZEPHYR_BASE}/samples/net/common/common.cmake)

set(gen_dir ${ZEPHYR_BINARY_DIR}/include/generated/)

# List of files that are used to generate .h file that can be included
# into .c file.
foreach(inc_file
	echo-apps-cert.der
	echo-apps-key.der
    )
  generate_inc_file_for_target(
    app
    src/${inc_file}
    ${gen_dir}/${inc_file}.inc
    )
endforeach()

foreach(inc_file
	index.html
	style.css
	favicon.ico
	br.js
    )
  generate_inc_file_for_target(
    app
    src/${inc_file}
    ${gen_dir}/${inc_file}.gz.inc
    --gzip
    )
endforeach()

target_include_directories(app PRIVATE $ENV{ZEPHYR_BASE}/subsys/net/ip)
```

## sample.yaml
```
common:
  harness: net
  tags: net rpl ieee802154 ethernet
  platform_whitelist: frdm_k64f
sample:
  description: Can be used to form RPL network. Needs
    to be run in real device. This cannot be run in
    QEMU.
  name: RPL Border Router demo application
tests:
  test_frdm_k64f_mcr20a:
    extra_args: CONF_FILE="prj_frdm_k64f_mcr20a.conf"
```

## prj.conf
```kconfig
# Note that this configuration file does not provide usable system.
# It is only used to verify the compilation of the application.

# Generic IP stack options and features
CONFIG_NETWORKING=y
CONFIG_NET_TCP=y
CONFIG_NET_UDP=y
CONFIG_RANDOM_GENERATOR=y
CONFIG_TEST_RANDOM_GENERATOR=y
CONFIG_NET_LOG=y
CONFIG_INIT_STACKS=y
CONFIG_NET_SHELL=y
CONFIG_NET_STATISTICS=y
CONFIG_NET_MAX_CONTEXTS=8
CONFIG_NET_IPV6=y
CONFIG_NET_IPV4=y
#CONFIG_NET_DHCPV4=y

# Number of network buffers
CONFIG_NET_PKT_RX_COUNT=128
CONFIG_NET_PKT_TX_COUNT=128
CONFIG_NET_BUF_RX_COUNT=128
CONFIG_NET_BUF_TX_COUNT=128

# IPv6 address counts
CONFIG_NET_IF_UNICAST_IPV6_ADDR_COUNT=4
CONFIG_NET_IF_MCAST_IPV6_ADDR_COUNT=5

# IPv6 neighbors/routes count
CONFIG_NET_IPV6_MAX_NEIGHBORS=8

# RPL and routing options
CONFIG_NET_RPL=y
CONFIG_NET_ROUTE=y
CONFIG_NET_ROUTING=y
# This is used as a prefix when creating DAG.
CONFIG_NET_RPL_PREFIX="fd77:d528:ae6a:6df6::1/64"

# HTTP(S) admin interface
CONFIG_HTTP=y
CONFIG_HTTPS=n
CONFIG_HTTP_APP=y
CONFIG_NET_APP_SERVER=y
CONFIG_HTTP_SERVER=y
# Firefox sends lot of fields so this needs to be quite large
CONFIG_HTTP_HEADERS=20
CONFIG_HTTP_SERVER_NUM_URLS=8
CONFIG_WEBSOCKET=y

# Crypto support
CONFIG_MBEDTLS=y
CONFIG_MBEDTLS_BUILTIN=y
CONFIG_MBEDTLS_CFG_FILE="config-mini-tls1_2.h"
CONFIG_MBEDTLS_ENABLE_HEAP=y
CONFIG_MBEDTLS_HEAP_SIZE=30000

# Logging
CONFIG_SYS_LOG_SHOW_COLOR=y
CONFIG_SYS_LOG_NET_LEVEL=1

# Debugging
CONFIG_NET_DEBUG_WEBSOCKET=y
CONFIG_NET_DEBUG_HTTP=y
CONFIG_NET_DEBUG_HTTP_CONN=y
CONFIG_NET_DEBUG_RPL=y
CONFIG_NET_DEBUG_ROUTE=y

# Network application settings
CONFIG_NET_APP_SETTINGS=y
CONFIG_NET_APP_NEED_IPV6=y
CONFIG_NET_APP_NEED_IPV4=y
# This is the ethernet interface setting for admin purposes
CONFIG_NET_APP_MY_IPV6_ADDR="2001:db8::1"
CONFIG_NET_APP_MY_IPV4_ADDR="192.0.2.1"
```

## prj_frdm_k64f_cc2520.conf
```kconfig
# Generic IP stack options and features
CONFIG_NETWORKING=y
CONFIG_NET_TCP=y
CONFIG_NET_UDP=y
CONFIG_ENTROPY_GENERATOR=y
CONFIG_TEST_RANDOM_GENERATOR=y
CONFIG_NET_LOG=y
CONFIG_INIT_STACKS=y
CONFIG_NET_SHELL=y
CONFIG_NET_STATISTICS=y
CONFIG_NET_MAX_CONTEXTS=16
CONFIG_NET_IPV6=y
CONFIG_NET_IPV4=y
#CONFIG_NET_DHCPV4=y

# Number of network buffers
CONFIG_NET_PKT_RX_COUNT=128
CONFIG_NET_PKT_TX_COUNT=128
CONFIG_NET_BUF_RX_COUNT=128
CONFIG_NET_BUF_TX_COUNT=128

# IPv6 address counts
CONFIG_NET_IF_UNICAST_IPV6_ADDR_COUNT=4
CONFIG_NET_IF_MCAST_IPV6_ADDR_COUNT=5

# IPv6 neighbors/routes count. This determines how many nodes
# our RPL network can have.
CONFIG_NET_IPV6_MAX_NEIGHBORS=128

# RPL and routing options
CONFIG_NET_RPL=y
CONFIG_NET_ROUTE=y
CONFIG_NET_ROUTING=y
CONFIG_NET_RPL_L2_IEEE802154=y
# This is used as a prefix when creating DAG. You can pick your own
# prefix here, better not to use this exact value.
CONFIG_NET_RPL_PREFIX="fde3:2cda:3eea:4d14::1/64"

# HTTP(S) admin and websocket interface support
CONFIG_HTTP=y
CONFIG_HTTPS=n
CONFIG_HTTP_SERVER=y
CONFIG_HTTP_SERVER_NUM_URLS=8
CONFIG_WEBSOCKET=y
CONFIG_WEBSOCKET_CONSOLE=y

# Allow two concurrent incoming connections
CONFIG_NET_TCP_BACKLOG_SIZE=2
CONFIG_NET_APP_SERVER_NUM_CONN=2

# Crypto support
CONFIG_MBEDTLS=y
CONFIG_MBEDTLS_BUILTIN=y
CONFIG_MBEDTLS_CFG_FILE="config-mini-tls1_2.h"
CONFIG_MBEDTLS_ENABLE_HEAP=y
CONFIG_MBEDTLS_HEAP_SIZE=12000

# Logging
CONFIG_SYS_LOG_SHOW_COLOR=y
CONFIG_SYS_LOG_NET_LEVEL=4
CONFIG_SYS_LOG_IEEE802154_DRIVER_LEVEL=0

# Debugging
CONFIG_NET_DEBUG_NET_PKT=y
CONFIG_NET_DEBUG_WEBSOCKET=y
CONFIG_NET_DEBUG_RPL=n
CONFIG_NET_DEBUG_ROUTE=n
CONFIG_NET_DEBUG_APP=y
CONFIG_NET_DEBUG_IPV6=n
CONFIG_NET_DEBUG_IPV6_NBR_CACHE=n
CONFIG_NET_DEBUG_CONTEXT=n
CONFIG_NET_DEBUG_TCP=n
CONFIG_NET_DEBUG_CONN=n
CONFIG_NET_DEBUG_HTTP=y
CONFIG_MBEDTLS_DEBUG=n

# Network application settings
CONFIG_NET_APP_SETTINGS=y
CONFIG_NET_APP_NEED_IPV6=y
CONFIG_NET_APP_NEED_IPV4=y
# This is the ethernet interface setting for admin purposes
CONFIG_NET_APP_MY_IPV6_ADDR="2001:db8::1"
CONFIG_NET_APP_MY_IPV4_ADDR="192.0.2.1"

# Set a proper hostname for the router
CONFIG_NET_HOSTNAME_ENABLE=y

# mDNS support is activated. After this one can connect to this device
# by zephyr.local name
CONFIG_MDNS_RESPONDER=y

# IEEE 802.15.4 options
CONFIG_NET_L2_IEEE802154_SHELL=y
CONFIG_NET_L2_IEEE802154=y
CONFIG_NET_L2_IEEE802154_FRAGMENT=y
CONFIG_NET_APP_IEEE802154_CHANNEL=26
CONFIG_NET_APP_IEEE802154_DEV_NAME="cc2520"
CONFIG_IEEE802154_CC2520=y

# IPv6 compression is needed for IEEE 802.15.4
CONFIG_NET_6LO=y
CONFIG_NET_6LO_CONTEXT=y

# CC2520 options
CONFIG_IEEE802154_CC2520_AUTO_ACK=y
CONFIG_IEEE802154_CC2520_SPI_DRV_NAME="SPI_0"
CONFIG_IEEE802154_CC2520_SPI_FREQ=4000000
CONFIG_IEEE802154_CC2520_SPI_SLAVE=0
CONFIG_GPIO=y
CONFIG_SPI=y
CONFIG_SPI_0=y
```

## prj_frdm_k64f_cc2520_tls.conf
```kconfig
# Generic IP stack options and features
CONFIG_NETWORKING=y
CONFIG_NET_TCP=y
CONFIG_NET_UDP=y
CONFIG_RANDOM_GENERATOR=y
CONFIG_TEST_RANDOM_GENERATOR=y
CONFIG_NET_LOG=y
CONFIG_INIT_STACKS=y
CONFIG_NET_SHELL=y
CONFIG_NET_STATISTICS=y
CONFIG_NET_MAX_CONTEXTS=16
CONFIG_NET_IPV6=y
CONFIG_NET_IPV4=y
#CONFIG_NET_DHCPV4=y

# Number of network buffers
CONFIG_NET_PKT_RX_COUNT=128
CONFIG_NET_PKT_TX_COUNT=128
CONFIG_NET_BUF_RX_COUNT=128
CONFIG_NET_BUF_TX_COUNT=128

# IPv6 address counts
CONFIG_NET_IF_UNICAST_IPV6_ADDR_COUNT=4
CONFIG_NET_IF_MCAST_IPV6_ADDR_COUNT=5

# IPv6 neighbors/routes count. This determines how many nodes
# our RPL network can have.
CONFIG_NET_IPV6_MAX_NEIGHBORS=128

# RPL and routing options
CONFIG_NET_RPL=y
CONFIG_NET_ROUTE=y
CONFIG_NET_ROUTING=y
CONFIG_NET_RPL_L2_IEEE802154=y
# This is used as a prefix when creating DAG.
CONFIG_NET_RPL_PREFIX="fde3:2cda:3eea:4d14::1/64"

# HTTP(S) admin and websocket interface support
CONFIG_HTTP=y
CONFIG_HTTPS=y
CONFIG_HTTP_APP=y
CONFIG_NET_APP_SERVER=y
CONFIG_HTTP_SERVER=y
# Firefox sends lot of fields to this needs to be quite large
CONFIG_HTTP_HEADERS=20
CONFIG_HTTP_SERVER_NUM_URLS=8
CONFIG_WEBSOCKET=y

# Crypto support
CONFIG_MBEDTLS=y
CONFIG_MBEDTLS_BUILTIN=y
CONFIG_MBEDTLS_CFG_FILE="config-mini-tls1_2.h"
CONFIG_MBEDTLS_ENABLE_HEAP=y
CONFIG_MBEDTLS_HEAP_SIZE=28500

# Logging
CONFIG_SYS_LOG_SHOW_COLOR=y
CONFIG_SYS_LOG_NET_LEVEL=4
CONFIG_SYS_LOG_IEEE802154_DRIVER_LEVEL=0

# Debugging
CONFIG_NET_DEBUG_WEBSOCKET=y
CONFIG_NET_DEBUG_RPL=n
CONFIG_NET_DEBUG_ROUTE=n
CONFIG_NET_DEBUG_APP=y
CONFIG_NET_DEBUG_HTTP=y
CONFIG_NET_DEBUG_IPV6=n
CONFIG_NET_DEBUG_L2_ETHERNET=n
CONFIG_NET_DEBUG_IPV6_NBR_CACHE=n
CONFIG_NET_DEBUG_CONTEXT=n
CONFIG_NET_DEBUG_TCP=n
CONFIG_NET_DEBUG_IF=n
CONFIG_NET_DEBUG_CORE=n
CONFIG_NET_DEBUG_NET_PKT=y
CONFIG_NET_DEBUG_CONN=n
CONFIG_MBEDTLS_DEBUG=n

# Network application settings
CONFIG_NET_APP_SETTINGS=y
CONFIG_NET_APP_NEED_IPV6=y
CONFIG_NET_APP_NEED_IPV4=y
# This is the ethernet interface setting for admin purposes
CONFIG_NET_APP_MY_IPV6_ADDR="2001:db8::1"
CONFIG_NET_APP_MY_IPV4_ADDR="192.0.2.1"

# Allow one concurrent connection. This is mandatory for HTTPS.
# You can increase the limit for plain HTTP.
CONFIG_NET_TCP_BACKLOG_SIZE=1
CONFIG_NET_APP_SERVER_NUM_CONN=1

# IEEE 802.15.4 options
CONFIG_NET_L2_IEEE802154_SHELL=y
CONFIG_NET_L2_IEEE802154=y
CONFIG_NET_L2_IEEE802154_FRAGMENT=y
CONFIG_NET_APP_IEEE802154_CHANNEL=15
CONFIG_NET_APP_IEEE802154_DEV_NAME="cc2520"
CONFIG_IEEE802154_CC2520=y

# IPv6 compression is needed for IEEE 802.15.4
CONFIG_NET_6LO=y
CONFIG_NET_6LO_CONTEXT=y

# CC2520 options
CONFIG_IEEE802154_CC2520_AUTO_ACK=y
CONFIG_IEEE802154_CC2520_SPI_DRV_NAME="SPI_0"
CONFIG_IEEE802154_CC2520_SPI_FREQ=4000000
CONFIG_IEEE802154_CC2520_SPI_SLAVE=0
CONFIG_GPIO=y
CONFIG_SPI=y
CONFIG_SPI_0=y
```

## prj_frdm_k64f_mcr20a.conf
```kconfig
# Generic IP stack options and features
CONFIG_NETWORKING=y
CONFIG_NET_TCP=y
CONFIG_NET_UDP=y
CONFIG_ENTROPY_GENERATOR=y
CONFIG_TEST_RANDOM_GENERATOR=y
CONFIG_INIT_STACKS=y
CONFIG_NET_SHELL=y
CONFIG_NET_STATISTICS=y
CONFIG_NET_MAX_CONTEXTS=16
CONFIG_NET_IPV6=y
CONFIG_NET_IPV4=y
CONFIG_NET_DHCPV4=n

CONFIG_NET_RX_STACK_SIZE=2048

# Number of network buffers
CONFIG_NET_PKT_RX_COUNT=80
CONFIG_NET_PKT_TX_COUNT=80
CONFIG_NET_BUF_RX_COUNT=80
CONFIG_NET_BUF_TX_COUNT=80

# Number of IPv6 Network Interfaces
CONFIG_NET_IF_MAX_IPV6_COUNT=2

# IPv6 address counts
CONFIG_NET_IF_UNICAST_IPV6_ADDR_COUNT=4
CONFIG_NET_IF_MCAST_IPV6_ADDR_COUNT=5

# IPv6 neighbors/routes count. This determines how many nodes
# our RPL network can have.
CONFIG_NET_IPV6_MAX_NEIGHBORS=25

# RPL and routing options
CONFIG_NET_RPL=y
CONFIG_NET_ROUTE=y
CONFIG_NET_ROUTING=y
CONFIG_NET_RPL_L2_IEEE802154=y
# This is used as a prefix when creating DAG. You can pick your own
# prefix here, better not to use this exact value.
CONFIG_NET_RPL_PREFIX="fde3:2cda:3eea:4d14::1/64"

# HTTP(S) admin and websocket interface support
CONFIG_HTTP=y
CONFIG_HTTP_SERVER=y
CONFIG_HTTP_SERVER_NUM_URLS=8
CONFIG_WEBSOCKET=y
CONFIG_WEBSOCKET_CONSOLE=n

# Allow two concurrent incoming connections
CONFIG_NET_TCP_BACKLOG_SIZE=1
CONFIG_NET_APP_SERVER_NUM_CONN=2

# Crypto support
CONFIG_MBEDTLS=y
CONFIG_MBEDTLS_BUILTIN=y
CONFIG_MBEDTLS_CFG_FILE="config-mini-tls1_2.h"
CONFIG_MBEDTLS_ENABLE_HEAP=y
CONFIG_MBEDTLS_HEAP_SIZE=12000

# Logging
CONFIG_NET_LOG=y
CONFIG_LOG=y
CONFIG_INIT_STACKS=y
CONFIG_PRINTK=y

# Network application settings
CONFIG_NET_CONFIG_SETTINGS=y
CONFIG_NET_CONFIG_NEED_IPV6=y
CONFIG_NET_CONFIG_NEED_IPV4=y
# This is the ethernet interface setting for admin purposes
CONFIG_NET_CONFIG_MY_IPV6_ADDR="2001:db8::1"
CONFIG_NET_CONFIG_MY_IPV4_ADDR="192.0.2.1"

# Set a proper hostname for the router
CONFIG_NET_HOSTNAME_ENABLE=y

# mDNS support is activated. After this one can connect to this device
# by zephyr.local name
CONFIG_MDNS_RESPONDER=y

# IPv6 compression is needed for IEEE 802.15.4
CONFIG_NET_6LO=y
CONFIG_NET_6LO_CONTEXT=n

#COAP
CONFIG_COAP=y

#MGMT
CONFIG_NET_MGMT=y
CONFIG_NET_MGMT_EVENT=y
CONFIG_NET_MGMT_EVENT_INFO=y
CONFIG_NET_MGMT_EVENT_STACK_SIZE=2048
CONFIG_NET_MGMT_EVENT_QUEUE_SIZE=20

#JSON
CONFIG_JSON_LIBRARY=y

CONFIG_NET_DEFAULT_IF_ETHERNET=y

# IEEE 802.15.4 options
CONFIG_NET_L2_IEEE802154_SHELL=y
CONFIG_NET_L2_IEEE802154=y
CONFIG_NET_L2_IEEE802154_FRAGMENT=y
CONFIG_NET_CONFIG_IEEE802154_CHANNEL=18

# IEEE MCR20A 802.15.4 options
CONFIG_NET_CONFIG_IEEE802154_DEV_NAME="mcr20a"
CONFIG_IEEE802154_MCR20A=y
CONFIG_SPI=y

#For TLS support enable options below
# HTTP(S) admin and websocket interface support
#CONFIG_HTTPS=y
# Firefox sends lot of fields to this needs to be quite large
#CONFIG_HTTP_HEADERS=20
#CONFIG_MBEDTLS_HEAP_SIZE=28500
```

## prj_frdm_k64f_mcr20a_tc.conf
```kconfig
# Generic IP stack options and features
CONFIG_NETWORKING=y
CONFIG_NET_TCP=y
CONFIG_NET_UDP=y
CONFIG_ENTROPY_GENERATOR=y
CONFIG_TEST_RANDOM_GENERATOR=y
CONFIG_INIT_STACKS=y
CONFIG_NET_SHELL=y
CONFIG_NET_STATISTICS=y
CONFIG_NET_MAX_CONTEXTS=16
CONFIG_NET_IPV6=y
CONFIG_NET_IPV4=y
CONFIG_NET_DHCPV4=n

CONFIG_NET_RX_STACK_SIZE=2048

# Number of network buffers
CONFIG_NET_PKT_RX_COUNT=80
CONFIG_NET_PKT_TX_COUNT=80
CONFIG_NET_BUF_RX_COUNT=80
CONFIG_NET_BUF_TX_COUNT=80

# Number of IPv6 Network Interfaces
CONFIG_NET_IF_MAX_IPV6_COUNT=2

# IPv6 address counts
CONFIG_NET_IF_UNICAST_IPV6_ADDR_COUNT=4
CONFIG_NET_IF_MCAST_IPV6_ADDR_COUNT=5

# IPv6 neighbors/routes count. This determines how many nodes
# our RPL network can have.
CONFIG_NET_IPV6_MAX_NEIGHBORS=25

# RPL and routing options
CONFIG_NET_RPL=y
CONFIG_NET_ROUTE=y
CONFIG_NET_ROUTING=y
CONFIG_NET_RPL_L2_IEEE802154=y
# This is used as a prefix when creating DAG. You can pick your own
# prefix here, better not to use this exact value.
CONFIG_NET_RPL_PREFIX="fde3:2cda:3eea:4d14::1/64"

# HTTP(S) admin and websocket interface support
CONFIG_HTTP=y
CONFIG_HTTP_SERVER=y
CONFIG_HTTP_SERVER_NUM_URLS=8
CONFIG_WEBSOCKET=y
CONFIG_WEBSOCKET_CONSOLE=n

# Allow two concurrent incoming connections
CONFIG_NET_TCP_BACKLOG_SIZE=1
CONFIG_NET_APP_SERVER_NUM_CONN=2

# Crypto support
CONFIG_MBEDTLS=y
CONFIG_MBEDTLS_BUILTIN=y
CONFIG_MBEDTLS_CFG_FILE="config-mini-tls1_2.h"
CONFIG_MBEDTLS_ENABLE_HEAP=y
CONFIG_MBEDTLS_HEAP_SIZE=12000

# Logging
CONFIG_NET_LOG=y
CONFIG_INIT_STACKS=y
CONFIG_PRINTK=y
CONFIG_SYS_LOG_SHOW_COLOR=y
CONFIG_SYS_LOG_NET_LEVEL=4
#CONFIG_SYS_LOG_IEEE802154_DRIVER_LEVEL=2

# Debugging
CONFIG_NET_DEBUG_NET_PKT=n
CONFIG_NET_DEBUG_WEBSOCKET=n
CONFIG_NET_DEBUG_RPL=n
CONFIG_NET_DEBUG_ROUTE=n
CONFIG_NET_DEBUG_APP=n
CONFIG_NET_DEBUG_IPV6=n
CONFIG_NET_DEBUG_L2_ETHERNET=n
CONFIG_NET_DEBUG_IPV6_NBR_CACHE=n
CONFIG_NET_DEBUG_CONTEXT=n
CONFIG_NET_DEBUG_TCP=n
CONFIG_NET_DEBUG_CORE=n
CONFIG_NET_DEBUG_CONN=n
CONFIG_NET_DEBUG_IF=n
CONFIG_NET_DEBUG_HTTP=n
CONFIG_MBEDTLS_DEBUG=n

# Network application settings
CONFIG_NET_APP_SETTINGS=y
CONFIG_NET_APP_NEED_IPV6=y
CONFIG_NET_APP_NEED_IPV4=y
# This is the ethernet interface setting for admin purposes
CONFIG_NET_APP_MY_IPV6_ADDR="2001:db8::1"
CONFIG_NET_APP_MY_IPV4_ADDR="192.0.2.1"

# Set a proper hostname for the router
CONFIG_NET_HOSTNAME_ENABLE=y

# mDNS support is activated. After this one can connect to this device
# by zephyr.local name
CONFIG_MDNS_RESPONDER=y

# IPv6 compression is needed for IEEE 802.15.4
CONFIG_NET_6LO=y
CONFIG_NET_6LO_CONTEXT=n

#COAP
CONFIG_COAP=y

#MGMT
CONFIG_NET_MGMT=y
CONFIG_NET_MGMT_EVENT=y
CONFIG_NET_MGMT_EVENT_INFO=y
CONFIG_NET_MGMT_EVENT_STACK_SIZE=2048
CONFIG_NET_MGMT_EVENT_QUEUE_SIZE=20

#JSON
CONFIG_JSON_LIBRARY=y

CONFIG_NET_DEFAULT_IF_ETHERNET=y

# IEEE 802.15.4 options
CONFIG_NET_L2_IEEE802154_SHELL=y
CONFIG_NET_L2_IEEE802154=y
CONFIG_NET_L2_IEEE802154_FRAGMENT=y
CONFIG_NET_APP_IEEE802154_CHANNEL=18

# IEEE MCR20A 802.15.4 options
CONFIG_NET_APP_IEEE802154_DEV_NAME="mcr20a"
CONFIG_IEEE802154_MCR20A=y
CONFIG_SPI=y

#For TLS support enable options below
# HTTP(S) admin and websocket interface support
#CONFIG_HTTPS=y
# Firefox sends lot of fields to this needs to be quite large
#CONFIG_HTTP_HEADERS=20
#CONFIG_MBEDTLS_HEAP_SIZE=28500

CONFIG_NET_L2_IEEE802154_SECURITY=y

CONFIG_TINYCRYPT=y
CONFIG_TINYCRYPT_AES=y
CONFIG_TINYCRYPT_AES_CBC=y
CONFIG_TINYCRYPT_AES_CTR=y
CONFIG_TINYCRYPT_AES_CCM=y
CONFIG_CRYPTO_TINYCRYPT_SHIM=y
CONFIG_NET_L2_IEEE802154_SECURITY_CRYPTO_DEV_NAME="CRYPTO_TC"

CONFIG_CRYPTO=y
CONFIG_SYS_LOG_CRYPTO_LEVEL=3

CONFIG_NET_APP_IEEE802154_SECURITY_KEY="123412341234123"
CONFIG_NET_APP_IEEE802154_SECURITY_KEY_MODE=0
CONFIG_NET_APP_IEEE802154_SECURITY_LEVEL=6
```

## prj_qemu_x86.conf
```kconfig
CONFIG_NETWORKING=y
CONFIG_NET_TCP=y
CONFIG_ENTROPY_GENERATOR=y
CONFIG_TEST_RANDOM_GENERATOR=y
CONFIG_NET_LOG=y
CONFIG_NET_SLIP_TAP=y
CONFIG_INIT_STACKS=y

CONFIG_NET_PKT_RX_COUNT=16
CONFIG_NET_PKT_TX_COUNT=16
CONFIG_NET_BUF_RX_COUNT=16
CONFIG_NET_BUF_TX_COUNT=16

CONFIG_NET_IF_UNICAST_IPV6_ADDR_COUNT=2
CONFIG_NET_IF_MCAST_IPV6_ADDR_COUNT=4

CONFIG_NET_MAX_CONTEXTS=16

CONFIG_SYS_LOG_SHOW_COLOR=y
CONFIG_SYS_LOG_NET_LEVEL=2
#CONFIG_NET_DEBUG_HTTP=y

CONFIG_HTTP_SERVER=y

CONFIG_NET_IPV6=y
CONFIG_NET_IPV4=y
#CONFIG_NET_DHCPV4=y

CONFIG_HTTPS=y
CONFIG_MBEDTLS=y
CONFIG_MBEDTLS_BUILTIN=y
CONFIG_MBEDTLS_CFG_FILE="config-mini-tls1_2.h"

CONFIG_NET_APP_SETTINGS=y
CONFIG_NET_APP_MY_IPV6_ADDR="2001:db8::1"
CONFIG_NET_APP_MY_IPV4_ADDR="192.0.2.1"

CONFIG_NET_SHELL=y
CONFIG_NET_STATISTICS=y
#CONFIG_NET_STATISTICS_PERIODIC_OUTPUT=y

CONFIG_NET_MGMT=y
CONFIG_NET_MGMT_EVENT=y

CONFIG_NET_RPL=y
```

## src/main.c
```c
/*
 * Copyright (c) 2017 Intel Corporation
 *
 * SPDX-License-Identifier: Apache-2.0
 */

#include <logging/log.h>
LOG_MODULE_REGISTER(net_rpl_br_sample, LOG_LEVEL_DBG);

#include <zephyr.h>
#include <stdio.h>

#include <net/net_if.h>

#include "config.h"

/* Sets the network parameters */

void main(void)
{
	struct net_if *iface = NULL, *mgmt_iface = NULL;

	LOG_DBG("RPL border router starting");

#if defined(CONFIG_NET_L2_IEEE802154)
	iface = net_if_get_ieee802154();
	if (!iface) {
		LOG_INF("No IEEE 802.15.4 network interface found.");
	}
#else
#if defined(CONFIG_QEMU_TARGET)
	/* This is just for testing purposes, the RPL network
	 * is not fully functional with QEMU.
	 */
	iface = net_if_get_default();
#endif
#endif

	if (!iface) {
		LOG_INF("Cannot continue because no suitable network "
			"interface exists.");
		return;
	}

	mgmt_iface = net_if_get_first_by_type(&NET_L2_GET_NAME(ETHERNET));
	if (!mgmt_iface) {
		LOG_INF("No management network interface found.");
	} else {
		start_http_server(mgmt_iface);
	}

	setup_rpl(iface, CONFIG_NET_RPL_PREFIX);

#if defined(CONFIG_COAP)
	coap_init();
#endif
}
```

## src/coap.c
```c
/*
 * Copyright (c) 2017 Intel Corporation
 *
 * SPDX-License-Identifier: Apache-2.0
 */

#include <logging/log.h>
LOG_MODULE_DECLARE(net_rpl_br_sample, LOG_LEVEL_DBG);

#include <zephyr.h>
#include <stdio.h>
#include <stdlib.h>

#include <net/net_app.h>
#include <net/coap.h>
#include <net/udp.h>

#include "rpl.h"
#include "net_private.h"

#include "config.h"

#define MY_COAP_PORT 0xC0AB
#define PEER_COAP_PORT htons(0x1633) /* 5683 */

#define PKT_WAIT_TIME K_SECONDS(1)
#define RESPONSE_TIME  K_SECONDS(3)

#define MAX_COAP_REQUEST_ATTEMPTS	5
#define MAX_COAP_REQUESTS		20

struct coap_request {
	struct k_delayed_work timer; /* Timer to retransmit messages */
	struct sockaddr_in6 peer; /* Peer CoAP server socket address */
	u16_t id; /* Message id sent */
	u8_t code; /* Expecting reply code */
	u8_t count; /* Number of trails */
	bool used; /* Entry used or not */
	enum coap_request_type type;
	coap_reply_cb_t cb;
	void *user_data;
};

struct network_topology topology;

static struct net_context *coap;
static struct coap_request requests[MAX_COAP_REQUESTS];

static const char * const led_uri_path[] = { "led", NULL };
static const char * const rpl_obs_path[] = { "rpl-obs", NULL };

static void get_from_ip_addr(struct coap_packet *cpkt,
			     struct sockaddr_in6 *from)
{
	struct net_udp_hdr hdr, *udp_hdr;

	udp_hdr = net_udp_get_hdr(cpkt->pkt, &hdr);
	if (!udp_hdr) {
		return;
	}

	net_ipaddr_copy(&from->sin6_addr, &NET_IPV6_HDR(cpkt->pkt)->src);
	from->sin6_port = udp_hdr->src_port;
	from->sin6_family = AF_INET6;
}

static struct coap_request *
get_coap_request_by_type(const struct sockaddr_in6 *peer,
			 enum coap_request_type type)
{
	u8_t i;

	for (i = 0U; i < MAX_COAP_REQUESTS; i++) {
		if (!requests[i].used) {
			continue;
		}

		if (requests[i].type == type &&
		    net_ipv6_addr_cmp(&requests[i].peer.sin6_addr,
				      &peer->sin6_addr)) {
			return &requests[i];
		}
	}

	return NULL;
}

static struct coap_request *
get_coap_request_by_id(const struct sockaddr_in6 *peer, u16_t id)
{
	u8_t i;

	for (i = 0U; i < MAX_COAP_REQUESTS; i++) {
		if (!requests[i].used) {
			continue;
		}

		if (requests[i].id == id &&
		    net_ipv6_addr_cmp(&requests[i].peer.sin6_addr,
				      &peer->sin6_addr)) {
			return &requests[i];
		}
	}

	return NULL;
}

static struct coap_request *
get_coap_request_by_addr(const struct in6_addr *peer)
{
	u8_t i;

	for (i = 0U; i < MAX_COAP_REQUESTS; i++) {
		if (!requests[i].used) {
			continue;
		}

		if (net_ipv6_addr_cmp(&requests[i].peer.sin6_addr, peer)) {
			return &requests[i];
		}
	}

	return NULL;
}

static struct coap_request *get_free_coap_request(void)
{
	int i;

	for (i = 0; i < MAX_COAP_REQUESTS; i++) {
		if (!requests[i].used) {
			return &requests[i];
		}
	}

	return NULL;
}

static void clear_coap_request(struct coap_request *request)
{
	if (!request->used) {
		return;
	}

	request->type = COAP_REQ_NONE;
	request->id = 0U;
	request->code = 0U;
	request->count = 0U;
	request->used = false;
	request->cb = NULL;
	request->user_data = NULL;

	k_delayed_work_cancel(&request->timer);
}

static bool toggle_led(const struct sockaddr_in6 *peer, u16_t id)
{
	struct net_pkt *pkt;
	struct net_buf *frag;
	struct coap_packet request;
	const char * const *p;
	int r;

	pkt = net_pkt_get_tx(coap, PKT_WAIT_TIME);
	if (!pkt) {
		LOG_ERR("Ran out of network packets");
		return false;
	}

	frag = net_pkt_get_data(coap, PKT_WAIT_TIME);
	if (!frag) {
		LOG_ERR("Ran out of network buffers");
		goto end;
	}

	net_pkt_frag_add(pkt, frag);

	r = coap_packet_init(&request, pkt, 1, COAP_TYPE_NON_CON,
			     0, NULL, COAP_METHOD_POST, id);
	if (r < 0) {
		LOG_ERR("Failed to initialize CoAP packet");
		goto end;
	}

	for (p = led_uri_path; p && *p; p++) {
		r = coap_packet_append_option(&request, COAP_OPTION_URI_PATH,
					      *p, strlen(*p));
		if (r < 0) {
			LOG_ERR("Unable add option to request.\n");
			goto end;
		}
	}

	r = net_context_sendto(pkt, (const struct sockaddr *)peer,
			       sizeof(struct sockaddr_in6),
			       NULL, 0, NULL, NULL);
	if (r < 0) {
		LOG_ERR("Cannot send data to peer (%d)", r);
		goto end;
	}

	return true;

end:
	net_pkt_unref(pkt);
	return false;
}

static bool set_rpl_observer(const struct sockaddr_in6 *peer, u16_t id)
{
	struct net_pkt *pkt;
	struct net_buf *frag;
	struct coap_packet request;
	const char * const *p;
	int r;

	pkt = net_pkt_get_tx(coap, PKT_WAIT_TIME);
	if (!pkt) {
		LOG_ERR("Ran out of network packets");
		return false;
	}

	frag = net_pkt_get_data(coap, PKT_WAIT_TIME);
	if (!frag) {
		LOG_ERR("Ran out of network buffers");
		goto end;
	}

	net_pkt_frag_add(pkt, frag);

	r = coap_packet_init(&request, pkt, 1, COAP_TYPE_CON,
			     8, coap_next_token(),
			     COAP_METHOD_GET, id);
	if (r < 0) {
		LOG_ERR("Failed to initialize CoAP packet");
		goto end;
	}

	r = coap_append_option_int(&request, COAP_OPTION_OBSERVE, 0);
	if (r < 0) {
		LOG_ERR("Unable add option to request");
		goto end;
	}

	for (p = rpl_obs_path; p && *p; p++) {
		r = coap_packet_append_option(&request, COAP_OPTION_URI_PATH,
					      *p, strlen(*p));
		if (r < 0) {
			LOG_ERR("Unable add option to request");
			goto end;
		}
	}

	r = net_context_sendto(pkt, (const struct sockaddr *)peer,
			       sizeof(struct sockaddr_in6),
			       NULL, 0, NULL, NULL);
	if (r < 0) {
		LOG_ERR("Cannot send data to peer (%d)", r);
		goto end;
	}

	return true;

end:
	net_pkt_unref(pkt);
	return false;
}

static void request_timeout(struct k_work *work)
{
	struct coap_request *request = CONTAINER_OF(work,
						    struct coap_request,
						    timer);

	if (request->type != COAP_REQ_RPL_OBS) {
		return;
	}

	/* Check if number of CoAP requests to this peer reached max or not. */
	if (request->count >= MAX_COAP_REQUEST_ATTEMPTS) {
			clear_coap_request(request);
		return;
	}

	request->count++;

	set_rpl_observer(&request->peer, request->id);

	k_delayed_work_submit(&request->timer, RESPONSE_TIME);
}

static void add_nbr_to_topology(struct in6_addr *nbr)
{
	if (topology.nodes[0].used) {
		return;
	}

	topology.nodes[0].id = 1U;
	topology.nodes[0].used = true;
	snprintk(topology.nodes[0].label, sizeof(topology.nodes[0].label),
		 "NBR");
	net_ipaddr_copy(&topology.nodes[0].addr, nbr);
}

static void add_node_to_topology(struct in6_addr *node)
{
	u8_t i;

	/* BR takes 'id : 1', so node's id starts from 2 */
	for (i = 1U; i < CONFIG_NET_IPV6_MAX_NEIGHBORS; i++) {
		if (topology.nodes[i].used) {
			continue;
		}

		topology.nodes[i].id = i + 1;
		topology.nodes[i].used = true;

		snprintk(topology.nodes[i].label,
			 sizeof(topology.nodes[i].label),
			 "N%d", topology.nodes[i].id);

		net_ipaddr_copy(&topology.nodes[i].addr, node);
		break;
	}
}

static void update_node_topology(struct in6_addr *node,
				 struct in6_addr *parent,
				 u16_t rank)
{
	u8_t i;

	for (i = 0U; i < CONFIG_NET_IPV6_MAX_NEIGHBORS; i++) {
		if (!topology.nodes[i].used) {
			continue;
		}

		if (!net_ipv6_addr_cmp(&topology.nodes[i].addr,
				       node)) {
			continue;
		}

		topology.nodes[i].rank = rank;
		net_ipaddr_copy(&topology.nodes[i].parent, parent);
		break;
	}
}

static void remove_node_from_topology(struct in6_addr *node)
{
	u8_t i;

	for (i = 1U; i < CONFIG_NET_IPV6_MAX_NEIGHBORS; i++) {
		if (!topology.nodes[i].used) {
			continue;
		}

		if (!net_ipv6_addr_cmp(&topology.nodes[i].addr,
				       node)) {
			continue;
		}

		topology.nodes[i].used = false;
	}
}

#define COAP_REPLY_PARENT strlen("parent-")
#define COAP_REPLY_RANK strlen("rank-")
#define COAP_REPLY_NONE strlen("None")
#define COAP_REPLY_RANK_VALUE 6

#define MAX_PAYLOAD_SIZE (NET_IPV6_ADDR_LEN + \
			  COAP_REPLY_PARENT + \
			  COAP_REPLY_RANK   + \
			  COAP_REPLY_RANK_VALUE)

static void node_obs_reply(struct coap_packet *response, void *user_data)
{
	char payload[MAX_PAYLOAD_SIZE];
	char parent_str[NET_IPV6_ADDR_LEN + 1];
	char rank_str[COAP_REPLY_RANK_VALUE + 1];
	struct sockaddr_in6 from;
	struct in6_addr parent;
	struct net_buf *frag;
	u16_t offset;
	u16_t len;
	u16_t rank;
	u8_t i;

	frag = coap_packet_get_payload(response, &offset, &len);
	if (!frag && offset == 0xffff) {
		LOG_ERR("Error while getting payload");
		return;
	}

	if (!len) {
		LOG_ERR("Invalid response");
		return;
	}

	frag = net_frag_read(frag, offset, &offset, len, (u8_t *) payload);
	if (!frag && offset == 0xffff) {
		return;
	}

	if (strncmp(payload, "parent-", COAP_REPLY_PARENT)) {
		return;
	}

	if (!strncmp(payload + COAP_REPLY_PARENT, "None", COAP_REPLY_NONE)) {
		return;
	}

	i = 0U;
	offset = COAP_REPLY_PARENT;
	while (payload[offset] != '\n') {
		parent_str[i++] = payload[offset++];
	}

	parent_str[i] = '\0';

	i++;
	if (strncmp(payload + COAP_REPLY_PARENT + i, "rank-",
		    COAP_REPLY_RANK)) {
		return;
	}

	if (!strncmp(payload + COAP_REPLY_PARENT + i, "None",
		     COAP_REPLY_NONE)) {
		return;
	}

	offset = COAP_REPLY_PARENT + i + COAP_REPLY_RANK;
	i = 0U;
	while (offset < len) {
		rank_str[i++] = payload[offset++];
	}

	if (i > strlen(rank_str)) {
		return;
	}

	rank_str[i] = '\0';

	if (net_addr_pton(AF_INET6, parent_str, &parent) < 0) {
		LOG_ERR("Failed to convert parent address");
		return;
	}

	get_from_ip_addr(response, &from);
	rank = atoi(rank_str);

	update_node_topology(&from.sin6_addr, &parent, rank);
}

static void pkt_receive(struct net_context *context,
			struct net_pkt *pkt,
			int status,
			void *user_data)
{
	struct coap_option options[4] = { 0 };
	struct coap_packet response;
	struct coap_request *coap_req;
	struct sockaddr_in6 from;
	u16_t id;
	u8_t type;
	u8_t code;
	u8_t opt_num = 4U;
	int r;

	r = coap_packet_parse(&response, pkt, options, opt_num);
	if (r < 0) {
		LOG_ERR("Invalid data received (%d)\n", r);
		net_pkt_unref(pkt);
		return;
	}

	type = coap_header_get_type(&response);
	code = coap_header_get_code(&response);
	id  = coap_header_get_id(&response);
	get_from_ip_addr(&response, &from);

	if (type != COAP_TYPE_ACK) {
		LOG_ERR("Invalid response, type %d", type);
		net_pkt_unref(pkt);
		return;
	}

	LOG_DBG("Received %d bytes coap payload",
		net_pkt_appdatalen(pkt) - response.hdr_len - response.opt_len);

	coap_req = get_coap_request_by_id(&from, id);
	if (!coap_req) {
		net_pkt_unref(pkt);
		return;
	}

	if (code != coap_req->code) {
		LOG_ERR("Invalid response, code %d", code);
		goto end;
	}

	if (coap_req->type == COAP_REQ_RPL_OBS) {
		node_obs_reply(&response, coap_req->user_data);
	}

	if (coap_req->cb) {
		coap_req->cb(&response, coap_req->user_data);
	}

end:
	clear_coap_request(coap_req);
	net_pkt_unref(pkt);
}

void coap_remove_node_from_topology(struct in6_addr *peer)
{
	struct coap_request *request;

	request = get_coap_request_by_addr(peer);
	if (request) {
		clear_coap_request(request);
	}

	remove_node_from_topology(peer);
}

void coap_send_request(struct in6_addr *peer_addr,
		       enum coap_request_type type,
		       coap_reply_cb_t cb,
		       void *user_data)
{
	struct sockaddr_in6 peer;
	struct coap_request *request;

	peer.sin6_family = AF_INET6;
	peer.sin6_port = PEER_COAP_PORT;
	net_ipaddr_copy(&peer.sin6_addr, peer_addr);

	if (type == COAP_REQ_TOGGLE_LED) {
		toggle_led(&peer, coap_next_id());
		return;
	}

	if (type != COAP_REQ_RPL_OBS) {
		return;
	}

	/* Check for request has been sent already or not. If request has been
	 * sent already then timer will run until number of requests reach
	 * MAX_COAP_REQUEST_ATTEMPTS.
	 */
	request = get_coap_request_by_type(&peer, type);
	if (request) {
		return;
	}

	request = get_free_coap_request();
	if (!request) {
		LOG_ERR("Failed to get free coap request");
		return;
	}

	request->peer.sin6_family = peer.sin6_family;
	request->peer.sin6_port = peer.sin6_port;
	net_ipaddr_copy(&request->peer.sin6_addr, &peer.sin6_addr);

	request->id = coap_next_id();
	request->count = 1U;
	request->type = type;
	request->cb = cb;
	request->user_data = user_data;
	request->used = true;
	request->code = COAP_RESPONSE_CODE_CONTENT;

	add_node_to_topology(peer_addr);
	set_rpl_observer(&request->peer, request->id);

	k_delayed_work_init(&request->timer, request_timeout);
	k_delayed_work_submit(&request->timer, RESPONSE_TIME);
}

int coap_init(void)
{
	struct net_if *iface = NULL;

	static struct sockaddr_in6 my_addr = {
			.sin6_family = AF_INET6,
			.sin6_port = htons(MY_COAP_PORT)
			};
	u8_t i;
	int r;

	iface = net_if_get_ieee802154();
	if (!iface) {
		LOG_ERR("No IEEE 802.15.4 network interface found.");
		return -EINVAL;
	}

	for (i = 0U; i < NET_IF_MAX_IPV6_ADDR; i++) {
		if (iface->config.ip.ipv6->unicast[i].is_used) {
			break;
		}
	}

	if (i >= NET_IF_MAX_IPV6_ADDR) {
		return -EINVAL;
	}

	net_ipaddr_copy(&my_addr.sin6_addr,
			&iface->config.ip.ipv6->unicast[i].address.in6_addr);

	add_nbr_to_topology(&my_addr.sin6_addr);

	r = net_context_get(AF_INET6, SOCK_DGRAM, IPPROTO_UDP, &coap);
	if (r < 0) {
		LOG_ERR("Could not get UDP context");
		return r;
	}

	r = net_context_bind(coap, (struct sockaddr *) &my_addr,
			     sizeof(my_addr));
	if (r < 0) {
		LOG_ERR("Could not bind to the context");
		return r;
	}

	r = net_context_recv(coap, pkt_receive, 0, NULL);
	if (r < 0) {
		LOG_ERR("Could not set recv callback in the context");
		return r;
	}

	return 0;
}
```

## src/config.h
```c
/*
 * Copyright (c) 2017 Intel Corporation
 *
 * SPDX-License-Identifier: Apache-2.0
 */

#ifndef _CONFIG_H_
#define _CONFIG_H_

#include <net/coap.h>

/* The startup time needs to be longish if DHCP is enabled as setting
 * DHCP up takes some time.
 */
#define APP_STARTUP_TIME K_SECONDS(20)

#ifdef CONFIG_NET_CONFIG_SETTINGS
#ifdef CONFIG_NET_IPV6
#define ZEPHYR_ADDR            CONFIG_NET_CONFIG_MY_IPV6_ADDR
#else
#define ZEPHYR_ADDR            CONFIG_NET_CONFIG_MY_IPV4_ADDR
#endif
#else
#ifdef CONFIG_NET_IPV6
#define ZEPHYR_ADDR            "2001:db8::1"
#else
#define ZEPHYR_ADDR            "192.0.2.1"
#endif
#endif

#ifndef ZEPHYR_PORT
#define ZEPHYR_PORT		8080
#endif

#define HTTP_TITLE		"Zephyr Border Router"

#define HTTP_AUTH_URL		"/auth"
#define HTTP_AUTH_TYPE		"Basic"

/* HTTP Basic Auth, see https://tools.ietf.org/html/rfc7617 */
#define HTTP_AUTH_REALM		"Zephyr"
#define HTTP_AUTH_USERNAME	"zephyr"
#define HTTP_AUTH_PASSWORD	"zephyr"

/* If you do not need HTTP support, then it is possible to disable it */
#if defined(CONFIG_WEBSOCKET)
void start_http_server(struct net_if *iface);
#else
#define start_http_server(...)
#endif

bool setup_rpl(struct net_if *iface, const char *addr_prefix);

enum coap_request_type {
	COAP_REQ_NONE = 0,
	COAP_REQ_TOGGLE_LED = 1,	/* Toggle the LED */
	COAP_REQ_RPL_OBS = 2,		/* Register OBS */
};

struct network_topology {
	struct {
		bool used;
		u16_t id;
		u16_t rank;
		char label[4];
		struct in6_addr addr;
		struct in6_addr parent;
	} nodes[CONFIG_NET_IPV6_MAX_NEIGHBORS];

	struct {
		u16_t from;
		u16_t to;
		bool used;
	} edges[CONFIG_NET_IPV6_MAX_NEIGHBORS];
};

extern struct network_topology topology;

typedef void (*coap_reply_cb_t)(struct coap_packet *response, void *user_data);

int coap_init(void);
void coap_send_request(struct in6_addr *peer_addr,
		       enum coap_request_type type,
		       coap_reply_cb_t cb,
		       void *user_data);

void coap_remove_node_from_topology(struct in6_addr *peer);
#endif
```

## src/rpl.c
```c
/*
 * Copyright (c) 2017 Intel Corporation
 *
 * SPDX-License-Identifier: Apache-2.0
 */

#define LOG_LEVEL LOG_LEVEL_DBG

#include <logging/log.h>
LOG_MODULE_DECLARE(net_rpl_br_sample, LOG_LEVEL);

#include <zephyr.h>
#include <stdio.h>
#include <stdlib.h>

#include <net/net_ip.h>
#include "../../../subsys/net/ip/rpl.h"

#include "config.h"

static struct {
	struct in6_addr dag_id;
	u8_t dag_init_version;
	bool dag_has_version;

	struct in6_addr prefix;
	u8_t prefix_len;
} rpl;

static bool br_join_dag(struct net_rpl_dio *dio)
{
	static u8_t last_version;

	if (net_ipv6_addr_cmp(&dio->dag_id, &rpl.dag_id)) {
		if (rpl.dag_init_version != dio->version &&
		    last_version != dio->version) {
			LOG_DBG("Me root, DIO version %d instance %d",
				dio->version, dio->instance_id);
			last_version = dio->version;
		}

		if (dio->version > NET_RPL_LOLLIPOP_CIRCULAR_REGION) {
			rpl.dag_init_version = dio->version;
			rpl.dag_has_version = true;
		}
	} else {
		if (LOG_LEVEL >= LOG_LEVEL_DBG) {
			char me[NET_IPV6_ADDR_LEN];
			char other[NET_IPV6_ADDR_LEN];

			net_addr_ntop(AF_INET6, &dio->dag_id, other,
				      NET_IPV6_ADDR_LEN);
			net_addr_ntop(AF_INET6, &rpl.dag_id, me,
				      NET_IPV6_ADDR_LEN);

			LOG_DBG("Other root %s, me %s, "
				"DIO version %d instance %d",
				log_strdup(other), log_strdup(me),
				dio->version, dio->instance_id);
		}
	}

	return 0;
}

bool setup_rpl(struct net_if *iface, const char *addr_prefix)
{
	char prefix[NET_IPV6_ADDR_LEN + 1];
	struct net_rpl_dag *dag;
	char *slash;
	bool ret;

	/* As the addr_prefix is Kconfig option we need to copy it to temporary
	 * buffer in order to be able to manipulate it.
	 */
	(void)memset(prefix, 0, sizeof(prefix));
	memcpy(prefix, addr_prefix, min(strlen(addr_prefix),
					NET_IPV6_ADDR_LEN));

	slash = strstr(prefix, "/");
	if (!slash) {
		rpl.prefix_len = 64U;
	} else {
		*slash = '\0';
		rpl.prefix_len = atoi(slash + 1);
	}

	if (rpl.prefix_len == 0) {
		LOG_ERR("Invalid prefix length %s", log_strdup(slash + 1));
		return false;
	}

	if (net_addr_pton(AF_INET6, prefix, &rpl.prefix) < 0) {
		LOG_ERR("Invalid IPv6 prefix %s", log_strdup(prefix));
		return false;
	}

	net_rpl_set_join_callback(br_join_dag);

	if (rpl.dag_has_version) {
		net_rpl_lollipop_increment(&rpl.dag_init_version);

		dag = net_rpl_set_root_with_version(iface,
			CONFIG_NET_RPL_DEFAULT_INSTANCE, &rpl.dag_id,
			rpl.dag_init_version);
	} else {
		dag = net_rpl_set_root(iface, CONFIG_NET_RPL_DEFAULT_INSTANCE,
				       &rpl.prefix);
	}
	if (!dag) {
		LOG_ERR("Cannot set root node");
		return false;
	}

	net_rpl_dag_set_grounded_status(dag, 1);

	ret = net_rpl_set_prefix(iface, dag, &rpl.prefix, rpl.prefix_len);
	if (!ret) {
		LOG_ERR("Cannot set prefix %s/%d", log_strdup(prefix),
			rpl.prefix_len);
		return false;
	}

	if (LOG_LEVEL >= LOG_LEVEL_DBG) {
		char out[NET_IPV6_ADDR_LEN];

		if (net_addr_ntop(AF_INET6, &rpl.prefix, out,
				  NET_IPV6_ADDR_LEN)) {
			if (rpl.dag_has_version) {
				LOG_DBG("New RPL dag %s/%d version %u created",
					log_strdup(out), rpl.prefix_len,
					rpl.dag_init_version);
			} else {
				LOG_DBG("New RPL dag %s/%d created",
					log_strdup(out),
					rpl.prefix_len);
			}
		}
	}

	return true;
}
```

## src/shell.c
```c
/*
 * Copyright (c) 2017 Intel Corporation
 *
 * SPDX-License-Identifier: Apache-2.0
 */

#include <logging/log.h>
LOG_MODULE_DECLARE(net_rpl_br_sample, LOG_LEVEL_DBG);

#include <zephyr.h>
#include <shell/shell.h>
#include <shell/shell_uart.h>
#include <stdio.h>

#include "../../../subsys/net/ip/rpl.h"

#include "config.h"

#define BR_SHELL_MODULE "br"

static int cmd_br_repair(const struct shell *shell,
			 size_t argc, char *argv[])
{
	ARG_UNUSED(argc);
	ARG_UNUSED(argv);

	shell_fprintf(shell, SHELL_INFO, "Starting global repair...\n");

	net_rpl_repair_root(CONFIG_NET_RPL_DEFAULT_INSTANCE);

	return 0;
}

static int cmd_coap_send(const struct shell *shell,
			 size_t argc, char *argv[])
{
	struct in6_addr peer_addr;
	enum coap_request_type type;
	int r;

	if (argc != 3 || !argv[1] || !argv[2]) {
		shell_fprintf(shell, SHELL_ERROR, "Invalid arguments.\n");
		return -ENOEXEC;
	}

	r = net_addr_pton(AF_INET6, argv[2], &peer_addr);
	if (r < 0) {
		return -ENOEXEC;
	}

	if (strcmp(argv[1], "toggle") == 0) {
		type = COAP_REQ_TOGGLE_LED;
	} else if (strcmp(argv[1], "rpl_obs") == 0) {
		type = COAP_REQ_RPL_OBS;
	} else {
		shell_fprintf(shell, SHELL_ERROR, "Invalid arguments.\n");
		return -ENOEXEC;
	}

	coap_send_request(&peer_addr, type, NULL, NULL);

	return 0;
}

SHELL_CREATE_STATIC_SUBCMD_SET(br_commands)
{
	SHELL_CMD(coap, NULL,
		  "Send CoAP commands to Node\n"
		  "toggle <host>   Toggle the LED on Node\n"
		  "rpl_obs <host>  Set RPL observer on Node",
		  cmd_coap_send),
	SHELL_CMD(repair, NULL,
		  "Global repair RPL network",
		  cmd_br_repair),
	SHELL_SUBCMD_SET_END
};

SHELL_CMD_REGISTER(br, &br_commands, "Border router commands", NULL);

void br_shell_init(void)
{
}
```
