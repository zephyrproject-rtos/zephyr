## prj.conf
```kconfig
CONFIG_ARC_INIT=n

CONFIG_NETWORKING=y
CONFIG_TEST_RANDOM_GENERATOR=y

CONFIG_NET_NBUF_RX_COUNT=6
CONFIG_NET_NBUF_TX_COUNT=6
CONFIG_NET_NBUF_RX_DATA_COUNT=10
CONFIG_NET_NBUF_TX_DATA_COUNT=10

CONFIG_NET_IPV4=n
CONFIG_NET_IPV6=y
CONFIG_NET_IPV6_RA_RDNSS=y
CONFIG_NET_IF_UNICAST_IPV6_ADDR_COUNT=2

CONFIG_NET_6LO=y
CONFIG_NET_DEBUG_6LO=y

CONFIG_NET_LOG=y
CONFIG_SYS_LOG_SHOW_COLOR=y
CONFIG_INIT_STACKS=y
CONFIG_PRINTK=y

CONFIG_NET_DEBUG_CORE=y
CONFIG_NET_DEBUG_IPV6_NBR_CACHE=y
CONFIG_NET_DEBUG_IPV6=y
CONFIG_NET_DEBUG_CONTEXT=y
CONFIG_NET_DEBUG_NET_BUF=y
CONFIG_NET_DEBUG_UTILS=y
CONFIG_NET_DEBUG_IF=y
CONFIG_NET_DEBUG_ICMPV6=y
CONFIG_NET_DEBUG_CONN=y
CONFIG_NET_STATISTICS=y

CONFIG_NET_L2_IEEE802154=y
CONFIG_NET_DEBUG_L2_IEEE802154=y
CONFIG_NET_L2_IEEE802154_RFD=y
CONFIG_NET_L2_IEEE802154_FRAGMENT=y
#CONFIG_NET_DEBUG_L2_IEEE802154_FRAGMENT=y

CONFIG_IEEE802154_CC2520=y
CONFIG_IEEE802154_CC2520_AUTO_ACK=y
CONFIG_SYS_LOG_IEEE802154_DRIVER_LEVEL=1

CONFIG_NET_L2_IEEE802154_SHELL=y
```

## prj_cc2520_1.conf
```kconfig
CONFIG_ARC_INIT=n

CONFIG_NETWORKING=y
CONFIG_TEST_RANDOM_GENERATOR=y

CONFIG_NET_TX_STACK_SIZE=2048
CONFIG_NET_RX_STACK_SIZE=2048

CONFIG_NET_PKT_RX_COUNT=10
CONFIG_NET_PKT_TX_COUNT=10
CONFIG_NET_BUF_RX_COUNT=20
CONFIG_NET_BUF_TX_COUNT=20
CONFIG_NET_MAX_CONTEXTS=10

CONFIG_NET_IPV4=n
CONFIG_NET_IPV6=y
CONFIG_NET_IPV6_ND=y
CONFIG_NET_IPV6_RA_RDNSS=n
CONFIG_NET_IPV6_DAD=n
CONFIG_NET_IPV6_MLD=n
CONFIG_NET_IF_UNICAST_IPV6_ADDR_COUNT=2

CONFIG_NET_6LO=y
CONFIG_NET_DEBUG_6LO=y

CONFIG_NET_LOG=y
CONFIG_SYS_LOG_NET_LEVEL=1
CONFIG_SYS_LOG_SHOW_COLOR=y
CONFIG_INIT_STACKS=y
CONFIG_PRINTK=y

CONFIG_NET_SHELL=y

CONFIG_NET_DEBUG_CORE=n
CONFIG_NET_DEBUG_IPV6_NBR_CACHE=n
CONFIG_NET_DEBUG_IPV6=n
CONFIG_NET_DEBUG_CONTEXT=n
CONFIG_NET_DEBUG_NET_PKT=n
CONFIG_NET_DEBUG_UTILS=n
CONFIG_NET_DEBUG_IF=n
CONFIG_NET_DEBUG_ICMPV6=n
CONFIG_NET_DEBUG_CONN=n
CONFIG_NET_STATISTICS=y
CONFIG_NET_STATISTICS_PERIODIC_OUTPUT=n

CONFIG_NET_L2_IEEE802154=y
CONFIG_NET_DEBUG_L2_IEEE802154=y
CONFIG_NET_L2_IEEE802154_FRAGMENT=y
CONFIG_NET_DEBUG_L2_IEEE802154_FRAGMENT=y
CONFIG_NET_L2_IEEE802154_SECURITY=y
CONFIG_NET_L2_IEEE802154_SECURITY_CRYPTO_DEV_NAME="cc2520_crypto"
CONFIG_NET_L2_IEEE802154_SHELL=y

CONFIG_IEEE802154_CC2520=y
CONFIG_IEEE802154_CC2520_AUTO_ACK=y
CONFIG_SYS_LOG_IEEE802154_DRIVER_LEVEL=1
CONFIG_IEEE802154_CC2520_CRYPTO=y

CONFIG_NET_APP_SETTINGS=y
CONFIG_NET_APP_MY_IPV6_ADDR="2001:db8::1"
CONFIG_NET_APP_IEEE802154_DEV_NAME="cc2520"
CONFIG_NET_APP_IEEE802154_SECURITY_KEY="moooooooooooooh"
CONFIG_NET_APP_IEEE802154_SECURITY_KEY_MODE=0
CONFIG_NET_APP_IEEE802154_SECURITY_LEVEL=7
```

## prj_cc2520_2.conf
```kconfig
CONFIG_ARC_INIT=n

CONFIG_NETWORKING=y
CONFIG_TEST_RANDOM_GENERATOR=y

CONFIG_NET_TX_STACK_SIZE=2048
CONFIG_NET_RX_STACK_SIZE=2048

CONFIG_NET_PKT_RX_COUNT=10
CONFIG_NET_PKT_TX_COUNT=10
CONFIG_NET_BUF_RX_COUNT=20
CONFIG_NET_BUF_TX_COUNT=20
CONFIG_NET_MAX_CONTEXTS=10

CONFIG_NET_IPV4=n
CONFIG_NET_IPV6=y
CONFIG_NET_IPV6_ND=y
CONFIG_NET_IPV6_RA_RDNSS=n
CONFIG_NET_IPV6_DAD=n
CONFIG_NET_IPV6_MLD=n
CONFIG_NET_IF_UNICAST_IPV6_ADDR_COUNT=2

CONFIG_NET_6LO=y
CONFIG_NET_DEBUG_6LO=y

CONFIG_NET_LOG=y
CONFIG_SYS_LOG_NET_LEVEL=1
CONFIG_SYS_LOG_SHOW_COLOR=y
CONFIG_INIT_STACKS=y
CONFIG_PRINTK=y

CONFIG_NET_SHELL=y

CONFIG_NET_DEBUG_CORE=n
CONFIG_NET_DEBUG_IPV6_NBR_CACHE=n
CONFIG_NET_DEBUG_IPV6=n
CONFIG_NET_DEBUG_CONTEXT=n
CONFIG_NET_DEBUG_NET_PKT=n
CONFIG_NET_DEBUG_UTILS=n
CONFIG_NET_DEBUG_IF=n
CONFIG_NET_DEBUG_ICMPV6=n
CONFIG_NET_DEBUG_CONN=n
CONFIG_NET_STATISTICS=y
CONFIG_NET_STATISTICS_PERIODIC_OUTPUT=n

CONFIG_NET_L2_IEEE802154=y
CONFIG_NET_DEBUG_L2_IEEE802154=y
CONFIG_NET_L2_IEEE802154_FRAGMENT=y
CONFIG_NET_DEBUG_L2_IEEE802154_FRAGMENT=y
CONFIG_NET_L2_IEEE802154_SECURITY=y
CONFIG_NET_L2_IEEE802154_SECURITY_CRYPTO_DEV_NAME="cc2520_crypto"
CONFIG_NET_L2_IEEE802154_SHELL=y

CONFIG_IEEE802154_CC2520=y
CONFIG_IEEE802154_CC2520_AUTO_ACK=y
CONFIG_SYS_LOG_IEEE802154_DRIVER_LEVEL=1
CONFIG_IEEE802154_CC2520_CRYPTO=y

CONFIG_NET_APP_SETTINGS=y
CONFIG_NET_APP_MY_IPV6_ADDR="2001:db8::2"
CONFIG_NET_APP_IEEE802154_DEV_NAME="cc2520"
CONFIG_NET_APP_IEEE802154_SECURITY_KEY="moooooooooooooh"
CONFIG_NET_APP_IEEE802154_SECURITY_KEY_MODE=0
CONFIG_NET_APP_IEEE802154_SECURITY_LEVEL=7
```

## prj_fsci.conf
```kconfig
CONFIG_NETWORKING=y
CONFIG_TEST_RANDOM_GENERATOR=y

CONFIG_NET_PKT_RX_COUNT=10
CONFIG_NET_PKT_TX_COUNT=10
CONFIG_NET_BUF_RX_COUNT=20
CONFIG_NET_BUF_TX_COUNT=20
CONFIG_NET_MAX_CONTEXTS=10

CONFIG_NET_IPV4=n
CONFIG_NET_IPV6=y
CONFIG_NET_IPV6_RA_RDNSS=y
CONFIG_NET_IF_UNICAST_IPV6_ADDR_COUNT=2

CONFIG_NET_6LO=y
CONFIG_NET_DEBUG_6LO=y

CONFIG_NET_LOG=y
CONFIG_SYS_LOG_NET_LEVEL=1
CONFIG_SYS_LOG_SHOW_COLOR=y
CONFIG_INIT_STACKS=y
CONFIG_PRINTK=y

CONFIG_NET_SHELL=y

CONFIG_NET_DEBUG_CORE=y
CONFIG_NET_DEBUG_IPV6_NBR_CACHE=y
CONFIG_NET_DEBUG_IPV6=y
CONFIG_NET_DEBUG_CONTEXT=y
CONFIG_NET_DEBUG_NET_PKT=y
CONFIG_NET_DEBUG_UTILS=y
CONFIG_NET_DEBUG_IF=y
CONFIG_NET_DEBUG_ICMPV6=y
CONFIG_NET_DEBUG_CONN=y
CONFIG_NET_STATISTICS=y
CONFIG_NET_STATISTICS_PERIODIC_OUTPUT=n

CONFIG_NET_L2_IEEE802154=y
CONFIG_NET_DEBUG_L2_IEEE802154=y
CONFIG_NET_L2_IEEE802154_FRAGMENT=y
#CONFIG_NET_DEBUG_L2_IEEE802154_FRAGMENT=y
CONFIG_NET_L2_IEEE802154_SECURITY=n
CONFIG_NET_L2_IEEE802154_SHELL=y

CONFIG_IEEE802154_FSCI=y
CONFIG_SYS_LOG_IEEE802154_DRIVER_LEVEL=1

CONFIG_NET_APP_SETTINGS=y
CONFIG_NET_APP_MY_IPV6_ADDR="2001:db8::1"
CONFIG_NET_APP_IEEE802154_DEV_NAME="FSCI"
```

## prj_kw40z.conf
```kconfig
CONFIG_NETWORKING=y
CONFIG_TEST_RANDOM_GENERATOR=y

CONFIG_NET_PKT_RX_COUNT=4
CONFIG_NET_PKT_TX_COUNT=4
CONFIG_NET_BUF_RX_COUNT=8
CONFIG_NET_BUF_TX_COUNT=8
CONFIG_NET_MAX_CONTEXTS=3

CONFIG_NET_TX_STACK_SIZE=1024
CONFIG_NET_RX_STACK_SIZE=1024

CONFIG_NET_IPV4=n
CONFIG_NET_IPV6=y
CONFIG_NET_IPV6_RA_RDNSS=y
CONFIG_NET_IF_UNICAST_IPV6_ADDR_COUNT=2
CONFIG_NET_IPV6_MAX_NEIGHBORS=4

CONFIG_NET_6LO=y
CONFIG_NET_DEBUG_6LO=y

CONFIG_NET_LOG=y
CONFIG_SYS_LOG_NET_LEVEL=1
CONFIG_SYS_LOG_SHOW_COLOR=y
CONFIG_INIT_STACKS=y
CONFIG_PRINTK=y

CONFIG_NET_SHELL=n

CONFIG_NET_DEBUG_CORE=y
CONFIG_NET_DEBUG_IPV6_NBR_CACHE=y
CONFIG_NET_DEBUG_IPV6=y
CONFIG_NET_DEBUG_CONTEXT=y
CONFIG_NET_DEBUG_NET_PKT=y
CONFIG_NET_DEBUG_UTILS=y
CONFIG_NET_DEBUG_IF=y
CONFIG_NET_DEBUG_ICMPV6=y
CONFIG_NET_DEBUG_CONN=y
CONFIG_NET_STATISTICS=y
CONFIG_NET_STATISTICS_PERIODIC_OUTPUT=n

CONFIG_NET_L2_IEEE802154=y
CONFIG_NET_DEBUG_L2_IEEE802154=y
CONFIG_NET_L2_IEEE802154_FRAGMENT=y
#CONFIG_NET_DEBUG_L2_IEEE802154_FRAGMENT=y
CONFIG_NET_L2_IEEE802154_SECURITY=n
CONFIG_NET_L2_IEEE802154_SHELL=n

CONFIG_IEEE802154_KW41Z=y
CONFIG_SYS_LOG_IEEE802154_DRIVER_LEVEL=1

CONFIG_NET_APP_SETTINGS=y
CONFIG_NET_APP_MY_IPV6_ADDR="2001:db8::1"
CONFIG_NET_APP_IEEE802154_DEV_NAME="KW41Z"
```

## prj_kw41z.conf
```kconfig
CONFIG_NETWORKING=y
CONFIG_TEST_RANDOM_GENERATOR=y

CONFIG_NET_PKT_RX_COUNT=10
CONFIG_NET_PKT_TX_COUNT=10
CONFIG_NET_BUF_RX_COUNT=20
CONFIG_NET_BUF_TX_COUNT=20
CONFIG_NET_MAX_CONTEXTS=10

CONFIG_NET_IPV4=n
CONFIG_NET_IPV6=y
CONFIG_NET_IPV6_RA_RDNSS=y
CONFIG_NET_IF_UNICAST_IPV6_ADDR_COUNT=2

CONFIG_NET_6LO=y
CONFIG_NET_DEBUG_6LO=y

CONFIG_NET_LOG=y
CONFIG_SYS_LOG_NET_LEVEL=1
CONFIG_SYS_LOG_SHOW_COLOR=y
CONFIG_INIT_STACKS=y
CONFIG_PRINTK=y

CONFIG_NET_SHELL=y

CONFIG_NET_DEBUG_CORE=y
CONFIG_NET_DEBUG_IPV6_NBR_CACHE=y
CONFIG_NET_DEBUG_IPV6=y
CONFIG_NET_DEBUG_CONTEXT=y
CONFIG_NET_DEBUG_NET_PKT=y
CONFIG_NET_DEBUG_UTILS=y
CONFIG_NET_DEBUG_IF=y
CONFIG_NET_DEBUG_ICMPV6=y
CONFIG_NET_DEBUG_CONN=y
CONFIG_NET_STATISTICS=y
CONFIG_NET_STATISTICS_PERIODIC_OUTPUT=n

CONFIG_NET_L2_IEEE802154=y
CONFIG_NET_DEBUG_L2_IEEE802154=y
CONFIG_NET_L2_IEEE802154_FRAGMENT=y
#CONFIG_NET_DEBUG_L2_IEEE802154_FRAGMENT=y
CONFIG_NET_L2_IEEE802154_SECURITY=n
CONFIG_NET_L2_IEEE802154_SHELL=y

CONFIG_IEEE802154_KW41Z=y
CONFIG_SYS_LOG_IEEE802154_DRIVER_LEVEL=1

CONFIG_NET_APP_SETTINGS=y
CONFIG_NET_APP_MY_IPV6_ADDR="2001:db8::1"
CONFIG_NET_APP_IEEE802154_DEV_NAME="KW41Z"
```

## prj_mcr20a.conf
```kconfig
CONFIG_SPI=y
CONFIG_SYS_LOG_SPI_LEVEL=1

CONFIG_NETWORKING=y
CONFIG_TEST_RANDOM_GENERATOR=y

CONFIG_NET_PKT_RX_COUNT=10
CONFIG_NET_PKT_TX_COUNT=10
CONFIG_NET_BUF_RX_COUNT=20
CONFIG_NET_BUF_TX_COUNT=20
CONFIG_NET_MAX_CONTEXTS=10

CONFIG_NET_IPV4=n
CONFIG_NET_IPV6=y
CONFIG_NET_IPV6_RA_RDNSS=y
CONFIG_NET_IF_UNICAST_IPV6_ADDR_COUNT=2

CONFIG_NET_6LO=y
CONFIG_NET_DEBUG_6LO=y

CONFIG_NET_LOG=y
CONFIG_SYS_LOG_NET_LEVEL=1
CONFIG_SYS_LOG_SHOW_COLOR=y
CONFIG_INIT_STACKS=y
CONFIG_PRINTK=y

CONFIG_NET_SHELL=y

CONFIG_NET_DEBUG_CORE=y
CONFIG_NET_DEBUG_IPV6_NBR_CACHE=y
CONFIG_NET_DEBUG_IPV6=y
CONFIG_NET_DEBUG_CONTEXT=y
CONFIG_NET_DEBUG_NET_PKT=y
CONFIG_NET_DEBUG_UTILS=y
CONFIG_NET_DEBUG_IF=y
CONFIG_NET_DEBUG_ICMPV6=y
CONFIG_NET_DEBUG_CONN=y
CONFIG_NET_STATISTICS=y
CONFIG_NET_STATISTICS_PERIODIC_OUTPUT=n

CONFIG_NET_L2_IEEE802154=y
CONFIG_NET_DEBUG_L2_IEEE802154=y
CONFIG_NET_L2_IEEE802154_FRAGMENT=y
#CONFIG_NET_DEBUG_L2_IEEE802154_FRAGMENT=y
CONFIG_NET_L2_IEEE802154_SECURITY=n
CONFIG_NET_L2_IEEE802154_SHELL=y

CONFIG_IEEE802154_MCR20A=y
CONFIG_SYS_LOG_IEEE802154_DRIVER_LEVEL=1

CONFIG_NET_APP_SETTINGS=y
CONFIG_NET_APP_MY_IPV6_ADDR="2001:db8::1"
CONFIG_NET_APP_IEEE802154_DEV_NAME="mcr20a"
```

## src/ieee802154_settings.c
```c
/* Workaround build system bug that will put objects in source dir */
#include "../../../common/ieee802154_settings.c"
```

## src/ieee802154_test.c
```c
/*
 * Copyright (c) 2016 Intel Corporation.
 *
 * SPDX-License-Identifier: Apache-2.0
 */

#if 1
#define SYS_LOG_DOMAIN "15_4_hw_test"
#define NET_SYS_LOG_LEVEL SYS_LOG_LEVEL_DEBUG
#define NET_LOG_ENABLED 1
#endif

#include <zephyr.h>
#include <errno.h>

#include <net/net_if.h>
#include <net/net_core.h>

#include <ieee802154_settings.h>

static void setup_ipv6(struct net_if *iface)
{
	char hr_addr[NET_IPV6_ADDR_LEN];
	struct in6_addr addr;

	if (net_addr_pton(AF_INET6, CONFIG_NET_APP_MY_IPV6_ADDR, &addr)) {
		NET_ERR("Invalid address: %s", CONFIG_NET_APP_MY_IPV6_ADDR);
		return;
	}

	net_if_ipv6_addr_add(iface, &addr, NET_ADDR_MANUAL, 0);

	NET_INFO("IPv6 address: %s",
		 net_addr_ntop(AF_INET6, &addr, hr_addr, NET_IPV6_ADDR_LEN));
}

void main(void)
{
	struct net_if *iface = net_if_get_default();

	if (ieee802154_sample_setup()) {
		NET_ERR("IEEE 802.15.4 setup failed");
	}

	setup_ipv6(iface);
}
```
