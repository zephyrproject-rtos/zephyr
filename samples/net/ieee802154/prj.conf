## CMakeLists.txt
```
set(QEMU_NET_STACK 1)

include($ENV{ZEPHYR_BASE}/cmake/app/boilerplate.cmake NO_POLICY_SCOPE)
project(NONE)

FILE(GLOB app_sources src/*.c)
target_sources(app PRIVATE ${app_sources})

if(CONFIG_BOARD_FRDM_K64F)
  include($ENV{ZEPHYR_BASE}/samples/net/common/common.cmake)
endif()
```

## prj.conf
```kconfig
CONFIG_NETWORKING=y
CONFIG_TEST_RANDOM_GENERATOR=y

CONFIG_NET_PKT_RX_COUNT=6
CONFIG_NET_PKT_TX_COUNT=6
CONFIG_NET_BUF_RX_COUNT=10
CONFIG_NET_BUF_TX_COUNT=10

CONFIG_NET_IPV4=n
CONFIG_NET_IPV6=y
CONFIG_NET_IPV6_RA_RDNSS=y
CONFIG_NET_IF_UNICAST_IPV6_ADDR_COUNT=2

CONFIG_NET_DEBUG_6LO=y

CONFIG_SYS_LOG=y
CONFIG_NET_BUF_LOG=n
CONFIG_SYS_LOG_NET_BUF_LEVEL=2
CONFIG_NET_LOG=y
CONFIG_NET_LOG_GLOBAL=y
CONFIG_SYS_LOG_NET_LEVEL=2
CONFIG_SYS_LOG_SHOW_COLOR=y
CONFIG_INIT_STACKS=y

CONFIG_NET_DEBUG_CORE=y
CONFIG_NET_DEBUG_IPV6_NBR_CACHE=y
CONFIG_NET_DEBUG_IPV6=y
CONFIG_NET_DEBUG_CONTEXT=y
CONFIG_NET_DEBUG_NET_PKT=y
CONFIG_NET_DEBUG_UTILS=y
CONFIG_NET_DEBUG_IF=y
CONFIG_NET_DEBUG_ICMPV6=y
CONFIG_NET_DEBUG_CONN=y
CONFIG_NET_STATISTICS=y

CONFIG_NET_L2_IEEE802154=y
CONFIG_NET_DEBUG_L2_IEEE802154=y
CONFIG_NET_L2_IEEE802154_RFD=y

CONFIG_IEEE802154_UPIPE=y
CONFIG_SYS_LOG_IEEE802154_DRIVER_LEVEL=2

CONFIG_NET_APP_SETTINGS=y
CONFIG_NET_APP_MY_IPV6_ADDR="2001:db8::1"

CONFIG_NET_SHELL=y
CONFIG_KERNEL_SHELL=y
CONFIG_NET_L2_IEEE802154_SHELL=y
```

## prj_cc2520_1.conf
```kconfig
CONFIG_ARC_INIT=n

CONFIG_NETWORKING=y
CONFIG_TEST_RANDOM_GENERATOR=y

CONFIG_NET_TX_STACK_SIZE=2048
CONFIG_NET_RX_STACK_SIZE=2048

CONFIG_NET_PKT_RX_COUNT=10
CONFIG_NET_PKT_TX_COUNT=10
CONFIG_NET_BUF_RX_COUNT=20
CONFIG_NET_BUF_TX_COUNT=20
CONFIG_NET_MAX_CONTEXTS=10

CONFIG_NET_IPV4=n
CONFIG_NET_IPV6=y
CONFIG_NET_IPV6_ND=y
CONFIG_NET_IPV6_RA_RDNSS=n
CONFIG_NET_IPV6_DAD=n
CONFIG_NET_IPV6_MLD=n
CONFIG_NET_IF_UNICAST_IPV6_ADDR_COUNT=2

CONFIG_NET_DEBUG_6LO=y

CONFIG_NET_LOG=y
CONFIG_SYS_LOG_NET_LEVEL=1
CONFIG_SYS_LOG_SHOW_COLOR=y
CONFIG_INIT_STACKS=y
CONFIG_PRINTK=y

CONFIG_NET_DEBUG_CORE=n
CONFIG_NET_DEBUG_IPV6_NBR_CACHE=n
CONFIG_NET_DEBUG_IPV6=n
CONFIG_NET_DEBUG_CONTEXT=n
CONFIG_NET_DEBUG_NET_PKT=n
CONFIG_NET_DEBUG_UTILS=n
CONFIG_NET_DEBUG_IF=n
CONFIG_NET_DEBUG_ICMPV6=n
CONFIG_NET_DEBUG_CONN=n
CONFIG_NET_STATISTICS=y
CONFIG_NET_STATISTICS_PERIODIC_OUTPUT=n

CONFIG_NET_L2_IEEE802154=y
CONFIG_NET_DEBUG_L2_IEEE802154=y
CONFIG_NET_DEBUG_L2_IEEE802154_FRAGMENT=y
CONFIG_NET_L2_IEEE802154_SECURITY=y
CONFIG_NET_L2_IEEE802154_SECURITY_CRYPTO_DEV_NAME="cc2520_crypto"

CONFIG_IEEE802154_CC2520=y
CONFIG_IEEE802154_CC2520_AUTO_ACK=y
CONFIG_SYS_LOG_IEEE802154_DRIVER_LEVEL=1
CONFIG_IEEE802154_CC2520_CRYPTO=y

CONFIG_NET_APP_SETTINGS=y
CONFIG_NET_APP_MY_IPV6_ADDR="2001:db8::1"
CONFIG_NET_APP_IEEE802154_DEV_NAME="cc2520"
CONFIG_NET_APP_IEEE802154_SECURITY_KEY="moooooooooooooh"
CONFIG_NET_APP_IEEE802154_SECURITY_KEY_MODE=0
CONFIG_NET_APP_IEEE802154_SECURITY_LEVEL=7

CONFIG_NET_SHELL=y
CONFIG_KERNEL_SHELL=y
CONFIG_NET_L2_IEEE802154_SHELL=y
```

## prj_cc2520_2.conf
```kconfig
CONFIG_ARC_INIT=n

CONFIG_NETWORKING=y
CONFIG_TEST_RANDOM_GENERATOR=y

CONFIG_NET_TX_STACK_SIZE=2048
CONFIG_NET_RX_STACK_SIZE=2048

CONFIG_NET_PKT_RX_COUNT=10
CONFIG_NET_PKT_TX_COUNT=10
CONFIG_NET_BUF_RX_COUNT=20
CONFIG_NET_BUF_TX_COUNT=20
CONFIG_NET_MAX_CONTEXTS=10

CONFIG_NET_IPV4=n
CONFIG_NET_IPV6=y
CONFIG_NET_IPV6_ND=y
CONFIG_NET_IPV6_RA_RDNSS=n
CONFIG_NET_IPV6_DAD=n
CONFIG_NET_IPV6_MLD=n
CONFIG_NET_IF_UNICAST_IPV6_ADDR_COUNT=2

CONFIG_NET_DEBUG_6LO=y

CONFIG_NET_LOG=y
CONFIG_SYS_LOG_NET_LEVEL=1
CONFIG_SYS_LOG_SHOW_COLOR=y
CONFIG_INIT_STACKS=y
CONFIG_PRINTK=y

CONFIG_NET_DEBUG_CORE=n
CONFIG_NET_DEBUG_IPV6_NBR_CACHE=n
CONFIG_NET_DEBUG_IPV6=n
CONFIG_NET_DEBUG_CONTEXT=n
CONFIG_NET_DEBUG_NET_PKT=n
CONFIG_NET_DEBUG_UTILS=n
CONFIG_NET_DEBUG_IF=n
CONFIG_NET_DEBUG_ICMPV6=n
CONFIG_NET_DEBUG_CONN=n
CONFIG_NET_STATISTICS=y
CONFIG_NET_STATISTICS_PERIODIC_OUTPUT=n

CONFIG_NET_L2_IEEE802154=y
CONFIG_NET_DEBUG_L2_IEEE802154=y
CONFIG_NET_DEBUG_L2_IEEE802154_FRAGMENT=y
CONFIG_NET_L2_IEEE802154_SECURITY=y
CONFIG_NET_L2_IEEE802154_SECURITY_CRYPTO_DEV_NAME="cc2520_crypto"

CONFIG_IEEE802154_CC2520=y
CONFIG_IEEE802154_CC2520_AUTO_ACK=y
CONFIG_SYS_LOG_IEEE802154_DRIVER_LEVEL=1
CONFIG_IEEE802154_CC2520_CRYPTO=y

CONFIG_NET_APP_SETTINGS=y
CONFIG_NET_APP_MY_IPV6_ADDR="2001:db8::2"
CONFIG_NET_APP_IEEE802154_DEV_NAME="cc2520"
CONFIG_NET_APP_IEEE802154_SECURITY_KEY="moooooooooooooh"
CONFIG_NET_APP_IEEE802154_SECURITY_KEY_MODE=0
CONFIG_NET_APP_IEEE802154_SECURITY_LEVEL=7

CONFIG_NET_SHELL=y
CONFIG_KERNEL_SHELL=y
CONFIG_NET_L2_IEEE802154_SHELL=y
```

## prj_client.conf
```kconfig
CONFIG_NETWORKING=y
CONFIG_TEST_RANDOM_GENERATOR=y

CONFIG_NET_PKT_RX_COUNT=6
CONFIG_NET_PKT_TX_COUNT=6
CONFIG_NET_BUF_RX_COUNT=10
CONFIG_NET_BUF_TX_COUNT=10

CONFIG_NET_IPV4=n
CONFIG_NET_IPV6=y
CONFIG_NET_IPV6_RA_RDNSS=y
CONFIG_NET_IF_UNICAST_IPV6_ADDR_COUNT=2

CONFIG_NET_DEBUG_6LO=y

CONFIG_SYS_LOG=y
CONFIG_NET_BUF_LOG=n
CONFIG_SYS_LOG_NET_BUF_LEVEL=2
CONFIG_NET_LOG=y
CONFIG_NET_LOG_GLOBAL=y
CONFIG_SYS_LOG_NET_LEVEL=2
CONFIG_SYS_LOG_SHOW_COLOR=y
CONFIG_INIT_STACKS=y

CONFIG_NET_DEBUG_CORE=y
CONFIG_NET_DEBUG_IPV6_NBR_CACHE=y
CONFIG_NET_DEBUG_IPV6=y
CONFIG_NET_DEBUG_CONTEXT=y
CONFIG_NET_DEBUG_NET_PKT=y
CONFIG_NET_DEBUG_UTILS=y
CONFIG_NET_DEBUG_IF=y
CONFIG_NET_DEBUG_ICMPV6=y
CONFIG_NET_DEBUG_CONN=y
CONFIG_NET_STATISTICS=y

CONFIG_NET_L2_IEEE802154=y
CONFIG_NET_DEBUG_L2_IEEE802154=y
CONFIG_NET_L2_IEEE802154_RFD=y

CONFIG_IEEE802154_UPIPE=y
CONFIG_SYS_LOG_IEEE802154_DRIVER_LEVEL=2

CONFIG_NET_APP_SETTINGS=y
CONFIG_NET_APP_MY_IPV6_ADDR="2001:db8::2"

CONFIG_NET_SHELL=y
CONFIG_KERNEL_SHELL=y
CONFIG_NET_L2_IEEE802154_SHELL=y
```

## prj_kw40z.conf
```kconfig
CONFIG_NETWORKING=y
CONFIG_TEST_RANDOM_GENERATOR=y

CONFIG_NET_PKT_RX_COUNT=4
CONFIG_NET_PKT_TX_COUNT=4
CONFIG_NET_BUF_RX_COUNT=8
CONFIG_NET_BUF_TX_COUNT=8
CONFIG_NET_MAX_CONTEXTS=3

CONFIG_NET_TX_STACK_SIZE=1024
CONFIG_NET_RX_STACK_SIZE=1024

CONFIG_NET_IPV4=n
CONFIG_NET_IPV6=y
CONFIG_NET_IPV6_RA_RDNSS=y
CONFIG_NET_IF_UNICAST_IPV6_ADDR_COUNT=2
CONFIG_NET_IPV6_MAX_NEIGHBORS=4

CONFIG_NET_DEBUG_6LO=y

CONFIG_NET_LOG=y
CONFIG_SYS_LOG_NET_LEVEL=1
CONFIG_SYS_LOG_SHOW_COLOR=y
CONFIG_INIT_STACKS=y
CONFIG_PRINTK=y

CONFIG_NET_DEBUG_CORE=y
CONFIG_NET_DEBUG_IPV6_NBR_CACHE=y
CONFIG_NET_DEBUG_IPV6=y
CONFIG_NET_DEBUG_CONTEXT=y
CONFIG_NET_DEBUG_NET_PKT=y
CONFIG_NET_DEBUG_UTILS=y
CONFIG_NET_DEBUG_IF=y
CONFIG_NET_DEBUG_ICMPV6=y
CONFIG_NET_DEBUG_CONN=y
CONFIG_NET_STATISTICS=y
CONFIG_NET_STATISTICS_PERIODIC_OUTPUT=n

CONFIG_NET_L2_IEEE802154=y
CONFIG_NET_DEBUG_L2_IEEE802154=y
CONFIG_NET_L2_IEEE802154_SECURITY=n

CONFIG_IEEE802154_KW41Z=y
CONFIG_SYS_LOG_IEEE802154_DRIVER_LEVEL=1

CONFIG_NET_APP_SETTINGS=y
CONFIG_NET_APP_MY_IPV6_ADDR="2001:db8::1"
CONFIG_NET_APP_IEEE802154_DEV_NAME="KW41Z"

CONFIG_NET_SHELL=y
CONFIG_KERNEL_SHELL=y
CONFIG_NET_L2_IEEE802154_SHELL=y
```

## prj_kw41z.conf
```kconfig
CONFIG_NETWORKING=y
CONFIG_TEST_RANDOM_GENERATOR=y

CONFIG_NET_PKT_RX_COUNT=10
CONFIG_NET_PKT_TX_COUNT=10
CONFIG_NET_BUF_RX_COUNT=20
CONFIG_NET_BUF_TX_COUNT=20
CONFIG_NET_MAX_CONTEXTS=10

CONFIG_NET_IPV4=n
CONFIG_NET_IPV6=y
CONFIG_NET_IPV6_RA_RDNSS=y
CONFIG_NET_IF_UNICAST_IPV6_ADDR_COUNT=2

CONFIG_NET_DEBUG_6LO=y

CONFIG_NET_LOG=y
CONFIG_SYS_LOG_NET_LEVEL=1
CONFIG_SYS_LOG_SHOW_COLOR=y
CONFIG_INIT_STACKS=y
CONFIG_PRINTK=y

CONFIG_NET_DEBUG_CORE=y
CONFIG_NET_DEBUG_IPV6_NBR_CACHE=y
CONFIG_NET_DEBUG_IPV6=y
CONFIG_NET_DEBUG_CONTEXT=y
CONFIG_NET_DEBUG_NET_PKT=y
CONFIG_NET_DEBUG_UTILS=y
CONFIG_NET_DEBUG_IF=y
CONFIG_NET_DEBUG_ICMPV6=y
CONFIG_NET_DEBUG_CONN=y
CONFIG_NET_STATISTICS=y
CONFIG_NET_STATISTICS_PERIODIC_OUTPUT=n

CONFIG_NET_L2_IEEE802154=y
CONFIG_NET_DEBUG_L2_IEEE802154=y
CONFIG_NET_L2_IEEE802154_SECURITY=n

CONFIG_IEEE802154_KW41Z=y
CONFIG_SYS_LOG_IEEE802154_DRIVER_LEVEL=1

CONFIG_NET_APP_SETTINGS=y
CONFIG_NET_APP_MY_IPV6_ADDR="2001:db8::1"
CONFIG_NET_APP_IEEE802154_DEV_NAME="KW41Z"

CONFIG_NET_SHELL=y
CONFIG_KERNEL_SHELL=y
CONFIG_NET_L2_IEEE802154_SHELL=y
```

## prj_mcr20a.conf
```kconfig
CONFIG_SPI=y
CONFIG_SYS_LOG_SPI_LEVEL=1

CONFIG_NETWORKING=y
CONFIG_TEST_RANDOM_GENERATOR=y

CONFIG_NET_PKT_RX_COUNT=10
CONFIG_NET_PKT_TX_COUNT=10
CONFIG_NET_BUF_RX_COUNT=20
CONFIG_NET_BUF_TX_COUNT=20
CONFIG_NET_MAX_CONTEXTS=10

CONFIG_NET_IPV4=n
CONFIG_NET_IPV6=y
CONFIG_NET_IPV6_RA_RDNSS=y
CONFIG_NET_IF_UNICAST_IPV6_ADDR_COUNT=2

CONFIG_NET_DEBUG_6LO=y

CONFIG_NET_LOG=y
CONFIG_SYS_LOG_NET_LEVEL=1
CONFIG_SYS_LOG_SHOW_COLOR=y
CONFIG_INIT_STACKS=y
CONFIG_PRINTK=y

CONFIG_NET_DEBUG_CORE=y
CONFIG_NET_DEBUG_IPV6_NBR_CACHE=y
CONFIG_NET_DEBUG_IPV6=y
CONFIG_NET_DEBUG_CONTEXT=y
CONFIG_NET_DEBUG_NET_PKT=y
CONFIG_NET_DEBUG_UTILS=y
CONFIG_NET_DEBUG_IF=y
CONFIG_NET_DEBUG_ICMPV6=y
CONFIG_NET_DEBUG_CONN=y
CONFIG_NET_STATISTICS=y
CONFIG_NET_STATISTICS_PERIODIC_OUTPUT=n

CONFIG_NET_L2_IEEE802154=y
CONFIG_NET_DEBUG_L2_IEEE802154=y
CONFIG_NET_L2_IEEE802154_SECURITY=n

CONFIG_IEEE802154_MCR20A=y
CONFIG_SYS_LOG_IEEE802154_DRIVER_LEVEL=1

CONFIG_NET_APP_SETTINGS=y
CONFIG_NET_APP_MY_IPV6_ADDR="2001:db8::1"
CONFIG_NET_APP_IEEE802154_DEV_NAME="mcr20a"

CONFIG_NET_SHELL=y
CONFIG_KERNEL_SHELL=y
CONFIG_NET_L2_IEEE802154_SHELL=y
```

## src/ieee802154_test.c
```c
/*
 * Copyright (c) 2016 Intel Corporation.
 *
 * SPDX-License-Identifier: Apache-2.0
 */

#include <zephyr.h>

void main(void)
{
	return;
}
```
