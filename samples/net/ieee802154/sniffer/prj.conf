## CMakeLists.txt
```
cmake_minimum_required(VERSION 3.20.0)

find_package(Zephyr REQUIRED HINTS $ENV{ZEPHYR_BASE})
project(ieee802154_sniffer)

target_sources(app PRIVATE src/main.c src/shell.c)
```

## prj.conf
```kconfig
CONFIG_LOG=y
CONFIG_LOG_DEFAULT_LEVEL=3

CONFIG_SERIAL=y
CONFIG_CONSOLE=y
CONFIG_UART_CONSOLE=y

CONFIG_NETWORKING=y

CONFIG_IEEE802154=y
CONFIG_IEEE802154_RAW_MODE=y
CONFIG_NET_PKT_TIMESTAMP=y

# The capture line carries the PSDU without an FCS and the host tool appends a
# recomputed one. The radio has already dropped the frames whose checksum was
# wrong, and some radios, the ESP32 among them, overwrite the two FCS bytes with
# RSSI and LQI, so what the driver would hand up is not a checksum at all.
CONFIG_IEEE802154_L2_PKT_INCL_FCS=n

CONFIG_SHELL=y
CONFIG_SHELL_BACKEND_SERIAL=y

# The console stays at the board's rate for the shell, and the host tool raises
# it for the duration of a capture.
CONFIG_UART_USE_RUNTIME_CONFIGURE=y

# Keep buffers small but sufficient for sniffing
CONFIG_NET_PKT_RX_COUNT=16
CONFIG_NET_BUF_RX_COUNT=32
CONFIG_NET_BUF_DATA_SIZE=256

# Channel the radio is tuned to at boot; the host tool retunes it.
CONFIG_NET_CONFIG_SETTINGS=y
CONFIG_NET_CONFIG_AUTO_INIT=n
CONFIG_NET_CONFIG_IEEE802154_CHANNEL=20
```

## src/main.c
```c
/*
 * Copyright (c) 2026 Espressif Systems (Shanghai) Co., Ltd.
 *
 * SPDX-License-Identifier: Apache-2.0
 */

#include <zephyr/logging/log.h>
#include <errno.h>
LOG_MODULE_REGISTER(sniffer, LOG_LEVEL_INF);

#include <zephyr/device.h>
#include <zephyr/drivers/uart.h>
#include <zephyr/kernel.h>
#include <zephyr/net_buf.h>
#include <zephyr/net/ieee802154.h>
#include <zephyr/net/ieee802154_pkt.h>
#include <zephyr/net/ieee802154_radio.h>
#include <zephyr/net/net_pkt.h>
#include <zephyr/sys/atomic.h>
#include <zephyr/sys/printk.h>
#include <string.h>
#include "sniffer.h"

#define DEFAULT_CHANNEL           20
#define SNIFFER_STREAM_Q_DEPTH    16
#define SNIFFER_STREAM_STACK_SIZE 2048
#define SNIFFER_STREAM_PRIO       K_LOWEST_APPLICATION_THREAD_PRIO

/* "psdu: " + 2 hex digits per PSDU byte
 * + " power: -32768 lqi: 255 time: 18446744073709551615\r\n"
 */
#define SNIFFER_LINE_PREFIX   "psdu: "
#define SNIFFER_LINE_TAIL_MAX 56

struct sniffer_capture_msg {
	uint16_t len;
	uint8_t lqi;
	int16_t rssi_dbm;
	uint64_t timestamp_us;
	uint8_t payload[IEEE802154_MAX_PHY_PACKET_SIZE];
};

static const struct ieee802154_radio_driver_api *radio_api;
static const struct device *const radio = DEVICE_DT_GET(DT_CHOSEN(zephyr_ieee802154));
static enum ieee802154_hw_caps caps;
static uint16_t current_channel;
static uint32_t current_console_speed;

/* Guards the capture state machine against concurrent shell commands. */
static K_MUTEX_DEFINE(sniffer_lock);
static bool sniffer_running;

#if DT_HAS_CHOSEN(zephyr_console)
static const struct device *const stream_uart = DEVICE_DT_GET(DT_CHOSEN(zephyr_console));
#else
static const struct device *const stream_uart;
#endif

K_MSGQ_DEFINE(sniffer_capture_q, sizeof(struct sniffer_capture_msg), SNIFFER_STREAM_Q_DEPTH, 4);

static atomic_t stat_rx_enqueued;
static atomic_t stat_rx_dropped;
static atomic_t stat_tx_records;
static atomic_t stat_tx_bytes;
static atomic_t stat_q_high_wm;

static void sniffer_stream_write(const uint8_t *buf, size_t len)
{
	if (stream_uart == NULL || !device_is_ready(stream_uart)) {
		return;
	}

	for (size_t i = 0; i < len; i++) {
		uart_poll_out(stream_uart, buf[i]);
	}
}

/* One capture line, as consumed by the extcap plugin:
 *
 *   psdu: <hex> power: <rssi-dbm> lqi: <lqi> time: <us>
 *
 * The hex digits are streamed out byte by byte rather than formatted into a
 * buffer: a maximum-length PSDU is 254 characters.
 */
static void sniffer_emit_frame(const struct sniffer_capture_msg *msg)
{
	static const char hex[] = "0123456789abcdef";
	char tail[SNIFFER_LINE_TAIL_MAX];
	int len;

	sniffer_stream_write((const uint8_t *)SNIFFER_LINE_PREFIX,
			     sizeof(SNIFFER_LINE_PREFIX) - 1U);

	for (size_t i = 0; i < msg->len; i++) {
		char nibbles[2];

		nibbles[0] = hex[(msg->payload[i] >> 4) & 0x0FU];
		nibbles[1] = hex[msg->payload[i] & 0x0FU];
		sniffer_stream_write((const uint8_t *)nibbles, sizeof(nibbles));
	}

	/* An unavailable RSSI is reported as IEEE802154_MAC_RSSI_DBM_UNDEFINED
	 * (INT16_MIN) rather than omitted, so every line has the same shape.
	 */
	len = snprintk(tail, sizeof(tail), " power: %d lqi: %u time: %llu\r\n", msg->rssi_dbm,
		       msg->lqi, msg->timestamp_us);
	if (len <= 0) {
		return;
	}

	if ((size_t)len >= sizeof(tail)) {
		len = sizeof(tail) - 1;
	}

	sniffer_stream_write((const uint8_t *)tail, (size_t)len);

	atomic_inc(&stat_tx_records);
	atomic_add(&stat_tx_bytes, sizeof(SNIFFER_LINE_PREFIX) - 1U + 2U * msg->len + (size_t)len);
}

static void sniffer_stream_thread(void *p1, void *p2, void *p3)
{
	ARG_UNUSED(p1);
	ARG_UNUSED(p2);
	ARG_UNUSED(p3);

	struct sniffer_capture_msg msg;

	while (1) {
		k_msgq_get(&sniffer_capture_q, &msg, K_FOREVER);
		sniffer_emit_frame(&msg);
	}
}

K_THREAD_DEFINE(sniffer_stream_tid, SNIFFER_STREAM_STACK_SIZE, sniffer_stream_thread, NULL, NULL,
		NULL, SNIFFER_STREAM_PRIO, 0, 0);

/* Receive time in microseconds since boot. Drivers that do not timestamp received
 * frames, and builds without CONFIG_NET_PKT_TIMESTAMP, leave it at 0; the frame is
 * then stamped with the time it reaches this sample instead.
 */
static inline uint64_t sniffer_rx_time_us(struct net_pkt *pkt)
{
	uint64_t timestamp_us = (uint64_t)(net_pkt_timestamp_ns(pkt) / NSEC_PER_USEC);

	if (timestamp_us != 0U) {
		return timestamp_us;
	}

	if (IS_ENABLED(CONFIG_TIMER_HAS_64BIT_CYCLE_COUNTER)) {
		return k_cyc_to_us_floor64(k_cycle_get_64());
	}

	return k_ticks_to_us_floor64(k_uptime_ticks());
}

/* Raw mode (CONFIG_IEEE802154_RAW_MODE) leaves the net stack out of the build,
 * so the driver's receive path lands here directly. It runs in the driver's RX thread.
 */
int net_recv_data(struct net_if *iface, struct net_pkt *pkt)
{
	ARG_UNUSED(iface);

	struct sniffer_capture_msg msg = {0};
	size_t len = net_pkt_get_len(pkt);
	uint32_t q_used;
	uint32_t q_hwm;
	int ret;

	if (len > IEEE802154_MAX_PHY_PACKET_SIZE) {
		atomic_inc(&stat_rx_dropped);
		net_pkt_unref(pkt);
		return 0;
	}

	msg.len = (uint16_t)len;
	msg.lqi = net_pkt_ieee802154_lqi(pkt);
	msg.rssi_dbm = net_pkt_ieee802154_rssi_dbm(pkt);
	msg.timestamp_us = sniffer_rx_time_us(pkt);
	net_pkt_cursor_init(pkt);
	ret = net_pkt_read(pkt, msg.payload, len);
	net_pkt_unref(pkt);

	if (ret < 0) {
		atomic_inc(&stat_rx_dropped);
		return 0;
	}

	ret = k_msgq_put(&sniffer_capture_q, &msg, K_NO_WAIT);
	if (ret != 0) {
		atomic_inc(&stat_rx_dropped);
		return 0;
	}

	atomic_inc(&stat_rx_enqueued);

	q_used = k_msgq_num_used_get(&sniffer_capture_q);
	q_hwm = atomic_get(&stat_q_high_wm);
	while (q_used > q_hwm &&
	       !atomic_cas(&stat_q_high_wm, (atomic_val_t)q_hwm, (atomic_val_t)q_used)) {
		q_hwm = atomic_get(&stat_q_high_wm);
	}

	return 0;
}

/* Raw mode has no L2 to match ACKs against, and some drivers call this unconditionally. */
enum net_verdict ieee802154_handle_ack(struct net_if *iface, struct net_pkt *pkt)
{
	ARG_UNUSED(iface);
	ARG_UNUSED(pkt);

	return NET_CONTINUE;
}

uint16_t sniffer_get_channel(void)
{
	return current_channel;
}

int sniffer_set_channel(uint16_t channel)
{
	int err;

	if ((radio_api == NULL) || (radio_api->set_channel == NULL)) {
		return -ENOTSUP;
	}

	k_mutex_lock(&sniffer_lock, K_FOREVER);

	/* The host tags the capture with the channel it asked for, so only retune while stopped. */
	if (sniffer_running) {
		k_mutex_unlock(&sniffer_lock);
		return -EBUSY;
	}

	err = radio_api->set_channel(radio, channel);
	if (err == 0) {
		current_channel = channel;
	}

	k_mutex_unlock(&sniffer_lock);

	return err;
}

uint32_t sniffer_get_console_speed(void)
{
	return current_console_speed;
}

/* The host tool raises the console rate for the duration of a capture: a
 * maximum-length frame takes 26 ms to print at 115200 baud, slower than a busy
 * channel delivers frames.
 *
 * uart_configure() answers -ENOTSUP of its own accord when
 * CONFIG_UART_USE_RUNTIME_CONFIGURE is disabled.
 */
int sniffer_set_console_speed(uint32_t baudrate)
{
	struct uart_config cfg;
	int err;

	if (stream_uart == NULL || !device_is_ready(stream_uart)) {
		return -ENODEV;
	}

	err = uart_config_get(stream_uart, &cfg);
	if (err != 0) {
		return err;
	}

	cfg.baudrate = baudrate;

	err = uart_configure(stream_uart, &cfg);
	if (err != 0) {
		return err;
	}

	current_console_speed = baudrate;

	return 0;
}

int sniffer_start(void)
{
	int err;

	if ((radio_api == NULL) || (radio_api->start == NULL)) {
		return -ENOTSUP;
	}

	k_mutex_lock(&sniffer_lock, K_FOREVER);

	if (sniffer_running) {
		k_mutex_unlock(&sniffer_lock);
		return -EALREADY;
	}

	err = radio_api->start(radio);
	if (err == 0 || err == -EALREADY) {
		sniffer_running = true;
		err = 0;
	}

	k_mutex_unlock(&sniffer_lock);

	return err;
}

int sniffer_stop(void)
{
	int err;

	if ((radio_api == NULL) || (radio_api->stop == NULL)) {
		return -ENOTSUP;
	}

	k_mutex_lock(&sniffer_lock, K_FOREVER);

	if (!sniffer_running) {
		k_mutex_unlock(&sniffer_lock);
		return -EALREADY;
	}

	err = radio_api->stop(radio);
	if (err == 0 || err == -EALREADY) {
		sniffer_running = false;
		err = 0;
	}

	k_mutex_unlock(&sniffer_lock);

	return err;
}

void sniffer_stream_get_stats(struct sniffer_stream_stats *stats)
{
	if (stats == NULL) {
		return;
	}

	stats->rx_enqueued = (uint32_t)atomic_get(&stat_rx_enqueued);
	stats->rx_dropped = (uint32_t)atomic_get(&stat_rx_dropped);
	stats->tx_records = (uint32_t)atomic_get(&stat_tx_records);
	stats->tx_bytes = (uint32_t)atomic_get(&stat_tx_bytes);
	stats->q_high_wm = (uint32_t)atomic_get(&stat_q_high_wm);
}

void sniffer_stream_reset_stats(void)
{
	atomic_clear(&stat_rx_enqueued);
	atomic_clear(&stat_rx_dropped);
	atomic_clear(&stat_tx_records);
	atomic_clear(&stat_tx_bytes);
	atomic_clear(&stat_q_high_wm);
}

uint32_t sniffer_stream_queue_used(void)
{
	return k_msgq_num_used_get(&sniffer_capture_q);
}

uint32_t sniffer_stream_queue_capacity(void)
{
	return SNIFFER_STREAM_Q_DEPTH;
}

int main(void)
{
	int ret;

	LOG_INF("IEEE 802.15.4 sniffer");

	/* Radio setup start */
	LOG_INF("Initialize radio...");

	if (!device_is_ready(radio)) {
		LOG_ERR("Radio not ready");
		return -1;
	}

	radio_api = radio->api;
	if ((radio_api == NULL) || (radio_api->start == NULL) || (radio_api->set_channel == NULL)) {
		LOG_ERR("IEEE 802.15.4 driver API incomplete");
		return -1;
	}

	if ((radio_api->configure != NULL) && (radio_api->get_capabilities != NULL)) {
		caps = radio_api->get_capabilities(radio);

		LOG_INF("Radio caps: 0x%x", (unsigned int)caps);

		if ((caps & IEEE802154_HW_PROMISC) != 0U) {
			struct ieee802154_config cfg = {0};

			cfg.promiscuous = true;
			if (radio_api->configure(radio, IEEE802154_CONFIG_PROMISCUOUS, &cfg) != 0) {
				LOG_WRN("Promiscuous mode enable failed");
			} else {
				LOG_INF("Promiscuous mode enabled");
			}
		} else {
			LOG_WRN("Driver does not allow IEEE802154_HW_PROMISC");
		}
	}

#if defined(CONFIG_NET_CONFIG_IEEE802154_CHANNEL)
	current_channel = CONFIG_NET_CONFIG_IEEE802154_CHANNEL;
#else
	current_channel = DEFAULT_CHANNEL;
#endif

	if (sniffer_set_channel(current_channel) != 0) {
		LOG_WRN("Failed to set channel %d", current_channel);
	} else {
		LOG_INF("Channel set to %d", current_channel);
	}

	if (stream_uart == NULL || !device_is_ready(stream_uart)) {
		LOG_WRN("Stream UART unavailable; capture output disabled");
	} else {
		struct uart_config cfg;

		/* The driver derives this from the clock divider, so it can be a
		 * few baud off the configured rate until the host sets one.
		 */
		if (uart_config_get(stream_uart, &cfg) == 0) {
			current_console_speed = cfg.baudrate;
			LOG_INF("Console at %u baud", current_console_speed);
		}
	}

	ret = sniffer_start();
	if ((ret != 0) && (ret != -EALREADY)) {
		LOG_ERR("Failed to start radio (%d)", ret);
		return -1;
	}

	LOG_INF("IEEE 802.15.4 sniffer started");

	return 0;
}
```

## src/shell.c
```c
/*
 * Copyright (c) 2026 Espressif Systems (Shanghai) Co., Ltd.
 *
 * SPDX-License-Identifier: Apache-2.0
 */

#include <errno.h>
#include <stdint.h>
#include <stdlib.h>

#include <zephyr/kernel.h>
#include <zephyr/shell/shell.h>

#include "sniffer.h"

static int cmd_sniffer_start(const struct shell *sh, size_t argc, char **argv)
{
	ARG_UNUSED(argc);
	ARG_UNUSED(argv);

	int err = sniffer_start();

	if (err == -EALREADY) {
		shell_print(sh, "already started");
		return 0;
	}

	if (err != 0) {
		shell_error(sh, "start failed (%d)", err);
		return err;
	}

	shell_print(sh, "started");
	return 0;
}

static int cmd_sniffer_stop(const struct shell *sh, size_t argc, char **argv)
{
	ARG_UNUSED(argc);
	ARG_UNUSED(argv);

	int err = sniffer_stop();

	if (err == -EALREADY) {
		shell_print(sh, "already stopped");
		return 0;
	}

	if (err != 0) {
		shell_error(sh, "stop failed (%d)", err);
		return err;
	}

	shell_print(sh, "stopped");
	return 0;
}

static int cmd_sniffer_channel(const struct shell *sh, size_t argc, char **argv)
{
	if (argc == 1) {
		shell_print(sh, "%u", (unsigned int)sniffer_get_channel());
		return 0;
	}

	char *endp = NULL;
	long ch = strtol(argv[1], &endp, 0);

	if (endp == NULL || *endp != '\0') {
		shell_error(sh, "invalid channel: %s", argv[1]);
		return -EINVAL;
	}

	if (ch < 0 || ch > UINT16_MAX) {
		shell_error(sh, "channel out of range: %ld", ch);
		return -ERANGE;
	}

	int err = sniffer_set_channel((uint16_t)ch);

	if (err == -EBUSY) {
		shell_error(sh, "cannot change channel while running; run 'sniffer stop' first");
		return err;
	}

	if (err != 0) {
		shell_error(sh, "set channel failed (%d)", err);
		return err;
	}

	shell_print(sh, "channel %u", (unsigned int)sniffer_get_channel());
	return 0;
}

/* The reply has to reach the host before the rate changes: the ESP32 driver
 * resets the transmit FIFO in uart_configure(), which would drop whatever is
 * still queued, and the host waits for this line at the old rate.
 */
#define SNIFFER_SPEED_DRAIN_MS 20

static int cmd_sniffer_speed(const struct shell *sh, size_t argc, char **argv)
{
	if (argc == 1) {
		shell_print(sh, "speed %u", (unsigned int)sniffer_get_console_speed());
		return 0;
	}

	char *endp = NULL;
	unsigned long baudrate = strtoul(argv[1], &endp, 0);

	if (endp == NULL || *endp != '\0') {
		shell_error(sh, "invalid baud rate: %s", argv[1]);
		return -EINVAL;
	}

	if (baudrate == 0UL || baudrate > UINT32_MAX) {
		shell_error(sh, "baud rate out of range: %s", argv[1]);
		return -ERANGE;
	}

	shell_print(sh, "speed %lu", baudrate);

	k_msleep(SNIFFER_SPEED_DRAIN_MS);

	int err = sniffer_set_console_speed((uint32_t)baudrate);

	if (err != 0) {
		/* Reported at the rate the console had before, which is still the
		 * one in use when the change failed.
		 */
		shell_error(sh, "set speed failed (%d)", err);
		return err;
	}

	return 0;
}

static int cmd_sniffer_stats(const struct shell *sh, size_t argc, char **argv)
{
	ARG_UNUSED(argc);
	ARG_UNUSED(argv);

	struct sniffer_stream_stats stats;

	sniffer_stream_get_stats(&stats);
	shell_print(sh, "enq=%u drop=%u tx_rec=%u tx_bytes=%u q_hwm=%u q_used=%u/%u",
		    stats.rx_enqueued, stats.rx_dropped, stats.tx_records, stats.tx_bytes,
		    stats.q_high_wm, sniffer_stream_queue_used(), sniffer_stream_queue_capacity());
	return 0;
}

static int cmd_sniffer_stats_reset(const struct shell *sh, size_t argc, char **argv)
{
	ARG_UNUSED(argc);
	ARG_UNUSED(argv);

	sniffer_stream_reset_stats();
	shell_print(sh, "stats reset");
	return 0;
}

/* clang-format off */
SHELL_STATIC_SUBCMD_SET_CREATE(
	sub_sniffer,
	SHELL_CMD(start, NULL, "Start sniffing (enable RX).", cmd_sniffer_start),
	SHELL_CMD(stop, NULL, "Stop sniffing (disable RX).", cmd_sniffer_stop),
	SHELL_CMD(channel, NULL, "Get/set channel: channel [11..26].", cmd_sniffer_channel),
	SHELL_CMD(speed, NULL, "Get/set console baud rate: speed [baud].", cmd_sniffer_speed),
	SHELL_CMD(stats, NULL, "Show stream queue and traffic stats.", cmd_sniffer_stats),
	SHELL_CMD(stats_reset, NULL, "Reset stream stats counters.", cmd_sniffer_stats_reset),
	SHELL_SUBCMD_SET_END
);
/* clang-format on */

SHELL_CMD_REGISTER(sniffer, &sub_sniffer, "IEEE 802.15.4 sniffer control.", NULL);
```

## src/sniffer.h
```c
/*
 * Copyright (c) 2026 Espressif Systems (Shanghai) Co., Ltd.
 *
 * SPDX-License-Identifier: Apache-2.0
 */

#ifndef IEEE802154_SNIFFER_H_
#define IEEE802154_SNIFFER_H_

#include <stdint.h>

struct sniffer_stream_stats {
	uint32_t rx_enqueued;
	uint32_t rx_dropped;
	uint32_t tx_records;
	uint32_t tx_bytes;
	uint32_t q_high_wm;
};

int sniffer_start(void);
int sniffer_stop(void);
int sniffer_set_channel(uint16_t channel);
uint16_t sniffer_get_channel(void);
int sniffer_set_console_speed(uint32_t baudrate);
uint32_t sniffer_get_console_speed(void);

void sniffer_stream_get_stats(struct sniffer_stream_stats *stats);
void sniffer_stream_reset_stats(void);
uint32_t sniffer_stream_queue_used(void);
uint32_t sniffer_stream_queue_capacity(void);

#endif /* IEEE802154_SNIFFER_H_ */
```
