## prj.conf
```kconfig
CONFIG_NETWORKING=y
CONFIG_TEST_RANDOM_GENERATOR=y

CONFIG_NET_NBUF_RX_COUNT=6
CONFIG_NET_NBUF_TX_COUNT=6
CONFIG_NET_NBUF_RX_DATA_COUNT=10
CONFIG_NET_NBUF_TX_DATA_COUNT=10

CONFIG_NET_IPV4=n
CONFIG_NET_IPV6=y
CONFIG_NET_IPV6_RA_RDNSS=y
CONFIG_NET_IF_UNICAST_IPV6_ADDR_COUNT=2

CONFIG_NET_6LO=y
CONFIG_NET_DEBUG_6LO=y

CONFIG_SYS_LOG=y
CONFIG_NET_BUF_LOG=n
CONFIG_SYS_LOG_NET_BUF_LEVEL=2
CONFIG_NET_LOG=y
CONFIG_NET_LOG_GLOBAL=y
CONFIG_SYS_LOG_NET_LEVEL=2
CONFIG_SYS_LOG_SHOW_COLOR=y
CONFIG_INIT_STACKS=y

CONFIG_NET_DEBUG_CORE=y
CONFIG_NET_DEBUG_IPV6_NBR_CACHE=y
CONFIG_NET_DEBUG_IPV6=y
CONFIG_NET_DEBUG_CONTEXT=y
CONFIG_NET_DEBUG_NET_BUF=y
CONFIG_NET_DEBUG_UTILS=y
CONFIG_NET_DEBUG_IF=y
CONFIG_NET_DEBUG_ICMPV6=y
CONFIG_NET_DEBUG_CONN=y
CONFIG_NET_STATISTICS=y

CONFIG_NET_L2_IEEE802154=y
CONFIG_NET_DEBUG_L2_IEEE802154=y
CONFIG_NET_L2_IEEE802154_RFD=y
CONFIG_NET_L2_IEEE802154_FRAGMENT=y
#CONFIG_NET_DEBUG_L2_IEEE802154_FRAGMENT=y

CONFIG_IEEE802154_UPIPE=y
CONFIG_SYS_LOG_IEEE802154_DRIVER_LEVEL=2

CONFIG_NET_APP_SETTINGS=y
CONFIG_NET_APP_MY_IPV6_ADDR="2001:db8::1"

CONFIG_NET_SHELL=y
CONFIG_KERNEL_SHELL=y
CONFIG_NET_L2_IEEE802154_SHELL=y
```

## prj_client.conf
```kconfig
CONFIG_NETWORKING=y
CONFIG_TEST_RANDOM_GENERATOR=y

CONFIG_NET_NBUF_RX_COUNT=6
CONFIG_NET_NBUF_TX_COUNT=6
CONFIG_NET_NBUF_RX_DATA_COUNT=10
CONFIG_NET_NBUF_TX_DATA_COUNT=10

CONFIG_NET_IPV4=n
CONFIG_NET_IPV6=y
CONFIG_NET_IPV6_RA_RDNSS=y
CONFIG_NET_IF_UNICAST_IPV6_ADDR_COUNT=2

CONFIG_NET_6LO=y
CONFIG_NET_DEBUG_6LO=y

CONFIG_SYS_LOG=y
CONFIG_NET_BUF_LOG=n
CONFIG_SYS_LOG_NET_BUF_LEVEL=2
CONFIG_NET_LOG=y
CONFIG_NET_LOG_GLOBAL=y
CONFIG_SYS_LOG_NET_LEVEL=2
CONFIG_SYS_LOG_SHOW_COLOR=y
CONFIG_INIT_STACKS=y

CONFIG_NET_DEBUG_CORE=y
CONFIG_NET_DEBUG_IPV6_NBR_CACHE=y
CONFIG_NET_DEBUG_IPV6=y
CONFIG_NET_DEBUG_CONTEXT=y
CONFIG_NET_DEBUG_NET_BUF=y
CONFIG_NET_DEBUG_UTILS=y
CONFIG_NET_DEBUG_IF=y
CONFIG_NET_DEBUG_ICMPV6=y
CONFIG_NET_DEBUG_CONN=y
CONFIG_NET_STATISTICS=y

CONFIG_NET_L2_IEEE802154=y
CONFIG_NET_DEBUG_L2_IEEE802154=y
CONFIG_NET_L2_IEEE802154_RFD=y
CONFIG_NET_L2_IEEE802154_FRAGMENT=y
#CONFIG_NET_DEBUG_L2_IEEE802154_FRAGMENT=y

CONFIG_IEEE802154_UPIPE=y
CONFIG_SYS_LOG_IEEE802154_DRIVER_LEVEL=2

CONFIG_NET_APP_SETTINGS=y
CONFIG_NET_APP_MY_IPV6_ADDR="2001:db8::2"

CONFIG_NET_SHELL=y
CONFIG_KERNEL_SHELL=y
CONFIG_NET_L2_IEEE802154_SHELL=y
```

## prj_server.conf
```kconfig
CONFIG_NETWORKING=y
CONFIG_TEST_RANDOM_GENERATOR=y

CONFIG_NET_NBUF_RX_COUNT=6
CONFIG_NET_NBUF_TX_COUNT=6
CONFIG_NET_NBUF_DATA_COUNT=10

CONFIG_NET_IPV4=n
CONFIG_NET_IPV6=y
CONFIG_NET_IPV6_RA_RDNSS=y
CONFIG_NET_IF_UNICAST_IPV6_ADDR_COUNT=2

CONFIG_NET_6LO=y
CONFIG_NET_DEBUG_6LO=y

CONFIG_SYS_LOG=y
CONFIG_NET_BUF_LOG=n
CONFIG_SYS_LOG_NET_BUF_LEVEL=2
CONFIG_NET_LOG=y
CONFIG_NET_LOG_GLOBAL=y
CONFIG_SYS_LOG_NET_LEVEL=2
CONFIG_SYS_LOG_SHOW_COLOR=y
CONFIG_INIT_STACKS=y

CONFIG_NET_DEBUG_CORE=y
CONFIG_NET_DEBUG_IPV6_NBR_CACHE=y
CONFIG_NET_DEBUG_IPV6=y
CONFIG_NET_DEBUG_CONTEXT=y
CONFIG_NET_DEBUG_NET_BUF=y
CONFIG_NET_DEBUG_UTILS=y
CONFIG_NET_DEBUG_IF=y
CONFIG_NET_DEBUG_ICMPV6=y
CONFIG_NET_DEBUG_CONN=y
CONFIG_NET_STATISTICS=y

CONFIG_NET_L2_IEEE802154=y
CONFIG_NET_DEBUG_L2_IEEE802154=y
CONFIG_NET_L2_IEEE802154_RFD=y
CONFIG_NET_L2_IEEE802154_FRAGMENT=y
#CONFIG_NET_DEBUG_L2_IEEE802154_FRAGMENT=y

CONFIG_IEEE802154_UPIPE=y
CONFIG_SYS_LOG_IEEE802154_DRIVER_LEVEL=2

CONFIG_NET_SAMPLES_IP_ADDRESSES=y
CONFIG_NET_SAMPLES_MY_IPV6_ADDR="2001:db8::1"

CONFIG_NET_SHELL=y
CONFIG_KERNEL_SHELL=y
CONFIG_NET_L2_IEEE802154_SHELL=y
```

## src/ieee802154_qemu_test.c
```c
/*
 * Copyright (c) 2016 Intel Corporation.
 *
 * SPDX-License-Identifier: Apache-2.0
 */

#if 1
#define SYS_LOG_DOMAIN "Setup"
#define NET_SYS_LOG_LEVEL SYS_LOG_LEVEL_DEBUG
#define NET_LOG_ENABLED 1
#endif

#include <zephyr.h>
#include <errno.h>

#include <net/net_if.h>
#include <net/net_core.h>

#define MCAST_IP6ADDR "ff84::2"

static void setup_device(void)
{
	char hr_addr[NET_IPV6_ADDR_LEN];
	struct net_if *iface;
	struct in6_addr addr;
	struct device *dev;

	dev = device_get_binding(CONFIG_IEEE802154_UPIPE_DRV_NAME);
	if (!dev) {
		NET_INFO("Cannot get UPIPE device\n");
		return;
	}

	iface = net_if_lookup_by_dev(dev);
	if (!iface) {
		NET_INFO("Cannot get UPIPE network interface\n");
		return;
	}

	if (net_addr_pton(AF_INET6, CONFIG_NET_APP_MY_IPV6_ADDR, &addr)) {
		NET_ERR("Invalid address: %s", CONFIG_NET_APP_MY_IPV6_ADDR);
		return;
	}

	net_if_ipv6_addr_add(iface, &addr, NET_ADDR_MANUAL, 0);

	NET_INFO("IPv6 address: %s",
		 net_addr_ntop(AF_INET6, &addr, hr_addr, NET_IPV6_ADDR_LEN));

	if (net_addr_pton(AF_INET6, MCAST_IP6ADDR, &addr)) {
		NET_ERR("Invalid address: %s", MCAST_IP6ADDR);
		return;
	}

	NET_INFO("802.15.4 device up and running\n");
}


void main(void)
{
	setup_device();

	return;
}
```
