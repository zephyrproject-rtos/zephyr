## CMakeLists.txt
```
# SPDX-License-Identifier: Apache-2.0

cmake_minimum_required(VERSION 3.20.0)
find_package(Zephyr REQUIRED HINTS $ENV{ZEPHYR_BASE})
project(dhcpv6_pd)

file(GLOB app_sources src/*.c)
target_sources(app PRIVATE ${app_sources})
```

## prj.conf
```kconfig
CONFIG_NETWORKING=y
CONFIG_NET_IPV6=y
CONFIG_NET_IPV4=n
CONFIG_NET_UDP=y

# DHCPv6 client with prefix delegation (requesting router).
CONFIG_NET_DHCPV6=y

# Router Advertisement transmit, required to advertise the delegated
# prefix on the downstream link.
CONFIG_NET_IPV6_ND=y
CONFIG_NET_IPV6_ND_RA_TX=y

# Send unsolicited Router Advertisements often so downstream hosts pick up
# the delegated prefix quickly (the default of 600s is impractical for
# interactive testing).
CONFIG_NET_IPV6_ND_RA_TX_INTERVAL=30

# Forwarding between the upstream (WAN) and downstream (LAN) interfaces.
CONFIG_NET_IPV6_ROUTE=y
CONFIG_NET_IPV6_FORWARDING=y

# Prefix delegation needs two links: an upstream (WAN) interface that runs
# the DHCPv6 client and a downstream (LAN) interface onto which the delegated
# prefix is advertised. On native_sim these map to two TAP interfaces
# (zeth0 = upstream, zeth1 = downstream) defined in boards/native_sim.overlay.

# Allow IPv6 on both interfaces and at least two interfaces (upstream +
# downstream) worth of addresses/prefixes.
CONFIG_NET_IF_MAX_IPV6_COUNT=2
CONFIG_NET_IF_UNICAST_IPV6_ADDR_COUNT=4
CONFIG_NET_IF_IPV6_PREFIX_COUNT=4

CONFIG_TEST_RANDOM_GENERATOR=y
CONFIG_INIT_STACKS=y

CONFIG_NET_MGMT=y
CONFIG_NET_MGMT_EVENT=y

CONFIG_NET_LOG=y
CONFIG_LOG=y

CONFIG_NET_SHELL=y

CONFIG_ETH_DRIVER=y
```

## overlay-server.conf
```kconfig
# Overlay to build the sample as a DHCPv6-PD server / delegating router
# instead of a requesting router.

CONFIG_NET_DHCPV6=n
CONFIG_NET_DHCPV6_SERVER=y

# The server serves clients on a single link, so one interface is enough.
# The extra downstream interface is disabled via overlay-server.overlay.
CONFIG_NET_IF_MAX_IPV6_COUNT=1
```

## pd-server.conf
```kconfig
# Overlay to build the sample as a DHCPv6-PD server / delegating router
# instead of a requesting router.

CONFIG_NET_DHCPV6=n
CONFIG_NET_DHCPV6_SERVER=y

# The server serves clients on a single link, so one interface is enough.
# The extra downstream interface is disabled via pd-server.overlay.
CONFIG_NET_IF_MAX_IPV6_COUNT=1
```

## overlay-server.overlay
```dts
/*
 * SPDX-FileCopyrightText: Copyright The Zephyr Project Contributors
 * SPDX-License-Identifier: Apache-2.0
 */

/*
 * The server role serves clients on a single link, so it uses one interface
 * named "zeth" and disables the downstream interface from the board overlay.
 */

&zeth0 {
	host-interface = "zeth";
};

&zeth1 {
	status = "disabled";
};
```

## boards/native_sim.overlay
```dts
/*
 * SPDX-FileCopyrightText: Copyright The Zephyr Project Contributors
 * SPDX-License-Identifier: Apache-2.0
 */

/*
 * The requesting-router (client) build needs two TAP interfaces:
 * zeth0 (upstream/WAN) and zeth1 (downstream/LAN).
 */

&zeth0 {
	host-interface = "zeth0";
};

/ {
	zeth1: zeth1 {
		compatible = "zephyr,native-tap";
		host-interface = "zeth1";
		zephyr,random-mac-address;
		zephyr,mac-address-prefix = [00 00 5e 00 53];
		status = "okay";
	};
};
```

## src/main.c
```c
/*
 * Copyright The Zephyr Project Contributors
 *
 * SPDX-License-Identifier: Apache-2.0
 */

#include <zephyr/logging/log.h>
LOG_MODULE_REGISTER(net_dhcpv6_pd_sample, LOG_LEVEL_INF);

#include <zephyr/kernel.h>
#include <zephyr/net/net_if.h>
#include <zephyr/net/net_mgmt.h>
#include <zephyr/net/net_event.h>
#include <zephyr/net/dhcpv6.h>
#if defined(CONFIG_NET_DHCPV6_SERVER)
#include <zephyr/net/dhcpv6_server.h>
#endif

static struct net_mgmt_event_callback mgmt_cb;

static void event_handler(struct net_mgmt_event_callback *cb,
			  uint64_t mgmt_event, struct net_if *iface)
{
	if (mgmt_event == NET_EVENT_IPV6_DHCP_BOUND) {
		LOG_INF("DHCPv6 bound on interface %d",
			net_if_get_by_iface(iface));
	} else if (mgmt_event == NET_EVENT_IPV6_PREFIX_ADD) {
		LOG_INF("IPv6 prefix added on interface %d",
			net_if_get_by_iface(iface));
	}
}

#if !defined(CONFIG_NET_DHCPV6_SERVER)
/* Return the first interface that is not @p exclude, or NULL. */
static struct net_if *second_iface(struct net_if *exclude)
{
	STRUCT_SECTION_FOREACH(net_if, iface) {
		if (iface != exclude) {
			return iface;
		}
	}

	return NULL;
}
#endif

int main(void)
{
	struct net_if *iface = net_if_get_default();

	if (iface == NULL) {
		LOG_ERR("No default network interface");
		return -ENODEV;
	}

	net_mgmt_init_event_callback(&mgmt_cb, event_handler,
				     NET_EVENT_IPV6_DHCP_BOUND |
				     NET_EVENT_IPV6_PREFIX_ADD);
	net_mgmt_add_event_callback(&mgmt_cb);

#if defined(CONFIG_NET_DHCPV6_SERVER)
	{
		/* The address pool and the prefix pool must not overlap,
		 * otherwise a client would end up advertising the subnet its
		 * own WAN address is taken from onto its LAN. The delegated
		 * prefixes are /56 so that a requesting router can carve
		 * several downstream /64s out of the one it is given.
		 */
		struct net_dhcpv6_server_params params = {
			/* 2001:db8:beef::/56, 2001:db8:beef:100::/56, ... */
			.prefix = { { { 0x20, 0x01, 0x0d, 0xb8, 0xbe, 0xef, 0, 0,
					0, 0, 0, 0, 0, 0, 0, 0 } } },
			.prefix_len = 56,
			/* 2001:db8:abcd::1, 2001:db8:abcd::2, ... */
			.addr = { { { 0x20, 0x01, 0x0d, 0xb8, 0xab, 0xcd, 0, 0,
				      0, 0, 0, 0, 0, 0, 0, 0 } } },
			.offer_addr = true,
			.offer_prefix = true,
		};

		LOG_INF("Starting DHCPv6-PD server");
		net_dhcpv6_server_start(iface, &params);
	}
#else
	{
		struct net_if *down = second_iface(iface);
		struct net_dhcpv6_params params = {
			.request_addr = true,
			.request_prefix = true,
		};

		if (down != NULL) {
			params.downstream_ifaces[0] = net_if_get_by_iface(down);
			params.downstream_count = 1;
			LOG_INF("Requesting router: upstream iface %d, "
				"downstream iface %d",
				net_if_get_by_iface(iface),
				net_if_get_by_iface(down));
		} else {
			LOG_WRN("No downstream interface found, the delegated "
				"prefix will only be installed on iface %d",
				net_if_get_by_iface(iface));
		}

		LOG_INF("Starting DHCPv6 requesting router (prefix delegation)");
		net_dhcpv6_start(iface, &params);
	}
#endif

	return 0;
}
```
