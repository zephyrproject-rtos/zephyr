## CMakeLists.txt
```
# SPDX-License-Identifier: Apache-2.0

cmake_minimum_required(VERSION 3.28.0)

find_package(Zephyr REQUIRED HINTS $ENV{ZEPHYR_BASE})
project(pkt_filter)

target_sources(app PRIVATE src/main.c)

include(${ZEPHYR_BASE}/samples/net/common/common.cmake)
```

## Kconfig
```
# Private config options for pkt_filter sample app

# Copyright (c) 2025 Nordic Semiconductor ASA
# SPDX-License-Identifier: Apache-2.0

mainmenu "Networking pkt_filter sample application"

config NET_SAMPLE_USE_PACKET_PRIORITIES
	bool "Use network packet priorities"
	help
	  Create multiple traffic class queues in order to test
	  network packet priorities.

source "samples/net/common/Kconfig"
source "Kconfig.zephyr"
```

## sample.yaml
```
sample:
  description: Network packet filtering functionality
  name: Network packet filter sample app
common:
  harness: net
  min_ram: 64
  tags:
    - net
    - statistics
    - net_pkt_filter
  depends_on: netif
  integration_platforms:
    - native_sim
tests:
  sample.net.pkt_filter: {}
  sample.net.pkt_filter_priorities:
    extra_args: EXTRA_CONF_FILE="overlay-priority.conf"
```

## prj.conf
```kconfig
# Generic network options
CONFIG_NETWORKING=y
CONFIG_NET_LOG=y
CONFIG_NET_IPV6=y
CONFIG_NET_IPV4=y
CONFIG_NET_DHCPV4=n
CONFIG_NET_UDP=y
CONFIG_NET_TCP=y
CONFIG_NET_L2_ETHERNET=y

# Enable packet filtering
CONFIG_NET_PKT_FILTER=y
CONFIG_NET_PKT_FILTER_IPV4_HOOK=y
CONFIG_NET_PKT_FILTER_IPV6_HOOK=y
CONFIG_NET_PKT_FILTER_LOCAL_IN_HOOK=y

# Network statistics options
CONFIG_NET_STATISTICS=y
CONFIG_NET_STATISTICS_USER_API=y
CONFIG_NET_STATISTICS_PER_INTERFACE=y
CONFIG_NET_STATISTICS_ETHERNET=y

CONFIG_TEST_RANDOM_GENERATOR=y

# Network packet configuration
CONFIG_NET_PKT_RX_COUNT=32
CONFIG_NET_PKT_TX_COUNT=32
CONFIG_NET_BUF_RX_COUNT=32
CONFIG_NET_BUF_TX_COUNT=32

# IP address configuration
CONFIG_NET_IF_UNICAST_IPV6_ADDR_COUNT=5
CONFIG_NET_IF_MCAST_IPV6_ADDR_COUNT=5
CONFIG_NET_IF_UNICAST_IPV4_ADDR_COUNT=1
CONFIG_NET_MAX_CONTEXTS=10

CONFIG_INIT_STACKS=y
CONFIG_PRINTK=y
CONFIG_NET_SHELL=y

# Application configuration
CONFIG_NET_CONFIG_NEED_IPV6=y
CONFIG_NET_CONFIG_NEED_IPV4=y
CONFIG_NET_CONFIG_SETTINGS=y

# IP address configuration
CONFIG_NET_CONFIG_MY_IPV6_ADDR="2001:db8::1"
CONFIG_NET_CONFIG_MY_IPV4_ADDR="192.0.2.1"
CONFIG_NET_CONFIG_PEER_IPV6_ADDR="2001:db8::2"
CONFIG_NET_CONFIG_PEER_IPV4_ADDR="192.0.2.2"

# Logging
CONFIG_LOG=y
CONFIG_LOG_MODE_DEFERRED=y
CONFIG_LOG_BUFFER_SIZE=4096

# VLAN settings. We will have two VLANs in this sample.
CONFIG_NET_VLAN=y
CONFIG_NET_VLAN_COUNT=2
CONFIG_NET_IF_MAX_IPV4_COUNT=3
CONFIG_NET_IF_MAX_IPV6_COUNT=3

# Network traffic class queues
CONFIG_NET_TC_THREAD_PREEMPTIVE=y
CONFIG_NET_TC_RX_COUNT=1
```

## overlay-priority.conf
```kconfig
# Enable network packet priority support in the sample
CONFIG_NET_SAMPLE_USE_PACKET_PRIORITIES=y
CONFIG_NET_TC_RX_COUNT=2
CONFIG_NET_TC_RX_SKIP_FOR_HIGH_PRIO=y
```

## overlay-vlan.conf
```kconfig
CONFIG_NET_VLAN=y

# Allow useful interface assigned to VLAN interface
CONFIG_NET_INTERFACE_NAME_LEN=15

# We have one non-vlan interface and two VLAN interfaces
CONFIG_NET_VLAN_COUNT=2

# There will be three network interfaces so allocate enough IPv4 and IPv6 configs.
CONFIG_NET_IF_MAX_IPV4_COUNT=3
CONFIG_NET_IF_MAX_IPV6_COUNT=3

# First ethernet interface will use these settings
CONFIG_NET_CONFIG_MY_IPV6_ADDR="2001:db8::1"
CONFIG_NET_CONFIG_PEER_IPV6_ADDR="2001:db8::2"
CONFIG_NET_CONFIG_MY_IPV4_ADDR="192.0.2.1"
CONFIG_NET_CONFIG_PEER_IPV4_ADDR="192.0.2.2"

# First VLAN interface will have these settings
CONFIG_NET_SAMPLE_COMMON_VLAN_SETUP_1="100;2001:db8:100::1/64,198.51.100.1/24"

# Second VLAN interface will have these settings
CONFIG_NET_SAMPLE_COMMON_VLAN_SETUP_2="200;2001:db8:200::1/64,203.0.113.1/24"
```

## src/main.c
```c
/*
 * Copyright (c) 2025 Nordic Semiconductor ASA
 *
 * SPDX-License-Identifier: Apache-2.0
 */

#include <zephyr/logging/log.h>
LOG_MODULE_REGISTER(net_stats_sample, LOG_LEVEL_DBG);

#include <zephyr/kernel.h>
#include <errno.h>

#include <zephyr/net/net_core.h>
#include <zephyr/net/net_if.h>
#include <zephyr/net/ethernet.h>
#include <zephyr/net/net_pkt_filter.h>

#include <net_sample_common.h>

#define MAX_INTERFACES 3

static struct net_if *interfaces[MAX_INTERFACES];

/* Interface match rule. The interface value is set at runtime in init_app() */
static NPF_IFACE_MATCH(match_iface_vlan1, NULL);
static NPF_IFACE_MATCH(match_iface_vlan2, NULL);
static NPF_IFACE_MATCH(match_iface_eth, NULL);

/* Match ethernet packets for the precision time protocol (PTP) */
static NPF_ETH_TYPE_MATCH(match_ptype_ptp, NET_ETH_PTYPE_PTP);
/* Match ethernet packets for the virtual local area network (VLAN) */
static NPF_ETH_TYPE_MATCH(match_ptype_vlan, NET_ETH_PTYPE_VLAN);
/* Match max size rule */
static NPF_SIZE_MAX(match_smaller_200, 200);
/* Match min size rule */
static NPF_SIZE_MIN(match_bigger_100, 100);
/* Match virtual internet protocol traffic */
static NPF_ETH_VLAN_TYPE_MATCH(match_ipv4_vlan, NET_ETH_PTYPE_IP);
/* Match virtual address resolution protocol (ARP) traffic */
static NPF_ETH_VLAN_TYPE_MATCH(match_arp_vlan, NET_ETH_PTYPE_ARP);

/* Allow all traffic to Ethernet interface */
static NPF_RULE(eth_iface_rule, NET_OK, match_iface_eth);
/* Maximal priority for ptp traffic */
static NPF_PRIORITY(eth_priority_ptp, NET_PRIORITY_NC, match_iface_eth, match_ptype_ptp);
/* Prioritize VLAN traffic on Ethernet interface */
static NPF_PRIORITY(eth_priority_vlan, NET_PRIORITY_EE, match_iface_eth, match_ptype_vlan);
/* Deprioritize all other traffic */
static NPF_PRIORITY(eth_priority_default, NET_PRIORITY_BK, match_iface_eth);

/* Allow only small ipv4 packets to the first VLAN interface */
static NPF_RULE(small_ipv4_pkt, NET_OK, match_iface_vlan1, match_ipv4_vlan, match_smaller_200);
/* Allow only ipv4 packets of minimum size to the second VLAN interface */
static NPF_RULE(large_ipv4_pkt, NET_OK, match_iface_vlan2, match_ipv4_vlan, match_bigger_100);
/* Allow ARP for both VLAN interfaces */
static NPF_RULE(arp_pkt_vlan1, NET_OK, match_iface_vlan1, match_arp_vlan);
static NPF_RULE(arp_pkt_vlan2, NET_OK, match_iface_vlan2, match_arp_vlan);
/* But give ARP the lowest priority */
static NPF_PRIORITY(arp_priority_vlan1, NET_PRIORITY_BK, match_iface_vlan1, match_arp_vlan);
static NPF_PRIORITY(arp_priority_vlan2, NET_PRIORITY_BK, match_iface_vlan2, match_arp_vlan);

/* Block IPv4 or IPv6 packets from only these addresses */
#define PEER1_IPV4_ADDR_INIT {{{ 192, 0, 2, 2 }}}
#define PEER2_IPV4_ADDR_INIT {{{ 198, 51, 100, 2 }}}
#define PEER1_IPV6_ADDR_INIT \
	{{{ 0x20, 0x01, 0x0d, 0xb8, 0, 0, 0, 0,	0, 0, 0, 0, 0, 0, 0, 0x02 }}}
#define PEER2_IPV6_ADDR_INIT \
	{{{ 0x20, 0x01, 0x0d, 0xb8, 0, 0, 0, 0,	0, 0, 0, 0, 0x1, 0, 0, 0x02 }}}

static struct net_in_addr peer_ipv4_addr[] = {
	[0] = PEER1_IPV4_ADDR_INIT,
	[1] = PEER2_IPV4_ADDR_INIT,
};

static struct net_in6_addr peer_ipv6_addr[] = {
	[0] = PEER1_IPV6_ADDR_INIT,
	[1] = PEER2_IPV6_ADDR_INIT,
};

static NPF_IP_SRC_ADDR_BLOCKLIST(ipv4_src_block,
				 peer_ipv4_addr, ARRAY_SIZE(peer_ipv4_addr),
				 NET_AF_INET);
static NPF_IP_SRC_ADDR_BLOCKLIST(ipv6_src_block,
				 peer_ipv6_addr, ARRAY_SIZE(peer_ipv6_addr),
				 NET_AF_INET6);
static NPF_RULE(ipv4_addr_block, NET_OK, ipv4_src_block);
static NPF_RULE(ipv6_addr_block, NET_OK, ipv6_src_block);

/* Rules for other upper layer protocols like UDP or TCP */
/* The pkt_counter is used to count matched packets in the handler. It is optional
 * and it is up to the application how to use it.
 */
static int user_data_pkt_counter;

static bool handler_local_in(struct net_pkt *pkt, void *user_data)
{
	int *pkt_counter = (int *)user_data;

	if (pkt_counter != NULL) {
		(*pkt_counter)++;

		LOG_DBG("Local-in matched packets: %d", *pkt_counter);
	} else {
		LOG_DBG("Local-in matched packet");
	}

	/* We can evaluate the packet here and return true/false based on that.
	 * For this sample, we just return true to match all the received packets.
	 */

	return true;
}

/* Note that the user_data argument is optional and can be NULL */
static NPF_LOCAL_IN_MATCH(local_in_match, handler_local_in, &user_data_pkt_counter);
static NPF_RULE(local_in_rule, NET_OK, local_in_match);

static void iface_cb(struct net_if *iface, void *user_data)
{
	int count = 0;

	ARG_UNUSED(user_data);

	ARRAY_FOR_EACH(interfaces, i) {
		if (interfaces[i] == NULL) {
			interfaces[i] = iface;
			return;
		}

		count++;
	}

	LOG_ERR("Too many interfaces %d (max is %d)", count, MAX_INTERFACES);
}

static void init_app(void)
{
	struct net_if *iface, *eth = NULL, *vlan1 = NULL, *vlan2 = NULL;
	int found = 0;

	ARRAY_FOR_EACH(interfaces, i) {
		if (interfaces[i] == NULL) {
			continue;
		}

		iface = interfaces[i];

		if (net_eth_is_vlan_interface(iface)) {
			if (vlan1 == NULL) {
				vlan1 = iface;
			} else if (vlan2 == NULL) {
				vlan2 = iface;
			}
		} else if (net_if_l2(iface) == &NET_L2_GET_NAME(ETHERNET)) {
			eth = iface;
		} else {
			continue;
		}

		found++;
	}

	if (found == 0) {
		LOG_ERR("No interfaces found");
		return;
	}

	match_iface_vlan1.iface = vlan1;
	match_iface_vlan2.iface = vlan2;
	match_iface_eth.iface = eth;

	/* The sample will setup the Ethernet interface and two VLAN
	 * optional interfaces (if VLAN is enabled).
	 * We allow all traffic to the Ethernet interface, but have
	 * filters for the VLAN interfaces and check IPv4 and IPv6 source addresses.
	 *
	 * First append the priority rules, so that they get evaluated before
	 * deciding on the final verdict for the packet.
	 */
	if (IS_ENABLED(CONFIG_NET_SAMPLE_USE_PACKET_PRIORITIES)) {
		LOG_INF("Using packet priorities");

		npf_append_recv_rule(&eth_priority_default);
		npf_append_recv_rule(&eth_priority_ptp);
		npf_append_recv_rule(&eth_priority_vlan);
		npf_append_recv_rule(&arp_priority_vlan1);
		npf_append_recv_rule(&arp_priority_vlan2);
	} else {
		LOG_INF("Packet priorities are disabled");
	}

	/* We allow small IPv4 packets to the VLAN interface 1 */
	npf_append_recv_rule(&small_ipv4_pkt);

	/* We allow large IPv4 packets to the VLAN interface 2 */
	npf_append_recv_rule(&large_ipv4_pkt);

	/* We allow all traffic to the Ethernet interface */
	npf_append_recv_rule(&eth_iface_rule);

	/* We allow ARP traffic to both VLAN interfaces */
	npf_append_recv_rule(&arp_pkt_vlan1);
	npf_append_recv_rule(&arp_pkt_vlan2);

	/* The remaining packets that do not match are dropped */
	npf_append_recv_rule(&npf_default_drop);

	/* We block packets from specific IPv4 addresses */
	npf_append_ipv4_recv_rule(&ipv4_addr_block);

	/* We block packets from specific IPv6 addresses */
	npf_append_ipv6_recv_rule(&ipv6_addr_block);

	/* Catch other upper layer protocols like UDP / TCP */
	npf_append_local_in_recv_rule(&local_in_rule);
}

int main(void)
{
	net_if_foreach(iface_cb, interfaces);

	init_vlan();
	init_app();

	return 0;
}
```
