/*
 * Copyright (c) 2020 DENX Software Engineering GmbH
 *
 * SPDX-License-Identifier: Apache-2.0
 */

&enet_mac {
	local-mac-address = [00 00 12 13 00 10];
};

&lan3 {
	local-mac-address = [00 00 12 13 00 37];
};

&lan2 {
	local-mac-address = [00 00 12 13 00 27];
};

&lan1 {
	local-mac-address = [00 00 12 13 00 17];
};
