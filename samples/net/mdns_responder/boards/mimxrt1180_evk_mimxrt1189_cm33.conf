## samples/net/mdns_responder/boards/mimxrt1180_evk_mimxrt1189_cm33.conf
```kconfig
# DSA
CONFIG_NET_DSA=y
CONFIG_NET_L2_ETHERNET=y

# Count and size
CONFIG_NET_IF_MAX_IPV4_COUNT=7
CONFIG_NET_IF_MAX_IPV6_COUNT=7
CONFIG_ZVFS_POLL_MAX=15
CONFIG_NET_MAX_CONTEXTS=14
CONFIG_NET_MAX_CONN=14
CONFIG_NET_BUF_DATA_SIZE=1024
CONFIG_MAIN_STACK_SIZE=4096
```

## samples/net/mdns_responder/sample.yaml
```yaml
common:
  harness: net
  tags:
    - net
    - mdns
sample:
  name: mDNS responder
tests:
  sample.net.mdns_responder:
    platform_allow:
      - qemu_x86
      - qemu_cortex_m3
    integration_platforms:
      - qemu_x86
  sample.net.mdns_responder.probing:
    extra_args:
      - CONFIG_MDNS_RESPONDER_PROBE=y
    platform_allow:
      - qemu_x86
      - qemu_cortex_m3
    integration_platforms:
      - qemu_x86
  sample.net.mdns_responder.wifi.nrf70dk:
    extra_args:
      - SNIPPET=wifi-ipv4
      - CONFIG_BUILD_ONLY_NO_BLOBS=y
    platform_allow:
      - nrf7002dk/nrf5340/cpuapp
  sample.net.mdns_responder.802154.subg:
    extra_args: EXTRA_CONF_FILE="overlay-802154-subg.conf"
    platform_allow: beagleconnect_freedom
```

## samples/net/midi2/Kconfig
```kconfig
# Copyright (c) 2025 Titouan Christophe
# SPDX-License-Identifier: Apache-2.0

menu "Networking MIDI2 sample application"

choice NET_SAMPLE_MIDI2_AUTH_TYPE
	prompt "UMP Endpoint authentication method"
	default NET_SAMPLE_MIDI2_AUTH_NONE

config NET_SAMPLE_MIDI2_AUTH_NONE
	bool "No authentication"

config NET_SAMPLE_MIDI2_AUTH_SHARED_SECRET
	bool "Authentication with shared secret"
	select NETMIDI2_HOST_AUTH

config NET_SAMPLE_MIDI2_AUTH_USER_PASSWORD
	bool "Authentication with username+password"
	select NETMIDI2_HOST_AUTH

endchoice

config NET_SAMPLE_MIDI2_SHARED_SECRET
	string "Shared secret"
	depends on NET_SAMPLE_MIDI2_AUTH_SHARED_SECRET

config NET_SAMPLE_MIDI2_USERNAME
	string "Username"
	depends on NET_SAMPLE_MIDI2_AUTH_USER_PASSWORD

config NET_SAMPLE_MIDI2_PASSWORD
	string "Password"
	depends on NET_SAMPLE_MIDI2_AUTH_USER_PASSWORD

endmenu

source "Kconfig.zephyr"
```

## samples/net/midi2/sample.yaml
```yaml
common:
  harness: net
  tags:
    - net
sample:
  description: Demonstrates usage of the Network MIDI2.0 host endpoint
  name: MIDI2.0 over the network (udp)
```

## samples/net/mqtt_offload_client/Kconfig
```kconfig
# Configuration options for MQTT-OFFLOAD sample

# Copyright (c) 2022 René Beckmann
# SPDX-License-Identifier: Apache-2.0
menu "Mqtt Offload"
mainmenu "MQTT-OFFLOAD sample application"

config NET_SAMPLE_MQTT_OFFLOAD_BUFFER_SIZE
	int "Size of the TX and RX buffers"
	default 255
config MQTT_ENDPOINT
	string "MQTT endpoint"
	default ""
	help
	  Endpoint (hostname) of the MQTT broker.
	  Note that the endpoint is different when using AWS Device Advisor.

config MQTT_PORT
	int "MQTT Port"
	default 8883
	help
	  Set port of MQTT broker.

config MQTT_THING_NAME
	string "MQTT Thing name"
	default "myThingName"
	help
	  Set the MQTT Thing name created on IoT Console

config MQTT_SUBSCRIBE_TOPIC
	string "MQTT subscribe topic"
	default "myThingName/downlink"
	help
	  MQTT topic the client should subscribe to.

config MQTT_PUBLISH_TOPIC
	string "MQTT publish topic"
	default "myThingName/data"
	help
	  MQTT topic the client should publish to.

choice MQTT_TEST_SUITE
	prompt "Device Advisor test suite"
	default MQTT_TEST_SUITE_NONE
	help
	  Select the AWS Device Advisor test suite to run.

config MQTT_TEST_SUITE_NONE
	bool "No test suite running"

config MQTT_TEST_SUITE_DQP
	bool "Device Qualification Program (DQP)"
	help
	  Make sure your region supports AWS Device Advisor for DQP

config MQTT_TEST_SUITE_RECV_QOS1
	bool "Test suite for receiving QoS 1 messages"
	help
	  For single test case "MQTT Client Puack QoS1"

endchoice

config MQTT_LIB_CUSTOM_TRANSPORT
	bool "Custom transport support for socket MQTT Library"
	help
	  Enable custom transport support for socket MQTT Library.
	  User must provide implementation for transport procedure.

config MQTT_OFFLOAD_LIB_TLS
	bool "TLS support for socket MQTT Library"
	help
	  Enable TLS support for socket MQTT Library

config MQTT_QOS
	int "MQTT QoS"
	default 0 if MQTT_TEST_SUITE_DQP
	default 1 if MQTT_TEST_SUITE_RECV_QOS1
	default 0
	range 0 1
	help
	  Quality of Service to use for publishing and subscribing to topics.
	  Notes:
	  - Use QoS 0 when passing DQP test suite
	  - QoS 2 is not supported by AWS MQTT broker


config MQTT_EXPONENTIAL_BACKOFF
	bool "enable exponential backoff"
	default n if MQTT_TEST_SUITE_DQP || MQTT_TEST_SUITE_RECV_QOS1
	default y
	help
	  Enable AWS exponential backoff for reconnecting to AWS MQTT broker.

endmenu

source "samples/net/common/Kconfig"
source "Kconfig.zephyr"
```

## samples/net/mqtt_offload_client/sample.yaml
```yaml
sample:
  description: mqtt-offload-client sample application
  name: mqtt-offload-client

common:
  harness: net
  tags:
    - net
    - mqtt
    - modem
    - hl78xx
  filter: dt_alias_exists("modem")
  extra_conf_files:
    - prj.conf
    - overlay-extra.conf
    - overlay-swir_hl78xx-verbose-logging.conf
    - overlay-swir_hl78xx_ev_kit.conf
    - overlay-swir_hl78xx-tls.conf
  extra_args:
    - SHIELD=swir_hl78xx_ev_kit
    - USE_DUMMY_CREDS=1

tests:
  sample.net.mqtt_offload:
    platform_allow:
      - nucleo_u575zi_q
    integration_platforms:
      - nucleo_u575zi_q
    build_only: true
```

## samples/net/mqtt_publisher/Kconfig
```kconfig
# Config options for mqtt_publisher sample application

# Copyright (c) 2020 Intel Corporation
# SPDX-License-Identifier: Apache-2.0

mainmenu "Networking mqtt_publisher sample application"

config NET_SAMPLE_APP_MAX_ITERATIONS
	int "Number of times to Publish sample MQTT messages"
	default 500
	help
	  Send sample MQTT messages this many times in a MQTT connection
	  before exiting. A value of zero means that the messages are sent
	  forever.

config NET_SAMPLE_APP_MAX_CONNECTIONS
	int "Number of times to connect to the MQTT server"
	default 0
	help
	  Number of times to connect to the MQTT server. With each connection
	  send NET_SAMPLE_APP_MAX_ITERATIONS amount of MQTT sample messages.
	  A value of zero means to continue forever.

source "Kconfig.zephyr"
```

## samples/net/mqtt_publisher/boards/cc3235sf_launchxl.conf
```kconfig
# Networking Config:
CONFIG_NET_IPV4=y
CONFIG_NET_IPV6=n
CONFIG_NET_SOCKETS=y
CONFIG_TEST_RANDOM_GENERATOR=y

# Enable SimpleLink WiFi Driver and Socket Offload
CONFIG_WIFI=y
CONFIG_WIFI_SIMPLELINK=y
CONFIG_NET_SOCKETS_OFFLOAD=y

# Enable TLS credential filenames for secure socket offload
CONFIG_TLS_CREDENTIAL_FILENAMES=y

# Disable unneeded settings from the base prj.conf:
CONFIG_DNS_RESOLVER=n
CONFIG_NET_CONFIG_SETTINGS=n
CONFIG_NET_CONFIG_MY_IPV4_ADDR=""
CONFIG_NET_CONFIG_PEER_IPV4_ADDR=""

# Debugging
CONFIG_NET_LOG=y
CONFIG_WIFI_LOG_LEVEL_DBG=y
CONFIG_DEBUG=y
CONFIG_CC3235SF_DEBUG=y
CONFIG_ASSERT=y
```

## samples/net/mqtt_publisher/sample.yaml
```yaml
sample:
  description: MQTT publisher sample application
  name: MQTT publisher
common:
  harness: net
  tags:
    - net
    - mqtt
tests:
  sample.net.mqtt_publisher:
    platform_allow:
      - frdm_k64f
      - qemu_x86
      - pinnacle_100_dvk
      - mg100
    integration_platforms:
      - qemu_x86
  sample.net.mqtt_publisher.userspace:
    platform_allow:
      - frdm_k64f
      - qemu_x86
    integration_platforms:
      - qemu_x86
    extra_args: CONFIG_USERSPACE=y
  sample.net.mqtt_publisher.bt:
    platform_allow: 96b_nitrogen
    tags:
      - net
      - mqtt
      - bluetooth
  sample.net.mqtt_publisher.wifi.nrf70dk:
    extra_args:
      - SNIPPET=wifi-ipv4
      - CONFIG_BUILD_ONLY_NO_BLOBS=y
    platform_allow:
      - nrf7002dk/nrf5340/cpuapp
```

## samples/net/mqtt_sn_publisher/boards/native_posix_native.conf
```kconfig
# Configuration options for MQTT-SN sample

# Copyright (c) 2022 René Beckmann
# SPDX-License-Identifier: Apache-2.0

CONFIG_NATIVE_POSIX_SLOWDOWN_TO_REAL_TIME=y
```

## samples/net/mqtt_sn_publisher/sample.yaml
```yaml
sample:
  description: MQTT-SN publisher sample application
  name: MQTT-SN publisher
common:
  harness: net
  tags:
    - net
    - mqtt
tests:
  sample.net.mqtt_publisher.sn:
    platform_allow:
      - frdm_k64f/mk64f12
      - qemu_x86/atom
      - pinnacle_100_dvk/nrf52840
      - mg100/nrf52840
      - native_sim/native/64
    integration_platforms:
      - qemu_x86/atom
```

## samples/net/nats/sample.yaml
```yaml
sample:
  name: NATS Client
tests:
  sample.net.nats:
    harness: net
    depends_on: netif
    tags: net nats
```

## samples/net/ocpp/sample.yaml
```yaml
sample:
  description: OCPP sample application
  name: OCPP charge point
tests:
  sample.net.ocpp:
    harness: net
    depends_on: netif
    tags:
      - net
      - ocpp

  sample.net.ocpp.tls:
    harness: net
    depends_on: netif
    extra_args:
      - EXTRA_CONF_FILE="overlay-tls13.conf"
      - USE_DUMMY_CREDS=1
    tags:
      - net
      - ocpp
      - tls
```

## samples/net/openthread/border_router/Kconfig
```kconfig
# Private config options for OpenThread Border Router sample app

# Copyright 2025 NXP
# SPDX-License-Identifier: Apache-2.0

mainmenu "OpenThread Border Router sample application"

config OTBR_WEB_SERVER
	bool "Enable HTTP web server and REST API"
	help
	  Manage OpenThread Border Router with web interface.

module = OTBR
module-str = OpenThread Border Router
module-help = Enables logging for OpenThread Border Router sample
source "subsys/logging/Kconfig.template.log_config"

source "samples/net/common/Kconfig"
source "Kconfig.zephyr"
```

## samples/net/openthread/border_router/sample.yaml
```yaml
common:
  harness: net
  tags:
    - net
    - openthread
  depends_on: openthread
sample:
  description: Test Wi-Fi and IEEE 802.15.4 using the OpenThread Border Router
  name: OpenThread Border Router
tests:
  sample.net.openthread.border_router.rw612_openthread_rcp_host:
    build_only: true
    extra_args:
      # Disabling monolithic since CI environment doesn't use blobs
      - CONFIG_NXP_MONOLITHIC_NBU=n
      - CONFIG_NXP_MONOLITHIC_WIFI=n
      - EXTRA_CONF_FILE="overlay-ot-rcp-host-wifi-nxp.conf"
    platform_allow:
      - frdm_rw612
      - rd_rw612_bga
  sample.net.openthread.border_router.esp_rcp_host_wifi:
    build_only: true
    extra_args:
      - EXTRA_CONF_FILE="overlay-ot-rcp-host-wifi-esp.conf"
    platform_allow:
      - esp32s3_devkitc/esp32s3/procpu
      - esp_threadbr/esp32s3/procpu
```

## samples/net/openthread/cli/Kconfig
```kconfig
# Copyright (c) 2025 Telink Semiconductor
# SPDX-License-Identifier: Apache-2.0

if SHELL_BACKEND_SERIAL

config SHELL_BACKEND_SERIAL_TX_RING_BUFFER_SIZE
	default 1024

config SHELL_BACKEND_SERIAL_RX_RING_BUFFER_SIZE
	default 1024

endif # SHELL_BACKEND_SERIAL

source "Kconfig.zephyr"
```

## samples/net/openthread/cli/boards/tl3218x.conf
```kconfig
# usb
CONFIG_USB_DEVICE_STACK=y
CONFIG_USB_DEVICE_INITIALIZE_AT_BOOT=n

# Telink relative thread features
CONFIG_NET_PKT_TXTIME=y
CONFIG_NET_PKT_TIMESTAMP=y
CONFIG_OPENTHREAD_NUM_MESSAGE_BUFFERS=35

CONFIG_OPENTHREAD_NUM_MESSAGE_BUFFERS=150
CONFIG_IEEE802154_TLX_MAC_FLASH=y

CONFIG_OPENTHREAD_JOINER=n
CONFIG_OPENTHREAD_LINK_METRICS_SUBJECT=n
CONFIG_OPENTHREAD_BORDER_ROUTER=n
CONFIG_OPENTHREAD_COMMISSIONER=n
CONFIG_OPENTHREAD_DHCP6_CLIENT=n
CONFIG_OPENTHREAD_DNS_CLIENT=n
CONFIG_OPENTHREAD_SLAAC=n
CONFIG_OPENTHREAD_REFERENCE_DEVICE=n
CONFIG_OPENTHREAD_MLR=n
CONFIG_OPENTHREAD_MAC_FILTER=n
CONFIG_OPENTHREAD_DUA=n
CONFIG_OPENTHREAD_COAP=n
CONFIG_OPENTHREAD_ENABLE_SERVICE=n
CONFIG_OPENTHREAD_CSL_RECEIVE_TIME_AHEAD=480
CONFIG_OPENTHREAD_MAX_CHILDREN=5

CONFIG_NET_BUF_TX_COUNT=12
CONFIG_NET_BUF_RX_COUNT=12

CONFIG_OPENTHREAD_COAPS=n
CONFIG_MBEDTLS_PEM_CERTIFICATE_FORMAT=n
CONFIG_COMMON_LIBC_MALLOC_ARENA_SIZE=8192
```

## samples/net/openthread/cli/boards/tl7218.conf
```kconfig
# usb
CONFIG_USB_DEVICE_STACK=y
CONFIG_USB_DEVICE_INITIALIZE_AT_BOOT=n

# Telink relative thread features
CONFIG_NET_PKT_TXTIME=y
CONFIG_NET_PKT_TIMESTAMP=y
CONFIG_IEEE802154_TELINK_TLX_ENCRYPTION=y
CONFIG_OPENTHREAD_NUM_MESSAGE_BUFFERS=350
CONFIG_IEEE802154_TLX_MAC_FLASH=y
```

## samples/net/openthread/cli/boards/tlsr9118bdk40d_v1.conf
```kconfig
# Copyright (c) 2025 Telink Semiconductor
# SPDX-License-Identifier: Apache-2.0

# Telink relative thread features
# CONFIG_NET_PKT_TXTIME=y
# CONFIG_NET_PKT_TIMESTAMP=y
# CONFIG_OPENTHREAD_NUM_MESSAGE_BUFFERS=350

# During development turn off features
CONFIG_OPENTHREAD_THREAD_VERSION_1_1=y
CONFIG_OPENTHREAD_SRP_CLIENT=n
CONFIG_OPENTHREAD_JOINER=n
CONFIG_OPENTHREAD_LINK_METRICS_SUBJECT=n
CONFIG_OPENTHREAD_BORDER_ROUTER=n
CONFIG_OPENTHREAD_COMMISSIONER=n
CONFIG_OPENTHREAD_DHCP6_CLIENT=n
CONFIG_OPENTHREAD_DNS_CLIENT=n
CONFIG_OPENTHREAD_SLAAC=n
CONFIG_OPENTHREAD_REFERENCE_DEVICE=n
CONFIG_OPENTHREAD_MLR=n
CONFIG_OPENTHREAD_MAC_FILTER=n
CONFIG_OPENTHREAD_DUA=n
CONFIG_OPENTHREAD_COAP=n
CONFIG_OPENTHREAD_COAPS=n
CONFIG_OPENTHREAD_ENABLE_SERVICE=n
```

## samples/net/openthread/cli/boards/tlsr9258a.conf
```kconfig
# Copyright (c) 2024 Telink Semiconductor
# SPDX-License-Identifier: Apache-2.0

# usb
CONFIG_USB_DEVICE_STACK=y
CONFIG_USB_DEVICE_INITIALIZE_AT_BOOT=n

# Telink relative thread features
CONFIG_NET_PKT_TXTIME=y
CONFIG_NET_PKT_TIMESTAMP=y
CONFIG_IEEE802154_TELINK_B9X_ENCRYPTION=y
CONFIG_OPENTHREAD_NUM_MESSAGE_BUFFERS=350
CONFIG_TELINK_B9X_MBEDTLS_HW_ACCELERATION=n
```

## samples/net/openthread/cli/boards/tlsr9518adk80d.conf
```kconfig
# Copyright (c) 2024 Telink Semiconductor
# SPDX-License-Identifier: Apache-2.0

# usb
CONFIG_USB_DEVICE_STACK=n
CONFIG_USB_DEVICE_INITIALIZE_AT_BOOT=n

# Telink relative thread features
CONFIG_NET_PKT_TXTIME=y
CONFIG_NET_PKT_TIMESTAMP=y
CONFIG_OPENTHREAD_NUM_MESSAGE_BUFFERS=350
```

## samples/net/openthread/cli/boards/tlsr9528a.conf
```kconfig
# Copyright (c) 2024 Telink Semiconductor
# SPDX-License-Identifier: Apache-2.0

# Telink relative thread features
CONFIG_NET_PKT_TXTIME=y
CONFIG_NET_PKT_TIMESTAMP=y
CONFIG_OPENTHREAD_NUM_MESSAGE_BUFFERS=350
```

## samples/net/openthread/coap/Kconfig
```kconfig
# Config options for OpenThread Border CoAP sample app

# Copyright (c) 2024 Alexandre Bailon
# SPDX-License-Identifier: Apache-2.0

mainmenu "OpenThread CoAP Sample"

menu "Application configuration"

config OT_COAP_SAMPLE_SERVER
	bool "Build the sample CoAP server application"

config OT_COAP_SAMPLE_LED
	bool "Enable LED support"
	default y

config OT_COAP_SAMPLE_SW
	bool "Enable switch support"
	default y

endmenu

source "Kconfig.zephyr"
```
