## samples/net/coaps_server/sample.yaml
```yaml
sample:
  name: COAP Server with DTLS
tests:
  test:
    harness: net
    depends_on: netif
    tags: net coap
```

## samples/net/cobs_throughput_client/Kconfig
```kconfig
# Copyright (c) 2024 Nordic Semiconductor ASA
# SPDX-License-Identifier: Apache-2.0

mainmenu "SLIP Throughput Client Configuration"

source "Kconfig.zephyr"

config SLIP_THROUGHPUT_PACKET_SIZE
	int "Default packet size in bytes"
	default 512
	range 16 1472
	help
	  Default size of packets to send during throughput test.
	  Maximum is 1472 bytes (MTU 1500 - IP header - UDP header).

config SLIP_THROUGHPUT_SERVER_IP
	string "Default server IP address"
	default "192.168.7.1"
	help
	  Default IP address of the throughput server.

config SLIP_THROUGHPUT_DURATION_SEC
	int "Default test duration in seconds"
	default 60
	range 1 3600
	help
	  Default duration of the throughput test in seconds.

config SLIP_THROUGHPUT_AUTO_START
	bool "Auto-start throughput test on boot"
	default n
	help
	  If enabled, the throughput test will automatically start
	  5 seconds after the SLIP interface comes up.
```

## samples/net/cobs_throughput_tcp/boards/nrf5340dk_nrf5340_cpuapp.conf
```kconfig
CONFIG_UART_2_INTERRUPT_DRIVEN=n
CONFIG_UART_2_ASYNC=y
CONFIG_UART_2_NRF_HW_ASYNC=y
CONFIG_UART_2_NRF_HW_ASYNC_TIMER=1
CONFIG_UART_3_INTERRUPT_DRIVEN=n
CONFIG_UART_3_ASYNC=y
CONFIG_UART_3_NRF_HW_ASYNC=y
CONFIG_UART_3_NRF_HW_ASYNC_TIMER=2
```

## samples/net/connectivity_check/Kconfig
```kconfig
# Private config options for connectivity check sample app

# Copyright (c) 2024 Nordic Semiconductor
# SPDX-License-Identifier: Apache-2.0

mainmenu "Networking connectivity check sample application"

config NET_SAMPLE_ONLINE_COUNT
	int "How many online -> offline checks to have"
	default 1
	help
	  The sample will quit after this many online->offline checks.

source "Kconfig.zephyr"
```

## samples/net/connectivity_check/sample.yaml
```yaml
common:
  tags:
    - net
    - http
    - conn_mgr
    - online_check
  min_ram: 32
  depends_on: netif
sample:
  description: Online connectivity check sample
  name: connectivity_check
tests:
  sample.net.connectivity_check:
    harness: net
```

## samples/net/dhcpv4_client/boards/fvp_base_revc_2xaemv8a_fvp_base_revc_2xaemv8a.conf
```kconfig
CONFIG_NET_L2_ETHERNET=y
CONFIG_MDIO=y
CONFIG_MDIO_SHELL=n

CONFIG_MDIO_INIT_PRIORITY=81
CONFIG_PHY_INIT_PRIORITY=82
```

## samples/net/dhcpv4_client/boards/mimxrt1170_evk_mimxrt1176_cm7.conf
```kconfig
# Board-specific debug config for MIMXRT1170 EVK CM7
#
# Purpose:
# - Disable ENET HW acceleration to test whether DHCP/ICMP failures are caused
#   by checksum offload / driver + toolchain interaction.
# - Enable focused network logging for DHCPv4/IPv4/UDP/Ethernet paths.

CONFIG_ETH_NXP_ENET_HW_ACCELERATION=n

CONFIG_NET_LOG=y
CONFIG_LOG_MODE_DEFERRED=y
CONFIG_LOG_BUFFER_SIZE=65536
CONFIG_LOG_PROCESS_THREAD_STACK_SIZE=4096

CONFIG_ETHERNET_LOG_LEVEL_DBG=y
CONFIG_NET_CORE_LOG_LEVEL_DBG=y
CONFIG_NET_PKT_LOG_LEVEL_INF=y
CONFIG_NET_CONTEXT_LOG_LEVEL_DBG=y
CONFIG_NET_MGMT_EVENT_LOG_LEVEL_DBG=y
CONFIG_NET_DHCPV4_LOG_LEVEL_DBG=y
CONFIG_NET_IPV4_LOG_LEVEL_DBG=y
CONFIG_NET_UDP_LOG_LEVEL_DBG=y
```

## samples/net/dhcpv4_client/boards/nucleo_u5a5zj_q.conf
```kconfig
CONFIG_USB_HOST_STACK=y
CONFIG_ETH_DRIVER=y
CONFIG_NET_L2_ETHERNET=y
CONFIG_ETH_LAN78XX=y
```

## samples/net/dhcpv4_client/boards/rd_rw612_bga.conf
```kconfig
CONFIG_USB_HOST_STACK=y
CONFIG_UHC_XFER_COUNT=32
CONFIG_UHC_BUF_COUNT=32
CONFIG_UHC_BUF_POOL_SIZE=4096
CONFIG_USBH_HUB_CLASS=y
CONFIG_USBH_CDC_ECM_CLASS=y
```

## samples/net/dhcpv4_client/sample.yaml
```yaml
sample:
  name: DHCP Client
tests:
  sample.net.dhcpv4_client:
    harness: net
    depends_on: netif
    tags:
      - net
      - http
  sample.net.dhcpv4_client.qemu:
    harness: console
    harness_config:
      type: multi_line
      regex:
        - "Run dhcpv4 client"
        - "Address\\[[0-9]+\\]: 10\\.0\\.2\\."
    platform_allow:
      - qemu_riscv64
    extra_configs:
      - CONFIG_NET_QEMU_USER=y
```

## samples/net/dns_resolve/sample.yaml
```yaml
common:
  harness: net
  depends_on: netif
  tags:
    - net
    - dns
sample:
  description: DNS resolver, mDNS and LLMNR responder
  name: DNS resolver and responder sample application
tests:
  sample.net.dns_resolve.mdns:
    extra_configs:
      - CONFIG_MDNS_RESOLVER=y
      - CONFIG_LLMNR_RESOLVER=n
      - CONFIG_NET_DHCPV4=y
    tags: mdns
  sample.net.dns_resolve.llmnr:
    extra_configs:
      - CONFIG_MDNS_RESOLVER=n
      - CONFIG_LLMNR_RESOLVER=y
      - CONFIG_NET_DHCPV4=y
    tags: llmnr
  sample.net.dns_resolve.wifi.nrf70dk:
    extra_args:
      - SNIPPET=wifi-ipv4
      - CONFIG_BUILD_ONLY_NO_BLOBS=y
    platform_allow:
      - nrf7002dk/nrf5340/cpuapp
```

## samples/net/dsa/Kconfig
```kconfig
# Private config options for DSA

# Copyright 2024 NXP
# SPDX-License-Identifier: Apache-2.0

mainmenu "DSA sample application"

if NET_DSA

config NET_SAMPLE_DSA_MAX_USER_PORTS
	int "DSA user ports maximum number"
	range 2 10
	default 3
	help
	  DSA user ports maximum number.

config NET_SAMPLE_DSA_LLDP
	bool "DSA LLDP example"
	default y
	help
	  Enable DSA LLDP example.

endif

source "Kconfig.zephyr"
```

## samples/net/dsa/boards/ip_k66f.conf
```kconfig
CONFIG_DSA_SPI=y
CONFIG_DSA_KSZ_TAIL_TAGGING=y

CONFIG_SHELL_BACKEND_RTT=y
CONFIG_SHELL_BACKEND_SERIAL=n
CONFIG_LOG_BACKEND_RTT=n

CONFIG_NET_CONFIG_SETTINGS=y
CONFIG_NET_CONFIG_NEED_IPV6=y
CONFIG_NET_CONFIG_NEED_IPV4=y
CONFIG_NET_CONFIG_INIT_TIMEOUT=10

CONFIG_NET_CONFIG_MY_IPV4_ADDR="192.168.0.2"
CONFIG_NET_CONFIG_MY_IPV4_GW="192.168.0.1"
CONFIG_NET_CONFIG_MY_IPV6_ADDR="2001:db8::1"
```

## samples/net/dsa/boards/mimxrt1180_evk_mimxrt1189_cm7.conf
```kconfig
CONFIG_NET_IF_MAX_IPV4_COUNT=7
CONFIG_NET_IF_MAX_IPV6_COUNT=7

CONFIG_NET_SAMPLE_DSA_LLDP=n
CONFIG_NET_SAMPLE_DSA_MAX_USER_PORTS=5
```

## samples/net/dsa/sample.yaml
```yaml
sample:
  description: Test DSA functionality
  name: DSA sample app
common:
  harness: net
  tags:
    - net
    - dsa
tests:
  sample.net.dsa:
    build_only: true
    platform_allow:
      - ip_k66f
      - mimxrt1180_evk/mimxrt1189/cm33
      - mimxrt1180_evk/mimxrt1189/cm7
      - imx943_evk/mimx94398/m33/ddr
      - imx943_evk/mimx94398/a55
    depends_on: eth
```

## samples/net/echo_client/boards/frdm_kw41z.conf
```kconfig
CONFIG_NET_TCP=n
CONFIG_NET_IPV4=n
CONFIG_NET_CONFIG_NEED_IPV4=n
CONFIG_NET_6LO=y
CONFIG_NET_DEBUG_6LO=y

CONFIG_NET_L2_IEEE802154=y
CONFIG_NET_DEBUG_L2_IEEE802154=y
CONFIG_NET_L2_IEEE802154_FRAGMENT=y
CONFIG_NET_DEBUG_L2_IEEE802154_FRAGMENT=y
CONFIG_NET_L2_IEEE802154_FRAGMENT_REASS_CACHE_SIZE=4

# For Wireshark filtering in a busy environment it is useful to set a unique
# PAN ID
#CONFIG_NET_CONFIG_IEEE802154_PAN_ID=0xbeef

CONFIG_NET_L2_IEEE802154_SECURITY=n
CONFIG_NET_L2_IEEE802154_SHELL=y

CONFIG_IEEE802154_KW41Z=y
CONFIG_SYS_LOG_IEEE802154_DRIVER_LEVEL=3

CONFIG_NET_CONFIG_IEEE802154_DEV_NAME="KW41Z"

CONFIG_FLASH=y
CONFIG_FLASH_PAGE_LAYOUT=y
CONFIG_CPLUSPLUS=y
CONFIG_REBOOT=y
```

## samples/net/echo_client/boards/nrf52840_pca10056.conf
```kconfig
CONFIG_BT=n

CONFIG_NET_TX_STACK_SIZE=4096

CONFIG_REBOOT=y

CONFIG_NET_LOG=y
CONFIG_SYS_LOG_SHOW_COLOR=y
CONFIG_PRINTK=y

CONFIG_UART_INTERRUPT_DRIVEN=y

CONFIG_FLASH=y
CONFIG_FLASH_PAGE_LAYOUT=y
CONFIG_MPU_ALLOW_FLASH_WRITE=y

CONFIG_NET_TCP=n
CONFIG_NET_IPV4=n
CONFIG_NET_CONFIG_NEED_IPV4=n

CONFIG_NET_DEBUG_L2_IEEE802154=y
CONFIG_NET_DEBUG_L2_IEEE802154_FRAGMENT=y
CONFIG_NET_L2_IEEE802154=y
CONFIG_NET_L2_IEEE802154_SHELL=y

CONFIG_IEEE802154_NRF5=y
CONFIG_IEEE802154_NRF5_DRV_NAME="IEEE802154_nrf5"
CONFIG_IEEE802154_NRF5_INIT_PRIO=80
CONFIG_SYS_LOG_IEEE802154_DRIVER_LEVEL=1

CONFIG_TEST_RANDOM_GENERATOR=n
CONFIG_ENTROPY_NRF5_RNG=y

CONFIG_SYS_CLOCK_TICKS_PER_SEC=1000
```

## samples/net/echo_client/sample.yaml
```yaml
common:
  harness: net
  tags: net
sample:
  description: Test core network features using a client/server
    sample
  name: Echo Client
tests:
  test:
    platform_whitelist: qemu_x86 frdm_k64f sam_e70_xplained
      qemu_cortex_m3 arduino_101 frdm_kw41z
  test_802154:
    extra_args: OVERLAY_CONFIG="overlay-qemu_802154.conf"
    platform_whitelist: qemu_x86
  test_bt:
    extra_args: OVERLAY_CONFIG="overlay-bt.conf"
    platform_whitelist: qemu_x86
    tags: bluetooth
  test_cc2520:
    extra_args: OVERLAY_CONFIG="overlay-frdm_k64f_cc2520.conf"
    platform_whitelist: frdm_k64f
  test_nrf:
    platform_whitelist: nrf52840_pca10056
  test_nrf_openthread:
    extra_args: OVERLAY_CONFIG="overlay-ot.conf"
    platform_whitelist: nrf52840_pca10056
  test_kw41z:
    platform_whitelist: frdm_kw41z
  test_kw41z_openthread:
    extra_args: OVERLAY_CONFIG="overlay-ot.conf"
    platform_whitelist: frdm_kw41z
```

## samples/net/echo_server/boards/frdm_kw41z.conf
```kconfig
CONFIG_NET_IPV4=n
CONFIG_NET_6LO=y

CONFIG_NET_L2_IEEE802154=y
CONFIG_NET_L2_IEEE802154_FRAGMENT=y
CONFIG_NET_L2_IEEE802154_FRAGMENT_REASS_CACHE_SIZE=2

# For Wireshark filtering in a busy environment it is useful to set a unique
# PAN ID
#CONFIG_NET_CONFIG_IEEE802154_PAN_ID=0xbeef

CONFIG_NET_L2_IEEE802154_SECURITY=n
CONFIG_NET_L2_IEEE802154_SHELL=y

CONFIG_IEEE802154_KW41Z=y

CONFIG_NET_CONFIG_MY_IPV6_ADDR="2001:db8::2"
CONFIG_NET_CONFIG_PEER_IPV6_ADDR="2001:db8::1"
CONFIG_NET_CONFIG_IEEE802154_DEV_NAME="KW41Z"

CONFIG_FLASH=y
CONFIG_FLASH_PAGE_LAYOUT=y
CONFIG_CPLUSPLUS=y
CONFIG_REBOOT=y
```

## samples/net/echo_server/sample.yaml
```yaml
common:
  harness: net
  tags: net
sample:
  description: Test core network features using a client/server
    sample
  name: Echo Server
tests:
  test:
    platform_whitelist: qemu_x86 sam_e70_xplained frdm_k64f
      qemu_cortex_m3 arduino_101 frdm_kw41z
  test_802154:
    extra_args: OVERLAY_CONFIG="overlay-qemu_802154.conf"
    platform_whitelist: qemu_x86
  test_bt:
    extra_args: OVERLAY_CONFIG="overlay-bt.conf"
    platform_whitelist: qemu_x86
    tags: bluetooth
  test_mcr20a:
    extra_args: OVERLAY_CONFIG="overlay-frdm_k64f_mcr20a.conf"
    platform_whitelist: frdm_k64f
  test_nrf:
    platform_whitelist: nrf52840_pca10056
  test_usbnet:
    harness: net
    extra_args: OVERLAY_CONFIG="overlay-netusb.conf"
    platform_whitelist: quark_se_c1000_devboard 96b_carbon
    tags: net usb
  test_usbnet_composite:
    harness: net
    extra_args: OVERLAY_CONFIG="overlay-netusb.conf"
    extra_configs:
      - CONFIG_USB_COMPOSITE_DEVICE=y
    platform_whitelist: quark_se_c1000_devboard 96b_carbon
    tags: net usb
  test_nrf_openthread:
    extra_args: OVERLAY_CONFIG="overlay-ot.conf"
    platform_whitelist: nrf52840_pca10056
  test_kw41z:
    platform_whitelist: frdm_kw41z
  test_kw41z_openthread:
    extra_args: OVERLAY_CONFIG="overlay-ot.conf"
    platform_whitelist: frdm_kw41z
```
