## CMakeLists.txt
```
# SPDX-FileCopyrightText: Copyright The Zephyr Project Contributors
# SPDX-License-Identifier: Apache-2.0

cmake_minimum_required(VERSION 3.20.0)

find_package(Zephyr REQUIRED HINTS $ENV{ZEPHYR_BASE})
project(rfc2217_server)

target_sources(app PRIVATE src/main.c)

include(${ZEPHYR_BASE}/samples/net/common/common.cmake)
```

## Kconfig
```
# SPDX-FileCopyrightText: Copyright The Zephyr Project Contributors
# SPDX-License-Identifier: Apache-2.0

config SAMPLE_RFC2217_PORT
	int "TCP port of the server the application starts"
	default 2217
	help
	  Without a zephyr,rfc2217-server node in the devicetree, the
	  application starts a server on the UART with the rfc2217-uart
	  alias, on this port.

source "samples/net/common/Kconfig"
source "Kconfig.zephyr"
```

## prj.conf
```kconfig
CONFIG_SERIAL=y

# Generic networking options
CONFIG_NETWORKING=y
CONFIG_NET_IPV4=y
CONFIG_NET_IPV6=y
CONFIG_NET_TCP=y
CONFIG_NET_SOCKETS=y
CONFIG_NET_CONNECTION_MANAGER=y

# Kernel options
CONFIG_ENTROPY_GENERATOR=y
CONFIG_TEST_RANDOM_GENERATOR=y

# Logging
CONFIG_LOG=y
CONFIG_NET_LOG=y

# IP address options
CONFIG_NET_CONFIG_SETTINGS=y
CONFIG_NET_CONFIG_NEED_IPV4=y
CONFIG_NET_CONFIG_NEED_IPV6=y
CONFIG_NET_CONFIG_MY_IPV4_ADDR="192.0.2.1"
CONFIG_NET_CONFIG_PEER_IPV4_ADDR="192.0.2.2"
CONFIG_NET_CONFIG_MY_IPV6_ADDR="2001:db8::1"
CONFIG_NET_CONFIG_PEER_IPV6_ADDR="2001:db8::2"

# The server: an IPv4 and an IPv6 listener, and a client
CONFIG_NET_MAX_CONTEXTS=6
CONFIG_ZVFS_OPEN_MAX=16
CONFIG_ZVFS_POLL_MAX=8

CONFIG_NET_RFC2217=y
CONFIG_NET_RFC2217_SERVER=y
```

## overlay-nsos.conf
```kconfig
# The host's network stack (offloaded sockets) instead of a TAP interface:
# clients on the host reach the server at 127.0.0.1
CONFIG_ETH_NATIVE_TAP=n
CONFIG_NET_DRIVERS=y
CONFIG_NET_SOCKETS_OFFLOAD=y
CONFIG_NET_NATIVE_OFFLOADED_SOCKETS=y

# IPv6 DAD requires lower level network interface access, below exposed socket-level access
CONFIG_NET_IPV6_DAD=n
```

## api.overlay
```dts
/*
 * SPDX-FileCopyrightText: Copyright The Zephyr Project Contributors
 * SPDX-License-Identifier: Apache-2.0
 */

/* No server node: the application starts the server on uart1 */
&uart1 {
	status = "okay";
};

/ {
	aliases {
		rfc2217-uart = &uart1;
	};
};
```

## boards/native_sim.overlay
```dts
/*
 * SPDX-FileCopyrightText: Copyright The Zephyr Project Contributors
 * SPDX-License-Identifier: Apache-2.0
 */

/* The second UART, on a pseudoterminal of the host */
&uart1 {
	status = "okay";
};

/ {
	rfc2217-server {
		compatible = "zephyr,rfc2217-server";
		uart = <&uart1>;
		port = <2217>;
	};
};
```

## boards/nucleo_f767zi.overlay
```dts
/*
 * SPDX-FileCopyrightText: Copyright The Zephyr Project Contributors
 * SPDX-License-Identifier: Apache-2.0
 */

/ {
	rfc2217-server {
		compatible = "zephyr,rfc2217-server";
		uart = <&arduino_serial>;
		port = <2217>;
	};
};
```

## src/main.c
```c
/*
 * SPDX-FileCopyrightText: Copyright The Zephyr Project Contributors
 * SPDX-License-Identifier: Apache-2.0
 */

#include <zephyr/drivers/uart.h>
#include <zephyr/kernel.h>
#include <zephyr/logging/log.h>
#include <zephyr/net/rfc2217.h>

#include "net_sample_common.h"

LOG_MODULE_REGISTER(rfc2217_server_sample, LOG_LEVEL_INF);

#if DT_HAS_COMPAT_STATUS_OKAY(zephyr_rfc2217_server)
/* Defined in the devicetree, started at boot */
#define SERVER_NODE DT_COMPAT_GET_ANY_STATUS_OKAY(zephyr_rfc2217_server)
#define UART_NODE   DT_PHANDLE(SERVER_NODE, uart)
#define PORT        DT_PROP(SERVER_NODE, port)

static struct rfc2217_server *const server = RFC2217_SERVER_DT_GET(SERVER_NODE);
#else
/* Defined and started by the application */
#define UART_NODE DT_ALIAS(rfc2217_uart)
#define PORT      CONFIG_SAMPLE_RFC2217_PORT

RFC2217_SERVER_DEFINE(app_server);
static struct rfc2217_server *const server = &app_server;
#endif

/* Where an application would hold the TX line low, or drive the reset and
 * boot pins of the board on the other side of the UART.
 */
static int set_break(struct rfc2217_server *srv, bool on)
{
	LOG_INF("BREAK %s", on ? "on" : "off");

	return 0;
}

static int set_line(struct rfc2217_server *srv, uint32_t line, bool on)
{
	LOG_INF("%s %s", line == UART_LINE_CTRL_DTR ? "DTR" : "RTS", on ? "on" : "off");

	return 0;
}

static const struct rfc2217_server_callbacks callbacks = {
	.set_break = set_break,
	.set_line = set_line,
};

int main(void)
{
	rfc2217_server_set_callbacks(server, &callbacks, NULL);

#if !DT_HAS_COMPAT_STATUS_OKAY(zephyr_rfc2217_server)
	const struct rfc2217_server_config config = {
		.uart = DEVICE_DT_GET(UART_NODE),
		.port = PORT,
	};
	int ret = rfc2217_server_start(server, &config);

	if (ret < 0) {
		LOG_ERR("Cannot start the server (%d)", ret);
		return 0;
	}
#endif

	wait_for_network();

	LOG_INF("Serving %s on TCP port %d", DEVICE_DT_NAME(UART_NODE), PORT);

	return 0;
}
```
