## Kconfig
```
# Private config options for connectivity check sample app

# Copyright (c) 2024 Nordic Semiconductor
# SPDX-License-Identifier: Apache-2.0

mainmenu "Networking connectivity check sample application"

config NET_SAMPLE_ONLINE_COUNT
	int "How many online -> offline checks to have"
	default 1
	help
	  The sample will quit after this many online->offline checks.

source "Kconfig.zephyr"
```

## sample.yaml
```
common:
  tags:
    - net
    - http
    - conn_mgr
    - online_check
  min_ram: 32
  depends_on: netif
sample:
  description: Online connectivity check sample
  name: connectivity_check
tests:
  sample.net.connectivity_check:
    harness: net
```

## prj.conf
```kconfig
# Networking config
CONFIG_NETWORKING=y
CONFIG_NET_IPV4=y
CONFIG_NET_IPV6=y
CONFIG_NET_TCP=y
CONFIG_NET_SHELL=y
CONFIG_NET_SOCKETS=y

# Network driver config
CONFIG_TEST_RANDOM_GENERATOR=y

# Network address config
CONFIG_NET_CONFIG_SETTINGS=y
CONFIG_NET_CONFIG_NEED_IPV4=y
CONFIG_NET_CONFIG_NEED_IPV6=y
CONFIG_NET_CONFIG_MY_IPV4_ADDR="192.0.2.1"
CONFIG_NET_CONFIG_MY_IPV4_GW="192.0.2.2"
CONFIG_NET_CONFIG_MY_IPV6_ADDR="2001:db8::1"

# Network debug config
CONFIG_LOG=y
CONFIG_LOG_MODE_IMMEDIATE=y
CONFIG_NET_LOG=y
#CONFIG_LOG_BUFFER_SIZE=65535
CONFIG_NET_SOCKETS_LOG_LEVEL_DBG=n
CONFIG_NET_CONTEXT_LOG_LEVEL_DBG=n
CONFIG_NET_SOCKETS_LOG_LEVEL_DBG=n
CONFIG_NET_ICMPV4_LOG_LEVEL_DBG=n
CONFIG_NET_ICMPV6_LOG_LEVEL_DBG=n
CONFIG_NET_HTTP_LOG_LEVEL_DBG=n
CONFIG_TLS_CREDENTIALS_LOG_LEVEL_DBG=n
CONFIG_NET_TRICKLE_LOG_LEVEL_DBG=y
CONFIG_DNS_RESOLVER_LOG_LEVEL_DBG=n
CONFIG_NET_CONNECTION_MANAGER_LOG_LEVEL_DBG=y

# DNS config
CONFIG_DNS_RESOLVER=y
CONFIG_DNS_SERVER_IP_ADDRESSES=y
CONFIG_DNS_SERVER1="192.0.2.2:15353"

# Online connectivity check needed config
CONFIG_NET_CONNECTION_MANAGER=y
CONFIG_NET_DHCPV4=y
CONFIG_NET_CONNECTION_MANAGER_ONLINE_CONNECTIVITY_CHECK=y
CONFIG_NET_CONNECTION_MANAGER_ONLINE_CHECK_PING=y
CONFIG_NET_CONNECTION_MANAGER_ONLINE_CHECK_PING_HOST="192.0.2.2"
CONFIG_NET_CONNECTION_MANAGER_ONLINE_CHECK_TIMEOUT=2000
CONFIG_NET_CONNECTION_MANAGER_ONLINE_VERIFY=y

# Note that the Trickle parameters are only meaningful for this
# sample application as they trigger the check once / minute which
# is not practical in real life environment.
CONFIG_NET_CONNECTION_MANAGER_ONLINE_VERIFY_PERIOD=1
CONFIG_NET_CONNECTION_MANAGER_ONLINE_VERIFY_IMIN=1
CONFIG_NET_CONNECTION_MANAGER_ONLINE_VERIFY_IMAX=1
CONFIG_NET_CONNECTION_MANAGER_ONLINE_VERIFY_K=1

CONFIG_MAIN_STACK_SIZE=2048

# To see what connectivity events are triggered
CONFIG_NET_MGMT_EVENT_MONITOR_AUTO_START=y
CONFIG_NET_MGMT_EVENT_MONITOR=y
CONFIG_NET_MGMT_EVENT=y
CONFIG_NET_MGMT=y
```

## overlay-testing-http.conf
```kconfig
# Online connectivity check using HTTP needed config
CONFIG_NET_CONNECTION_MANAGER_ONLINE_CHECK_PING=n
CONFIG_NET_CONNECTION_MANAGER_ONLINE_CHECK_HTTP=y
CONFIG_NET_CONNECTION_MANAGER_ONLINE_CHECK_TIMEOUT=5000
CONFIG_NET_CONNECTION_MANAGER_ONLINE_CHECK_HTTP_URL="http://online.zephyr.test:8000/testing"
```

## overlay-testing-https.conf
```kconfig
# Online connectivity check using HTTP needed config
CONFIG_NET_CONNECTION_MANAGER_ONLINE_CHECK_PING=n
CONFIG_NET_CONNECTION_MANAGER_ONLINE_CHECK_HTTP=y
CONFIG_NET_CONNECTION_MANAGER_ONLINE_CHECK_TIMEOUT=5000
CONFIG_NET_CONNECTION_MANAGER_ONLINE_CHECK_HTTP_URL="https://online.zephyr.test:4443/testing"
```

## src/main.c
```c
/*
 * Copyright (c) 2024 Nordic Semiconductor ASA
 *
 * SPDX-License-Identifier: Apache-2.0
 */

#include <zephyr/logging/log.h>
LOG_MODULE_REGISTER(net_connectivity_check_sample, LOG_LEVEL_DBG);

#include <zephyr/net/net_ip.h>
#include <zephyr/net/socket.h>
#include <zephyr/net/tls_credentials.h>
#include <zephyr/net/http/client.h>
#include <zephyr/net/conn_mgr_monitor.h>

#include "ca_certificate.h"

static void trigger_check(struct k_work *work);
static K_WORK_DELAYABLE_DEFINE(dwork, trigger_check);
static K_SEM_DEFINE(quit_lock, 0, K_SEM_MAX_LIMIT);
static struct net_if *my_iface;
static bool connected;

#define TRIGGER_TIMEOUT 5
static k_timeout_t trigger_timeout = K_SECONDS(TRIGGER_TIMEOUT);

void quit(void)
{
	k_sem_give(&quit_lock);
}

static void trigger_check(struct k_work *work)
{
	static int count;

	ARG_UNUSED(work);

	if (count >= CONFIG_NET_SAMPLE_ONLINE_COUNT) {
		quit();
	}

	count++;
}

#define EVENTS (NET_EVENT_CONNECTIVITY_ONLINE | NET_EVENT_CONNECTIVITY_OFFLINE)

static void event_handler(uint32_t mgmt_event, struct net_if *iface,
			  void *info, size_t info_length, void *user_data)
{
	if ((mgmt_event & EVENTS) != mgmt_event) {
		return;
	}

	if (mgmt_event == NET_EVENT_CONNECTIVITY_ONLINE) {
		char ifname[CONFIG_NET_INTERFACE_NAME_LEN];

		(void)net_if_get_name(iface, ifname, sizeof(ifname));

		LOG_INF("Connected online on interface %s (%p)",
			ifname, iface);
		connected = true;
		my_iface = iface;

		/* Wait a bit, and then trigger online check again */
		k_work_reschedule(&dwork, trigger_timeout);
		return;
	}

	if (mgmt_event == NET_EVENT_CONNECTIVITY_OFFLINE) {
		if (connected == false) {
			LOG_INF("Waiting network to get online.");
		} else {
			LOG_INF("Network no longer online");
			connected = false;
		}

		return;
	}
}

static NET_MGMT_REGISTER_EVENT_HANDLER(connectivity_events, EVENTS,
				       event_handler, NULL);

static int tls_setup_cb(struct net_if *iface,
			const sec_tag_t **sec_tag_list,
			size_t *sec_tag_size,
			const char **tls_hostname,
			const char *url,
			const char *host,
			const char *port,
			struct sockaddr *dst,
			void *user_data)
{
	if (!IS_ENABLED(CONFIG_NET_SOCKETS_SOCKOPT_TLS)) {
		return -ENOTSUP;
	}

	/* In this test app, we are only interested in the security tags */
	ARG_UNUSED(iface);
	ARG_UNUSED(url);
	ARG_UNUSED(host);
	ARG_UNUSED(port);
	ARG_UNUSED(dst);
	ARG_UNUSED(user_data);

#if defined(CONFIG_NET_SOCKETS_SOCKOPT_TLS)
	static sec_tag_t my_sec_tag_list[] = {
		CA_CERTIFICATE_TAG,
	};

	int ret = tls_credential_add(CA_CERTIFICATE_TAG,
				     TLS_CREDENTIAL_CA_CERTIFICATE,
				     ca_certificate,
				     sizeof(ca_certificate));
	if (ret < 0 && ret != -EEXIST) {
		LOG_ERR("Failed to register public certificate: %d", ret);
	}

	*sec_tag_list = my_sec_tag_list;
	*sec_tag_size = sizeof(my_sec_tag_list);

	/* This works only for this sample and not to be used in real life
	 * environment.
	 */
	*tls_hostname = "localhost";
#else
	ARG_UNUSED(sec_tag_list);
	ARG_UNUSED(sec_tag_size);
	ARG_UNUSED(tls_hostname);
#endif

	return 0;
}

int main(void)
{
	if (IS_ENABLED(CONFIG_NET_DHCPV4)) {
		net_dhcpv4_start(net_if_get_default());
	}

	/* Default strategy is PING so only set the HTTP one if enabled. */
	if (IS_ENABLED(CONFIG_NET_CONNECTION_MANAGER_ONLINE_CHECK_HTTP)) {
		conn_mgr_set_online_check_strategy(NET_CONN_MGR_ONLINE_CHECK_HTTP);
	}

	if (IS_ENABLED(CONFIG_NET_SOCKETS_SOCKOPT_TLS)) {
		int ret;

		ret = conn_mgr_register_online_checker_cb(tls_setup_cb, NULL);
		if (ret < 0) {
			LOG_WRN("Cannot enable TLS (%d)", ret);
		}
	}

	k_sem_take(&quit_lock, K_FOREVER);

	/* This print is for Docker based tester which monitors the output
	 * of this script and stops when it sees the "DONE!" string on a
	 * single line.
	 */
	printk("DONE!\n");

	return 0;
}
```
