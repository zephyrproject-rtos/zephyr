## CMakeLists.txt
```
# SPDX-License-Identifier: Apache-2.0

cmake_minimum_required(VERSION 3.20.0)

find_package(Zephyr REQUIRED HINTS $ENV{ZEPHYR_BASE})
project(gui_guider)

FILE(GLOB_RECURSE app_sources src/*.c src/generated/*.c src/custom/*.c)
target_include_directories(app PRIVATE src/generated src/custom src/generated/guider_customer_fonts src/generated/guider_fonts src/generated/images)
target_sources(app PRIVATE ${app_sources})
target_compile_definitions(app PRIVATE LV_LVGL_H_INCLUDE_SIMPLE)
```

## prj.conf
```kconfig
CONFIG_LV_Z_MEM_POOL_SIZE=100000
CONFIG_MAIN_STACK_SIZE=2048

CONFIG_DISPLAY=y
CONFIG_DISPLAY_LOG_LEVEL_ERR=y

CONFIG_LOG=y

CONFIG_LVGL=y
CONFIG_LV_MEM_CUSTOM=y
CONFIG_LV_USE_LOG=y
CONFIG_LV_USE_LABEL=y
CONFIG_LV_USE_BTN=y
CONFIG_LV_USE_IMG=y
CONFIG_LV_FONT_MONTSERRAT_14=y

CONFIG_GC9X01X=y
CONFIG_MULTITHREADING=y
```

## src/main.c
```c
/*
 * Copyright (c) 2018 Jan Van Winkel <jan.van_winkel@dxplore.eu>
 *
 * SPDX-License-Identifier: Apache-2.0
 */

#include <zephyr/device.h>
#include <zephyr/drivers/display.h>
#include <lvgl.h>
#include <stdio.h>
#include <string.h>
#include <zephyr/kernel.h>

#include "../generated/gui_guider.h"
#include "../generated/events_init.h"

#define LOG_LEVEL CONFIG_LOG_DEFAULT_LEVEL
#include <zephyr/logging/log.h>
LOG_MODULE_REGISTER(app);

lv_ui guider_ui;

int main(void)
{
	const struct device *display_dev;

	display_dev = DEVICE_DT_GET(DT_CHOSEN(zephyr_display));
	if (!device_is_ready(display_dev)) {
		LOG_ERR("Device not ready, aborting test");
		return 0;
	}

	setup_ui(&guider_ui);
   	events_init(&guider_ui);

	// lv_task_handler();
	display_blanking_off(display_dev);

	while (1) {
		lv_task_handler();
		// k_sleep(K_MSEC(10));
	}
}
```

## src/RTC.h
```c
#include <zephyr/drivers/i2c.h>

#define CLOCK_H24 0
#define CLOCK_H12 1

#define HOUR_AM 0
#define HOUR_PM 1
#define HOUR_24 2

#define DS3231_ADDR 0x68
/*ftypes*/
uint8_t bitSet(uint8_t data,uint8_t shift);
uint8_t bitClear(uint8_t data,uint8_t shift);
uint8_t bitRead(uint8_t data,uint8_t shift);
uint8_t bitWrite(uint8_t data,uint8_t shift,uint8_t bit);
void DS3231_setHourMode(const struct device *dev,uint8_t slave_address,uint8_t h_mode);
uint8_t DS3231_getHourMode(const struct device *dev,uint8_t slave_address);
void DS3231_setMeridiem(const struct device *dev,uint8_t slave_address,uint8_t meridiem);
uint8_t DS3231_getMeridiem(const struct device *dev,uint8_t slave_address);
uint8_t DS3231_getSeconds(const struct device *dev,uint8_t slave_address);
void DS3231_setSeconds(const struct device *dev,uint8_t slave_address,uint8_t seconds);
uint8_t DS3231_getMinutes(const struct device *dev,uint8_t slave_address);
void DS3231_setMinutes(const struct device *dev,uint8_t slave_address,uint8_t minutes);
uint8_t DS3231_getHours(const struct device *dev,uint8_t slave_address);
void  DS3231_setHours(const struct device *dev,uint8_t slave_address,uint8_t hours);
uint8_t DS3231_getWeek(const struct device *dev,uint8_t slave_address);
void DS3231_setWeek(const struct device *dev,uint8_t slave_address,uint8_t week);
void DS3231_updateWeek(const struct device *dev,uint8_t slave_address);
uint8_t DS3231_getDay(const struct device *dev,uint8_t slave_address);
void DS3231_setDay(const struct device *dev,uint8_t slave_address,uint8_t day);
uint8_t DS3231_getMonth(const struct device *dev,uint8_t slave_address);
void DS3231_setMonth(const struct device *dev,uint8_t slave_address,uint8_t month);
uint16_t DS3231_getYear(const struct device *dev,uint8_t slave_address);
void DS3231_setYear(const struct device *dev,uint8_t slave_address,uint16_t year);
void DS3231_setTime(const struct device *dev,uint8_t slave_address,uint8_t hours, uint8_t minutes, uint8_t seconds);
void DS3231_setDate(const struct device *dev,uint8_t slave_address,uint8_t day, uint8_t month, uint16_t year);
void DS3231_setDateTime(const struct device *dev,uint8_t slave_address,char* date, char* time);
uint8_t bcd2bin_in(uint8_t val);
uint8_t bin2bcd_in(uint8_t val);
```

## src/acc_gyro.c
```c
#include "acc_gyro.h"
float _gres, _ares, _mres; // Gyroscope, Accelerometer, and Magnetometer resolution
float _magXcoef, _magYcoef, _magZcoef; // Magnetometer calibration coefficients for X, Y, Z axes

// Constants for step detection algorithm
const double lowPassFilterAlpha = 0.9; // alpha value for the low-pass filter applied to the accelerometer data
const double highLineAlpha = 0.0005; // rate of adjustment for the high line threshold
const double lowLineAlpha = 0.0005; // rate of adjustment for the low line threshold
const double highLineMin = 1.0; // minimum value for the high line threshold
const double highLineMax = 1.75; // maximum value for the high line threshold
const double lowLineMin = -1.0; // minimum value for the low line threshold
const double lowLineMax = -1.75; // maximum value for the low line threshold
const long stepTimeInterval = 100; // Milliseconds

// Step detection variables
double lastAccelZValue = -0.1;  // stores the previous Z-axis acceleration value
long lastCheckTime = 0; // stores the timestamp of the last check or update in milliseconds
bool highLineState = true;  // the current state of the high line threshold detection
bool lowLineState = true; // the current state of the low line threshold detection.
bool passageState = false;  // passage from high to low or vice versa has occurred, indicating a step
double highLine = 1; // threshold value for detecting upward acceleration (stepping phase)
double highBoundaryLine = 0; // the boundary for the high line threshold
double highBoundaryLineAlpha = 1.0; // scaling factor for adjusting the high boundary line
double lowLine = -1; // threshold value for detecting downward acceleration (lifting phase)
double lowBoundaryLine = 0; // the boundary for the low line threshold
double lowBoundaryLineAlpha = -1.0; // scaling factor for adjusting the low boundary line

/**
 * @fn mpu9250_read(const struct device *dev, uint8_t slave_addr, uint8_t reg_addr, uint8_t num, uint8_t* buffer)
 * @brief The function reads data from MPU9250 sensor
 * @details The function `mpu9250_read` reads data from an MPU9250 sensor using I2C communication.
 * @param dev Specify the I2C interface number used by MPU9250 sensor
 * @param slave_addr address of the slave device on the I2C bus 
 * @param reg_addr register address from which data needs to be read from the MPU9250 sensor 
 * @param num number of bytes to read from the MPU9250 sensor. 
 * @param buffer pointer to an array where the data read from the MPU9250 sensor will be stored
 */
uint64_t get_mcycle_start() {
  uint64_t mcycle = 0;
  __asm__ volatile("csrr %0,mcycle":"=r"(mcycle));
  return mcycle;
}

uint64_t get_mcycle_stop(){
  uint64_t mcycle;
  __asm__ volatile("csrr %0,mcycle":"=r"(mcycle));
  return mcycle;
}
int millis(int total_cycles)
{
	return total_cycles/(CLOCK_FREQUENCY/1000);
}
void mpu9250_read(const struct device *dev, uint8_t slave_addr, uint8_t reg_addr, uint8_t num, uint8_t* buffer){
    uint8_t i = 0;
	uint8_t msg_arr[1];
	struct i2c_msg msg_obj;
	msg_obj.buf = msg_arr;
    for(i = 0; i < num; i++){
	  msg_obj.len = 1;
	  msg_arr[0] = reg_addr;
	  msg_obj.flags = I2C_MSG_WRITE;
	  i2c_transfer(dev,&msg_obj,1,slave_addr);
      msg_obj.flags = I2C_MSG_READ;
	  i2c_transfer(dev,&msg_obj,1,slave_addr);
	  buffer[i++] = msg_arr[0];
    }
}

/**
 * @fn mpu9250_write(const struct device *dev, uint8_t slave_addr, uint8_t reg_addr, uint8_t data)
 * @brief The function `mpu9250_write` is used to write data
 * @details The function `mpu9250_write` writes data to an MPU9250 sensor using I2C communication 
 * @param dev Specify the I2C interface number used by MPU9250 sensor
 * @param slave_addr address of the slave device on the I2C bus 
 * @param reg_addr register address from which data needs to be read from the MPU9250 sensor 
 * @param data data to write to a specific register in the MPU9250 sensor
 */
void mpu9250_write(const struct device *dev, uint8_t slave_addr, uint8_t reg_addr, uint8_t data){
	  uint8_t msg_arr[2];
	  struct i2c_msg msg_obj;
	  msg_obj.buf = msg_arr;
	  msg_obj.len = 2;
	  msg_arr[0] = reg_addr;
      msg_arr[1] = data;
	  msg_obj.flags = I2C_MSG_WRITE;
	  i2c_transfer(dev,&msg_obj,1,slave_addr);
}

/**
 * @fn accel_xyz(const struct device *dev, uint8_t slave_addr, float* ax, float* ay, float* az)
 * @brief The function `accel_xyz` reads raw accelerometer data
 * @details The function `accel_xyz` reads raw accelerometer data from an MPU9250 sensor 
 * and converts it to float values for the x, y, and z axes
 * @param dev Specify the I2C interface number used by MPU9250 sensor
 * @param slave_addr address of the slave device on the I2C bus 
 * @param ax pointer to a float variable where the acceleration value along the X-axis 
 * will be stored after converting the raw accelerometer data.
 * @param ay pointer to a float variable where the acceleration value along the Y-axis 
 * will be stored after converting the raw accelerometer data.
 * @param az pointer to a float variable where the acceleration value along the Z-axis 
 * will be stored after converting the raw accelerometer data.
 */
void accel_xyz(const struct device *dev, uint8_t slave_addr, float* ax, float* ay, float* az){
    uint8_t data[6]; // Array to store raw accelerometer data (2 bytes per axis)
    int16_t axc, ayc, azc; // Variables to store combined accelerometer data for each axis

    // Read raw accelerometer data from MPU9250 starting at ACCEL_XOUT_H register
    mpu9250_read(dev, slave_addr, ACCEL_XOUT_H, 6, data); 

    // Combine high and low bytes for each accelerometer axis
    axc = ((int16_t)data[0] << 8) | data[1]; 
    ayc = ((int16_t)data[2] << 8) | data[3]; 
    azc = ((int16_t)data[4] << 8) | data[5];

    // Convert raw accelerometer data to float values using the accelerometer resolution (_ares)
    *ax = (float)axc * _ares;
    *ay = (float)ayc * _ares;
    *az = (float)azc * _ares;
}

/**
 * @fn gyro_xyz(const struct device *dev, uint8_t slave_addr, float* gx, float* gy, float* gz)
 * @brief The function `gyro_xyz` reads raw gyroscope data
 * @details The function `gyro_xyz` reads raw gyroscope data from an MPU9250 sensor 
 * and converts it to float values for the x, y, and z axes.
 * @param dev Specify the I2C interface number used by MPU9250 sensor
 * @param slave_addr address of the slave device on the I2C bus 
 * @param gx pointer to a float variable where the gyroscope value along for the X-axis 
 * will be stored after converting the raw gyroscope data.
 * @param gy pointer to a float variable where the gyroscope value along for the Y-axis 
 * will be stored after converting the raw gyroscope data.
 * @param gz pointer to a float variable where the gyroscope value along for the Z-axis 
 * will be stored after converting the raw gyroscope data.
 */
void gyro_xyz(const struct device *dev, uint8_t slave_addr, float* gx, float* gy, float* gz){
    uint8_t data[6]; // Array to store raw gyroscope data (2 bytes per axis)
    int16_t gxc, gyc, gzc; // Variables to store combined gyroscope data for each axis

    // Read raw gyroscope data from MPU9250 starting at GYRO_XOUT_L register
    mpu9250_read(dev, slave_addr, GYRO_XOUT_L, 6, data);

    // Combine high and low bytes for each gyroscope axis
    gxc = ((int16_t)data[0] << 8) | data[1];
    gyc = ((int16_t)data[2] << 8) | data[3];
    gzc = ((int16_t)data[4] << 8) | data[5];

    // Convert raw gyroscope data to float values using the gyroscope resolution (_gres)
    *gx = (float)gxc * _gres;
    *gy = (float)gyc * _gres;
    *gz = (float)gzc * _gres;
}

/**
 * @fn magneto_xyz(const struct device *dev, uint8_t slave_addr, float* mx, float* my, float* mz)
 * @brief The function `magneto_xyz` reads raw magnetometer data
 * @details The function `magneto_xyz` reads raw magnetometer data from an AK8963 magnetometer, 
 * combines the data for each axis, and converts it to float values using resolution and coefficients.
 * @param dev Specify the I2C interface number used by MPU9250 sensor
 * @param slave_addr address of the slave device on the I2C bus 
 * @param mx pointer to a float variable where the magnetometer value along for the X-axis 
 * will be stored after converting the raw magnetometer data
 * @param my pointer to a float variable where the magnetometer value along for the Y-axis 
 * will be stored after converting the raw magnetometer data
 * @param mz pointer to a float variable where the magnetometer value along for the Z-axis 
 * will be stored after converting the raw magnetometer data
 */
void magneto_xyz(const struct device *dev, uint8_t slave_addr, float* mx, float* my, float* mz){
    uint8_t data[7]; // Array to store raw magnetometer data (2 bytes per axis + 1 for status)
    uint8_t drdy; // Variable to store data ready status from magnetometer
    int16_t mxc, myc, mzc; // Variables to store combined magnetometer data for each axis

    // Read data ready status from AK8963 magnetometer
    mpu9250_read(dev, slave_addr, MAGNETO_ST1, 1, &drdy);

    // Check if data is ready
    if(drdy & 0x01){
        // Read raw magnetometer data from AK8963 starting at HXL register
        mpu9250_read(dev, slave_addr, MAGNETO_HXL, 7, data);

        // Check for magnetic sensor overflow
        if(!(data[6] & 0x08)){
            // Combine high and low bytes for each magnetometer axis
            mxc = ((int16_t)data[0] << 8) | data[1];
            myc = ((int16_t)data[3] << 8) | data[2];
            mzc = ((int16_t)data[5] << 8) | data[4];

            // Convert raw magnetometer data to float values using magnetometer resolution and coefficients
            *mx = (float)mxc * _mres * _magXcoef;
            *my = (float)myc * _mres * _magYcoef;
            *mz = (float)mzc * _mres * _magZcoef;
        }
    }
}

/**
 * @fn mpu9250_config(const struct device *dev, uint8_t slave_addr, uint8_t gfs, uint8_t afs)
 * @brief The function `mpu9250_config` configures the MPU9250 sensor
 * @details The function `mpu9250_config` configures the MPU9250 sensor with specified gyro and accelerometer
 * full scales, and sets various register values for operation.
 * @param dev Specify the I2C interface number used by MPU9250 sensor
 * @param slave_addr address of the slave device on the I2C bus 
 * @param gfs gfs(Gyroscope Full Scale) specify the full scale range for the gyroscope sensor
 * @param afs afs(accelerometer Full Scale) specify the full scale range for the accelerometer sensor
 */
void mpu9250_config(const struct device *dev, uint8_t slave_addr){
    // Configure gyro full scale
	uint8_t gfs = GYRO_FS_250;
	uint8_t afs = ACCEL_FS_2G;
    switch (gfs)
    {
    case GYRO_FS_250:
        _gres = 250.0/32768.0; // Set gyro resolution for ±250 dps
        break;
    case GYRO_FS_500:
        _gres = 500.0/32768.0; // Set gyro resolution for ±500 dps
        break;
    case GYRO_FS_1000:
        _gres = 1000.0/32768.0; // Set gyro resolution for ±1000 dps
        break;
    case GYRO_FS_2000:
        _gres = 2000.0/32768.0; // Set gyro resolution for ±2000 dps
        break;
    }

    // Configure accelerometer full scale
    switch (afs)
    {
    case ACCEL_FS_2G:
        _ares = 2.0/32768.0; // Set accel resolution for ±2g
        break;
    case ACCEL_FS_4G:
        _ares = 4.0/32768.0; // Set accel resolution for ±4g
        break;
    case ACCEL_FS_8G:
        _ares = 8.0/32768.0; // Set accel resolution for ±8g
        break;
    case ACCEL_FS_16G:
        _ares = 16.0/32768.0; // Set accel resolution for ±16g
        break;
    }

    // Turn off sleep mode
    mpu9250_write(dev, slave_addr, PWR_MGMT_1, 0x00);

    // Auto-select clock source
    mpu9250_write(dev, slave_addr, PWR_MGMT_1, 0x01);

    // Set Digital Low Pass Filter Configuration
    mpu9250_write(dev, slave_addr, CONFIG, 0x03); 

    // Set sample rate divider
    mpu9250_write(dev, slave_addr, INT_SAMP_RATE, 0x04);

    // Set gyro full scale select 
    mpu9250_write(dev, slave_addr, GYRO_CONFIG, gfs << 3); 

    // Set accel full scale select
    mpu9250_write(dev, slave_addr, ACCEL_CONFIG, afs << 3); 

    // Set accel Digital Low Pass Filter Configuration
    mpu9250_write(dev, slave_addr, ACCEL_CONFIG_2, 0x03); 

    // Enable I2C bypass for external magnetometer
    mpu9250_write(dev, slave_addr, INT_PIN_CFG, 0x02); 
}

/**
 * @fn ak8963_config(const struct device *dev, uint8_t slave_addr, uint8_t mode, uint8_t mfs)
 * @brief The function `ak8963_config` configures the AK8963 sensor
 * @details The function `ak8963_config` configures the AK8963 sensor with specified Magneto Scale Select 
 * and sets various register values for operation.
 * @param dev Specify the I2C interface number used by AK8963 sensor
 * @param slave_addr address of the slave device on the I2C bus 
 * @param mode specify the Magneto Mode Select for the AK8963 magnetometer
 * @param mfs mfs(Magneto Scale Select) represents the magnetometer scale factor and
 * determine the resolution of the magnetometer output
 */
void ak8963_config(const struct device *dev, uint8_t slave_addr){
    uint8_t data[3]; // Array to store calibration coefficient data from AK8963 magnetometer
	uint8_t mode = MAGNETO_MODE_C8HZ;
	uint8_t mfs= MAGNETO_BIT_16;
    // Set magnetometer resolution based on selected scale factor
    switch(mfs){
        case MAGNETO_BIT_14:
            _mres = 4912.0 / 8190.0; // Set resolution for 14-bit output
            break;
        case MAGNETO_BIT_16:
            _mres = 4912.0 / 32760.0; // Set resolution for 16-bit output
            break;
    }

    // Set power down mode for AK8963
    mpu9250_write(dev, slave_addr, MAGNETO_CNTL1, 0x00);

    // Set read FuseROM mode to obtain magnetometer calibration coefficients
    mpu9250_write(dev, slave_addr, MAGNETO_CNTL1, 0x0F);

    // Read magnetometer calibration coefficients
    mpu9250_read(dev, slave_addr, MAGNETO_ASAX, 3, data);
    _magXcoef = (float)(data[0] - 128) / 256.0 + 1.0;
    _magYcoef = (float)(data[1] - 128) / 256.0 + 1.0;
    _magZcoef = (float)(data[2] - 128) / 256.0 + 1.0;

    // Set power down mode again before changing mode
    mpu9250_write(dev, slave_addr, MAGNETO_CNTL1, 0x00);

    // Set magnetometer scale and mode
    mpu9250_write(dev, slave_addr, MAGNETO_CNTL1, (mfs << 4 | mode));
}

/**
 * @fn readStepDetection(float ax, float ay, float az)
 * @brief The function `readStepDetection` implements a step detection algorithm
 * @details The function `readStepDetection` implements a step detection algorithm using accelerometer data 
 * and state transitions based on threshold values.
 * @param ax Handling step detection based on accelerometer data `ax` represent the acceleration values in the x,
 * The function processes the accelerometer data to detect steps based on certain thresholds
 * @param ay Handling step detection based on accelerometer data `ay` represent the acceleration values in the y,
 * The function processes the accelerometer data to detect steps based on certain thresholds
 * @param az Handling step detection based on accelerometer data `az` represent the acceleration values in the z,
 * The function processes the accelerometer data to detect steps based on certain thresholds
 */
uint16_t readStepDetection(float ax, float ay, float az){
    long currentTime = millis(get_mcycle_stop()); // Get the current time in milliseconds
    long gapTime = currentTime - lastCheckTime; // Calculate time gap since last check
    static uint16_t stepCount = 0;
    // Initialize lastAccelZValue
    if (lastAccelZValue == -9999) {
        lastAccelZValue = az;
        printf("lastAccelZValue\n");
    }

    // Apply low pass filter to the accelerometer Z-value
    double zValue = (lowPassFilterAlpha * lastAccelZValue) + (1 - lowPassFilterAlpha) * az;
    // printf("    %d", zValue);

    // Update highLine and highBoundaryLine based on their states
    if (highLineState && highLine > highLineMin) {
        highLine -= highLineAlpha; // Decrease highLine value by highLineAlpha
        highBoundaryLine = highLine * highBoundaryLineAlpha;  // Update highBoundaryLine based on the updated highLine value
        printf("highBoundaryLine\n");
    }

    // Update lowLine and lowBoundaryLine based on their states
    if (lowLineState && lowLine < lowLineMax) {
        lowLine += lowLineAlpha; // Increase lowLine value by lowLineAlpha
        lowBoundaryLine = lowLine * lowBoundaryLineAlpha; // Update lowBoundaryLine based on the updated lowLine value
        printf("lowBoundaryLine\n");
    }

    // Check conditions for highLineState change and potential step detection
    if (highLineState && gapTime > stepTimeInterval && zValue > highBoundaryLine) {
        highLineState = false;
        printf("highLineState\n");
    }

    // Check conditions for lowLineState change
    if (lowLineState && zValue < lowBoundaryLine && passageState) {
        lowLineState = false;
        printf("lowLineState\n");
    }

    // Handle transition to highLineState
    if (!highLineState) {
        if (zValue > highLine) {
            highLine = zValue; // Update highLine with the new zValue
            highBoundaryLine = highLine * highBoundaryLineAlpha; // Update highBoundaryLine based on the updated highLine value
            printf("highBoundaryLine0\n");

            // Limit highLine value    
            if (highLine > highLineMax) {
                highLine = highLineMax;
                highBoundaryLine = highLine * highBoundaryLineAlpha; // Update highBoundaryLine based on the updated highLine value
                printf("highBoundaryLine\n");
            }
        } 
        else {
            if (highBoundaryLine > zValue) {
                highLineState = true; // Transition back to highLineState 
                passageState = true; // set passageState 
                printf("passageState\n");
            }
        }
    }

    // Handle transition to lowLineState
    if (!lowLineState && passageState) {
        if (zValue < lowLine) {
            lowLine = zValue; // Update lowLine with the new zValue
            lowBoundaryLine = lowLine * lowBoundaryLineAlpha; // Update lowBoundaryLine based on the updated lowLine value
            printf("if condition");

            // Limit lowLine value to lowLineMin
            if (lowLine < lowLineMin) {
                lowLine = lowLineMin;
                lowBoundaryLine = lowLine * lowBoundaryLineAlpha; // Update lowBoundaryLine based on the updated lowLine value
            }
        } 
        else {
            if (lowBoundaryLine < zValue) {
                lowLineState = true; // Transition back to lowLineState
                passageState = false; // set passageState

                // Step is detected here
                
                // Increment step count
                stepCount++;
                //printf("Step count: %d\n", stepCount);

                // Update last check time
                lastCheckTime = currentTime;
            }
        }
    }

    lastAccelZValue = zValue; // Update lastAccelZValue for next iteration
    return stepCount;
}
```

## src/acc_gyro.h
```c
#include <stdio.h>
#include<zephyr/device.h>
#include<zephyr/devicetree.h>
#include <zephyr/drivers/i2c.h>
#define ACC_GYRO dev, 0x68
#define MAGETO dev, 0x0C
#define CLOCK_FREQUENCY 40000000
// Gyroscope Self-Test Registers
#define GYRO_SELF_TEST_X 0x00
#define GYRO_SELF_TEST_Y 0x01
#define GYRO_SELF_TEST_Z 0x02

// Accelerometer Self-Test Registers
#define ACCEL_SELF_TEST_X 0x0D
#define ACCEL_SELF_TEST_Y 0x0E
#define ACCEL_SELF_TEST_Z 0x0F

// Gyro Offset Registers
#define XG_OFFSET_H 0x13
#define XG_OFFSET_L 0x14
#define YG_OFFSET_H 0x15
#define YG_OFFSET_L 0x16
#define ZG_OFFSET_H 0x17
#define ZG_OFFSET_L 0x18

// Accelerometer Offset Registers
#define XA_OFFSET_H 0x77
#define XA_OFFSET_L 0x78
#define YA_OFFSET_H 0x7A
#define YA_OFFSET_L 0x7B
#define ZA_OFFSET_H 0x7D
#define ZA_OFFSET_L 0x7E

// Sample Rate Divider
#define INT_SAMP_RATE 0x19 

// Configuration
#define CONFIG 0x1A
#define GYRO_CONFIG 0x1B
#define ACCEL_CONFIG 0x1C
#define ACCEL_CONFIG_2 0x1D

#define LP_ACCEL_ODR 0x1E // Low Power Accelerometer ODR Control
#define WOM_THRESHOLD 0x1F // Wake-on Motion Threshold

#define I2C_MST_CTRL 0x24 // I2C Master ControL
#define I2C_MST_DELAY_CTRL 0x67 

// I2C Slave 0 Control
#define I2C_SLV0_ADDR 0x25
#define I2C_SLV0_REG 0x26
#define I2C_SLV0_CTRL 0x27
#define I2C_SLV0_DO 0x63

// I2C Slave 1 Control
#define I2C_SLV1_ADDR 0x28
#define I2C_SLV1_REG 0x29
#define I2C_SLV1_CTRL 0x2A
#define I2C_SLV1_DO 0x64

// I2C Slave 2 Control
#define I2C_SLV2_ADDR 0x2B
#define I2C_SLV2_REG 0x2C
#define I2C_SLV2_CTRL 0x2D
#define I2C_SLV2_DO 0x65

// I2C Slave 3 Control
#define I2C_SLV3_ADDR 0x2E
#define I2C_SLV3_REG 0x2F
#define I2C_SLV3_CTRL 0x30
#define I2C_SLV3_DO 0x66

// I2C Slave 4 Control
#define I2C_SLV4_ADDR 0x31
#define I2C_SLV4_REG 0x32
#define I2C_SLV4_D0 0x33
#define I2C_SLV4_CTRL 0x34
#define I2C_SLV4_DI 0x35

#define I2C_MST_STATUS 0x36 // I2C Master Status
#define INT_PIN_CFG 0x37
#define INT_ENABLE 0x38
#define INT_STATUS 0x3A

// Accelerometer Measurements
#define ACCEL_XOUT_H 0x3B
#define ACCEL_XOUT_L 0x3C
#define ACCEL_YOUT_H 0x3D
#define ACCEL_YOUT_L 0x3E
#define ACCEL_ZOUT_H 0x3F
#define ACCEL_ZOUT_L 0x40

// Temperature Measurements
#define TEMP_OUT_H 0x41
#define TEMP_OUT_L 0x42

// Gyroscope Measurements
#define GYRO_XOUT_H 0x43
#define GYRO_XOUT_L 0x44
#define GYRO_YOUT_H 0x45
#define GYRO_YOUT_L 0x46
#define GYRO_ZOUT_H 0x47
#define GYRO_ZOUT_H 0x48

// External Sensor Data
#define EXT_SENS_DATA_00 0x49
#define EXT_SENS_DATA_01 0x4A
#define EXT_SENS_DATA_02 0x4B
#define EXT_SENS_DATA_03 0x4C
#define EXT_SENS_DATA_04 0x4D
#define EXT_SENS_DATA_05 0x4E
#define EXT_SENS_DATA_06 0x4F
#define EXT_SENS_DATA_07 0x50
#define EXT_SENS_DATA_08 0x51
#define EXT_SENS_DATA_09 0x52
#define EXT_SENS_DATA_10 0x53
#define EXT_SENS_DATA_11 0x54
#define EXT_SENS_DATA_12 0x55
#define EXT_SENS_DATA_13 0x56
#define EXT_SENS_DATA_14 0x57
#define EXT_SENS_DATA_15 0x58
#define EXT_SENS_DATA_16 0x59
#define EXT_SENS_DATA_17 0x5A
#define EXT_SENS_DATA_18 0x5B
#define EXT_SENS_DATA_19 0x5C
#define EXT_SENS_DATA_20 0x5D
#define EXT_SENS_DATA_21 0x5E
#define EXT_SENS_DATA_22 0x5F
#define EXT_SENS_DATA_23 0x60

#define SIGNAL_PATH_RESET 0x68
#define MOT_DETECT_CTRL 0x69
#define USER_CTRL 0x6A

// Power Management 
#define PWR_MGMT_1 0x6B
#define PWR_MGMT_2 0x6C

#define FIFO_EN 0x23
#define FIFO_COUNT_H 0x72
#define FIFO_COUNT_L 0x73
#define FIFO_R_W 0x74

#define WHO_AM_I 0x75

// Magnetometer Registers
#define MAGNETO_WIA 0x00
#define MAGNETO_INFO 0x01
#define MAGNETO_ST1 0x02

// Measurement data of magnetic sensor X-axis/Y-axis/Z-axis
#define MAGNETO_HXL 0x03
#define MAGNETO_HXH 0x04
#define MAGNETO_HYL 0x05
#define MAGNETO_HYH 0x06
#define MAGNETO_HZL 0x07
#define MAGNETO_HZH 0x08

#define MAGNETO_ST2 0x09
#define MAGNETO_CNTL1 0x0A
#define MAGNETO_CNTL2 0x0B 
#define MAGNETO_ASTC 0x0C // Self-Test Control
#define MAGNETO_TS1 0x0D
#define MAGNETO_TS2 0x0E
#define MAGNETO_I2CDIS 0x0F // I2C Disable

// Sensitivity Adjustment values
#define MAGNETO_ASAX 0x10
#define MAGNETO_ASAY 0x11
#define MAGNETO_ASAZ 0x12
#define MAGNETO_RSV 0x13

// CNTL1 Mode select
#define MAGNETO_MODE_DOWN 0x00 // Power down mode
#define MAGNETO_MODE_ONE 0x01 // One shot data output
#define MAGNETO_MODE_C8HZ 0x02 // Continous data output 8Hz
#define MAGNETO_MODE_C100HZ 0x06 // Continous data output 100Hz
#define MAGNETO_MODE_TRIG 0x04 // External trigger data output
#define MAGNETO_MODE_TEST 0x08 // Self test
#define MAGNETO_MODE_FUSE 0x0F // Fuse ROM access

// Magneto Scale Select
#define MAGNETO_BIT_14 0x00 // 14bit output
#define MAGNETO_BIT_16 0x01 // 16bit output

// Gyro Full Scale Select
#define GYRO_FS_250  0x0 // +250dps
#define GYRO_FS_500  0x1 // +500dps
#define GYRO_FS_1000 0x2 // +1000dps
#define GYRO_FS_2000 0x3 // +2000dps

// Accel Full Scale Select
#define ACCEL_FS_2G  0x0 // 2g
#define ACCEL_FS_4G  0x1 // 4g
#define ACCEL_FS_8G  0x2 // 8g
#define ACCEL_FS_16G 0x3 // 16g

/**
 * @fn mpu9250_read(const struct device *dev, uint8_t slave_addr, uint8_t reg_addr, uint8_t num, uint8_t* buffer)
 * @brief The function reads data from MPU9250 sensor
 * @details The function `mpu9250_read` reads data from an MPU9250 sensor using I2C communication.
 * @param i2c_num Specify the I2C interface number used by MPU9250 sensor
 * @param slave_addr address of the slave device on the I2C bus 
 * @param reg_addr register address from which data needs to be read from the MPU9250 sensor 
 * @param num number of bytes to read from the MPU9250 sensor. 
 * @param buffer pointer to an array where the data read from the MPU9250 sensor will be stored
 */
void mpu9250_read(const struct device *dev, uint8_t slave_addr, uint8_t reg_addr, uint8_t num, uint8_t* buffer);

/**
 * @fn mpu9250_write(const struct device *dev, uint8_t slave_addr, uint8_t reg_addr, uint8_t data)
 * @brief The function `mpu9250_write` is used to write data
 * @details The function `mpu9250_write` writes data to an MPU9250 sensor using I2C communication 
 * @param i2c_num Specify the I2C interface number used by MPU9250 sensor
 * @param slave_addr address of the slave device on the I2C bus 
 * @param reg_addr register address from which data needs to be read from the MPU9250 sensor 
 * @param data data to write to a specific register in the MPU9250 sensor
 */
void mpu9250_write(const struct device *dev, uint8_t slave_addr, uint8_t reg_addr, uint8_t data);

/**
 * @fn accel_xyz(const struct device *dev, uint8_t slave_addr, float* ax, float* ay, float* az)
 * @brief The function `accel_xyz` reads raw accelerometer data
 * @details The function `accel_xyz` reads raw accelerometer data from an MPU9250 sensor 
 * and converts it to float values for the x, y, and z axes
 * @param i2c_num Specify the I2C interface number used by MPU9250 sensor
 * @param slave_addr address of the slave device on the I2C bus 
 * @param ax pointer to a float variable where the acceleration value along the X-axis 
 * will be stored after converting the raw accelerometer data.
 * @param ay pointer to a float variable where the acceleration value along the Y-axis 
 * will be stored after converting the raw accelerometer data.
 * @param az pointer to a float variable where the acceleration value along the Z-axis 
 * will be stored after converting the raw accelerometer data.
 */
void accel_xyz(const struct device *dev, uint8_t slave_addr, float* ax, float* ay, float* az);

/**
 * @fn gyro_xyz(const struct device *dev, uint8_t slave_addr, float* gx, float* gy, float* gz)
 * @brief The function `gyro_xyz` reads raw gyroscope data
 * @details The function `gyro_xyz` reads raw gyroscope data from an MPU9250 sensor 
 * and converts it to float values for the x, y, and z axes.
 * @param i2c_num Specify the I2C interface number used by MPU9250 sensor
 * @param slave_addr address of the slave device on the I2C bus 
 * @param gx pointer to a float variable where the gyroscope value along for the X-axis 
 * will be stored after converting the raw gyroscope data.
 * @param gy pointer to a float variable where the gyroscope value along for the Y-axis 
 * will be stored after converting the raw gyroscope data.
 * @param gz pointer to a float variable where the gyroscope value along for the Z-axis 
 * will be stored after converting the raw gyroscope data.
 */
void gyro_xyz(const struct device *dev, uint8_t slave_addr, float* gx, float* gy, float* gz);

/**
 * @fn magneto_xyz(const struct device *dev, uint8_t slave_addr, float* mx, float* my, float* mz)
 * @brief The function `magneto_xyz` reads raw magnetometer data
 * @details The function `magneto_xyz` reads raw magnetometer data from an AK8963 magnetometer, 
 * combines the data for each axis, and converts it to float values using resolution and coefficients.
 * @param i2c_num Specify the I2C interface number used by MPU9250 sensor
 * @param slave_addr address of the slave device on the I2C bus 
 * @param mx pointer to a float variable where the magnetometer value along for the X-axis 
 * will be stored after converting the raw magnetometer data
 * @param my pointer to a float variable where the magnetometer value along for the Y-axis 
 * will be stored after converting the raw magnetometer data
 * @param mz pointer to a float variable where the magnetometer value along for the Z-axis 
 * will be stored after converting the raw magnetometer data
 */
void magneto_xyz(const struct device *dev, uint8_t slave_addr, float* mx, float* my, float* mz);

/**
 * @fn mpu9250_config(const struct device *dev, uint8_t slave_addr, uint8_t gfs, uint8_t afs)
 * @brief The function `mpu9250_config` configures the MPU9250 sensor
 * @details The function `mpu9250_config` configures the MPU9250 sensor with specified gyro and accelerometer
 * full scales, and sets various register values for operation.
 * @param i2c_num Specify the I2C interface number used by MPU9250 sensor
 * @param slave_addr address of the slave device on the I2C bus 
 * @param gfs gfs(Gyroscope Full Scale) specify the full scale range for the gyroscope sensor
 * @param afs afs(accelerometer Full Scale) specify the full scale range for the accelerometer sensor
 */
void mpu9250_config(const struct device *dev, uint8_t slave_addr);

/**
 * @fn ak8963_config(const struct device *dev, uint8_t slave_addr, uint8_t mode, uint8_t mfs)
 * @brief The function `ak8963_config` configures the AK8963 sensor
 * @details The function `ak8963_config` configures the AK8963 sensor with specified Magneto Scale Select 
 * and sets various register values for operation.
 * @param i2c_num Specify the I2C interface number used by AK8963 sensor
 * @param slave_addr address of the slave device on the I2C bus 
 * @param mode specify the Magneto Mode Select for the AK8963 magnetometer
 * @param mfs mfs(Magneto Scale Select) represents the magnetometer scale factor and
 * determine the resolution of the magnetometer output
 */
void ak8963_config(const struct device *dev, uint8_t slave_addr);

/**
 * @fn readStepDetection(float ax, float ay, float az)
 * @brief The function `readStepDetection` implements a step detection algorithm
 * @details The function `readStepDetection` implements a step detection algorithm using accelerometer data 
 * and state transitions based on threshold values.
 * @param ax Handling step detection based on accelerometer data `ax` represent the acceleration values in the x,
 * The function processes the accelerometer data to detect steps based on certain thresholds
 * @param ay Handling step detection based on accelerometer data `ay` represent the acceleration values in the y,
 * The function processes the accelerometer data to detect steps based on certain thresholds
 * @param az Handling step detection based on accelerometer data `az` represent the acceleration values in the z,
 * The function processes the accelerometer data to detect steps based on certain thresholds
 */
uint16_t readStepDetection(float ax, float ay, float az);
```

## src/cst816s.c
```c
#include "cst816s.h"

void CST816S_init(cst816s_t *handle,const struct device *gpio_dev,const struct device *i2c_dev,uint8_t rst,uint8_t irq,uint8_t *data)
{
    handle->rst.pin = rst;
    handle->irq.pin = irq;
    handle->i2c_dev = i2c_dev;
    handle->rst.port = gpio_dev;
    handle->irq.port = gpio_dev;
    gpio_pin_configure(gpio_dev,rst,GPIO_OUTPUT);
    gpio_pin_configure(gpio_dev,irq,GPIO_INPUT);
    handle->data_arr = data;
}

data_struct CST816S_begin(cst816s_t *handle)
{
/*implementation without interrupt*/
/*Have to set irq pin as input for interrupt*/
/*rst pin by default configured as output*/

 gpio_pin_set_dt(&handle->rst, 1);
  k_msleep(50);
  gpio_pin_set_dt(&handle->rst, 0);
  k_msleep(5);
  gpio_pin_set_dt(&handle->rst, 1 );
  k_msleep(50);
  data_struct data;
  CST816S_read(handle,CST816S_ADDRESS, 0x15, &data.version, 1);
  k_msleep(5);
  CST816S_read(handle,CST816S_ADDRESS, 0xA7, data.versionInfo, 3);
  return data;

}
uint8_t CST816S_read(cst816s_t *handle,uint16_t addr, uint8_t reg_addr, uint8_t *reg_data, uint32_t length)
{
    uint8_t msg_arr[1];
	struct i2c_msg msg_obj;
	msg_obj.buf = msg_arr; 
	msg_obj.len = 1;
	for(uint8_t i=0;i<length;i++){
      msg_arr[0] = reg_addr+i;
	  msg_obj.flags = I2C_MSG_WRITE;
	  i2c_transfer(handle->i2c_dev,&msg_obj,1,addr);
      msg_obj.flags = I2C_MSG_READ;
	  i2c_transfer(handle->i2c_dev,&msg_obj,1,addr);
	  reg_data[i] = msg_arr[0];
    }
  return 0;
}
uint8_t CST816S_write(cst816s_t *handle,uint8_t addr, uint8_t reg_addr, const uint8_t *reg_data, uint32_t length)
{
      uint8_t msg_arr[10];
	  struct i2c_msg msg_obj;
	  msg_obj.buf = msg_arr;
	  msg_obj.len = length;
      msg_arr[0] = reg_addr;
      for(uint8_t i=1;i<=length;i++){
        msg_arr[i] = reg_data[i];
      }
	  msg_obj.flags = I2C_MSG_WRITE;
	  i2c_transfer(handle->i2c_dev,&msg_obj,1,addr);
  return 0;
}

data_struct CST816S_read_touch(cst816s_t *handle) {
  uint8_t *data_raw = handle->data_arr;
  CST816S_read(handle,CST816S_ADDRESS, 0x01, data_raw, 6);
  data_struct data;
  data.gestureID = data_raw[0];
  data.points = data_raw[1];
  data.event = data_raw[2] >> 6;
  data.x = ((data_raw[2] & 0xF) << 8) + data_raw[3];
  data.y = ((data_raw[4] & 0xF) << 8) + data_raw[5];
  return data;
}

void CST816S_sleep(cst816s_t *handle) {
  gpio_pin_set_dt(&handle->rst, 0);
  k_msleep(5);
  gpio_pin_set_dt(&handle->rst, 1 );
  k_msleep(50);
  uint8_t standby_value = 0x03;
  CST816S_write(handle->i2c_dev,CST816S_ADDRESS, 0xA5, &standby_value, 1);
}
```
