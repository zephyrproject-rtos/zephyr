## CMakeLists.txt
```
# SPDX-License-Identifier: Apache-2.0

cmake_minimum_required(VERSION 3.20.0)

find_package(Zephyr REQUIRED HINTS $ENV{ZEPHYR_BASE})
project(gc_disp_test)
target_sources(app PRIVATE src/main.c)
if(CONFIG_XIP)
    zephyr_code_relocate(src/main.c ROM_TEXT NOCOPY)
    zephyr_code_relocate(src/main.c ROM_DATA)
    zephyr_code_relocate(src/main.c ROM_BSS)
endif()
```

## prj.conf
```kconfig
CONFIG_CODE_DATA_RELOCATION=n
# CONFIG_HAVE_CUSTOM_LINKER_SCRIPT=y
# CONFIG_CUSTOM_LINKER_SCRIPT="linker_secure-iot.ld"
CONFIG_XIP=n
CONFIG_FLASH=y
CONFIG_FLASH_BASE_ADDRESS=0x90000000
CONFIG_I2C_SECURE_IOT=y
CONFIG_MULTITHREADING=y
#CONFIG_SMP=y
CONFIG_MAIN_STACK_SIZE=2048
CONFIG_DISPLAY=y
# CONFIG_DUMMY_DISPLAY=y
CONFIG_SPI=y
CONFIG_SPI_SHAKTI=y
CONFIG_GC9X01X=y
CONFIG_DISPLAY_LOG_LEVEL_ERR=y
CONFIG_MULTITHREADING=y
CONFIG_LOG=y
```

## src/main.c
```c
#include <zephyr/device.h>
#include <zephyr/drivers/display.h>
#include <stdio.h>
#include <string.h>
#include <zephyr/kernel.h>
#include <zephyr/drivers/spi.h>
#include <zephyr/pm/device.h>

#define LOG_LEVEL CONFIG_LOG_DEFAULT_LEVEL
#include <zephyr/logging/log.h>
LOG_MODULE_REGISTER(app);


int main(void)
{
	const struct device *display_dev,*parent_dev;
	// display_dev = DEVICE_DT_GET(DT_CHOSEN(zephyr_display));
	display_dev = DEVICE_DT_GET(DT_NODELABEL(gc9x01_display));
	parent_dev =  DEVICE_DT_GET(DT_PARENT(DT_NODELABEL(gc9x01_display)));
	printf("display dev name:%s \n",display_dev->name);
	printf("display dev config: 0x%x \n",display_dev->config);
	printf("display dev api: 0x%x \n",display_dev->api);
	printf("display dev name:%s \n",parent_dev->name);
	printf("display dev config: 0x%x \n",parent_dev->config);
	printf("display dev api: 0x%x \n",parent_dev->api);
	while(1);
}
```
