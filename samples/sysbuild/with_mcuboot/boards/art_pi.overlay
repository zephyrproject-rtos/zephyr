/*
 * Copyright (c) 2025 Dejiang He <hedejiang9@gmail.com>
 *
 * SPDX-License-Identifier: Apache-2.0
 */

/*
 * Define the device, controller and partition to be the external memory
 * for running the application in external NOR from MCUboot
 */
/ {
	chosen {
		zephyr,flash = &w25q64_qspi;
		zephyr,flash-controller = &w25q64_qspi;
		zephyr,code-partition = &slot0_partition;
	};
};
