## samples/sysbuild/hello_world/Kconfig.sysbuild
```kconfig
# Copyright (c) 2024 Nordic Semiconductor ASA
# SPDX-License-Identifier: Apache-2.0

source "$(ZEPHYR_BASE)/share/sysbuild/Kconfig"

choice REMOTE_NRF54H20_CORE
	prompt "Remote nRF54h20 core"
	default REMOTE_NRF54H20_CPUFLPR_CORE
	depends on SOC_NRF54H20_CPUAPP

config REMOTE_NRF54H20_CPUFLPR_CORE
	bool "flpr core"

config REMOTE_NRF54H20_CPUFLPR_XIP_CORE
	bool "flpr/xip core"

config REMOTE_NRF54H20_CPUPPR_CORE
	bool "ppr core"

config REMOTE_NRF54H20_CPUPPR_XIP_CORE
	bool "ppr/xip core"

config REMOTE_NRF54H20_CPURAD_CORE
	bool "cpurad"

endchoice

config REMOTE_BOARD
	string
	default "$(BOARD)/nrf5340/cpunet" if SOC_NRF5340_CPUAPP
	default "$(BOARD)/nrf54l15/cpuflpr" if SOC_NRF54L15_CPUAPP
	default "$(BOARD)/nrf54h20/cpurad" if SOC_NRF54H20_CPUAPP && REMOTE_NRF54H20_CPURAD_CORE
	default "$(BOARD)/nrf54h20/cpuppr" if SOC_NRF54H20_CPUAPP && REMOTE_NRF54H20_CPUPPR_CORE
	default "$(BOARD)/nrf54h20/cpuppr/xip" if SOC_NRF54H20_CPUAPP && REMOTE_NRF54H20_CPUPPR_XIP_CORE
	default "$(BOARD)/nrf54h20/cpuflpr" if SOC_NRF54H20_CPUAPP && REMOTE_NRF54H20_CPUFLPR_CORE
	default "$(BOARD)/nrf54h20/cpuflpr/xip" if SOC_NRF54H20_CPUAPP && REMOTE_NRF54H20_CPUFLPR_XIP_CORE
```

## samples/sysbuild/hello_world/boards/apard32690_max32690_m4.conf
```kconfig
# Copyright (c) 2026 Analog Devices, Inc.
# SPDX-License-Identifier: Apache-2.0

CONFIG_MAX32_SECONDARY_RV32=y
CONFIG_MAX32_SECONDARY_RV32_STARTUP_DELAY=15000000
```

## samples/sysbuild/hello_world/boards/max32655evkit_max32655_m4.conf
```kconfig
# Copyright (c) 2024 Analog Devices, Inc.
# SPDX-License-Identifier: Apache-2.0

CONFIG_MAX32_SECONDARY_RV32=y
```

## samples/sysbuild/hello_world/boards/max32666evkit_max32666_cpu0.conf
```kconfig
# Copyright (c) 2026 Analog Devices, Inc.
# SPDX-License-Identifier: Apache-2.0

CONFIG_MAX32_SECONDARY_M4=y
CONFIG_MAX32_SECONDARY_M4_STARTUP_DELAY=15000000
```

## samples/sysbuild/hello_world/boards/nrf5340dk_nrf5340_cpuapp.conf
```kconfig
# Copyright (c) 2024 Nordic Semiconductor ASA
# SPDX-License-Identifier: Apache-2.0

CONFIG_SOC_NRF53_CPUNET_ENABLE=y
```

## samples/sysbuild/hello_world/sample.yaml
```yaml
sample:
  name: Hello World for multiple board targets using Sysbuild
  description: |
    Hello World application that builds for multiple targets. Both images print
    the board target they were run on.

common:
  sysbuild: true
  harness: pytest
  harness_config:
    pytest_dut_scope: session
  timeout: 20

tests:
  sample.sysbuild.hello_world.nrf5340dk_cpuapp_cpunet:
    platform_allow:
      - nrf5340dk/nrf5340/cpuapp
    integration_platforms:
      - nrf5340dk/nrf5340/cpuapp
  sample.sysbuild.hello_world.nrf54h20dk_cpuapp_cpurad:
    platform_allow:
      - nrf54h20dk/nrf54h20/cpuapp
    integration_platforms:
      - nrf54h20dk/nrf54h20/cpuapp
    extra_args:
      - SB_CONFIG_REMOTE_NRF54H20_CPURAD_CORE=y
      - hello_world_CONFIG_SOC_NRF54H20_CPURAD_ENABLE=y
  sample.sysbuild.hello_world.nrf54h20dk_cpuapp_cpuppr:
    platform_allow:
      - nrf54h20dk/nrf54h20/cpuapp
    integration_platforms:
      - nrf54h20dk/nrf54h20/cpuapp
    extra_args:
      - SB_CONFIG_REMOTE_NRF54H20_CPUPPR_CORE=y
      - hello_world_SNIPPET=nordic-ppr
  sample.sysbuild.hello_world.nrf54h20dk_cpuapp_cpuppr_xip:
    platform_allow:
      - nrf54h20dk/nrf54h20/cpuapp
    integration_platforms:
      - nrf54h20dk/nrf54h20/cpuapp
    extra_args:
      - SB_CONFIG_REMOTE_NRF54H20_CPUPPR_XIP_CORE=y
      - hello_world_SNIPPET=nordic-ppr-xip
  sample.sysbuild.hello_world.nrf54l15_cpuflpr:
    platform_allow:
      - nrf54l15dk/nrf54l15/cpuapp
      - ophelia4ev/nrf54l15/cpuapp
      - bl54l15_dvk/nrf54l15/cpuapp
      - bl54l15u_dvk/nrf54l15/cpuapp
    integration_platforms:
      - nrf54l15dk/nrf54l15/cpuapp
      - ophelia4ev/nrf54l15/cpuapp
      - bl54l15_dvk/nrf54l15/cpuapp
      - bl54l15u_dvk/nrf54l15/cpuapp
    extra_args:
      - hello_world_SNIPPET=nordic-flpr
  sample.sysbuild.hello_world.nrf54h20dk_cpuapp_cpuflpr:
    platform_allow:
      - nrf54h20dk/nrf54h20/cpuapp
    integration_platforms:
      - nrf54h20dk/nrf54h20/cpuapp
    extra_args:
      - SB_CONFIG_REMOTE_NRF54H20_CPUFLPR_CORE=y
      - hello_world_SNIPPET=nordic-flpr
  sample.sysbuild.hello_world.nrf54h20dk_cpuapp_cpuflpr_xip:
    platform_allow:
      - nrf54h20dk/nrf54h20/cpuapp
    integration_platforms:
      - nrf54h20dk/nrf54h20/cpuapp
    extra_args:
      - SB_CONFIG_REMOTE_NRF54H20_CPUFLPR_XIP_CORE=y
      - hello_world_SNIPPET=nordic-flpr-xip
```

## samples/sysbuild/mcuboot_dual_key/sample.yaml
```yaml
sample:
  description: Sample demonstrating MCUboot with two accepted signing keys
  name: mcuboot dual key
tests:
  sample.sysbuild.mcuboot_dual_key:
    sysbuild: true
    platform_allow:
      - nrf52840dk/nrf52840
      - frdm_k64f
    integration_platforms:
      - nrf52840dk/nrf52840
    tags: mcuboot
    harness: console
    harness_config:
      type: multi_line
      regex:
        - "Address of sample(.*)"
        - "Hello mcuboot dual key!(.*)"
```

## samples/sysbuild/shared_vars/sample.yaml
```yaml
sample:
  name: Passing variables from sysbuild.cmake to application cmake
  description: |
    Not even an application - just a cmake sample how to pass variables directly to cmake call
    of the external project.

common:
  sysbuild: true
  build_only: true

tests:
  sample.sysbuild.shared_vars:
    platform_allow: native_posix
    extra_args: >-
      SHARE_ME_APP1=101
      SHARE_ME_APP2=102
      SHARE_ME_REMOTE1=201
      SHARE_ME_REMOTE2=202
```

## samples/sysbuild/updateable_mcuboot/sample.yaml
```yaml
sample:
  description: Sample with a 2-stage MCUboot bootloader setup
  name: MCUboot updateable bootloader
tests:
  sample.sysbuild.updateable.mcuboot:
    sysbuild: true
    platform_allow:
      - nrf52840dk/nrf52840
    integration_platforms:
      - nrf52840dk/nrf52840
    tags: mcuboot
```

## samples/sysbuild/with_mcuboot/boards/mimxrt1064_evk.conf
```kconfig
# Copyright 2026 NXP
# SPDX-License-Identifier: Apache-2.0

# Enable Ethernet networking for MIMXRT1064-EVK MCUboot sysbuild test
CONFIG_NETWORKING=y
CONFIG_NET_L2_ETHERNET=y
CONFIG_ETH_DRIVER=y
```

## samples/sysbuild/with_mcuboot/sample.yaml
```yaml
sample:
  description: Sample with MCUboot built through sysbuild
  name: with mcuboot
tests:
  sample.sysbuild.with_mcuboot:
    sysbuild: true
    # Platform allowed is used as twister using sysbuild still lacks proper
    # filtering support, see discussion in #49552.
    platform_allow:
      - reel_board
      - nrf52840dk/nrf52840
      - esp32_devkitc/esp32/procpu
      - esp32s2_devkitc
      - esp32s3_devkitc/esp32s3/procpu
      - esp32c3_devkitm
      - esp32c6_devkitc/esp32c6/hpcore
      - nucleo_c071rb
      - nucleo_f091rc
      - nucleo_f207zg
      - nucleo_f429zi
      - nucleo_f746zg
      - nucleo_g071rb
      - nucleo_g474re
      - nucleo_h753zi
      - nucleo_h7s3l8/stm32h7s3xx/ext_flash_app
      - nucleo_l152re
      - nucleo_u385rg_q
      - nucleo_wb55rg
      - nucleo_wb09ke
      - nucleo_wba65ri
      - nucleo_wba55cg
      - nucleo_wl55jc
      - stm32f3_disco
      - stm32h7s78_dk/stm32h7s7xx/ext_flash_app
      - stm32h573i_dk
      - stm32h573i_dk/stm32h573xx/ext_flash_app
      - stm32h750b_dk/stm32h750xx/ext_flash_app
      - stm32l562e_dk
      - stm32u083c_dk
      - stm32wba65i_dk1
      - sam_e54_xpro
      - pic32cx_sg41_cult
    integration_platforms:
      - nrf52840dk/nrf52840
      - esp32_devkitc/esp32/procpu
      - esp32s2_devkitc
      - esp32s3_devkitc/esp32s3/procpu
      - esp32c3_devkitm
      - esp32c6_devkitc/esp32c6/hpcore
    tags: mcuboot
    harness: console
    harness_config:
      type: multi_line
      regex:
        - "Address of sample(.*)"
        - "Hello sysbuild with mcuboot!(.*)"
```

## samples/testing/integration/testcase.yaml
```yaml
tests:
  # section.subsection
  testing.ztest:
    build_only: true
    platform_whitelist: native_posix
    tags: testing
```

## samples/testing/unit/sample.yaml
```yaml
sample:
  description: TBD
  name: TBD
tests:
  test:
    tags: buf
    type: unit
```

## samples/tfm_integration/config_build/sample.yaml
```yaml
sample:
  description: Test TF-M builds in various configurations
  name: TF-M build configuration
common:
  tags:
    - trusted-firmware-m
  platform_allow:
    - v2m_musca_s1/musca_s1/ns
    - nrf5340dk/nrf5340/cpuapp/ns
    - nrf9160dk/nrf9160/ns
    - nrf54l15dk/nrf54l15/cpuapp/ns
    - nrf54l15dk/nrf54l10/cpuapp/ns
    - bl5340_dvk/nrf5340/cpuapp/ns
  integration_platforms:
    - nrf5340dk/nrf5340/cpuapp/ns
  harness: console
  harness_config:
    type: one_line
    regex:
      - "Hello World! (.*)"
tests:
  sample.config_build.no_bl2:
    extra_configs:
      - CONFIG_TFM_BL2=n
  sample.config_build.single_image:
    tags:
      - mcuboot
    platform_allow:
      # Platform fails no_bl2
      - stm32l562e_dk/stm32l562xx/ns
    extra_configs:
      - CONFIG_TFM_MCUBOOT_IMAGE_NUMBER=1
```

## samples/tfm_integration/devicetree_layout/tfm_default/sample.yaml
```yaml
sample:
  description: TF-M with default partitions
  name: tfm-default-partitions
tests:
  sample.tfm.tfm_default:
    tags: trusted-firmware-m
    build_only: true
    platform_allow:
      - nrf5340dk/nrf5340/cpuapp/ns
    integration_platforms:
      - nrf5340dk/nrf5340/cpuapp/ns
```

## samples/tfm_integration/devicetree_layout/tfm_ext_secondary/sample.yaml
```yaml
sample:
  description: TF-M with no secondary image
  name: tfm-external-secondary
tests:
  sample.tfm.tfm_no_secondary:
    tags: trusted-firmware-m
    build_only: true
    platform_allow:
      - nrf5340dk/nrf5340/cpuapp/ns
    integration_platforms:
      - nrf5340dk/nrf5340/cpuapp/ns
```

## samples/tfm_integration/devicetree_layout/tfm_no_bl2/sample.yaml
```yaml
sample:
  description: TF-M with no bootloader
  name: tfm-no-bl2
tests:
  sample.tfm.tfm_no_bl2:
    tags: trusted-firmware-m
    build_only: true
    platform_allow:
      - nrf5340dk/nrf5340/cpuapp/ns
    integration_platforms:
      - nrf5340dk/nrf5340/cpuapp/ns
```

## samples/tfm_integration/devicetree_layout/tfm_single_image/sample.yaml
```yaml
sample:
  description: TF-M with MCUBOOT_IMAGE_NUMBER=1
  name: tfm-single-image
tests:
  sample.tfm.tfm_single_img:
    tags: trusted-firmware-m
    build_only: true
    platform_allow:
      - nrf5340dk/nrf5340/cpuapp/ns
    integration_platforms:
      - nrf5340dk/nrf5340/cpuapp/ns
```

## samples/tfm_integration/psa_crypto/Kconfig
```kconfig
# Private config options for PSA level 1 application

# Copyright (c) 2019,2020 Linaro
# SPDX-License-Identifier: Apache-2.0

mainmenu "PSA level 1 sample application"

menu "Application configuration"

module = PSA
module-str = psa
source "subsys/logging/Kconfig.template.log_config"

endmenu

config PSA_SHELL
	bool "The 'psa' shell command"
	depends on SHELL
	help
	  Enabling this option will make the 'psa' shell command available.

config PSA_IMPORT_KEY
	bool "Support for importing private key data"
	help
	  Enable support for importing a pre-generated or randomly generated
	  private key using PSA APIs and PRIVATE_KEY_STATIC or
	  PRIVATE_KEY_RANDOM.

choice
	prompt "Private Key"
	default PRIVATE_KEY_RANDOM

config PRIVATE_KEY_STATIC
	bool "Static"
	depends on PSA_IMPORT_KEY
	help
	  A static key value will be used for the elliptic curve 'secp256r1'
	  private key.

config PRIVATE_KEY_RANDOM
	bool "Random"
	depends on PSA_IMPORT_KEY
	help
	  A randomly generated value will be used for the elliptic curve
	  'secp256r1' private key.

endchoice

source "Kconfig.zephyr"
```

## samples/tfm_integration/psa_crypto/boards/max32657evkit_max32657_ns.conf
```kconfig
# Copyright (c) 2025 Analog Devices, Inc.
#
# SPDX-License-Identifier: Apache-2.0
#

CONFIG_TFM_IPC=n
CONFIG_TFM_SFN=y
CONFIG_TFM_ISOLATION_LEVEL=1
```

## samples/tfm_integration/psa_crypto/sample.yaml
```yaml
sample:
  description: This app provides an example of using PSA crypto APIs
      to generate device certificate signing request in Zephyr
      using IPC mode.
  name: PSA crypto example
tests:
  sample.psa_crypto:
    tags:
      - introduction
      - trusted-firmware-m
      - crypto
      - csr
      - mcuboot
    platform_allow: mps2/an521/cpu0/ns v2m_musca_s1/musca_s1/ns
      nrf5340dk/nrf5340/cpuapp/ns nrf9160dk/nrf9160/ns
      stm32l562e_dk/stm32l562xx/ns bl5340_dvk/nrf5340/cpuapp/ns
      rd_rw612_bga/rw612/ns
    harness: console
    harness_config:
      type: multi_line
      regex:
        - "System IAT size is: (.*)"
        - "Requesting IAT with (.*) byte challenge."
        - "IAT data received: (.*)"
        - "Retrieving public key for key #1"
        - "Signature verified"
        - "Destroyed persistent key #1"
        - "Generating 256 bytes of random data."
        - "Create device Certificate Signing Request completed"
        - "BEGIN CERTIFICATE REQUEST"
        - "END CERTIFICATE REQUEST"
```

## samples/tfm_integration/psa_custom_service/sample.yaml
```yaml
sample:
  description: PSA Custom Service sample
  name: PSA Custom Service
tests:
    sample.psa_custom_service:
        tags: introduction tfm psa custom service
        platform_allow: mps2_an521_nonsecure lpcxpresso55s69_ns nrf5340dk_nrf5340_cpuappns
          nrf9160dk_nrf9160ns nucleo_l552ze_q_ns v2m_musca_s1_nonsecure stm32l562e_dk_ns
          bl5340_dvk_cpuappns
        harness: console
        harness_config:
          type: multi_line
          regex:
            - "app: Hashing the message"
            - "\\[Example partition\\] Calculating SHA-256 hash!"
            - "\\[Example partition\\] Done!"
            - "app: Size of SHA-256 hash is 32 bytes"
```

## samples/tfm_integration/psa_firmware/Kconfig
```kconfig
# Private config options for PSA firmware application

# Copyright (c) 2021 Linaro
# SPDX-License-Identifier: Apache-2.0

mainmenu "PSA firmware sample application"

menu "Application configuration"

module = APP
module-str = app
source "subsys/logging/Kconfig.template.log_config"

endmenu

config APP_FIRMWARE_UPDATE_IMAGE
	string "Firmware update image to update to"
	help
	  This required option specifies the path to an image that this
	  exapmle will update to.
	default "$(shell, dirname $(filename))/boards/hello-an547.hex" if BOARD_MPS3_AN547

config APP_FIRMWARE_UPDATE_IMAGE_VERSION
	string "Version of the new image to update to"
	default "0.0.2+0"

source "Kconfig.zephyr"
```
