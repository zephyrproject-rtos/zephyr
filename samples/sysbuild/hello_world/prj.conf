## CMakeLists.txt
```
# Copyright (c) 2024 Nordic Semiconductor ASA
# SPDX-License-Identifier: Apache-2.0

cmake_minimum_required(VERSION 3.28.0)
find_package(Zephyr REQUIRED HINTS $ENV{ZEPHYR_BASE})

project(hello_world)
target_sources(app PRIVATE src/main.c)
```

## Kconfig.sysbuild
```
# Copyright (c) 2024 Nordic Semiconductor ASA
# SPDX-License-Identifier: Apache-2.0

source "$(ZEPHYR_BASE)/share/sysbuild/Kconfig"

choice REMOTE_NRF54H20_CORE
	prompt "Remote nRF54h20 core"
	default REMOTE_NRF54H20_CPUFLPR_CORE
	depends on SOC_NRF54H20_CPUAPP

config REMOTE_NRF54H20_CPUFLPR_CORE
	bool "flpr core"

config REMOTE_NRF54H20_CPUFLPR_XIP_CORE
	bool "flpr/xip core"

config REMOTE_NRF54H20_CPUPPR_CORE
	bool "ppr core"

config REMOTE_NRF54H20_CPUPPR_XIP_CORE
	bool "ppr/xip core"

config REMOTE_NRF54H20_CPURAD_CORE
	bool "cpurad"

endchoice

config REMOTE_BOARD
	string
	default "$(BOARD)/nrf5340/cpunet" if SOC_NRF5340_CPUAPP
	default "$(BOARD)/nrf54h20/cpurad" if SOC_NRF54H20_CPUAPP && REMOTE_NRF54H20_CPURAD_CORE
	default "$(BOARD)/nrf54h20/cpuppr" if SOC_NRF54H20_CPUAPP && REMOTE_NRF54H20_CPUPPR_CORE
	default "$(BOARD)/nrf54h20/cpuppr/xip" if SOC_NRF54H20_CPUAPP && REMOTE_NRF54H20_CPUPPR_XIP_CORE
	default "$(BOARD)/nrf54h20/cpuflpr" if SOC_NRF54H20_CPUAPP && REMOTE_NRF54H20_CPUFLPR_CORE
	default "$(BOARD)/nrf54h20/cpuflpr/xip" if SOC_NRF54H20_CPUAPP && REMOTE_NRF54H20_CPUFLPR_XIP_CORE
	default "$(BOARD)/nrf54l15/cpuflpr" if SOC_NRF54L15_CPUAPP
	default "$(BOARD)/nrf54lv10a/cpuflpr" if SOC_NRF54LV10A_CPUAPP
	default "$(BOARD)/nrf7120/cpuflpr" if SOC_NRF7120_CPUAPP
	default "$(BOARD)/max32655/rv32" if SOC_MAX32655_M4
	default "$(BOARD)/max32690/rv32" if SOC_MAX32690_M4
	default "$(BOARD)/max78002/rv32" if SOC_MAX78002_M4
	default "$(BOARD)/max78000/rv32" if SOC_MAX78000_M4
	default "$(BOARD)/max32666/cpu1" if SOC_MAX32666_CPU0
	default "$(BOARD)/rp2350a/m33_1" if SOC_RP2350A_M33_0
```

## sample.yaml
```
sample:
  name: Hello World for multiple board targets using Sysbuild
  description: |
    Hello World application that builds for multiple targets. Both images print
    the board target they were run on.

common:
  sysbuild: true
  harness: pytest
  harness_config:
    pytest_dut_scope: session

tests:
  sample.sysbuild.hello_world:
    platform_allow:
      - nrf5340dk/nrf5340/cpuapp
      - max32655evkit/max32655/m4
      - max32655fthr/max32655/m4
      - max32690evkit/max32690/m4
      - max78002evkit/max78002/m4
    integration_platforms:
      - nrf5340dk/nrf5340/cpuapp
      - max32655evkit/max32655/m4
      - max32655fthr/max32655/m4
      - max32690evkit/max32690/m4
      - max78002evkit/max78002/m4
  sample.sysbuild.hello_world.nrf54h20dk_cpuapp_cpurad:
    platform_allow:
      - nrf54h20dk/nrf54h20/cpuapp
    integration_platforms:
      - nrf54h20dk/nrf54h20/cpuapp
    extra_args:
      - SB_CONFIG_REMOTE_NRF54H20_CPURAD_CORE=y
      - hello_world_CONFIG_SOC_NRF54H20_CPURAD_ENABLE=y
  sample.sysbuild.hello_world.nrf54h20dk_cpuapp_cpuppr:
    platform_allow:
      - nrf54h20dk/nrf54h20/cpuapp
    integration_platforms:
      - nrf54h20dk/nrf54h20/cpuapp
    extra_args:
      - SB_CONFIG_REMOTE_NRF54H20_CPUPPR_CORE=y
      - hello_world_SNIPPET=nordic-ppr
  sample.sysbuild.hello_world.nrf54h20dk_cpuapp_cpuppr_xip:
    platform_allow:
      - nrf54h20dk/nrf54h20/cpuapp
    integration_platforms:
      - nrf54h20dk/nrf54h20/cpuapp
    extra_args:
      - SB_CONFIG_REMOTE_NRF54H20_CPUPPR_XIP_CORE=y
      - hello_world_SNIPPET=nordic-ppr-xip
  sample.sysbuild.hello_world.nrf54l15_cpuflpr:
    platform_allow:
      - nrf54l15dk/nrf54l15/cpuapp
      - ophelia4ev/nrf54l15/cpuapp
      - bl54l15_dvk/nrf54l15/cpuapp
    integration_platforms:
      - nrf54l15dk/nrf54l15/cpuapp
      - ophelia4ev/nrf54l15/cpuapp
      - bl54l15_dvk/nrf54l15/cpuapp
    extra_args:
      - hello_world_SNIPPET=nordic-flpr
  sample.sysbuild.hello_world.nrf54h20dk_cpuapp_cpuflpr:
    platform_allow:
      - nrf54h20dk/nrf54h20/cpuapp
    integration_platforms:
      - nrf54h20dk/nrf54h20/cpuapp
    harness_config: &pytest_only_first_uart
      pytest_root:
        - "pytest/test_both_uart.py::test_uart_in_app"
    extra_args:
      - SB_CONFIG_REMOTE_NRF54H20_CPUFLPR_CORE=y
      - hello_world_SNIPPET=nordic-flpr
  sample.sysbuild.hello_world.nrf54h20dk_cpuapp_cpuflpr_xip:
    platform_allow:
      - nrf54h20dk/nrf54h20/cpuapp
    integration_platforms:
      - nrf54h20dk/nrf54h20/cpuapp
    harness_config: *pytest_only_first_uart
    extra_args:
      - SB_CONFIG_REMOTE_NRF54H20_CPUFLPR_XIP_CORE=y
      - hello_world_SNIPPET=nordic-flpr-xip
  sample.sysbuild.hello_world.nrf7120_cpuflpr:
    platform_allow:
      - nrf7120dk/nrf7120/cpuapp
    integration_platforms:
      - nrf7120dk/nrf7120/cpuapp
    extra_args:
      - hello_world_SNIPPET=nordic-flpr
```

## prj.conf
```kconfig
# no additional configuration is required
```

## boards/apard32690_max32690_m4.conf
```kconfig
# Copyright (c) 2026 Analog Devices, Inc.
# SPDX-License-Identifier: Apache-2.0

CONFIG_MAX32_SECONDARY_RV32=y
CONFIG_MAX32_SECONDARY_RV32_STARTUP_DELAY=15000000
```

## boards/max32655evkit_max32655_m4.conf
```kconfig
# Copyright (c) 2025 Analog Devices, Inc.
# SPDX-License-Identifier: Apache-2.0

CONFIG_MAX32_SECONDARY_RV32=y
```

## boards/max32655fthr_max32655_m4.conf
```kconfig
# Copyright (c) 2026 Analog Devices, Inc.
# SPDX-License-Identifier: Apache-2.0

CONFIG_MAX32_SECONDARY_RV32=y
```

## boards/max32666evkit_max32666_cpu0.conf
```kconfig
# Copyright (c) 2026 Analog Devices, Inc.
# SPDX-License-Identifier: Apache-2.0

CONFIG_MAX32_SECONDARY_M4=y
CONFIG_MAX32_SECONDARY_M4_STARTUP_DELAY=15000000
```

## boards/max32690evkit_max32690_m4.conf
```kconfig
# Copyright (c) 2025 Analog Devices, Inc.
# SPDX-License-Identifier: Apache-2.0

CONFIG_MAX32_SECONDARY_RV32=y
CONFIG_MAX32_SECODARY_RV32_STARTUP_DELAY=15000000
```

## boards/nrf5340dk_nrf5340_cpuapp.conf
```kconfig
# Copyright (c) 2024 Nordic Semiconductor ASA
# SPDX-License-Identifier: Apache-2.0

CONFIG_SOC_NRF53_CPUNET_ENABLE=y
```

## src/main.c
```c
/*
 * Copyright (c) 2024 Nordic Semiconductor ASA
 * SPDX-License-Identifier: Apache-2.0
 */

#include <zephyr/sys/printk.h>

int main(void)
{
	printk("Hello world from %s\n", CONFIG_BOARD_TARGET);

	return 0;
}
```
