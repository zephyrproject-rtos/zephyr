/*
 * Copyright (c) 2025 Ambiq Micro Inc. <www.ambiq.com>
 *
 * SPDX-License-Identifier: Apache-2.0
 */

/ {
	/delete-node/ xo32m_xtal;

	chosen {
		zephyr,sram = &dtcm;
	};

	aliases {
		button = &button0;
		led = &led0;
	};
};

&stimer0 {
	status = "disabled";
};
