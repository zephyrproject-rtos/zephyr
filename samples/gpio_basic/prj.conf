## CMakeLists.txt
```
# SPDX-License-Identifier: Apache-2.0

cmake_minimum_required(VERSION 3.20.0)

find_package(Zephyr REQUIRED HINTS $ENV{ZEPHYR_BASE})
project(gpio_basic)

target_sources(app PRIVATE src/main.c)
# zephyr_library_include_directories(include(zephyr(drivers(gpio_shakti.h))))
if(CONFIG_XIP)
    zephyr_code_relocate(src/main.c ROM_TEXT NOCOPY)
    zephyr_code_relocate(src/main.c ROM_DATA)
    zephyr_code_relocate(src/main.c ROM_BSS)
endif()
```

## sample.yaml
```
sample:
  description: GPIO application sample, the simplest Zephyr
    application
  name: gpio_shakti_app
common:
  tags: introduction
  integration_platforms:
    - native_posix
  harness: console
  harness_config:
    type: one_line
    regex:
      - "gpio_shakti_app! (.*)"
tests:
  sample.basic.gpioshaktiapp:
    tags: introduction
```

## prj.conf
```kconfig
CONFIG_GPIO=y
CONFIG_GPIO_SHAKTI=y

CONFIG_MULTITHREADING=y
CONFIG_DISPLAY=y
CONFIG_GC9X01X=y
```

## src/main.c
```c
#include <zephyr/kernel.h>
#include <zephyr/device.h>
#include <zephyr/devicetree.h>

#include <stdio.h>
#include <string.h>

#include <zephyr/drivers/gpio.h>



void main(){
    
    const struct device *dev = DEVICE_DT_GET(DT_NODELABEL(gpio0)); //DEVICE_DT_GET_ONE(shakti_gpio0) This can also be used to define the device.
    
    // const struct device *dev2 = DEVICE_DT_GET(DT_NODELABEL(gc9x01_display));

    int ret;
    ret = gpio_pin_configure(dev, 9, 1);
    ret = gpio_pin_configure(dev, 10, 1);
    ret = gpio_pin_configure(dev, 11, 1);

    while (1){
        printf("set\n");
        ret = gpio_port_toggle_bits(dev, 9);
        ret = gpio_port_toggle_bits(dev, 10);
        ret = gpio_port_toggle_bits(dev, 11);
    }
}
```
