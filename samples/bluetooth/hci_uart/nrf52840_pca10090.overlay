/* SPDX-License-Identifier: Apache-2.0 */

/ {
	chosen {
		zephyr,bt-c2h-uart=&uart1;
	};
};

&uart1 {
	compatible = "nordic,nrf-uarte";
	current-speed = <1000000>;
	status = "okay";
	tx-pin = <17>;
	rx-pin = <20>;
	rts-pin = <15>;
	cts-pin = <22>;
};
