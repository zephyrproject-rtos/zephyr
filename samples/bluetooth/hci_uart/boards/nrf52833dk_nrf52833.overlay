/*
 * Copyright (c) 2022 Nordic Semiconductor ASA
 *
 * SPDX-License-Identifier: Apache-2.0
 */

 &uart0 {
	compatible = "nordic,nrf-uarte";
	current-speed = <1000000>;
	status = "okay";
	hw-flow-control;
};
