## samples/bluetooth/hci_uart/boards/nrf51_blenano.conf
```kconfig
CONFIG_MAIN_STACK_SIZE=512
CONFIG_BT_MAX_CONN=10
CONFIG_IDLE_STACK_SIZE=256
CONFIG_ISR_STACK_SIZE=512
CONFIG_BT_RX_BUF_LEN=76
CONFIG_BT_DISCARDABLE_BUF_SIZE=45
```

## samples/bluetooth/hci_uart/boards/nrf51dongle_nrf51422.conf
```kconfig
CONFIG_MAIN_STACK_SIZE=512

CONFIG_BT_CTLR_ASSERT_HANDLER=y
CONFIG_BT_CTLR_DTM_HCI=y
```

## samples/bluetooth/hci_uart/boards/nrf52840dongle_nrf52840.conf
```kconfig
# The board uses the CDC ACM UART as the serial backend by default, nothing
# else needs to be configured here.
CONFIG_CDC_ACM_SERIAL_PRODUCT_STRING="Zephyr HCI UART sample"
```

## samples/bluetooth/hci_uart/boards/nrf52dk_nrf52832_low_lat.conf
```kconfig
CONFIG_CONSOLE=n
CONFIG_STDOUT_CONSOLE=n
CONFIG_UART_CONSOLE=n
CONFIG_GPIO=y
CONFIG_SERIAL=y
CONFIG_UART_INTERRUPT_DRIVEN=y
CONFIG_BT=y
CONFIG_BT_HCI_RAW=y
CONFIG_BT_HCI_RAW_H4=y
CONFIG_BT_HCI_RAW_H4_ENABLE=y
CONFIG_BT_MAX_CONN=16
CONFIG_BT_TINYCRYPT_ECC=n

CONFIG_SYSTEM_WORKQUEUE_STACK_SIZE=512

# Workaround: Unable to allocate command buffer when using K_NO_WAIT since
# Host number of completed commands does not follow normal flow control.
CONFIG_BT_BUF_CMD_TX_COUNT=10

# CONFIG_BT_BUF_EVT_RX_COUNT=16

CONFIG_BT_BUF_EVT_RX_SIZE=255
CONFIG_BT_BUF_ACL_RX_SIZE=255
CONFIG_BT_BUF_ACL_TX_SIZE=251
CONFIG_BT_BUF_CMD_TX_SIZE=255

# CONFIG_BT_EXT_ADV=y
# CONFIG_BT_PER_ADV=y
# CONFIG_BT_PER_ADV_SYNC=y

CONFIG_BT_CTLR_ASSERT_HANDLER=y
CONFIG_BT_CTLR_DTM_HCI=y

# CONFIG_BT_CTLR_RX_BUFFERS=9
CONFIG_BT_CTLR_DATA_LENGTH_MAX=251

# CONFIG_BT_CTLR_ADV_SET=2
# CONFIG_BT_CTLR_ADV_DATA_LEN_MAX=191
# CONFIG_BT_CTLR_SCAN_DATA_LEN_MAX=1650

CONFIG_BT_CTLR_ADVANCED_FEATURES=y
# CONFIG_BT_CTLR_ADV_AUX_SET=2
# CONFIG_BT_CTLR_ADV_SYNC_SET=2
# CONFIG_BT_CTLR_ADV_DATA_BUF_MAX=6

# CONFIG_BT_CTLR_SCAN_AUX_SET=2
# CONFIG_BT_CTLR_SCAN_UNRESERVED=y
# CONFIG_BT_TICKER_NEXT_SLOT_GET_MATCH=y

# Low Latency configuration
CONFIG_BT_CTLR_LLL_PRIO=0
CONFIG_BT_CTLR_ULL_HIGH_PRIO=0
CONFIG_BT_CTLR_ULL_LOW_PRIO=0
CONFIG_BT_CTLR_LOW_LAT=y
CONFIG_BT_CTLR_LOW_LAT_ULL=y
CONFIG_BT_CTLR_LOW_LAT_ULL_DONE=y
# CONFIG_BT_CTLR_RADIO_ENABLE_FAST=n
# CONFIG_BT_CTLR_TIFS_HW=y
CONFIG_BT_TICKER_EXT=n
CONFIG_BT_TICKER_LOW_LAT=y
```

## samples/bluetooth/hci_uart/boards/nrf5340dk_nrf5340_cpuapp.conf
```kconfig
# Host and Controller common dependencies
CONFIG_BT_EXT_ADV=y
CONFIG_BT_PER_ADV=y
CONFIG_BT_PER_ADV_SYNC=y
CONFIG_BT_PER_ADV_SYNC_MAX=2

# Broadcast and Connected ISO
CONFIG_BT_ISO_BROADCASTER=y
CONFIG_BT_ISO_SYNC_RECEIVER=y
CONFIG_BT_ISO_CENTRAL=y
CONFIG_BT_ISO_PERIPHERAL=y

# ISO Streams
CONFIG_BT_ISO_MAX_CHAN=4
CONFIG_BT_ISO_TX_BUF_COUNT=18
CONFIG_BT_ISO_RX_BUF_COUNT=1
```

## samples/bluetooth/hci_uart/boards/nrf5340pdk_nrf5340_cpuapp.conf
```kconfig
CONFIG_GPIO=y
CONFIG_MAIN_STACK_SIZE=1024
CONFIG_SYSTEM_WORKQUEUE_STACK_SIZE=512
CONFIG_BT_MAX_CONN=16
CONFIG_BT_TINYCRYPT_ECC=n
CONFIG_BT_CTLR_DTM_HCI=y
CONFIG_BT_CTLR_ASSERT_HANDLER=y
```

## samples/bluetooth/hci_uart/boards/nrf9160dk_nrf52840.conf
```kconfig
# Override prj.conf defaults
CONFIG_CONSOLE=y
CONFIG_STDOUT_CONSOLE=y
CONFIG_UART_CONSOLE=y
```

## samples/bluetooth/hci_uart/boards/rv32m1_vega_ri5cy.conf
```kconfig
#
# Copyright 2020, NXP
#
# SPDX-License-Identifier: Apache-2.0
#

CONFIG_UART_INTERRUPT_DRIVEN=y
```

## samples/bluetooth/hci_uart/boards/yd_esp32_procpu.conf
```kconfig
CONFIG_CONSOLE=y
CONFIG_STDOUT_CONSOLE=y
CONFIG_UART_CONSOLE=y
CONFIG_BT_MAX_CONN=9
```

## samples/bluetooth/hci_uart/sample.yaml
```yaml
sample:
  name: Bluetooth HCI UART
  description: Allows Zephyr to provide Bluetooth connectivity via UART
tests:
  sample.bluetooth.hci_uart.nrf5:
    harness: bluetooth
    platform_allow:
      - nrf52dk/nrf52832
      - nrf52840dk/nrf52840
      - nrf21540dk/nrf52840
    integration_platforms:
      - nrf52dk/nrf52832
      - nrf52840dk/nrf52840
      - nrf21540dk/nrf52840
    tags:
      - uart
      - bluetooth
  sample.bluetooth.hci_uart.nrf52833.df:
    harness: bluetooth
    platform_allow: nrf52833dk/nrf52833
    integration_platforms:
      - nrf52833dk/nrf52833
    extra_args:
      - DTC_OVERLAY_FILE=./boards/nrf52833dk_nrf52833_df.overlay
      - SNIPPET="bt-ll-sw-split"
    extra_configs:
      - CONFIG_BT_CTLR_DF=y
    tags:
      - uart
      - bluetooth
  sample.bluetooth.hci_uart.nrf5340_netcore.df:
    harness: bluetooth
    platform_allow: nrf5340dk/nrf5340/cpunet
    extra_args:
      - DTC_OVERLAY_FILE=./boards/nrf5340dk_nrf5340_cpunet_df.overlay
      - SNIPPET="bt-ll-sw-split"
    extra_configs:
      - CONFIG_BT_CTLR_DF=y
    tags:
      - uart
      - bluetooth
  sample.bluetooth.hci_uart.nrf52833.df.iq_report:
    harness: bluetooth
    platform_allow: nrf52833dk/nrf52833
    integration_platforms:
      - nrf52833dk/nrf52833
    extra_args:
      - DTC_OVERLAY_FILE=./boards/nrf52833dk_nrf52833_df.overlay
      - SNIPPET="bt-ll-sw-split"
    extra_configs:
      - CONFIG_BT_CTLR_DF=y
      - CONFIG_BT_CTLR_DTM_HCI_DF_IQ_REPORT=y
    tags:
      - uart
      - bluetooth
  sample.bluetooth.hci_uart.nrf5340_netcore.df.iq_report:
    harness: bluetooth
    platform_allow: nrf5340dk/nrf5340/cpunet
    extra_args:
      - DTC_OVERLAY_FILE=./boards/nrf5340dk_nrf5340_cpunet_df.overlay
      - SNIPPET="bt-ll-sw-split"
    extra_configs:
      - CONFIG_BT_CTLR_DF=y
      - CONFIG_BT_CTLR_DTM_HCI_DF_IQ_REPORT=y
    tags:
      - uart
      - bluetooth
  sample.bluetooth.hci_uart.nrf5340dk_cpuapp:
    harness: bluetooth
    platform_allow:
      - nrf5340dk/nrf5340/cpuapp
    integration_platforms:
      - nrf5340dk/nrf5340/cpuapp
    tags:
      - uart
      - bluetooth
  sample.bluetooth.hci_uart.nrf5340_audio_dk_cpuapp.fem:
    harness: bluetooth
    platform_allow:
      - nrf5340_audio_dk/nrf5340/cpuapp
    integration_platforms:
      - nrf5340_audio_dk/nrf5340/cpuapp
    extra_args: DTC_OVERLAY_FILE=./boards/nrf5340_audio_dk_nrf5340_cpuapp_nrf21540_ek.overlay
    tags:
      - uart
      - bluetooth
  sample.bluetooth.hci_uart.nrf52833.all:
    harness: bluetooth
    platform_allow: nrf52833dk/nrf52833
    integration_platforms:
      - nrf52833dk/nrf52833
    extra_args:
      - EXTRA_CONF_FILE=overlay-all-bt_ll_sw_split.conf
      - DTC_OVERLAY_FILE=./boards/nrf52833dk_nrf52833_df.overlay
      - SNIPPET="bt-ll-sw-split"
    tags:
      - uart
      - bluetooth
  sample.bluetooth.hci_uart.nrf54l15.all:
    harness: bluetooth
    platform_allow: nrf54l15dk/nrf54l15/cpuapp
    integration_platforms:
      - nrf54l15dk/nrf54l15/cpuapp
    extra_args:
      - EXTRA_CONF_FILE=overlay-all-bt_ll_sw_split.conf
      - DTC_OVERLAY_FILE=./boards/nrf54l15dk_nrf54l15_cpuapp_df.overlay
      - SNIPPET="bt-ll-sw-split"
    tags:
      - uart
      - bluetooth
```

## samples/bluetooth/hci_uart_3wire/boards/bbc_microbit.conf
```kconfig
CONFIG_MAIN_STACK_SIZE=512
CONFIG_IDLE_STACK_SIZE=256
CONFIG_ISR_STACK_SIZE=512
CONFIG_BT_MAX_CONN=10
# Revert values set in prj.conf, set them to their Kconfig default value
CONFIG_BT_BUF_CMD_TX_SIZE=65
CONFIG_BT_BUF_ACL_RX_SIZE=69
CONFIG_BT_BUF_EVT_DISCARDABLE_SIZE=43
```

## samples/bluetooth/hci_uart_3wire/boards/nrf52840dongle_nrf52840.conf
```kconfig
CONFIG_USB_DEVICE_STACK=y
CONFIG_USB_DEVICE_PRODUCT="Zephyr HCI UART 3Wire sample"
CONFIG_USB_CDC_ACM=y
CONFIG_USB_DEVICE_INITIALIZE_AT_BOOT=n
```

## samples/bluetooth/hci_uart_async/Kconfig
```kconfig
# HCI over Asynchronous UART sample configuration

# Copyright (c) 2020 Nordic Semiconductor ASA
# SPDX-License-Identifier: Apache-2.0

menu "HCI over UART asynchronous"

config BT_HCI_UART_ASYNC_RX_POOL_BUF_SIZE
	int "Single buffer size in the RX pool"
	default 64
	help
	  If UART is using DMA with double buffering it may be even possible to not
	  use HW flow control by increasing buffer size.

config BT_HCI_UART_ASYNC_RX_POOL_BUF_COUNT
	int "Number of buffers in the RX pool"
	default 3

endmenu

menu "Zephyr Kernel"
source "Kconfig.zephyr"
endmenu
```

## samples/bluetooth/hci_uart_async/boards/nrf52840dk_nrf52840.conf
```kconfig
CONFIG_GPIO=y
CONFIG_MAIN_STACK_SIZE=1024
CONFIG_SYSTEM_WORKQUEUE_STACK_SIZE=512
CONFIG_BT_MAX_CONN=16
CONFIG_BT_TINYCRYPT_ECC=n
CONFIG_BT_CTLR_DTM_HCI=y
CONFIG_BT_CTLR_ASSERT_HANDLER=y

CONFIG_UART_ASYNC_API=y
CONFIG_UART_1_ASYNC=y
CONFIG_UART_1_NRF_HW_ASYNC=y
CONFIG_UART_1_NRF_HW_ASYNC_TIMER=2
CONFIG_NRFX_TIMER2=y
CONFIG_BT_CTLR_TO_HOST_UART_DEV_NAME="UART_1"
```

## samples/bluetooth/hci_uart_async/sample.yaml
```yaml
sample:
  name: Bluetooth HCI UART Async
  description:
    This sample is a batteries-included example of a Bluetooth HCI UART
    connectivity chip.

    It demonstrates a possible implementation of an HCI UART (H4)
    interface on top of Zephyr's Bluetooth Raw API, and how to expose it
    over a UART.

    This implementation is based on the Zephyr Asynchoronous UART API.
tests:
  sample.bluetooth.hci_uart_async.nrf5:
    harness: bluetooth
    platform_allow:
      - nrf52dk_nrf52832
    tags:
      - uart
      - bluetooth
```

## samples/bluetooth/hci_usb/boards/nrf54h20dk_nrf54h20_cpuapp.conf
```kconfig
# Power up CPURAD
CONFIG_SOC_NRF54H20_CPURAD_ENABLE=y

# We are only using full-speed, disable including high-speed implementation
CONFIG_UDC_DRIVER_HIGH_SPEED_SUPPORT_ENABLED=n

# Enable Power Management for nRF54H20
CONFIG_PM=y

# USB Product Name
CONFIG_SAMPLE_USBD_PRODUCT="Zephyr nRF54H20DK USBD BT HCI"
```

## samples/bluetooth/hci_usb/sample.yaml
```yaml
sample:
  name: Bluetooth over USB sample
tests:
  sample.bluetooth.hci_usb:
    harness: bluetooth
    depends_on:
      - usbd
      - ble
    tags:
      - usb
      - bluetooth
```

## samples/bluetooth/hci_usb_h4/Kconfig
```kconfig
# Copyright (c) 2019 Nordic Semiconductor ASA
# SPDX-License-Identifier: Apache-2.0

config USB_DEVICE_PID
	default USB_PID_BLE_HCI_H4_SAMPLE

source "Kconfig.zephyr"
```

## samples/bluetooth/hci_usb_h4/sample.yaml
```yaml
sample:
  name: Bluetooth over USB sample
tests:
  sample.bluetooth.hci_usb_h4:
    harness: bluetooth
    depends_on:
      - usb_device
      - ble
    tags:
      - usb
      - bluetooth
    # FIXME: exclude due to build error
    platform_exclude: 96b_carbon/stm32f401xe stm32l562e_dk
```

## samples/bluetooth/hci_vs_scan_req/sample.yaml
```yaml
sample:
  name: Bluetooth HCI Vendor-Specific Scan Request
tests:
  sample.bluetooth.hci_vs_scan_req:
    harness: bluetooth
    platform_allow:
      - nrf52dk/nrf52832
    integration_platforms:
      - nrf52dk/nrf52832
    extra_configs:
      - CONFIG_BT_LL_SW_SPLIT=y
    tags: bluetooth
```

## samples/bluetooth/hearing_aid/boards/nrf5340_audio_dk_nrf5340_cpuapp.conf
```kconfig
###     Bluetoooth      ###
# Not supported on Packetcraft controller
CONFIG_BT_ATT_ENFORCE_FLOW=n
# Disable Zephyr HCI Vendor-Specific extensions
CONFIG_BT_HCI_VS_EXT=n

###     Debugging       ###
CONFIG_USE_SEGGER_RTT=y
CONFIG_BT_DEBUG_MONITOR_RTT=y

###     Logging         ###
CONFIG_LOG=y
CONFIG_LOG_BACKEND_RTT=n

###     Audio   ###
CONFIG_I2S=y
CONFIG_LIBLC3CODEC=y
```
