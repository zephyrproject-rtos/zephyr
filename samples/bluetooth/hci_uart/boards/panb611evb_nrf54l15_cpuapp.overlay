/*
 * Copyright (c) 2025 Panasonic Industrial Devices Europe GmbH
 *
 * SPDX-License-Identifier: Apache-2.0
 */

&uart30 {
	compatible = "nordic,nrf-uarte";
	current-speed = <1000000>;
	status = "okay";
	hw-flow-control;
};
