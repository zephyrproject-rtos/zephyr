/* SPDX-License-Identifier: Apache-2.0 */

&zephyr_udc0 {
    cdc_acm_uart0: cdc_acm_uart0 {
        compatible = "zephyr,cdc-acm-uart";
        label = "CDC_ACM_0";
    };
};

/ {
    chosen {
        zephyr,bt-c2h-uart = &cdc_acm_uart0;
    };
};
