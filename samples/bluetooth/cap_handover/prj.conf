## CMakeLists.txt
```
# SPDX-License-Identifier: Apache-2.0

cmake_minimum_required(VERSION 3.20.0)
find_package(Zephyr REQUIRED HINTS $ENV{ZEPHYR_BASE})
project(cap_handover)

target_sources(app PRIVATE
  src/main.c
  src/cap_stream_tx.c
)

zephyr_library_include_directories(${ZEPHYR_BASE}/samples/bluetooth)
```

## Kconfig
```
# Copyright (c) 2024 Nordic Semiconductor ASA
# SPDX-License-Identifier: Apache-2.0

mainmenu "Bluetooth: Common Audio Profile initiator sample"

config SAMPLE_STATIC_BROADCAST_ID
	bool "Use static broadcast ID"
	default y
	help
	   Enabling this option will make the application use static broadcast ID, as opposed to a
	   randomly generated one.

config SAMPLE_BROADCAST_ID
	hex "The static broadcast ID to use"
	range 0x000000 0xFFFFFF
	depends on SAMPLE_STATIC_BROADCAST_ID
	default 0x123456
	help
	   This is the 3-octet broadcast ID advertised if static broadcast IDs are enabled.

source "Kconfig.zephyr"
```

## sample.yaml
```
sample:
  description: Bluetooth Low Energy Common Audio Profile Handover sample
  name: Bluetooth Low Energy Common Audio Profile Handover sample
tests:
  sample.bluetooth.cap_handover:
    harness: bluetooth
    platform_allow:
      - qemu_cortex_m3
      - qemu_x86
      - nrf5340dk/nrf5340/cpuapp
      - nrf5340bsim/nrf5340/cpuapp
    integration_platforms:
      - qemu_x86
      - nrf5340dk/nrf5340/cpuapp
    tags: bluetooth
    sysbuild: true
  sample.bluetooth.cap_handover.bt_ll_sw_split:
    harness: bluetooth
    platform_allow:
      - nrf52_bsim
      - nrf52833dk/nrf52833
      - nrf52840dk/nrf52840
      - nrf52840dongle/nrf52840
    integration_platforms:
      - nrf52_bsim
      - nrf52833dk/nrf52833
      - nrf52840dk/nrf52840
      - nrf52840dongle/nrf52840
    extra_args: EXTRA_CONF_FILE=overlay-bt_ll_sw_split.conf
    tags: bluetooth
```

## prj.conf
```kconfig
CONFIG_LOG=y
CONFIG_ASSERT=y

CONFIG_BT=y
CONFIG_BT_BROADCASTER=y
CONFIG_BT_CENTRAL=y
CONFIG_BT_GATT_CLIENT=y
CONFIG_BT_GATT_AUTO_DISCOVER_CCC=y
CONFIG_BT_GATT_AUTO_UPDATE_MTU=y
CONFIG_BT_GATT_DYNAMIC_DB=y
CONFIG_BT_KEYS_OVERWRITE_OLDEST=y
CONFIG_BT_SMP=y
CONFIG_BT_EXT_ADV=y
CONFIG_BT_PER_ADV=y
CONFIG_BT_PER_ADV_SYNC=y
CONFIG_BT_DEVICE_NAME="CAP handover central"
CONFIG_UTF8=y
CONFIG_BT_AUDIO=y

# ISO configs
CONFIG_BT_ISO_MAX_CHAN=2
CONFIG_BT_ISO_CENTRAL=y
CONFIG_BT_ISO_BROADCASTER=y
CONFIG_BT_ISO_SYNC_RECEIVER=y

# BAP configs
CONFIG_BT_BAP_UNICAST_CLIENT=y
CONFIG_BT_BAP_UNICAST_CLIENT_GROUP_STREAM_COUNT=1
CONFIG_BT_BAP_UNICAST_CLIENT_ASE_SNK_COUNT=2

CONFIG_BT_BAP_SCAN_DELEGATOR=y

CONFIG_BT_BAP_BROADCAST_SOURCE=y
CONFIG_BT_BAP_BROADCAST_SRC_STREAM_COUNT=2
CONFIG_BT_BAP_BROADCAST_SRC_SUBGROUP_COUNT=1

CONFIG_BT_BAP_BROADCAST_ASSISTANT=y

# CAP configs
CONFIG_BT_CAP_INITIATOR=y
CONFIG_BT_CAP_COMMANDER=y
CONFIG_BT_CAP_HANDOVER=y

# CSIP configs
CONFIG_BT_CSIP_SET_COORDINATOR=y

# Relevant debug logs that can be enabled
# CONFIG_BT_CAP_INITIATOR_LOG_LEVEL_DBG=y
# CONFIG_BT_CAP_COMMANDER_LOG_LEVEL_DBG=y
# CONFIG_BT_CAP_COMMON_LOG_LEVEL_DBG=y
# CONFIG_BT_CAP_HANDOVER_LOG_LEVEL_DBG=y
# CONFIG_BT_BAP_BROADCAST_ASSISTANT_LOG_LEVEL_DBG=y
# CONFIG_BT_BAP_STREAM_LOG_LEVEL_DBG=y
```

## overlay-bt_ll_sw_split.conf
```kconfig
# Zephyr Bluetooth Controller
CONFIG_BT_LL_SW_SPLIT=y
CONFIG_ISR_TABLES_LOCAL_DECLARATION=y
CONFIG_LTO=y

CONFIG_BT_MAX_CONN=1
CONFIG_BT_BROADCASTER=y
CONFIG_BT_OBSERVER=y
CONFIG_BT_EXT_ADV=y
CONFIG_BT_PER_ADV=y
CONFIG_BT_PER_ADV_SYNC=y
CONFIG_BT_CENTRAL=y
CONFIG_BT_MAX_CONN=1
CONFIG_BT_CTLR_PHY_CODED=y

# Zephyr Controller tested maximum advertising data that can be set in a single HCI command
CONFIG_BT_CTLR_SCAN_DATA_LEN_MAX=191
CONFIG_BT_CTLR_ADV_DATA_LEN_MAX=191

CONFIG_BT_ISO_BROADCASTER=y
CONFIG_BT_ISO_SYNC_RECEIVER=y
CONFIG_BT_ISO_CENTRAL=y
CONFIG_BT_ISO_TX_MTU=310
CONFIG_BT_ISO_RX_MTU=310
CONFIG_BT_ISO_MAX_CHAN=2

CONFIG_BT_CTLR_ADV_ISO_STREAM_COUNT=2
CONFIG_BT_CTLR_CONN_ISO_GROUPS=1
CONFIG_BT_CTLR_CONN_ISO_STREAMS=2
CONFIG_BT_CTLR_CONN_ISO_STREAMS_PER_GROUP=2

# In theory, CONFIG_BT_ISO_TX_BUF_COUNT=1, should be sufficient but this count
# is used in the context of IPC which falls into a "Newton's Cradle" effect
# where probably (CONFIG_BT_CTLR_ISO_TX_BUFFERS - CONFIG_BT_ISO_TX_BUF_COUNT)
# buffers get throttled. Hence, always have the value equal or greater.
CONFIG_BT_ISO_TX_BUF_COUNT=12
CONFIG_BT_ISO_RX_BUF_COUNT=1

# Support the highest SDU size required by any BAP LC3 presets (310) + 8 bytes of HCI ISO Data
# packet overhead (the Packet_Sequence_Number, ISO_SDU_Length, Packet_Status_Flag fields; and
# the optional Time_Stamp field, if supplied)
CONFIG_BT_CTLR_ISO_TX_BUFFER_SIZE=318
CONFIG_BT_CTLR_ISO_TX_SDU_LEN_MAX=310
```

## src/cap_initiator.h
```c
/*
 * Copyright (c) 2025 Nordic Semiconductor ASA
 *
 * SPDX-License-Identifier: Apache-2.0
 */
#include <stdint.h>

#include <zephyr/bluetooth/audio/bap.h>
#include <zephyr/bluetooth/audio/cap.h>
#include <zephyr/bluetooth/conn.h>

struct tx_stream {
	struct bt_cap_stream *stream;
	uint16_t seq_num;
};

/**
 * @brief Initialize TX
 *
 * This will initialize TX if not already initialized. This creates and starts a thread that
 * will attempt to send data on all streams registered with cap_initiator_tx_register_stream().
 */
void cap_initiator_tx_init(void);

/**
 * @brief Register a stream for TX
 *
 * This will add it to the list of streams the TX thread will attempt to send on.
 *
 * @retval 0 on success
 * @retval -EINVAL if @p cap_stream is NULL
 * @retval -ENOMEM if not more streams can be registered
 */
int cap_initiator_tx_register_stream(struct bt_cap_stream *cap_stream);

/**
 * @brief Unregister a stream for TX
 *
 * This will remove it to the list of streams the TX thread will attempt to send on.
 *
 * @retval 0 on success
 * @retval -EINVAL if @p cap_stream is NULL
 * @retval -EALREADY if the stream is currently not registered
 */
int cap_initiator_tx_unregister_stream(struct bt_cap_stream *cap_stream);
```

## src/cap_stream_tx.c
```c
/*
 * Copyright (c) 2025 Nordic Semiconductor ASA
 *
 * SPDX-License-Identifier: Apache-2.0
 */

#include <errno.h>
#include <stdbool.h>
#include <stddef.h>
#include <stdint.h>

#include <zephyr/autoconf.h>
#include <zephyr/bluetooth/audio/cap.h>
#include <zephyr/bluetooth/audio/bap.h>
#include <zephyr/bluetooth/bluetooth.h>
#include <zephyr/bluetooth/iso.h>
#include <zephyr/kernel.h>
#include <zephyr/kernel/thread_stack.h>
#include <zephyr/logging/log.h>
#include <zephyr/logging/log_core.h>
#include <zephyr/net_buf.h>
#include <zephyr/sys/__assert.h>
#include <zephyr/sys/byteorder.h>
#include <zephyr/sys/util.h>
#include <zephyr/sys/util_macro.h>
#include <zephyr/types.h>

#include "cap_stream_tx.h"

LOG_MODULE_REGISTER(cap_stream_tx, LOG_LEVEL_INF);

/** Mutex to prevent race conditions as the values are accessed by multiple threads */
#define TX_MUTEX_TIMEOUT K_MSEC(1000)
static K_MUTEX_DEFINE(tx_mutex);

struct tx_stream tx_streams[CAP_STREAM_TX_MAX];

static void tx_thread_func(void *arg1, void *arg2, void *arg3)
{
	NET_BUF_POOL_FIXED_DEFINE(tx_pool, CONFIG_BT_ISO_TX_BUF_COUNT,
				  BT_ISO_SDU_BUF_SIZE(CONFIG_BT_ISO_TX_MTU),
				  CONFIG_BT_CONN_TX_USER_DATA_SIZE, NULL);
	static uint8_t data[CONFIG_BT_ISO_TX_MTU];

	for (size_t i = 0U; i < ARRAY_SIZE(data); i++) {
		data[i] = (uint8_t)i;
	}

	while (true) {
		bool retry = true;
		int err;

		err = k_mutex_lock(&tx_mutex, K_FOREVER);
		__ASSERT(err == 0, "k_mutex_lock failed with %d", err);

		for (size_t i = 0U; i < ARRAY_SIZE(tx_streams); i++) {
			const struct bt_bap_stream *bap_stream;
			struct bt_cap_stream *cap_stream;
			struct net_buf *buf;

			cap_stream = tx_streams[i].stream;
			if (cap_stream == NULL) {
				continue;
			}

			bap_stream = &cap_stream->bap_stream;

			/* No-op if stream is not configured */
			if (bap_stream->ep == NULL) {
				continue;
			}

			buf = net_buf_alloc(&tx_pool, TX_MUTEX_TIMEOUT);
			if (buf == NULL) {
				LOG_WRN("Failed to allocate buffer");
				break;
			}

			net_buf_reserve(buf, BT_ISO_CHAN_SEND_RESERVE);

			net_buf_add_mem(buf, data, bap_stream->qos->sdu);

			err = bt_cap_stream_send(cap_stream, buf, tx_streams[i].seq_num);
			if (err == 0) {
				tx_streams[i].seq_num++;
				retry = false;
			} else {
				/* -EBADMSG may be returned if the stream has disconnected, which is
				 * a valid case that we can handle
				 */
				if (err != -EBADMSG) {
					LOG_ERR("Unable to send: %d", err);
				}
				net_buf_unref(buf);
			}
		}

		err = k_mutex_unlock(&tx_mutex);
		__ASSERT(err == 0, "Failed to unlock mutex: %d", err);

		if (retry) {
			/* In case of any errors or nothing sent, retry with a delay */
			k_sleep(K_MSEC(100));
		}
	}
}

int cap_stream_tx_register_stream(struct bt_cap_stream *cap_stream)
{
	int ret;
	int err;

	if (cap_stream == NULL) {
		return -EINVAL;
	}

	err = k_mutex_lock(&tx_mutex, TX_MUTEX_TIMEOUT);
	if (err != 0) {
		LOG_ERR("Failed to take mutex: %d", err);
		return err;
	}

	ret = -ENOMEM;
	for (size_t i = 0U; i < ARRAY_SIZE(tx_streams); i++) {
		if (tx_streams[i].stream == NULL) {
			tx_streams[i].stream = cap_stream;
			tx_streams[i].seq_num = 0U;
			ret = 0;

			break;
		}
	}

	err = k_mutex_unlock(&tx_mutex);
	__ASSERT(err == 0, "Failed to unlock mutex: %d", err);

	return ret;
}

int cap_stream_tx_unregister_stream(struct bt_cap_stream *cap_stream)
{
	int ret;
	int err;

	if (cap_stream == NULL) {
		return -EINVAL;
	}

	err = k_mutex_lock(&tx_mutex, TX_MUTEX_TIMEOUT);
	if (err != 0) {
		LOG_ERR("Failed to take mutex: %d", err);
		return err;
	}

	ret = -ENOENT;
	for (size_t i = 0U; i < ARRAY_SIZE(tx_streams); i++) {
		if (tx_streams[i].stream == cap_stream) {
			tx_streams[i].stream = NULL;

			ret = 0;
			break;
		}
	}

	err = k_mutex_unlock(&tx_mutex);
	__ASSERT(err == 0, "Failed to unlock mutex: %d", err);

	return ret;
}

void cap_stream_tx_init(void)
{
	static bool thread_started;

	if (!thread_started) {
		static K_KERNEL_STACK_DEFINE(tx_thread_stack, 1024);
		const int tx_thread_prio = K_PRIO_PREEMPT(5);
		static struct k_thread tx_thread;

		k_thread_create(&tx_thread, tx_thread_stack, K_KERNEL_STACK_SIZEOF(tx_thread_stack),
				tx_thread_func, NULL, NULL, NULL, tx_thread_prio, 0, K_NO_WAIT);
		k_thread_name_set(&tx_thread, "TX thread");
		thread_started = true;
	}
}
```

## src/cap_stream_tx.h
```c
/*
 * Copyright (c) 2025 Nordic Semiconductor ASA
 *
 * SPDX-License-Identifier: Apache-2.0
 */
#include <stdint.h>

#include <zephyr/autoconf.h>
#include <zephyr/bluetooth/audio/bap.h>
#include <zephyr/bluetooth/audio/cap.h>
#include <zephyr/bluetooth/conn.h>
#include <zephyr/kernel.h>
#include <zephyr/sys/util.h>

/* Number of streams we support
 * If this value is > 1, then we may not always be able to perform the handover.
 * For example if the remote device supports 2 unicast sink streams, but only 1 broadcast sink
 * stream, then the handover procedure cannot be performed.
 */
#define CAP_STREAM_TX_MAX                                                                          \
	(MIN(CONFIG_BT_BAP_UNICAST_CLIENT_ASE_SNK_COUNT, CONFIG_BT_BAP_BROADCAST_SRC_STREAM_COUNT))

struct tx_stream {
	/** Reference to a stream */
	struct bt_cap_stream *stream;

	/** The last sent sequence number */
	uint16_t seq_num;
};

/**
 * @brief Initialize TX
 *
 * This will initialize TX if not already initialized. This creates and starts a thread that
 * will attempt to send data on all streams registered with cap_stream_tx_register_stream().
 */
void cap_stream_tx_init(void);

/**
 * @brief Register a stream for TX
 *
 * This will add it to the list of streams the TX thread will attempt to send on.
 *
 * @retval 0 on success
 * @retval -EINVAL if @p cap_stream is NULL
 * @retval -ENOMEM if not more streams can be registered
 */
int cap_stream_tx_register_stream(struct bt_cap_stream *cap_stream);

/**
 * @brief Unregister a stream for TX
 *
 * This will remove it to the list of streams the TX thread will attempt to send on.
 *
 * @retval 0 on success
 * @retval -EINVAL if @p cap_stream is NULL
 * @retval -EALREADY if the stream is currently not registered
 */
int cap_stream_tx_unregister_stream(struct bt_cap_stream *cap_stream);
```
