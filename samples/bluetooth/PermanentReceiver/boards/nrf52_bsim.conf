## samples/bluetooth/a2dp_sink/Kconfig
```kconfig
# Private config options for a2dp sink sample

# Copyright (c) 2024 NXP
# SPDX-License-Identifier: Apache-2.0

mainmenu "bluetooth a2dp sink sample application"

config A2DP_SINK_STREAM_VIRTUAL_CODEC
	bool "use actual codec or not"
	help
	  false means no codec to play audio stream, true means to use the actual codec (like: WM8960).

source "Kconfig.zephyr"
```

## samples/bluetooth/a2dp_source/sample.yaml
```yaml
sample:
  name: Bluetooth A2dp Source
tests:
  sample.bluetooth.a2dp_source:
    harness: bluetooth
    platform_allow: mimxrt1060_evk
    tags: bluetooth
```

## samples/bluetooth/aoa_receiver_multiple/sample.yaml
```yaml
sample:
  name: Direction Finding Connectionless Locator
tests:
  sample.bluetooth.direction_finding_connectionless_rx:
    harness: bluetooth
    platform_allow: nrf52833dk_nrf52833
    tags: bluetooth
  sample.bluetooth.direction_finding_connectionless_rx.aod:
    extra_args: OVERLAY_CONFIG="overlay-aod.conf"
    platform_allow: nrf52833dk_nrf52833
```

## samples/bluetooth/audio/bap_broadcast_sink/boards/nrf52833dk_nrf52833.conf
```kconfig
# Have Extended Advertising in the background
CONFIG_SCAN_OFFLOAD=n
CONFIG_SCAN_SELF=y
CONFIG_SCAN_BACKGROUND=y

# Enable Full Extended Scanning
CONFIG_BT_EXT_SCAN_BUF_SIZE=1650

# Zephyr Bluetooth LE Controller needs 16 event buffers to generate Extended
# Advertising Report for receiving the complete 1650 bytes of data
CONFIG_BT_BUF_EVT_RX_COUNT=16

CONFIG_BT_LOG_SNIFFER_INFO=y

CONFIG_THREAD_ANALYZER=y
CONFIG_THREAD_ANALYZER_AUTO=y
CONFIG_THREAD_ANALYZER_AUTO_INTERVAL=5
CONFIG_THREAD_NAME=y

CONFIG_LOG=y
CONFIG_LOG_BUFFER_SIZE=4096
```

## samples/bluetooth/audio/bap_broadcast_sink/boards/nrf52840dongle_nrf52840.conf
```kconfig
# Use USB Audio as audio sink
CONFIG_USE_USB_AUDIO_OUTPUT=y
CONFIG_SAMPLE_USBD_PRODUCT="USB Broadcast Sink sample"

CONFIG_BOARD_SERIAL_BACKEND_CDC_ACM=n
```

## samples/bluetooth/audio/bap_broadcast_sink/boards/nrf52_bsim_native.conf
```kconfig
# Have Extended Advertising in the background
CONFIG_SCAN_OFFLOAD=y
CONFIG_SCAN_SELF=y
CONFIG_SCAN_BACKGROUND=y

# Enable Full Extended Scanning
CONFIG_BT_EXT_SCAN_BUF_SIZE=1650

# Zephyr Bluetooth LE Controller needs 16 event buffers to generate Extended
# Advertising Report for receiving the complete 1650 bytes of data
CONFIG_BT_BUF_EVT_RX_COUNT=16

CONFIG_CLOCK_CONTROL_NRF_K32SRC_100PPM=y

CONFIG_BT_LOG_SNIFFER_INFO=y
```

## samples/bluetooth/audio/bap_broadcast_sink/boards/nrf54h20dk_nrf54h20_cpuapp.conf
```kconfig
# Use USB Audio as audio sink
CONFIG_USE_USB_AUDIO_OUTPUT=y
CONFIG_SAMPLE_USBD_PRODUCT="USB Broadcast Sink nRF54H20DK"

# We are only using full-speed, disable including high-speed implementation
CONFIG_UDC_DRIVER_HIGH_SPEED_SUPPORT_ENABLED=n

# Increase main stack needed
CONFIG_MAIN_STACK_SIZE=2048

# Enable Power Management for nRF54H20
CONFIG_PM=y
```

## samples/bluetooth/audio/bap_broadcast_sink/boards/sf32lb52_devkit_lcd.conf
```kconfig
# Use Codec Audio as output for sf32lb52_devkit_lcd board
CONFIG_USE_CODEC_AUDIO_OUTPUT=y
CONFIG_HEAP_MEM_POOL_SIZE=32000
CONFIG_AUDIO=y
CONFIG_AUDIO_CODEC=y
```

## samples/bluetooth/audio/bap_broadcast_source/boards/nrf5340dk_nrf5340_cpuapp.conf
```kconfig
# Use USB Audio as audio source
CONFIG_USE_USB_AUDIO_INPUT=y
CONFIG_SAMPLE_USBD_PRODUCT="USB Broadcast Source sample"

CONFIG_BAP_BROADCAST_48_2_1=y
```

## samples/bluetooth/audio/bap_broadcast_source/boards/nrf54lm20dk_nrf54lm20a_cpuapp.conf
```kconfig
# Use USB Audio as audio source
CONFIG_USE_USB_AUDIO_INPUT=y
CONFIG_SAMPLE_USBD_PRODUCT="USB Broadcast Audio nRF54LM20DK"

CONFIG_BAP_BROADCAST_48_2_1=y

# app.overlay has USB full-speed enabled, let us not have high-speed support
# implementation included in the build.
CONFIG_UDC_DRIVER_HIGH_SPEED_SUPPORT_ENABLED=n
```

## samples/bluetooth/audio/bap_unicast_client/Kconfig
```kconfig
# Copyright (c) 2025 Nordic Semiconductor ASA
# SPDX-License-Identifier: Apache-2.0

mainmenu "Bluetooth: BAP Unicast Client"

config INFO_REPORTING_INTERVAL
	int "Number of SDUs received between each information report"
	default 1000
	help
	  Determines how often information about received data is logged.
	  Set to 0 to disable reporting.

config ISO_PACKING_INTERLEAVED
	bool "Use interleaved packing"
	help
	  Use interleaved packing between CIS ISO stream subevents.

source "Kconfig.zephyr"
```

## samples/bluetooth/audio/bap_unicast_client/boards/nrf5340dk_nrf5340_cpuapp.conf
```kconfig
# For LC3 the following configs are needed
CONFIG_FPU=y
CONFIG_LIBLC3=y
# The LC3 codec uses a large amount of stack. This app runs the codec in the work-queue, hence
# inctease stack size for that thread.
CONFIG_SYSTEM_WORKQUEUE_STACK_SIZE=4096

CONFIG_BT_BUF_EVT_RX_SIZE=255
CONFIG_BT_BUF_ACL_RX_SIZE=255
CONFIG_BT_BUF_ACL_TX_SIZE=251
CONFIG_BT_BUF_CMD_TX_SIZE=255
```

## samples/bluetooth/audio/hap_ha/Kconfig
```kconfig
#
# Copyright (c) 2022 Codecoup
#
# SPDX-License-Identifier: Apache-2.0
#

mainmenu "Bluetooth: Hearing Aid"

menu "Zephyr"
source "Kconfig.zephyr"
endmenu

menu "Hearing Aid"

config HAP_HA_SET_RANK
	int "Device rank in set"
	depends on BT_CSIP_SET_MEMBER
	range 1 2
	help
	  Rank of this device in set.

choice HAP_HA_HEARING_AID_TYPE_CHOICE
	prompt "Hearing Aid Type selection"
	help
	  Select the Hearing Aid Type to compile.

config HAP_HA_HEARING_AID_MONAURAL
	bool "Monaural Hearing Aid"

config HAP_HA_HEARING_AID_BINAURAL
	depends on BT_CSIP_SET_MEMBER
	bool "Binaural Hearing Aid"

config HAP_HA_HEARING_AID_BANDED
	bool "Banded Hearing Aid"

endchoice # HAP_HA_HEARING_AID_TYPE_CHOICE

choice HAP_HA_HEARING_AID_LOCATION
	prompt "Hearing Aid Device Location"
	help
	  Select the Hearing Aid Device location.

config HAP_HA_HEARING_AID_LEFT
	bool "Left Ear"

config HAP_HA_HEARING_AID_RIGHT
	bool "Right Ear"

endchoice # HAP_HA_HEARING_AID_LOCATION

endmenu
```

## samples/bluetooth/audio/hap_ha/boards/native_sim.conf
```kconfig
CONFIG_LOG_MODE_IMMEDIATE=y

# For LE-audio at 10ms intervals we need the tick counter to occur more frequently
# than every 10 ms as each PDU for some reason takes 2 ticks to process.
CONFIG_SYS_CLOCK_TICKS_PER_SEC=1000
CONFIG_NATIVE_SIM_SLOWDOWN_TO_REAL_TIME=y
```

## samples/bluetooth/audio/pbp_public_broadcast_sink/Kconfig.sysbuild
```kconfig
# Copyright 2023 Nordic Semiconductor ASA
# SPDX-License-Identifier: Apache-2.0

source "share/sysbuild/Kconfig"

config NET_CORE_BOARD
	string
	default "nrf5340dk/nrf5340/cpunet" if "$(BOARD)" = "nrf5340dk"
	default "nrf5340_audio_dk/nrf5340/cpunet" if "$(BOARD)" = "nrf5340_audio_dk"
	default "nrf5340bsim/nrf5340/cpunet" if "$(BOARD_TARGET_STRING)" = "NRF5340BSIM_NRF5340_CPUAPP"

config NET_CORE_IMAGE_HCI_IPC
	bool "HCI IPC image on network core"
	default y
	depends on NET_CORE_BOARD != ""
```

## samples/bluetooth/audio/pbp_public_broadcast_source/Kconfig
```kconfig
# Copyright (c) 2024 Demant A/S
# SPDX-License-Identifier: Apache-2.0

mainmenu "Bluetooth: PBP Broadcast Audio Source"

config STATIC_BROADCAST_ID
	bool "Use static broadcast ID"
	default y
	help
	   Enabling this option will make the application use static broadcast ID, as opposed to a
	   randomly generated one.

config BROADCAST_ID
	hex "The static broadcast ID to use"
	range 0x000000 0xFFFFFF
	depends on STATIC_BROADCAST_ID
	help
	   This is the 3-octet broadcast ID advertised if static broadcast IDs are enabled.

source "Kconfig.zephyr"
```

## samples/bluetooth/audio/tmap_bmr/sample.yaml
```yaml
sample:
  description: Bluetooth Low Energy Audio TMAP BMR sample
  name: Bluetooth Low Energy Audio TMAP BMR sample
tests:
  sample.bluetooth.audio.tmap_bmr:
    harness: bluetooth
    platform_allow:
      - qemu_cortex_m3
      - qemu_x86
      - native_sim
    tags: bluetooth
    integration_platforms:
      - qemu_cortex_m3
```

## samples/bluetooth/bap_broadcast_assistant/sample.yaml
```yaml
sample:
  description: Bluetooth Low Energy Broadcast Assistant sample
  name: Bluetooth Low Energy Broadcast Assistant sample
tests:
  sample.bluetooth.bap_broadcast_assistant:
    harness: bluetooth
    platform_allow:
      - nrf52840dk/nrf52840
    integration_platforms:
      - nrf52840dk/nrf52840
    tags: bluetooth
```

## samples/bluetooth/bap_broadcast_sink/Kconfig
```kconfig
# Copyright (c) 2022 Nordic Semiconductor ASA
# SPDX-License-Identifier: Apache-2.0

mainmenu "Bluetooth: Broadcast Audio Sink"

config SCAN_OFFLOAD
	bool "Whether to wait for a Broadcast Assistant"
	default y
	# enable PAST support if we can
	select BT_PER_ADV_SYNC_TRANSFER_RECEIVER if !BT_CTLR || BT_CTLR_SYNC_TRANSFER_RECEIVER_SUPPORT
	help
	  If set to true, the sample will start advertising connectable for
	  Broadcast Assistants.

config SCAN_SELF
	bool "Whether to scan for Broadcast Sources without Broadcast Assistant"
	default y
	help
	  If set to true, the sample will start scanning for Broadcast Sources
	  without waiting for a Broadcast Assistant to connect.

config SCAN_DELAY
	int "Delay before starting scan (in seconds)"
	range 0 255
	default 10
	depends on SCAN_SELF
	help
	  Time to advertise connectable for a Broadcast Assistant to connect
	  before starting scanning for Broadcast Sources.

config TARGET_BROADCAST_NAME
	string "Target Broadcast Device Name"
	default ""
	help
	  Name of target broadcast device. If not empty string, sink device
	  will only listen to the specified broadcast source. Not case sensitive.

config MAX_CODEC_FRAMES_PER_SDU
	int "The maximum number of codec frame per SDU supported"
	default 1
	range 1 255
	help
	  Maximum number of codec frames per SDU supported by this device. Increasing this value
	  allows support for a greater variaty of broadcasts, but also increases memory usage.

config ENABLE_LC3
	bool "Enable the LC3 codec"
	# By default let's enable it in the platforms we know are capable of supporting it
	default y
	depends on CPU_HAS_FPU && \
		(ARCH_POSIX || SOC_COMPATIBLE_NRF52X || SOC_COMPATIBLE_NRF5340_CPUAPP)
	select LIBLC3
	select FPU

config USE_USB_AUDIO_OUTPUT
	bool "Use USB Audio as output"
	depends on ENABLE_LC3
	select USB_DEVICE_STACK
	select USB_DEVICE_AUDIO
	select RING_BUFFER
	help
	  Enables USB audio as output as a USB peripheral. This does not support providing USB
	  audio to e.g. speakers that are also USB peripherals, but can be connected to e.g. a
	  phone or PC as a USB-in device (such as a USB microphone).
	  USB audio only supports a single audio channel.

config USE_SPECIFIC_BROADCAST_CHANNEL
	bool "Use specific Broadcast Channel Audio Location"
	default y
	depends on USE_USB_AUDIO_OUTPUT
	help
	  Enables the use of a specific Channel Audio Location (see config TARGET_BROADCAST_CHANNEL).

config TARGET_BROADCAST_CHANNEL
	int "Broadcast Channel Audio Location to sync to"
	range 0 3
	default 1
	depends on USE_SPECIFIC_BROADCAST_CHANNEL
	help
	  Channel Audio Location to sync to. These corresponds to the bt_audio_location,
	  supporting mono, left and right channels

source "Kconfig.zephyr"
```

## samples/bluetooth/bap_broadcast_sink/Kconfig.sysbuild
```kconfig
# Copyright 2023 Nordic Semiconductor ASA
# SPDX-License-Identifier: Apache-2.0

source "share/sysbuild/Kconfig"

config NET_CORE_BOARD
	string
	default "$(BOARD)/nrf5340/cpunet" if $(BOARD) = "nrf5340dk"
	default "$(BOARD)/nrf5340/cpunet" if $(BOARD) = "nrf5340_audio_dk"
	default "$(BOARD)/nrf5340/cpunet" if $(BOARD) = "nrf5340bsim"
	default "$(BOARD)/nrf54h20/cpurad" if $(BOARD) = "nrf54h20dk"
	default "nrf5340bsim/nrf5340/cpunet" if $(BOARD_TARGET_STRING) = "NRF5340BSIM_NRF5340_CPUAPP"

config NET_CORE_IMAGE_HCI_IPC
	bool "HCI IPC image on network core"
	default y
	depends on NET_CORE_BOARD != ""
```

## samples/bluetooth/bap_broadcast_sink/boards/nrf5340_audio_dk_nrf5340_cpuapp.conf
```kconfig
# Use CS47L63 codec for audio output via I2S
CONFIG_USE_CODEC_AUDIO_OUTPUT=y
CONFIG_SPI=y
CONFIG_AUDIO=y
CONFIG_AUDIO_CODEC=y
CONFIG_USE_I2S_CODEC=y
CONFIG_LOG=y
CONFIG_LOG_BUFFER_SIZE=4096
```
