## CMakeLists.txt
```
# SPDX-License-Identifier: Apache-2.0

cmake_minimum_required(VERSION 3.28.0)
find_package(Zephyr REQUIRED HINTS $ENV{ZEPHYR_BASE})
project(peripheral_identity)

target_sources(app PRIVATE
  src/main.c
  src/peripheral_identity.c
)

zephyr_library_include_directories(${ZEPHYR_BASE}/samples/bluetooth)
```

## Kconfig
```
# Copyright (c) 2021 Nordic Semiconductor ASA
# SPDX-License-Identifier: Apache-2.0

mainmenu "Bluetooth: Central Multilink"

config SAMPLE_CONN_ITERATIONS
	int "Connection iterations"
	range 0 255
	default 0
	help
	  Expected number of times connect and disconnect from
	  central_multilink sample.

source "Kconfig.zephyr"
```

## sample.yaml
```
sample:
  description: Bluetooth Peripheral Identity
  name: Demonstrates use of multiple identity and the ability to be connected to from
    multiple central devices
tests:
  sample.bluetooth.peripheral_identity:
    harness: bluetooth
    platform_allow:
      - qemu_cortex_m3
      - qemu_x86
      - nrf52840dk/nrf52840
    tags: bluetooth
    integration_platforms:
      - qemu_cortex_m3
```

## prj.conf
```kconfig
CONFIG_BT=y
CONFIG_BT_PERIPHERAL=y
CONFIG_BT_SMP=y
CONFIG_BT_PRIVACY=y

CONFIG_BT_DEVICE_NAME="Zephyr Peripheral"
CONFIG_BT_GAP_AUTO_UPDATE_CONN_PARAMS=n

CONFIG_BT_MAX_CONN=61
CONFIG_BT_ID_MAX=61

# CONFIG_BT_MAX_PAIRED=62
```

## boards/frdm_mcxw23.conf
```kconfig
# SPDX-FileCopyrightText: Copyright 2026 NXP
# SPDX-License-Identifier: Apache-2.0

# frdm_mcxw23 has 112 KB SRAM. The generic sample requests 61 simultaneous
# connections/identities, whose per-connection ATT/GATT/L2CAP pools overflow
# RAM on this board. The exact count is arbitrary (it only needs to
# demonstrate "many identities"), so cap it to a value that fits this board.
CONFIG_BT_MAX_CONN=58
CONFIG_BT_ID_MAX=58
```

## boards/qemu_cortex_m3_ti_lm3s6965.conf
```kconfig
# Reduce main stack size to compensate for increased net_buf size
# (atomic_t ref field increases memory usage by ~3 bytes per buffer)
# Overflow is 108 bytes, reducing stack by 128 bytes provides minimal margin
CONFIG_MAIN_STACK_SIZE=896
```

## src/main.c
```c
/* main.c - Application main entry point */

/*
 * Copyright (c) 2021 Nordic Semiconductor ASA
 *
 * SPDX-License-Identifier: Apache-2.0
 */

#include <stdint.h>

int init_peripheral(uint8_t max_conn, uint8_t iterations);

int main(void)
{
	(void)init_peripheral(CONFIG_BT_MAX_CONN, CONFIG_SAMPLE_CONN_ITERATIONS);
	return 0;
}
```

## src/peripheral_identity.c
```c
/* main.c - Application main entry point */

/*
 * Copyright (c) 2021 Nordic Semiconductor ASA
 * Copyright (c) 2015-2016 Intel Corporation
 *
 * SPDX-License-Identifier: Apache-2.0
 */

#include <stddef.h>
#include <zephyr/sys/printk.h>

#include <zephyr/bluetooth/bluetooth.h>
#include <zephyr/bluetooth/conn.h>
#include <zephyr/bluetooth/hci.h>

static struct k_work work_adv_start;
static uint8_t conn_count_max;
static uint8_t volatile conn_count;
static uint8_t id_current;
static bool volatile is_disconnecting;
#if defined(CONFIG_BT_OBSERVER)
static bool scanning;
#endif

static const struct bt_data ad[] = {
	BT_DATA_BYTES(BT_DATA_FLAGS, (BT_LE_AD_GENERAL | BT_LE_AD_NO_BREDR)),
};

static const struct bt_data sd[] = {
	BT_DATA(BT_DATA_NAME_COMPLETE, CONFIG_BT_DEVICE_NAME, sizeof(CONFIG_BT_DEVICE_NAME) - 1),
};

static void adv_start(struct k_work *work)
{
	struct bt_le_adv_param adv_param = {
		.id = BT_ID_DEFAULT,
		.sid = 0,
		.secondary_max_skip = 0,
		.options = BT_LE_ADV_OPT_CONN,
		.interval_min = 0x0020, /* 20 ms */
		.interval_max = 0x0020, /* 20 ms */
		.peer = NULL,
	};
	size_t id_count = 0xFF;
	int err;

	bt_id_get(NULL, &id_count);
	if (id_current == id_count) {
		int id;

		id = bt_id_create(NULL, NULL);
		if (id < 0) {
			printk("Create id failed (%d)\n", id);
			if (id_current == 0) {
				id_current = conn_count_max;
			}
			id_current--;
		} else {
			printk("New id: %d\n", id);
		}
	}

	printk("Using current id: %u\n", id_current);
	adv_param.id = id_current;

#if defined(CONFIG_BT_OBSERVER)
	/* When privacy is enabled, we cannot start a legacy advertiser with an RPA generated for a
	 * different identity than scanner role. Therefore, we need to stop scanning.
	 */
	if (adv_param.id != BT_ID_DEFAULT && scanning) {
		err = bt_le_scan_stop();
		if (err) {
			printk("Failed to stop scanning (err %d)\n", err);
			return;
		}

		scanning = false;
	}
#endif

	err = bt_le_adv_start(&adv_param, ad, ARRAY_SIZE(ad), sd, ARRAY_SIZE(sd));
	if (err) {
		printk("Advertising failed to start (err %d)\n", err);
		return;
	}

	id_current++;
	if (id_current == conn_count_max) {
		id_current = 0;
	}

	printk("Advertising successfully started\n");
}

static void connected(struct bt_conn *conn, uint8_t err)
{
	if (err) {
		printk("Connection failed, err 0x%02x %s\n", err, bt_hci_err_to_str(err));
		return;
	}

	conn_count++;
	if (conn_count < conn_count_max) {
		k_work_submit(&work_adv_start);
	}

	printk("Connected (%u): %s\n", conn_count, bt_conn_dst_str(conn));
}

static void disconnected(struct bt_conn *conn, uint8_t reason)
{
	printk("Disconnected %s, reason %s(0x%02x)\n", bt_conn_dst_str(conn),
	       bt_hci_err_to_str(reason), reason);

	if (reason == BT_HCI_ERR_CONN_TIMEOUT && conn_count < conn_count_max && !is_disconnecting) {
		k_work_submit(&work_adv_start);
	}

	if ((conn_count == 1U) && is_disconnecting) {
		is_disconnecting = false;
		k_work_submit(&work_adv_start);
	}
	conn_count--;
}

static bool le_param_req(struct bt_conn *conn, struct bt_le_conn_param *param)
{
	printk("LE conn  param req: %s int (0x%04x, 0x%04x) lat %d to %d\n",
	       bt_conn_dst_str(conn), param->interval_min, param->interval_max, param->latency,
	       param->timeout);

	return true;
}

static void le_param_updated(struct bt_conn *conn, uint16_t interval,
			     uint16_t latency, uint16_t timeout)
{
	printk("LE conn param updated: %s int 0x%04x lat %d to %d\n",
	       bt_conn_dst_str(conn), interval, latency, timeout);
}

#if defined(CONFIG_BT_USER_PHY_UPDATE)
static void le_phy_updated(struct bt_conn *conn,
			   struct bt_conn_le_phy_info *param)
{
	printk("LE PHY Updated: %s Tx 0x%x, Rx 0x%x\n", bt_conn_dst_str(conn), param->tx_phy,
	       param->rx_phy);
}
#endif /* CONFIG_BT_USER_PHY_UPDATE */

#if defined(CONFIG_BT_USER_DATA_LEN_UPDATE)
static void le_data_len_updated(struct bt_conn *conn,
				struct bt_conn_le_data_len_info *info)
{
	printk("Data length updated: %s max tx %u (%u us) max rx %u (%u us)\n",
	       bt_conn_dst_str(conn), info->tx_max_len, info->tx_max_time, info->rx_max_len,
	       info->rx_max_time);
}
#endif /* CONFIG_BT_USER_DATA_LEN_UPDATE */

#if defined(CONFIG_BT_SMP)
static void security_changed(struct bt_conn *conn, bt_security_t level,
			     enum bt_security_err err)
{
	if (!err) {
		printk("Security changed: %s level %u\n", bt_conn_dst_str(conn), level);
	} else {
		printk("Security failed: %s level %u err %s(%d)\n", bt_conn_dst_str(conn), level,
		       bt_security_err_to_str(err), err);
	}
}

static void auth_cancel(struct bt_conn *conn)
{
	printk("Pairing cancelled: %s\n", bt_conn_dst_str(conn));
}

static struct bt_conn_auth_cb auth_callbacks = {
	.cancel = auth_cancel,
};
#endif /* CONFIG_BT_SMP */

static struct bt_conn_cb conn_callbacks = {
	.connected = connected,
	.disconnected = disconnected,
	.le_param_req = le_param_req,
	.le_param_updated = le_param_updated,

#if defined(CONFIG_BT_SMP)
	.security_changed = security_changed,
#endif /* CONFIG_BT_SMP */

#if defined(CONFIG_BT_USER_PHY_UPDATE)
	.le_phy_updated = le_phy_updated,
#endif /* CONFIG_BT_USER_PHY_UPDATE */

#if defined(CONFIG_BT_USER_DATA_LEN_UPDATE)
	.le_data_len_updated = le_data_len_updated,
#endif /* CONFIG_BT_USER_DATA_LEN_UPDATE */
};

#if defined(CONFIG_BT_OBSERVER)
#define BT_LE_SCAN_PASSIVE_ALLOW_DUPILCATES \
		BT_LE_SCAN_PARAM(BT_LE_SCAN_TYPE_PASSIVE, \
				 BT_LE_SCAN_OPT_NONE, \
				 BT_GAP_SCAN_FAST_INTERVAL, \
				 BT_GAP_SCAN_FAST_INTERVAL)

static void device_found(const bt_addr_le_t *addr, int8_t rssi, uint8_t type,
			 struct net_buf_simple *ad)
{
	printk("Device found: %s (RSSI %d)\n", bt_addr_le_str(addr), rssi);
}
#endif /* CONFIG_BT_OBSERVER */

static void disconnect(struct bt_conn *conn, void *data)
{
	int err;

	printk("Disconnecting %s...\n", bt_conn_dst_str(conn));

	err = bt_conn_disconnect(conn, BT_HCI_ERR_REMOTE_USER_TERM_CONN);
	if (err) {
		printk("Failed disconnection %s.\n", bt_conn_dst_str(conn));
		return;
	}

	printk("Disconnect initiated\n");
}

int init_peripheral(uint8_t max_conn, uint8_t iterations)
{
	size_t id_count;
	int err;

	conn_count_max = max_conn;

	err = bt_enable(NULL);
	if (err) {
		printk("Bluetooth init failed (err %d)\n", err);
		return err;
	}

	bt_conn_cb_register(&conn_callbacks);

#if defined(CONFIG_BT_SMP)
	bt_conn_auth_cb_register(&auth_callbacks);
#endif /* CONFIG_BT_SMP */

	printk("Bluetooth initialized\n");

#if defined(CONFIG_BT_OBSERVER)
	printk("Start continuous passive scanning...");
	err = bt_le_scan_start(BT_LE_SCAN_PASSIVE_ALLOW_DUPILCATES,
			       device_found);
	if (err) {
		printk("Scan start failed (%d).\n", err);
		return err;
	}

	scanning = true;

	printk("Scanning start success.\n");
#endif /* CONFIG_BT_OBSERVER */

	k_work_init(&work_adv_start, adv_start);
	k_work_submit(&work_adv_start);

	/* wait for connection attempts on all identities */
	do {
		k_sleep(K_MSEC(10));

		id_count = 0xFF;
		bt_id_get(NULL, &id_count);
	} while (id_count != conn_count_max);

	/* rotate identities so reconnections are attempted in case of any
	 * disconnections
	 */
	uint8_t prev_count = conn_count;
	while (1) {
		/* If maximum connections is reached, wait for disconnections
		 */
		if (conn_count == conn_count_max) {
			is_disconnecting = true;

			/* Lets wait sufficiently to ensure a stable connection
			 * before starting to disconnect for next iteration.
			 */
			printk("Waiting for stable connections...\n");
			k_sleep(K_SECONDS(60));

			if (!iterations) {
				break;
			}
			iterations--;
			printk("Iterations remaining: %u\n", iterations);

			/* Device needing multiple connections is the one
			 * initiating the disconnects.
			 */
			if (conn_count_max > 1U) {
				printk("Disconnecting all...\n");
				bt_conn_foreach(BT_CONN_TYPE_LE, disconnect, NULL);
			} else {
				printk("Wait for disconnections...\n");
			}

			while (is_disconnecting) {
				k_sleep(K_MSEC(10));
			}
			printk("All disconnected.\n");

			continue;
		}

		/* As long as there is connection count changes, identity
		 * rotation in this loop is not needed.
		 */
		if (prev_count != conn_count) {
			prev_count = conn_count;

			continue;
		} else {
			uint16_t wait = 6200U;

			/* Maximum duration without connection count change,
			 * central waiting before disconnecting all its
			 * connections plus few seconds of margin.
			 */
			while ((prev_count == conn_count) && wait) {
				printk("Waiting connections (%u/%u) %u...\n",
				       prev_count, conn_count, wait);

				wait--;

				k_sleep(K_MSEC(10));
			}

			if (wait) {
				continue;
			}
		}

		/* Stopping and restarting advertising to use new identity */
		printk("Stop advertising...\n");
		err = bt_le_adv_stop();
		if (err) {
			printk("Failed to stop advertising (%d)\n", err);

			return err;
		}

		k_work_submit(&work_adv_start);
	}

	return 0;
}
```
