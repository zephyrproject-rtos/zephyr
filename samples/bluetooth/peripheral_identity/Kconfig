## samples/bluetooth/peripheral_identity/Kconfig
```kconfig
# Copyright (c) 2021 Nordic Semiconductor ASA
# SPDX-License-Identifier: Apache-2.0

mainmenu "Bluetooth: Central Multilink"

config SAMPLE_CONN_ITERATIONS
	int "Connection iterations"
	range 0 255
	default 0
	help
	  Expected number of times connect and disconnect from
	  central_multilink sample.

source "Kconfig.zephyr"
```

## samples/bluetooth/peripheral_identity/boards/qemu_cortex_m3_ti_lm3s6965.conf
```kconfig
# Reduce main stack size to compensate for increased net_buf size
# (atomic_t ref field increases memory usage by ~3 bytes per buffer)
# Overflow is 108 bytes, reducing stack by 128 bytes provides minimal margin
CONFIG_MAIN_STACK_SIZE=896
```

## samples/bluetooth/peripheral_identity/sample.yaml
```yaml
sample:
  description: Bluetooth Peripheral Identity
  name: Demonstrates use of multiple identity and the ability to be connected to from
    multiple central devices
tests:
  sample.bluetooth.peripheral_identity:
    harness: bluetooth
    platform_allow:
      - qemu_cortex_m3/ti_lm3s6965
      - qemu_x86/atom
      - nrf52840dk/nrf52840
    tags: bluetooth
    integration_platforms:
      - qemu_cortex_m3/ti_lm3s6965
```

## samples/bluetooth/peripheral_iso/sample.yaml
```yaml
sample:
  description: Bluetooth ISO peripheral (server) sample
  name: Bluetooth ISO peripheral (server) sample
tests:
  sample.bluetooth.peripheral_iso:
    harness: bluetooth
    platform_allow: qemu_x86
    tags: bluetooth
    integration_platforms:
      - qemu_x86
```

## samples/bluetooth/peripheral_nus/sample.yaml
```yaml
sample:
  name: Bluetooth Peripheral NUS
  description: Demonstrates the NUS GATT Service (Nordic UART Service)
tests:
  sample.bluetooth.peripheral_nus:
    harness: bluetooth
    platform_allow:
      - qemu_cortex_m3
      - qemu_x86
      - nrf52840dk/nrf52840
      - ophelia4ev/nrf54l15/cpuapp
    integration_platforms:
      - qemu_cortex_m3
    tags: bluetooth
```

## samples/bluetooth/peripheral_ots/sample.yaml
```yaml
sample:
  name: Bluetooth Peripheral OTS
  description: Demonstrates the OTS (Object Transfer) GATT Service
tests:
  sample.bluetooth.peripheral_ots:
    harness: bluetooth
    platform_allow:
      - qemu_cortex_m3
      - qemu_x86
    tags: bluetooth
    integration_platforms:
      - qemu_cortex_m3
```

## samples/bluetooth/peripheral_past/sample.yaml
```yaml
sample:
  name: Bluetooth Peripheral Periodic Advertising Synchronization Transfer (PAST)
tests:
  sample.bluetooth.peripheral_past:
    harness: bluetooth
    platform_allow:
      - qemu_cortex_m3
      - qemu_x86
    tags: bluetooth
    integration_platforms:
      - qemu_cortex_m3
```

## samples/bluetooth/peripheral_sc_only/boards/tlsr9518adk80d.conf
```kconfig
# Copyright (c) 2022 Telink Semiconductor
# SPDX-License-Identifier: Apache-2.0

CONFIG_BT_SEND_ECC_EMULATION=n
```

## samples/bluetooth/peripheral_sc_only/boards/tlsr9518adk80d_tlsr9518.conf
```kconfig
# Copyright (c) 2022 Telink Semiconductor
# SPDX-License-Identifier: Apache-2.0

CONFIG_BT_TINYCRYPT_ECC=n
```

## samples/bluetooth/peripheral_sc_only/sample.yaml
```yaml
sample:
  name: Bluetooth Peripheral SC-only
  description: Demonstrates Secure Connections Only mode
tests:
  sample.bluetooth.peripheral_sc_only:
    harness: bluetooth
    platform_allow:
      - qemu_cortex_m3
      - qemu_x86
    tags: bluetooth
    integration_platforms:
      - qemu_cortex_m3
```

## samples/bluetooth/public_broadcast_source/Kconfig.sysbuild
```kconfig
# Copyright 2023 Nordic Semiconductor ASA
# SPDX-License-Identifier: Apache-2.0

source "share/sysbuild/Kconfig"

config NET_CORE_BOARD
	string
	default "nrf5340dk_nrf5340_cpunet" if $(BOARD) = "nrf5340dk_nrf5340_cpuapp"
	default "nrf5340_audio_dk_nrf5340_cpunet" if $(BOARD) = "nrf5340_audio_dk_nrf5340_cpuapp"
	default "nrf5340bsim_nrf5340_cpunet" if $(BOARD) = "nrf5340bsim_nrf5340_cpuapp"

config NET_CORE_IMAGE_HCI_IPC
	bool "HCI IPC image on network core"
	default y
	depends on NET_CORE_BOARD != ""
```

## samples/bluetooth/public_broadcast_source/sample.yaml
```yaml
sample:
  description: Bluetooth Low Energy Public Broadcast Source sample
  name: Bluetooth Low Energy Public Broadcast Source sample
tests:
  sample.bluetooth.public_broadcast_source:
    harness: bluetooth
    platform_allow:
      - qemu_cortex_m3
      - qemu_x86
      - nrf5340dk/nrf5340/cpuapp
      - nrf5340bsim_nrf5340_cpuapp
    integration_platforms:
      - qemu_x86
      - nrf5340dk/nrf5340/cpuapp
    tags: bluetooth
    sysbuild: true
  sample.bluetooth.public_broadcast_source.bt_ll_sw_split:
    harness: bluetooth
    platform_allow:
      - nrf52_bsim
      - nrf52833dk/nrf52820
      - nrf52833dk/nrf52833
    integration_platforms:
      - nrf52_bsim
      - nrf52833dk/nrf52833
    extra_args: OVERLAY_CONFIG=overlay-bt_ll_sw_split.conf
    tags: bluetooth
```

## samples/bluetooth/sniff/sample.yaml
```yaml
sample:
  description: TBD
  name: TBD
tests:
  sample.bluetooth.sniff:
    harness: bluetooth
    platform_allow: qemu_cortex_m3 qemu_x86
    tags: bluetooth
```

## samples/bluetooth/st_ble_sensor/sample.yaml
```yaml
sample:
  name: Bluetooth ST Bluetooth LE Sensor Demo
  description: Demonstrates Bluetooth LE peripheral by exposing vendor-specific GATT
    services
tests:
  sample.bluetooth.st_ble_sensor:
    harness: bluetooth
    platform_allow: nucleo_wb55rg
    tags: bluetooth
```

## samples/bluetooth/testcase.yaml
```yaml
common:
  platform_allow:
    - qemu_cortex_m3
  harness: pytest
  tags: bluetooth

tests:
  bluetooth.central_and_peripheral_hr:
    required_images:
      - sample.bluetooth.central
      - sample.bluetooth.peripheral_hr

  bluetooth.central_and_peripheral_ht:
    required_images:
      - sample.bluetooth.central
      - sample.bluetooth.peripheral_ht
```

## samples/bluetooth/tmap_bmr/Kconfig
```kconfig
#
# Copyright (c) 2022 Codecoup
# Copyright 2023 NXP
#
# SPDX-License-Identifier: Apache-2.0
#

mainmenu "Bluetooth: Earbuds"

menu "Zephyr"
source "Kconfig.zephyr"
endmenu
```

## samples/bluetooth/tmap_bmr/sample.yaml
```yaml
sample:
  description: Bluetooth Low Energy Audio TMAP BMR sample
  name: Bluetooth Low Energy Audio TMAP BMR sample
tests:
  sample.bluetooth.tmap_bmr:
    harness: bluetooth
    platform_allow:
      - qemu_cortex_m3/ti_lm3s6965
      - qemu_x86/atom
      - native_sim/native
    tags: bluetooth
    integration_platforms:
      - qemu_cortex_m3/ti_lm3s6965
```

## samples/bluetooth/tmap_bms/sample.yaml
```yaml
sample:
  description: Bluetooth Low Energy Audio TMAP BMS sample
  name: Bluetooth Low Energy Audio TMAP BMS sample
tests:
  sample.bluetooth.tmap_bms:
    harness: bluetooth
    platform_allow:
      - qemu_cortex_m3
      - qemu_x86
      - native_sim
    tags: bluetooth
    integration_platforms:
      - qemu_cortex_m3
```

## samples/bluetooth/tmap_central/boards/nrf52840dk_nrf52840.conf
```kconfig
CONFIG_BT_CTLR_CENTRAL_ISO=y

# Supports the highest SDU size required by any BAP LC3 presets (155)
CONFIG_BT_CTLR_ISO_TX_BUFFER_SIZE=155
```

## samples/bluetooth/tmap_central/sample.yaml
```yaml
sample:
  description: Bluetooth Low Energy Audio TMAP Central sample
  name: Bluetooth Low Energy Audio TMAP Central sample
tests:
  sample.bluetooth.tmap_central:
    harness: bluetooth
    platform_allow:
      - qemu_cortex_m3/ti_lm3s6965
      - qemu_x86/atom
      - native_sim/native
    tags: bluetooth
    integration_platforms:
      - qemu_cortex_m3/ti_lm3s6965
```

## samples/bluetooth/tmap_peripheral/Kconfig
```kconfig
#
# Copyright (c) 2022 Codecoup
# Copyright 2023 NXP
#
# SPDX-License-Identifier: Apache-2.0
#

mainmenu "Bluetooth: Earbuds"

menu "Zephyr"
source "Kconfig.zephyr"
endmenu

menu "Earbuds"

config TMAP_PERIPHERAL_SET_RANK
	int "Device rank in set"
	depends on TMAP_PERIPHERAL_DUO
	range 1 2
	help
	  Rank of this device in set.

choice TMAP_PERIPHERAL_TYPE_CHOICE
	prompt "Earbuds type"
	help
	  Select the Earbuds Type to compile.

config TMAP_PERIPHERAL_SINGLE
	bool "Single ear headset"

config TMAP_PERIPHERAL_DUO
	depends on BT_CAP_ACCEPTOR_SET_MEMBER
	bool "Duo headset"

endchoice # TMAP_PERIPHERAL_TYPE_CHOICE

choice TMAP_PERIPHERAL_LOCATION
	prompt "Earbud Location"
	help
	  Select the Earbud location.

config TMAP_PERIPHERAL_LEFT
	bool "Left Ear"

config TMAP_PERIPHERAL_RIGHT
	bool "Right Ear"

endchoice # TMAP_PERIPHERAL_LOCATION

endmenu
```

## samples/bluetooth/tmap_peripheral/boards/nrf5340dk_nrf5340_cpuapp.conf
```kconfig
# For LC3 the following configs are needed
CONFIG_FPU=y
CONFIG_LIBLC3=y
# The LC3 codec uses a large amount of stack. This app runs the codec in the work-queue, hence
# inctease stack size for that thread.
CONFIG_SYSTEM_WORKQUEUE_STACK_SIZE=4096
```

## samples/bluetooth/tmap_peripheral/sample.yaml
```yaml
sample:
  description: Bluetooth Low Energy Audio TMAP Peripheral sample
  name: Bluetooth Low Energy Audio TMAP Peripheral sample
tests:
  sample.bluetooth.tmap_peripheral:
    harness: bluetooth
    platform_allow:
      - qemu_cortex_m3
      - qemu_x86
      - native_sim
    tags: bluetooth
    integration_platforms:
      - qemu_cortex_m3
  sample.bluetooth.tmap_peripheral.duo:
    harness: bluetooth
    platform_allow:
      - qemu_cortex_m3
      - qemu_x86
      - native_sim
    tags: bluetooth
    extra_args: EXTRA_CONF_FILE="duo.conf"
    extra_configs:
      - CONFIG_TMAP_PERIPHERAL_SET_RANK=2
    integration_platforms:
      - qemu_cortex_m3
```
