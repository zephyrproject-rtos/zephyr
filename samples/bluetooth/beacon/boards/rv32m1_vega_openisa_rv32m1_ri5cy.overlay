/*
 * Copyright 2019 NXP
 *
 * SPDX-License-Identifier: Apache-2.0
 */

&lptmr1 {
	interrupt-parent = <&intmux0_ch2>;
};

&intmux0_ch2 {
	status = "okay";
};

&intmux0_ch3 {
	status = "okay";
};

&generic_fsk {
	interrupt-parent = <&intmux0_ch3>;
	status = "okay";
};
