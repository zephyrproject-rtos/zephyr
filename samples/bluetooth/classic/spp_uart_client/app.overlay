/*
 * Copyright (c) 2026 Xiaomi Corporation
 * SPDX-License-Identifier: Apache-2.0
 */

/ {
	spp_uart0: spp_uart0 {
		compatible = "zephyr,bt-spp-uart";
		role = "client";
		channel = <0>;        /* 0 = discover via SDP */
		tx-fifo-size = <1024>;
		rx-fifo-size = <1024>;
	};
};
