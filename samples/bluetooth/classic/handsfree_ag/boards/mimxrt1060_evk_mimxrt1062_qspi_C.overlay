/*
 * Copyright 2026 NXP
 *
 * SPDX-License-Identifier: Apache-2.0
 */

/ {
	aliases {
		i2s-codec-rx = &sai1;
		pcm-rxtx = &sai2;
	};
};

/* SAI1 already has pinctrl-0 set in board dtsi, just add our properties */
&sai1 {
	status = "okay";
	mclk-output;
	nxp,rx-sync-mode;
};

/* SAI2 needs full configuration as it is not in board dtsi */
&sai2 {
	status = "okay";
	nxp,rx-sync-mode;
};
