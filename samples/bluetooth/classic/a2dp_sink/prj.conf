## CMakeLists.txt
```
#SPDX-License-Identifier: Apache-2.0

cmake_minimum_required(VERSION 3.28.0)
find_package(Zephyr REQUIRED HINTS $ENV{ZEPHYR_BASE})
project(a2dp_sink)

FILE(GLOB app_sources src/*.c)
target_sources(app PRIVATE ${app_sources})

zephyr_library_include_directories(${ZEPHYR_BASE}/samples/bluetooth)
target_include_directories(app PRIVATE src)
```

## Kconfig
```
#
# Copyright 2025 NXP
#
# SPDX-License-Identifier: Apache-2.0
#

mainmenu "Bluetooth: A2DP Sink"

config USE_CODEC_CLOCK
	bool "I2S BCK is generated by a selected codec device"
	help
	  If selected, the I2S selected peripheral will be configured to consume
	  (receive) the I2S BCK and WS signals and the codec will be configured
	  to generate those. If not selected, the I2S peripheral will generate
	  them and the codec will be expected to consume them.

config A2DP_SBC_PCM_BUFFER_PLAY_COUNT
	int "The buffer count that every size is 480*2*2 bytes"
	default 50

config A2DP_BOARD_CODEC_PLAY_COUNT
	int "The play count of the board codec interface (i2s)"
	default 4

config A2DP_BOARD_CODEC_OUTPUT_CHANNELS
	int "Number of board codec output channels"
	range 1 2
	default 2
	help
	  Number of channels supported by the board codec output. Stereo input
	  is downmixed when this is set to 1.

config A2DP_BOARD_CODEC_PLAY_THRESHOLD
	int "The threshold of pcm buffer when playing data to codec (n%)"
	default 20

source "Kconfig.zephyr"
```

## sample.yaml
```
sample:
  name: Bluetooth A2DP Sink
tests:
  sample.bluetooth.a2dp.sink:
    harness: bluetooth
    platform_allow:
      - qemu_cortex_m3
      - qemu_x86
    tags: bluetooth
    integration_platforms:
      - qemu_cortex_m3
  sample.bluetooth.a2dp.sink.no_blobs:
    platform_allow:
      - mimxrt1170_evk@B/mimxrt1176/cm7
    tags:
      - bluetooth
      - gap
    extra_args:
      - CONFIG_BUILD_ONLY_NO_BLOBS=y
    timeout: 600
    build_only: true
```

## prj.conf
```kconfig
# -------------------------- Classic Bluetooth Core Configuration --------------------------
CONFIG_BT=y                      # Enable base Bluetooth stack
CONFIG_BT_CLASSIC=y              # Enable Classic Bluetooth (BR/EDR)
CONFIG_BT_DEVICE_NAME="Zephyr A2DP Sink"  # Visible device name
CONFIG_BT_SMP=y                  # Enable secure pairing (required for Classic BT connections)
CONFIG_BT_AVDTP=y                # AVDTP protocol (underlying transport for A2DP)
CONFIG_BT_A2DP=y                 # Enable A2DP protocol (automatically includes SBC codec in 4.2)
CONFIG_BT_A2DP_SINK=y            # Enable A2DP Sink role (receives audio from phone)
CONFIG_BT_DEVICE_NAME_MAX=64
CONFIG_BT_DEVICE_NAME_DYNAMIC=y
CONFIG_BT_COD=0x200405
CONFIG_BT_PERIPHERAL=y
CONFIG_BT_BUF_ACL_RX_SIZE=1021

# -------------------------- AVRCP Configuration --------------------------
CONFIG_BT_AVRCP=y                # Enable AVRCP (remote control protocol)
CONFIG_BT_AVRCP_TARGET=y         # Enable AVRCP Target role (responds to commands)
CONFIG_BT_AVRCP_BROWSING=y

# -------------------------- LIB SBC Configuration --------------------------
CONFIG_LIBSBC=y

# -------------------------- DAC and System Configuration --------------------------
CONFIG_DMA=y                     # Enable DMA for continuous audio output
CONFIG_LOG=y                     # Enable logging for debugging
CONFIG_CONSOLE=y                 # Enable serial console for logs
CONFIG_UART_CONSOLE=y            # Use UART for console output

CONFIG_AUDIO=y
CONFIG_AUDIO_CODEC=y
CONFIG_LOG=y
CONFIG_HEAP_MEM_POOL_SIZE=32000
```

## boards/mimxrt1060_evk_mimxrt1062_qspi_C.conf
```kconfig
#
# Copyright 2026 NXP
#
# SPDX-License-Identifier: Apache-2.0
#

CONFIG_I2S=y
CONFIG_AUDIO=y
CONFIG_AUDIO_CODEC=y
```

## boards/mimxrt1170_evk_mimxrt1176_cm7_B.conf
```kconfig
#select NXP NW612 Chipset
CONFIG_BT_NXP_NW612=y

CONFIG_I2S=y
CONFIG_AUDIO=y
CONFIG_AUDIO_CODEC=y
```

## boards/sf32lb52_devkit_lcd.conf
```kconfig
# Use Codec Audio as output for sf32lb52_devkit_lcd board
CONFIG_HEAP_MEM_POOL_SIZE=32000
CONFIG_AUDIO=y
CONFIG_AUDIO_CODEC=y
CONFIG_A2DP_BOARD_CODEC_OUTPUT_CHANNELS=1
```

## boards/mimxrt1060_evk_mimxrt1062_qspi_C.overlay
```dts
/*
 * Copyright 2026 NXP
 *
 * SPDX-License-Identifier: Apache-2.0
 */

&sai1 {
	mclk-output;
	podf = <15>;
	pll-clocks = <&anatop 0 0 0>,
		     <&anatop 0 0 30>,
		     <&anatop 0 0 1>,
		     <&anatop 0 0 106>,
		     <&anatop 0 0 1000>;
};
```

## boards/mimxrt1170_evk_mimxrt1176_cm7_B.overlay
```dts
/*
 * Copyright 2025 NXP
 *
 * SPDX-License-Identifier: Apache-2.0
 */

/ {
	chosen {
		zephyr,sram = &ocram1;
	};
};

&sai1 {
	mclk-output;
	podf = <32>;
	pll-clocks = <&anatop 0 0 0>,
		     <&anatop 0 0 30>,
		     <&anatop 0 0 1>,
		     <&anatop 0 0 106>,
		     <&anatop 0 0 1000>;
};
```

## src/main.c
```c
/* main.c - Application main entry point */

/*
 * Copyright 2024-2025 NXP
 *
 * SPDX-License-Identifier: Apache-2.0
 */

#include <zephyr/types.h>
#include <stddef.h>
#include <string.h>
#include <errno.h>
#include <zephyr/sys/printk.h>
#include <zephyr/sys/byteorder.h>
#include <zephyr/kernel.h>

#include <zephyr/bluetooth/bluetooth.h>
#include <zephyr/bluetooth/conn.h>
#include <zephyr/bluetooth/classic/a2dp_codec_sbc.h>
#include <zephyr/bluetooth/classic/a2dp.h>
#include <zephyr/bluetooth/classic/sdp.h>
#include <zephyr/settings/settings.h>
#include "audio_buf.h"
#include "codec_play.h"

#define SAMPLE_BIT_WIDTH (16U)

struct bt_a2dp *default_a2dp;
BT_A2DP_SBC_SINK_EP_DEFAULT(sbc_sink_ep);
static struct bt_a2dp_stream sbc_stream;
BT_A2DP_SBC_EP_CFG_DEFAULT(sbc_cfg, A2DP_SBC_SAMP_FREQ_44100);

#define A2DP_VERSION 0x0104

static struct bt_sdp_attribute a2dp_sink_attrs[] = {
	BT_SDP_NEW_SERVICE,
	BT_SDP_LIST(
		BT_SDP_ATTR_SVCLASS_ID_LIST,
		BT_SDP_TYPE_SIZE_VAR(BT_SDP_SEQ8, 3), /* 35 03 */
		BT_SDP_DATA_ELEM_LIST(
		{
			BT_SDP_TYPE_SIZE(BT_SDP_UUID16), /* 19 */
			BT_SDP_ARRAY_16(BT_SDP_AUDIO_SINK_SVCLASS) /* 11 0B */
		},
		)
	),
	BT_SDP_LIST(
		BT_SDP_ATTR_PROTO_DESC_LIST,
		BT_SDP_TYPE_SIZE_VAR(BT_SDP_SEQ8, 16),/* 35 10 */
		BT_SDP_DATA_ELEM_LIST(
		{
			BT_SDP_TYPE_SIZE_VAR(BT_SDP_SEQ8, 6),/* 35 06 */
			BT_SDP_DATA_ELEM_LIST(
			{
				BT_SDP_TYPE_SIZE(BT_SDP_UUID16), /* 19 */
				BT_SDP_ARRAY_16(BT_SDP_PROTO_L2CAP) /* 01 00 */
			},
			{
				BT_SDP_TYPE_SIZE(BT_SDP_UINT16), /* 09 */
				BT_SDP_ARRAY_16(BT_UUID_AVDTP_VAL) /* 00 19 */
			},
			)
		},
		{
			BT_SDP_TYPE_SIZE_VAR(BT_SDP_SEQ8, 6),/* 35 06 */
			BT_SDP_DATA_ELEM_LIST(
			{
				BT_SDP_TYPE_SIZE(BT_SDP_UUID16), /* 19 */
				BT_SDP_ARRAY_16(BT_UUID_AVDTP_VAL) /* 00 19 */
			},
			{
				BT_SDP_TYPE_SIZE(BT_SDP_UINT16), /* 09 */
				BT_SDP_ARRAY_16(AVDTP_VERSION) /* AVDTP version: 01 03 */
			},
			)
		},
		)
	),
	BT_SDP_LIST(
		BT_SDP_ATTR_PROFILE_DESC_LIST,
		BT_SDP_TYPE_SIZE_VAR(BT_SDP_SEQ8, 8), /* 35 08 */
		BT_SDP_DATA_ELEM_LIST(
		{
			BT_SDP_TYPE_SIZE_VAR(BT_SDP_SEQ8, 6), /* 35 06 */
			BT_SDP_DATA_ELEM_LIST(
			{
				BT_SDP_TYPE_SIZE(BT_SDP_UUID16), /* 19 */
				BT_SDP_ARRAY_16(BT_SDP_ADVANCED_AUDIO_SVCLASS) /* 11 0d */
			},
			{
				BT_SDP_TYPE_SIZE(BT_SDP_UINT16), /* 09 */
				BT_SDP_ARRAY_16(A2DP_VERSION) /* 01 04 */
			},
			)
		},
		)
	),
	BT_SDP_SERVICE_NAME("A2DPSink"),
	BT_SDP_SUPPORTED_FEATURES(0x0001U),
};

static struct bt_sdp_record a2dp_sink_rec = BT_SDP_RECORD(a2dp_sink_attrs);

static void sbc_stop_play(void)
{
	printk("stream stopped\n");
	codec_play_stop();
}

void sbc_stream_configured(struct bt_a2dp_stream *stream)
{
	uint32_t sample_freq;
	uint8_t channel_num;
	struct bt_a2dp_codec_sbc_params *sbc_config = (struct bt_a2dp_codec_sbc_params *)
						      &sbc_cfg.codec_config->codec_ie[0];

	channel_num = bt_a2dp_sbc_get_channel_num(sbc_config);
	sample_freq = bt_a2dp_sbc_get_sampling_frequency(sbc_config);
	codec_play_configure(sample_freq, SAMPLE_BIT_WIDTH, channel_num);

	printk("stream configured\n");
}

void sbc_stream_established(struct bt_a2dp_stream *stream)
{
	printk("stream established\n");
}

void sbc_stream_released(struct bt_a2dp_stream *stream)
{
	sbc_stop_play();
}

void sbc_stream_started(struct bt_a2dp_stream *stream)
{
	printk("stream started\n");

	uint32_t sample_freq;
	struct bt_a2dp_codec_sbc_params *sbc_config = (struct bt_a2dp_codec_sbc_params *)
						      &sbc_cfg.codec_config->codec_ie[0];

	sample_freq = bt_a2dp_sbc_get_sampling_frequency(sbc_config);
	audio_buf_reset(sample_freq);
	codec_play_start();
}

void sbc_stream_suspended(struct bt_a2dp_stream *stream)
{
	sbc_stop_play();
}

void sbc_stream_recv(struct bt_a2dp_stream *stream, struct net_buf *buf, uint16_t seq_num,
		     uint32_t ts)
{
	uint8_t channel_num;
	struct bt_a2dp_codec_sbc_params *sbc_config = (struct bt_a2dp_codec_sbc_params *)
						      &sbc_cfg.codec_config->codec_ie[0];

	channel_num = bt_a2dp_sbc_get_channel_num(sbc_config);

	audio_process_sbc_buf(net_buf_pull_u8(buf), buf->data, buf->len, seq_num, ts, channel_num);
}

static struct bt_a2dp_stream_ops stream_ops = {
	.configured = sbc_stream_configured,
	.established = sbc_stream_established,
	.released = sbc_stream_released,
	.started = sbc_stream_started,
	.suspended = sbc_stream_suspended,
	.recv = sbc_stream_recv,
};

void app_a2dp_connected(struct bt_a2dp *a2dp, int err)
{
	if (err == 0) {
		default_a2dp = a2dp;
		printk("a2dp connected success\n");
	} else {
		printk("a2dp connected fail\n");
	}
}

void app_a2dp_disconnected(struct bt_a2dp *a2dp)
{
	default_a2dp = NULL;
	codec_play_stop();
	printk("a2dp disconnected\n");
}

int app_a2dp_config_req(struct bt_a2dp *a2dp, struct bt_a2dp_ep *ep,
			struct bt_a2dp_codec_cfg *codec_cfg, struct bt_a2dp_stream **stream,
			uint8_t *rsp_err_code)
{
	uint32_t sample_rate;

	*sbc_cfg.codec_config = *codec_cfg->codec_config;

	bt_a2dp_stream_cb_register(&sbc_stream, &stream_ops);
	*stream = &sbc_stream;
	*rsp_err_code = 0;

	printk("receive requesting config and accept\n");
	sample_rate = bt_a2dp_sbc_get_sampling_frequency(
		(struct bt_a2dp_codec_sbc_params *)&codec_cfg->codec_config->codec_ie[0]);
	printk("sample rate %dHz\n", sample_rate);

	return 0;
}

static struct bt_a2dp_cb a2dp_cb = {
	.connected = app_a2dp_connected,
	.disconnected = app_a2dp_disconnected,
	.config_req = app_a2dp_config_req,
};

static void bt_ready(int err)
{
	if (err != 0) {
		printk("Bluetooth init failed (err %d)\n", err);
		return;
	}

	if (IS_ENABLED(CONFIG_SETTINGS)) {
		settings_load();
	}

	printk("Bluetooth initialized\n");

	bt_sdp_register_service(&a2dp_sink_rec);

	bt_a2dp_register_ep(&sbc_sink_ep, BT_AVDTP_AUDIO, BT_AVDTP_SINK);

	err = bt_a2dp_register_cb(&a2dp_cb);
	__ASSERT(err == 0, "Failed to register A2DP callbacks");

	err = bt_br_set_connectable(true, NULL);
	if (err != 0) {
		printk("BR/EDR set/rest connectable failed (err %d)\n", err);
		return;
	}
	err = bt_br_set_discoverable(true, false);
	if (err != 0) {
		printk("BR/EDR set discoverable failed (err %d)\n", err);
		return;
	}

	printk("BR/EDR set connectable and discoverable done\n");
}

int main(void)
{
	int err;

	if (codec_play_init() != 0) {
		printk("codec initialization fail\n");
		return 0;
	}

	err = bt_enable(bt_ready);
	if (err != 0) {
		printk("Bluetooth init failed (err %d)\n", err);
		return 0;
	}

	codec_keep_play();

	return 0;
}
```

## src/audio_buf.c
```c
/*
 * Copyright 2024-2025 NXP
 *
 * SPDX-License-Identifier: Apache-2.0
 */

#include <zephyr/types.h>
#include <stddef.h>
#include <string.h>
#include <errno.h>
#include <zephyr/sys/printk.h>
#include <zephyr/sys/byteorder.h>
#include <zephyr/kernel.h>
#include <zephyr/bluetooth/classic/a2dp_codec_sbc.h>
#include <zephyr/bluetooth/sbc.h>
#include "audio_buf.h"

#if IS_ENABLED(CONFIG_AUDIO_CODEC)

/* The whole PCM buffer (save the audio data after decoding) size */
#define A2DP_SBC_DECODER_PCM_BUFFER_SIZE (A2DP_SBC_DATA_PLAY_SIZE_48K *\
					  CONFIG_A2DP_SBC_PCM_BUFFER_PLAY_COUNT)
uint32_t pcm_buffer_size; /* set it dynamically based on frequency */
/* The PCM data size for one sbc frame
 * (channel num: 2, sample size: 2, max subband: 8, max block length: 16)
 */
#define A2DP_SBC_ONE_FRAME_MAX_SIZE (2 * 2 * 16 * 8)
/* audio stream control variables */
static volatile uint32_t pcm_r;
static volatile uint32_t pcm_w;
static volatile uint32_t pcm_rm;
static volatile uint32_t pcm_w_count;
static volatile uint32_t pcm_r_count;
static volatile uint32_t pcm_rm_count;
static struct sbc_decoder decoder;
static volatile bool sbc_first_data;
static uint32_t sbc_expected_ts;
static uint16_t pcm_frame_buffer[A2DP_SBC_ONE_FRAME_MAX_SIZE / 2];
static __aligned(4) uint8_t decoded_pcm_buf[A2DP_SBC_DECODER_PCM_BUFFER_SIZE];

static uint32_t audio_pcm_buffer_free_size(void)
{
	/* Calculate available data space, handling uint32_t wraparound.
	 * Direct subtraction works correctly even when pcm_w_count wraps around:
	 * - Normal case (pcm_w_count >= pcm_rm_count): data_space = pcm_w_count - pcm_rm_count
	 * - Wraparound case (pcm_w_count < pcm_rm_count): unsigned arithmetic automatically
	 *   produces the correct result due to modulo 2^32 behavior.
	 */
	return pcm_buffer_size - (pcm_w_count - pcm_rm_count);
}

static uint32_t audio_add_pcm_data(uint8_t *data, uint32_t length)
{
	uint32_t free_space;

	free_space = audio_pcm_buffer_free_size();

	if (free_space < length) {
		length = free_space;
	}

	/* copy data to buffer */
	if ((pcm_w + length) <= pcm_buffer_size) {
		if (data != NULL) {
			memcpy(&decoded_pcm_buf[pcm_w], data, length);
		} else {
			memset(&decoded_pcm_buf[pcm_w], 0, length);
		}

		pcm_w += length;
	} else {
		if (data != NULL) {
			memcpy(&decoded_pcm_buf[pcm_w], data, (pcm_buffer_size - pcm_w));
			memcpy(&decoded_pcm_buf[0], &data[(pcm_buffer_size - pcm_w)],
			       length - (pcm_buffer_size - pcm_w));
		} else {
			memset(&decoded_pcm_buf[pcm_w], 0, (pcm_buffer_size - pcm_w));
			memset(&decoded_pcm_buf[0], 0, length - (pcm_buffer_size - pcm_w));
		}

		pcm_w = length - (pcm_buffer_size - pcm_w);
	}
	pcm_w_count += length;

	if (pcm_w == pcm_buffer_size) {
		pcm_w = 0;
	}

	return length;
}

int audio_media_sync(uint8_t *data, uint16_t datalen)
{
	if (data != NULL) {
		pcm_rm += datalen;
		pcm_rm_count += datalen;

		if (pcm_rm >= pcm_buffer_size) {
			pcm_rm -= pcm_buffer_size;
		}
	}

	return 0;
}

void audio_get_pcm_data(uint8_t **data, uint32_t length)
{
	static bool reach_threshold;
	uint32_t data_space;
	uint32_t w_count = pcm_w_count;
	uint32_t r_count = pcm_r_count;

	/* Calculate available data space, handling uint32_t wraparound.
	 * Direct subtraction works correctly even when w_count wraps around:
	 * - Normal case (w_count >= r_count): data_space = w_count - r_count
	 * - Wraparound case (w_count < r_count): unsigned arithmetic automatically
	 *   produces the correct result due to modulo 2^32 behavior.
	 *   Example: w_count=5, r_count=0xFFFFFFF0
	 *   Result: 5 - 0xFFFFFFF0 = 0x15 (21 in decimal), which is correct
	 *   because w_count has wrapped and is actually 0x100000005 in the sequence.
	 */
	data_space = w_count - r_count;

	if (!reach_threshold) {
		if (data_space > CONFIG_A2DP_BOARD_CODEC_PLAY_THRESHOLD * pcm_buffer_size / 100) {
			reach_threshold = true;
		} else {
			*data = NULL;
			return;
		}
	}

	if (data_space < length) {
		*data = NULL;
		reach_threshold = false;
	} else {
		pcm_r_count += length;
		*data = &decoded_pcm_buf[pcm_r];
		pcm_r += length;

		if (pcm_r >= pcm_buffer_size) {
			pcm_r = 0;
		}
	}
}

void audio_process_sbc_buf(uint8_t sbc_hdr, uint8_t *data, size_t len, uint16_t seq_num,
			   uint32_t ts, uint8_t channel_num)
{
	const void *in_data;
	size_t samples_count;
	size_t out_size;
	size_t samples_lost;
	uint8_t num_frames;
	int err;

	samples_lost = 0;

	if (!sbc_first_data) {
		sbc_first_data = true;
		sbc_expected_ts = ts;
	} else {
		if (sbc_expected_ts != ts) {
			if (sbc_expected_ts < ts) {
				samples_lost = ts - sbc_expected_ts;
			}
		}
	}

	if (samples_lost != 0) {
		(void)audio_add_pcm_data(NULL, samples_lost * 2U * channel_num);
		sbc_expected_ts = sbc_expected_ts + samples_lost;
	}

	num_frames = BT_A2DP_SBC_MEDIA_HDR_NUM_FRAMES_GET(sbc_hdr);

	samples_count = 0;
	in_data = (void *)data;
	for (uint8_t i = 0; i < num_frames; ++i) {
		if (audio_pcm_buffer_free_size() == 0) {
			/* if no enough space, don't need decode. */
			continue;
		}

		out_size = sizeof(pcm_frame_buffer);
		err = sbc_decode(&decoder, &in_data, &len, pcm_frame_buffer, &out_size);

		if (err == 0) {
			audio_add_pcm_data((uint8_t *)pcm_frame_buffer, out_size);
		} else {
			printk("decode err\n");
			break;
		}

		samples_count += (out_size / 2 / channel_num);
	}

	sbc_expected_ts = ts + samples_count;
}

void audio_buf_reset(uint32_t fs)
{
	pcm_r = 0;
	pcm_w = 0;
	pcm_rm = 0;
	pcm_w_count = 0;
	pcm_r_count = 0;
	pcm_rm_count = 0;

	sbc_setup_decoder(&decoder);

	if (fs == 48000) {
		pcm_buffer_size = A2DP_SBC_DECODER_PCM_BUFFER_SIZE;
	} else if (fs == 44100) {
		pcm_buffer_size = A2DP_SBC_DECODER_PCM_BUFFER_SIZE -
				  A2DP_SBC_DECODER_PCM_BUFFER_SIZE % A2DP_SBC_DATA_PLAY_SIZE_44_1K;
	} else {
		printk("wrong frequency\n");
	}

	sbc_first_data = false;
}

#else

void audio_buf_reset(uint32_t fs)
{
}

void audio_process_sbc_buf(uint8_t sbc_hdr, uint8_t *data, size_t len, uint16_t seq_num,
			   uint32_t ts, uint8_t channel_num)
{
}

#endif
```

## src/audio_buf.h
```c
/*
 * Copyright 2024-2025 NXP
 *
 * SPDX-License-Identifier: Apache-2.0
 */

#ifndef ZEPHYR_INCLUDE_AUDIO_BUF_H_
#define ZEPHYR_INCLUDE_AUDIO_BUF_H_

/* The played audio data is 10ms data size */
#define A2DP_SBC_DATA_PLAY_SIZE_44_1K (441 * 2 * 2)
#define A2DP_SBC_DATA_PLAY_SIZE_48K (480 * 2 * 2)

void audio_buf_reset(uint32_t fs);

void audio_process_sbc_buf(uint8_t sbc_hdr, uint8_t *data, size_t len, uint16_t seq_num,
			   uint32_t ts, uint8_t channel_num);

int audio_media_sync(uint8_t *data, uint16_t datalen);

void audio_get_pcm_data(uint8_t **data, uint32_t length);
#endif
```

## src/codec_play.c
```c
/*
 * Copyright 2024-2025 NXP
 *
 * SPDX-License-Identifier: Apache-2.0
 */

#include <zephyr/types.h>
#include <stddef.h>
#include <string.h>
#include <errno.h>
#include <zephyr/sys/printk.h>
#include <zephyr/sys/byteorder.h>
#include <zephyr/kernel.h>
#include <zephyr/drivers/i2s.h>
#include <zephyr/audio/codec.h>
#include "audio_buf.h"
#include "codec_play.h"

#if DT_HAS_ALIAS(i2s_codec_tx) && IS_ENABLED(CONFIG_I2S) && IS_ENABLED(CONFIG_AUDIO_CODEC)

#if CONFIG_NOCACHE_MEMORY
#define __NOCACHE	__attribute__((__section__(".nocache")))
#elif defined(CONFIG_DT_DEFINED_NOCACHE)
#define __NOCACHE	__attribute__((__section__(CONFIG_DT_DEFINED_NOCACHE_NAME)))
#else /* CONFIG_NOCACHE_MEMORY */
#define __NOCACHE
#endif /* CONFIG_NOCACHE_MEMORY */

/* audio stream control variables */
static volatile bool audio_start;
static uint32_t audio_sample_rate;
static uint8_t *audio_data_sync_buf[CONFIG_A2DP_BOARD_CODEC_PLAY_COUNT];
static uint32_t audio_data_sync_buf_size[CONFIG_A2DP_BOARD_CODEC_PLAY_COUNT];
static uint8_t audio_data_sync_buf_w;
static uint8_t audio_data_sync_buf_r;
static __NOCACHE __aligned(4) uint8_t a2dp_silence_data[A2DP_SBC_DATA_PLAY_SIZE_48K];
#define I2S_CODEC_TX DT_ALIAS(i2s_codec_tx)
#define I2S_TIMEOUT (2000U)

const struct device *const codec_tx = DEVICE_DT_GET(I2S_CODEC_TX);

/* k_mem_slab_init() requires a word-aligned buffer as well as a word-aligned block size */
static __NOCACHE __aligned(sizeof(void *)) uint8_t mem_slab_buffer[
	CONFIG_A2DP_BOARD_CODEC_PLAY_COUNT * A2DP_SBC_DATA_PLAY_SIZE_48K];
static struct k_mem_slab mem_slab;

int codec_play_init(void)
{
	const struct device *const codec_dev = DEVICE_DT_GET(DT_NODELABEL(audio_codec));

	if (!device_is_ready(codec_tx)) {
		printk("%s is not ready\n", codec_tx->name);
		return -EIO;
	}

	if (!device_is_ready(codec_dev)) {
		printk("%s is not ready\n", codec_dev->name);
		return -EIO;
	}

	return 0;
}

void codec_play_configure(uint32_t sample_rate, uint8_t sample_width, uint8_t channels)
{
	const struct device *const codec_dev = DEVICE_DT_GET(DT_NODELABEL(audio_codec));
	struct i2s_config config = {0};
	struct audio_codec_cfg audio_cfg;
	size_t block_size;
	int err;

	audio_sample_rate = sample_rate;
	if (sample_rate == 44100) {
		/*
		 * A2DP_SBC_DATA_PLAY_SIZE_44_1K (1764 bytes) is not a multiple of
		 * sizeof(void *). k_mem_slab_init()/create_free_list() require the
		 * block size to be word aligned (they build an in-place free list by
		 * linking each block's first pointer-sized word). On 32-bit targets
		 * 1764 happens to be 4-byte aligned so this went unnoticed, but on
		 * this AArch64 board (8-byte pointers) it fails the alignment check,
		 * k_mem_slab_init() returns -EINVAL, and the mem_slab is left with
		 * an uninitialized wait_q/free_list. The buffer itself is already
		 * sized using the larger A2DP_SBC_DATA_PLAY_SIZE_48K, so rounding
		 * the block size up here is safe (the actual data written per
		 * block, A2DP_SBC_DATA_PLAY_SIZE_44_1K, still fits within it).
		 */
		block_size = ROUND_UP(A2DP_SBC_DATA_PLAY_SIZE_44_1K, sizeof(void *));
	} else {
		block_size = A2DP_SBC_DATA_PLAY_SIZE_48K;
	}

	audio_cfg.dai_route = AUDIO_ROUTE_PLAYBACK;
	audio_cfg.dai_type = AUDIO_DAI_TYPE_I2S;
	audio_cfg.dai_cfg.i2s.word_size = sample_width;
	audio_cfg.dai_cfg.i2s.channels = channels;
	audio_cfg.dai_cfg.i2s.format = I2S_FMT_DATA_FORMAT_I2S;
#ifdef CONFIG_USE_CODEC_CLOCK
	audio_cfg.dai_cfg.i2s.options = I2S_OPT_FRAME_CLK_CONTROLLER | I2S_OPT_BIT_CLK_CONTROLLER;
#else
	audio_cfg.dai_cfg.i2s.options = I2S_OPT_FRAME_CLK_TARGET | I2S_OPT_BIT_CLK_TARGET;
#endif
	audio_cfg.dai_cfg.i2s.frame_clk_freq = sample_rate;
	audio_cfg.dai_cfg.i2s.mem_slab = &mem_slab;
	audio_cfg.dai_cfg.i2s.block_size = block_size;

	config.word_size = sample_width;
	config.channels = channels;
	config.format = I2S_FMT_DATA_FORMAT_I2S;
#ifdef CONFIG_USE_CODEC_CLOCK
	config.options = I2S_OPT_BIT_CLK_TARGET | I2S_OPT_FRAME_CLK_TARGET;
#else
	config.options = I2S_OPT_BIT_CLK_CONTROLLER | I2S_OPT_FRAME_CLK_CONTROLLER;
#endif
	config.frame_clk_freq = sample_rate;
	config.mem_slab = &mem_slab;
	config.block_size = block_size;
	config.timeout = I2S_TIMEOUT;

	/*
	 * Configure the SAI (MCLK master) BEFORE the codec. On boards where
	 * MCLK is derived from a runtime-tunable CCM root clock (i.MX93 SAI3),
	 * i2s_configure() may need to retune the SAI root clock to a
	 * sample-rate-aligned frequency (e.g. 11.2896 MHz for the 44.1 kHz
	 * family vs. 12.288 MHz for the 48 kHz family). If the codec is
	 * configured first, it reads a stale MCLK rate via
	 * clock_control_get_rate() and programs its internal FLL for the
	 * wrong input frequency, producing an out-of-spec SYSCLK once the
	 * SAI subsequently retunes MCLK.
	 *
	 * Reordering is safe on boards whose MCLK is DT-static (e.g. NXP RT
	 * anatop pll-clocks): configuring the SAI first has no effect on the
	 * codec beyond a slightly earlier MCLK enable, which the WM8962
	 * tolerates.
	 */
	err = i2s_configure(codec_tx, I2S_DIR_TX, &config);
	if (err != 0) {
		printk("failed to configure i2s tx: %d\n", err);
		return;
	}

	err = audio_codec_configure(codec_dev, &audio_cfg);
	if (err != 0) {
		printk("failed to configure codec: %d\n", err);
		return;
	}
	k_msleep(1000);

	err = k_mem_slab_init(&mem_slab, mem_slab_buffer, block_size,
			      CONFIG_A2DP_BOARD_CODEC_PLAY_COUNT);
	if (err != 0) {
		printk("failed to init mem slab: %d\n", err);
	}
}

static void codec_play_to_dev(uint8_t *data, uint32_t length)
{
	int ret;

	ret = i2s_buf_write(codec_tx, data, length);
	if (ret < 0) {
		printk("Failed to write data: %d\n", ret);
	}
}

static void codec_play_data(uint8_t *data, uint32_t length)
{
	audio_data_sync_buf[audio_data_sync_buf_w % CONFIG_A2DP_BOARD_CODEC_PLAY_COUNT] = data;
	audio_data_sync_buf_size[audio_data_sync_buf_w % CONFIG_A2DP_BOARD_CODEC_PLAY_COUNT] =
											length;
	audio_data_sync_buf_w++;

	if (!audio_start) {
		return;
	}

	if ((data != NULL) && (length != 0U)) {
		codec_play_to_dev(data, length);
	} else {
		codec_play_to_dev(a2dp_silence_data,
				  audio_sample_rate == 48000 ?
				  A2DP_SBC_DATA_PLAY_SIZE_48K : A2DP_SBC_DATA_PLAY_SIZE_44_1K);
	}
}

void codec_play_start(void)
{
	if (audio_start) {
		return;
	}

	audio_start = true;

	for (uint8_t i = 0; i < CONFIG_A2DP_BOARD_CODEC_PLAY_COUNT; i++) {
		codec_play_data(a2dp_silence_data,
				audio_sample_rate == 48000 ?
				A2DP_SBC_DATA_PLAY_SIZE_48K : A2DP_SBC_DATA_PLAY_SIZE_44_1K);

		if (i == 0) {
			i2s_trigger(codec_tx, I2S_DIR_TX, I2S_TRIGGER_START);
		}
	}
}

void codec_play_stop(void)
{
	if (!audio_start) {
		return;
	}

	audio_start = false;
	/* Don't need to stop codec_tx. After all the written buf is sent, the I2S tx is stopped. */
	/* i2s_trigger(codec_tx, I2S_DIR_TX, I2S_TRIGGER_STOP); */
}

void codec_keep_play(void)
{
	uint8_t *get_data;
	uint32_t length;

	while (true) {
		if (!audio_start) {
			k_sleep(K_MSEC(1));
			continue;
		}

		if (audio_sample_rate == 44100) {
			length = A2DP_SBC_DATA_PLAY_SIZE_44_1K;
		} else {
			length = A2DP_SBC_DATA_PLAY_SIZE_48K;
		}
		/* play data */
		audio_get_pcm_data(&get_data, length);
		codec_play_data(get_data, length);

		/* sync the already played media data */
		audio_media_sync(audio_data_sync_buf[audio_data_sync_buf_r %
				CONFIG_A2DP_BOARD_CODEC_PLAY_COUNT],
				audio_data_sync_buf_size[audio_data_sync_buf_r %
				CONFIG_A2DP_BOARD_CODEC_PLAY_COUNT]);

		audio_data_sync_buf_r++;
	}
}

#else

void codec_play_configure(uint32_t sample_rate, uint8_t sample_width, uint8_t channels)
{
	printk("Codec is unsupported\n");
}

int codec_play_init(void)
{
	return 0;
}

void codec_play_start(void)
{
}

void codec_play_stop(void)
{
}

void codec_keep_play(void)
{
}

#endif
```

## src/codec_play.h
```c
/*
 * Copyright 2024-2025 NXP
 *
 * SPDX-License-Identifier: Apache-2.0
 */

#ifndef ZEPHYR_INCLUDE_CODEC_PLAY_H_
#define ZEPHYR_INCLUDE_CODEC_PLAY_H_

int codec_play_init(void);

void codec_play_configure(uint32_t sample_rate, uint8_t sample_width, uint8_t channels);

void codec_play_start(void);

void codec_play_stop(void);

void codec_keep_play(void);

#endif
```
