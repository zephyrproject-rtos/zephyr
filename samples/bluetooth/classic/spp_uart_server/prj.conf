## CMakeLists.txt
```
# SPDX-License-Identifier: Apache-2.0

cmake_minimum_required(VERSION 3.20.0)
find_package(Zephyr REQUIRED HINTS $ENV{ZEPHYR_BASE})
project(spp_uart_server)

target_sources(app PRIVATE src/main.c)
```

## prj.conf
```kconfig
CONFIG_BT=y
CONFIG_BT_CLASSIC=y
CONFIG_BT_RFCOMM=y
CONFIG_BT_DEVICE_NAME="Zephyr SPP"

CONFIG_SERIAL=y
CONFIG_UART_INTERRUPT_DRIVEN=y

CONFIG_LOG=y
CONFIG_BT_LOG_LEVEL_WRN=y
```

## app.overlay
```dts
/*
 * Copyright (c) 2026 Xiaomi Corporation
 * SPDX-License-Identifier: Apache-2.0
 */

/ {
	spp_uart0: spp_uart0 {
		compatible = "zephyr,bt-spp-uart";
		tx-fifo-size = <1024>;
	};
};
```

## src/main.c
```c
/*
 * Copyright (c) 2026 Xiaomi Corporation
 *
 * SPDX-License-Identifier: Apache-2.0
 *
 * Sample: Bluetooth Classic SPP UART
 *
 * Demonstrates how to use the SPP UART driver to exchange serial data
 * over Bluetooth Classic (RFCOMM). The device acts as an SPP server;
 * a remote device (phone/PC) connects via SPP and can send/receive data
 * through the virtual UART.
 *
 * Usage:
 *   1. Build and flash this sample
 *   2. Make the device discoverable (it starts discoverable by default)
 *   3. From a phone/PC SPP client, connect to "Zephyr SPP"
 *   4. Data sent from the remote appears on the Zephyr console
 *   5. Zephyr echoes received data back to the remote
 */

#include <zephyr/kernel.h>
#include <zephyr/device.h>
#include <zephyr/drivers/uart.h>
#include <zephyr/sys/util.h>
#include <zephyr/bluetooth/bluetooth.h>
#include <zephyr/bluetooth/classic/classic.h>
#include <zephyr/settings/settings.h>
#include <stdio.h>

#include <zephyr/logging/log.h>
LOG_MODULE_REGISTER(spp_uart_sample, LOG_LEVEL_INF);

#define SPP_UART_NODE DT_NODELABEL(spp_uart0)
static const struct device *const spp_dev = DEVICE_DT_GET(SPP_UART_NODE);

static uint8_t rx_buf[64];
/* Bytes of rx_buf not echoed yet, starting at echo_off */
static int echo_len;
static int echo_off;

/* Queue the pending echo bytes; returns true once all are queued */
static bool echo_flush(const struct device *dev)
{
	int wrote = uart_fifo_fill(dev, &rx_buf[echo_off], echo_len);

	if (wrote > 0) {
		echo_off += wrote;
		echo_len -= wrote;
	}

	return echo_len == 0;
}

static void uart_irq_handler(const struct device *dev, void *user_data)
{
	ARG_UNUSED(user_data);

	uart_irq_update(dev);

	/* The TX FIFO may take only part of an echo while the peer withholds
	 * TX credits. Keep the rest and read no more data until it is queued,
	 * so the RX credits are held back as well.
	 */
	if ((echo_len > 0) && (uart_irq_tx_ready(dev) == 0 || !echo_flush(dev))) {
		return;
	}

	while (uart_irq_rx_ready(dev)) {
		int len = uart_fifo_read(dev, rx_buf, sizeof(rx_buf));

		if (len <= 0) {
			break;
		}

		LOG_INF("RX %d bytes", len);
		/* Echo back */
		echo_off = 0;
		echo_len = len;
		if (!echo_flush(dev)) {
			break;
		}
	}
}

int main(void)
{
	int err;

	LOG_INF("Bluetooth Classic SPP UART sample");

	if (!device_is_ready(spp_dev)) {
		LOG_ERR("SPP UART device not ready");
		return -ENODEV;
	}

	/* Initialize Bluetooth */
	err = bt_enable(NULL);
	if (err != 0) {
		LOG_ERR("Bluetooth init failed (err %d)", err);
		return err;
	}

	LOG_INF("Bluetooth initialized");

	if (IS_ENABLED(CONFIG_SETTINGS)) {
		err = settings_load();
		if (err != 0) {
			LOG_ERR("Settings load failed (err %d)", err);
			return err;
		}
	}

	/* Make device connectable and discoverable */
	err = bt_br_set_connectable(true, NULL);
	if (err != 0) {
		LOG_ERR("BR/EDR set connectable failed (err %d)", err);
		return err;
	}

	err = bt_br_set_discoverable(true, false);
	if (err != 0) {
		LOG_ERR("BR/EDR set discoverable failed (err %d)", err);
		return err;
	}

	LOG_INF("Discoverable as \"%s\", waiting for SPP connection...",
		CONFIG_BT_DEVICE_NAME);

	/* Set up UART IRQ-driven RX with echo */
	err = uart_irq_callback_user_data_set(spp_dev, uart_irq_handler, NULL);
	if (err < 0) {
		if (err == -ENOTSUP) {
			LOG_ERR("Interrupt-driven UART API not enabled");
		} else if (err == -ENOSYS) {
			LOG_ERR("UART device does not support interrupt-driven API");
		} else {
			LOG_ERR("Failed to set UART callback (err %d)", err);
		}
		return err;
	}
	uart_irq_rx_enable(spp_dev);
	uart_irq_tx_enable(spp_dev);

	LOG_INF("SPP UART ready (IRQ-driven echo mode)");

	/* Main loop: also demonstrate poll-based TX */
	int count = 0;

	while (1) {
		k_sleep(K_SECONDS(10));
		count++;

		/* Periodic heartbeat message via poll_out */
		char msg[32];
		int len = snprintf(msg, sizeof(msg), "[heartbeat %d]\r\n", count);

		if (len < 0) {
			continue;
		}

		/* snprintf() returns the length it would have written, so clamp
		 * it to what actually fits in the buffer.
		 */
		len = MIN(len, (int)sizeof(msg) - 1);

		for (int i = 0; i < len; i++) {
			uart_poll_out(spp_dev, msg[i]);
		}
	}

	return 0;
}
```
