/*
 * Copyright (c) 2026 Xiaomi Corporation
 * SPDX-License-Identifier: Apache-2.0
 */

/ {
	spp_uart0: spp_uart0 {
		compatible = "zephyr,bt-spp-uart";
		channel = <10>;
		tx-fifo-size = <1024>;
	};
};
