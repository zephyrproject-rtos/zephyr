## CMakeLists.txt
```
# SPDX-License-Identifier: Apache-2.0

cmake_minimum_required(VERSION 3.28.0)
find_package(Zephyr REQUIRED HINTS $ENV{ZEPHYR_BASE})
project(broadcaster_multiple)

target_sources(app PRIVATE
  src/main.c
  src/broadcaster_multiple.c
)
```

## sample.yaml
```
sample:
  name: Bluetooth Multiple Extended Advertising Broadcaster
common:
  harness: bluetooth
  tags:
    - bluetooth
tests:
  sample.bluetooth.broadcaster_multiple:
    platform_allow:
      - qemu_cortex_m3
      - qemu_x86
    integration_platforms:
      - qemu_cortex_m3
  sample.bluetooth.broadcaster_multiple.bt_ll_sw_split:
    extra_args:
      - EXTRA_CONF_FILE=overlay-bt_ll_sw_split.conf
    platform_allow:
      - nrf51dk/nrf51822
      - nrf52_bsim
      - nrf52dk/nrf52832
      - nrf52840dk/nrf52840
      - lp_em_cc2340r5
      - lp_em_cc2340r5moda
      - lp_em_cc2340r53
      - lp_em_cc2340r53_wcsp
      - lp_em_cc2745r10_q1/cc2745r10_q1
      - lp_em_cc2745r10_q1/cc2755r10
      - lp_em_cc2755p10
      - lp_em_cc2755p20
    integration_platforms:
      - nrf52dk/nrf52832
      - nrf52840dk/nrf52840
```

## prj.conf
```kconfig
CONFIG_BT=y
CONFIG_BT_BROADCASTER=y
CONFIG_BT_DEVICE_NAME="Broadcaster Multiple"
CONFIG_LOG=y

# Require Bluetooth Advertising Extensions Feature
CONFIG_BT_EXT_ADV=y

# Two advertising sets should be supported by most Controller implementations with Advertising
# Extensions support.
# Increasing to 4 should gives one each of legacy, 2M, 1M and Coded PHY advertising sets, when
# supported by Controller implementation.
CONFIG_BT_EXT_ADV_MAX_ADV_SET=2
```

## overlay-bt_ll_sw_split.conf
```kconfig
# Set to 4 to give one each of legacy, 2M, 1M and Coded PHY advertising sets
CONFIG_BT_EXT_ADV_MAX_ADV_SET=4

# Use Zephyr Bluetooth Low Energy Controller
CONFIG_BT_LL_SW_SPLIT=y

# Enable Coded PHY support in Zephyr Controller, if testing 4 advertising sets
CONFIG_BT_CTLR_PHY_CODED=y

# Zephyr Bluetooth LE Controller will need to use chain PDUs when AD data
# length > 191 bytes
# - 31 bytes will use 22 bytes for the default name in this sample plus 9 bytes
#   for manufacturer data
# - 191 bytes will use 22 bytes for the default name in this sample plus 169
#   bytes for manufacturer data
# - 277 bytes will use 22 bytes for the default name in this sample plus 255
#   bytes for manufacturer data
CONFIG_BT_CTLR_ADV_DATA_LEN_MAX=192

# Increase Advertising PDU buffers to number of advertising sets times the
# number of chain PDUs per advertising set when using Zephyr Bluetooth LE
# Controller
CONFIG_BT_CTLR_ADVANCED_FEATURES=y
CONFIG_BT_CTLR_ADV_RESERVE_MAX=n
CONFIG_BT_CTLR_ADV_DATA_BUF_MAX=6
CONFIG_BT_CTLR_ADV_DATA_CHAIN=y

# Code size reduction
CONFIG_ISR_TABLES_LOCAL_DECLARATION=y
CONFIG_LTO=y
```

## src/main.c
```c
/*
 * Copyright (c) 2022 Nordic Semiconductor ASA
 *
 * SPDX-License-Identifier: Apache-2.0
 */

#include <zephyr/sys/printk.h>
#include <zephyr/bluetooth/bluetooth.h>

int broadcaster_multiple(void);

int main(void)
{
	int err;

	printk("Starting Multiple Broadcaster Demo\n");

	/* Initialize the Bluetooth Subsystem */
	err = bt_enable(NULL);
	if (err) {
		printk("Bluetooth init failed (err %d)\n", err);
		return 0;
	}

	(void)broadcaster_multiple();

	printk("Exiting %s thread.\n", __func__);
	return 0;
}
```

## src/broadcaster_multiple.c
```c
/*
 * Copyright (c) 2022 Nordic Semiconductor ASA
 *
 * SPDX-License-Identifier: Apache-2.0
 */

#include <zephyr/sys/printk.h>
#include <zephyr/bluetooth/bluetooth.h>

/* Maximum supported AD data length, use a value supported by the Controller,
 * Bluetooth Core Specification define minimum of 31 bytes will be supported by
 * all Controllers, can be a maximum of 1650 bytes when supported.
 */
#if defined(CONFIG_BT_CTLR_ADV_DATA_LEN_MAX)
#define BT_AD_DATA_LEN_MAX CONFIG_BT_CTLR_ADV_DATA_LEN_MAX
#elif defined(CONFIG_BT_EXT_ADV)
#define BT_AD_DATA_LEN_MAX 255U
#else
#define BT_AD_DATA_LEN_MAX 31U
#endif

/* Size of AD data format length field in octets */
#define BT_AD_DATA_FORMAT_LEN_SIZE 1U

/* Size of AD data format type field in octets */
#define BT_AD_DATA_FORMAT_TYPE_SIZE 1U

/* Maximum value of AD data format length field (8-bit) */
#define BT_AD_DATA_FORMAT_LEN_MAX 255U

#define DEVICE_NAME CONFIG_BT_DEVICE_NAME " " CONFIG_BOARD

/* Device name length, size minus one null character */
#define BT_DEVICE_NAME_LEN (sizeof(DEVICE_NAME) - 1U)

/* Device name length in AD data format, 2 bytes for length and type overhead */
#define BT_DEVICE_NAME_AD_DATA_LEN (BT_AD_DATA_FORMAT_LEN_SIZE + \
				    BT_AD_DATA_FORMAT_TYPE_SIZE + \
				    BT_DEVICE_NAME_LEN)

/* Maximum manufacturer data length, considering ad data format overhead and
 * the included device name in ad data format.
 */
#define BT_MFG_DATA_LEN_MAX       (MIN((BT_AD_DATA_FORMAT_LEN_MAX - \
					BT_AD_DATA_FORMAT_TYPE_SIZE), \
				       (BT_AD_DATA_LEN_MAX - \
					BT_AD_DATA_FORMAT_LEN_SIZE - \
					BT_AD_DATA_FORMAT_TYPE_SIZE)))
#define BT_MFG_DATA_LEN           (MIN(BT_MFG_DATA_LEN_MAX, \
				       (BT_AD_DATA_LEN_MAX - \
					BT_AD_DATA_FORMAT_LEN_SIZE - \
					BT_AD_DATA_FORMAT_TYPE_SIZE - \
					BT_DEVICE_NAME_AD_DATA_LEN)))
/*
 * Datalength is an integer, so BT_MFG_DATA_LEN can not be larger than 255.
 * To ensure that we need to chain PDUs we therefore add manufacturer data
 * twice when chaining is enabled
 */
static uint8_t mfg_data[BT_MFG_DATA_LEN] = { 0xFF, 0xFF, };

static const struct bt_data ad_long[] = {
	BT_DATA(BT_DATA_MANUFACTURER_DATA, mfg_data, sizeof(mfg_data)),
#if CONFIG_BT_CTLR_ADV_DATA_LEN_MAX > 255
	BT_DATA(BT_DATA_MANUFACTURER_DATA, mfg_data, sizeof(mfg_data)),
#endif
	BT_DATA(BT_DATA_NAME_COMPLETE, DEVICE_NAME, sizeof(DEVICE_NAME) - 1),
};

static const struct bt_data ad_short[] = {
	BT_DATA(BT_DATA_NAME_COMPLETE, DEVICE_NAME, sizeof(DEVICE_NAME) - 1),
};

static struct bt_le_ext_adv *adv[CONFIG_BT_EXT_ADV_MAX_ADV_SET];

struct bt_le_ext_adv *broadcaster_multiple_connectable_get(void)
{
#define ADV_CONN_IDX 1

	return adv[ADV_CONN_IDX];
}

int broadcaster_multiple(void)
{
	int err;

	/* Create and start Advertising Sets */
	for (int index = 0; index < CONFIG_BT_EXT_ADV_MAX_ADV_SET; index++) {
		struct bt_le_adv_param adv_param = {
			.id = BT_ID_DEFAULT,
			.sid = 0U, /* Supply unique SID when creating advertising set */
			.secondary_max_skip = 0U,
			.options = BT_LE_ADV_OPT_EXT_ADV,
			.interval_min = BT_GAP_ADV_FAST_INT_MIN_2,
			.interval_max = BT_GAP_ADV_FAST_INT_MAX_2,
			.peer = NULL,
		};
		const struct adv_param_config {
			uint32_t options;
			const struct bt_data *ad;
			size_t ad_size;
		} param_config[] = {
		{ /* Use 1M legacy PDU */
			.options = BT_LE_ADV_OPT_NONE,
			.ad = ad_short,
			.ad_size = ARRAY_SIZE(ad_short),
		},
		{ /* Use 2M auxiliary PDU */
			.options = BT_LE_ADV_OPT_EXT_ADV | BT_LE_ADV_OPT_CONN,
			.ad = ad_short,
			.ad_size = ARRAY_SIZE(ad_short),
		},
		{ /* Use 1M auxiliary PDU */
			.options = BT_LE_ADV_OPT_EXT_ADV | BT_LE_ADV_OPT_NO_2M,
			.ad = ad_long,
			.ad_size = ARRAY_SIZE(ad_long),
		},
		{ /* Use Coded PHY */
			.options = BT_LE_ADV_OPT_EXT_ADV | BT_LE_ADV_OPT_CODED,
			.ad = ad_long,
			.ad_size = ARRAY_SIZE(ad_long),
		}};
		const struct bt_data *ad;
		size_t ad_size;

		/* Use advertising set instance index as SID */
		adv_param.sid = index;

		/* Advertising set options, AD and AD array size */
		const struct adv_param_config *config =
			&param_config[index % ARRAY_SIZE(param_config)];

		adv_param.options = config->options;
		ad = config->ad;
		ad_size = config->ad_size;

ext_adv_create_retry:
		/* Create a non-connectable advertising set */
		err = bt_le_ext_adv_create(&adv_param, NULL, &adv[index]);
		if (err) {
			/* Failed creating Coded PHY advertising set? */
			if ((adv_param.options & BT_LE_ADV_OPT_CODED) != 0U) {
				printk("Failed to create advertising set %d with Coded PHY "
				       "(err %d), retry without...\n", index, err);

				/* Retry with non-Coded PHY advertising set */
				adv_param.options &= ~BT_LE_ADV_OPT_CODED;

				goto ext_adv_create_retry;
			}

			printk("Failed to create advertising set %d (err %d)\n", index, err);
			return err;
		}

		/* Set extended advertising data */
		err = bt_le_ext_adv_set_data(adv[index], ad, ad_size, NULL, 0);
		if (err) {
			printk("Failed to set advertising data for set %d "
			       "(err %d)\n", index, err);
			return err;
		}

		/* Start extended advertising set */
		err = bt_le_ext_adv_start(adv[index],
					  BT_LE_EXT_ADV_START_DEFAULT);
		if (err) {
			printk("Failed to start extended advertising set %d "
			       "(err %d)\n", index, err);
			return err;
		}

		printk("Started Extended Advertising Set %d.\n", index);
	}

	return 0;
}
```
