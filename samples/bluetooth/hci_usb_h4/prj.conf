## CMakeLists.txt
```
# SPDX-License-Identifier: Apache-2.0

cmake_minimum_required(VERSION 3.20.0)
find_package(Zephyr REQUIRED HINTS $ENV{ZEPHYR_BASE})
project(hci_usb_h4)

target_sources(app PRIVATE src/main.c)
```

## Kconfig
```
# Copyright (c) 2019 Nordic Semiconductor ASA
# SPDX-License-Identifier: Apache-2.0

config USB_DEVICE_PID
	default USB_PID_BLE_HCI_H4_SAMPLE

source "Kconfig.zephyr"
```

## sample.yaml
```
sample:
  name: Bluetooth over USB sample
tests:
  sample.bluetooth.hci_usb_h4:
    harness: bluetooth
    depends_on:
      - usb_device
      - ble
    tags:
      - usb
      - bluetooth
    # FIXME: exclude due to build error
    platform_exclude:
      - 96b_carbon/stm32f401xe
      - stm32l562e_dk
```

## prj.conf
```kconfig
CONFIG_STDOUT_CONSOLE=y
CONFIG_GPIO=y
CONFIG_SERIAL=y
CONFIG_UART_INTERRUPT_DRIVEN=y
CONFIG_USB_DEVICE_INITIALIZE_AT_BOOT=n

CONFIG_USB_DEVICE_STACK=y
CONFIG_USB_DEVICE_PID=0x000C
CONFIG_USB_DEVICE_BT_H4=y

# Workaround: Unable to allocate command buffer when using K_NO_WAIT since
# Host number of completed commands does not follow normal flow control.
CONFIG_BT_BUF_CMD_TX_COUNT=10
```

## src/main.c
```c
/*
 * Copyright (c) 2020 Intel Corporation
 *
 * SPDX-License-Identifier: Apache-2.0
 */

#include <zephyr/kernel.h>
#include <zephyr/sys/printk.h>
#include <zephyr/usb/usb_device.h>

int main(void)
{
	int ret;

	ret = usb_enable(NULL);
	if (ret != 0) {
		printk("Failed to enable USB");
		return 0;
	}

	printk("Bluetooth H:4 over USB sample\n");
	return 0;
}
```
