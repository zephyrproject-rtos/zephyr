## samples/bluetooth/bap_broadcast_sink/boards/nrf5340dk_nrf5340_cpuapp.conf
```kconfig
# Use USB Audio as audio sink
CONFIG_USE_USB_AUDIO_OUTPUT=y
CONFIG_USB_DEVICE_PRODUCT="USB Broadcast Sink"
CONFIG_ENTROPY_GENERATOR=y
```

## samples/bluetooth/bap_broadcast_sink/boards/nrf54h20dk_nrf54h20_cpuapp.conf
```kconfig
# Use USB Audio as audio sink
CONFIG_USE_USB_AUDIO_OUTPUT=y
CONFIG_SAMPLE_USBD_PRODUCT="USB Broadcast Sink nRF54H20DK"

# Do not want any complexity trying to get high speed working on a friday evening!
CONFIG_UDC_DRIVER_HIGH_SPEED_SUPPORT_ENABLED=n

# Needed main stack to support PSA Crypto?
CONFIG_MAIN_STACK_SIZE=2048

# Enable Power Management for nRF54H20
CONFIG_PM=y
```

## samples/bluetooth/bap_broadcast_sink/boards/nrf54l15dk_nrf54l15_cpuapp.conf
```kconfig
CONFIG_USE_CODEC_AUDIO_OUTPUT=y

CONFIG_AUDIO=y
CONFIG_AUDIO_CODEC=y
CONFIG_USE_I2S_CODEC=y
CONFIG_USE_I2S_CODEC_CLK_MASTER=y

CONFIG_LOG=y
CONFIG_LOG_BUFFER_SIZE=4096
CONFIG_AUDIO_CODEC_LOG_LEVEL_DBG=y
```

## samples/bluetooth/bap_broadcast_sink/sample.yaml
```yaml
sample:
  description: Bluetooth Low Energy Audio Broadcast Sink sample
  name: Bluetooth Low Energy Audio Broadcast Sink sample
tests:
  sample.bluetooth.bap_broadcast_sink:
    harness: bluetooth
    platform_allow:
      - qemu_cortex_m3
      - qemu_x86
      - nrf5340dk/nrf5340/cpuapp
      - nrf5340bsim/nrf5340/cpuapp
    integration_platforms:
      - qemu_x86
      - nrf5340dk/nrf5340/cpuapp
    tags: bluetooth
    sysbuild: true
  sample.bluetooth.bap_broadcast_sink.bt_ll_sw_split:
    harness: bluetooth
    platform_allow:
      - nrf52_bsim
      - nrf52833dk/nrf52833
      - nrf52840dongle/nrf52840
    integration_platforms:
      - nrf52_bsim
      - nrf52833dk/nrf52833
      - nrf52840dongle/nrf52840
    extra_args:
      - EXTRA_CONF_FILE=overlay-bt_ll_sw_split.conf
      - SNIPPET="bt-ll-sw-split"
    tags: bluetooth
```

## samples/bluetooth/bap_broadcast_source/Kconfig
```kconfig
# Copyright (c) 2023 Demant A/S
# Copyright (c) 2023 Nordic Semiconductor ASA
# SPDX-License-Identifier: Apache-2.0

mainmenu "Bluetooth: Broadcast Audio Source"

choice BAP_LC3_PRESET
	prompt "The BAP LC3 Preset to be used"
	default BAP_BROADCAST_16_2_1

config BAP_BROADCAST_16_2_1
	bool "BAP_LC3_BROADCAST_PRESET_16_2_1 preset"
	help
	  Using the BAP_LC3_BROADCAST_PRESET_16_2_1 preset.

config BAP_BROADCAST_24_2_1
	bool "BAP_LC3_BROADCAST_PRESET_24_2_1 preset"
	help
	  Using the BAP_LC3_BROADCAST_PRESET_24_2_1 preset.

endchoice

config ENABLE_LC3
	bool "Enable the LC3 codec"
	# By default let's enable it in the platforms we know are capable of supporting it
	default y
	depends on CPU_HAS_FPU && \
		(ARCH_POSIX || SOC_COMPATIBLE_NRF52X || SOC_COMPATIBLE_NRF5340_CPUAPP)
	select LIBLC3
	select FPU

config ISO_PACKING_INTERLEAVED
	bool "Use interleaved packing"
	help
	  Use interleaved packing between BIS ISO stream subevents.

config USE_USB_AUDIO_INPUT
	bool "Use USB Audio as input"
	# By default, use the USB Audio path is disabled.
	default n
	depends on ENABLE_LC3
	select USB_DEVICE_STACK_NEXT
	select USBD_AUDIO2_CLASS
	select RING_BUFFER

config BROADCAST_CODE
	string "The broadcast code (if any) to use for encrypted broadcast"
	default ""
	help
	   Setting a non-empty string for this option will encrypt the broadcast using this
	   string as the broadcast code. The length of the string shall be between 1 and 16 octets.

config STATIC_BROADCAST_ID
	bool "Use static broadcast ID"
	default y
	help
	   Enabling this option will make the application use static broadcast ID, as opposed to a
	   randomly generated one.

config BROADCAST_ID
	hex "The static broadcast ID to use"
	range 0x000000 0xFFFFFF
	depends on STATIC_BROADCAST_ID
	help
	   This is the 3-octet broadcast ID advertised if static broadcast IDs are enabled.

# Source common USB sample options used to initialize new experimental USB device stack.
# The scope of these options is limited to USB samples in project tree,
# you cannot use them in your own application.
source "samples/subsys/usb/common/Kconfig.sample_usbd"

source "Kconfig.zephyr"
```

## samples/bluetooth/bap_broadcast_source/boards/nrf52840dongle_nrf52840.conf
```kconfig
# Use USB Audio as audio source
CONFIG_USE_USB_AUDIO_INPUT=y
CONFIG_SAMPLE_USBD_PRODUCT="USB Broadcast Source sample"

CONFIG_BOARD_SERIAL_BACKEND_CDC_ACM=n
```

## samples/bluetooth/bap_broadcast_source/boards/nrf5340dk_nrf5340_cpuapp.conf
```kconfig
# Use USB Audio as audio source
CONFIG_USE_USB_AUDIO_INPUT=y
CONFIG_USB_DEVICE_PRODUCT="Zephyr Broadcast Source"
CONFIG_ENTROPY_GENERATOR=y
```

## samples/bluetooth/bap_broadcast_source/boards/nrf54h20dk_nrf54h20_cpuapp.conf
```kconfig
# Use USB Audio as audio source
CONFIG_USE_USB_AUDIO_INPUT=y
CONFIG_SAMPLE_USBD_PRODUCT="USB Broadcast Audio nRF54H20DK"

# Default to 24 KHz sampling for nRF54H20
CONFIG_BAP_BROADCAST_24_2_1=y

# Do not want any complexity trying to get high speed working on a friday evening!
CONFIG_UDC_DRIVER_HIGH_SPEED_SUPPORT_ENABLED=n

# Enable Power Management for nRF54H20
CONFIG_PM=y
```

## samples/bluetooth/bap_broadcast_source/sample.yaml
```yaml
sample:
  description: Bluetooth Low Energy Broadcast Audio Source sample
  name: Bluetooth Low Energy Broadcast Audio Source sample
tests:
  sample.bluetooth.bap_broadcast_source:
    harness: bluetooth
    platform_allow:
      - qemu_cortex_m3
      - qemu_x86
      - nrf5340dk/nrf5340/cpuapp
      - nrf5340bsim/nrf5340/cpuapp
    integration_platforms:
      - qemu_x86
      - nrf5340dk/nrf5340/cpuapp
    tags: bluetooth
    sysbuild: true
  sample.bluetooth.bap_broadcast_source.nrf5340_audio_dk_cpuapp.fem:
    harness: bluetooth
    platform_allow:
      - nrf5340_audio_dk/nrf5340/cpuapp
    integration_platforms:
      - nrf5340_audio_dk/nrf5340/cpuapp
    extra_args:
      - DTC_OVERLAY_FILE=boards/nrf5340_audio_dk_nrf5340_cpuapp_nrf21540_ek.overlay
      - hci_ipc_DTC_OVERLAY_FILE=boards/nrf5340_audio_dk_nrf5340_cpunet_nrf21540_ek.overlay
    tags: bluetooth
    sysbuild: true
  sample.bluetooth.bap_broadcast_source.bt_ll_sw_split:
    harness: bluetooth
    platform_allow:
      - nrf52_bsim
      - nrf52833dk/nrf52820
      - nrf52833dk/nrf52833
      - nrf52840dongle/nrf52840
    integration_platforms:
      - nrf52_bsim
      - nrf52833dk/nrf52833
      - nrf52840dongle/nrf52840
    extra_args:
      - EXTRA_CONF_FILE=overlay-bt_ll_sw_split.conf
      - SNIPPET="bt-ll-sw-split"
    tags: bluetooth
```

## samples/bluetooth/bap_unicast_client/Kconfig
```kconfig
# Copyright (c) 2025 Nordic Semiconductor ASA
# SPDX-License-Identifier: Apache-2.0

mainmenu "Bluetooth: BAP Unicast Client"

config INFO_REPORTING_INTERVAL
	int "Number of SDUs received between each information report"
	default 1000
	help
	  Determines how often information about received data is logged.
	  Set to 0 to disable reporting.

source "Kconfig.zephyr"
```

## samples/bluetooth/bap_unicast_client/boards/nrf5340bsim_nrf5340_cpunet.conf
```kconfig
# This configuration overlay is used when the controller, host and application are built
# all together in the network core

# For LC3 the following configs are needed
CONFIG_FPU=y
CONFIG_LIBLC3=y
```

## samples/bluetooth/bap_unicast_server/boards/nrf5340_audio_dk_nrf5340_cpuapp.conf
```kconfig
# For LC3 the following configs are needed
CONFIG_FPU=y
CONFIG_LIBLC3=y

CONFIG_BT_BUF_EVT_RX_SIZE=255
CONFIG_BT_BUF_ACL_RX_SIZE=255
CONFIG_BT_BUF_ACL_TX_SIZE=251
CONFIG_BT_BUF_CMD_TX_SIZE=255

CONFIG_BT_TINYCRYPT_ECC=y
```

## samples/bluetooth/beacon/Kconfig
```kconfig
# Copyright (c) 2021 Nordic Semiconductor ASA
# SPDX-License-Identifier: Apache-2.0

config SUPPORT_BT_RPC
	bool
	default y

source "Kconfig.zephyr"
```

## samples/bluetooth/beacon/boards/nrf54l15dk_nrf54l15_cpuapp.conf
```kconfig
# We need a random number generator to properly initialize the PSA Crypto core
# implemented by Mbed TLS. The proper thing to do in this platform would be
# to enable ENTROPY_GENERATOR, but this is not supported right now for the
# following reasons:
# - at device-tree level (nrf54l15_cpuapp.dtsi) the only RNG source available
#   is "zephyr,psa-crypto-rng" which means that TF-M is required in order for
#   this to work. Unfortunately TF-M is still not supported for this platform, yet.
# - cpuapp does not have a direct access to the RNG without TF-M, so there's
#   no other way it can make use of it as of now.
#
# Since both options are not viable, we fall back to the test random generator
# until further support is added to the platform.
CONFIG_TEST_RANDOM_GENERATOR=y
```

## samples/bluetooth/beacon/sample.yaml
```yaml
sample:
  name: Bluetooth Beacon
tests:
  sample.bluetooth.beacon:
    harness: bluetooth
    platform_allow:
      - qemu_cortex_m3
      - qemu_x86
      - nrf51dk/nrf51822
      - nrf52dk/nrf52832
      - nrf54l15dk/nrf54l15/cpuapp
      - ophelia4ev/nrf54l15/cpuapp
      - nrf54lm20dk/nrf54lm20a/cpuapp
    tags: bluetooth
    integration_platforms:
      - qemu_cortex_m3
      - nrf51dk/nrf51822
      - nrf52dk/nrf52832
      - nrf54l15dk/nrf54l15/cpuapp
      - ophelia4ev/nrf54l15/cpuapp
      - nrf54lm20dk/nrf54lm20a/cpuapp
  sample.bluetooth.beacon-coex:
    extra_args: CONF_FILE="prj-coex.conf"
    harness: bluetooth
    platform_allow:
      - nrf52840dk/nrf52840
    integration_platforms:
      - nrf52840dk/nrf52840
    tags: bluetooth
```

## samples/bluetooth/broadcast_audio_assistant/Kconfig
```kconfig
# Copyright (c) 2024 Demant A/S
# SPDX-License-Identifier: Apache-2.0

mainmenu "Bluetooth: Broadcast Audio Assistant"

config SELECT_SOURCE_NAME
	string "Selected Broadcast Source name"
	default ""
	help
	  Name of broadcast source device to select. This will be used as a
	  substring matched against both BT device name and broadcast name.
	  If empty, the first broadcast source found will be chosen.
	  Matching is not case sensitive.

config SELECT_SINK_NAME
	string "Selected Broadcast Sink name"
	default ""
	help
	  Name of broadcast sink device to select. This will be used as a
	  substring matched against the BT device name.
	  If empty, the first broadcast sink found will be chosen.
	  Matching is not case sensitive.

source "Kconfig.zephyr"
```

## samples/bluetooth/broadcast_audio_sink/Kconfig
```kconfig
# Copyright (c) 2022 Nordic Semiconductor ASA
# SPDX-License-Identifier: Apache-2.0

mainmenu "Bluetooth: Broadcast Audio Sink"

config SCAN_OFFLOAD
	bool "Whether to wait for a Broadcast Assistant"
	default y
	# enable PAST support if we can
	select BT_PER_ADV_SYNC_TRANSFER_RECEIVER if !BT_CTLR || BT_CTLR_SYNC_TRANSFER_RECEIVER_SUPPORT
	help
	  If set to true, the sample will start advertising connectable for
	  Broadcast Assistants.

config SCAN_SELF
	bool "Whether to scan for Broadcast Sources without Broadcast Assistant"
	default y
	help
	  If set to true, the sample will start scanning for Broadcast Sources
	  without waiting for a Broadcast Assistant to connect.

config SCAN_DELAY
	int "Delay before starting scan (in seconds)"
	range 0 255
	default 5
	depends on SCAN_SELF
	help
	  Time to advertise connectable for a Broadcast Assistant to connect
	  before starting scanning for Broadcast Sources.

source "Kconfig.zephyr"
```

## samples/bluetooth/broadcast_audio_sink/boards/nrf52840dk_nrf52840.conf
```kconfig
CONFIG_BT_CTLR_SYNC_ISO=y

# Supports the highest SDU size required by any BAP LC3 presets (155)
CONFIG_BT_CTLR_SYNC_ISO_PDU_LEN_MAX=155
# Supports the highest advertising data that can be set in a single HCI command
CONFIG_BT_CTLR_SCAN_DATA_LEN_MAX=251
```

## samples/bluetooth/broadcast_audio_sink/boards/nrf5340_audio_dk_nrf5340_cpuapp.conf
```kconfig
# The LC3 codec uses a large amount of stack. This app runs the codec in the work-queue, hence
# inctease stack size for that thread.
CONFIG_SYSTEM_WORKQUEUE_STACK_SIZE=4096
CONFIG_ENABLE_LC3=y
CONFIG_TARGET_BROADCAST_CHANNEL=1
CONFIG_USE_USB_AUDIO_OUTPUT=y
CONFIG_USB_DEVICE_PRODUCT="USB Broadcast Sink"
```

## samples/bluetooth/broadcast_audio_sink/sample.yaml
```yaml
sample:
  description: Bluetooth Low Energy Audio Broadcast Sink sample
  name: Bluetooth Low Energy Audio Broadcast Sink sample
tests:
  sample.bluetooth.broadcast_audio_sink:
    harness: bluetooth
    platform_allow:
      - qemu_cortex_m3
      - qemu_x86
      - nrf5340dk/nrf5340/cpuapp
      - nrf5340bsim_nrf5340_cpuapp
    integration_platforms:
      - qemu_x86
      - nrf5340dk/nrf5340/cpuapp
    tags: bluetooth
    sysbuild: true
  sample.bluetooth.broadcast_audio_sink.bt_ll_sw_split:
    harness: bluetooth
    platform_allow:
      - nrf52_bsim
      - nrf52833dk/nrf52820
      - nrf52833dk/nrf52833
      - nrf52840dongle/nrf52840
    integration_platforms:
      - nrf52_bsim
      - nrf52833dk/nrf52833
      - nrf52840dongle/nrf52840
    extra_args: OVERLAY_CONFIG=overlay-bt_ll_sw_split.conf
    tags: bluetooth
```

## samples/bluetooth/broadcast_audio_source/Kconfig
```kconfig
# Copyright (c) 2023 Demant A/S
# Copyright (c) 2023 Nordic Semiconductor ASA
# SPDX-License-Identifier: Apache-2.0

mainmenu "Bluetooth: Broadcast Audio Source"

choice BAP_LC3_PRESET
	prompt "The BAP LC3 Preset to be used"
	default BAP_BROADCAST_16_2_1

config BAP_BROADCAST_16_2_1
	bool "BAP_LC3_BROADCAST_PRESET_16_2_1 preset"
	help
	  Using the BAP_LC3_BROADCAST_PRESET_16_2_1 preset.

config BAP_BROADCAST_24_2_1
	bool "BAP_LC3_BROADCAST_PRESET_24_2_1 preset"
	help
	  Using the BAP_LC3_BROADCAST_PRESET_24_2_1 preset.

endchoice

config ENABLE_BROADCAST_CODE
	bool "Enable Broadcast code"
	default n
	help
		Enable encryption and use of broadcast code string.

config BROADCAST_CODE_STRING
	string "Broadcast code string"
	default "Zephyr Broadcast Code"
	depends on ENABLE_BROADCAST_CODE
	help
		Broadcast code of target broadcast device. If not empty string, source device
		will broadcast the specified broadcast code.

config ENABLE_LC3
	bool "Enable the LC3 codec"
	# By default let's enable it in the platforms we know are capable of supporting it
	default y
	depends on (ARCH_POSIX || SOC_NRF5340_CPUAPP)
	select LIBLC3
	select FPU

source "Kconfig.zephyr"
```

## samples/bluetooth/broadcast_audio_source/boards/nrf52833dk_nrf52833.conf
```kconfig
CONFIG_MAIN_STACK_SIZE=4096

# Use USB Audio as input
CONFIG_USE_USB_AUDIO_INPUT=y
CONFIG_USB_DEVICE_PRODUCT="Zephyr Broadcast Source"
```

## samples/bluetooth/broadcast_audio_source/boards/nrf52840dk_nrf52840.conf
```kconfig
CONFIG_BT_CTLR_ADV_ISO=y
# Supports the highest SDU size required by any BAP LC3 presets (155)
CONFIG_BT_CTLR_ISO_TX_BUFFER_SIZE=155
# Zephyr Controller tested maximum advertising data that can be set in a single HCI command
CONFIG_BT_CTLR_ADV_DATA_LEN_MAX=191
```

## samples/bluetooth/broadcast_audio_source/boards/nrf5340_audio_dk_nrf5340_cpuapp.conf
```kconfig
CONFIG_MAIN_STACK_SIZE=4096

# Use USB Audio as input
CONFIG_USE_USB_AUDIO_INPUT=y
CONFIG_USB_DEVICE_PRODUCT="Zephyr Broadcast Source"

# Two streams in one subgroup (stereo)
CONFIG_BT_BAP_BROADCAST_SRC_SUBGROUP_COUNT=1
```
