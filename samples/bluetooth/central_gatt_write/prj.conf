## CMakeLists.txt
```
# SPDX-License-Identifier: Apache-2.0

cmake_minimum_required(VERSION 3.28.0)
find_package(Zephyr REQUIRED HINTS $ENV{ZEPHYR_BASE})
project(central_gatt_write)

FILE(GLOB app_sources src/*.c)
target_sources(app PRIVATE ${app_sources})

zephyr_library_include_directories(${ZEPHYR_BASE}/samples/bluetooth)
```

## Kconfig.gatt_write
```
# Copyright (c) 2025 Nordic Semiconductor ASA
# SPDX-License-Identifier: Apache-2.0

config USE_VARIABLE_LENGTH_DATA
	bool "Use variable length data in GATT Write without Response"
	help
	  Use increasing and decreasing length data in GATT Write without
	  Response.

config USE_CONN_UPDATE_ITERATION_ONCE
	bool "Test Connection Update"
	help
	  Perform Connection Update for a single iteration.

config USE_PHY_UPDATE_ITERATION_ONCE
	bool "Test PHY Update"
	depends on BT_USER_PHY_UPDATE
	help
	  Perform PHY Update for a single iteration.

config USE_NOTIFY
	bool "Use GATT Notifications instead of Write without Response"
	help
	  Exercise the GATT Notification throughput path instead of GATT Write
	  without Response. The peripheral streams notifications and the central
	  subscribes and receives them. With USE_FULL_DUPLEX both peers subscribe
	  to and notify each other; otherwise only the peripheral notifies
	  (one-directional). When disabled (default), both peers transmit GATT
	  Write without Response commands.

config USE_FULL_DUPLEX
	bool "Exercise full-duplex (bidirectional) throughput"
	depends on USE_NOTIFY
	default y
	help
	  Drive throughput from both peers simultaneously. For GATT Write without
	  Response this is the inherent behaviour. For GATT Notifications
	  (USE_NOTIFY) both peers subscribe to and notify each other instead of
	  the one-directional peripheral-to-central path. Full-duplex transfers
	  help uncover stack regressions such as deadlocks/livelocks (for example
	  on supervision timeout) under simultaneous bidirectional load. Disable
	  to exercise the one-directional (simplex) notify path.
```

## sample.yaml
```
sample:
  name: Bluetooth Central GATT Write
tests:
  sample.bluetooth.central_gatt_write:
    harness: bluetooth
    platform_allow:
      - qemu_cortex_m3
      - qemu_x86
      - lp_em_cc2340r5moda
      - lp_em_cc2340r53
      - lp_em_cc2340r53_wcsp
      - lp_em_cc2745r10_q1/cc2745r10_q1
      - lp_em_cc2745r10_q1/cc2755r10
      - lp_em_cc2755p10
      - lp_em_cc2755p20
      - nrf52_bsim
    integration_platforms:
      - qemu_cortex_m3
    tags: bluetooth
```

## prj.conf
```kconfig
CONFIG_BT=y
CONFIG_BT_CENTRAL=y
CONFIG_BT_SMP=y
CONFIG_BT_GATT_CLIENT=y

CONFIG_BT_BUF_ACL_RX_SIZE=255
CONFIG_BT_BUF_ACL_TX_SIZE=251
CONFIG_BT_BUF_CMD_TX_SIZE=255
CONFIG_BT_BUF_EVT_DISCARDABLE_SIZE=255

CONFIG_BT_L2CAP_TX_MTU=247

CONFIG_LOG=y
```

## src/main.c
```c
/*
 * Copyright (c) 2022 Nordic Semiconductor ASA
 *
 * SPDX-License-Identifier: Apache-2.0
 */

#include <stdint.h>

extern uint32_t central_gatt_write(uint32_t count);

int main(void)
{
	(void)central_gatt_write(0U);
	return 0;
}
```

## src/central_gatt_write.c
```c
/*
 * Copyright (c) 2022 Nordic Semiconductor ASA
 *
 * SPDX-License-Identifier: Apache-2.0
 */

#include <zephyr/kernel.h>
#include <zephyr/sys/printk.h>

#include <zephyr/bluetooth/bluetooth.h>
#include <zephyr/bluetooth/conn.h>
#include <zephyr/bluetooth/gatt.h>
#include <zephyr/bluetooth/hci.h>

#include "gatt_write.h"

static void device_found(const bt_addr_le_t *addr, int8_t rssi, uint8_t type,
			 struct net_buf_simple *ad)
{
	struct bt_conn *conn;
	int err;

	printk("[DEVICE]: %s, AD evt type %u, AD data len %u, RSSI %i\n",
	       bt_addr_le_str(addr), type, ad->len, rssi);

	/* We're only interested in connectable events */
	if (type != BT_GAP_ADV_TYPE_ADV_IND &&
	    type != BT_GAP_ADV_TYPE_ADV_DIRECT_IND) {
		return;
	}

	/* connect only to devices in close proximity */
	if (rssi < -50) {
		return;
	}

	err = bt_le_scan_stop();
	if (err) {
		printk("%s: Stop LE scan failed (err %d)\n", __func__, err);
		return;
	}

	err = bt_conn_le_create(addr, BT_CONN_LE_CREATE_CONN,
				BT_LE_CONN_PARAM_DEFAULT, &conn);
	if (err) {
		printk("%s: Create conn failed (err %d)\n", __func__, err);
		start_scan_func();
	} else {
		bt_conn_unref(conn);
	}
}

static void start_scan(void)
{
	int err;

	err = bt_le_scan_start(BT_LE_SCAN_ACTIVE, device_found);
	if (err) {
		printk("%s: Scanning failed to start (err %d)\n", __func__,
		       err);
		return;
	}

	printk("%s: Scanning successfully started\n", __func__);
}

void mtu_updated(struct bt_conn *conn, uint16_t tx, uint16_t rx)
{
	printk("Updated MTU: TX: %d RX: %d bytes\n", tx, rx);
}

static struct bt_gatt_cb gatt_callbacks = {
	.att_mtu_updated = mtu_updated
};

uint32_t central_gatt_write(uint32_t count)
{
	int err;

	err = bt_enable(NULL);
	if (err) {
		printk("Bluetooth init failed (err %d)\n", err);
		return 0U;
	}
	printk("Bluetooth initialized\n");

	bt_gatt_cb_register(&gatt_callbacks);

	conn_connected = NULL;
	last_write_rate = 0U;
	write_countdown = &count;

	if (IS_ENABLED(CONFIG_USE_NOTIFY) && !IS_ENABLED(CONFIG_USE_FULL_DUPLEX)) {
		notify_rx_window_start(count);
	}

	if (count != 0U) {
		printk("GATT Write countdown %u on connection.\n", count);
	} else {
		printk("GATT Write forever on connection.\n");
	}

#if defined(CONFIG_BT_USER_PHY_UPDATE)
	err = bt_conn_le_set_default_phy(BT_GAP_LE_PHY_1M, BT_GAP_LE_PHY_1M);
	if (err) {
		printk("Failed to set default PHY (err %d)\n", err);
		return 0U;
	}
#endif /* CONFIG_BT_USER_PHY_UPDATE */

	start_scan_func = start_scan;
	start_scan_func();

	while (true) {
		/* Simplex notify: the central only receives, so it completes on
		 * its RX window instead of the TX countdown below.
		 */
		if (notify_rx_window_done()) {
			break;
		}

		if (conn_connected == NULL) {
			(void)k_sleep(K_SECONDS(1));
			continue;
		}

		/* Hold a reference across the transmit so the connection is not
		 * freed by the disconnected callback mid-transmit. bt_conn_ref()
		 * returns NULL if the connection was torn down concurrently.
		 */
		struct bt_conn *conn = conn_connected;

		if (conn != NULL) {
			conn = bt_conn_ref(conn);
		}

		if (conn == NULL) {
			continue;
		}

		if (IS_ENABLED(CONFIG_USE_NOTIFY)) {
			err = notify_poll(conn) ? notify_data(conn) : -EAGAIN;
			if (err != 0) {
				/* Not ready (-EAGAIN), out of buffers (-ENOMEM) or
				 * the link is going down: back off one connection
				 * interval. Sleeping (not yielding) lets time
				 * advance so a pending disconnect is delivered.
				 */
				k_timeout_t delay = conn_interval_get(conn);

				bt_conn_unref(conn);
				(void)k_sleep(delay);
				continue;
			}
		} else {
			err = write_cmd(conn);
			if (err != 0 && err != -ENOMEM) {
				/* -ENOMEM just means no TX buffer was free this
				 * iteration and is retried on the next one; any
				 * other error is unexpected.
				 */
				printk("%s: write_cmd failed (%d)\n", __func__, err);
			}
		}

		bt_conn_unref(conn);

		/* Passing `0` will not use the countdown; the block below is
		 * optimized out by the linker in that case.
		 */
		if (count != 0U) {
			if ((count % 1000U) == 0U) {
				printk("GATT %s countdown %u\n",
				       IS_ENABLED(CONFIG_USE_NOTIFY) ? "Notify" : "Write",
				       count);
			}

			count--;
			if (count == 0U) {
				break;
			}
		}

		k_yield();
	}

	return last_write_rate;
}
```

## src/gatt_write.h
```c
/*
 * Copyright The Zephyr Project Contributors
 *
 * SPDX-License-Identifier: Apache-2.0
 */

#ifndef ZEPHYR_SAMPLES_BLUETOOTH_CENTRAL_GATT_WRITE_GATT_WRITE_H_
#define ZEPHYR_SAMPLES_BLUETOOTH_CENTRAL_GATT_WRITE_GATT_WRITE_H_

#include <stdbool.h>
#include <stdint.h>

#include <zephyr/kernel.h>
#include <zephyr/bluetooth/conn.h>

/* Globals shared between the central/peripheral mains and gatt_write_common.c */
extern struct bt_conn *conn_connected;
extern uint32_t last_write_rate;
extern uint32_t *write_countdown;

/* Restart helpers installed by each sample's main() */
extern void (*start_scan_func)(void);
extern int (*restart_adv_func)(void);

/**
 * @brief Send one GATT Write Without Response to the connected peer.
 *
 * @param conn Connection to transmit on.
 *
 * @return 0 on success, or a negative errno on failure.
 */
int write_cmd(struct bt_conn *conn);

/**
 * @brief Get the current connection interval, for backing off a retry.
 *
 * @param conn Connection to query.
 *
 * @return The connection interval, or 10 ms if it cannot be read.
 */
k_timeout_t conn_interval_get(struct bt_conn *conn);

/**
 * @brief Advance the notification flow and check if this side may transmit.
 *
 * Retries a failed local discovery or subscription. Call on every iteration
 * of the sample's thread while holding a reference to @p conn.
 *
 * Only defined when @kconfig{CONFIG_USE_NOTIFY} is set.
 *
 * @param conn Current connection.
 *
 * @return true once the peer has subscribed on this connection and, with
 *         @kconfig{CONFIG_USE_FULL_DUPLEX}, the local subscription is in
 *         place; false otherwise, always for the simplex central.
 */
bool notify_poll(struct bt_conn *conn);

/**
 * @brief Send one GATT notification to the subscribed peer.
 *
 * Call only after notify_poll() returned true. Only defined when
 * @kconfig{CONFIG_USE_NOTIFY} is set.
 *
 * @param conn Connection to notify on.
 *
 * @return 0 when a notification was queued, -ENOMEM if no buffer was free,
 *         or another negative errno on failure.
 */
int notify_data(struct bt_conn *conn);

/**
 * @brief Start a simplex notification RX measurement window.
 *
 * @param count Notifications to receive from now on to complete the window,
 *              or 0 to receive forever.
 */
void notify_rx_window_start(uint32_t count);

/**
 * @brief Check whether the current simplex RX measurement window is complete.
 *
 * @return true once the notifications requested by the last
 *         notify_rx_window_start() have been received, false otherwise.
 */
bool notify_rx_window_done(void);

#endif /* ZEPHYR_SAMPLES_BLUETOOTH_CENTRAL_GATT_WRITE_GATT_WRITE_H_ */
```
