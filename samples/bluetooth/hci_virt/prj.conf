## CMakeLists.txt
```
# Copyright 2026 Xiaomi Corporation
#
# SPDX-License-Identifier: Apache-2.0

cmake_minimum_required(VERSION 3.28.0)

find_package(Zephyr REQUIRED HINTS $ENV{ZEPHYR_BASE})
project(hci_virt)

if(NOT CONFIG_SOC_SERIES_BSIM_NRFXX)
  message(FATAL_ERROR "This sample requires a bsim board")
endif()

target_sources(app PRIVATE src/main.c)

target_sources(native_simulator INTERFACE src/hci_virt_bottom_socket.c)
```

## prj.conf
```kconfig
# Copyright 2026 Xiaomi Corporation
#
# SPDX-License-Identifier: Apache-2.0

CONFIG_BT=y
CONFIG_BT_HCI_RAW=y
CONFIG_BT_MAX_CONN=16
CONFIG_BT_DATA_LEN_UPDATE=y
CONFIG_BT_CTLR_DATA_LENGTH_MAX=27

CONFIG_BT_EXT_ADV=y
CONFIG_BT_PER_ADV=y
CONFIG_BT_PER_ADV_SYNC=y

CONFIG_BT_CTLR_ADV_EXT=y
CONFIG_BT_CTLR_ADV_SET=8
CONFIG_BT_CTLR_ADV_DATA_LEN_MAX=191
CONFIG_BT_CTLR_ADV_PERIODIC=y
CONFIG_BT_CTLR_SYNC_PERIODIC=y
CONFIG_BT_CTLR_SYNC_TRANSFER_RECEIVER=y
CONFIG_BT_CTLR_SYNC_TRANSFER_SENDER=y
CONFIG_BT_CTLR_SYNC_PERIODIC_ADV_LIST_SIZE=8

CONFIG_BT_BUF_EVT_RX_COUNT=16
CONFIG_BT_BUF_EVT_RX_SIZE=255
CONFIG_BT_BUF_ACL_RX_SIZE=251
CONFIG_BT_BUF_ACL_TX_SIZE=251
CONFIG_BT_BUF_CMD_TX_SIZE=255

CONFIG_CONSOLE=n
CONFIG_UART_CONSOLE=n
CONFIG_LOG=y
CONFIG_LOG_MODE_IMMEDIATE=y
CONFIG_BT_LOG_LEVEL_INF=y
CONFIG_ASSERT=y
CONFIG_SPEED_OPTIMIZATIONS=y
```

## src/main.c
```c
/*
 * Copyright 2026 Xiaomi Corporation
 *
 * SPDX-License-Identifier: Apache-2.0
 */

#include <errno.h>
#include <stddef.h>
#include <stdint.h>
#include <string.h>

#include <zephyr/bluetooth/addr.h>
#include <zephyr/bluetooth/buf.h>
#include <zephyr/bluetooth/controller.h>
#include <zephyr/bluetooth/hci.h>
#include <zephyr/bluetooth/hci_raw.h>
#include <zephyr/kernel.h>
#include <zephyr/logging/log.h>
#include <zephyr/net_buf.h>
#include <zephyr/sys/byteorder.h>
#include <zephyr/sys/util.h>

#include "posix_board_if.h"
#include "hci_virt_bottom.h"

LOG_MODULE_REGISTER(hci_virt, LOG_LEVEL_INF);

#define H4_CMD 0x01U
#define H4_ACL 0x02U
#define H4_ISO 0x05U
#define H4_DISCARD_LEN 32U

static K_THREAD_STACK_DEFINE(tx_thread_stack, CONFIG_BT_HCI_TX_STACK_SIZE);
static K_THREAD_STACK_DEFINE(rx_thread_stack, CONFIG_BT_HCI_TX_STACK_SIZE);
static struct k_thread tx_thread_data;
static struct k_thread rx_thread_data;
static K_FIFO_DEFINE(rx_queue);

static bool valid_type(uint8_t type)
{
	return type == H4_CMD || type == H4_ACL || type == H4_ISO;
}

static int set_public_addr_from_arg(void)
{
	const char *str = hci_virt_bd_addr();
	bt_addr_t addr;

	if (str == NULL) {
		return 0;
	}

	if (strlen(str) != BT_ADDR_STR_LEN - 1U) {
		return -EINVAL;
	}

	for (size_t i = 2U; i < BT_ADDR_STR_LEN - 1U; i += 3U) {
		if (str[i] != ':') {
			return -EINVAL;
		}
	}

	for (size_t i = 0U; i < ARRAY_SIZE(addr.val); i++) {
		size_t reverse_i = ARRAY_SIZE(addr.val) - 1U - i;

		if (hex2bin(&str[i * 3U], 2U, &addr.val[reverse_i], 1U) != 1U) {
			return -EINVAL;
		}
	}

	if (bt_addr_eq(&addr, BT_ADDR_ANY)) {
		return -EINVAL;
	}

	bt_ctlr_set_public_addr(addr.val);

	return 0;
}

static size_t payload_len(const uint8_t *header, uint8_t type)
{
	switch (type) {
	case H4_CMD:
		return header[2];
	case H4_ISO:
		return bt_iso_hdr_len(sys_get_le16(&header[2]));
	case H4_ACL:
		return sys_get_le16(&header[2]);
	default:
		return 0U;
	}
}

static size_t header_len(uint8_t type)
{
	switch (type) {
	case H4_CMD:
		return sizeof(struct bt_hci_cmd_hdr);
	case H4_ISO:
		return sizeof(struct bt_hci_iso_hdr);
	case H4_ACL:
		return sizeof(struct bt_hci_acl_hdr);
	default:
		return 0U;
	}
}

/* The raw interface prepends the H:4 packet type to each controller packet. */
static void tx_thread(void *p1, void *p2, void *p3)
{
	ARG_UNUSED(p1);
	ARG_UNUSED(p2);
	ARG_UNUSED(p3);

	while (true) {
		struct net_buf *buf = k_fifo_get(&rx_queue, K_FOREVER);
		int err;

		err = hci_virt_write(buf->data, buf->len);
		if (err == 0) {
			hci_virt_btsnoop_capture(buf->data, buf->len, false);
		} else if (err != -ENOTCONN) {
			LOG_WRN("Failed to send HCI packet to host (%d)", err);
		}

		net_buf_unref(buf);

		k_yield();
	}
}

static void forward_to_controller(struct net_buf *buf)
{
	int err;

	hci_virt_btsnoop_capture(buf->data, buf->len, true);

	err = bt_send(buf);
	if (err != 0) {
		LOG_WRN("Failed to send HCI packet to controller (%d)", err);
		net_buf_unref(buf);
	}

	k_yield();
}

static void rx_thread(void *p1, void *p2, void *p3)
{
	uint8_t header[MAX(sizeof(struct bt_hci_cmd_hdr),
			   MAX(sizeof(struct bt_hci_acl_hdr),
			       sizeof(struct bt_hci_iso_hdr)))];
	uint8_t discard[H4_DISCARD_LEN];
	struct net_buf *buf = NULL;
	size_t remaining = 0U;
	size_t received = 0U;
	enum {
		ST_TYPE,
		ST_HEADER,
		ST_PAYLOAD,
		ST_DISCARD
	} state = ST_TYPE;
	uint8_t type = 0U;

	ARG_UNUSED(p1);
	ARG_UNUSED(p2);
	ARG_UNUSED(p3);

	while (true) {
		while (hci_virt_poll()) {
			int32_t count;

			switch (state) {
			case ST_TYPE:
				count = hci_virt_read(&type, sizeof(type));
				break;
			case ST_HEADER:
				count = hci_virt_read(header + received, remaining);
				break;
			case ST_PAYLOAD:
				count = hci_virt_read(net_buf_tail(buf), remaining);
				break;
			case ST_DISCARD:
				count = hci_virt_read(discard, MIN(remaining, sizeof(discard)));
				break;
			default:
				CODE_UNREACHABLE;
			}

			if (count < 0) {
				/*
				 * The Host disconnected (-ECONNRESET) or is not connected
				 * (-ENOTCONN): drop any partial frame and resync on the next
				 * packet type byte once a new Host connects.
				 */
				net_buf_drop(&buf);
				state = ST_TYPE;
				break;
			}
			if (count == 0) {
				break;
			}

			switch (state) {
			case ST_TYPE:
				if (valid_type(type)) {
					received = 0U;
					remaining = header_len(type);
					state = ST_HEADER;
				}
				break;
			case ST_HEADER:
				received += (size_t)count;
				remaining -= (size_t)count;
				if (remaining > 0U) {
					break;
				}

				remaining = payload_len(header, type);
				buf = bt_buf_get_tx(bt_buf_type_from_h4(type, BT_BUF_OUT),
						    K_FOREVER, NULL, 0);
				if (buf == NULL ||
				    header_len(type) + remaining > net_buf_tailroom(buf)) {
					net_buf_drop(&buf);
					LOG_WRN("Dropping HCI packet: no suitable buffer");
					state = remaining > 0U ? ST_DISCARD : ST_TYPE;
					break;
				}

				net_buf_add_mem(buf, header, header_len(type));
				state = ST_PAYLOAD;
				break;
			case ST_PAYLOAD:
				net_buf_add(buf, (size_t)count);
				remaining -= (size_t)count;
				break;
			case ST_DISCARD:
				remaining -= (size_t)count;
				if (remaining == 0U) {
					state = ST_TYPE;
				}
				break;
			default:
				CODE_UNREACHABLE;
			}

			if (state == ST_PAYLOAD && remaining == 0U) {
				forward_to_controller(net_buf_take(&buf));
				state = ST_TYPE;
			}
		}

		k_sleep(K_MSEC(1));
	}
}

int main(void)
{
	int err;

	err = set_public_addr_from_arg();
	if (err != 0) {
		LOG_ERR("Invalid controller public address (%d)", err);
		posix_exit(1);
	}

	hci_virt_open();

	err = bt_enable_raw(&rx_queue);
	if (err != 0) {
		LOG_ERR("Failed to enable Bluetooth RAW mode (%d)", err);
		posix_exit(1);
	}

	k_thread_create(&tx_thread_data, tx_thread_stack, K_THREAD_STACK_SIZEOF(tx_thread_stack),
			tx_thread, NULL, NULL, NULL, K_PRIO_COOP(7), 0, K_NO_WAIT);
	k_thread_create(&rx_thread_data, rx_thread_stack, K_THREAD_STACK_SIZEOF(rx_thread_stack),
			rx_thread, NULL, NULL, NULL, K_PRIO_COOP(7), 0, K_NO_WAIT);

	return 0;
}
```

## src/hci_virt_bottom.h
```c
/*
 * Copyright 2026 Xiaomi Corporation
 *
 * SPDX-License-Identifier: Apache-2.0
 */

#ifndef HCI_VIRT_BOTTOM_H
#define HCI_VIRT_BOTTOM_H

#include <stdbool.h>
#include <stddef.h>
#include <stdint.h>

/* These functions run in the native simulator runner context. */
void hci_virt_open(void);
const char *hci_virt_bd_addr(void);
bool hci_virt_poll(void);
/* Return a byte count, zero when no data is ready, or a negative errno. */
int32_t hci_virt_read(void *buf, size_t len);
/* Return zero on success or a negative errno; failed writes disconnect the host. */
int hci_virt_write(const void *buf, size_t len);
void hci_virt_btsnoop_capture(const void *buf, size_t len, bool tx);

#endif /* HCI_VIRT_BOTTOM_H */
```

## src/hci_virt_bottom_socket.c
```c
/*
 * Copyright 2026 Xiaomi Corporation
 *
 * SPDX-License-Identifier: Apache-2.0
 */

/* Unix domain sockets run in the native simulator context. */

#include <errno.h>
#include <fcntl.h>
#include <poll.h>
#include <stdbool.h>
#include <stdint.h>
#include <string.h>
#include <sys/socket.h>
#include <sys/stat.h>
#include <sys/un.h>
#include <unistd.h>

#include <nsi_hw_scheduler.h>
#include <nsi_tasks.h>
#include <nsi_tracing.h>

#include "bs_cmd_line.h"
#include "bs_dynargs.h"

#include "hci_virt_bottom.h"

#define DEFAULT_SOCKET_PATH "/tmp/hci0.sock"
#define BTSNOOP_DATALINK_HCI_H4 1002U
#define BTSNOOP_EPOCH_DELTA_US 0x00DCDDB30F2F8000ULL
#define BTSNOOP_FILE_HEADER_LEN 16U
#define BTSNOOP_RECORD_HEADER_LEN 24U
#define BTSNOOP_MAX_FRAME 2048U
#define BTSNOOP_FLAG_RECEIVED 1U
#define BTSNOOP_FLAG_COMMAND_EVENT 2U
#define H4_CMD 0x01U
#define H4_EVT 0x04U

static int listen_fd = -1;
static int client_fd = -1;
static int btsnoop_fd = -1;
static char *socket_path_arg;
static char *btsnoop_file_path_arg;
static char *bd_addr_arg;
static uint32_t btsnoop_drops;
/* Notify the receiver when another context disconnects the host. */
static bool disconnect_pending;

static void put_be32(uint8_t *dst, uint32_t value)
{
	dst[0] = (uint8_t)(value >> 24U);
	dst[1] = (uint8_t)(value >> 16U);
	dst[2] = (uint8_t)(value >> 8U);
	dst[3] = (uint8_t)value;
}

static void put_be64(uint8_t *dst, uint64_t value)
{
	put_be32(dst, (uint32_t)(value >> 32U));
	put_be32(dst + 4, (uint32_t)value);
}

static void close_fd(int *fd)
{
	if (*fd < 0) {
		return;
	}

	if (close(*fd) < 0) {
		nsi_print_warning("hci_virt: close: %s\n", strerror(errno));
	}
	*fd = -1;
}

static void disconnect_host(void)
{
	if (client_fd >= 0) {
		nsi_print_trace("hci_virt: Host disconnected\n");
		close_fd(&client_fd);
	}
}

static void set_nonblocking(int fd)
{
	int flags = fcntl(fd, F_GETFL);

	if (flags < 0 || fcntl(fd, F_SETFL, flags | O_NONBLOCK) < 0) {
		nsi_print_error_and_exit("hci_virt: fcntl: %s\n", strerror(errno));
	}
}

static void register_socket_args(void)
{
	static bs_args_struct_t opts[] = {
		{
			.option = "hci-socket",
			.name = "path",
			.type = 's',
			.dest = &socket_path_arg,
			.descript = "Unix socket path for HCI transport "
				    "(default: " DEFAULT_SOCKET_PATH ")",
		},
		{
			.option = "btsnoop-file",
			.name = "path",
			.type = 's',
			.dest = &btsnoop_file_path_arg,
			.descript = "File path for BTSnoop HCI capture "
				    "(disabled by default)",
		},
		{
			.option = "bd-addr",
			.name = "addr",
			.type = 's',
			.dest = &bd_addr_arg,
			.descript = "Controller public address in AA:BB:CC:DD:EE:FF format",
		},
		ARG_TABLE_ENDMARKER,
	};

	bs_add_extra_dynargs(opts);
}

NSI_TASK(register_socket_args, PRE_BOOT_1, 1);

static const char *get_path(void)
{
	return socket_path_arg != NULL && socket_path_arg[0] != '\0' ? socket_path_arg
								     : DEFAULT_SOCKET_PATH;
}

const char *hci_virt_bd_addr(void)
{
	return bd_addr_arg;
}

static bool btsnoop_enabled(void)
{
	return btsnoop_file_path_arg != NULL && btsnoop_file_path_arg[0] != '\0';
}

static int write_nonblocking_all(int fd, const uint8_t *buf, size_t len)
{
	size_t total = 0U;

	while (total < len) {
		ssize_t count = send(fd, buf + total, len - total, MSG_NOSIGNAL);

		if (count > 0) {
			total += (size_t)count;
			continue;
		}

		if (count < 0 && errno == EINTR) {
			continue;
		}

		return count < 0 ? -errno : -EIO;
	}

	return 0;
}

static void write_btsnoop_all(const uint8_t *buf, size_t len)
{
	size_t total = 0U;

	while (total < len) {
		ssize_t count = write(btsnoop_fd, buf + total, len - total);

		if (count > 0) {
			total += (size_t)count;
			continue;
		}

		if (count < 0 && errno == EINTR) {
			continue;
		}

		nsi_print_error_and_exit("hci_virt: BTSnoop write: %s\n",
					 strerror(count < 0 ? errno : EIO));
	}
}

static void open_btsnoop_file(void)
{
	uint8_t header[BTSNOOP_FILE_HEADER_LEN] = "btsnoop";

	if (!btsnoop_enabled()) {
		return;
	}

	/* Unbuffered writes preserve completed records on SIGKILL teardown. */
	btsnoop_fd = open(btsnoop_file_path_arg, O_WRONLY | O_CREAT | O_TRUNC | O_CLOEXEC,
			  0644);
	if (btsnoop_fd < 0) {
		nsi_print_error_and_exit("hci_virt: open BTSnoop file %s: %s\n",
					 btsnoop_file_path_arg, strerror(errno));
	}

	put_be32(&header[8], 1U);
	put_be32(&header[12], BTSNOOP_DATALINK_HCI_H4);

	write_btsnoop_all(header, sizeof(header));

	nsi_print_trace("hci_virt: BTSnoop file = %s\n", btsnoop_file_path_arg);
}

static int accept_client(int fd)
{
	int accepted = accept(fd, NULL, NULL);

	if (accepted >= 0) {
		set_nonblocking(accepted);
	} else if (errno != EAGAIN && errno != EWOULDBLOCK && errno != EINTR) {
		nsi_print_warning("hci_virt: accept: %s\n", strerror(errno));
	}

	return accepted;
}

static void open_socket(const char *path)
{
	struct sockaddr_un addr = {.sun_family = AF_UNIX};
	struct stat path_stat;

	if (strlen(path) >= sizeof(addr.sun_path)) {
		nsi_print_error_and_exit("hci_virt: socket path is too long: %s\n", path);
	}

	if (lstat(path, &path_stat) == 0) {
		if (!S_ISSOCK(path_stat.st_mode)) {
			nsi_print_error_and_exit(
				"hci_virt: refusing to remove non-socket path %s\n", path);
		}

		if (unlink(path) < 0) {
			nsi_print_error_and_exit("hci_virt: unlink %s: %s\n", path,
						 strerror(errno));
		}
	} else if (errno != ENOENT) {
		nsi_print_error_and_exit("hci_virt: lstat %s: %s\n", path, strerror(errno));
	}

	listen_fd = socket(AF_UNIX, SOCK_STREAM | SOCK_CLOEXEC, 0);
	if (listen_fd < 0) {
		nsi_print_error_and_exit("hci_virt: socket: %s\n", strerror(errno));
	}

	memcpy(addr.sun_path, path, strlen(path) + 1U);

	if (bind(listen_fd, (struct sockaddr *)&addr, sizeof(addr)) < 0) {
		nsi_print_error_and_exit("hci_virt: bind %s: %s\n", path, strerror(errno));
	}

	if (listen(listen_fd, 1) < 0) {
		nsi_print_error_and_exit("hci_virt: listen: %s\n", strerror(errno));
	}

	set_nonblocking(listen_fd);
	nsi_print_trace("hci_virt: Unix socket = %s\n", path);
}

void hci_virt_open(void)
{
	if (btsnoop_enabled() && strcmp(get_path(), btsnoop_file_path_arg) == 0) {
		nsi_print_error_and_exit(
			"hci_virt: HCI socket and BTSnoop file need different paths\n");
	}

	open_socket(get_path());

	open_btsnoop_file();
}

bool hci_virt_poll(void)
{
	struct pollfd pfd = {.fd = client_fd, .events = POLLIN};
	int rc;

	if (disconnect_pending) {
		return true;
	}

	if (client_fd < 0) {
		client_fd = accept_client(listen_fd);
		return false;
	}

	rc = poll(&pfd, 1, 0);
	if (rc < 0) {
		if (errno != EINTR) {
			nsi_print_warning("hci_virt: poll: %s\n", strerror(errno));
			disconnect_host();
			disconnect_pending = true;
			return true;
		}
		return false;
	}

	return (pfd.revents & (POLLIN | POLLHUP | POLLERR | POLLNVAL)) != 0;
}

int32_t hci_virt_read(void *buf, size_t len)
{
	ssize_t count;

	if (disconnect_pending) {
		disconnect_pending = false;
		return -ECONNRESET;
	}

	if (client_fd < 0) {
		return -ENOTCONN;
	}

	count = read(client_fd, buf, len);
	if (count > 0) {
		return (int32_t)count;
	}

	if (count < 0 && (errno == EAGAIN || errno == EWOULDBLOCK || errno == EINTR)) {
		return 0;
	}

	disconnect_host();

	return -ECONNRESET;
}

int hci_virt_write(const void *buf, size_t len)
{
	int err;

	if (client_fd < 0) {
		return -ENOTCONN;
	}

	err = write_nonblocking_all(client_fd, buf, len);
	if (err != 0) {
		disconnect_host();
		disconnect_pending = true;
	}

	return err;
}

void hci_virt_btsnoop_capture(const void *buf, size_t len, bool tx)
{
	uint8_t record[BTSNOOP_RECORD_HEADER_LEN + BTSNOOP_MAX_FRAME];
	const uint8_t *payload = buf;
	uint32_t flags = tx ? 0U : BTSNOOP_FLAG_RECEIVED;

	if (btsnoop_fd < 0) {
		return;
	}

	if (len == 0U || len > BTSNOOP_MAX_FRAME) {
		btsnoop_drops++;
		return;
	}

	if (payload[0] == H4_CMD || payload[0] == H4_EVT) {
		flags |= BTSNOOP_FLAG_COMMAND_EVENT;
	}

	put_be32(&record[0], (uint32_t)len);
	put_be32(&record[4], (uint32_t)len);
	put_be32(&record[8], flags);
	put_be32(&record[12], btsnoop_drops);
	put_be64(&record[16], nsi_hws_get_time() + BTSNOOP_EPOCH_DELTA_US);
	memcpy(&record[BTSNOOP_RECORD_HEADER_LEN], payload, len);

	write_btsnoop_all(record, BTSNOOP_RECORD_HEADER_LEN + len);
}

static void cleanup_sockets(void)
{
	close_fd(&client_fd);
	close_fd(&btsnoop_fd);
	if (listen_fd >= 0) {
		close_fd(&listen_fd);
		if (unlink(get_path()) < 0 && errno != ENOENT) {
			nsi_print_warning("hci_virt: unlink: %s\n", strerror(errno));
		}
	}
}

NSI_TASK(cleanup_sockets, ON_EXIT_PRE, 100);
```
