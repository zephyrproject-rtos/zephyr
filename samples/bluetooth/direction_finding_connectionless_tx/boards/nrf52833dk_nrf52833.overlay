/*
 * Copyright (c) 2021 Nordic Semiconductor ASA
 *
 * SPDX-License-Identifier: Apache-2.0
 */

&radio {
	status = "okay";
	/* This is an example number of antennas that may be available
	 * on antenna matrix board.
	 */
	dfe-antenna-num = <10>;
	/* This is an example switch pattern that will be used to set an
	 * antenna for Tx PDU (period before start of Tx CTE).
	 */
	dfe-pdu-antenna = <0x1>;

	/* These are example GPIO pin numbers that are provided to
	 * Radio peripheral. The pins will be acquired by Radio to
	 * drive antenna switching when AoD is enabled.
	 */
	dfegpio0-gpios = <&gpio0 3 0>;
	dfegpio1-gpios = <&gpio0 4 0>;
	dfegpio2-gpios = <&gpio0 28 0>;
	dfegpio3-gpios = <&gpio0 29 0>;
};
