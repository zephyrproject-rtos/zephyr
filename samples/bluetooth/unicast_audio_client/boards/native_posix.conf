## samples/bluetooth/unicast_audio_client/boards/native_posix.conf
```kconfig
CONFIG_LOG_MODE_IMMEDIATE=y
#Enable TINYCRYPT for native_posix
CONFIG_BT_TINYCRYPT_ECC=y

# The LC3 library is a cpp based lib, hence enable on posix where the codec can be used.
CONFIG_LIBLC3CODEC=y
CONFIG_CPLUSPLUS=y
CONFIG_LIB_CPLUSPLUS=y

# For LE-audio at 10ms intervals we need the tick counter to occur more frequently
# than every 10 ms as each PDU for some reason takes 2 ticks to process.
CONFIG_SYS_CLOCK_TICKS_PER_SEC=1000
CONFIG_NATIVE_POSIX_SLOWDOWN_TO_REAL_TIME=y
```

## samples/bluetooth/unicast_audio_client/boards/nrf5340bsim_nrf5340_cpunet.conf
```kconfig
# This configuration overlay is used when the controller, host and application are built
# all together in the network core

# For LC3 the following configs are needed
CONFIG_FPU=y
CONFIG_LIBLC3=y
# LC3 lib requires floating point support in the c-lib.
CONFIG_REQUIRES_FULL_LIBC=y
```

## samples/bluetooth/unicast_audio_client/sample.yaml
```yaml
sample:
  description: Bluetooth Low Energy Audio Unicast Client sample
  name: Bluetooth Low Energy Audio Unicast Client sample
tests:
  sample.bluetooth.audio_unicast_client:
    harness: bluetooth
    platform_allow:
      - qemu_cortex_m3
      - qemu_x86
    tags: bluetooth
    integration_platforms:
      - qemu_cortex_m3
  sample.bluetooth.audio_unicast_client.bt_ll_sw_split:
    harness: bluetooth
    platform_allow:
      - qemu_cortex_m3
      - qemu_x86
      - nrf52_bsim
      - nrf52dk_nrf52832
    integration_platforms:
      - nrf52dk_nrf52832
    extra_args: OVERLAY_CONFIG=overlay-bt_ll_sw_split.conf
    tags: bluetooth
```

## samples/bluetooth/unicast_audio_server/boards/nrf5340bsim_nrf5340_cpunet.conf
```kconfig
# For LC3 the following configs are needed
CONFIG_FPU=y
CONFIG_LIBLC3=y
# LC3 lib requires floating point support in the c-lib.
CONFIG_REQUIRES_FULL_LIBC=y
```

## samples/bluetooth/unicast_audio_server/boards/nrf5340dk_nrf5340_cpuapp.conf
```kconfig
CONFIG_SYSTEM_WORKQUEUE_STACK_SIZE=2048

CONFIG_BT_CTLR_ADV_EXT=y
CONFIG_BT_CTLR_ADV_PERIODIC=y
```

## samples/bluetooth/unicast_audio_server/sample.yaml
```yaml
sample:
  description: Bluetooth Low Energy Audio Unicast Server sample
  name: Bluetooth Low Energy Audio Unicast Server sample
tests:
  sample.bluetooth.audio_unicast_server:
    harness: bluetooth
    platform_allow:
      - qemu_cortex_m3
      - qemu_x86
    tags: bluetooth
    integration_platforms:
      - qemu_cortex_m3
  sample.bluetooth.audio_unicast_server.bt_ll_sw_split:
    harness: bluetooth
    platform_allow:
      - qemu_cortex_m3
      - qemu_x86
      - nrf52_bsim
      - nrf52dk_nrf52832
    integration_platforms:
      - nrf52dk_nrf52832
    extra_args: OVERLAY_CONFIG=overlay-bt_ll_sw_split.conf
    tags: bluetooth
```

## samples/boards/96b_argonkey/microphone/sample.yaml
```yaml
sample:
  description: ArgonKey sensor testing
  name: ArgonKey test
tests:
  sample.board.96b_argonkey.microphone:
    harness: sensor
    platform_allow: 96b_argonkey/stm32f412cx
    tags: sensors
    depends_on:
      - i2s
      - gpio
```

## samples/boards/96b_argonkey/sensors/sample.yaml
```yaml
sample:
  description: ArgonKey sensor testing
  name: ArgonKey test
tests:
  sample.board.96b_argonkey.sensors:
    harness: sensor
    platform_allow: 96b_argonkey/stm32f412cx
    tags: sensors
    depends_on:
      - i2c
      - spi
      - gpio
```

## samples/boards/altera_max10/pio/sample.yaml
```yaml
sample:
  description: Sample application to verify the Nios-II based
    PIO soft IP block.
  name: Nios-II Parallel Input/Output (PIO)
tests:
  sample.board.altera_max10.pio:
    platform_whitelist: altera_max10
    tags: pio
```

## samples/boards/ambiq/spi_serial_flash/sample.yaml
```yaml
sample:
  name: SPI PSRAM Module Sample
tests:
  sample.drivers.spi.apm_aps6404l:
    tags:
      - drivers
      - psram
    harness: psram
    depends_on:
      - gpio
      - spi
    filter: dt_alias_exists("spi_psram")
```

## samples/boards/amd/amp_ipi_exchange/boards/versal2_rpu_amd_versal2_rpu_amp_core0.conf
```kconfig
# Copyright (c) 2026 Advanced Micro Devices, Inc.
# SPDX-License-Identifier: Apache-2.0
#
# Versal Gen 2 RPU AMP Core 0 — IPI mailbox config

CONFIG_MBOX=y
```

## samples/boards/amd/amp_ipi_exchange/boards/versalnet_rpu_amd_versalnet_rpu_amp_core0.conf
```kconfig
# Copyright (c) 2026 Advanced Micro Devices, Inc.
# SPDX-License-Identifier: Apache-2.0
#
# VersalNet RPU AMP Core 0 — IPI mailbox config

CONFIG_MBOX=y
```

## samples/boards/amd/amp_ipi_exchange/sample.yaml
```yaml
sample:
  name: AMD RPU AMP IPI Exchange Demo
  description: |
    Dual-core AMP demonstration for AMD RPU platforms using IPI mailbox
    for inter-core communication.  Two independent Zephyr instances
    (one per core) exchange sensor data via the Xilinx IPI hardware
    mailbox, demonstrating workload isolation with structured data flow.
    Core 0 acts as a producer (sends data), Core 1 as a consumer
    (receives data, sends ACK).  Round-trip latency is measured.
    Supports Versal RPU (Cortex-R5, GICv1), VersalNet RPU,
    and Versal Gen 2 RPU (Cortex-R52, GICv3).
    Requires two separate ELFs (core0 + core1) loaded via XSDB.
tests:
  sample.board.amp_ipi_exchange:
    platform_allow:
      - versal_rpu/versal_rpu/amp/core0
      - versal_rpu/versal_rpu/amp/core1
      - versalnet_rpu/amd_versalnet_rpu/amp/core0
      - versalnet_rpu/amd_versalnet_rpu/amp/core1
      - versal2_rpu/amd_versal2_rpu/amp/core0
      - versal2_rpu/amd_versal2_rpu/amp/core1
    tags: boards amd amp mbox
    harness: console
    harness_config:
      type: one_line
      regex:
        - ".*Overall: ALL PASS.*"
```

## samples/boards/amd/rpu_dual_irq/Kconfig
```kconfig
# Copyright (c) 2026 Advanced Micro Devices, Inc.
# SPDX-License-Identifier: Apache-2.0

source "Kconfig.zephyr"

config RPU_DUAL_IRQ_AMP_CPU_INDEX
	int "Override logical core ID for split AMP images (-1 = derive from MPIDR)"
	range -1 3
	default 0 if BOARD = "versal2_rpu" && BOARD_QUALIFIERS = "amd_versal2_rpu/amp/core0"
	default 1 if BOARD = "versal2_rpu" && BOARD_QUALIFIERS = "amd_versal2_rpu/amp/core1"
	default 0 if BOARD = "versalnet_rpu" && BOARD_QUALIFIERS = "amd_versalnet_rpu/amp/core0"
	default 1 if BOARD = "versalnet_rpu" && BOARD_QUALIFIERS = "amd_versalnet_rpu/amp/core1"
	default 0 if BOARD = "versal_rpu" && BOARD_QUALIFIERS = "versal_rpu/amp/core0"
	default 1 if BOARD = "versal_rpu" && BOARD_QUALIFIERS = "versal_rpu/amp/core1"
	default -1
	help
	  Zephyr AMP samples are built per-core (separate ELF). Some platforms should
	  use the board-qualified ID instead of deriving from MPIDR at runtime.
```

## samples/boards/amd/rpu_dual_irq/sample.yaml
```yaml
sample:
  name: AMD RPU Dual-Core GIC AMP Validation Test
  description: |
    Dual-core AMP validation test for AMD RPU platforms.
    Supports Versal RPU (Cortex-R5, GICv1), VersalNet RPU (Cortex-R52, GICv3),
    and Versal Gen 2 RPU (GICv3).
    Phase 1 tests SGI delivery to both cores.
    Phase 2 tests SPI routing and delivery (GICD_ITARGETSRn on GICv1,
    GICD_IROUTERn on GICv3).
    Requires two separate ELFs (core0 + core1) loaded via XSDB.
tests:
  sample.board.rpu_dual_irq:
    platform_allow:
      - versal_rpu/versal_rpu/amp/core0
      - versal_rpu/versal_rpu/amp/core1
      - versalnet_rpu/amd_versalnet_rpu/amp/core0
      - versalnet_rpu/amd_versalnet_rpu/amp/core1
      - versal2_rpu/amd_versal2_rpu/amp/core0
      - versal2_rpu/amd_versal2_rpu/amp/core1
    tags: boards amd amp
    harness: console
    harness_config:
      type: one_line
      regex:
        - ".*Overall: ALL PASS.*"
```

## samples/boards/amd/xclk_wiz/Kconfig
```kconfig
# Copyright (c) 2026, Advanced Micro Devices, Inc.
# SPDX-License-Identifier: Apache-2.0

mainmenu "Xilinx AXI Clocking Wizard EA Sample"

source "Kconfig.zephyr"
```

## samples/boards/arc_secure_services/em_starterkit_em7d_normal_defconfig
```kconfig
CONFIG_SOC_EMSK=y
CONFIG_SOC_EMSK_EM7D=y
CONFIG_BOARD_EM_STARTERKIT=y
CONFIG_SYS_CLOCK_TICKS_PER_SEC=100
CONFIG_XIP=n
CONFIG_BUILD_NO_GAP_FILL=y
CONFIG_BUILD_OUTPUT_BIN=n
CONFIG_PRINTK=y
CONFIG_ARCV2_INTERRUPT_UNIT=y
CONFIG_ARCV2_TIMER=y
CONFIG_CONSOLE=y
CONFIG_UART_CONSOLE=y
CONFIG_SERIAL=y
CONFIG_UART_INTERRUPT_DRIVEN=y
CONFIG_GPIO=y
CONFIG_ARC_MPU_ENABLE=y
CONFIG_ARC_HAS_SECURE=y
CONFIG_TRUSTED_EXECUTION_NONSECURE=y
```

## samples/boards/arc_secure_services/nsim_sem_normal_defconfig
```kconfig
CONFIG_SOC_NSIM=y
CONFIG_SOC_NSIM_SEM=y
CONFIG_BOARD_NSIM=y
CONFIG_SYS_CLOCK_TICKS_PER_SEC=100
CONFIG_XIP=n
CONFIG_BUILD_OUTPUT_BIN=n
CONFIG_PRINTK=y
CONFIG_ARCV2_INTERRUPT_UNIT=y
CONFIG_ARCV2_TIMER=y
CONFIG_CONSOLE=y
CONFIG_UART_CONSOLE=y
CONFIG_SERIAL=y
CONFIG_TRUSTED_EXECUTION_NONSECURE=y
```

## samples/boards/arc_secure_services/sample.yaml
```yaml
sample:
  description: Sample application to verify the secure monitor for
     Designware ARC SecureShiled.
  name: Designware ARC Secure monitor
tests:
  sample.board.arc_secure_services:
    # Requires multiple kernels in an AMP config. See README.rst
    build_only: true
    platform_allow: nsim_sem em_starterkit_em7d_secure
    tags: secure
    harness: console
    harness_config:
      type: multi_line
      ordered: true
      regex:
        -  "I am the main thread in secure world: 0"
        -  "Go to normal application"
        -  "I am the main thread in secure world: 1"
        -  "I am the main thread in secure world: 2"
        -  "I am the main thread in secure world: 3"
```

## samples/boards/arduino_101/environmental_sensing/ap/sample.yaml
```yaml
sample:
  description: Environmental Sensing sample using BLE
    and sensor features on Arduino 101.
  name: Environmental Sensing (Application Processor Part)
tests:
  sample.board.arduino_101.env_sensing:
    platform_whitelist: arduino_101
    tags: sensors
    harness: sensor
```

## samples/boards/arduino_101/environmental_sensing/sensor/sample.yaml
```yaml
sample:
  description: Environmental Sensing sample using BLE
    and sensor features on Arduino 101.
  name: Environmental Sensing (Sensor Subsystem Part)
tests:
  sample.board.arduino_101_sss.env_sensing:
    platform_whitelist: arduino_101_sss
    tags: sensors
    harness: sensor
```

## samples/boards/bbc/microbit/display/sample.yaml
```yaml
sample:
  name: BB micro:bit Display
tests:
  sample.boards.bbc_microbit.display:
    platform_allow: bbc_microbit
    tags: display
```

## samples/boards/bbc/microbit/line_follower_robot/dts/bindings/motor-controller.yaml
```yaml
# Copyright (c) 2022 Nordic Semiconductor ASA
# SPDX-License-Identifier: Apache-2.0

description: Motor controller embedded in DFRobot Maqueen.

compatible: "motor-controller"

include: i2c-device.yaml
```

## samples/boards/bbc/microbit/line_follower_robot/sample.yaml
```yaml
sample:
  name: BBC micro:bit Line follower robot
tests:
  sample.boards.bbc_microbit.line_follower_robot:
    platform_allow: bbc_microbit
    tags:
      - microbit
      - line-follower
      - robot
      - car
```

## samples/boards/bbc/microbit/pong/sample.yaml
```yaml
sample:
  name: Pong game using BBC Micro:bit
tests:
  sample.boards.bbc_microbit.pong:
    platform_allow: bbc_microbit
    tags:
      - microbit
      - mesh
      - bluetooth
```
