## CMakeLists.txt
```
# SPDX-License-Identifier: Apache-2.0

cmake_minimum_required(VERSION 3.28.0)
find_package(Zephyr REQUIRED HINTS $ENV{ZEPHYR_BASE})
project(observer)

target_sources(app PRIVATE
  src/main.c
  src/observer.c
)
```

## sample.yaml
```
sample:
  name: Bluetooth Observer
common:
  harness: bluetooth
  tags:
    - bluetooth
tests:
  sample.bluetooth.observer:
    platform_allow:
      - qemu_cortex_m3
      - qemu_x86
      - lp_em_cc2340r5
      - lp_em_cc2340r5moda
      - lp_em_cc2340r53
      - lp_em_cc2340r53_wcsp
      - lp_em_cc2745r10_q1/cc2745r10_q1
      - lp_em_cc2745r10_q1/cc2755r10
      - lp_em_cc2755p10
      - lp_em_cc2755p20
      - nrf52840dk/nrf52840
      - cyw920829m2evk_02/cyw20829b0lkml
    integration_platforms:
      - qemu_cortex_m3
      - nrf52840dk/nrf52840
  sample.bluetooth.observer.extended:
    extra_args:
      - CONF_FILE="prj_extended.conf"
    platform_allow:
      - qemu_cortex_m3
      - qemu_x86
    integration_platforms:
      - qemu_cortex_m3
  sample.bluetooth.observer.extended.bt_ll_sw_split:
    extra_args:
      - CONF_FILE="prj_extended.conf"
      - EXTRA_CONF_FILE="overlay-bt_ll_sw_split.conf"
    platform_allow:
      - nrf52840dk/nrf52840
    integration_platforms:
      - nrf52840dk/nrf52840
  sample.bluetooth.observer.extended.bbc_microbit.bt_ll_sw_split:
    extra_args:
      - CONF_FILE="prj_extended.conf"
      - EXTRA_CONF_FILE="debug.conf;overlay_bbc_microbit-bt_ll_sw_split.conf"
    platform_allow:
      - bbc_microbit
    integration_platforms:
      - bbc_microbit
```

## prj.conf
```kconfig
CONFIG_BT=y
CONFIG_BT_OBSERVER=y
```

## debug.conf
```kconfig
# Enable thread analysis
CONFIG_THREAD_ANALYZER=y
CONFIG_THREAD_ANALYZER_AUTO=y
CONFIG_THREAD_ANALYZER_AUTO_INTERVAL=5
CONFIG_THREAD_NAME=y

# Every thread object has room for the longest name: 16 bytes hold the names
# of this sample's threads.
CONFIG_THREAD_MAX_NAME_LEN=16
```

## overlay-bt_ll_sw_split.conf
```kconfig
# Enable Extended Scanning
CONFIG_BT_EXT_ADV=y

# Zephyr Bluetooth LE Controller needs 16 event buffers to generate Extended
# Advertising Report for receiving the complete 1650 bytes of data
CONFIG_BT_BUF_EVT_RX_COUNT=10

# Use Zephyr Bluetooth Low Energy Controller implementation
CONFIG_BT_LL_SW_SPLIT=y

# Enable Coded PHY support in Zephyr Controller, if testing 4 advertising sets
CONFIG_BT_CTLR_PHY_CODED=y

# Set maximum scan data length for Extended Scanning in Bluetooth LE Controller
CONFIG_BT_CTLR_SCAN_DATA_LEN_MAX=1650

# Increase Zephyr Bluetooth LE Controller Rx buffer to receive complete chain
# of PDUs
CONFIG_BT_CTLR_RX_BUFFERS=9

# Code size reduction
CONFIG_ISR_TABLES_LOCAL_DECLARATION=y
CONFIG_LTO=y
```

## overlay_bbc_microbit-bt_ll_sw_split.conf
```kconfig
# Adjust Stack Sizes for reduce RAM usage
CONFIG_MAIN_STACK_SIZE=1024
CONFIG_IDLE_STACK_SIZE=128
# Extended scanning exercises deep controller ISR paths. 960 bytes keeps
# margin for them while making room for the host lock state in RAM.
CONFIG_ISR_STACK_SIZE=960
CONFIG_SYSTEM_WORKQUEUE_STACK_SIZE=448

CONFIG_BT_RX_STACK_SIZE=892

# The observer does not use the accelerometer, which is built in as soon as
# the sensor subsystem is on, which the clock calibration turns on, and brings
# the I2C driver with it.
CONFIG_FXOS8700=n

# Enable Extended Scanning
# CONFIG_BT_EXT_ADV=y

# Set maximum scan data length for Extended Scanning
CONFIG_BT_EXT_SCAN_BUF_SIZE=192

# Zephyr Bluetooth LE Controller needs 16 event buffers to generate Extended
# Advertising Report for receiving the complete 1650 bytes of data.
# Use 4 to be able to receive a minimal extended advertising with chains.
CONFIG_BT_BUF_EVT_RX_COUNT=4

# With the scan data length limited to 192 bytes below, the controller puts at
# most that much, after 26 bytes of report header, into one event.
CONFIG_BT_BUF_EVT_RX_SIZE=218

# What the controller receives with extended scanning it reports in buffers of
# the pool above. Nothing in this build produces discardable events, so their
# pool is as small as it can be.
CONFIG_BT_BUF_EVT_DISCARDABLE_COUNT=1
CONFIG_BT_BUF_EVT_DISCARDABLE_SIZE=58

# Use Zephyr Bluetooth Low Energy Controller implementation
CONFIG_BT_LL_SW_SPLIT=y

# Set maximum scan data length for Extended Scanning in Bluetooth LE Controller.
CONFIG_BT_CTLR_SCAN_DATA_LEN_MAX=192

# Increase Zephyr Bluetooth LE Controller Rx buffer to receive complete chain
# of PDUs. Need 9 for maximum of 1650 bytes, but we use 3 as minimum to receive
# at least a primary PDU, an auxiliary PDU and a chain PDU.
CONFIG_BT_CTLR_RX_BUFFERS=3

# Use link time optimization for code size reduction
CONFIG_ISR_TABLES_LOCAL_DECLARATION=y
CONFIG_LTO=y

# Generate .lst file, to find HCI h/w error event given PC
CONFIG_OUTPUT_DISASSEMBLY=y
CONFIG_OUTPUT_DISASSEMBLY_WITH_SOURCE=y
```

## prj_extended.conf
```kconfig
CONFIG_BT=y
CONFIG_BT_OBSERVER=y

# Enable Extended Scanning
CONFIG_BT_EXT_ADV=y
CONFIG_BT_EXT_SCAN_BUF_SIZE=1650
```

## dts/arm/nordic/override.dtsi
```dts
/* Keep default IRQ priority low for peripherals to reduce Radio ISR latency.
 * ARM Cortex-M4 lowest priority value of 5, i.e. considering Zephyr reserved 2
 * levels for Exceptions and ZLI (if enabled).
 * ARM Cortex-M0 lowest priority value of 3, i.e. we use it as Zephyr has no
 * support for ZLI on Cortex-M0.
 */
#define NRF_DEFAULT_IRQ_PRIORITY 3
```

## src/main.c
```c
/*
 * Copyright (c) 2022 Nordic Semiconductor ASA
 *
 * SPDX-License-Identifier: Apache-2.0
 */

#include <zephyr/sys/printk.h>
#include <zephyr/bluetooth/bluetooth.h>

int observer_start(void);

int main(void)
{
	int err;

	printk("Starting Observer Demo\n");

	/* Initialize the Bluetooth Subsystem */
	err = bt_enable(NULL);
	if (err) {
		printk("Bluetooth init failed (err %d)\n", err);
		return 0;
	}

	(void)observer_start();

	printk("Exiting %s thread.\n", __func__);
	return 0;
}
```

## src/observer.c
```c
/*
 * Copyright (c) 2022 Nordic Semiconductor ASA
 * Copyright (c) 2015-2016 Intel Corporation
 *
 * SPDX-License-Identifier: Apache-2.0
 */

#include <zephyr/sys/printk.h>
#include <zephyr/bluetooth/bluetooth.h>
#include <zephyr/bluetooth/hci.h>

static void device_found(const bt_addr_le_t *addr, int8_t rssi, uint8_t type,
			 struct net_buf_simple *ad)
{
#if !defined(CONFIG_BT_EXT_ADV)
	printk("Device found: %s (RSSI %d), type %u, AD data len %u\n",
	       bt_addr_le_str(addr), rssi, type, ad->len);
#endif /* !CONFIG_BT_EXT_ADV */
}

#if defined(CONFIG_BT_EXT_ADV)
#define NAME_LEN 30

static bool data_cb(struct bt_data *data, void *user_data)
{
	char *name = user_data;
	uint8_t len;

	switch (data->type) {
	case BT_DATA_NAME_SHORTENED:
	case BT_DATA_NAME_COMPLETE:
		len = MIN(data->data_len, NAME_LEN - 1);
		(void)memcpy(name, data->data, len);
		name[len] = '\0';
		return false;
	default:
		return true;
	}
}

static const char *phy2str(uint8_t phy)
{
	switch (phy) {
	case BT_GAP_LE_PHY_NONE: return "No packets";
	case BT_GAP_LE_PHY_1M: return "LE 1M";
	case BT_GAP_LE_PHY_2M: return "LE 2M";
	case BT_GAP_LE_PHY_CODED: return "LE Coded";
	default: return "Unknown";
	}
}

static void scan_recv(const struct bt_le_scan_recv_info *info,
		      struct net_buf_simple *buf)
{
	static uint32_t rx_cnt;
	char name[NAME_LEN];
	uint8_t data_status;
	uint16_t data_len;

	(void)memset(name, 0, sizeof(name));

	data_len = buf->len;
	bt_data_parse(buf, data_cb, name);

	data_status = BT_HCI_LE_ADV_EVT_TYPE_DATA_STATUS(info->adv_props);

	rx_cnt++;

	printk("%u. [DEVICE]: %s, AD evt type %u, Tx Pwr: %i, RSSI %i "
	       "Data status: %u, AD data len: %u Name: %s "
	       "C:%u S:%u D:%u SR:%u E:%u Pri PHY: %s, Sec PHY: %s, "
	       "Interval: 0x%04x (%u ms), SID: %u\n", rx_cnt,
	       bt_addr_le_str(info->addr), info->adv_type, info->tx_power, info->rssi,
	       data_status, data_len, name,
	       (info->adv_props & BT_GAP_ADV_PROP_CONNECTABLE) != 0,
	       (info->adv_props & BT_GAP_ADV_PROP_SCANNABLE) != 0,
	       (info->adv_props & BT_GAP_ADV_PROP_DIRECTED) != 0,
	       (info->adv_props & BT_GAP_ADV_PROP_SCAN_RESPONSE) != 0,
	       (info->adv_props & BT_GAP_ADV_PROP_EXT_ADV) != 0,
	       phy2str(info->primary_phy), phy2str(info->secondary_phy),
	       info->interval, info->interval * 5 / 4, info->sid);
}

static struct bt_le_scan_cb scan_callbacks = {
	.recv = scan_recv,
};
#endif /* CONFIG_BT_EXT_ADV */

static int scan_start(void)
{
	/* 30 ms continuous active scanning with duplicate filtering. */
	struct bt_le_scan_param scan_param = {
		.type       = BT_LE_SCAN_TYPE_ACTIVE,
		.options    = BT_LE_SCAN_OPT_NONE,
		.interval   = 0x0010,
		.window     = 0x0010,
	};
	int err;

#if defined(CONFIG_BT_EXT_ADV)
	scan_param.options |= BT_LE_SCAN_OPT_CODED;
#endif /* CONFIG_BT_EXT_ADV */

scan_start_retry:
	printk("Starting scanning...\n");
	err = bt_le_scan_start(&scan_param, device_found);
	if (err) {
		if ((scan_param.options & BT_LE_SCAN_OPT_CODED) != 0U) {
			printk("Failed to start scanning with Coded PHY (err %d), retrying "
			       "without...\n", err);

			scan_param.options &= ~BT_LE_SCAN_OPT_CODED;

			goto scan_start_retry;
		}

		printk("Start scanning failed (err %d)\n", err);

		return err;
	}

	printk("success.\n");

	return 0;
}

static struct k_work_delayable scan_stop_work;

static void scan_stop_timeout(struct k_work *work)
{
	int err;

	printk("Stopping scanning...\n");
	err = bt_le_scan_stop();
	if (err) {
		printk("Stop scanning failed (err %d)\n", err);
		return;
	}
	printk("Stopped scanning...\n");

	(void)scan_start();

	k_work_schedule(&scan_stop_work, K_SECONDS(5));
}

int observer_start(void)
{
	int err;

#if defined(CONFIG_BT_EXT_ADV)
	bt_le_scan_cb_register(&scan_callbacks);
	printk("Registered scan callbacks\n");
#endif /* CONFIG_BT_EXT_ADV */

	err = scan_start();
	if (err != 0) {
		return err;
	}

	k_work_init_delayable(&scan_stop_work, scan_stop_timeout);
	k_work_schedule(&scan_stop_work, K_MSEC(0));

	return 0;
}
```
