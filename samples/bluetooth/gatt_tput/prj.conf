## CMakeLists.txt
```
# SPDX-License-Identifier: Apache-2.0

cmake_minimum_required(VERSION 3.20.0)
find_package(Zephyr REQUIRED HINTS $ENV{ZEPHYR_BASE})
project(gatt_tput)

file(GLOB app_sources src/*.c)
target_sources(app PRIVATE ${app_sources})
```

## Kconfig
```
# Copyright (c) 2026 Infineon Technologies AG
# SPDX-License-Identifier: Apache-2.0

mainmenu "BLE GATT Throughput sample"

choice
	prompt "Application role"
	default APP_ROLE_PERIPHERAL
	help
	  Selects whether this image runs as the GATT server (peripheral,
	  advertises as "TPUT") or the GATT client (central). The same source
	  builds both roles; pick one per image.

config APP_ROLE_PERIPHERAL
	bool "Peripheral (GATT server, advertises as TPUT)"

config APP_ROLE_CENTRAL
	bool "Central (GATT client, connects to TPUT)"

endchoice

source "Kconfig.zephyr"
```

## prj.conf
```kconfig
# Common Bluetooth configuration
CONFIG_BT=y
CONFIG_BT_DEVICE_NAME="TPUT"
CONFIG_BT_DEVICE_APPEARANCE=0

# Default role: peripheral (GATT server; works with the tput_client Python
# client or any GATT client such as nRF Connect).
# Build the central image with: -DEXTRA_CONF_FILE=overlay-central.conf
CONFIG_APP_ROLE_PERIPHERAL=y
CONFIG_BT_PERIPHERAL=y

# Throughput-oriented link tuning: 2M PHY + Data Length Extension + large MTU
CONFIG_BT_USER_PHY_UPDATE=y
CONFIG_BT_USER_DATA_LEN_UPDATE=y
CONFIG_BT_AUTO_DATA_LEN_UPDATE=y
CONFIG_BT_DATA_LEN_UPDATE=y
CONFIG_BT_GATT_AUTO_UPDATE_MTU=y
CONFIG_BT_L2CAP_TX_MTU=247
CONFIG_BT_BUF_ACL_TX_SIZE=251
CONFIG_BT_BUF_ACL_RX_SIZE=255

# More in-flight TX buffers for higher throughput. BT_BUF_ACL_TX_COUNT sizes the
# host's per-packet completion contexts (and must match the controller's ACL
# buffer count); its default of 3 caps the real HCI pipeline depth.
CONFIG_BT_L2CAP_TX_BUF_COUNT=12
CONFIG_BT_BUF_ACL_TX_COUNT=12
CONFIG_BT_ATT_TX_COUNT=12
# HCI event RX buffers must exceed ACL TX buffers (host enforces this so command
# completions can drain while ACL TX is in flight).
CONFIG_BT_BUF_EVT_RX_COUNT=13

# Logging
CONFIG_LOG=y
```

## overlay-central.conf
```kconfig
# Central role overlay:
#   west build -b <board> samples/bluetooth/gatt_tput \
#       -- -DEXTRA_CONF_FILE=overlay-central.conf

# Switch role to central
CONFIG_APP_ROLE_CENTRAL=y

# Central needs scanning + connecting + GATT client; drop peripheral role
CONFIG_BT_CENTRAL=y
CONFIG_BT_OBSERVER=y
CONFIG_BT_GATT_CLIENT=y
CONFIG_BT_PERIPHERAL=n

# Interactive control shell (start/stop notify|write|both, throttle, status)
CONFIG_SHELL=y
CONFIG_SHELL_BACKEND_SERIAL=y
```

## src/main.c
```c
/*
 * Copyright (c) 2026 Infineon Technologies AG
 *
 * SPDX-License-Identifier: Apache-2.0
 */

#include <zephyr/kernel.h>
#include <zephyr/bluetooth/bluetooth.h>
#include <zephyr/logging/log.h>

#include "common.h"

LOG_MODULE_DECLARE(gatt_tput, LOG_LEVEL_INF);

int main(void)
{
	int err;

	err = bt_enable(NULL);
	if (err) {
		LOG_ERR("Bluetooth init failed (%d)", err);
		return 0;
	}

	LOG_INF("Bluetooth initialized");

	if (IS_ENABLED(CONFIG_APP_ROLE_PERIPHERAL)) {
		app_peripheral_start();
	} else {
		app_central_start();
	}

	return 0;
}
```

## src/central.c
```c
/*
 * Copyright (c) 2026 Infineon Technologies AG
 *
 * SPDX-License-Identifier: Apache-2.0
 *
 * Central role: scans for "TPUT", connects, discovers the throughput service,
 * and streams in either/both directions on demand (driven by the tput shell).
 * Used for the two-board (central <-> peripheral) test.
 */

#include <string.h>
#include <zephyr/kernel.h>
#include <zephyr/sys/byteorder.h>
#include <zephyr/bluetooth/bluetooth.h>
#include <zephyr/bluetooth/conn.h>
#include <zephyr/bluetooth/gatt.h>
#include <zephyr/bluetooth/uuid.h>
#include <zephyr/logging/log.h>

#include "common.h"

#ifdef CONFIG_APP_ROLE_CENTRAL

LOG_MODULE_DECLARE(gatt_tput, LOG_LEVEL_INF);

static struct bt_uuid_128 meas_svc_uuid = BT_UUID_INIT_128(TPUT_MEAS_SVC_BYTES);
static struct bt_uuid_128 notify_uuid = BT_UUID_INIT_128(TPUT_NOTIFY_CHR_BYTES);
static struct bt_uuid_128 writeme_uuid = BT_UUID_INIT_128(TPUT_WRITEME_CHR_BYTES);
static struct bt_uuid_128 diag_svc_uuid = BT_UUID_INIT_128(TPUT_DIAG_SVC_BYTES);
static struct bt_uuid_128 throttle_uuid = BT_UUID_INIT_128(TPUT_THROTTLE_CHR_BYTES);

static struct bt_conn *default_conn;
static K_MUTEX_DEFINE(conn_lock); /* guards default_conn against the BT RX thread */

static struct {
	uint16_t meas_start;
	uint16_t meas_end;
	uint16_t notify_value;
	uint16_t notify_ccc;
	uint16_t writeme_value;
	uint16_t diag_start;
	uint16_t diag_end;
	uint16_t throttle_value;
	bool ready;
} h;

enum discover_step {
	STEP_MEAS_SVC,
	STEP_NOTIFY_CHR,
	STEP_WRITEME_CHR,
	STEP_DIAG_SVC,
	STEP_THROTTLE_CHR,
	STEP_DONE,
};

static enum discover_step step;
static struct bt_gatt_discover_params disc;
static struct bt_gatt_subscribe_params sub;

static atomic_t write_on;
static K_SEM_DEFINE(wr_credits, APP_TX_CREDITS, APP_TX_CREDITS);
static uint8_t wr_buf[APP_MAX_PAYLOAD];

static void start_scan(void);
static void gatt_discover(void);
static struct bt_conn *conn_get(void);

bool app_central_ready(void)
{
	return h.ready && default_conn != NULL;
}

static uint8_t notify_func(struct bt_conn *conn, struct bt_gatt_subscribe_params *params,
			   const void *data, uint16_t length)
{
	ARG_UNUSED(conn);

	if (data == NULL) {
		params->value_handle = 0U;
		return BT_GATT_ITER_STOP;
	}

	atomic_add(&app_rx_bytes, length);
	return BT_GATT_ITER_CONTINUE;
}

static uint8_t discover_func(struct bt_conn *conn, const struct bt_gatt_attr *attr,
			     struct bt_gatt_discover_params *params)
{
	ARG_UNUSED(conn);
	ARG_UNUSED(params);

	if (attr == NULL) {
		LOG_WRN("Discovery step %d: attribute not found "
			"(meas %u-%u notify_val %u)",
			step, h.meas_start, h.meas_end, h.notify_value);
		return BT_GATT_ITER_STOP;
	}

	switch (step) {
	case STEP_MEAS_SVC: {
		struct bt_gatt_service_val *v = attr->user_data;

		h.meas_start = attr->handle + 1U;
		h.meas_end = v->end_handle;
		step = STEP_NOTIFY_CHR;
		break;
	}
	case STEP_NOTIFY_CHR:
		h.notify_value = bt_gatt_attr_value_handle(attr);
		/* CCC always follows the value in the peer's fixed layout; derive it
		 * instead of a descriptor discovery the AIROC peer fails to answer.
		 */
		h.notify_ccc = h.notify_value + 1U;
		step = STEP_WRITEME_CHR;
		break;
	case STEP_WRITEME_CHR:
		h.writeme_value = bt_gatt_attr_value_handle(attr);
		step = STEP_DIAG_SVC;
		break;
	case STEP_DIAG_SVC: {
		struct bt_gatt_service_val *v = attr->user_data;

		h.diag_start = attr->handle + 1U;
		h.diag_end = v->end_handle;
		step = STEP_THROTTLE_CHR;
		break;
	}
	case STEP_THROTTLE_CHR:
		h.throttle_value = bt_gatt_attr_value_handle(attr);
		step = STEP_DONE;
		break;
	default:
		return BT_GATT_ITER_STOP;
	}

	if (step == STEP_DONE) {
		h.ready = true;
		LOG_INF("Discovery complete - ready. Try: tput start both");
		return BT_GATT_ITER_STOP;
	}

	gatt_discover();
	return BT_GATT_ITER_STOP;
}

static void gatt_discover(void)
{
	int err;

	memset(&disc, 0, sizeof(disc));
	disc.func = discover_func;

	switch (step) {
	case STEP_MEAS_SVC:
		disc.uuid = &meas_svc_uuid.uuid;
		disc.type = BT_GATT_DISCOVER_PRIMARY;
		disc.start_handle = 0x0001;
		disc.end_handle = 0xffff;
		break;
	case STEP_NOTIFY_CHR:
		disc.uuid = &notify_uuid.uuid;
		disc.type = BT_GATT_DISCOVER_CHARACTERISTIC;
		disc.start_handle = h.meas_start;
		disc.end_handle = h.meas_end;
		break;
	case STEP_WRITEME_CHR:
		disc.uuid = &writeme_uuid.uuid;
		disc.type = BT_GATT_DISCOVER_CHARACTERISTIC;
		disc.start_handle = h.meas_start;
		disc.end_handle = h.meas_end;
		break;
	case STEP_DIAG_SVC:
		disc.uuid = &diag_svc_uuid.uuid;
		disc.type = BT_GATT_DISCOVER_PRIMARY;
		disc.start_handle = 0x0001;
		disc.end_handle = 0xffff;
		break;
	case STEP_THROTTLE_CHR:
		disc.uuid = &throttle_uuid.uuid;
		disc.type = BT_GATT_DISCOVER_CHARACTERISTIC;
		disc.start_handle = h.diag_start;
		disc.end_handle = h.diag_end;
		break;
	default:
		return;
	}

	err = bt_gatt_discover(default_conn, &disc);
	if (err) {
		LOG_ERR("Discover (step %d) failed (%d)", step, err);
	}
}

void app_central_set_notify(bool on)
{
	int err;
	struct bt_conn *conn = conn_get();

	if (conn == NULL || !h.ready) {
		if (conn != NULL) {
			bt_conn_unref(conn);
		}
		LOG_WRN("Not ready (no connection/discovery)");
		return;
	}

	if (on) {
		sub.notify = notify_func;
		sub.value_handle = h.notify_value;
		sub.ccc_handle = h.notify_ccc;
		sub.value = BT_GATT_CCC_NOTIFY;

		err = bt_gatt_subscribe(conn, &sub);
		if (err && err != -EALREADY) {
			LOG_ERR("Subscribe failed (%d)", err);
		} else {
			LOG_INF("Notify (RX) started");
		}
	} else {
		bt_gatt_unsubscribe(conn, &sub);
		LOG_INF("Notify (RX) stopped");
	}

	bt_conn_unref(conn);
}

void app_central_set_write(bool on)
{
	if (!app_central_ready()) {
		LOG_WRN("Not ready (no connection/discovery)");
		return;
	}

	atomic_set(&write_on, on ? 1 : 0);
	LOG_INF("Write (TX) %s", on ? "started" : "stopped");
}

void app_central_set_throttle(uint16_t kb_s)
{
	uint8_t val[2];
	int err;
	struct bt_conn *conn = conn_get();

	if (conn == NULL || !h.ready) {
		if (conn != NULL) {
			bt_conn_unref(conn);
		}
		LOG_WRN("Not ready (no connection/discovery)");
		return;
	}

	sys_put_le16(kb_s, val);
	err = bt_gatt_write_without_response(conn, h.throttle_value, val, sizeof(val), false);
	if (err) {
		LOG_ERR("Throttle write failed (%d)", err);
	} else {
		LOG_INF("Throttle set to %u KB/s", kb_s);
	}

	bt_conn_unref(conn);
}

static void write_done(struct bt_conn *conn, void *user_data)
{
	ARG_UNUSED(conn);
	ARG_UNUSED(user_data);
	k_sem_give(&wr_credits);
}

/* Take a reference to the live connection so it can't be freed while in use. */
static struct bt_conn *conn_get(void)
{
	struct bt_conn *conn = NULL;

	k_mutex_lock(&conn_lock, K_FOREVER);
	if (default_conn != NULL) {
		conn = bt_conn_ref(default_conn);
	}
	k_mutex_unlock(&conn_lock);
	return conn;
}

static void writer_thread(void)
{
	while (1) {
		if (!atomic_get(&write_on) || !app_central_ready()) {
			k_msleep(20);
			continue;
		}

		if (k_sem_take(&wr_credits, K_MSEC(100)) != 0) {
			continue;
		}

		struct bt_conn *conn = conn_get();

		if (conn == NULL) {
			k_sem_give(&wr_credits);
			k_msleep(1);
			continue;
		}

		uint16_t len = app_payload_len(conn);
		int err = bt_gatt_write_without_response_cb(conn, h.writeme_value, wr_buf, len,
							    false, write_done, NULL);

		bt_conn_unref(conn);

		if (err) {
			k_sem_give(&wr_credits);
			k_msleep(1);
			continue;
		}

		atomic_add(&app_tx_bytes, len);
	}
}

K_THREAD_DEFINE(writer_tid, 2048, writer_thread, NULL, NULL, NULL, K_PRIO_PREEMPT(7), 0, 0);

static bool ad_has_tput(struct bt_data *data, void *user_data)
{
	bool *match = user_data;

	if (data->type == BT_DATA_NAME_COMPLETE || data->type == BT_DATA_NAME_SHORTENED) {
		if (data->data_len == 4U && memcmp(data->data, "TPUT", 4) == 0) {
			*match = true;
			return false;
		}
	}

	return true;
}

static void scan_cb(const bt_addr_le_t *addr, int8_t rssi, uint8_t type, struct net_buf_simple *ad)
{
	struct bt_conn *conn = NULL;
	bool match = false;
	int err;

	ARG_UNUSED(rssi);
	ARG_UNUSED(type);

	if (default_conn != NULL) {
		return;
	}

	bt_data_parse(ad, ad_has_tput, &match);
	if (!match) {
		return;
	}

	if (bt_le_scan_stop()) {
		return;
	}

	err = bt_conn_le_create(addr, BT_CONN_LE_CREATE_CONN, BT_LE_CONN_PARAM(24, 40, 0, 400),
				&conn);
	if (err) {
		LOG_ERR("Create connection failed (%d)", err);
		start_scan();
		return;
	}

	k_mutex_lock(&conn_lock, K_FOREVER);
	default_conn = conn;
	k_mutex_unlock(&conn_lock);
}

static void start_scan(void)
{
	int err = bt_le_scan_start(BT_LE_SCAN_ACTIVE, scan_cb);

	if (err) {
		LOG_ERR("Scan start failed (%d)", err);
		return;
	}

	LOG_INF("Scanning for \"TPUT\"...");
}

static void connected(struct bt_conn *conn, uint8_t err)
{
	if (err) {
		struct bt_conn *old;

		LOG_ERR("Failed to connect (0x%02x)", err);
		k_mutex_lock(&conn_lock, K_FOREVER);
		old = default_conn;
		default_conn = NULL;
		k_mutex_unlock(&conn_lock);
		if (old != NULL) {
			bt_conn_unref(old);
		}
		start_scan();
		return;
	}

	LOG_INF("Connected");
	app_reset_totals();

	memset(&h, 0, sizeof(h));
	step = STEP_MEAS_SVC;
	gatt_discover();
}

static void disconnected(struct bt_conn *conn, uint8_t reason)
{
	ARG_UNUSED(conn);
	LOG_INF("Disconnected (0x%02x)", reason);

	h.ready = false;
	atomic_set(&write_on, 0);

	struct bt_conn *old;

	k_mutex_lock(&conn_lock, K_FOREVER);
	old = default_conn;
	default_conn = NULL;
	k_mutex_unlock(&conn_lock);
	if (old != NULL) {
		bt_conn_unref(old);
	}

	/* Reclaim credits held by in-flight writes that won't complete now. */
	for (int i = 0; i < APP_TX_CREDITS; i++) {
		k_sem_give(&wr_credits);
	}

	start_scan();
}

BT_CONN_CB_DEFINE(conn_callbacks) = {
	.connected = connected,
	.disconnected = disconnected,
};

void app_central_start(void)
{
	memset(wr_buf, 0x5A, sizeof(wr_buf));
	start_scan();
}

#endif /* CONFIG_APP_ROLE_CENTRAL */
```

## src/common.h
```c
/*
 * Copyright (c) 2026 Infineon Technologies AG
 *
 * SPDX-License-Identifier: Apache-2.0
 */

#ifndef GATT_TPUT_COMMON_H
#define GATT_TPUT_COMMON_H

#include <stdint.h>
#include <stdbool.h>
#include <zephyr/sys/atomic.h>
#include <zephyr/bluetooth/conn.h>

/*
 * Custom GATT contract. The 16-byte UUID arrays are little-endian, which is
 * exactly what BT_UUID_INIT_128() expects, and are shared with the Python
 * client (see tput_client/) so it can drive this firmware unchanged.
 */

/* Throughput Measurement service + Notify (TX) and WriteMe (RX) characteristics */
#define TPUT_MEAS_SVC_BYTES                                                                        \
	0xCC, 0x7B, 0xCB, 0x32, 0x07, 0x08, 0x17, 0xAF, 0xD3, 0x43, 0x1E, 0x5D, 0x20, 0x0D, 0xEC,  \
		0x1A
#define TPUT_NOTIFY_CHR_BYTES                                                                      \
	0x1E, 0x25, 0x21, 0x59, 0x67, 0x84, 0x78, 0x9E, 0x30, 0x4D, 0xE9, 0x91, 0x81, 0x13, 0xB0,  \
		0xF7
#define TPUT_WRITEME_CHR_BYTES                                                                     \
	0xC7, 0x58, 0xCF, 0x70, 0xB3, 0xAF, 0xE4, 0xAD, 0x65, 0x44, 0xA3, 0x85, 0x26, 0x7B, 0x70,  \
		0xD4

/* Diagnostics service + Throttle characteristic (1-2 byte LE target in KB/s) */
#define TPUT_DIAG_SVC_BYTES                                                                        \
	0xBD, 0x90, 0x93, 0xF5, 0x7A, 0xBC, 0x39, 0x85, 0xF6, 0x4B, 0xA9, 0x1C, 0xFF, 0x1C, 0x4E,  \
		0x6E
#define TPUT_THROTTLE_CHR_BYTES                                                                    \
	0x0C, 0xF3, 0xC4, 0x97, 0x70, 0x00, 0x7B, 0x97, 0x98, 0x4E, 0xB7, 0x77, 0x66, 0xFD, 0x40,  \
		0x19

/* Largest application payload the buffers can hold. With DLE=251 a 244-byte
 * value fits one LL PDU; 495 spans two (used when the ATT MTU is large enough).
 */
#define APP_MAX_PAYLOAD 495

/* ATT and L2CAP header overhead, and the two payload tiers. */
#define APP_ATT_HEADER_SIZE    3U
#define APP_L2CAP_HEADER_SIZE  4U
#define APP_DATA_PACKET_SIZE_1 244U /* one LL PDU  (251 - 4 - 3) */
#define APP_DATA_PACKET_SIZE_2 495U /* two LL PDUs (244 + 251)   */

/* In-flight ATT operation budget; keep <= CONFIG_BT_L2CAP_TX_BUF_COUNT. */
#define APP_TX_CREDITS 12

/* Throughput counters, updated by the active role and printed by the reporter. */
extern atomic_t app_tx_bytes;
extern atomic_t app_rx_bytes;

/* Reset cumulative totals (call on each new connection). */
void app_reset_totals(void);

/* Clamp an application payload to what the negotiated ATT MTU allows. */
uint16_t app_payload_len(struct bt_conn *conn);

/* Request 2M PHY and maximum data length on a fresh connection. */
void app_link_optimize(struct bt_conn *conn);

/* Role entry points (only the selected one is compiled in). */
void app_peripheral_start(void);
void app_central_start(void);

/* Central control API, invoked from the shell (central role only). */
void app_central_set_notify(bool on);
void app_central_set_write(bool on);
void app_central_set_throttle(uint16_t kb_s);
bool app_central_ready(void);

#endif /* GATT_TPUT_COMMON_H */
```

## src/peripheral.c
```c
/*
 * Copyright (c) 2026 Infineon Technologies AG
 *
 * SPDX-License-Identifier: Apache-2.0
 *
 * Peripheral role: GATT server exposing the custom "TPUT" throughput service
 * so a matching GATT client (see tput_client/) drives it unchanged.
 *
 * TX is dynamic:
 *   - payload size is chosen from the negotiated ATT MTU (3 tiers),
 *   - the number of notifications per connection event is derived from the live
 *     connection interval and PHY (airtime model), optionally throttled to a
 *     peer-requested rate,
 *   - notifications are pipelined with a fixed TX-credit budget and back off on
 *     congestion (-ENOMEM), resuming when a buffer frees.
 * RX has no special logic: written bytes are just accumulated for the report.
 */

#include <string.h>
#include <zephyr/kernel.h>
#include <zephyr/sys/util.h>
#include <zephyr/sys/byteorder.h>
#include <zephyr/bluetooth/bluetooth.h>
#include <zephyr/bluetooth/conn.h>
#include <zephyr/bluetooth/gatt.h>
#include <zephyr/bluetooth/hci.h>
#include <zephyr/bluetooth/uuid.h>
#include <zephyr/logging/log.h>

#include "common.h"

#ifdef CONFIG_APP_ROLE_PERIPHERAL

LOG_MODULE_DECLARE(gatt_tput, LOG_LEVEL_INF);

/* Airtime model constants. */
#define TIFS_US        150U
#define US_PER_BYTE_2M 4U
#define US_PER_BYTE_1M 8U
#define PENDING_CAP    255U

static struct bt_uuid_128 meas_svc_uuid = BT_UUID_INIT_128(TPUT_MEAS_SVC_BYTES);
static struct bt_uuid_128 notify_uuid = BT_UUID_INIT_128(TPUT_NOTIFY_CHR_BYTES);
static struct bt_uuid_128 writeme_uuid = BT_UUID_INIT_128(TPUT_WRITEME_CHR_BYTES);
static struct bt_uuid_128 diag_svc_uuid = BT_UUID_INIT_128(TPUT_DIAG_SVC_BYTES);
static struct bt_uuid_128 throttle_uuid = BT_UUID_INIT_128(TPUT_THROTTLE_CHR_BYTES);

static struct bt_conn *default_conn;
static K_MUTEX_DEFINE(conn_lock); /* guards default_conn against the BT RX thread */
static volatile bool notify_enabled;

/* Live link state driving the pacing model. */
static uint16_t conn_interval; /* units of 1.25 ms */
static uint8_t tx_phy = 1U;    /* 1 or 2 (Mbit/s) */
static uint16_t packet_size = APP_DATA_PACKET_SIZE_1;
static uint8_t max_packets_per_event;
static uint8_t notifications_per_event;
static uint16_t target_kb_s; /* raw Throttle value in KB/s; 0 = max */

/* Throttled pacing as fixed-point notifications/event (x1000) plus a carry so a
 * fractional rate enqueues zero on some events instead of rounding up to one.
 */
static uint32_t notif_rate_milli;
static uint32_t notif_accum_milli;

static atomic_t pending; /* notifications queued for this window */

static K_SEM_DEFINE(tx_credits, APP_TX_CREDITS, APP_TX_CREDITS);
static K_SEM_DEFINE(stream_wake, 0, 1);
static struct k_timer notif_timer;
static uint8_t stream_buf[APP_MAX_PAYLOAD];

/* 3-tier payload selection from the negotiated ATT MTU. */
static uint16_t notif_packet_size(uint16_t mtu)
{
	if (mtu < APP_DATA_PACKET_SIZE_1 + APP_ATT_HEADER_SIZE) {
		return mtu - APP_ATT_HEADER_SIZE;
	}

	if (mtu < APP_DATA_PACKET_SIZE_2 + APP_ATT_HEADER_SIZE) {
		return APP_DATA_PACKET_SIZE_1;
	}

	return APP_DATA_PACKET_SIZE_2;
}

/* Recompute max packets/event (airtime) and notifications/event (throttle). */
static void calc_pacing(void)
{
	if (default_conn == NULL || conn_interval == 0U) {
		max_packets_per_event = 0U;
		notifications_per_event = 0U;
		notif_rate_milli = 0U;
		return;
	}

	uint32_t per_byte = (tx_phy == 2U) ? US_PER_BYTE_2M : US_PER_BYTE_1M;
	uint32_t ci_us = (uint32_t)conn_interval * 1250U;
	uint8_t preamble = (tx_phy == 2U) ? 2U : 1U;

	/* On-air bytes: preamble + AA(4) + LL(2) + L2CAP(4) + ATT hdr(3) + payload + CRC(3). */
	uint16_t notif_air =
		preamble + 4U + 2U + APP_L2CAP_HEADER_SIZE + APP_ATT_HEADER_SIZE + packet_size + 3U;
	uint16_t empty_air = preamble + 4U + 2U + 3U;

	uint32_t t_txn =
		TIFS_US + (uint32_t)notif_air * per_byte + TIFS_US + (uint32_t)empty_air * per_byte;

	max_packets_per_event = (uint8_t)(ci_us / t_txn);

	if (target_kb_s > 0U) {
		/* target is KB/s; x8 -> kbps. Fixed-point notifications/event (x1000) so a
		 * fractional rate can enqueue zero on some events instead of being rounded
		 * up to one, which would overshoot low targets.
		 */
		uint32_t kbps = (uint32_t)target_kb_s * 8U;
		uint32_t payload = (packet_size > 0U) ? packet_size : 1U;
		uint64_t num = (uint64_t)kbps * conn_interval * 5U;
		uint32_t den = payload * 32U;

		notif_rate_milli = (uint32_t)((num * 1000U + den / 2U) / den);
	} else {
		notif_rate_milli = (uint32_t)max_packets_per_event * 1000U;
	}

	uint32_t max_milli = (uint32_t)max_packets_per_event * 1000U;

	if (notif_rate_milli > max_milli) {
		notif_rate_milli = max_milli;
	}
	notifications_per_event = (uint8_t)((notif_rate_milli + 500U) / 1000U);

	LOG_INF("Pacing: max/evt=%u notif/evt=%u PHY=%uM interval=%u.%02ums payload=%u",
		max_packets_per_event, notifications_per_event, tx_phy,
		(conn_interval * 125U) / 100U, (conn_interval * 125U) % 100U, packet_size);
}

static void notif_timer_expiry(struct k_timer *timer)
{
	ARG_UNUSED(timer);

	if (!notify_enabled || default_conn == NULL) {
		return;
	}

	uint8_t add;

	if (notif_rate_milli == 0U) {
		/* Pacing not computed yet: fall back to a full credit window. */
		add = APP_TX_CREDITS;
	} else {
		notif_accum_milli += notif_rate_milli;
		add = (uint8_t)MIN(notif_accum_milli / 1000U, (uint32_t)PENDING_CAP);
		notif_accum_milli -= (uint32_t)add * 1000U;
	}

	if (add == 0U) {
		/* Fractional target: this event enqueues nothing. */
		return;
	}

	if ((uint32_t)atomic_add(&pending, add) + add > PENDING_CAP) {
		atomic_set(&pending, PENDING_CAP);
	}

	k_sem_give(&stream_wake);
}

static void timer_restart(void)
{
	uint32_t period_us = (conn_interval != 0U) ? (uint32_t)conn_interval * 1250U : 30000U;

	k_timer_start(&notif_timer, K_USEC(period_us), K_USEC(period_us));
}

static void notify_ccc_cfg_changed(const struct bt_gatt_attr *attr, uint16_t value)
{
	ARG_UNUSED(attr);
	notify_enabled = (value == BT_GATT_CCC_NOTIFY);
	LOG_INF("Notifications %s", notify_enabled ? "enabled" : "disabled");

	if (notify_enabled) {
		atomic_set(&pending, 0);
		notif_accum_milli = 0U;
		calc_pacing();
		timer_restart();
		k_sem_give(&stream_wake);
	} else {
		k_timer_stop(&notif_timer);
		atomic_set(&pending, 0);
	}
}

static ssize_t writeme_write(struct bt_conn *conn, const struct bt_gatt_attr *attr, const void *buf,
			     uint16_t len, uint16_t offset, uint8_t flags)
{
	ARG_UNUSED(conn);
	ARG_UNUSED(attr);
	ARG_UNUSED(buf);
	ARG_UNUSED(offset);
	ARG_UNUSED(flags);

	/* RX: no special logic, just accumulate the byte count. */
	atomic_add(&app_rx_bytes, len);
	return len;
}

static ssize_t throttle_read(struct bt_conn *conn, const struct bt_gatt_attr *attr, void *buf,
			     uint16_t len, uint16_t offset)
{
	uint16_t val = sys_cpu_to_le16(target_kb_s);

	return bt_gatt_attr_read(conn, attr, buf, len, offset, &val, sizeof(val));
}

static ssize_t throttle_write(struct bt_conn *conn, const struct bt_gatt_attr *attr,
			      const void *buf, uint16_t len, uint16_t offset, uint8_t flags)
{
	const uint8_t *p = buf;

	ARG_UNUSED(conn);
	ARG_UNUSED(attr);
	ARG_UNUSED(flags);

	if (offset != 0) {
		return BT_GATT_ERR(BT_ATT_ERR_INVALID_OFFSET);
	}

	if (len == 1U) {
		target_kb_s = p[0];
	} else if (len == 2U) {
		target_kb_s = sys_get_le16(p);
	} else {
		return BT_GATT_ERR(BT_ATT_ERR_INVALID_ATTRIBUTE_LEN);
	}

	LOG_INF("Throttle target = %u KB/s (0 = max)", target_kb_s);
	calc_pacing();
	return len;
}

BT_GATT_SERVICE_DEFINE(tput_meas_svc, BT_GATT_PRIMARY_SERVICE(&meas_svc_uuid),
		       BT_GATT_CHARACTERISTIC(&notify_uuid.uuid, BT_GATT_CHRC_NOTIFY,
					      BT_GATT_PERM_NONE, NULL, NULL, NULL),
		       BT_GATT_CCC(notify_ccc_cfg_changed, BT_GATT_PERM_READ | BT_GATT_PERM_WRITE),
		       BT_GATT_CHARACTERISTIC(&writeme_uuid.uuid,
					      BT_GATT_CHRC_WRITE | BT_GATT_CHRC_WRITE_WITHOUT_RESP,
					      BT_GATT_PERM_WRITE, NULL, writeme_write, NULL));

BT_GATT_SERVICE_DEFINE(diag_svc, BT_GATT_PRIMARY_SERVICE(&diag_svc_uuid),
		       BT_GATT_CHARACTERISTIC(&throttle_uuid.uuid,
					      BT_GATT_CHRC_READ | BT_GATT_CHRC_WRITE |
						      BT_GATT_CHRC_WRITE_WITHOUT_RESP,
					      BT_GATT_PERM_READ | BT_GATT_PERM_WRITE, throttle_read,
					      throttle_write, NULL));

/* attrs[1] is the Notify characteristic declaration; bt_gatt_notify uses its value. */
#define NOTIFY_ATTR (&tput_meas_svc.attrs[1])

static void notify_sent(struct bt_conn *conn, void *user_data)
{
	ARG_UNUSED(conn);
	ARG_UNUSED(user_data);

	/* Free one credit and nudge the stream thread (congestion recovery). */
	k_sem_give(&tx_credits);
	k_sem_give(&stream_wake);
}

/* Take a reference to the live connection so it can't be freed while in use. */
static struct bt_conn *conn_get(void)
{
	struct bt_conn *conn = NULL;

	k_mutex_lock(&conn_lock, K_FOREVER);
	if (default_conn != NULL) {
		conn = bt_conn_ref(default_conn);
	}
	k_mutex_unlock(&conn_lock);
	return conn;
}

static void stream_thread(void)
{
	while (1) {
		if (!notify_enabled || default_conn == NULL) {
			k_sem_take(&stream_wake, K_FOREVER);
			continue;
		}

		if (atomic_get(&pending) == 0) {
			k_sem_take(&stream_wake, K_MSEC(100));
			continue;
		}

		struct bt_conn *conn = conn_get();

		if (conn == NULL) {
			continue;
		}

		/* Resolve the conn ref and usable ATT MTU once, then drain the whole
		 * available TX-credit window in a tight burst. Keeping the conn mutex /
		 * ref / get_mtu overhead out of the per-packet path lets the connection
		 * event fill up before it closes.
		 */
		uint16_t mtu = bt_gatt_get_mtu(conn);
		uint16_t max_payload =
			(mtu > APP_ATT_HEADER_SIZE) ? (mtu - APP_ATT_HEADER_SIZE) : 20U;
		uint16_t len = MIN(packet_size, max_payload);

		while (notify_enabled && atomic_get(&pending) > 0 &&
		       k_sem_take(&tx_credits, K_NO_WAIT) == 0) {
			struct bt_gatt_notify_params params = {
				.attr = NOTIFY_ATTR,
				.data = stream_buf,
				.len = len,
				.func = notify_sent,
			};

			int err = bt_gatt_notify_cb(conn, &params);

			if (err) {
				/* -ENOMEM = congested: give the credit back and end the
				 * burst; a freed buffer or the next tick re-wakes us.
				 */
				k_sem_give(&tx_credits);
				if (err != -ENOMEM) {
					LOG_WRN("notify failed (%d)", err);
				}
				break;
			}

			atomic_dec(&pending);
			atomic_add(&app_tx_bytes, len);
		}

		bt_conn_unref(conn);

		/* Burst done (credits exhausted, queue drained, or congested): wait for
		 * a credit to free (notify_sent) or the next timer tick.
		 */
		k_sem_take(&stream_wake, K_MSEC(10));
	}
}

K_THREAD_DEFINE(stream_tid, 2048, stream_thread, NULL, NULL, NULL, K_PRIO_PREEMPT(7), 0, 0);

static const struct bt_data ad[] = {
	BT_DATA_BYTES(BT_DATA_FLAGS, (BT_LE_AD_GENERAL | BT_LE_AD_NO_BREDR)),
	BT_DATA(BT_DATA_NAME_COMPLETE, "TPUT", 4),
};

static void adv_start(void)
{
	int err = bt_le_adv_start(BT_LE_ADV_CONN_FAST_1, ad, ARRAY_SIZE(ad), NULL, 0);

	if (err) {
		LOG_ERR("Advertising failed to start (%d)", err);
		return;
	}

	LOG_INF("Advertising as \"TPUT\"");
}

/* Restart advertising once the disconnected connection object is fully recycled;
 * restarting from the disconnected callback can return -ENOMEM because the
 * connection has not been freed yet.
 */
static void recycled_cb(void)
{
	adv_start();
}

static void mtu_updated(struct bt_conn *conn, uint16_t tx, uint16_t rx)
{
	ARG_UNUSED(conn);
	/* Effective ATT MTU is symmetric = min(tx, rx); use it to size notifications. */
	uint16_t mtu = MIN(tx, rx);

	packet_size = notif_packet_size(mtu);
	LOG_INF("ATT MTU updated: tx=%u rx=%u -> payload=%u", tx, rx, packet_size);
	calc_pacing();
}

static struct bt_gatt_cb gatt_callbacks = {
	.att_mtu_updated = mtu_updated,
};

static void connected(struct bt_conn *conn, uint8_t err)
{
	struct bt_conn_info info;

	if (err) {
		LOG_ERR("Connection failed (0x%02x)", err);
		return;
	}

	k_mutex_lock(&conn_lock, K_FOREVER);
	default_conn = bt_conn_ref(conn);
	k_mutex_unlock(&conn_lock);
	LOG_INF("Connected");
	app_reset_totals();

	if (bt_conn_get_info(conn, &info) == 0 && info.type == BT_CONN_TYPE_LE) {
		conn_interval = (uint16_t)(info.le.interval_us / 1250U);
		tx_phy = (info.le.phy->tx_phy == BT_GAP_LE_PHY_2M) ? 2U : 1U;
	}

	packet_size = notif_packet_size(bt_gatt_get_mtu(conn));
	calc_pacing();
	app_link_optimize(conn);
}

static void le_param_updated(struct bt_conn *conn, uint16_t interval, uint16_t latency,
			     uint16_t timeout)
{
	ARG_UNUSED(conn);
	ARG_UNUSED(latency);
	ARG_UNUSED(timeout);

	conn_interval = interval;
	calc_pacing();

	if (notify_enabled) {
		timer_restart();
	}
}

static void le_phy_updated(struct bt_conn *conn, struct bt_conn_le_phy_info *param)
{
	ARG_UNUSED(conn);
	tx_phy = (param->tx_phy == BT_GAP_LE_PHY_2M) ? 2U : 1U;
	calc_pacing();
}

static void disconnected(struct bt_conn *conn, uint8_t reason)
{
	ARG_UNUSED(conn);
	LOG_INF("Disconnected (0x%02x)", reason);

	notify_enabled = false;
	k_timer_stop(&notif_timer);
	atomic_set(&pending, 0);
	conn_interval = 0U;

	struct bt_conn *old;

	k_mutex_lock(&conn_lock, K_FOREVER);
	old = default_conn;
	default_conn = NULL;
	k_mutex_unlock(&conn_lock);
	if (old != NULL) {
		bt_conn_unref(old);
	}

	/* Reclaim credits held by in-flight notifications that won't complete now. */
	for (int i = 0; i < APP_TX_CREDITS; i++) {
		k_sem_give(&tx_credits);
	}
}

BT_CONN_CB_DEFINE(conn_callbacks) = {
	.connected = connected,
	.disconnected = disconnected,
	.recycled = recycled_cb,
	.le_param_updated = le_param_updated,
	.le_phy_updated = le_phy_updated,
};

void app_peripheral_start(void)
{
	for (size_t i = 0; i < sizeof(stream_buf); i++) {
		stream_buf[i] = (uint8_t)i;
	}

	k_timer_init(&notif_timer, notif_timer_expiry, NULL);
	bt_gatt_cb_register(&gatt_callbacks);
	adv_start();
}

#endif /* CONFIG_APP_ROLE_PERIPHERAL */
```

## src/tput_common.c
```c
/*
 * Copyright (c) 2026 Infineon Technologies AG
 *
 * SPDX-License-Identifier: Apache-2.0
 *
 * Shared helpers: throughput counters, a once-per-second reporter thread, and
 * per-connection link tuning (2M PHY + Data Length Extension).
 */

#include <zephyr/kernel.h>
#include <zephyr/sys/util.h>
#include <zephyr/bluetooth/gatt.h>
#include <zephyr/logging/log.h>

#include "common.h"

LOG_MODULE_REGISTER(gatt_tput, LOG_LEVEL_INF);

atomic_t app_tx_bytes;
atomic_t app_rx_bytes;

static uint32_t total_tx; /* cumulative TX bytes for this session */
static uint32_t total_rx; /* cumulative RX bytes for this session */

void app_reset_totals(void)
{
	total_tx = 0U;
	total_rx = 0U;
	atomic_clear(&app_tx_bytes);
	atomic_clear(&app_rx_bytes);
}

uint16_t app_payload_len(struct bt_conn *conn)
{
	uint16_t mtu = bt_gatt_get_mtu(conn);
	uint16_t len;

	/* ATT notification/write payload = MTU - 3 byte ATT header. */
	if (mtu < 23U) {
		mtu = 23U;
	}

	len = mtu - 3U;

	return MIN(len, APP_MAX_PAYLOAD);
}

void app_link_optimize(struct bt_conn *conn)
{
	int err;

	err = bt_conn_le_phy_update(conn, BT_CONN_LE_PHY_PARAM_2M);
	if (err) {
		LOG_WRN("PHY update request failed (%d)", err);
	}

	err = bt_conn_le_data_len_update(conn, BT_LE_DATA_LEN_PARAM_MAX);
	if (err) {
		LOG_WRN("Data length update request failed (%d)", err);
	}
}

static void report_thread(void)
{
	while (1) {
		k_sleep(K_SECONDS(1));

		uint32_t tx = atomic_clear(&app_tx_bytes);
		uint32_t rx = atomic_clear(&app_rx_bytes);

		if (tx == 0U && rx == 0U) {
			continue;
		}

		total_tx += tx;
		total_rx += rx;

		/* bytes/s -> kbps with 3 decimals so sub-kbps rates aren't rounded to 0. */
		uint32_t tx_bits = tx * 8U;
		uint32_t rx_bits = rx * 8U;

		LOG_INF("Throughput  TX = %u.%03u kbps   RX = %u.%03u kbps   [total TX=%u B  RX=%u "
			"B]",
			tx_bits / 1000U, tx_bits % 1000U, rx_bits / 1000U, rx_bits % 1000U,
			total_tx, total_rx);
	}
}

K_THREAD_DEFINE(app_report_tid, 1024, report_thread, NULL, NULL, NULL,
		K_LOWEST_APPLICATION_THREAD_PRIO, 0, 0);
```

## src/tput_shell.c
```c
/*
 * Copyright (c) 2026 Infineon Technologies AG
 *
 * SPDX-License-Identifier: Apache-2.0
 *
 * Interactive "tput" shell for the central role, mirroring the host client's
 * buttons for the two-board test.
 */

#include <stdlib.h>
#include <string.h>
#include <zephyr/shell/shell.h>

#include "common.h"

#ifdef CONFIG_APP_ROLE_CENTRAL

static int set_target(const struct shell *sh, const char *what, bool on)
{
	if (strcmp(what, "notify") == 0) {
		app_central_set_notify(on);
	} else if (strcmp(what, "write") == 0) {
		app_central_set_write(on);
	} else if (strcmp(what, "both") == 0) {
		app_central_set_notify(on);
		app_central_set_write(on);
	} else {
		shell_error(sh, "expected: notify | write | both");
		return -EINVAL;
	}

	return 0;
}

static int cmd_start(const struct shell *sh, size_t argc, char **argv)
{
	return set_target(sh, argv[1], true);
}

static int cmd_stop(const struct shell *sh, size_t argc, char **argv)
{
	return set_target(sh, argv[1], false);
}

static int cmd_throttle(const struct shell *sh, size_t argc, char **argv)
{
	char *end;
	unsigned long kb_s = strtoul(argv[1], &end, 10);

	if (end == argv[1] || *end != '\0' || kb_s > UINT16_MAX) {
		shell_error(sh, "invalid KB/s value (expected 0-65535)");
		return -EINVAL;
	}

	app_central_set_throttle((uint16_t)kb_s);
	return 0;
}

static int cmd_status(const struct shell *sh, size_t argc, char **argv)
{
	ARG_UNUSED(argc);
	ARG_UNUSED(argv);

	shell_print(sh, "connected+discovered: %s", app_central_ready() ? "yes" : "no");
	return 0;
}

SHELL_STATIC_SUBCMD_SET_CREATE(
	tput_cmds, SHELL_CMD_ARG(start, NULL, "start notify|write|both", cmd_start, 2, 0),
	SHELL_CMD_ARG(stop, NULL, "stop notify|write|both", cmd_stop, 2, 0),
	SHELL_CMD_ARG(throttle, NULL, "throttle <KB/s> (0 = max)", cmd_throttle, 2, 0),
	SHELL_CMD_ARG(status, NULL, "show link/discovery status", cmd_status, 1, 0),
	SHELL_SUBCMD_SET_END);

SHELL_CMD_REGISTER(tput, &tput_cmds, "BLE throughput control", NULL);

#endif /* CONFIG_APP_ROLE_CENTRAL */
```
