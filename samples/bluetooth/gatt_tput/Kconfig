## samples/bluetooth/gatt_tput/Kconfig
```kconfig
# Copyright (c) 2026 Infineon Technologies AG
# SPDX-License-Identifier: Apache-2.0

mainmenu "BLE GATT Throughput sample"

choice
	prompt "Application role"
	default APP_ROLE_PERIPHERAL
	help
	  Selects whether this image runs as the GATT server (peripheral,
	  advertises as "TPUT") or the GATT client (central). The same source
	  builds both roles; pick one per image.

config APP_ROLE_PERIPHERAL
	bool "Peripheral (GATT server, advertises as TPUT)"

config APP_ROLE_CENTRAL
	bool "Central (GATT client, connects to TPUT)"

endchoice

source "Kconfig.zephyr"
```

## samples/bluetooth/mesh/sample.yaml
```yaml
sample:
  name: Bluetooth Mesh
tests:
  sample.bluetooth.mesh:
    harness: bluetooth
    platform_allow:
      - bbc_microbit
      - qemu_x86
      - lp_em_cc2340r53
      - lp_em_cc2340r53_wcsp
      - lp_em_cc2340r5moda
      - lp_em_cc2745r10_q1/cc2745r10_q1
      - lp_em_cc2745r10_q1/cc2755r10
      - lp_em_cc2755p10
      - lp_em_cc2755p20
      - nrf52840dk/nrf52840
      - nrf5340dk/nrf5340/cpuapp/ns
    integration_platforms:
      - qemu_x86
    tags: bluetooth
```

## samples/bluetooth/mesh_demo/boards/esp32c6_devkitc_esp32c6_hpcore.conf
```kconfig
CONFIG_MAIN_STACK_SIZE=2048
CONFIG_SYSTEM_WORKQUEUE_STACK_SIZE=2560
CONFIG_BT_MESH_SETTINGS_WORKQ_STACK_SIZE=1536
```

## samples/bluetooth/mesh_provisioner/sample.yaml
```yaml
sample:
  name: Bluetooth Mesh Provisioner
tests:
  sample.bluetooth.mesh_provisioner:
    harness: bluetooth
    platform_allow:
      - qemu_x86
      - lp_em_cc2340r53
      - lp_em_cc2340r53_wcsp
      - lp_em_cc2745r10_q1/cc2745r10_q1
      - lp_em_cc2745r10_q1/cc2755r10
      - lp_em_cc2755p10
      - nrf52840dk/nrf52840
      - nrf5340dk/nrf5340/cpuapp/ns
    integration_platforms:
      - qemu_x86
    tags: bluetooth
```

## samples/bluetooth/observer/sample.yaml
```yaml
sample:
  name: Bluetooth Observer
common:
  harness: bluetooth
  tags:
    - bluetooth
tests:
  sample.bluetooth.observer:
    platform_allow:
      - qemu_cortex_m3
      - qemu_x86
      - lp_em_cc2340r5
      - lp_em_cc2340r5moda
      - lp_em_cc2340r53
      - lp_em_cc2340r53_wcsp
      - lp_em_cc2745r10_q1/cc2745r10_q1
      - lp_em_cc2745r10_q1/cc2755r10
      - nrf52840dk/nrf52840
      - cyw920829m2evk_02/cyw20829b0lkml
    integration_platforms:
      - qemu_cortex_m3
      - nrf52840dk/nrf52840
  sample.bluetooth.observer.extended:
    extra_args:
      - CONF_FILE="prj_extended.conf"
    platform_allow:
      - qemu_cortex_m3
      - qemu_x86
    integration_platforms:
      - qemu_cortex_m3
  sample.bluetooth.observer.extended.bt_ll_sw_split:
    extra_args:
      - CONF_FILE="prj_extended.conf"
      - EXTRA_CONF_FILE="overlay-bt_ll_sw_split.conf"
    platform_allow:
      - nrf52840dk/nrf52840
    integration_platforms:
      - nrf52840dk/nrf52840
  sample.bluetooth.observer.extended.bbc_microbit.bt_ll_sw_split:
    extra_args:
      - CONF_FILE="prj_extended.conf"
      - EXTRA_CONF_FILE="debug.conf;overlay_bbc_microbit-bt_ll_sw_split.conf"
    platform_allow:
      - bbc_microbit
    integration_platforms:
      - bbc_microbit
```

## samples/bluetooth/periodic_adv/sample.yaml
```yaml
sample:
  name: Bluetooth Periodic Advertising
tests:
  sample.bluetooth.periodic_adv:
    harness: bluetooth
    platform_allow:
      - qemu_cortex_m3
      - qemu_x86
      - lp_em_cc2340r5
      - lp_em_cc2340r53
      - lp_em_cc2745r10_q1/cc2745r10_q1
      - lp_em_cc2745r10_q1/cc2755r10
      - nrf52_bsim
      - nrf52dk/nrf52832
    tags: bluetooth
    integration_platforms:
      - qemu_cortex_m3
```

## samples/bluetooth/periodic_adv_conn/Kconfig
```kconfig
#
# Copyright The Zephyr Project Contributors
#
# SPDX-License-Identifier: Apache-2.0
#

mainmenu "Bluetooth: Periodic Advertising Connection"

config SAMPLE_PERIODIC_ADV_CONN_PEER_NAME
	string "Periodic synchronization connection peer name"
	default "PAwR sync conn sample"
	help
	  Device name advertised by the peer that this sample connects to
	  before starting Periodic Advertising with Responses.

source "Kconfig.zephyr"
```

## samples/bluetooth/periodic_adv_rsp/sample.yaml
```yaml
sample:
  name: Bluetooth Periodic Advertising with Responses Advertiser
tests:
  sample.bluetooth.periodic_adv_rsp:
    harness: bluetooth
    platform_allow:
      - qemu_cortex_m3
      - qemu_x86
      - lp_em_cc2340r5
      - lp_em_cc2340r53
      - lp_em_cc2745r10_q1/cc2745r10_q1
      - lp_em_cc2745r10_q1/cc2755r10
    tags: bluetooth
    integration_platforms:
      - qemu_cortex_m3
```

## samples/bluetooth/periodic_sync_conn/Kconfig
```kconfig
#
# Copyright The Zephyr Project Contributors
#
# SPDX-License-Identifier: Apache-2.0
#

mainmenu "Bluetooth: Periodic Advertising Synchronization Connection"

config SAMPLE_PERIODIC_SYNC_CONN_PEER_NAME
	string "Periodic advertising connection peer name"
	default "PAwR conn sample"
	help
	  Device name advertised by the peer that this sample synchronizes
	  to after the initial regular connection.

source "Kconfig.zephyr"
```

## samples/bluetooth/periodic_sync_conn/sample.yaml
```yaml
sample:
  name: Bluetooth Periodic Advertising Connection Procedure
tests:
  sample.bluetooth.periodic_sync_conn:
    harness: bluetooth
    platform_allow:
      - qemu_cortex_m3
      - qemu_x86
      - lp_em_cc2340r5moda
      - lp_em_cc2340r53
      - lp_em_cc2340r53_wcsp
      - lp_em_cc2745r10_q1/cc2745r10_q1
      - lp_em_cc2745r10_q1/cc2755r10
      - lp_em_cc2755p10
      - lp_em_cc2755p20
    tags: bluetooth
    integration_platforms:
      - qemu_cortex_m3
```

## samples/bluetooth/peripheral_gatt_write/sample.yaml
```yaml
sample:
  name: Bluetooth Peripheral GATT Write
tests:
  sample.bluetooth.peripheral_gatt_write:
    harness: bluetooth
    platform_allow:
      - qemu_cortex_m3
      - qemu_x86
      - lp_em_cc2340r5moda
      - lp_em_cc2340r53
      - lp_em_cc2340r53_wcsp
      - lp_em_cc2745r10_q1/cc2745r10_q1
      - lp_em_cc2745r10_q1/cc2755r10
      - lp_em_cc2755p10
      - lp_em_cc2755p20
      - nrf52_bsim
    tags: bluetooth
    integration_platforms:
      - qemu_cortex_m3
```

## samples/bluetooth/peripheral_hogp/Kconfig
```kconfig
# Copyright (c) 2026 Xiaomi Corporation
# SPDX-License-Identifier: Apache-2.0

mainmenu "Bluetooth: HID over GATT Profile Device"

config SAMPLE_BT_USE_AUTHENTICATION
	bool "Require an authenticated link"
	help
	  Request Security Level 3 instead of Level 2 and register the passkey
	  display callback, so that the bond is protected against a
	  Man-In-The-Middle attack. HOGP only requires an encrypted link, so
	  this is stricter than the profile asks for.

source "Kconfig.zephyr"
```

## samples/bluetooth/scan_adv/sample.yaml
```yaml
sample:
  name: Bluetooth Scan & Advertise
  description: Demonstrates combined Bluetooth LE Broadcaster & Observer role functionality
tests:
  sample.bluetooth.scan_adv:
    harness: bluetooth
    platform_allow:
      - qemu_cortex_m3
      - qemu_x86
      - cyw920829m2evk_02/cyw20829b0lkml
      - lp_em_cc2340r5
      - lp_em_cc2340r5moda
      - lp_em_cc2340r53
      - lp_em_cc2340r53_wcsp
      - lp_em_cc2745r10_q1/cc2745r10_q1
      - lp_em_cc2745r10_q1/cc2755r10
    tags: bluetooth
    integration_platforms:
      - qemu_cortex_m3
```

## samples/boards/infineon/autanalog/multi_seq/Kconfig
```kconfig
# SPDX-FileCopyrightText: Copyright (c) 2026 Infineon Technologies AG,
# SPDX-FileCopyrightText: or an affiliate of Infineon Technologies AG. All rights reserved.
#
# SPDX-License-Identifier: Apache-2.0

mainmenu "Infineon AutAnalog SAR multi-sequencer sample"

source "Kconfig.zephyr"

config SAMPLE_ADC_CALIBRATE_REQUIRED
	bool "Require calibrate field in ADC"
	help
	  Set the calibrate field in the ADC sequence so a calibration is
	  performed before the read.
```
