## samples/bluetooth/broadcast_audio_source/sample.yaml
```yaml
sample:
  description: Bluetooth Low Energy Broadcast Audio Source sample
  name: Bluetooth Low Energy Broadcast Audio Source sample
tests:
  sample.bluetooth.broadcast_audio_source:
    harness: bluetooth
    platform_allow:
      - qemu_cortex_m3
      - qemu_x86
      - nrf5340dk_nrf5340_cpuapp
    integration_platforms:
      - qemu_x86
      - nrf5340dk_nrf5340_cpuapp
    tags: bluetooth
  sample.bluetooth.broadcast_audio_source.bt_ll_sw_split:
    harness: bluetooth
    platform_allow:
      - nrf52_bsim
      - nrf52833dk_nrf52820
      - nrf52833dk_nrf52833
    integration_platforms:
      - nrf52_bsim
      - nrf52833dk_nrf52833
    extra_args: OVERLAY_CONFIG=overlay-bt_ll_sw_split.conf
    tags: bluetooth
```

## samples/bluetooth/broadcaster_lite/Kconfig
```kconfig
# Copyright (c) 2025 Nordic Semiconductor ASA
# SPDX-License-Identifier: Apache-2.0

config BT_BROADCASTER
	default y

config BT_LL_SW_SPLIT
	default y

source "Kconfig.zephyr"
```

## samples/bluetooth/cap_acceptor/Kconfig
```kconfig
# Copyright (c) 2022 Nordic Semiconductor ASA
# SPDX-License-Identifier: Apache-2.0

mainmenu "Bluetooth: Common Audio Profile Acceptor sample"

config SAMPLE_UNICAST
	bool "Whether or not to search for CAP acceptors for unicast audio"
	default y
	select BT_BAP_UNICAST_SERVER
	select BT_ISO_PERIPHERAL
	select BT_ASCS
	select BT_PAC_SNK
	select BT_PAC_SNK_LOC
	select BT_PAC_SRC
	select BT_PAC_SRC_LOC
	select BT_CTLR_PERIPHERAL_ISO if BT_CTLR
	help
	  If set to true, the sample will start advertising connectable for
	  Broadcast Assistants.

config SAMPLE_BROADCAST
	bool "Whether or not to search for CAP acceptors for unicast audio"
	default y if !SAMPLE_UNICAST
	select BT_ISO_SYNC_RECEIVER
	select BT_BAP_SCAN_DELEGATOR
	select BT_BAP_BROADCAST_SINK
	select BT_PAC_SNK
	select BT_PAC_SNK_LOC
	select BT_PER_ADV_SYNC_TRANSFER_RECEIVER if !BT_CTLR || BT_CTLR_SYNC_TRANSFER_RECEIVER_SUPPORT
	select BT_CTLR_SYNC_ISO if BT_CTLR
	help
	  If set to true, the sample will start advertising syncable audio streams

config SAMPLE_SCAN_SELF
	bool "Whether to scan for Broadcast Sources without Broadcast Assistant"
	depends on SAMPLE_BROADCAST
	help
	  If set to true, the sample will start scanning for Broadcast Sources
	  without waiting for a Broadcast Assistant to connect.

config SAMPLE_TARGET_BROADCAST_NAME
	string "Target Broadcast Device Name when self-scanning"
	default ""
	help
	  Name of target broadcast device. If not empty string, sink device
	  will only listen to the specified broadcast source. Not case sensitive.

source "Kconfig.zephyr"
```

## samples/bluetooth/cap_acceptor/boards/nrf5340dk_nrf5340_cpuapp.conf
```kconfig
CONFIG_BT_BUF_EVT_RX_SIZE=255
CONFIG_BT_BUF_ACL_RX_SIZE=255
CONFIG_BT_BUF_ACL_TX_SIZE=251
CONFIG_BT_BUF_CMD_TX_SIZE=255

CONFIG_BT_TINYCRYPT_ECC=y
```

## samples/bluetooth/cap_initiator/Kconfig
```kconfig
# Copyright (c) 2024 Nordic Semiconductor ASA
# SPDX-License-Identifier: Apache-2.0

mainmenu "Bluetooth: Common Audio Profile initiator sample"

config SAMPLE_UNICAST
	bool "Whether or not to search for CAP acceptors for unicast audio"
	default y
	select BT_CENTRAL
	select BT_ISO_CENTRAL
	select BT_SMP
	select BT_KEYS_OVERWRITE_OLDEST
	select BT_CSIP_SET_COORDINATOR
	select BT_BAP_UNICAST_CLIENT
	select BT_CTLR_CENTRAL_ISO if BT_CTLR
	help
	  If set to true, the sample will start advertising connectable for
	  Broadcast Assistants.

config SAMPLE_BROADCAST
	bool "Whether or not to search for CAP acceptors for broadcast audio"
	default y if !SAMPLE_UNICAST
	select BT_BROADCASTER
	select BT_BAP_BROADCAST_SOURCE
	select BT_CTLR_ADV_ISO if BT_CTLR
	help
	  If set to true, the sample will start advertising syncable audio streams

source "Kconfig.zephyr"
```

## samples/bluetooth/cap_initiator/sample.yaml
```yaml
sample:
  description: Bluetooth Low Energy Common Audio Profile Initiator sample
  name: Bluetooth Low Energy Common Audio Profile Initiator sample
tests:
  sample.bluetooth.cap_initiator:
    harness: bluetooth
    platform_allow:
      - qemu_cortex_m3
      - qemu_x86
      - nrf5340dk/nrf5340/cpuapp
      - nrf5340bsim/nrf5340/cpuapp
    integration_platforms:
      - qemu_x86
      - nrf5340dk/nrf5340/cpuapp
    tags: bluetooth
    sysbuild: true
  sample.bluetooth.cap_initiator.bt_ll_sw_split:
    harness: bluetooth
    platform_allow:
      - nrf52_bsim
      - nrf52833dk/nrf52833
      - nrf52840dk/nrf52840
      - nrf52840dongle/nrf52840
    integration_platforms:
      - nrf52_bsim
      - nrf52833dk/nrf52833
      - nrf52840dk/nrf52840
      - nrf52840dongle/nrf52840
    extra_args: OVERLAY_CONFIG=overlay-bt_ll_sw_split.conf
    tags: bluetooth
```

## samples/bluetooth/ccp_call_control_client/sample.yaml
```yaml
sample:
  description: Bluetooth Low Energy Call Control Profile Server sample
  name: Bluetooth Low Energy Call Control Profile Server sample
tests:
  sample.bluetooth.ccp_call_control_client:
    harness: bluetooth
    platform_allow:
      - qemu_cortex_m3
      - qemu_x86
      - nrf5340dk/nrf5340/cpuapp
      - nrf5340bsim/nrf5340/cpuapp
    integration_platforms:
      - qemu_x86
      - nrf5340dk/nrf5340/cpuapp
    tags: bluetooth
    sysbuild: true
  sample.bluetooth.ccp_call_control_client.bt_ll_sw_split:
    harness: bluetooth
    platform_allow:
      - nrf52_bsim
      - nrf52833dk/nrf52833
      - nrf52840dk/nrf52840
      - nrf52840dongle/nrf52840
    integration_platforms:
      - nrf52_bsim
      - nrf52833dk/nrf52833
      - nrf52840dk/nrf52840
      - nrf52840dongle/nrf52840
    extra_args: OVERLAY_CONFIG=overlay-bt_ll_sw_split.conf
    tags: bluetooth
```

## samples/bluetooth/central/sample.yaml
```yaml
sample:
  name: Bluetooth Central
tests:
  sample.bluetooth.central:
    harness: bluetooth
    platform_allow:
      - qemu_cortex_m3
      - qemu_x86
    tags: bluetooth
    integration_platforms:
      - qemu_cortex_m3
  sample.bluetooth.central.no_blobs:
    extra_args:
      - CONFIG_BUILD_ONLY_NO_BLOBS=y
    platform_allow:
      - esp32_devkitc/esp32/procpu
      - esp32s3_devkitm/esp32s3/procpu
      - esp8684_devkitm
      - esp32c3_devkitm
      - esp32c6_devkitc/esp32c6/hpcore
      - sltb010a/efr32bg22c224f512im40
      - xg24_rb4187c/efr32mg24b220f1536im48
      - xg27_dk2602a/efr32bg27c140f768im40
      - xg29_rb4412a/efr32mg29b140f1024im40
    build_only: true
```

## samples/bluetooth/central_gatt_write/sample.yaml
```yaml
sample:
  name: Bluetooth Central GATT Write
tests:
  sample.bluetooth.central_gatt_write:
    harness: bluetooth
    platform_allow:
      - qemu_cortex_m3/ti_lm3s6965
      - qemu_x86/atom
      - nrf52_bsim/nrf52833
    integration_platforms:
      - qemu_cortex_m3/ti_lm3s6965
    tags: bluetooth
```

## samples/bluetooth/central_hogp/sample.yaml
```yaml
sample:
  name: Bluetooth Central HOGP
  description: BLE HID over GATT Profile Host (Central)
tests:
  sample.bluetooth.central_hogp:
    tags:
      - bluetooth
    platform_allow:
      - native_sim/native/64
      - nrf52840dk/nrf52840
    harness: bluetooth
```

## samples/bluetooth/central_hr/boards/nrf5340bsim_nrf5340_cpuapp.conf
```kconfig
# Set same the ACL RX buffer size as in hci_ipc on netcore so that
# HCI Controller to Host Flowcontrol is supported.
CONFIG_BT_BUF_ACL_RX_SIZE=255
CONFIG_ENTROPY_GENERATOR=y
```

## samples/bluetooth/central_hr/boards/nrf54l15dk_nrf54l15_cpuapp.conf
```kconfig
# SPDX-FileCopyrightText: Copyright The Zephyr Project Contributors
# SPDX-License-Identifier: Apache-2.0

CONFIG_MAIN_STACK_SIZE=2048

# IPC service and MBOX for communication with FLPR core
CONFIG_IPC_SERVICE=y
CONFIG_MBOX=y
```

## samples/bluetooth/central_hr/sample.yaml
```yaml
sample:
  name: Bluetooth Central HR
tests:
  sample.bluetooth.central_hr:
    arch_allow: x86
    harness: bluetooth
    tags: bluetooth
  sample.bluetooth.central_hr.minimal:
    harness: bluetooth
    platform_allow:
      - bbc_microbit
    integration_platforms:
      - bbc_microbit
    extra_args: CONF_FILE=prj_minimal.conf
    tags: bluetooth
  sample.bluetooth.central_hr.bt_ll_sw_split.extended:
    harness: bluetooth
    platform_allow:
      - nrf52_bsim
      - nrf52dk/nrf52832
      - nrf52840dk/nrf52840
    integration_platforms:
      - nrf52_bsim
      - nrf52dk/nrf52832
      - nrf52840dk/nrf52840
    extra_args: EXTRA_CONF_FILE=overlay-extended.conf
    tags: bluetooth
  sample.bluetooth.central_hr.multicore.bt_ll_sw_split.extended:
    harness: bluetooth
    platform_allow:
      - nrf5340bsim/nrf5340/cpuapp
      - nrf5340dk/nrf5340/cpuapp
    integration_platforms:
      - nrf5340bsim/nrf5340/cpuapp
      - nrf5340dk/nrf5340/cpuapp
    extra_args:
      - CONFIG_BT_EXT_ADV=y
    tags: bluetooth
    sysbuild: true
  sample.bluetooth.central_hr.bt_ll_sw_split.phy_coded:
    harness: bluetooth
    platform_allow:
      - nrf52_bsim
      - nrf52dk/nrf52832
      - nrf52840dk/nrf52840
    integration_platforms:
      - nrf52_bsim
      - nrf52dk/nrf52832
      - nrf52840dk/nrf52840
    extra_args: EXTRA_CONF_FILE=overlay-phy_coded.conf
    tags: bluetooth
  sample.bluetooth.central_hr.multicore.bt_ll_sw_split.phy_coded:
    harness: bluetooth
    platform_allow:
      - nrf5340bsim/nrf5340/cpuapp
      - nrf5340dk/nrf5340/cpuapp
    integration_platforms:
      - nrf5340bsim/nrf5340/cpuapp
      - nrf5340dk/nrf5340/cpuapp
    extra_args:
      - CONFIG_BT_EXT_ADV=y
      - CONFIG_BT_AUTO_PHY_CENTRAL_NONE=y
    tags: bluetooth
    sysbuild: true
```

## samples/bluetooth/central_ht/sample.yaml
```yaml
sample:
  name: Bluetooth Central HT
tests:
  sample.bluetooth.central_ht:
    harness: bluetooth
    platform_allow:
      - qemu_cortex_m3
      - qemu_x86
      - nrf51dk/nrf51822
      - nrf52dk/nrf52832
    tags: bluetooth
    integration_platforms:
      - qemu_cortex_m3
  sample.bluetooth.central_ht.nxp:
    # Disabling monolithic since CI environment doesn't use blobs
    harness: bluetooth
    platform_allow:
      - rd_rw612_bga
      - frdm_rw612
    extra_configs:
      - CONFIG_NXP_MONOLITHIC_BT=n
```

## samples/bluetooth/central_iso/sample.yaml
```yaml
sample:
  description: Bluetooth ISO central (client) sample
  name: Bluetooth ISO central (client) sample
tests:
  sample.bluetooth.central_iso:
    harness: bluetooth
    platform_allow: qemu_x86
    integration_platforms:
      - qemu_x86
    tags: bluetooth
  sample.bluetooth.central_iso.bt_ll_sw_split:
    harness: bluetooth
    platform_allow:
      - qemu_cortex_m3
      - qemu_x86
      - nrf52_bsim
      - nrf52833dk/nrf52833
    integration_platforms:
      - nrf52833dk/nrf52833
    extra_args: OVERLAY_CONFIG=overlay-bt_ll_sw_split.conf
    tags: bluetooth
```

## samples/bluetooth/central_multilink/Kconfig
```kconfig
# Copyright (c) 2021 Nordic Semiconductor ASA
# SPDX-License-Identifier: Apache-2.0

mainmenu "Bluetooth: Central Multilink"

config SAMPLE_CONN_ITERATIONS
	int "Connection iterations"
	range 0 255
	default 0
	help
	  Number of times to connect and disconnect to peripheral_identity
	  sample.

source "Kconfig.zephyr"
```

## samples/bluetooth/central_multilink/boards/qemu_cortex_m3_ti_lm3s6965.conf
```kconfig
# Reduce connection count to compensate for increased net_buf size
# (atomic_t ref field increases memory usage by ~3 bytes per buffer)
# 624-byte overflow with 62 connections; reducing to 50 saves ~10KB
CONFIG_BT_MAX_CONN=50
```

## samples/bluetooth/central_multilink/sample.yaml
```yaml
sample:
  name: Bluetooth Central Multilink
tests:
  sample.bluetooth.central.multilink:
    harness: bluetooth
    platform_allow:
      - qemu_cortex_m3/ti_lm3s6965
      - qemu_x86/atom
      - nrf52840dk/nrf52840
    integration_platforms:
      - qemu_cortex_m3/ti_lm3s6965
    tags: bluetooth
```

## samples/bluetooth/central_notify_receive/sample.yaml
```yaml
sample:
  name: Bluetooth Central Notify Receive
tests:
  sample.bluetooth.central_notify_receive:
    harness: bluetooth
    platform_allow:
      - qemu_cortex_m3
      - qemu_x86
      - nrf52_bsim
    tags: bluetooth
    integration_platforms:
      - qemu_cortex_m3
```

## samples/bluetooth/central_otc/sample.yaml
```yaml
sample:
  name: Bluetooth Central Object transfer client
tests:
  sample.bluetooth.central_otc:
    harness: bluetooth
    platform_allow:
      - nrf21540dk/nrf52840
      - nrf52840dk/nrf52840
      - nrf52833dk/nrf52833
    tags: bluetooth
    integration_platforms:
      - nrf21540dk/nrf52840
```

## samples/bluetooth/central_past/sample.yaml
```yaml
sample:
  name: Bluetooth Central Periodic Advertising Sync Transfer
tests:
  sample.bluetooth.central_past:
    harness: bluetooth
    platform_allow:
      - qemu_cortex_m3/ti_lm3s6965
      - qemu_x86/atom
    integration_platforms:
      - qemu_cortex_m3/ti_lm3s6965
    tags: bluetooth
```

## samples/bluetooth/central_peripheral_notify_send_receive/sample.yaml
```yaml
sample:
  name: Bluetooth Central Peripheral Notify Send Receive
tests:
  sample.bluetooth.central_peripheral_notify_send_receive:
    harness: bluetooth
    platform_allow:
      - qemu_cortex_m3
      - qemu_x86
      - nrf52_bsim
    tags: bluetooth
    integration_platforms:
      - qemu_cortex_m3
```

## samples/bluetooth/channel_sounding/connected_cs/initiator/sample.yaml
```yaml
sample:
  name: Bluetooth Channel Sounding - Initiator
tests:
  sample.bluetooth.channel_sounding.connected_cs.initiator:
    harness: bluetooth
    platform_allow:
      - qemu_cortex_m3
      - qemu_x86
    tags: bluetooth
    integration_platforms:
      - qemu_cortex_m3
```
