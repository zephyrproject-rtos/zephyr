zephyr_udc0: &usbd {
	compatible = "nordic,nrf-usbd";
	status = "okay";

	hs_0: hs_0 {
		compatible = "usb-audio-hs";
		mic-feature-mute;
		mic-channel-l;
		mic-channel-r;

		hp-feature-mute;
		hp-channel-l;
		hp-channel-r;
	};
};
