## CMakeLists.txt
```
# SPDX-License-Identifier: Apache-2.0

cmake_minimum_required(VERSION 3.20.0)
find_package(Zephyr REQUIRED HINTS $ENV{ZEPHYR_BASE})
project(hearing_aid)

target_sources(app PRIVATE
  src/main.c
  src/sink.c
  src/source.c
  src/utils.c
  src/volume.c
)

zephyr_library_include_directories(${ZEPHYR_BASE}/samples/bluetooth)
```

## sample.yaml
```
sample:
  description: Bluetooth Hearing Aid sample
  name: Bluetooth Hearing Aid sample
tests:
  sample.bluetooth.hearing_aid:
    harness: bluetooth
    platform_allow: qemu_cortex_m3 qemu_x86
    tags: bluetooth
```

## prj.conf
```kconfig
###     System  ###
CONFIG_REBOOT=y
CONFIG_MAIN_THREAD_PRIORITY=10
CONFIG_MAIN_STACK_SIZE=1940
CONFIG_THREAD_NAME=y
CONFIG_SHELL=y

###     General Bluetooth       ###
CONFIG_BT=y
CONFIG_BT_DEBUG_LOG=y
CONFIG_BT_CENTRAL=y
CONFIG_BT_PERIPHERAL=y
CONFIG_BT_PRIVACY=y
CONFIG_BT_SMP=y
CONFIG_BT_SMP_SC_PAIR_ONLY=y
CONFIG_BT_SMP_MIN_ENC_KEY_SIZE=16
CONFIG_BT_DEVICE_NAME="AudioDevice"
# CONFIG_BT_DEVICE_NAME="HA_Zephyr"
CONFIG_BT_L2CAP_TX_BUF_COUNT=10
CONFIG_BT_EATT=n
CONFIG_BT_GATT_DYNAMIC_DB=y
CONFIG_BT_EXT_ADV=y
CONFIG_BT_BONDABLE=n

# Temporarily disabled connetion parameter and PHY update
CONFIG_BT_GAP_AUTO_UPDATE_CONN_PARAMS=n
CONFIG_BT_AUTO_PHY_UPDATE=n
CONFIG_BT_AUTO_DATA_LEN_UPDATE=n

# In-ear hearing aid
# CONFIG_BT_DEVICE_APPEARANCE=2625

###     Bluetooth LE_Audio    ###
CONFIG_BT_AUDIO=y
CONFIG_BT_PACS_SNK_CONTEXT=0x0006
CONFIG_BT_ASCS_ASE_SNK_COUNT=1
CONFIG_BT_ASCS_ASE_SRC_COUNT=1
CONFIG_BT_AUDIO_UNICAST_SERVER=y
# CONFIG_BT_AUDIO_BROADCAST_SINK=y
CONFIG_BT_VCS=y
CONFIG_BT_MICS=y
CONFIG_BT_HAS=y
CONFIG_BT_HAS_HEARING_AID_BANDED=y
CONFIG_BT_HAS_PRESET_COUNT=0

CONFIG_BT_AICS_MAX_INSTANCE_COUNT=0
# The HA may expose an instance of MICS and an instance of AICS to control the capture of ambient sound.
CONFIG_BT_VCS_AICS_INSTANCE_COUNT=0
# An HA may instantiate one or more instances of Audio Input Control Service (AICS) to expose control of the gain of its inputs to a Volume Controller.
CONFIG_BT_MICS_AICS_INSTANCE_COUNT=0
# If the HA supports the Volume Balance feature (see Section 3.1) and the HA is part of a Binaural Hearing Aid Set, the HA shall instantiate one instance of Volume Offset Control Service (VOCS).
CONFIG_BT_VCS_VOCS_INSTANCE_COUNT=0
CONFIG_BT_TBS_CLIENT=n
CONFIG_BT_BAS=y
CONFIG_BT_CSIS=n
# CONFIG_BT_IAS=y

###     Debugging       ###
CONFIG_BT_DEBUG_LOG=y
CONFIG_BT_DEBUG_ASCS=y
CONFIG_BT_DEBUG_PACS=y
CONFIG_BT_AUDIO_DEBUG_UNICAST_SERVER=y
CONFIG_BT_DEBUG_HAS=y
```

## boards/native_posix.conf
```kconfig
CONFIG_LOG_MODE_IMMEDIATE=y
CONFIG_BT_TINYCRYPT_ECC=y

###     Codec   ###
CONFIG_FPU=y
CONFIG_LIBLC3CODEC=y

# For LE-audio at 10ms intervals we need the tick counter to occur more frequently
# than every 10 ms as each PDU for some reason takes 2 ticks to process.
CONFIG_SYS_CLOCK_TICKS_PER_SEC=1000
CONFIG_NATIVE_POSIX_SLOWDOWN_TO_REAL_TIME=y
```

## boards/nrf5340_audio_dk_nrf5340_cpuapp.conf
```kconfig
###     Bluetoooth      ###
# Not supported on Packetcraft controller
CONFIG_BT_ATT_ENFORCE_FLOW=n
# Disable Zephyr HCI Vendor-Specific extensions
CONFIG_BT_HCI_VS_EXT=n

###     Debugging       ###
CONFIG_USE_SEGGER_RTT=y
CONFIG_BT_DEBUG_MONITOR_RTT=y

###     Logging         ###
CONFIG_LOG=y
CONFIG_LOG_BACKEND_RTT=n

###     Audio   ###
CONFIG_I2S=y
CONFIG_LIBLC3CODEC=y
```

## boards/nrf5340_audio_dk_nrf5340_cpuapp.overlay
```dts
/*
 * Copyright (c) 2021 Nordic Semiconductor ASA
 *
 * SPDX-License-Identifier: Apache-2.0
 */

&clock {
	hfclkaudio-frequency = <12288000>;
};

i2s_rxtx: &i2s0 {
	status = "okay";
	pinctrl-0 = <&i2s0_default>;
	pinctrl-1 = <&i2s0_sleep>;
	pinctrl-names = "default", "sleep";
	clock-source = "ACLK";
};
```

## src/main.c
```c
/*
 * Copyright (c) 2020 Intel Corporation
 * Copyright (c) 2022 Nordic Semiconductor ASA
 * Copyright (c) 2022 Codecoup
 *
 * SPDX-License-Identifier: Apache-2.0
 */

#include <zephyr.h>

#include <device.h>
#include <kernel.h>
#include <errno.h>
#include <stddef.h>
#include <stdlib.h>
#include <stdio.h>

#include <zephyr/shell/shell.h>

#include <zephyr/bluetooth/bluetooth.h>
#include <zephyr/bluetooth/conn.h>
#include <zephyr/bluetooth/audio/audio.h>
#include <zephyr/bluetooth/audio/capabilities.h>
#include <zephyr/bluetooth/audio/mics.h>
#include <zephyr/bluetooth/audio/has.h>
#include <zephyr/bluetooth/audio/vcs.h>
#include <drivers/gpio.h>
#include <sys/byteorder.h>
#include <sys/printk.h>

#include "hearing_aid.h"

#define LOG_LEVEL LOG_LEVEL_DBG
#include <zephyr/logging/log.h>
LOG_MODULE_REGISTER(ha_main);

static struct bt_conn *default_conn;
static struct k_work_delayable adv_work;

static uint8_t unicast_server_addata[] = {
	BT_UUID_16_ENCODE(BT_UUID_ASCS_VAL), /* ASCS UUID */
	BT_AUDIO_UNICAST_ANNOUNCEMENT_TARGETED, /* Target Announcement */
	(((AVAILABLE_SINK_CONTEXT) >>  0) & 0xFF),
	(((AVAILABLE_SINK_CONTEXT) >>  8) & 0xFF),
	(((AVAILABLE_SOURCE_CONTEXT) >>  0) & 0xFF),
	(((AVAILABLE_SOURCE_CONTEXT) >>  8) & 0xFF),
	0x00, /* Metadata length */
};

#if defined(CONFIG_BT_PRIVACY)
/* HAP_d1.0r00; 3.3 Service UUIDs AD Type
 * The HA shall not include the Hearing Access Service UUID in the Service UUID AD type field of
 * the advertising data or scan response data if in one of the GAP connectable modes and if the HA
 * is using a resolvable private address.
 */
#define BT_DATA_UUID16_ALL_VAL BT_UUID_16_ENCODE(BT_UUID_ASCS_VAL)
#else
/* HAP_d1.0r00; 3.3 Service UUIDs AD Type
 * The HA shall include the Hearing Access Service Universally Unique Identifier (UUID) defined in
 * [2] in the Service UUID Advertising Data (AD) Type field of the advertising data or scan
 * response data, if in one of the Generic Access Profile (GAP) discoverable modes.
 */
#define BT_DATA_UUID16_ALL_VAL BT_UUID_16_ENCODE(BT_UUID_ASCS_VAL), \
			       BT_UUID_16_ENCODE(BT_UUID_HAS_VAL)
#endif /* CONFIG_BT_PRIVACY */

/* TODO: Expand with BAP data */
static const struct bt_data ad[] = {
	BT_DATA_BYTES(BT_DATA_FLAGS, (BT_LE_AD_GENERAL | BT_LE_AD_NO_BREDR)),
	BT_DATA_BYTES(BT_DATA_UUID16_ALL, BT_DATA_UUID16_ALL_VAL),
	BT_DATA(BT_DATA_SVC_DATA16, unicast_server_addata, ARRAY_SIZE(unicast_server_addata)),
};

static void connected(struct bt_conn *conn, uint8_t err)
{
	char addr[BT_ADDR_LE_STR_LEN];

	bt_addr_le_to_str(bt_conn_get_dst(conn), addr, sizeof(addr));

	if (err != 0) {
		LOG_ERR("Failed to connect to %s (%u)", addr, err);

		default_conn = NULL;
		return;
	}

	LOG_DBG("Connected: %s", addr);
	default_conn = bt_conn_ref(conn);
}

static void disconnected(struct bt_conn *conn, uint8_t reason)
{
	char addr[BT_ADDR_LE_STR_LEN];

	if (conn != default_conn) {
		return;
	}

	bt_addr_le_to_str(bt_conn_get_dst(conn), addr, sizeof(addr));

	LOG_DBG("Disconnected: %s (reason 0x%02x)", addr, reason);

	bt_conn_unref(default_conn);
	default_conn = NULL;

	/* Restart advertising after disconnection */
	k_work_schedule(&adv_work, K_SECONDS(1));
}

BT_CONN_CB_DEFINE(conn_callbacks) = {
	.connected = connected,
	.disconnected = disconnected,
};

static int le_ext_adv_create(struct bt_le_ext_adv **adv)
{
	int err;

	/* Create a non-connectable non-scannable advertising set */
	err = bt_le_ext_adv_create(BT_LE_EXT_ADV_CONN_NAME, NULL, adv);
	if (err) {
		LOG_ERR("Failed to create advertising set (err %d)", err);
		return err;
	}

	err = bt_le_ext_adv_set_data(*adv, ad, ARRAY_SIZE(ad), NULL, 0);
	if (err) {
		LOG_ERR("Failed to set advertising data (err %d)", err);
		return err;
	}

	return err;
}

static void adv_work_process(struct k_work *work)
{
	static struct bt_le_ext_adv *adv = NULL;
	int err;

	if (!adv) {
		err = le_ext_adv_create(&adv);
		__ASSERT_NO_MSG(adv);
	}

	err = bt_le_ext_adv_start(adv, BT_LE_EXT_ADV_START_DEFAULT);
	if (err) {
		LOG_ERR("Failed to start advertising set (err %d)", err);
		return;
	}

	LOG_DBG("Advertising successfully started");
}

static int cmd_init(const struct shell *sh, size_t argc, char **argv)
{
	int err;

	ARG_UNUSED(sh);
	ARG_UNUSED(argc);
	ARG_UNUSED(argv);

	err = bt_enable(NULL);
	if (err) {
		LOG_ERR("Bluetooth init failed (err %d)", err);
		return err;
	}

	LOG_DBG("Bluetooth initialized");

	err = hearing_aid_sink_init();
	if (err) {
		LOG_ERR("Sink init failed (err %d)", err);
		return err;
	}

	LOG_DBG("Stream Sink initialized");

	err = hearing_aid_source_init();
	if (err) {
		LOG_ERR("Source init failed (err %d)", err);
		return err;
	}

	LOG_DBG("Stream Source initialized");

	err = hearing_aid_volume_init();
	if (err) {
		LOG_ERR("Volume init failed (err %d)", err);
		return err;
	}

	LOG_DBG("Volume initialized");

	k_work_init_delayable(&adv_work, adv_work_process);
	k_work_schedule(&adv_work, K_NO_WAIT);

	return 0;
}

static int cmd_ha(const struct shell *sh, size_t argc, char **argv)
{
	if (argc > 1) {
		shell_error(sh, "%s unknown parameter: %s", argv[0], argv[1]);
	} else {
		shell_error(sh, "%s missing subcomand", argv[0]);
	}

	return -ENOEXEC;
}

#define HELP_NONE "[none]"

SHELL_STATIC_SUBCMD_SET_CREATE(ha_cmds,
	SHELL_CMD_ARG(init, NULL, HELP_NONE, cmd_init, 1, 0),
	SHELL_SUBCMD_SET_END
);

SHELL_CMD_ARG_REGISTER(ha, &ha_cmds, "Bluetooth HAS shell commands", cmd_ha, 1, 1);

#if defined(CONFIG_GPIO)
#define BTN4_NODE        DT_ALIAS(sw3)
#if DT_NODE_HAS_STATUS(BTN4_NODE, okay)
#define BTN4_LABEL       DT_PROP(BTN4_NODE, label)
static struct gpio_dt_spec btn4_spec = GPIO_DT_SPEC_GET(BTN4_NODE, gpios);
#endif

#if DT_NODE_HAS_STATUS(BTN4_NODE, okay)
static void init_work_handler(struct k_work *work)
{
	cmd_init(NULL, 0, NULL);
}

K_WORK_DEFINE(init_work, init_work_handler);

static struct gpio_callback callback_common;

static void btn4_handler(const struct device *dev, struct gpio_callback *cb,
			uint32_t pins)
{
	k_work_submit(&init_work);
}
#endif

static int buttons_init(const struct device *d)
{
	int err;

#if DT_NODE_HAS_STATUS(BTN4_NODE, okay)
	if (!device_is_ready(btn4_spec.port)) {
		LOG_ERR("%s is not ready", btn4_spec.port->name);
		return false;LOG_DBG("pressed");
	}

	err = gpio_pin_configure_dt(&btn4_spec, GPIO_INPUT);
	if (err < 0) {
		LOG_ERR("Failed to configure %s pin %d: %d",
		       btn4_spec.port->name, btn4_spec.pin, err);
		return false;
	}

	err = gpio_pin_interrupt_configure_dt(&btn4_spec,
					      GPIO_INT_EDGE_TO_ACTIVE);
	if (err < 0) {
		LOG_ERR("Failed to configure interrupt on %s pin %d: %d",
		       btn4_spec.port->name, btn4_spec.pin, err);
		return false;
	}

	gpio_init_callback(&callback_common, btn4_handler, BIT(btn4_spec.pin));
	gpio_add_callback(btn4_spec.port, &callback_common);
#endif

	(void)err;
	return true;
}

SYS_INIT(buttons_init, APPLICATION, CONFIG_APPLICATION_INIT_PRIORITY);
#endif /* CONFIG_GPIO */
```

## src/hearing_aid.h
```c
/*
 * Copyright (c) 2022 Codecoup
 *
 * SPDX-License-Identifier: Apache-2.0
 */

#include <bluetooth/audio/audio.h>

#define AVAILABLE_SINK_CONTEXT  (BT_AUDIO_CONTEXT_TYPE_CONVERSATIONAL | \
				 BT_AUDIO_CONTEXT_TYPE_MEDIA)

#define AVAILABLE_SOURCE_CONTEXT BT_AUDIO_CONTEXT_TYPE_CONVERSATIONAL

/* HAP_d1.0r00; 3.7 BAP Unicast Server role requirements
 * The HA shall support a Presentation Delay range in the Codec Configured state that includes
 * the value of 20ms, in addition to the requirement of Table 5.2 of [3].
 */
#define PD_MIN_USEC 20000

/* BAP_v1.0; Table 5.2: QoS configuration support setting requirements for the Unicast Client and
 * Unicast Server
 */
#define PD_MAX_USEC 40000

#define MAX_UNICAST_SINK_STREAMS 2
#define MAX_UNICAST_SOURCE_STREAMS 1
#define MAX_BROADCAST_SINK_STREAMS BROADCAST_SNK_STREAM_CNT

int hearing_aid_sink_init(void);
int hearing_aid_source_init(void);
int hearing_aid_volume_init(void);

/* Utils */
void print_hex(const uint8_t *ptr, size_t len);
void print_codec(const struct bt_codec *codec);
void print_qos(struct bt_codec_qos *qos);
void print_codec_capabilities(const struct bt_codec *codec);

/* Button callback structure */
struct button_cb {
	void (*on_volume_up)(void);
	void (*on_volume_down)(void);
	void (*on_play_pause)(void);
	void (*on_button_5)(void);
	void (*on_button_4)(void);
};

void button_cb_register(struct button_cb *cb);
```

## src/sink.c
```c
/*
 * Copyright (c) 2020 Intel Corporation
 * Copyright (c) 2022 Nordic Semiconductor ASA
 * Copyright (c) 2022 Codecoup
 *
 * SPDX-License-Identifier: Apache-2.0
 */

#include <zephyr.h>
#include <stdio.h>
#include <stddef.h>
#include <errno.h>

#include <bluetooth/audio/audio.h>
#include <bluetooth/audio/capabilities.h>
#include <sys/byteorder.h>

#include "hearing_aid.h"

#define LOG_LEVEL LOG_LEVEL_DBG
#include <zephyr/logging/log.h>
LOG_MODULE_REGISTER(ha_sink);

static struct bt_codec lc3_codec_sink =
	BT_CODEC_LC3(BT_CODEC_LC3_FREQ_16KHZ | BT_CODEC_LC3_FREQ_24KHZ, BT_CODEC_LC3_DURATION_10,
		     BT_CODEC_LC3_CHAN_COUNT_SUPPORT(1), 40u, 60u, 1,
		     (BT_AUDIO_CONTEXT_TYPE_CONVERSATIONAL | BT_AUDIO_CONTEXT_TYPE_MEDIA),
		      BT_AUDIO_CONTEXT_TYPE_UNSPECIFIED);

static struct bt_audio_stream unicast_streams[MAX_UNICAST_SINK_STREAMS];

#if defined(CONFIG_LIBLC3CODEC)
#include "lc3.h"

#define MAX_SAMPLE_RATE         48000
#define MAX_FRAME_DURATION_US   10000
#define MAX_NUM_SAMPLES         ((MAX_FRAME_DURATION_US * MAX_SAMPLE_RATE) / USEC_PER_SEC)

static int16_t audio_buf[MAX_NUM_SAMPLES];
static lc3_decoder_t lc3_decoder;
static lc3_decoder_mem_48k_t lc3_decoder_mem;
static int frames_per_sdu;

#endif /* CONFIG_LIBLC3CODEC */

static struct bt_audio_stream *lc3_config(struct bt_conn *conn,
					  struct bt_audio_ep *ep,
					  enum bt_audio_dir dir,
					  struct bt_audio_capability *cap,
					  struct bt_codec *codec)
{
	LOG_DBG("ASE Codec Config: conn %p ep %p type %u, cap %p",
	       (void *)conn, (void *)ep, dir, cap);

	print_codec(codec);

	for (size_t i = 0; i < ARRAY_SIZE(unicast_streams); i++) {
		struct bt_audio_stream *stream = &unicast_streams[i];

		if (!stream->conn) {
			LOG_DBG("ASE Codec Config stream %p", stream);
			return stream;
		}
	}

	LOG_DBG("No streams available");

#if defined(CONFIG_LIBLC3CODEC)
	/* Nothing to free as static memory is used */
	lc3_decoder = NULL;
#endif

	return NULL;
}

static int lc3_reconfig(struct bt_audio_stream *stream,
			struct bt_audio_capability *cap,
			struct bt_codec *codec)
{
	LOG_DBG("ASE Codec Reconfig: stream %p cap %p", stream, cap);

	print_codec(codec);

#if defined(CONFIG_LIBLC3CODEC)
	/* Nothing to free as static memory is used */
	lc3_decoder = NULL;
#endif

	/* We only support one QoS at the moment, reject changes */
	return -ENOEXEC;
}

static int lc3_qos(struct bt_audio_stream *stream, struct bt_codec_qos *qos)
{
	LOG_DBG("QoS: stream %p qos %p", stream, qos);

	print_qos(qos);

	return 0;
}

static int lc3_enable(struct bt_audio_stream *stream,
		      struct bt_codec_data *meta,
		      size_t meta_count)
{
	LOG_DBG("Enable: stream %p meta_count %u", stream, meta_count);

#if defined(CONFIG_LIBLC3CODEC)
	{
		const int freq_hz = bt_codec_cfg_get_freq(stream->codec);
		const int frame_duration_us = bt_codec_cfg_get_frame_duration_us(stream->codec);

		if (freq_hz < 0) {
			LOG_DBG("Error: Codec frequency not set, cannot start codec.");
			return -1;
		}

		if (frame_duration_us < 0) {
			LOG_DBG("Error: Frame duration not set, cannot start codec.");
			return -1;
		}

		frames_per_sdu = bt_codec_cfg_get_frame_blocks_per_sdu(stream->codec, true);

		lc3_decoder = lc3_setup_decoder(frame_duration_us,
						freq_hz,
						0, /* No resampling */
						&lc3_decoder_mem);

		if (lc3_decoder == NULL) {
			LOG_DBG("ERROR: Failed to setup LC3 encoder - wrong parameters?");
			return -1;
		}
	}
#endif

	return 0;
}

static int lc3_start(struct bt_audio_stream *stream)
{
	LOG_DBG("Start: stream %p", stream);

	return 0;
}

static int lc3_metadata(struct bt_audio_stream *stream,
			struct bt_codec_data *meta,
			size_t meta_count)
{
	LOG_DBG("Metadata: stream %p meta_count %u", stream, meta_count);

	return 0;
}

static int lc3_disable(struct bt_audio_stream *stream)
{
	LOG_DBG("Disable: stream %p", stream);

	return 0;
}

static int lc3_stop(struct bt_audio_stream *stream)
{
	LOG_DBG("Stop: stream %p", stream);

	return 0;
}

static int lc3_release(struct bt_audio_stream *stream)
{
	LOG_DBG("Release: stream %p", stream);
	return 0;
}

static struct bt_audio_capability_ops lc3_ops = {
	.config = lc3_config,
	.reconfig = lc3_reconfig,
	.qos = lc3_qos,
	.enable = lc3_enable,
	.start = lc3_start,
	.metadata = lc3_metadata,
	.disable = lc3_disable,
	.stop = lc3_stop,
	.release = lc3_release,
};

#if defined(CONFIG_LIBLC3CODEC)
static void stream_recv(struct bt_audio_stream *stream, const struct bt_iso_recv_info *info,
			struct net_buf *buf)
{
	uint8_t err = -1;

	/* TODO: If there is a way to know if the controller supports indicating errors in the
	 *       payload one could feed that into bad-frame-indicator. The HCI layer allows to
	 *       include this information, but currently there is no controller support.
	 *       Here it is assumed that reveiving a zero-length payload means a lost frame -
	 *       but actually it could just as well indicate a pause in the stream.
	 */
	const uint8_t bad_frame_indicator = buf->len == 0 ? 1 : 0;
	uint8_t *in_buf = (bad_frame_indicator ? NULL : buf->data);
	const int octets_per_frame = buf->len / frames_per_sdu;

	if (lc3_decoder == NULL) {
		LOG_DBG("LC3 decoder not setup, cannot decode data.");
		return;
	}

	/* This code is to demonstrate the use of the LC3 codec. On an actual implementation
	 * it might be required to offload the processing to another task to avoid blocking the
	 * BT stack.
	 */
	for (int i = 0; i < frames_per_sdu; i++) {
		int offset = 0;

		err = lc3_decode(lc3_decoder, in_buf + offset, octets_per_frame,
				 LC3_PCM_FORMAT_S16, audio_buf, 1);

		if (in_buf != NULL) {
			offset += octets_per_frame;
		}
	}

	LOG_DBG("RX stream %p len %u", stream, buf->len);

	if (err == 1) {
		LOG_DBG("  decoder performed PLC");
		return;

	} else if (err < 0) {
		LOG_DBG("  decoder failed - wrong parameters?");
	}
}
#else
static void stream_recv(struct bt_audio_stream *stream,
			const struct bt_iso_recv_info *info,
			struct net_buf *buf)
{
	LOG_DBG("Incoming audio on stream %p len %u", stream, buf->len);
}
#endif /* CONFIG_LIBLC3CODEC */

static struct bt_audio_stream_ops stream_ops = {
	.recv = stream_recv,
};

#if defined(CONFIG_BT_AUDIO_BROADCAST_SINK)
static uint32_t accepted_broadcast_id;
static struct bt_audio_base received_base;
static bool sink_syncable;
static struct bt_audio_stream broadcast_streams[MAX_BROADCAST_SINK_STREAMS];
static struct bt_audio_broadcast_sink *default_sink;

static bool scan_recv(const struct bt_le_scan_recv_info *info,
		     uint32_t broadcast_id)
{
	LOG_DBG("Found broadcaster with ID 0x%06X", broadcast_id);

	if (broadcast_id == accepted_broadcast_id) {
		LOG_DBG("PA syncing to broadcaster");
		accepted_broadcast_id = 0;
		return true;
	}

	return false;
}

static void pa_synced(struct bt_audio_broadcast_sink *sink,
		      struct bt_le_per_adv_sync *sync,
		      uint32_t broadcast_id)
{
	LOG_DBG("PA synced to broadcaster with ID 0x%06X as sink %p", broadcast_id, (void *)sink);

	if (default_sink == NULL) {
		default_sink = sink;

		LOG_DBG("Sink %p is set as default", (void *)sink);
	}
}

static void base_recv(struct bt_audio_broadcast_sink *sink,
		      const struct bt_audio_base *base)
{
	uint8_t bis_indexes[BROADCAST_SNK_STREAM_CNT] = { 0 };
	/* "0xXX " requires 5 characters */
	char bis_indexes_str[5 * ARRAY_SIZE(bis_indexes) + 1];
	size_t index_count = 0;

	if (memcmp(base, &received_base, sizeof(received_base)) == 0) {
		/* Don't print duplicates */
		return;
	}

	LOG_DBG("Received BASE from sink %p:", (void *)sink);

	for (int i = 0; i < base->subgroup_count; i++) {
		const struct bt_audio_base_subgroup *subgroup;

		subgroup = &base->subgroups[i];

		LOG_DBG("Subgroup[%d]:", i);
		print_codec(&subgroup->codec);

		for (int j = 0; j < subgroup->bis_count; j++) {
			const struct bt_audio_base_bis_data *bis_data;

			bis_data = &subgroup->bis_data[j];

			LOG_DBG("BIS[%d] index 0x%02x", i, bis_data->index);
			bis_indexes[index_count++] = bis_data->index;

			for (int k = 0; k < bis_data->data_count; k++) {
				const struct bt_codec_data *codec_data;

				codec_data = &bis_data->data[k];

				LOG_DBG("data #%u: type 0x%02x len %u", i, codec_data->data.type,
				       codec_data->data.data_len);
				print_hex(codec_data->data.data,
					  codec_data->data.data_len - sizeof(codec_data->data.type));
			}

			LOG_DBG("");
		}
	}

	memset(bis_indexes_str, 0, sizeof(bis_indexes_str));
	/* Create space separated list of indexes as hex values */
	for (int i = 0; i < index_count; i++) {
		char bis_index_str[6];

		sprintf(bis_index_str, "0x%02x ", bis_indexes[i]);

		strcat(bis_indexes_str, bis_index_str);
		LOG_DBG("[%d]: %s", i, bis_index_str);
	}

	LOG_DBG("Possible indexes: %s", bis_indexes_str);

	(void)memcpy(&received_base, base, sizeof(received_base));
}

static void syncable(struct bt_audio_broadcast_sink *sink, bool encrypted)
{
	if (sink_syncable) {
		return;
	}

	LOG_DBG("Sink %p is ready to sync %s encryption", (void *)sink, encrypted ? "with" : "without");
	sink_syncable = true;
}

static void scan_term(int err)
{
	LOG_DBG("Broadcast scan was terminated: %d", err);
}

static void pa_sync_lost(struct bt_audio_broadcast_sink *sink)
{
	LOG_DBG("Sink %p disconnected", (void *)sink);

	if (default_sink == sink) {
		default_sink = NULL;
		sink_syncable = false;
	}
}

static struct bt_audio_broadcast_sink_cb broadcast_sink_cb = {
	.scan_recv = scan_recv,
	.pa_synced = pa_synced,
	.base_recv = base_recv,
	.syncable = syncable,
	.scan_term = scan_term,
	.pa_sync_lost = pa_sync_lost,
};
#endif /* CONFIG_BT_AUDIO_BROADCAST_SINK */

/* HAP_d1.0r00; 3.7 BAP Unicast Server role requirements
 * The HA shall support a Presentation Delay range in the Codec Configured state that includes
 * the value of 20ms, in addition to the requirement of Table 5.2 of [3].
 */
#define PD_MIN_USEC 20000

/* BAP_v1.0; Table 5.2: QoS configuration support setting requirements for the Unicast Client and
 * Unicast Server
 */
#define PD_MAX_USEC 40000

static struct bt_audio_capability caps[] = {
	{
		.dir = BT_AUDIO_DIR_SINK,
		.pref = BT_AUDIO_CAPABILITY_PREF(BT_AUDIO_CAPABILITY_UNFRAMED_SUPPORTED,
						 BT_GAP_LE_PHY_2M, 0x02, 10,
						 PD_MIN_USEC, PD_MAX_USEC,
						 PD_MIN_USEC, PD_MAX_USEC),
		.codec = &lc3_codec_sink,
		.ops = &lc3_ops,
	},
};

int hearing_aid_sink_init(void)
{
	for (size_t i = 0; i < ARRAY_SIZE(caps); i++) {
		bt_audio_capability_register(&caps[i]);
	}

	for (size_t i = 0; i < ARRAY_SIZE(unicast_streams); i++) {
		bt_audio_stream_cb_register(&unicast_streams[i], &stream_ops);
	}

#if defined(CONFIG_BT_AUDIO_BROADCAST_SINK)
	bt_audio_broadcast_sink_register_cb(&broadcast_sink_cb);

	for (size_t i = 0; i < ARRAY_SIZE(broadcast_streams); i++) {
		bt_audio_stream_cb_register(&broadcast_streams[i], &stream_ops);
	}
#endif /* CONFIG_BT_AUDIO_BROADCAST_SINK */

	return 0;
}
```

## src/source.c
```c
/*
 * Copyright (c) 2020 Intel Corporation
 * Copyright (c) 2022 Nordic Semiconductor ASA
 * Copyright (c) 2022 Codecoup
 *
 * SPDX-License-Identifier: Apache-2.0
 */

#include <zephyr.h>

#include <stddef.h>
#include <errno.h>
#include <sys/slist.h>

#include <bluetooth/audio/audio.h>
#include <bluetooth/audio/capabilities.h>
#include <bluetooth/bluetooth.h>
#include <sys/byteorder.h>

#include "hearing_aid.h"

#define LOG_LEVEL LOG_LEVEL_DBG
#include <zephyr/logging/log.h>
LOG_MODULE_REGISTER(ha_source);

struct hearing_aid_stream {
	struct bt_audio_stream stream;

	sys_snode_t node;
};

NET_BUF_POOL_FIXED_DEFINE(tx_pool, MAX_UNICAST_SOURCE_STREAMS,
			  BT_ISO_SDU_BUF_SIZE(CONFIG_BT_ISO_TX_MTU),
			  8, NULL);
K_MEM_SLAB_DEFINE(stream_slab, sizeof(struct bt_audio_stream),
		  MAX_UNICAST_SOURCE_STREAMS, __alignof__(struct bt_audio_stream));

static struct bt_codec lc3_codec_source =
	BT_CODEC_LC3(BT_CODEC_LC3_FREQ_16KHZ, BT_CODEC_LC3_DURATION_10,
		     BT_CODEC_LC3_CHAN_COUNT_SUPPORT(1), 40u, 40u, 1,
		     BT_AUDIO_CONTEXT_TYPE_CONVERSATIONAL, BT_AUDIO_CONTEXT_TYPE_UNSPECIFIED);

static struct k_work_delayable audio_send_work;
static k_timeout_t audio_send_work_delay = K_NO_WAIT;
static sys_slist_t active_streams;

#if defined(CONFIG_LIBLC3CODEC)
#include "lc3.h"
#include "math.h"

#define MAX_SAMPLE_RATE         48000
#define MAX_FRAME_DURATION_US   10000
#define MAX_NUM_SAMPLES         ((MAX_FRAME_DURATION_US * MAX_SAMPLE_RATE) / USEC_PER_SEC)
#define AUDIO_VOLUME            (INT16_MAX - 3000) /* codec does clipping above INT16_MAX - 3000 */
#define AUDIO_TONE_FREQUENCY_HZ   400

static int16_t audio_buf[MAX_NUM_SAMPLES];
static lc3_encoder_t lc3_encoder;
static lc3_encoder_mem_48k_t lc3_encoder_mem;
static int octets_per_frame;
static int frames_per_sdu;
static int frame_duration_us;

/**
 * Use the math lib to generate a sine-wave using 16 bit samples into a buffer.
 *
 * @param buf Destination buffer
 * @param length_us Length of the buffer in microseconds
 * @param frequency_hz frequency in Hz
 * @param sample_rate_hz sample-rate in Hz.
 */
static void fill_audio_buf_sin(int16_t *buf, int length_us, int frequency_hz, int sample_rate_hz)
{
	const int sine_period_samples = sample_rate_hz / frequency_hz;
	const unsigned int num_samples = (length_us * sample_rate_hz) / USEC_PER_SEC;
	const float step = 2 * 3.1415 / sine_period_samples;

	for (unsigned int i = 0; i < num_samples; i++) {
		const float sample = sin(i * step);

		buf[i] = (int16_t)(AUDIO_VOLUME * sample);
	}
}

static void audio_timer_timeout(struct k_work *work)
{
	/* For the first call-back we push multiple audio frames to the buffer to use the
	 * controller ISO buffer to handle jitter.
	 */
	const uint8_t prime_count = 2;
	static int64_t start_time;
	static int32_t sdu_cnt;
	int32_t sdu_goal_cnt;
	int64_t uptime, run_time_ms;

	k_work_schedule(&audio_send_work, audio_send_work_delay);

	if (lc3_encoder == NULL) {
		LOG_DBG("LC3 encoder not setup, cannot encode data.");
		return;
	}

	if (start_time == 0) {
		/* Read start time and produce the number of frames needed to catch up with any
		 * inaccuracies in the timer. by calculating the number of frames we should
		 * have sent and compare to how many were actually sent.
		 */
		start_time = k_uptime_get();
	}

	uptime = k_uptime_get();
	run_time_ms = uptime - start_time;

	sdu_goal_cnt = (run_time_ms * 1000) / (frame_duration_us * frames_per_sdu);

	/* Add primer value to ensure the controller do not run low on data due to jitter */
	sdu_goal_cnt += prime_count;

	LOG_DBG("LC3 encode %d frames in %d SDUs", (sdu_goal_cnt - sdu_cnt) * frames_per_sdu,
						    (sdu_goal_cnt - sdu_cnt));

	while (sdu_cnt < sdu_goal_cnt) {
		struct hearing_aid_stream *ha_stream;
		int ret;
		struct net_buf *buf;
		uint8_t *net_buffer;
		int lc3_ret = -1;
		const uint16_t tx_sdu_len = frames_per_sdu * octets_per_frame;
		int offset = 0;

		SYS_SLIST_FOR_EACH_CONTAINER(&active_streams, ha_stream, node) {
			buf = net_buf_alloc(&tx_pool, K_FOREVER);
			net_buf_reserve(buf, BT_ISO_CHAN_SEND_RESERVE);

			net_buffer = net_buf_tail(buf);
			buf->len += tx_sdu_len;

			for (int i = 0; i < frames_per_sdu; i++) {
				lc3_ret = lc3_encode(lc3_encoder, LC3_PCM_FORMAT_S16, audio_buf,
						1, octets_per_frame, net_buffer + offset);
				offset += octets_per_frame;
			}

			if (lc3_ret == -1) {
				LOG_DBG("LC3 encoder failed - wrong parameters?: %d", lc3_ret);
				net_buf_unref(buf);
				return;
			}

			ret = bt_audio_stream_send(&ha_stream->stream, buf);
			if (ret < 0) {
				LOG_DBG("Failed to send LC3 audio data on stream %p: (%d)",
				       &ha_stream->stream, ret);
				net_buf_unref(buf);
			} else {
				LOG_DBG("Sending LC3 audio data with len %zu on stream %p",
				       tx_sdu_len, &ha_stream->stream);
			}
		}

		sdu_cnt++;
	}
}
#else
/**
 * @brief Send audio data on timeout
 *
 * This will send an increasing amount of audio data, starting from 1 octet.
 * The data is just mock data, and does not actually represent any audio.
 *
 * First iteration : 0x00
 * Second iteration: 0x00 0x01
 * Third iteration : 0x00 0x01 0x02
 *
 * And so on, until it wraps around the configured MTU (CONFIG_BT_ISO_TX_MTU)
 *
 * @param work Pointer to the work structure
 */
static void audio_timer_timeout(struct k_work *work)
{
	struct hearing_aid_stream *ha_stream;
	int ret;
	static uint8_t buf_data[CONFIG_BT_ISO_TX_MTU];
	static bool data_initialized;
	struct net_buf *buf;
	static size_t len_to_send = 1;

	if (!data_initialized) {
		/* TODO: Actually encode some audio data */
		for (int i = 0; i < ARRAY_SIZE(buf_data); i++) {
			buf_data[i] = (uint8_t)i;
		}

		data_initialized = true;
	}

	SYS_SLIST_FOR_EACH_CONTAINER(&active_streams, ha_stream, node) {
		buf = net_buf_alloc(&tx_pool, K_FOREVER);
		net_buf_reserve(buf, BT_ISO_CHAN_SEND_RESERVE);
		net_buf_add_mem(buf, buf_data, len_to_send);

		ret = bt_audio_stream_send(&ha_stream->stream, buf);
		if (ret < 0) {
			LOG_DBG("Failed to send mock audio data on stream %p: (%d)",
			       &ha_stream->stream, ret);
			net_buf_unref(buf);
		} else {
			LOG_DBG("Sending mock audio data with len %zu on stream %p",
			       len_to_send, &ha_stream->stream);
		}
	}

	k_work_schedule(&audio_send_work, audio_send_work_delay);

	len_to_send++;
	if (len_to_send > ARRAY_SIZE(buf_data)) {
		len_to_send = 1;
	}
}
#endif /* CONFIG_LIBLC3CODEC */

static void stream_sent(struct bt_audio_stream *stream)
{
	LOG_DBG("Audio Stream %p sent", stream);
}

static struct bt_audio_stream_ops stream_ops = {
	.sent = stream_sent,
};

static struct bt_audio_stream *lc3_config(struct bt_conn *conn,
					  struct bt_audio_ep *ep,
					  enum bt_audio_dir dir,
					  struct bt_audio_capability *cap,
					  struct bt_codec *codec)
{
	struct hearing_aid_stream *ha_stream = NULL;

	LOG_DBG("ASE Codec Config: conn %p ep %p type %u, cap %p",
	       (void *)conn, (void *)ep, dir, cap);

	print_codec(codec);

	/* Alloc stream */
	if (k_mem_slab_alloc(&stream_slab, (void **)&ha_stream, K_NO_WAIT)) {
		LOG_DBG("Failed to allocate stream");
		return NULL;
	}

	bt_audio_stream_cb_register(&ha_stream->stream, &stream_ops);

	LOG_DBG("ASE Codec Config stream %p", &ha_stream->stream);

	return &ha_stream->stream;
}

static int lc3_reconfig(struct bt_audio_stream *stream,
			struct bt_audio_capability *cap,
			struct bt_codec *codec)
{
	LOG_DBG("ASE Codec Reconfig: stream %p cap %p", stream, cap);

	print_codec(codec);

#if defined(CONFIG_LIBLC3CODEC)
	/* Nothing to free as static memory is used */
	lc3_encoder = NULL;
#endif

	/* We only support one QoS at the moment, reject changes */
	return -ENOEXEC;
}

static int lc3_qos(struct bt_audio_stream *stream, struct bt_codec_qos *qos)
{
	LOG_DBG("QoS: stream %p qos %p", stream, qos);

	print_qos(qos);

	audio_send_work_delay = K_USEC(qos->interval);

	return 0;
}

static int lc3_enable(struct bt_audio_stream *stream,
		      struct bt_codec_data *meta,
		      size_t meta_count)
{
	LOG_DBG("Enable: stream %p meta_count %u", stream, meta_count);

#if defined(CONFIG_LIBLC3CODEC)
	const int freq_hz = bt_codec_cfg_get_freq(stream->codec);
	unsigned int num_samples;

	if (freq_hz < 0) {
		LOG_DBG("Error: Codec frequency not set, cannot start codec.");
		return -EINVAL;
	}

	frame_duration_us = bt_codec_cfg_get_frame_duration_us(stream->codec);
	if (frame_duration_us < 0) {
		LOG_DBG("Error: Frame duration not set, cannot start codec.");
		return -EINVAL;
	}

	octets_per_frame = bt_codec_cfg_get_octets_per_frame(stream->codec);
	if (octets_per_frame < 0) {
		LOG_DBG("Error: Octets per frame not set, cannot start codec.");
		return -EINVAL;
	}

	frames_per_sdu = bt_codec_cfg_get_frame_blocks_per_sdu(stream->codec, true);
	if (frames_per_sdu < 0) {
		LOG_DBG("Error: Frames per SDU not set, cannot start codec.");
		return -EINVAL;
	}

	/* Fill audio buffer with Sine wave only once and repeat encoding the same tone frame */
	fill_audio_buf_sin(audio_buf, frame_duration_us, AUDIO_TONE_FREQUENCY_HZ, freq_hz);

	num_samples = ((frame_duration_us * freq_hz) / USEC_PER_SEC);
	for (unsigned int i = 0; i < num_samples; i++) {
		LOG_DBG("%3i: %6i", i, audio_buf[i]);
	}

	lc3_encoder = lc3_setup_encoder(frame_duration_us,
					freq_hz,
					0, /* No resampling */
					&lc3_encoder_mem);

	if (lc3_encoder == NULL) {
		LOG_DBG("ERROR: Failed to setup LC3 encoder - wrong parameters?");
	}
#endif /* CONFIG_LIBLC3CODEC */

	return 0;
}

static int lc3_start(struct bt_audio_stream *stream)
{
	struct hearing_aid_stream *ha_stream = CONTAINER_OF(stream, struct hearing_aid_stream,
							    stream);

	LOG_DBG("Start: stream %p", stream);

	sys_slist_append(&active_streams, &ha_stream->node);

	if (!k_work_delayable_is_pending(&audio_send_work)) {
		/* Start sending audio data */
		k_work_schedule(&audio_send_work, K_NO_WAIT);
	}

	return 0;
}

static int lc3_metadata(struct bt_audio_stream *stream,
			struct bt_codec_data *meta,
			size_t meta_count)
{
	LOG_DBG("Metadata: stream %p meta_count %u", stream, meta_count);

	return 0;
}

static int lc3_disable(struct bt_audio_stream *stream)
{
	LOG_DBG("Disable: stream %p", stream);

	return 0;
}

static void disactivate_stream(struct bt_audio_stream *stream)
{
	struct hearing_aid_stream *ha_stream;
	sys_snode_t *prev = NULL;

	SYS_SLIST_FOR_EACH_CONTAINER(&active_streams, ha_stream, node) {
		if (&ha_stream->stream == stream) {
			sys_slist_remove(&active_streams, prev, &ha_stream->node);
			break;
		}

		prev = &ha_stream->node;
	}
}

static int lc3_stop(struct bt_audio_stream *stream)
{
	LOG_DBG("Stop: stream %p", stream);

	disactivate_stream(stream);

	k_work_cancel_delayable(&audio_send_work);

	return 0;
}

static int lc3_release(struct bt_audio_stream *stream)
{
	struct hearing_aid_stream *ha_stream = CONTAINER_OF(stream, struct hearing_aid_stream,
							    stream);

	LOG_DBG("Release: stream %p", stream);

	k_work_cancel_delayable(&audio_send_work);

	disactivate_stream(stream);

	k_mem_slab_free(&stream_slab, (void **)&ha_stream);

	return 0;
}

static struct bt_audio_capability_ops lc3_ops = {
	.config = lc3_config,
	.reconfig = lc3_reconfig,
	.qos = lc3_qos,
	.enable = lc3_enable,
	.start = lc3_start,
	.metadata = lc3_metadata,
	.disable = lc3_disable,
	.stop = lc3_stop,
	.release = lc3_release,
};

static struct bt_audio_capability caps[] = {
	{
		.dir = BT_AUDIO_DIR_SOURCE,
		.pref = BT_AUDIO_CAPABILITY_PREF(BT_AUDIO_CAPABILITY_UNFRAMED_SUPPORTED,
						 BT_GAP_LE_PHY_2M, 0x02, 10,
						 PD_MIN_USEC, PD_MAX_USEC,
						 PD_MIN_USEC, PD_MAX_USEC),
		.codec = &lc3_codec_source,
		.ops = &lc3_ops,
	},
};

int hearing_aid_source_init(void)
{
	for (size_t i = 0; i < ARRAY_SIZE(caps); i++) {
		bt_audio_capability_register(&caps[i]);
	}

	if (IS_ENABLED(CONFIG_BT_HAS_HEARING_AID_LEFT)) {
		bt_audio_capability_set_location(BT_AUDIO_DIR_SOURCE, BT_AUDIO_LOCATION_FRONT_LEFT);
	} else {
		bt_audio_capability_set_location(BT_AUDIO_DIR_SOURCE, BT_AUDIO_LOCATION_FRONT_RIGHT);
	}

	k_work_init_delayable(&audio_send_work, audio_timer_timeout);
	sys_slist_init(&active_streams);

	return 0;
}
```

## src/utils.c
```c
/*
 * Copyright (c) 2020 Intel Corporation
 * Copyright (c) 2022 Nordic Semiconductor ASA
 * Copyright (c) 2022 Codecoup
 *
 * SPDX-License-Identifier: Apache-2.0
 */

#include <zephyr.h>
#include <stddef.h>
#include <sys/printk.h>

#include <bluetooth/audio/audio.h>

void print_hex(const uint8_t *ptr, size_t len)
{
	while (len-- != 0) {
		printk("%02x", *ptr++);
	}
}

void print_codec(const struct bt_codec *codec)
{
	printk("codec 0x%02x cid 0x%04x vid 0x%04x count %u\n",
	       codec->id, codec->cid, codec->vid, codec->data_count);

	for (size_t i = 0; i < codec->data_count; i++) {
		printk("data #%zu: type 0x%02x len %u\n",
		       i, codec->data[i].data.type,
		       codec->data[i].data.data_len);
		print_hex(codec->data[i].data.data,
			  codec->data[i].data.data_len -
			  sizeof(codec->data[i].data.type));
		printk("\n");
	}

	if (codec->id == BT_CODEC_LC3_ID) {
		/* LC3 uses the generic LTV format - other codecs might do as well */

		uint32_t chan_allocation;

		printk("  Frequency: %d Hz\n", bt_codec_cfg_get_freq(codec));
		printk("  Frame Duration: %d us\n", bt_codec_cfg_get_frame_duration_us(codec));
		if (bt_codec_cfg_get_chan_allocation_val(codec, &chan_allocation) == 0) {
			printk("  Channel allocation: 0x%x\n", chan_allocation);
		}

		printk("  Octets per frame: %d (negative means value not pressent)\n",
		       bt_codec_cfg_get_octets_per_frame(codec));
		printk("  Frames per SDU: %d\n",
		       bt_codec_cfg_get_frame_blocks_per_sdu(codec, true));
	}

	for (size_t i = 0; i < codec->meta_count; i++) {
		printk("meta #%zu: type 0x%02x len %u\n",
		       i, codec->meta[i].data.type,
		       codec->meta[i].data.data_len);
		print_hex(codec->meta[i].data.data,
			  codec->meta[i].data.data_len -
			  sizeof(codec->meta[i].data.type));
		printk("\n");
	}
}

void print_qos(struct bt_codec_qos *qos)
{
	printk("QoS: interval %u framing 0x%02x phy 0x%02x sdu %u "
	       "rtn %u latency %u pd %u\n",
	       qos->interval, qos->framing, qos->phy, qos->sdu,
	       qos->rtn, qos->latency, qos->pd);
}

void print_codec_capabilities(const struct bt_codec *codec)
{
	printk("codec 0x%02x cid 0x%04x vid 0x%04x count %u\n",
	       codec->id, codec->cid, codec->vid, codec->data_count);

	for (size_t i = 0; i < codec->data_count; i++) {
		printk("data #%zu: type 0x%02x len %u\n",
		       i, codec->data[i].data.type,
		       codec->data[i].data.data_len);
		print_hex(codec->data[i].data.data,
			  codec->data[i].data.data_len -
			  sizeof(codec->data[i].data.type));
		printk("\n");
	}

	for (size_t i = 0; i < codec->meta_count; i++) {
		printk("meta #%zu: type 0x%02x len %u\n",
		       i, codec->meta[i].data.type,
		       codec->meta[i].data.data_len);
		print_hex(codec->meta[i].data.data,
			  codec->meta[i].data.data_len -
			  sizeof(codec->meta[i].data.type));
		printk("\n");
	}
}
```

## src/volume.c
```c
/*
 * Copyright (c) 2020 Intel Corporation
 * Copyright (c) 2022 Nordic Semiconductor ASA
 * Copyright (c) 2022 Codecoup
 *
 * SPDX-License-Identifier: Apache-2.0
 */

#include <zephyr.h>
#include <stdio.h>
#include <stddef.h>
#include <errno.h>
#include <sys/printk.h>

#include <bluetooth/bluetooth.h>
#include <bluetooth/audio/audio.h>
#include <bluetooth/audio/mics.h>
#include <bluetooth/audio/vcs.h>
#include <sys/byteorder.h>

static struct bt_vcs *vcs;

static void vcs_state_cb(struct bt_vcs *vcs, int err, uint8_t volume,
			 uint8_t mute)
{
	if (err) {
		printk("VCS state get failed (%d)\n", err);
	} else {
		printk("VCS volume %u, mute %u\n", volume, mute);
	}
}

static void vcs_flags_cb(struct bt_vcs *vcs, int err, uint8_t flags)
{
	if (err) {
		printk("VCS flags get failed (%d)\n", err);
	} else {
		printk("VCS flags 0x%02X\n", flags);
	}
}

static struct bt_vcs_cb vcs_cbs = {
	.state = vcs_state_cb,
	.flags = vcs_flags_cb,
};

#if CONFIG_BT_VCS_AICS_INSTANCE_COUNT > 0
static void aics_state_cb(struct bt_aics *inst, int err, int8_t gain,
			  uint8_t mute, uint8_t mode)
{
	if (err) {
		printk("AICS state get failed (%d) for inst %p\n", err, inst);
	} else {
		printk("AICS inst %p state gain %d, mute %u, mode %u\n", inst, gain, mute, mode);
	}
}

static void aics_gain_setting_cb(struct bt_aics *inst, int err, uint8_t units,
				 int8_t minimum, int8_t maximum)
{
	if (err) {
		printk("AICS gain settings get failed (%d) for inst %p\n", err, inst);
	} else {
		printk("AICS inst %p gain settings units %u, min %d, max %d\n", inst, units,
		       minimum, maximum);
	}
}

static void aics_input_type_cb(struct bt_aics *inst, int err,
			       uint8_t input_type)
{
	if (err) {
		printk("AICS input type get failed (%d) for inst %p\n", err, inst);
	} else {
		printk("AICS inst %p input type %u\n", inst, input_type);
	}
}

static void aics_status_cb(struct bt_aics *inst, int err, bool active)
{
	if (err) {
		printk("AICS status get failed (%d) for inst %p\n", err, inst);
	} else {
		printk("AICS inst %p status %s\n", inst, active ? "active" : "inactive");
	}

}
static void aics_description_cb(struct bt_aics *inst, int err,
				char *description)
{
	if (err) {
		printk("AICS description get failed (%d) for inst %p\n", err, inst);
	} else {
		printk("AICS inst %p description %s\n", inst, description);
	}
}

static struct bt_aics_cb aics_cbs = {
	.state = aics_state_cb,
	.gain_setting = aics_gain_setting_cb,
	.type = aics_input_type_cb,
	.status = aics_status_cb,
	.description = aics_description_cb
};
#endif /* CONFIG_BT_VCS_AICS_INSTANCE_COUNT */

#if CONFIG_BT_VCS_VOCS_INSTANCE_COUNT > 0
static void vocs_state_cb(struct bt_vocs *inst, int err, int16_t offset)
{
	if (err) {
		printk("VOCS state get failed (%d) for inst %p\n", err, inst);
	} else {
		printk("VOCS inst %p offset %d\n", inst, offset);
	}
}

static void vocs_location_cb(struct bt_vocs *inst, int err, uint32_t location)
{
	if (err) {
		printk("VOCS location get failed (%d) for inst %p\n", err, inst);
	} else {
		printk("VOCS inst %p location %u\n", inst, location);
	}
}

static void vocs_description_cb(struct bt_vocs *inst, int err,
				char *description)
{
	if (err) {
		printk("VOCS description get failed (%d) for inst %p\n", err, inst);
	} else {
		printk("VOCS inst %p description %s\n", inst, description);
	}
}

static struct bt_vocs_cb vocs_cbs = {
	.state = vocs_state_cb,
	.location = vocs_location_cb,
	.description = vocs_description_cb
};
#endif /* CONFIG_BT_VCS_VOCS_INSTANCE_COUNT */

static int vcs_init(void)
{
	struct bt_vcs_register_param param;

	memset(&param, 0, sizeof(param));

#if CONFIG_BT_VCS_VOCS_INSTANCE_COUNT > 0
	char output_desc[CONFIG_BT_VCS_VOCS_INSTANCE_COUNT][16];

	for (int i = 0; i < ARRAY_SIZE(param.vocs_param); i++) {
		param.vocs_param[i].location_writable = true;
		param.vocs_param[i].desc_writable = true;
		snprintf(output_desc[i], sizeof(output_desc[i]),
			 "Output %d", i + 1);
		param.vocs_param[i].output_desc = output_desc[i];
		param.vocs_param[i].cb = &vocs_cbs;
	}
#endif /* CONFIG_BT_VCS_VOCS_INSTANCE_COUNT */

#if CONFIG_BT_VCS_AICS_INSTANCE_COUNT > 0
	char input_desc[CONFIG_BT_VCS_AICS_INSTANCE_COUNT][16];

	for (int i = 0; i < ARRAY_SIZE(param.aics_param); i++) {
		param.aics_param[i].desc_writable = true;
		snprintf(input_desc[i], sizeof(input_desc[i]),
			 "Input %d", i + 1);
		param.aics_param[i].description = input_desc[i];
		param.aics_param[i].type = BT_AICS_INPUT_TYPE_UNSPECIFIED;
		param.aics_param[i].status = true;
		param.aics_param[i].gain_mode = BT_AICS_MODE_MANUAL;
		param.aics_param[i].units = 1;
		param.aics_param[i].min_gain = -100;
		param.aics_param[i].max_gain = 100;
		param.aics_param[i].cb = &aics_cbs;
	}
#endif /* CONFIG_BT_VCS_AICS_INSTANCE_COUNT */

	param.step = 1;
	param.mute = BT_VCS_STATE_UNMUTED;
	param.volume = 100;

	param.cb = &vcs_cbs;

	return bt_vcs_register(&param, &vcs);
}

#if defined(CONFIG_BT_MICS)
static struct bt_mics *mics;

static void mics_mute_cb(struct bt_mics *mics, int err, uint8_t mute)
{
	if (err != 0) {
		printk("Mute get failed (%d)\n", err);
	} else {
		printk("Mute value %u\n", mute);
	}
}

static struct bt_mics_cb mics_cbs = {
	.mute = mics_mute_cb,
};

#if CONFIG_BT_MICS_AICS_INSTANCE_COUNT > 0
static void mics_aics_state_cb(struct bt_aics *inst, int err, int8_t gain,
			       uint8_t mute, uint8_t mode)
{
	if (err != 0) {
		printk("AICS state get failed (%d) for inst %p\n", err, inst);
	} else {
		printk("AICS inst %p state gain %d, mute %u, mode %u\n", inst, gain, mute, mode);
	}

}
static void mics_aics_gain_setting_cb(struct bt_aics *inst, int err,
				      uint8_t units, int8_t minimum,
				      int8_t maximum)
{
	if (err != 0) {
		printk("AICS gain settings get failed (%d) for inst %p\n", err, inst);
	} else {
		printk("AICS inst %p gain settings units %u, min %d, max %d\n", inst, units,
		       minimum, maximum);
	}

}
static void mics_aics_input_type_cb(struct bt_aics *inst, int err,
				    uint8_t input_type)
{
	if (err != 0) {
		printk("AICS input type get failed (%d) for inst %p\n", err, inst);
	} else {
		printk("AICS inst %p input type %u\n", inst, input_type);
	}

}
static void mics_aics_status_cb(struct bt_aics *inst, int err, bool active)
{
	if (err != 0) {
		printk("AICS status get failed (%d) for inst %p\n", err, inst);
	} else {
		printk("AICS inst %p status %s\n", inst, active ? "active" : "inactive");
	}

}
static void mics_aics_description_cb(struct bt_aics *inst, int err,
				     char *description)
{
	if (err != 0) {
		printk("AICS description get failed (%d) for inst %p\n", err, inst);
	} else {
		printk("AICS inst %p description %s\n", inst, description);
	}
}

static struct bt_aics_cb aics_cb = {
	.state = mics_aics_state_cb,
	.gain_setting = mics_aics_gain_setting_cb,
	.type = mics_aics_input_type_cb,
	.status = mics_aics_status_cb,
	.description = mics_aics_description_cb,
};
#endif /* CONFIG_BT_MICS_AICS_INSTANCE_COUNT > 0 */

static int mics_init(void)
{
	struct bt_mics_register_param mics_param;

	(void)memset(&mics_param, 0, sizeof(mics_param));

#if CONFIG_BT_MICS_AICS_INSTANCE_COUNT > 0
	char input_desc[CONFIG_BT_MICS_AICS_INSTANCE_COUNT][16];

	for (int i = 0; i < ARRAY_SIZE(mics_param.aics_param); i++) {
		mics_param.aics_param[i].desc_writable = true;
		snprintf(input_desc[i], sizeof(input_desc[i]),
			 "Input %d", i + 1);
		mics_param.aics_param[i].description = input_desc[i];
		mics_param.aics_param[i].type = BT_AICS_INPUT_TYPE_UNSPECIFIED;
		mics_param.aics_param[i].status = true;
		mics_param.aics_param[i].gain_mode = BT_AICS_MODE_MANUAL;
		mics_param.aics_param[i].units = 1;
		mics_param.aics_param[i].min_gain = -100;
		mics_param.aics_param[i].max_gain = 100;
		mics_param.aics_param[i].cb = &aics_cb;
	}
#endif /* CONFIG_BT_MICS_AICS_INSTANCE_COUNT > 0 */

	mics_param.cb = &mics_cbs;

	return bt_mics_register(&mics_param, &mics);
}
#endif /* CONFIG_BT_MICS */

int hearing_aid_volume_init(void)
{
        int err;

        err = vcs_init();
	if (err) {
		printk("VCS init failed (err %d)\n", err);
		return err;
	}

	printk("VCS initialized\n");

#if defined(CONFIG_BT_MICS)
	err = mics_init();
	if (err) {
		printk("MICS init failed (err %d)\n", err);
		return err;
	}

	printk("MICS initialized\n");
#endif /* CONFIG_BT_MICS */

        return 0;
}
```
