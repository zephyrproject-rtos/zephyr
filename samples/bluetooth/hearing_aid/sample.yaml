## samples/bluetooth/hearing_aid/sample.yaml
```yaml
sample:
  description: Bluetooth Hearing Aid sample
  name: Bluetooth Hearing Aid sample
tests:
  sample.bluetooth.hearing_aid:
    harness: bluetooth
    platform_allow: qemu_cortex_m3 qemu_x86
    tags: bluetooth
```

## samples/bluetooth/ibeacon/sample.yaml
```yaml
sample:
  description: Sample code for Zephyr iBeacon Demo
  name: iBeacon
tests:
  sample.bluetooth.ibeacon:
    harness: bluetooth
    platform_allow:
      - bbc_microbit
      - qemu_x86
    tags: bluetooth
    integration_platforms:
      - qemu_x86
  sample.bluetooth.ibeacon.console:
    tags: bluetooth
    harness: console
    harness_config:
      type: one_line
      regex:
        - "iBeacon started"
    platform_allow:
      - apollo510b_evb
```

## samples/bluetooth/ipsp/sample.yaml
```yaml
sample:
  name: Bluetooth IPSP Sample
  description: IPSP (Internet Protocol Support Profile) Node role sample
tests:
  sample.bluetooth.ipsp:
    harness: bluetooth
    platform_allow:
      - qemu_x86/atom
      - qemu_cortex_m3/ti_lm3s6965
    tags:
      - bluetooth
      - net
    integration_platforms:
      - qemu_x86/atom
  sample.bluetooth.ipsp.zep1656:
    harness: bluetooth
    extra_args: CONF_FILE="prj_zep1656.conf"
    platform_allow:
      - qemu_x86/atom
      - qemu_cortex_m3/ti_lm3s6965
    tags:
      - bluetooth
      - net
    integration_platforms:
      - qemu_x86/atom
```

## samples/bluetooth/iso_broadcast/Kconfig
```kconfig
# Copyright (c) 2023 Nordic Semiconductor ASA
# SPDX-License-Identifier: Apache-2.0

mainmenu "Bluetooth: ISO Broadcast"

config ISO_PACKING_INTERLEAVED
	bool "Use interleaved packing"
	help
	  Use interleaved packing between BIS ISO stream subevents.

config ISO_PRINT_INTERVAL
	int "Interval between each packet report"
	range 1 360000
	default 1
	help
	  Only print the packet report once in a given interval of ISO packets.

config BIG_TERMINATE_TIMEOUT_SECONDS
	int "BIG terminate timeout in seconds"	
	range 0 86400
	default 60
	help
	  Every BIG will be terminated after this timeout. Set to 0 to disable.
	  This is useful to test the BIG termination procedure
	  The BIG will be automatically recreated after termination.

config BIS_SEND_PAYLOAD_MASK
	hex "Bitmask for which BIS will actually be sent"
	range 0x1 0xFFFFFFFF
	default 0xFFFFFFFF
	help
	  Every BIG will be terminated after this timeout. Set to 0 to disable.
	  This is useful to test the BIG termination procedure
	  The BIG will be automatically recreated after termination.
	  
source "Kconfig.zephyr"
```

## samples/bluetooth/iso_broadcast/boards/nrf21540dk_nrf52840.conf
```kconfig
CONFIG_BT_CTLR_ADV_ISO=y
CONFIG_BT_CTLR_ADV_ISO_PDU_LEN_MAX=251
CONFIG_BT_CTLR_ADV_ISO_STREAM_MAX=2
CONFIG_BT_CTLR_ISOAL_SOURCES=2
```

## samples/bluetooth/iso_broadcast/boards/nrf52840dk_nrf52840.conf
```kconfig
CONFIG_BT_CTLR_ADV_ISO=y
CONFIG_BT_CTLR_ADV_ISO_PDU_LEN_MAX=251
CONFIG_BT_CTLR_ADV_ISO_STREAM_MAX=2
```

## samples/bluetooth/iso_broadcast/sample.yaml
```yaml
sample:
  name: Bluetooth ISO Broadcaster
tests:
  sample.bluetooth.iso_broadcast:
    harness: bluetooth
    platform_allow:
      - qemu_cortex_m3
      - qemu_x86
      - nrf52_bsim
      - nrf52dk/nrf52832
    integration_platforms:
      - qemu_cortex_m3
    tags: bluetooth
  sample.bluetooth.iso_broadcast.bt_ll_sw_split:
    harness: bluetooth
    platform_allow:
      - qemu_cortex_m3
      - qemu_x86
      - nrf52_bsim
      - nrf52833dk/nrf52833
    integration_platforms:
      - nrf52833dk/nrf52833
    extra_args: OVERLAY_CONFIG=overlay-bt_ll_sw_split.conf
    tags: bluetooth
```

## samples/bluetooth/iso_broadcast_benchmark/sample.yaml
```yaml
sample:
  name: Bluetooth LE ISO Broadcast
  description: Bluetooth Low Energy ISO Broadcast Benchmark sample
tests:
  sample.bluetooth.iso_broadcast_benchmark:
    build_only: true
    platform_allow:
      - nrf5340dk/nrf5340/cpuapp
      - nrf5340_audio_dk/nrf5340/cpuapp
    integration_platforms:
      - nrf5340dk/nrf5340/cpuapp
    tags: bluetooth
  sample.bluetooth.iso_broadcast_benchmark.nrf52x.bt_ll_sw_split:
    harness: bluetooth
    platform_allow:
      - nrf52_bsim
      - nrf52833dk/nrf52833
    integration_platforms:
      - nrf52833dk/nrf52833
    extra_args: EXTRA_CONF_FILE=overlay-bt_ll_sw_split.conf
    tags: bluetooth
```

## samples/bluetooth/iso_central/sample.yaml
```yaml
sample:
  description: Bluetooth ISO central (client) sample
  name: Bluetooth ISO central (client) sample
tests:
  sample.bluetooth.iso_central:
    harness: bluetooth
    platform_allow: qemu_x86
    integration_platforms:
      - qemu_x86
    tags: bluetooth
  sample.bluetooth.iso_central.bt_ll_sw_split:
    harness: bluetooth
    platform_allow:
      - qemu_cortex_m3
      - qemu_x86
      - nrf52_bsim
      - nrf52833dk/nrf52833
    integration_platforms:
      - nrf52833dk/nrf52833
    extra_args: EXTRA_CONF_FILE=overlay-bt_ll_sw_split.conf
    tags: bluetooth
```

## samples/bluetooth/iso_connected_benchmark/sample.yaml
```yaml
sample:
  name: BLE ISO Connected
  description: Bluetooth Low Energy ISO Connected Benchmark sample
tests:
  sample.bluetooth.iso_connected_benchmark:
    build_only: true
    platform_allow:
      - nrf5340dk_nrf5340_cpuapp
      - nrf5340_audio_dk_nrf5340_cpuapp
    tags: bluetooth
```

## samples/bluetooth/iso_group_chat/common/Kconfig
```kconfig
# Copyright (c) 2025 Tailored Technology Ltd
# SPDX-License-Identifier: Apache-2.0

config ISO_PRINT_INTERVAL
	int "Interval between each packet report"
	range 1 360000
	default 1
	help
	  Only print the packet report once in a given interval of ISO packets.

config ISO_ALIGN_PRINT_INTERVALS
	bool "Align report interval with incoming packets"
	help
	  Align interval-counter with packet number from incoming ISO packets.
	  This may be needed if report printouts are to be synchronized between
	  the iso_broadcast sample and the iso_receive sample.

config BT_ISO_GROUPCHAT_COMMON
    bool "Enable common code specific to the groupchat feature devices"
    default n
	help
	  When enabled, additional features and modifications shared by all
	  groupchat devices will be compiled into the project. This option can
	  blocks guarded by `#ifdef CONFIG_BT_ISO_GROUPCHAT_COMMON` in shared .c
	  and .h files.

config GROUPCHAT_FUNCTION_DEBUG
	bool "Enable function debug"
    default n
	help
	  When enabled, functions which are conditionally marked with 
	  __attribute__((optimize("O0"))) around this config will not be
	  optimied by the compiler to enable debugging.

config GROUPCHAT_PRINTMT_ENABLE
    bool "Enable expansion of PRINTMT macro to printk"
    default n
	help
	  This is to help debug controller source code. It will expand the PRINTMT
	  macro to printk. And the following code MUST be added to any file that
	  uses the PRINTMT macro:
	    #define PRINTMT(fmt, ...)  printk(fmt, ##__VA_ARGS__)  /* HACK-MJT*/
	    #else
	    #define PRINTMT(fmt, ...)
	    #endif
```

## samples/bluetooth/iso_group_chat/mixer/Kconfig
```kconfig
# Copyright (c) 2023 Nordic Semiconductor ASA
# SPDX-License-Identifier: Apache-2.0

source "Kconfig.zephyr"

mainmenu "Bluetooth: GroupChat Mixer"

config ISO_PRINT_INTERVAL
	int "Interval between each packet report"
	range 1 360000
	default 1
	help
	  Only print the packet report once in a given interval of ISO packets.

config ISO_ALIGN_PRINT_INTERVALS
	bool "Align report interval with incoming packets"
	help
	  Align interval-counter with packet number from incoming ISO packets.
	  This may be needed if report printouts are to be synchronized between
	  the iso_broadcast sample and the iso_receive sample.

config ISO_BLINK_LED0
	bool "Blink led0"
	depends on $(dt_alias_enabled,led0)
	select GPIO
	default y

config GROUPCHAT_COMMON
    bool "Enable common code specific to the groupchat feature devices"
    default n
	help
	  When enabled, additional features and modifications shared by all
	  groupchat devices will be compiled into the project. This option can
	  blocks guarded by `#ifdef CONFIG_GROUPCHAT_COMMON` in shared .c
	  and .h files.

config GROUPCHAT_MIXER
    bool "Enable code specific to the groupchat mixer device"
    default n
	help
	  When enabled, additional features and modifications will be compiled
	  into the project. This option can be used to include or exclude code
	  blocks guarded by `#ifdef CONFIG_GROUPCHAT_MIXER` in shared .c
	  and .h files.
```

## samples/bluetooth/iso_group_chat/mixer/sample.yaml
```yaml
sample:
  name: Bluetooth Group Chat - Mixer
  description: LE Broadcast Sink, BIG with 2 BIS, Rx all BISes
tests:
  sample.bluetooth.iso_group_chat.mixer:
    build_only: true  # Ensures only the build process is executed, no functional tests
    platform_allow:
      - qemu_cortex_m3
      - qemu_x86
      - nrf52_bsim
      - nrf52840dk/nrf52840
    integration_platforms:
      - nrf52840dk/nrf52840
    tags:
      - bluetooth 
```

## samples/bluetooth/iso_group_chat/primary/Kconfig
```kconfig
# Copyright (c) 2023 Nordic Semiconductor ASA
# SPDX-License-Identifier: Apache-2.0

source "Kconfig.zephyr"

mainmenu "Bluetooth: GroupChat Primary"

source "samples/bluetooth/iso_group_chat/common/Kconfig"

config BT_ISO_GROUPCHAT_PRIMARY
    bool "Enable code specific to the groupchat primary device"
    default n
	help
	  When enabled, additional features and modifications will be compiled
	  into the project. This option can be used to include or exclude code
	  blocks guarded by `#ifdef CONFIG_BT_ISO_GROUPCHAT_PRIMARY` in shared .c
	  and .h files.
```

## samples/bluetooth/iso_group_chat/primary/sample.yaml
```yaml
sample:
  name: Bluetooth Group Chat - Primary
  description: LE Broadcast Source, BIG with 2 BIS, tx on only BIS1
tests:
  sample.bluetooth.iso_group_chat.primary:
    build_only: true  # Ensures only the build process is executed, no functional tests
    platform_allow:
      - qemu_cortex_m3
      - qemu_x86
      - nrf52_bsim
      - nrf52840dk/nrf52840
    integration_platforms:
      - nrf52840dk/nrf52840
    tags:
      - bluetooth 
```

## samples/bluetooth/iso_group_chat/secondary/Kconfig
```kconfig
# Copyright (c) 2023 Nordic Semiconductor ASA
# SPDX-License-Identifier: Apache-2.0

source "Kconfig.zephyr"

mainmenu "Bluetooth: GroupChat Secondary"

source "samples/bluetooth/iso_group_chat/common/Kconfig"

config ISO_BLINK_LED0
	bool "Blink led0"
	depends on $(dt_alias_enabled,led0)
	select GPIO
	default y

config BT_ISO_GROUPCHAT_SECONDARY
    bool "Enable code specific to the groupchat secondary device"
    default n
	help
	  When enabled, additional features and modifications will be compiled
	  into the project. This option can be used to include or exclude code
	  blocks guarded by `#ifdef CONFIG_BT_ISO_GROUPCHAT_SECONDARY` in shared .c
	  and .h files.
```

## samples/bluetooth/iso_group_chat/secondary/sample.yaml
```yaml
sample:
  name: Bluetooth Group Chat - Secondary
  description: LE Broadcast Sink, BIG with 2 BIS, Rx on BIS1, Tx on BIS2
tests:
  sample.bluetooth.iso_group_chat.mixer.secondary:
    build_only: true  # Ensures only the build process is executed, no functional tests
    platform_allow:
      - qemu_cortex_m3
      - qemu_x86
      - nrf52_bsim
      - nrf52840dk/nrf52840
    integration_platforms:
      - nrf52840dk/nrf52840
    tags:
      - bluetooth 
```

## samples/bluetooth/iso_peripheral/sample.yaml
```yaml
sample:
  description: Bluetooth ISO peripheral (server) sample
  name: Bluetooth ISO peripheral (server) sample
tests:
  sample.bluetooth.iso_peripheral:
    harness: bluetooth
    platform_allow: qemu_x86
    tags: bluetooth
    integration_platforms:
      - qemu_x86
```

## samples/bluetooth/iso_receive/Kconfig
```kconfig
# Copyright (c) 2023 Nordic Semiconductor ASA
# SPDX-License-Identifier: Apache-2.0

source "Kconfig.zephyr"

mainmenu "Bluetooth: ISO Receive"

config ISO_PRINT_INTERVAL
	int "Interval between each packet report"
	range 1 360000
	default 1
	help
	  Only print the packet report once in a given interval of ISO packets.

config ISO_ALIGN_PRINT_INTERVALS
	bool "Align report interval with incoming packets"
	help
	  Align interval-counter with packet number from incoming ISO packets.
	  This may be needed if report printouts are to be synchronized between
	  the iso_broadcast sample and the iso_receive sample.

config ISO_BLINK_LED0
	bool "Blink led0"
	depends on $(dt_alias_enabled,led0)
	select GPIO
	default y
```

## samples/bluetooth/iso_receive/boards/nrf52840dk_nrf52840.conf
```kconfig
CONFIG_BT_CTLR_ADV_EXT=y
CONFIG_BT_CTLR_SYNC_PERIODIC=y
CONFIG_BT_CTLR_SYNC_ISO=y
CONFIG_BT_CTLR_SYNC_ISO_PDU_LEN_MAX=251
```

## samples/bluetooth/iso_receive/sample.yaml
```yaml
sample:
  name: Bluetooth Synchronized Receiver
tests:
  sample.bluetooth.iso_receive:
    harness: bluetooth
    platform_allow: qemu_cortex_m3 qemu_x86 nrf52_bsim nrf52dk_nrf52832
    integration_platforms:
      - qemu_cortex_m3
    tags: bluetooth
```

## samples/bluetooth/iso_recv_send/Kconfig
```kconfig
# Copyright (c) 2023 Nordic Semiconductor ASA
# SPDX-License-Identifier: Apache-2.0

source "Kconfig.zephyr"

mainmenu "Bluetooth: ISO Receive"

config BT_ISO_BIS_RECV_SEND
	bool "Enable Send/Recv in a BIS for group talk"
	default n
	help
	  This option enables code in the underlying stack to send and receive
	  audio in a BIS for group talk. This is only needed if the application
	  is using the group talk feature. The default is to not include this
	  code in the stack, which saves some code space.
	  If enabled, then the following MUST also be enabled in either file
	  prj.conf or overlay-bt_ll_sw_split.conf:
          CONFIG_BT_CTLR_SYNC_ISO=y
          CONFIG_BT_CTLR_ADV_ISO=y


config BT_ISO_BIS_RECV_SEND_DBG
	bool "Enable Send/Recv related debug code and attributes"
	default n
	help
	  Use this attribute to enable disable debug code and attributes
	  related to the Send/Recv feature. This is only needed if the
	  application is using the group talk feature. The default is to
	  not include this code in the stack, which saves some code space.

config BT_ISO_FUNC_NO_OPTIMIZE_MASK
	hex "Bitmask for enable/disable -O0 optimisation for functions"
	default 0x00000000
	help
	  Default will leave all functions optimised as per default.
	   Do a search to finf which bitmask controls which function.

config ISO_PRINT_INTERVAL
	int "Interval between each packet report"
	range 1 360000
	default 1
	help
	  Only print the packet report once in a given interval of ISO packets.

config ISO_ALIGN_PRINT_INTERVALS
	bool "Align report interval with incoming packets"
	help
	  Align interval-counter with packet number from incoming ISO packets.
	  This may be needed if report printouts are to be synchronized between
	  the iso_broadcast sample and the iso_receive sample.

config ISO_BLINK_LED0
	bool "Blink led0"
	depends on $(dt_alias_enabled,led0)
	select GPIO
	default y

config APP_FEATURES_BITMASK
	hex "Bitmask for application features"
	default 0x00000000
	help
	  Default will generate normal expected behavior.
	   0x00000001 - Only print ext & pa adv packets when PA not synced
	   0x00000002 - Print BIS data in new enhanced report format



	  
```

## samples/bluetooth/iso_recv_send/sample.yaml
```yaml
sample:
  name: Bluetooth isochronous recv/send
tests:
  sample.bluetooth.iso_recv_send:
    harness: bluetooth
    platform_allow:
      - qemu_cortex_m3
      - qemu_x86
      - nrf52_bsim
      - nrf52dk/nrf52832
    integration_platforms:
      - qemu_cortex_m3
    tags: bluetooth
  sample.bluetooth.iso_recv_send.bt_ll_sw_split:
    harness: bluetooth
    platform_allow:
      - qemu_cortex_m3
      - qemu_x86
      - nrf52_bsim
      - nrf52dk/nrf52832
    integration_platforms:
      - nrf52dk/nrf52832
    extra_args: EXTRA_CONF_FILE=overlay-bt_ll_sw_split.conf
    tags: bluetooth
```
