## samples/bluetooth/periodic_sync/sample.yaml
```yaml
sample:
  name: Bluetooth Periodic Advertising Synchronization
tests:
  sample.bluetooth.periodic_sync:
    harness: bluetooth
    platform_allow:
      - qemu_cortex_m3/ti_lm3s6965
      - qemu_x86/atom
      - nrf52_bsim/nrf52833
      - nrf52dk/nrf52832
    tags: bluetooth
    integration_platforms:
      - qemu_cortex_m3/ti_lm3s6965
```

## samples/bluetooth/periodic_sync_rsp/sample.yaml
```yaml
sample:
  name: Bluetooth Periodic Advertising with Responses Synchronization
tests:
  sample.bluetooth.periodic_sync_rsp:
    harness: bluetooth
    platform_allow:
      - qemu_cortex_m3/ti_lm3s6965
      - qemu_x86/atom
      - nrf52840dk/nrf52840
    tags: bluetooth
    integration_platforms:
      - nrf52840dk/nrf52840
    extra_configs:
      - CONFIG_BT_CTLR=n
      - CONFIG_BT_NO_DRIVER=y
```

## samples/bluetooth/peripheral/sample.yaml
```yaml
sample:
  name: Bluetooth Peripheral
  description: Demonstrates the Bluetooth LE Peripheral role
tests:
  sample.bluetooth.peripheral:
    harness: bluetooth
    platform_allow:
      - qemu_x86
      - nucleo_wb55rg
    integration_platforms:
      - qemu_x86
    tags: bluetooth
  sample.bluetooth.peripheral.x_nucleo_idb05a1_shield:
    harness: bluetooth
    platform_allow: nucleo_l4r5zi
    depends_on:
      - arduino_spi
      - arduino_gpio
    extra_args: SHIELD=x_nucleo_idb05a1
    integration_platforms:
      - nucleo_l4r5zi
  sample.bluetooth.peripheral.no_blobs:
    extra_args:
      - CONFIG_BUILD_ONLY_NO_BLOBS=y
    platform_allow:
      - esp32_devkitc_wroom/esp32/procpu
      - esp32s3_devkitm/esp32s3/procpu
      - esp32c3_devkitm
      - sltb010a/efr32bg22c224f512im40
      - xg24_rb4187c/efr32mg24b220f1536im48
      - xg27_dk2602a/efr32bg27c140f768im40
      - xg29_rb4412a/efr32mg29b140f1024im40
    build_only: true
```

## samples/bluetooth/peripheral_accept_list/sample.yaml
```yaml
sample:
  name: Bluetooth Peripheral Accept List
tests:
  sample.bluetooth.peripheral_accept_list:
    harness: bluetooth
    platform_allow: qemu_x86
    tags: bluetooth
```

## samples/bluetooth/peripheral_amota/sample.yaml
```yaml
sample:
  name: Bluetooth AMOTA
  description: Demonstrates the Ambiq OTA GATT Service
tests:
  sample.bluetooth.peripheral_amota:
    harness: bluetooth
    platform_allow:
      - apollo4p_blue_kxr_evb
      - apollo510b_evb
    tags: bluetooth
  sample.bluetooth.peripheral_amota.console:
    harness: console
    harness_config:
      type: multi_line
      ordered: true
      regex:
        - "BLE AMOTA Application"
        - "Bluetooth initialized"
        - "Advertising successfully started"
    platform_allow:
      - apollo4p_blue_kxr_evb
      - apollo510b_evb
    tags: bluetooth
```

## samples/bluetooth/peripheral_csc/sample.yaml
```yaml
sample:
  name: Bluetooth Peripheral CSC
  description: Demonstrates the CSC (Cycling Speed and Cadence) GATT Service
tests:
  sample.bluetooth.peripheral_csc:
    harness: bluetooth
    platform_allow:
      - qemu_cortex_m3/ti_lm3s6965
      - qemu_x86/atom
    tags: bluetooth
    integration_platforms:
      - qemu_cortex_m3/ti_lm3s6965
```

## samples/bluetooth/peripheral_dis/sample.yaml
```yaml
sample:
  name: Bluetooth Peripheral DIS
  description: Demonstrates the DIS (Device Information) GATT Service
tests:
  sample.bluetooth.peripheral_dis:
    harness: bluetooth
    platform_allow:
      - qemu_cortex_m3
      - qemu_x86
      - ophelia4ev/nrf54l15/cpuapp
      - cyw920829m2evk_02/cyw20829b0lkml
    tags: bluetooth
    integration_platforms:
      - qemu_cortex_m3
```

## samples/bluetooth/peripheral_esp/Kconfig
```kconfig
# Copyright (c) 2026 Infineon Technologies AG,
# or an affiliate of Infineon Technologies AG.
#
# SPDX-License-Identifier: Apache-2.0

config ESP_USE_HARDWARE_SENSOR
	bool "Use hardware sensor for Environmental Sensing"
	default y if $(dt_alias_enabled,ambient-temp0) || \
		$(dt_alias_enabled,dht0) || \
		$(dt_alias_enabled,die-temp0)
	select SENSOR
	help
	  Enable this to use a physical sensor (via Devicetree aliases)
	  to provide real physical data over the BLE ESP profile instead
	  of simulating dummy values.

source "Kconfig.zephyr"
```

## samples/bluetooth/peripheral_esp/sample.yaml
```yaml
sample:
  name: Bluetooth Peripheral ESP
  description: Demonstrates the ESP (Environmental Sensing Profile) GATT Service
tests:
  sample.bluetooth.peripheral_esp:
    harness: bluetooth
    platform_allow:
      - qemu_cortex_m3/ti_lm3s6965
      - qemu_x86/atom
    tags: bluetooth
    integration_platforms:
      - qemu_cortex_m3/ti_lm3s6965
```

## samples/bluetooth/peripheral_ets/sample.yaml
```yaml
sample:
  name: Bluetooth Peripheral ETS
  description: Demonstrates the ETS (Elapsed Time Service) GATT Service
tests:
  sample.bluetooth.peripheral_ets:
    harness: bluetooth
    platform_allow:
      - qemu_cortex_m3
      - qemu_x86
      - frdm_rw612
    tags: bluetooth
    integration_platforms:
      - qemu_cortex_m3
  sample.bluetooth.peripheral_ets.local_time:
    harness: bluetooth
    platform_allow:
      - qemu_cortex_m3
      - qemu_x86
      - frdm_rw612
    integration_platforms:
      - qemu_cortex_m3
    extra_args: EXTRA_CONF_FILE=overlay-local-time.conf
    tags: bluetooth
```

## samples/bluetooth/peripheral_gatt_dynamic_service/sample.yaml
```yaml
sample:
  name: Bluetooth GATT Dynamic Service
  description: Demonstrates changing GATT services at runtime
tests:
  sample.bluetooth.peripheral_gatt_dynamic_service:
    harness: bluetooth
    platform_allow:
      - qemu_cortex_m3
      - qemu_x86
      - nrf52_bsim
      - nrf5340bsim/nrf5340/cpuapp
      - nrf51dk/nrf51822
      - nrf52dk/nrf52832
      - nrf52840dk/nrf52840
      - nrf5340dk/nrf5340/cpuapp
      - nrf54l15dk/nrf54l15/cpuapp
    integration_platforms:
      - qemu_cortex_m3
      - nrf52_bsim
      - nrf5340bsim/nrf5340/cpuapp
      - nrf51dk/nrf51822
      - nrf52dk/nrf52832
      - nrf52840dk/nrf52840
      - nrf5340dk/nrf5340/cpuapp
      - nrf54l15dk/nrf54l15/cpuapp
    tags: bluetooth
```

## samples/bluetooth/peripheral_gatt_notify/sample.yaml
```yaml
sample:
  name: Bluetooth Peripheral GATT Notify
tests:
  sample.bluetooth.peripheral_gatt_notify:
    harness: bluetooth
    platform_allow:
      - qemu_cortex_m3
      - qemu_x86
      - nrf52_bsim
    tags: bluetooth
    integration_platforms:
      - qemu_cortex_m3
```

## samples/bluetooth/peripheral_gatt_write/Kconfig
```kconfig
# Copyright (c) 2025 Nordic Semiconductor ASA
# SPDX-License-Identifier: Apache-2.0

source "samples/bluetooth/central_gatt_write/Kconfig.gatt_write"
source "Kconfig.zephyr"
```

## samples/bluetooth/peripheral_hids/Kconfig
```kconfig
# Copyright 2023 Google LLC
# SPDX-License-Identifier: Apache-2.0

mainmenu "Bluetooth: Peripheral HIDs"

config SAMPLE_BT_USE_AUTHENTICATION
	bool "Enable passkey authentication"
	default y
	help
	  Enable the passkey authentication callback and register the GATT
	  read and and write attributes as authentication required.

source "Kconfig.zephyr"
```

## samples/bluetooth/peripheral_hids/sample.yaml
```yaml
sample:
  name: Bluetooth Peripheral HIDs
  description: Bluetooth Low Energy HID-over-GATT service sample
tests:
  sample.bluetooth.peripheral_hids:
    harness: bluetooth
    platform_allow: qemu_cortex_m3 qemu_x86
    tags: bluetooth
    integration_platforms:
      - qemu_cortex_m3
  sample.bluetooth.peripheral_hids.no_authentication:
    harness: bluetooth
    extra_configs:
      - CONFIG_SAMPLE_BT_USE_AUTHENTICATION=n
    platform_allow: qemu_cortex_m3 qemu_x86
    tags: bluetooth
    integration_platforms:
      - qemu_cortex_m3
```

## samples/bluetooth/peripheral_hogp/sample.yaml
```yaml
sample:
  name: Bluetooth Peripheral HOGP
  description: BLE HID over GATT Profile Device (Mouse)
tests:
  sample.bluetooth.peripheral_hogp:
    tags: bluetooth
    platform_allow:
      - native_sim/native/64
      - nrf52840dk/nrf52840
    integration_platforms:
      - native_sim/native/64
    harness: bluetooth
```

## samples/bluetooth/peripheral_hr/Kconfig
```kconfig
# Copyright 2024 Nordic Semiconductor ASA
# SPDX-License-Identifier: Apache-2.0

if "$(FILE_SUFFIX)" = "extended"

# Increase Advertising Data Length, as Complete Local Name too needs to be
# placed in the AUX_ADV_IND PDU compared to when it is placed in ADV_SCAN_IND
# PDU in the case of legacy advertising.
configdefault BT_CTLR_ADV_DATA_LEN_MAX
	default 36

endif


if "$(FILE_SUFFIX)" = "phy_coded"

# Increase Advertising Data Length, as Complete Local Name too needs to be
# placed in the AUX_ADV_IND PDU compared to when it is placed in ADV_SCAN_IND
# PDU in the case of legacy advertising.
configdefault BT_CTLR_ADV_DATA_LEN_MAX
	default 36

configdefault BT_CTLR_PHY_CODED
	default y

endif


source "Kconfig"
```

## samples/bluetooth/peripheral_hr/Kconfig.sysbuild
```kconfig
# Copyright 2023-2024 Nordic Semiconductor ASA
# SPDX-License-Identifier: Apache-2.0

source "share/sysbuild/Kconfig"

config NET_CORE_BOARD
	string
	default "nrf5340dk/nrf5340/cpunet" if $(BOARD) = "nrf5340dk"
	default "nrf5340_audio_dk/nrf5340/cpunet" if $(BOARD) = "nrf5340_audio_dk"
	default "nrf5340bsim/nrf5340/cpunet" if $(BOARD_TARGET_STRING) = "NRF5340BSIM_NRF5340_CPUAPP"

config NET_CORE_IMAGE_HCI_IPC
	bool "HCI IPC image on network core"
	default y
	depends on NET_CORE_BOARD != ""

config BT_CTLR_SCAN_DATA_LEN_MAX
	int "Scan data length max"
	default 36
	depends on TEST_MODE_EXTENDED || TEST_MODE_PHY_CODED

config BT_BUF_EVT_DISCARDABLE_SIZE
	int "Discardable buffer size"
	default 58
	depends on TEST_MODE_EXTENDED || TEST_MODE_PHY_CODED

choice TEST_MODE
	prompt "Test mode"
	default TEST_MODE_MINIMAL

config TEST_MODE_MINIMAL
	bool "Minimal"

config TEST_MODE_EXTENDED
	bool "Extended"

config TEST_MODE_PHY_CODED
	bool "PHY coded"

endchoice
```

## samples/bluetooth/peripheral_hr/boards/nrf54h20dk_nrf54h20_cpuapp.conf
```kconfig
# Increase main stack needed
CONFIG_MAIN_STACK_SIZE=2048

# Enable Power Management for nRF54H20
CONFIG_PM=y
```

## samples/bluetooth/peripheral_hr/boards/nrf9160dk_nrf9160.conf
```kconfig
CONFIG_BT_WAIT_NOP=y
CONFIG_BT_H4=y

CONFIG_BT_UART_ON_DEV_NAME="UART_2"

# CONFIG_UART_INTERRUPT_DRIVEN=y
# CONFIG_BT_H4_UART_INTERRUPT_DRIVEN=y

CONFIG_BT_H4_UART_ASYNC=y
CONFIG_UART_2_INTERRUPT_DRIVEN=n
CONFIG_UART_2_ASYNC=y
CONFIG_UART_2_NRF_HW_ASYNC=y
CONFIG_UART_2_NRF_HW_ASYNC_TIMER=1
```

## samples/bluetooth/peripheral_hr/sample.yaml
```yaml
sample:
  name: Bluetooth Peripheral HR
  description: Demonstrates the HR (Heart Rate) GATT Service
tests:
  sample.bluetooth.peripheral_hr:
    harness: bluetooth
    platform_allow:
      - qemu_cortex_m3
      - qemu_x86
      - nrf52_bsim
      - nrf5340bsim/nrf5340/cpuapp
      - nrf51dk/nrf51822
      - nrf52dk/nrf52832
      - nrf52840dk/nrf52840
      - nrf5340dk/nrf5340/cpuapp
      - nrf54l15dk/nrf54l15/cpuapp
      - ophelia4ev/nrf54l15/cpuapp
      - nrf54lm20dk/nrf54lm20a/cpuapp
    integration_platforms:
      - qemu_cortex_m3
      - nrf52_bsim
      - nrf5340bsim/nrf5340/cpuapp
      - nrf51dk/nrf51822
      - nrf52dk/nrf52832
      - nrf52840dk/nrf52840
      - nrf5340dk/nrf5340/cpuapp
      - nrf54l15dk/nrf54l15/cpuapp
      - ophelia4ev/nrf54l15/cpuapp
      - nrf54lm20dk/nrf54lm20a/cpuapp
    tags: bluetooth
    sysbuild: true
  sample.bluetooth.peripheral_hr.minimal:
    harness: bluetooth
    platform_allow:
      - qemu_cortex_m3
    integration_platforms:
      - qemu_cortex_m3
    extra_args:
      - CONF_FILE=prj_minimal.conf
    tags: bluetooth
  sample.bluetooth.peripheral_hr.bt_ll_sw_split.minimal:
    harness: bluetooth
    platform_allow:
      - bbc_microbit
      - nrf52dk/nrf52832
      - nrf54l15dk/nrf54l15/cpuapp
    integration_platforms:
      - bbc_microbit
      - nrf52dk/nrf52832
      - nrf54l15dk/nrf54l15/cpuapp
    extra_args:
      - CONF_FILE=prj_minimal.conf
      - EXTRA_CONF_FILE=overlay-bt_ll_sw_split-minimal.conf
    tags: bluetooth
  sample.bluetooth.peripheral_hr.bt_ll_sw_split.extended:
    harness: bluetooth
    platform_allow:
      - nrf52_bsim
      - nrf52dk/nrf52832
      - nrf52840dk/nrf52840
    integration_platforms:
      - nrf52_bsim
      - nrf52dk/nrf52832
      - nrf52840dk/nrf52840
    extra_args: EXTRA_CONF_FILE=overlay-extended.conf
    tags: bluetooth
  sample.bluetooth.peripheral_hr.multicore.bt_ll_sw_split.extended:
    harness: bluetooth
    platform_allow:
      - nrf5340bsim/nrf5340/cpuapp
      - nrf5340dk/nrf5340/cpuapp
    integration_platforms:
      - nrf5340bsim/nrf5340/cpuapp
      - nrf5340dk/nrf5340/cpuapp
    extra_args: CONFIG_BT_EXT_ADV=y
    tags: bluetooth
    sysbuild: true
  sample.bluetooth.peripheral_hr.bt_ll_sw_split.phy_coded:
    harness: bluetooth
    platform_allow:
      - nrf52_bsim
      - nrf52dk/nrf52832
      - nrf52840dk/nrf52840
    integration_platforms:
      - nrf52_bsim
      - nrf52dk/nrf52832
      - nrf52840dk/nrf52840
    extra_args: EXTRA_CONF_FILE=overlay-phy_coded.conf
    tags: bluetooth
    sysbuild: true
  sample.bluetooth.peripheral_hr.multicore.bt_ll_sw_split.phy_coded:
    harness: bluetooth
    platform_allow:
      - nrf5340bsim/nrf5340/cpuapp
      - nrf5340dk/nrf5340/cpuapp
    integration_platforms:
      - nrf5340bsim/nrf5340/cpuapp
      - nrf5340dk/nrf5340/cpuapp
    extra_args:
      - CONFIG_BT_EXT_ADV=y
      - CONFIG_BT_AUTO_PHY_UPDATE=n
    tags: bluetooth
    sysbuild: true
  sample.bluetooth.peripheral_hr_rv32m1_vega_openisa_rv32m1_ri5cy:
    platform_allow: rv32m1_vega/openisa_rv32m1/ri5cy
    tags: bluetooth
    build_only: true
  sample.bluetooth.peripheral_hr.frdm_kw41z_shield:
    harness: bluetooth
    depends_on: arduino_serial
    tags: bluetooth
    extra_args: SHIELD=frdm_kw41z
```

## samples/bluetooth/peripheral_ht/Kconfig
```kconfig
# Copyright (c) 2021 Nordic Semiconductor ASA
# SPDX-License-Identifier: Apache-2.0

mainmenu "Bluetooth: Peripheral HT"

config SENSOR
	default y if HAS_HW_NRF_TEMP || $(dt_alias_enabled,dht0)

if HAS_HW_NRF_TEMP

config TEMP_NRF5
	default y

endif # HAS_HW_NRF_TEMP

source "Kconfig.zephyr"
```

## samples/bluetooth/peripheral_ht/sample.yaml
```yaml
sample:
  name: Bluetooth Peripheral HT
  description: Demonstrates the HT (Health Thermometer) GATT Service
tests:
  sample.bluetooth.peripheral_ht:
    harness: bluetooth
    platform_allow:
      - qemu_cortex_m3
      - qemu_x86
      - nrf51dk/nrf51822
      - nrf52dk/nrf52832
    tags: bluetooth
    integration_platforms:
      - qemu_cortex_m3
  sample.bluetooth.peripheral_ht.frdm_kw41z_shield:
    harness: bluetooth
    platform_allow:
      - mimxrt1020_evk
      - mimxrt1050_evk/mimxrt1052/hyperflash
      - mimxrt1060_evk@A/mimxrt1062/qspi
      - mimxrt1060_evk@B/mimxrt1062/qspi
      - mimxrt1060_evk@C/mimxrt1062/qspi
      - frdm_k64f
    tags: bluetooth
    extra_args: SHIELD=frdm_kw41z
    integration_platforms:
      - mimxrt1020_evk
      - mimxrt1060_evk/mimxrt1062/qspi
  sample.bluetooth.peripheral_ht.nxp:
    # Disabling monolithic since CI environment doesn't use blobs
    build_only: true
    harness: bluetooth
    platform_allow:
      - rd_rw612_bga
      - frdm_rw612
    extra_configs:
      - CONFIG_NXP_MONOLITHIC_NBU=n
```
