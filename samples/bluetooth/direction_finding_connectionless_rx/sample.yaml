## samples/bluetooth/hci_rpmsg/boards/thingy53_nrf5340_cpunet.conf
```kconfig
# Copyright (c) 2021 Nordic Semiconductor ASA
#
# SPDX-License-Identifier: Apache-2.0

# Reduce RAM usage to let the firmware fit on network core
CONFIG_BT_MAX_CONN=10

# Increase maximum data length of PDU supported in the Controller
CONFIG_BT_CTLR_DATA_LENGTH_MAX=251
CONFIG_BT_BUF_ACL_TX_SIZE=251
CONFIG_BT_BUF_ACL_RX_SIZE=251
```

## samples/bluetooth/hci_rpmsg/sample.yaml
```yaml
sample:
  description: Allows Zephyr to provide Bluetooth connectivity
    via RPMsg.
  name: Bluetooth HCI RPMsg
tests:
  sample.bluetooth.hci_rpmsg:
    harness: bluetooth
    platform_allow: nrf5340dk_nrf5340_cpunet
    tags: bluetooth
    integration_platforms:
      - nrf5340dk_nrf5340_cpunet
  sample.bluetooth.hci_rpmsg.iso_broadcast.bt_ll_sw_split:
    harness: bluetooth
    extra_args: CONF_FILE="nrf5340_cpunet_iso_broadcast-bt_ll_sw_split.conf"
    platform_allow: nrf5340dk_nrf5340_cpunet
    tags: bluetooth
    integration_platforms:
      - nrf5340dk_nrf5340_cpunet
  sample.bluetooth.hci_rpmsg.iso_receive.bt_ll_sw_split:
    harness: bluetooth
    extra_args: CONF_FILE="nrf5340_cpunet_iso_receive-bt_ll_sw_split.conf"
    platform_allow: nrf5340dk_nrf5340_cpunet
    tags: bluetooth
    integration_platforms:
      - nrf5340dk_nrf5340_cpunet
```

## samples/bluetooth/hci_spi/sample.yaml
```yaml
sample:
  description: Allows Zephyr to provide Bluetooth connectivity
    via SPI.
  name: Bluetooth HCI SPI
tests:
  sample.bluetooth.hci_spi:
    harness: bluetooth
    platform_allow: nrf52840dk_nrf52840
    integration_platforms:
      - nrf52840dk_nrf52840
    tags: bluetooth spi
```

## samples/bluetooth/hci_uart/Kconfig
```kconfig
# Copyright (c) 2025 Zephyr Project members and individual contributors
# SPDX-License-Identifier: Apache-2.0
#

mainmenu "Bluetooth: HCI UART"

menu "HCI UART"

config HCI_UART_APP_DEFAULT_FEATURES
	bool "Enable default HCI UART features"
	select BT_CTLR_ASSERT_HANDLER
	select BT_CTLR_DTM_HCI
	select BT_CTLR_DTM_HCI_SUPPORT
	select BT_CTLR_CRYPTO_SUPPORT
	default y

endmenu

menu "Zephyr"
source "Kconfig.zephyr"
endmenu
```

## samples/bluetooth/hci_uart/boards/ATMEVK-3425-YQK-5_ns.conf
```kconfig
# Override prj.conf defaults
CONFIG_CONSOLE=y
CONFIG_STDOUT_CONSOLE=y
CONFIG_UART_CONSOLE=y
CONFIG_BT_BUF_ACL_TX_SIZE=255
CONFIG_BT_BUF_ACL_TX_COUNT=10
# override the following since the Zephyr LL controller is not used
CONFIG_BT_CTLR_DTM_HCI=n
CONFIG_BT_CTLR_ASSERT_HANDLER=n
```

## samples/bluetooth/hci_uart/boards/bbc_microbit.conf
```kconfig
CONFIG_GPIO=y
CONFIG_MAIN_STACK_SIZE=512
CONFIG_IDLE_STACK_SIZE=256
CONFIG_ISR_STACK_SIZE=512
CONFIG_BT_MAX_CONN=10
```
