## samples/bluetooth/direction_finding_connectionless_rx/sample.yaml
```yaml
sample:
  name: Direction Finding Connectionless Locator
tests:
  sample.bluetooth.direction_finding_connectionless_rx:
    harness: bluetooth
    platform_allow:
      - nrf52833dk/nrf52833
      - nrf52833dk/nrf52820
      - nrf5340dk/nrf5340/cpuapp
    tags: bluetooth
    integration_platforms:
      - nrf52833dk/nrf52833
      - nrf52833dk/nrf52820
      - nrf5340dk/nrf5340/cpuapp
  sample.bluetooth.direction_finding_connectionless_rx.aod_with_controller:
    harness: bluetooth
    extra_args:
      - OVERLAY_CONFIG="overlay-aod.conf"
      - SNIPPET="bt-ll-sw-split"
    platform_allow:
      - nrf52833dk/nrf52833
      - nrf52833dk/nrf52820
    integration_platforms:
      - nrf52833dk/nrf52833
      - nrf52833dk/nrf52820
  sample.bluetooth.direction_finding_connectionless_rx.aod_host_only:
    harness: bluetooth
    extra_args:
      - OVERLAY_CONFIG="overlay-aod.conf"
    platform_allow:
      - nrf5340dk/nrf5340/cpuapp
    integration_platforms:
      - nrf5340dk/nrf5340/cpuapp
```

## samples/bluetooth/direction_finding_connectionless_tx/boards/nrf52833dk_nrf52820.conf
```kconfig
CONFIG_BT_CTLR=y
CONFIG_BT_LL_SW_SPLIT=y

CONFIG_BT_CTLR_ADV_EXT=y
CONFIG_BT_CTLR_ADV_PERIODIC=y

# Enable Direction Finding TX Feature including AoA and AoD
CONFIG_BT_CTLR_DF=y
CONFIG_BT_CTLR_DF_ANT_SWITCH_RX=n
CONFIG_BT_CTLR_DF_SCAN_CTE_RX=n
```

## samples/bluetooth/direction_finding_connectionless_tx/boards/nrf52833dk_nrf52833.conf
```kconfig
CONFIG_BT_CTLR_ADV_EXT=y
CONFIG_BT_CTLR_ADV_PERIODIC=y

# Enable Direction Finding TX Feature including AoA and AoD
CONFIG_BT_CTLR_DF=y
CONFIG_BT_CTLR_DF_ANT_SWITCH_RX=n
CONFIG_BT_CTLR_DF_SCAN_CTE_RX=n

# Enable chaining of multiple CTEs in periodic advertising
CONFIG_BT_CTLR_ADVANCED_FEATURES=y
CONFIG_BT_CTLR_ADV_SYNC_PDU_BACK2BACK=y
CONFIG_BT_CTLR_DF_PER_ADV_CTE_NUM_MAX=16
```

## samples/bluetooth/direction_finding_connectionless_tx/sample.yaml
```yaml
sample:
  name: Direction Finding Connectionless Beacon
tests:
  sample.bluetooth.direction_finding_connectionless:
    harness: bluetooth
    platform_allow:
      - nrf52833dk/nrf52833
      - nrf52833dk/nrf52820
      - nrf5340dk/nrf5340/cpuapp
    tags: bluetooth
    integration_platforms:
      - nrf52833dk/nrf52833
      - nrf52833dk/nrf52820
      - nrf5340dk/nrf5340/cpuapp
  sample.bluetooth.direction_finding_connectionless.aoa_with_controller:
    harness: bluetooth
    extra_args:
      - EXTRA_CONF_FILE="overlay-aoa.conf"
      - SNIPPET="bt-ll-sw-split"
    platform_allow:
      - nrf52833dk/nrf52833
      - nrf52833dk/nrf52820
    integration_platforms:
      - nrf52833dk/nrf52833
      - nrf52833dk/nrf52820
  sample.bluetooth.direction_finding_connectionless.aoa_host_only:
    harness: bluetooth
    extra_args:
      - OVERLAY_CONFIG="overlay-aoa.conf"
    platform_allow:
      - nrf5340dk/nrf5340/cpuapp
    integration_platforms:
      - nrf5340dk/nrf5340/cpuapp
```

## samples/bluetooth/direction_finding_peripheral/boards/nrf52833dk_nrf52833.conf
```kconfig
#
# Copyright (c) 2022 Nordic Semiconductor ASA
#
# SPDX-License-Identifier: Apache-2.0
#

CONFIG_BT_CTLR=y
CONFIG_BT_LL_SW_SPLIT=y

# Enable new implementation of LLCPs
CONFIG_BT_LL_SW_LLCP=y

# Enable Direction Finding Feature including AoA and AoD
CONFIG_BT_CTLR_DF=y

CONFIG_BT_CTLR_DF_CTE_TX=y
CONFIG_BT_CTLR_DF_CONN_CTE_TX=y
CONFIG_BT_CTLR_DF_ANT_SWITCH_TX=y
CONFIG_BT_CTLR_DF_CONN_CTE_RSP=y

# Ensure that there is enough control procedure contexts to queue and execute all procedures
CONFIG_BT_CTLR_ADVANCED_FEATURES=y
CONFIG_BT_CTLR_LLCP_LOCAL_PROC_CTX_BUF_NUM=6
```

## samples/bluetooth/direction_finding_peripheral/sample.yaml
```yaml
sample:
  name: Direction Finding Peripheral
  description: Sample application showing peripheral role of Direction Finding in
    connected mode
tests:
  sample.bluetooth.direction_finding.peripheral:
    harness: bluetooth
    platform_allow:
      - nrf52833dk/nrf52833
      - nrf52833dk/nrf52820
      - nrf5340dk/nrf5340/cpuapp
    tags: bluetooth
    integration_platforms:
      - nrf52833dk/nrf52833
      - nrf52833dk/nrf52820
      - nrf5340dk/nrf5340/cpuapp
  sample.bluetooth.direction_finding.peripheral.aod:
    harness: bluetooth
    extra_args: EXTRA_CONF_FILE="overlay-aoa.conf"
    platform_allow:
      - nrf52833dk/nrf52833
      - nrf52833dk/nrf52820
      - nrf5340dk/nrf5340/cpuapp
    tags: bluetooth
    integration_platforms:
      - nrf52833dk/nrf52833
      - nrf52833dk/nrf52820
      - nrf5340dk/nrf5340/cpuapp
```

## samples/bluetooth/eddystone/sample.yaml
```yaml
sample:
  name: Bluetooth Eddystone
tests:
  sample.bluetooth.eddystone:
    harness: bluetooth
    platform_allow:
      - qemu_cortex_m3
      - qemu_x86
    tags: bluetooth
    integration_platforms:
      - qemu_cortex_m3
  sample.bluetooth.eddystone.console:
    tags: bluetooth
    harness: console
    harness_config:
      type: one_line
      regex:
        - "Configuration mode: waiting connections"
```

## samples/bluetooth/encrypted_advertising/peripheral/sample.yaml
```yaml
sample:
  name: Bluetooth Peripheral Encrypted Advertising Data
tests:
  sample.bluetooth.peripheral_ead:
    harness: bluetooth
    platform_allow: nrf52840dk_nrf52840
    tags: bluetooth
```

## samples/bluetooth/handsfree/sample.yaml
```yaml
sample:
  name: Bluetooth Handsfree
tests:
  sample.bluetooth.handsfree:
    harness: bluetooth
    platform_allow:
      - qemu_cortex_m3/ti_lm3s6965
      - qemu_x86/atom
    tags: bluetooth
    integration_platforms:
      - qemu_cortex_m3/ti_lm3s6965
```

## samples/bluetooth/handsfree_ag/sample.yaml
```yaml
sample:
  name: Bluetooth Handsfree Audio Gateway
tests:
  sample.bluetooth.handsfree.ag:
    harness: bluetooth
    platform_allow:
      - qemu_cortex_m3
      - qemu_x86
    tags: bluetooth
    integration_platforms:
      - qemu_cortex_m3
    extra_configs:
      - CONFIG_BT_HFP_AG_CALL_OUTGOING=y
```

## samples/bluetooth/hap_ha/Kconfig
```kconfig
#
# Copyright (c) 2022 Codecoup
#
# SPDX-License-Identifier: Apache-2.0
#

mainmenu "Bluetooth: Hearing Aid"

menu "Zephyr"
source "Kconfig.zephyr"
endmenu

menu "Hearing Aid"

config HAP_HA_SET_RANK
	int "Device rank in set"
	depends on BT_CSIP_SET_MEMBER
	range 1 2
	help
	  Rank of this device in set.

choice HAP_HA_HEARING_AID_TYPE_CHOICE
	prompt "Hearing Aid Type selection"
	help
	  Select the Hearing Aid Type to compile.

config HAP_HA_HEARING_AID_MONAURAL
	bool "Monaural Hearing Aid"

config HAP_HA_HEARING_AID_BINAURAL
	depends on BT_CSIP_SET_MEMBER
	bool "Binaural Hearing Aid"

config HAP_HA_HEARING_AID_BANDED
	bool "Banded Hearing Aid"

endchoice # HAP_HA_HEARING_AID_TYPE_CHOICE

choice HAP_HA_HEARING_AID_LOCATION
	prompt "Hearing Aid Device Location"
	help
	  Select the Hearing Aid Device location.

config HAP_HA_HEARING_AID_LEFT
	bool "Left Ear"

config HAP_HA_HEARING_AID_RIGHT
	bool "Right Ear"

endchoice # HAP_HA_HEARING_AID_LOCATION

config MAX_CODEC_FRAMES_PER_SDU
	int "The maximum number of codec frame per SDU supported"
	default 1
	range 1 255
	help
	  Maximum number of codec frames per SDU supported by this device. Increasing this value
	  allows support for a greater variety of broadcasts, but also increases memory usage.
 
config ENABLE_LC3
	bool "Enable the LC3 codec"
	# By default let's enable it in the platforms we know are capable of supporting it
	default y
	depends on CPU_HAS_FPU && \
	(ARCH_POSIX || SOC_COMPATIBLE_NRF52X || SOC_COMPATIBLE_NRF5340_CPUAPP)
	select LIBLC3
	select FPU

config USE_SPECIFIC_BROADCAST_CHANNEL
	bool "Use specific Broadcast Channel Audio Location"
	default y
	#depends on USE_USB_AUDIO_OUTPUT
	help
	  Enables the use of a specific Channel Audio Location (see config TARGET_BROADCAST_CHANNEL).


config TARGET_BROADCAST_CHANNEL
	int "Broadcast Channel Audio Location to sync to"
	range 0 3
	default 1
	help
	  Channel Audio Location to sync to. These corresponds to the bt_audio_location,
	  supporting mono, left and right channels
 
config INFO_REPORTING_INTERVAL
	int "Number of SDUs received between each information report"
	default 500
	help
	  Determines how often information about received data is logged.
	  Set to 0 to disable reporting.
 

endmenu 
```

## samples/bluetooth/hap_ha/sample.yaml
```yaml
sample:
  description: Bluetooth HAP Hearing Aid sample
  name: Bluetooth HAP Hearing Aid sample
tests:
  sample.bluetooth.hap_ha.monaural:
    harness: bluetooth
    platform_allow:
      - native_sim
    tags: bluetooth
    build_only: true
  sample.bluetooth.hap_ha.monaural_no_presets:
    harness: bluetooth
    platform_allow:
      - native_sim
    tags: bluetooth
    build_only: true
    extra_configs:
      - CONFIG_BT_HAS_PRESET_COUNT=0
  sample.bluetooth.hap_ha.banded:
    harness: bluetooth
    platform_allow:
      - native_sim
    tags: bluetooth
    extra_args: EXTRA_CONF_FILE="banded.conf"
    build_only: true
  sample.bluetooth.hap_ha.binaural:
    harness: bluetooth
    platform_allow:
      - native_sim
    tags: bluetooth
    extra_args: EXTRA_CONF_FILE="binaural.conf"
    build_only: true
    extra_configs:
      - CONFIG_HAP_HA_SET_RANK=2
```

## samples/bluetooth/hci_ipc/boards/nrf5340dk_nrf5340_cpunet.conf
```kconfig
CONFIG_ISR_STACK_SIZE=1024
CONFIG_IDLE_STACK_SIZE=256
CONFIG_MAIN_STACK_SIZE=512
CONFIG_SYSTEM_WORKQUEUE_STACK_SIZE=512
CONFIG_HEAP_MEM_POOL_SIZE=4096

# Execute from RRAM to save RAM space
CONFIG_XIP=y

# Use link time optimization for code size reduction
CONFIG_ISR_TABLES_LOCAL_DECLARATION=y
CONFIG_LTO=y

# Generate .lst file, to find HCI h/w error event given PC
CONFIG_OUTPUT_DISASSEMBLY=y
CONFIG_OUTPUT_DISASSEMBLY_WITH_SOURCE=y

# peripheral_hr config, with CONFIG_SMP=y
CONFIG_BT_BUF_ACL_RX_SIZE=69

# Disable features not needed to reduce code size
# CONFIG_BT_MAX_CONN=1

# Thread Analysis
CONFIG_THREAD_ANALYZER=y
CONFIG_THREAD_ANALYZER_AUTO=y
CONFIG_THREAD_ANALYZER_AUTO_INTERVAL=5
CONFIG_THREAD_NAME=y

CONFIG_LOG=y
CONFIG_LOG_BUFFER_SIZE=4096

# IRQ Priorities
CONFIG_BT_CTLR_ADVANCED_FEATURES=y
CONFIG_BT_CTLR_LLL_PRIO=0
CONFIG_BT_CTLR_ULL_HIGH_PRIO=1
CONFIG_BT_CTLR_ULL_LOW_PRIO=1

# CONFIG_BT_CTLR_TEST=y
CONFIG_BT_CTLR_PROFILE_ISR=y
```

## samples/bluetooth/hci_ipc/sample.yaml
```yaml
sample:
  description: Allows Zephyr to provide Bluetooth connectivity via IPC
  name: Bluetooth HCI IPC
tests:
  sample.bluetooth.hci_ipc:
    harness: bluetooth
    tags: bluetooth
    platform_allow:
      - nrf5340dk/nrf5340/cpunet
      - nrf5340_audio_dk/nrf5340/cpunet
      - nrf5340bsim/nrf5340/cpunet
    integration_platforms:
      - nrf5340dk/nrf5340/cpunet
      - nrf5340_audio_dk/nrf5340/cpunet
  sample.bluetooth.hci_ipc.iso_broadcast.bt_ll_sw_split:
    harness: bluetooth
    tags: bluetooth
    extra_args:
      - CONF_FILE="nrf5340_cpunet_iso_broadcast-bt_ll_sw_split.conf"
      - SNIPPET="bt-ll-sw-split"
    platform_allow:
      - nrf5340dk/nrf5340/cpunet
      - nrf5340_audio_dk/nrf5340/cpunet
      - nrf5340bsim/nrf5340/cpunet
    integration_platforms:
      - nrf5340dk/nrf5340/cpunet
      - nrf5340_audio_dk/nrf5340/cpunet
  sample.bluetooth.hci_ipc.iso_receive.bt_ll_sw_split:
    harness: bluetooth
    tags: bluetooth
    extra_args:
      - CONF_FILE="nrf5340_cpunet_iso_receive-bt_ll_sw_split.conf"
      - SNIPPET="bt-ll-sw-split"
    platform_allow:
      - nrf5340dk/nrf5340/cpunet
      - nrf5340_audio_dk/nrf5340/cpunet
      - nrf5340bsim/nrf5340/cpunet
    integration_platforms:
      - nrf5340dk/nrf5340/cpunet
  sample.bluetooth.hci_ipc.bis.bt_ll_sw_split:
    harness: bluetooth
    tags: bluetooth
    extra_args:
      - CONF_FILE="nrf5340_cpunet_bis-bt_ll_sw_split.conf"
      - SNIPPET="bt-ll-sw-split"
    platform_allow:
      - nrf5340dk/nrf5340/cpunet
      - nrf5340_audio_dk/nrf5340/cpunet
      - nrf5340bsim/nrf5340/cpunet
    integration_platforms:
      - nrf5340dk/nrf5340/cpunet
  sample.bluetooth.hci_ipc.iso_central.bt_ll_sw_split:
    harness: bluetooth
    tags: bluetooth
    extra_args:
      - CONF_FILE="nrf5340_cpunet_iso_central-bt_ll_sw_split.conf"
      - SNIPPET="bt-ll-sw-split"
    platform_allow:
      - nrf5340dk/nrf5340/cpunet
      - nrf5340_audio_dk/nrf5340/cpunet
      - nrf5340bsim/nrf5340/cpunet
    integration_platforms:
      - nrf5340dk/nrf5340/cpunet
  sample.bluetooth.hci_ipc.iso_peripheral.bt_ll_sw_split:
    harness: bluetooth
    tags: bluetooth
    extra_args:
      - CONF_FILE="nrf5340_cpunet_iso_peripheral-bt_ll_sw_split.conf"
      - SNIPPET="bt-ll-sw-split"
    platform_allow:
      - nrf5340dk/nrf5340/cpunet
      - nrf5340_audio_dk/nrf5340/cpunet
      - nrf5340bsim/nrf5340/cpunet
    integration_platforms:
      - nrf5340dk/nrf5340/cpunet
  sample.bluetooth.hci_ipc.cis.bt_ll_sw_split:
    harness: bluetooth
    tags: bluetooth
    extra_args:
      - CONF_FILE="nrf5340_cpunet_cis-bt_ll_sw_split.conf"
      - SNIPPET="bt-ll-sw-split"
    platform_allow:
      - nrf5340dk/nrf5340/cpunet
      - nrf5340_audio_dk/nrf5340/cpunet
      - nrf5340bsim/nrf5340/cpunet
    integration_platforms:
      - nrf5340dk/nrf5340/cpunet
  sample.bluetooth.hci_ipc.iso.bt_ll_sw_split:
    harness: bluetooth
    tags: bluetooth
    extra_args:
      - CONF_FILE="nrf5340_cpunet_iso-bt_ll_sw_split.conf"
      - SNIPPET="bt-ll-sw-split"
    platform_allow:
      - nrf5340dk/nrf5340/cpunet
      - nrf5340bsim/nrf5340/cpunet
    integration_platforms:
      - nrf5340dk/nrf5340/cpunet
  sample.bluetooth.hci_ipc.df.bt_ll_sw_split:
    harness: bluetooth
    tags: bluetooth
    extra_args:
      - CONF_FILE="nrf5340_cpunet_df-bt_ll_sw_split.conf"
      - DTC_OVERLAY_FILE="nrf5340_cpunet_df-bt_ll_sw_split.overlay"
      - SNIPPET="bt-ll-sw-split"
    platform_allow: nrf5340dk/nrf5340/cpunet
    integration_platforms:
      - nrf5340dk/nrf5340/cpunet
  sample.bluetooth.hci_ipc.df.no_phy_coded.bt_ll_sw_split:
    harness: bluetooth
    tags: bluetooth
    extra_args:
      - CONF_FILE="nrf5340_cpunet_df-bt_ll_sw_split.conf"
      - DTC_OVERLAY_FILE="nrf5340_cpunet_df-bt_ll_sw_split.overlay"
      - CONFIG_BT_CTLR_PHY_CODED=n
      - SNIPPET="bt-ll-sw-split"
    platform_allow: nrf5340dk/nrf5340/cpunet
    integration_platforms:
      - nrf5340dk/nrf5340/cpunet
  sample.bluetooth.hci_ipc.mesh.bt_ll_sw_split:
    harness: bluetooth
    tags: bluetooth
    extra_args:
      - CONF_FILE="nrf5340_cpunet_bt_mesh-bt_ll_sw_split.conf"
      - SNIPPET="bt-ll-sw-split"
    platform_allow: nrf5340dk/nrf5340/cpunet
    integration_platforms:
      - nrf5340dk/nrf5340/cpunet
```

## samples/bluetooth/hci_pwr_ctrl/sample.yaml
```yaml
sample:
  name: Bluetooth HCI-based Dynamic Power Control
tests:
  sample.bluetooth.hci_pwr_ctrl:
    harness: bluetooth
    platform_allow:
      - bbc_microbit/nrf51822
      - nrf51dk/nrf51822
      - nrf52dk/nrf52832
      - qemu_cortex_m3/ti_lm3s6965
      - qemu_x86/atom
    tags: bluetooth
    integration_platforms:
      - qemu_cortex_m3/ti_lm3s6965
```

## samples/bluetooth/hci_rpmsg/boards/nrf5340dk_nrf5340_cpunet.conf
```kconfig
#
# Copyright (c) 2021 Nordic Semiconductor ASA
#
# SPDX-License-Identifier: LicenseRef-Nordic-5-Clause
#

# Reguired to enable BT_BUF_CMD_TX_SIZE for LE Set Extended Advertising Data command
CONFIG_BT_EXT_ADV=y
CONFIG_BT_PER_ADV_SYNC=y

CONFIG_BT_CTLR=y
CONFIG_BT_LL_SW_SPLIT=y

CONFIG_BT_CTLR_ADV_EXT=y
CONFIG_BT_CTLR_ADV_PERIODIC=y

# Enable Direction Finding Feature including AoA and AoD
CONFIG_BT_CTLR_DF=y

# Disable Direction Finding Rx mode
CONFIG_BT_CTLR_DF_SCAN_CTE_RX=y
CONFIG_BT_CTLR_DF_ANT_SWITCH_RX=y

# Disable Direction Finding TX mode
CONFIG_BT_CTLR_DF_ADV_CTE_TX=y

# limit scanner chains to 1 to fit into the RAM
CONFIG_BT_CTLR_DF_PER_SCAN_CTE_NUM_MAX=1
```
