/*
 * Copyright (c) 2026 Nordic Semiconductor ASA
 *
 * SPDX-License-Identifier: Apache-2.0
 */

&radio {
	/* This is an example number of antennas that may be available
	 * on antenna matrix board.
	 */
	dfe-antenna-num = <10>;

	/* This is an example switch pattern that will be used to set an
	 * antenna for Rx PDU (period before start of Rx CTE).
	 */
	dfe-pdu-antenna = <0x1>;

	/* These are example GPIO pin numbers that are provided to
	 * Radio peripheral. The pins will be acquired by Radio to
	 * drive antenna switching when AoA is enabled.
	 */
	dfegpio0-gpios = <&gpio1 11 0>;
	dfegpio1-gpios = <&gpio1 12 0>;
	dfegpio2-gpios = <&gpio1 15 0>;
	dfegpio3-gpios = <&gpio1 16 0>;

	status = "okay";
};
