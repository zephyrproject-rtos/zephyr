/*
 * Copyright 2023 NXP
 *
 * SPDX-License-Identifier: Apache-2.0
 */

/ {
	chosen {
		zephyr,bt-uart = &lpuart3;
		zephyr,sram = &ocram;
	};
};

&lpuart3 {
	status = "okay";
	current-speed = <3000000>;
	hw-flow-control;
};
