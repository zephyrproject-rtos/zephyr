## samples/bluetooth/channel_sounding/connected_cs/reflector/sample.yaml
```yaml
sample:
  name: Bluetooth Channel Sounding - Reflector
tests:
  sample.bluetooth.channel_sounding.connected_cs.reflector:
    harness: bluetooth
    platform_allow:
      - qemu_cortex_m3
      - qemu_x86
    tags: bluetooth
    integration_platforms:
      - qemu_cortex_m3
```

## samples/bluetooth/channel_sounding/connected_cs/sample.yaml
```yaml
sample:
  name: Bluetooth Channel Sounding
tests:
  sample.bluetooth.channel_sounding.connected_cs:
    harness: bluetooth
    platform_allow:
      - qemu_cortex_m3
      - qemu_x86
    tags: bluetooth
    integration_platforms:
      - qemu_cortex_m3
```

## samples/bluetooth/channel_sounding_test/sample.yaml
```yaml
sample:
  name: Bluetooth Channel Sounding Test
tests:
  sample.bluetooth.channel_sounding_test:
    harness: bluetooth
    platform_allow:
      - qemu_cortex_m3
      - qemu_x86
    tags: bluetooth
    integration_platforms:
      - qemu_cortex_m3
```

## samples/bluetooth/classic/a2dp_sink/Kconfig
```kconfig
#
# Copyright 2025 NXP
#
# SPDX-License-Identifier: Apache-2.0
#

mainmenu "Bluetooth: A2DP Sink"

config USE_CODEC_CLOCK
	bool "I2S BCK is generated by a selected codec device"
	help
	  If selected, the I2S selected peripheral will be configured to consume
	  (receive) the I2S BCK and WS signals and the codec will be configured
	  to generate those. If not selected, the I2S peripheral will generate
	  them and the codec will be expected to consume them.

config A2DP_SBC_PCM_BUFFER_PLAY_COUNT
	int "The buffer count that every size is 480*2*2 bytes"
	default 50

config A2DP_BOARD_CODEC_PLAY_COUNT
	int "The play count of the board codec interface (i2s)"
	default 4

config A2DP_BOARD_CODEC_PLAY_THRESHOLD
	int "The threshold of pcm buffer when playing data to codec (n%)"
	default 20

source "Kconfig.zephyr"
```

## samples/bluetooth/classic/a2dp_sink/boards/mimxrt1060_evk_mimxrt1062_qspi_C.conf
```kconfig
#
# Copyright 2026 NXP
#
# SPDX-License-Identifier: Apache-2.0
#

CONFIG_I2S=y
CONFIG_AUDIO=y
CONFIG_AUDIO_CODEC=y
```

## samples/bluetooth/classic/a2dp_sink/boards/mimxrt1170_evk_mimxrt1176_cm7_B.conf
```kconfig
#select NXP NW612 Chipset
CONFIG_BT_NXP_NW612=y

CONFIG_I2S=y
CONFIG_AUDIO=y
CONFIG_AUDIO_CODEC=y
```

## samples/bluetooth/classic/a2dp_sink/sample.yaml
```yaml
sample:
  name: Bluetooth A2DP Sink
tests:
  sample.bluetooth.a2dp.sink:
    harness: bluetooth
    platform_allow:
      - qemu_cortex_m3
      - qemu_x86
    tags: bluetooth
    integration_platforms:
      - qemu_cortex_m3
  sample.bluetooth.a2dp.sink.no_blobs:
    platform_allow:
      - mimxrt1170_evk@B/mimxrt1176/cm7
    tags:
      - bluetooth
      - gap
    extra_args:
      - CONFIG_BUILD_ONLY_NO_BLOBS=y
    timeout: 600
    build_only: true
```

## samples/bluetooth/classic/a2dp_source/Kconfig
```kconfig
#
# Copyright 2025 NXP
#
# SPDX-License-Identifier: Apache-2.0
#

mainmenu "Bluetooth: A2DP Source"

config BT_A2DP_SOURCE_DISCOVER_RESULT_COUNT
	int "Maximum result count per device discovery"
	default 10

config BT_A2DP_SOURCE_EPS_DISCOVER_COUNT
	int "Maximum result count per a2dp endpoint discovery"
	default 5

config BT_A2DP_SOURCE_SBC_BIT_RATE_DEFAULT
	int "default sbc bit rate"
	default 229

config BT_A2DP_SOURCE_DATA_SEND_INTERVAL
	int "data send interval (ms)"
	default 10

config BT_A2DP_SOURCE_DATA_BUF_SIZE
	int "data buffer size (bytes)"
	default 1000

config BT_A2DP_SOURCE_DATA_BUF_COUNT
	int "data buffer count"
	default 5

config BT_A2DP_SOURCE_DATA_SEND_WORKQ_STACK_SIZE
	int "the data sending work queue stack size"
	default 1024

config BT_A2DP_SOURCE_DATA_SEND_WORKQ_PRIORITY
	int "the data sending work queue stack size"
	default SYSTEM_WORKQUEUE_PRIORITY

source "Kconfig.zephyr"
```

## samples/bluetooth/classic/a2dp_source/sample.yaml
```yaml
sample:
  name: Bluetooth A2DP Source
tests:
  sample.bluetooth.a2dp.source:
    harness: bluetooth
    platform_allow:
      - qemu_cortex_m3
      - qemu_x86
    tags: bluetooth
    integration_platforms:
      - qemu_cortex_m3
```

## samples/bluetooth/classic/handsfree/boards/mimxrt1170_evk_mimxrt1176_cm7_B.conf
```kconfig
#select NXP NW612 Chipset
CONFIG_BT_NXP_NW612=y

CONFIG_I2S=y
CONFIG_DMA_TCD_QUEUE_SIZE=4
CONFIG_AUDIO=y
CONFIG_AUDIO_CODEC=y

CONFIG_DMA_MCUX_USE_DTCM_FOR_DMA_DESCRIPTORS=n
```

## samples/bluetooth/classic/handsfree/boards/sf32lb52_devkit_lcd.conf
```kconfig
CONFIG_BT_CLASSIC=y
CONFIG_BT_RFCOMM=y
CONFIG_BT_HFP_HF=y
CONFIG_BT_PERIPHERAL=y
CONFIG_BT_DEVICE_NAME="test-Handsfree"
CONFIG_BT_COD=0x200408

CONFIG_BT_SCO_OVER_HCI=y
CONFIG_BT_HFP_HF_CODEC_NEG=y
CONFIG_BT_HFP_HF_CODEC_MSBC=y
CONFIG_HFP_SCO_HCI_MSBC=y
CONFIG_LIBSBC=y
CONFIG_HEAP_MEM_POOL_SIZE=32000
CONFIG_AUDIO=y
CONFIG_AUDIO_CODEC=y
CONFIG_RING_BUFFER=y
```

## samples/bluetooth/classic/handsfree_ag/Kconfig
```kconfig
#
# Copyright 2024-2025 NXP
#
# SPDX-License-Identifier: Apache-2.0
#

mainmenu "Bluetooth: handsfree AG"

config BT_HFP_AG_DISCOVER_RESULT_COUNT
	int "Maximum result count per device discovery"
	default 10

config BT_HFP_AG_CALL_OUTGOING
	bool "The simulate call: outgoing (y), incoming (n)"

config BT_HFP_AG_START_CALL_DELAY_TIME
	int "The delay time used to start simulating a call after AG connection"
	default 5000
	help
	  The Delay time is used to wait for the peer to start dialing. If the
	  peer does not dial within the timeout period, AG satrt simulating a
	  call. The unit is ms.

source "Kconfig.zephyr"

config AUDIO_TRANSFER_INTERVAL
	int "Audio transfer interval"
	default 10
	range 1 100
	help
	  Controls the audio transfer interval.

config PCM_BUFFERS
	int "PCM Buffer Count"
	default 4
	help
	  Controls the initial count of audio data blocks.

config PCM_RX_THREAD_STACK_SIZE
	int "PCM RX thread stack size"
	default 1024
	help
	  Controls the PCM RX thread stack size in bytes.

config PCM_RX_THREAD_PRIO
	int "PCM RX thread priority"
	default 4
	help
	  Controls the PCM RX thread priority.

config CODEC_BUFFERS
	int "CODEC Buffer Count"
	default PCM_BUFFERS
	help
	  Controls the initial count of audio data blocks.

config CODEC_RX_THREAD_STACK_SIZE
	int "CODEC RX thread stack size"
	default 1024
	help
	  Controls the CODEC RX thread stack size in bytes.

config CODEC_RX_THREAD_PRIO
	int "CODEC RX thread priority"
	default 4
	help
	  Controls the CODEC RX thread priority.
```

## samples/bluetooth/classic/handsfree_ag/boards/mimxrt1170_evk_mimxrt1176_cm7_B.conf
```kconfig
#select NXP NW612 Chipset
CONFIG_BT_NXP_NW612=y

CONFIG_I2S=y
CONFIG_DMA_TCD_QUEUE_SIZE=4
CONFIG_AUDIO=y
CONFIG_AUDIO_CODEC=y

CONFIG_BT_HFP_AG_CODEC_NEG=y
CONFIG_BT_HFP_AG_CODEC_MSBC=y

CONFIG_DMA_MCUX_USE_DTCM_FOR_DMA_DESCRIPTORS=n
```

## samples/bluetooth/classic/handsfree_ag/boards/sf32lb52_devkit_lcd.conf
```kconfig
CONFIG_BT_CLASSIC=y
CONFIG_BT_RFCOMM=y
CONFIG_BT_HFP_AG=y
CONFIG_BT_CENTRAL=y
CONFIG_BT_DEVICE_NAME="test-Handsfree-AG"
CONFIG_BT_COD=0x400408

CONFIG_BT_SCO_OVER_HCI=y
CONFIG_BT_HFP_AG_CODEC_NEG=y
CONFIG_BT_HFP_AG_CODEC_MSBC=y
CONFIG_HFP_SCO_HCI_MSBC=y
CONFIG_LIBSBC=y
CONFIG_HEAP_MEM_POOL_SIZE=32000
CONFIG_AUDIO=y
CONFIG_AUDIO_CODEC=y
CONFIG_RING_BUFFER=y
```

## samples/bluetooth/classic/hid_device/sample.yaml
```yaml
sample:
  name: Bluetooth HID Device
tests:
  sample.bluetooth.hid_device:
    harness: bluetooth
    platform_allow:
      - sf32lb52_devkit_lcd/sf32lb525uc6
      - qemu_cortex_m3
      - qemu_x86
    tags: bluetooth
    integration_platforms:
      - sf32lb52_devkit_lcd/sf32lb525uc6
```

## samples/bluetooth/classic/pbap_pce/sample.yaml
```yaml
sample:
  name: Bluetooth Classic PBAP PCE (Phone Book Client)
tests:
  sample.bluetooth.classic.pbap_pce:
    harness: bluetooth
    platform_allow:
      - qemu_cortex_m3
      - qemu_x86
    tags:
      - bluetooth
      - classic
      - pbap
    integration_platforms:
      - qemu_cortex_m3
```

## samples/bluetooth/classic/pbap_pse/Kconfig
```kconfig
#
# Copyright 2024-2025 NXP
#
# SPDX-License-Identifier: Apache-2.0
#

mainmenu "Bluetooth: PBAP PSE"

config BT_PBAP_PSE_DISCOVER_RESULT_COUNT
	int "Maximum result count per device discovery"
	default 10

config BT_PBAP_PSE_RFCOMM_CHANNEL
        int "RFCOMM channel for PBAP PSE"
        default 3

config BT_PBAP_PSE_L2CAP_PSM
        hex "L2CAP PSM for PBAP PSE"
        default 0x1009

config BT_PBAP_PSE_SUPPORTED_REPOSITORIES
        hex "Supported repositories bitmask for PBAP PSE"
        default 0xf

config BT_PBAP_PSE_SUPPORTED_FEATURES
	hex "Supported features bitmask for PBAP PSE"
        default 0x3ff

source "Kconfig.zephyr"
```

## samples/bluetooth/classic/spp_client/boards/sf32lb52_devkit_lcd.conf
```kconfig
# SPDX-License-Identifier: Apache-2.0

# SF32LB52 DevKit LCD board configuration for Bluetooth Classic SPP client

CONFIG_BT_BUF_ACL_RX_SIZE=200
CONFIG_BT_BUF_ACL_TX_SIZE=200
CONFIG_HEAP_MEM_POOL_SIZE=8192
```

## samples/bluetooth/direct_adv/sample.yaml
```yaml
sample:
  name: Bluetooth Direct Advertising
tests:
  sample.bluetooth.direct_adv:
    harness: bluetooth
    platform_allow: qemu_x86
    integration_platforms:
      - qemu_x86
    tags: bluetooth
  sample.bluetooth.direct_adv.console:
    tags: bluetooth
    harness: console
    harness_config:
      type: one_line
      regex:
        - "Advertising successfully started"
```

## samples/bluetooth/direction_finding_central/Kconfig
```kconfig
#
# Copyright (c) 2022 Nordic Semiconductor ASA
#
# SPDX-License-Identifier: Apache-2.0
#

menu "Direction Finding Central"
config DF_CENTRAL_APP_IQ_REPORT_PRINT_IQ_SAMPLES
	bool "Print IQ samples for received IQ reports"
	help
	  The option enables printing of IQ samples for received IQ report.
endmenu

menu "Zephyr Kernel"
source "Kconfig.zephyr"
endmenu
```

## samples/bluetooth/direction_finding_central/boards/nrf52833dk_nrf52833.conf
```kconfig
#
# Copyright (c) 2022 Nordic Semiconductor ASA
#
# SPDX-License-Identifier: Apache-2.0
#

# Enable Direction Finding Feature including AoA and AoD
CONFIG_BT_CTLR_DF=y

CONFIG_BT_CTLR_DF_CTE_RX=y
CONFIG_BT_CTLR_DF_CONN_CTE_RX=y
CONFIG_BT_CTLR_DF_ANT_SWITCH_RX=y
CONFIG_BT_CTLR_DF_CONN_CTE_REQ=y

# Ensure that there is enough control procedure contexts to queue and execute all procedures
CONFIG_BT_CTLR_LLCP_LOCAL_PROC_CTX_BUF_NUM=6
CONFIG_BT_CTLR_ADVANCED_FEATURES=y
```

## samples/bluetooth/direction_finding_central/sample.yaml
```yaml
sample:
  name: Direction Finding Central
  description: Sample application showing central role of Direction Finding in connected
    mode
tests:
  sample.bluetooth.direction_finding.central:
    harness: bluetooth
    platform_allow:
      - nrf52833dk/nrf52833
      - nrf52833dk/nrf52820
      - nrf5340dk/nrf5340/cpuapp
    tags: bluetooth
    integration_platforms:
      - nrf52833dk/nrf52833
      - nrf52833dk/nrf52820
      - nrf5340dk/nrf5340/cpuapp
  sample.bluetooth.direction_finding.central.aod:
    harness: bluetooth
    extra_args: EXTRA_CONF_FILE="overlay-aod.conf"
    platform_allow:
      - nrf52833dk/nrf52833
      - nrf52833dk/nrf52820
      - nrf5340dk/nrf5340/cpuapp
    tags: bluetooth
    integration_platforms:
      - nrf52833dk/nrf52833
      - nrf52833dk/nrf52820
      - nrf5340dk/nrf5340/cpuapp
```

## samples/bluetooth/direction_finding_connectionless_rx/boards/nrf52833dk_nrf52820.conf
```kconfig
CONFIG_BT_CTLR_ADV_EXT=y
CONFIG_BT_CTLR_SYNC_PERIODIC=y

# Enable Direction Finding Feature including AoA and AoD
CONFIG_BT_CTLR_DF=y

# Disable Direction Finding TX mode
CONFIG_BT_CTLR_DF_ANT_SWITCH_TX=n
CONFIG_BT_CTLR_DF_ADV_CTE_TX=n

# Limit maximum number of CTEs to fit into nRF52820 SRAM size
CONFIG_BT_CTLR_DF_PER_SCAN_CTE_NUM_MAX=1
```

## samples/bluetooth/direction_finding_connectionless_rx/boards/nrf52833dk_nrf52833.conf
```kconfig
CONFIG_BT_CTLR=y
CONFIG_BT_LL_SW_SPLIT=y

CONFIG_BT_CTLR_ADV_EXT=y
CONFIG_BT_CTLR_SYNC_PERIODIC=y

# Enable Direction Finding Feature including AoA and AoD
CONFIG_BT_CTLR_DF=y

# Disable Direction Finding TX mode
CONFIG_BT_CTLR_DF_ANT_SWITCH_TX=n
CONFIG_BT_CTLR_DF_ADV_CTE_TX=n

CONFIG_BT_CTLR_DF_PER_SCAN_CTE_NUM_MAX=16
```
