## CMakeLists.txt
```
# SPDX-License-Identifier: Apache-2.0

cmake_minimum_required(VERSION 3.28.0)
find_package(Zephyr REQUIRED HINTS $ENV{ZEPHYR_BASE})
project(broadcaster)

FILE(GLOB app_sources src/*.c)
target_sources(app PRIVATE ${app_sources})

zephyr_library_include_directories(${ZEPHYR_BASE}/samples/bluetooth)
```

## Kconfig
```
# Copyright The Zephyr Project Contributors
# SPDX-License-Identifier: Apache-2.0

mainmenu "Bluetooth: Broadcaster"

config SAMPLE_BT_USE_DISABLE
	bool "Periodically disable Bluetooth"
	help
	  When enabled, the sample enables Bluetooth and broadcasts for a
	  configurable duration, then disables Bluetooth for a configurable
	  duration, and repeats the cycle. When disabled (default), the sample
	  keeps Bluetooth enabled and broadcasts continuously.

if SAMPLE_BT_USE_DISABLE

config SAMPLE_BT_BROADCAST_DURATION_MS
	int "Broadcast duration (milliseconds)"
	range 1 2147483647
	default 5000
	help
	  Duration in milliseconds during which Bluetooth is enabled and the
	  sample broadcasts advertising packets before disabling Bluetooth.

config SAMPLE_BT_DISABLE_DURATION_MS
	int "Disable duration (milliseconds)"
	range 1 2147483647
	default 5000
	help
	  Duration in milliseconds during which Bluetooth is disabled before it
	  is enabled again to resume broadcasting.

endif # SAMPLE_BT_USE_DISABLE

source "Kconfig.zephyr"
```

## sample.yaml
```
sample:
  name: broadcaster
tests:
  sample.bluetooth.broadcaster:
    harness: bluetooth
    platform_allow:
      - qemu_cortex_m3
      - qemu_x86
      - lp_em_cc2340r5
      - lp_em_cc2340r5moda
      - lp_em_cc2340r53
      - lp_em_cc2340r53_wcsp
      - lp_em_cc2745r10_q1/cc2745r10_q1
      - lp_em_cc2745r10_q1/cc2755r10
      - lp_em_cc2755p10
      - lp_em_cc2755p20
      - nrf51dk/nrf51822
      - nrf52dk/nrf52832
      - cyw920829m2evk_02/cyw20829b0lkml
    tags: bluetooth
    integration_platforms:
      - qemu_cortex_m3
```

## prj.conf
```kconfig
CONFIG_BT=y
CONFIG_BT_BROADCASTER=y
```

## src/main.c
```c
/* main.c - Application main entry point */

/*
 * Copyright (c) 2015-2016 Intel Corporation
 *
 * SPDX-License-Identifier: Apache-2.0
 */

#include <zephyr/types.h>
#include <stddef.h>
#include <zephyr/sys/printk.h>
#include <zephyr/sys/util.h>

#include <zephyr/bluetooth/bluetooth.h>
#include <zephyr/bluetooth/hci.h>

static uint8_t mfg_data[] = { 0xff, 0xff, 0x00 };

static const struct bt_data ad[] = {
	BT_DATA(BT_DATA_MANUFACTURER_DATA, mfg_data, 3),
};

#if defined(CONFIG_SAMPLE_BT_USE_DISABLE)
int main(void)
{
	int err;

	printk("Starting Broadcaster\n");

	do {
		/* Initialize the Bluetooth Subsystem */
		err = bt_enable(NULL);
		if (err) {
			printk("Bluetooth init failed (err %d)\n", err);
			return 0;
		}

		printk("Bluetooth initialized\n");

		printk("Sending advertising data: 0x%02X\n", mfg_data[2]);

		/* Start advertising */
		err = bt_le_adv_start(BT_LE_ADV_NCONN, ad, ARRAY_SIZE(ad),
				      NULL, 0);
		if (err) {
			printk("Advertising failed to start (err %d)\n", err);
			return 0;
		}

		/* Broadcast for the configured duration */
		k_msleep(CONFIG_SAMPLE_BT_BROADCAST_DURATION_MS);

		err = bt_le_adv_stop();
		if (err) {
			printk("Advertising failed to stop (err %d)\n", err);
			return 0;
		}

		/* Disable the Bluetooth Subsystem */
		err = bt_disable();
		if (err) {
			printk("Bluetooth disable failed (err %d)\n", err);
			return 0;
		}

		printk("Bluetooth disabled\n");

		mfg_data[2]++;

		/* Keep Bluetooth disabled for the configured duration */
		k_msleep(CONFIG_SAMPLE_BT_DISABLE_DURATION_MS);

	} while (1);
	return 0;
}
#else /* !CONFIG_SAMPLE_BT_USE_DISABLE */
int main(void)
{
	int err;

	printk("Starting Broadcaster\n");

	/* Initialize the Bluetooth Subsystem */
	err = bt_enable(NULL);
	if (err) {
		printk("Bluetooth init failed (err %d)\n", err);
		return 0;
	}

	printk("Bluetooth initialized\n");

	do {
		k_msleep(1000);

		printk("Sending advertising data: 0x%02X\n", mfg_data[2]);

		/* Start advertising */
		err = bt_le_adv_start(BT_LE_ADV_NCONN, ad, ARRAY_SIZE(ad),
				      NULL, 0);
		if (err) {
			printk("Advertising failed to start (err %d)\n", err);
			return 0;
		}

		k_msleep(1000);

		err = bt_le_adv_stop();
		if (err) {
			printk("Advertising failed to stop (err %d)\n", err);
			return 0;
		}

		mfg_data[2]++;

	} while (1);
	return 0;
}
#endif /* CONFIG_SAMPLE_BT_USE_DISABLE */
```
