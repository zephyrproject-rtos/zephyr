## samples/bluetooth/l2cap_mesh/sample.yaml
```yaml
sample:
  name: Bluetooth L2CAP Mesh
tests:
  sample.bluetooth.l2cap_mesh:
    harness: bluetooth
    platform_allow: qemu_cortex_m3 qemu_x86
    tags: bluetooth
```

## samples/bluetooth/mesh/Kconfig
```kconfig
# Copyright (c) 2024 Andreas Kurz
# SPDX-License-Identifier: Apache-2.0

menu "BLE Mesh sample settings"

config BLE_MESH_SAMPLE_ENABLE_SELF_PROVISIONING
	bool "Enable self provisioning"
	default y
	help
	  This will allow self provisioning with arbitrary keys
	  on button press if not already provisioned.

endmenu

source "Kconfig.zephyr"
```

## samples/bluetooth/mesh/boards/bbc_microbit.conf
```kconfig
CONFIG_INIT_STACKS=y
CONFIG_ISR_STACK_SIZE=768
CONFIG_MAIN_STACK_SIZE=512
CONFIG_DISPLAY=y
CONFIG_MICROBIT_DISPLAY=y
CONFIG_SYSTEM_WORKQUEUE_STACK_SIZE=1024
CONFIG_MICROBIT_DISPLAY_STR_MAX=5
CONFIG_GPIO=y

CONFIG_PM=n

CONFIG_BT_PERIPHERAL=n
CONFIG_BT_EXT_ADV=n
CONFIG_BT_RX_STACK_SIZE=1100
CONFIG_BT_BUF_EVT_RX_COUNT=3
CONFIG_BT_BUF_EVT_DISCARDABLE_COUNT=3

# CONFIG_BT_BUF_ACL_TX_COUNT has to be less than CONFIG_BT_BUF_EVT_RX_COUNT
CONFIG_BT_BUF_ACL_TX_COUNT=1

CONFIG_BT_CTLR_ADV_EXT=n

CONFIG_BT_MESH_ADV_BUF_COUNT=3
CONFIG_BT_MESH_SEG_BUFS=3
CONFIG_BT_MESH_RELAY=n
CONFIG_BT_MESH_LOOPBACK_BUFS=1

CONFIG_BT_MESH_PB_GATT=n
CONFIG_BT_MESH_GATT_PROXY=n
CONFIG_BT_MESH_MODEL_EXTENSIONS=n
CONFIG_BT_MESH_FRIEND=n

CONFIG_BT_MESH_SUBNET_COUNT=1
CONFIG_BT_MESH_APP_KEY_COUNT=1
CONFIG_BT_MESH_MODEL_GROUP_COUNT=1
CONFIG_BT_MESH_LABEL_COUNT=0
CONFIG_BT_MESH_ACCESS_DELAYABLE_MSG=n
```

## samples/bluetooth/mesh/boards/esp32_devkitc_wroom.conf
```kconfig
# Enable legacy support
CONFIG_BT_EXT_ADV_LEGACY_SUPPORT=y
CONFIG_BT_MESH_ADV_LEGACY=y

# Enable entropy generator
CONFIG_ENTROPY_GENERATOR=y

# Disable self-provisioning
CONFIG_BLE_MESH_SAMPLE_ENABLE_SELF_PROVISIONING=n
```

## samples/bluetooth/mesh_demo/sample.yaml
```yaml
sample:
  name: Bluetooth Mesh Demo
tests:
  sample.bluetooth.mesh_demo:
    harness: bluetooth
    platform_allow:
      - bbc_microbit/nrf51822
      - qemu_x86/atom
      - nrf52840dk/nrf52840
      - nrf5340dk/nrf5340/cpuapp/ns
    integration_platforms:
      - qemu_x86/atom
      - bbc_microbit/nrf51822
    tags: bluetooth
```

## samples/bluetooth/mesh_provisioner/Kconfig
```kconfig
# Copyright (c) 2024 Nordic Semiconductor ASA
# SPDX-License-Identifier: Apache-2.0

source "Kconfig.zephyr"

mainmenu "Bluetooth: Mesh Provisioner"

config MESH_PROVISIONER_USE_SW0
	bool "Use sw0 button to provision"
	depends on $(dt_alias_enabled,sw0)
	select GPIO
	default y
```

## samples/bluetooth/mtu_update/central/sample.yaml
```yaml
sample:
  name: Bluetooth Central MTU Update
tests:
  sample.bluetooth.central_mtu_update:
    harness: bluetooth
    platform_allow: qemu_cortex_m3 qemu_x86 nrf52_bsim
    tags: bluetooth
    integration_platforms:
      - qemu_cortex_m3
```

## samples/bluetooth/mtu_update/peripheral/sample.yaml
```yaml
sample:
  name: Bluetooth Peripheral MTU Update
tests:
  sample.bluetooth.peripheral_mtu_update:
    harness: bluetooth
    platform_allow:
      - qemu_cortex_m3/ti_lm3s6965
      - qemu_x86/atom
      - nrf52_bsim/nrf52833
    tags: bluetooth
    integration_platforms:
      - qemu_cortex_m3/ti_lm3s6965
```

## samples/bluetooth/observer_multi/boards/nrf52_bsim.conf
```kconfig
#
# Copyright (C) 2026 Xiaomi Corporation
#
# SPDX-License-Identifier: Apache-2.0
#

# uart0 is repurposed as the second HCI UART for the bsim multi-controller
# test; disable the UART console so it does not conflict.
CONFIG_UART_CONSOLE=n

CONFIG_LOG=y
CONFIG_ASSERT=y
```

## samples/bluetooth/observer_multi/sample.yaml
```yaml
sample:
  name: Bluetooth Multi-Controller Observer
  description: Demonstrates BLE scanning on two HCI controllers simultaneously
tests:
  sample.bluetooth.observer_multi:
    harness: bluetooth
    build_only: true
    platform_allow:
      - native_sim
      - qemu_x86
    integration_platforms:
      - native_sim
      - qemu_x86
    tags: bluetooth
```

## samples/bluetooth/opendroneid/sample.yaml
```yaml
sample:
  name: Bluetooth ODID
tests:
  sample.bluetooth.opendroneid:
    harness: bluetooth
    platform_allow:
      - qemu_x86
      - kw45b41z_evk
    tags: bluetooth
```

## samples/bluetooth/pbp_public_broadcast_sink/sample.yaml
```yaml
sample:
  description: Bluetooth Low Energy Audio PBP Broadcast Sink sample
  name: Bluetooth Low Energy Audio PBP Broadcast Sink sample
tests:
  sample.bluetooth.pbp_public_broadcast_sink:
    harness: bluetooth
    platform_allow:
      - qemu_cortex_m3
      - qemu_x86
      - nrf5340dk/nrf5340/cpuapp
      - nrf5340bsim/nrf5340/cpuapp
    integration_platforms:
      - qemu_x86
      - nrf5340dk/nrf5340/cpuapp
    tags: bluetooth
    sysbuild: true
  sample.bluetooth.pbp_public_broadcast_sink.bt_ll_sw_split:
    harness: bluetooth
    platform_allow:
      - nrf52_bsim
      - nrf52833dk/nrf52820
      - nrf52833dk/nrf52833
    integration_platforms:
      - nrf52_bsim
      - nrf52833dk/nrf52833
    extra_args:
      - EXTRA_CONF_FILE=overlay-bt_ll_sw_split.conf
      - SNIPPET="bt-ll-sw-split"
    tags: bluetooth
```

## samples/bluetooth/pbp_public_broadcast_source/sample.yaml
```yaml
sample:
  description: Bluetooth Low Energy Public Broadcast Source sample
  name: Bluetooth Low Energy Public Broadcast Source sample
tests:
  sample.bluetooth.pbp_public_broadcast_source:
    harness: bluetooth
    platform_allow:
      - qemu_cortex_m3
      - qemu_x86
      - nrf5340dk/nrf5340/cpuapp
      - nrf5340bsim/nrf5340/cpuapp
    integration_platforms:
      - qemu_x86
      - nrf5340dk/nrf5340/cpuapp
    tags: bluetooth
    sysbuild: true
  sample.bluetooth.pbp_public_broadcast_source.bt_ll_sw_split:
    harness: bluetooth
    platform_allow:
      - nrf52_bsim
      - nrf52833dk/nrf52820
      - nrf52833dk/nrf52833
    integration_platforms:
      - nrf52_bsim
      - nrf52833dk/nrf52833
    extra_args:
      - EXTRA_CONF_FILE=overlay-bt_ll_sw_split.conf
      - SNIPPET="bt-ll-sw-split"
    tags: bluetooth
```

## samples/bluetooth/periodic_adv/boards/nrf52833dk_nrf52833.conf
```kconfig
CONFIG_BT_CTLR_DF=y

CONFIG_BT_CTLR_ADVANCED_FEATURES=y
CONFIG_BT_CTLR_ADV_SYNC_PDU_BACK2BACK=y
CONFIG_BT_CTLR_DF_PER_ADV_CTE_NUM_MAX=1
```

## samples/bluetooth/periodic_adv/boards/nrf52_bsim.conf
```kconfig
CONFIG_BT_CTLR_ADV_EXT=y
CONFIG_BT_CTLR_ADV_PERIODIC=y

CONFIG_BT_CTLR_ADV_DATA_LEN_MAX=191
CONFIG_BT_CTLR_ADV_DATA_BUF_MAX=20

CONFIG_BT_CTLR_ADVANCED_FEATURES=y
# CONFIG_BT_CTLR_ADV_PDU_LINK=y
# CONFIG_BT_CTLR_ADV_PDU_BACK2BACK=y
CONFIG_BT_CTLR_ADV_SYNC_PDU_BACK2BACK=y
CONFIG_BT_CTLR_ADV_SYNC_PDU_BACK2BACK_AFS=300
# CONFIG_BT_CTLR_ADV_SYNC_PDU_BACK2BACK_AFS=1000
```

## samples/bluetooth/periodic_adv_conn/sample.yaml
```yaml
sample:
  name: Bluetooth Periodic Advertising Connection Procedure
tests:
  sample.bluetooth.periodic_adv_conn:
    harness: bluetooth
    platform_allow:
      - qemu_cortex_m3/ti_lm3s6965
      - qemu_x86/atom
      - nrf52840dk/nrf52840
    tags: bluetooth
    integration_platforms:
      - nrf52840dk/nrf52840
    extra_configs:
      - CONFIG_BT_CTLR=n
      - CONFIG_BT_NO_DRIVER=y
```

## samples/bluetooth/periodic_sync/Kconfig
```kconfig
#
# Copyright (c) 2024 Hang Fan
#
# SPDX-License-Identifier: Apache-2.0
#

mainmenu "Bluetooth: Periodic Advertising Sync"

config PER_ADV_NAME
	string "Target Periodic Advertising Name"
	default ""
	help
	  Name of target advertising for Periodic Advertising Synchronization.

config PER_BLINK_LED0
	bool "Blink led0"
	depends on $(dt_alias_enabled,led0)
	select GPIO
	default y

source "Kconfig.zephyr"
```

## samples/bluetooth/periodic_sync/boards/nrf52833dk_nrf52833.conf
```kconfig
CONFIG_BT_CTLR_ADV_EXT=y
CONFIG_BT_CTLR_SYNC_PERIODIC=y
CONFIG_BT_CTLR_DUP_FILTER_ADV_SET_MAX=16
```

## samples/bluetooth/periodic_sync/boards/nrf52_bsim.conf
```kconfig
CONFIG_BT_CTLR_ADV_EXT=y
CONFIG_BT_CTLR_SYNC_PERIODIC=y
CONFIG_BT_CTLR_DUP_FILTER_ADV_SET_MAX=16
CONFIG_BT_CTLR_SCAN_DATA_LEN_MAX=1650
CONFIG_BT_CTLR_RX_BUFFERS=6
```

## samples/bluetooth/periodic_sync/boards/nrf52dk_nrf52810.conf
```kconfig
CONFIG_BT_CTLR_ADV_EXT=y
CONFIG_BT_CTLR_SYNC_PERIODIC=y
CONFIG_USE_SEGGER_RTT=y
CONFIG_BT_LL_SW_SPLIT=y
CONFIG_PRINTK=y
```
