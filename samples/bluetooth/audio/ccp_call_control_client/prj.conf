## CMakeLists.txt
```
# SPDX-License-Identifier: Apache-2.0

cmake_minimum_required(VERSION 3.20.0)
find_package(Zephyr REQUIRED HINTS $ENV{ZEPHYR_BASE})
project(ccp_call_control_client)

target_sources(app PRIVATE
  src/main.c
)

zephyr_library_include_directories(${ZEPHYR_BASE}/samples/bluetooth)
```

## prj.conf
```kconfig
CONFIG_BT=y
CONFIG_LOG=y
CONFIG_BT_CENTRAL=y
CONFIG_BT_GATT_CLIENT=y
CONFIG_BT_GATT_AUTO_DISCOVER_CCC=y
CONFIG_BT_AUDIO=y
CONFIG_BT_EXT_ADV=y
CONFIG_BT_DEVICE_NAME="CCP Call Control Client"

CONFIG_BT_SMP=y
CONFIG_BT_KEYS_OVERWRITE_OLDEST=y

# CCP support
CONFIG_BT_CCP_CALL_CONTROL_CLIENT=y
CONFIG_BT_CCP_CALL_CONTROL_CLIENT_BEARER_COUNT=2
CONFIG_BT_TBS_CLIENT_GTBS=y
CONFIG_BT_TBS_CLIENT_TBS=y
CONFIG_BT_TBS_CLIENT_MAX_TBS_INSTANCES=1
CONFIG_BT_TBS_CLIENT_BEARER_PROVIDER_NAME=y
CONFIG_BT_TBS_CLIENT_BEARER_UCI=y
CONFIG_BT_TBS_CLIENT_BEARER_TECHNOLOGY=y
CONFIG_BT_TBS_CLIENT_BEARER_URI_SCHEMES_SUPPORTED_LIST=y
CONFIG_BT_TBS_CLIENT_BEARER_SIGNAL_STRENGTH=y
CONFIG_UTF8=y

# TBS Client may require up to 12 buffers
CONFIG_BT_ATT_TX_COUNT=12
```

## extra-bt_ll_sw_split.conf
```kconfig
# Zephyr Bluetooth Controller
CONFIG_BT_LL_SW_SPLIT=y

# Zephyr Controller tested maximum advertising data that can be set in a single HCI command
CONFIG_BT_CTLR_ADV_DATA_LEN_MAX=191
CONFIG_BT_CTLR_SCAN_DATA_LEN_MAX=191
```

## src/main.c
```c
/*
 * Copyright (c) 2024-2026 Nordic Semiconductor ASA
 *
 * SPDX-License-Identifier: Apache-2.0
 */

#include <errno.h>
#include <stdbool.h>
#include <stddef.h>
#include <stdint.h>
#include <stdio.h>
#include <string.h>

#include <zephyr/autoconf.h>
#include <zephyr/bluetooth/addr.h>
#include <zephyr/bluetooth/assigned_numbers.h>
#include <zephyr/bluetooth/audio/tbs.h>
#include <zephyr/bluetooth/audio/ccp.h>
#include <zephyr/bluetooth/bluetooth.h>
#include <zephyr/bluetooth/conn.h>
#include <zephyr/bluetooth/gap.h>
#include <zephyr/bluetooth/hci_types.h>
#include <zephyr/bluetooth/uuid.h>
#include <zephyr/kernel.h>
#include <zephyr/logging/log.h>
#include <zephyr/net_buf.h>
#include <zephyr/sys/byteorder.h>
#include <zephyr/sys/util.h>
#include <zephyr/sys/util_macro.h>
#include <zephyr/toolchain.h>

LOG_MODULE_REGISTER(ccp_call_control_client, CONFIG_LOG_DEFAULT_LEVEL);

#define SEM_TIMEOUT K_SECONDS(10U)

static struct bt_conn *peer_conn;
/* call_control_client is not static as it is used for testing purposes */
struct bt_ccp_call_control_client *call_control_client;
static struct bt_ccp_call_control_client_bearers client_bearers;

static K_SEM_DEFINE(sem_conn_state_change, 0U, 1U);
static K_SEM_DEFINE(sem_security_updated, 0U, 1U);
static K_SEM_DEFINE(sem_ccp_action_completed, 0U, 1U);
static bool required_action_failed;

static void connected_cb(struct bt_conn *conn, uint8_t err)
{
	if (err != BT_HCI_ERR_SUCCESS) {
		LOG_INF("Failed to connect: %u", err);
		bt_conn_drop(&peer_conn);
	} else {
		LOG_INF("Connected: %s", bt_conn_dst_str(conn));
	}

	k_sem_give(&sem_conn_state_change);
}

static void disconnected_cb(struct bt_conn *conn, uint8_t reason)
{
	if (conn != peer_conn) {
		return;
	}

	LOG_INF("Disconnected: %s (reason 0x%02x)", bt_conn_dst_str(conn),
		reason);

	bt_conn_drop(&peer_conn);
	call_control_client = NULL;
	memset(&client_bearers, 0, sizeof(client_bearers));
	k_sem_give(&sem_conn_state_change);
}

static void security_changed_cb(struct bt_conn *conn, bt_security_t level, enum bt_security_err err)
{
	ARG_UNUSED(conn);
	ARG_UNUSED(level);

	if (err == 0) {
		k_sem_give(&sem_security_updated);
	} else {
		LOG_ERR("Failed to set security level: %s(%u)", bt_security_err_to_str(err), err);
	}
}

BT_CONN_CB_DEFINE(conn_callbacks) = {
	.connected = connected_cb,
	.disconnected = disconnected_cb,
	.security_changed = security_changed_cb,
};

static bool check_gtbs_support(struct bt_data *data, void *user_data)
{
	struct net_buf_simple svc_data;
	bool *connect = user_data;
	const struct bt_uuid *uuid;
	uint16_t uuid_val;

	if (data->type != BT_DATA_SVC_DATA16) {
		return true; /* Continue parsing to next AD data type */
	}

	if (data->data_len < sizeof(uuid_val)) {
		LOG_WRN("AD invalid size %u", data->data_len);
		return true; /* Continue parsing to next AD data type */
	}

	net_buf_simple_init_with_data(&svc_data, (void *)data->data, data->data_len);

	/* Pull the 16-bit service data and compare to what we are searching for */
	uuid_val = net_buf_simple_pull_le16(&svc_data);
	uuid = BT_UUID_DECLARE_16(sys_le16_to_cpu(uuid_val));
	if (bt_uuid_cmp(uuid, BT_UUID_GTBS) != 0) {
		/* We are looking for the GTBS service data */
		return true; /* Continue parsing to next AD data type */
	}

	*connect = true;

	return false; /* Stop parsing */
}

static void scan_recv_cb(const struct bt_le_scan_recv_info *info, struct net_buf_simple *ad)
{
	bool connect = false;

	if (peer_conn != NULL) {
		/* Already connected */
		return;
	}

	/* CCP mandates that connectbale extended advertising is used by the peripherals so we
	 * ignore any scan report this is not that.
	 * We also ignore reports with poor RSSI
	 */
	if (info->adv_type != BT_GAP_ADV_TYPE_EXT_ADV ||
	    (info->adv_props & BT_GAP_ADV_PROP_EXT_ADV) == 0 ||
	    (info->adv_props & BT_GAP_ADV_PROP_CONNECTABLE) == 0 || info->rssi < -70) {
		return;
	}

	LOG_INF("Connectable device found: %s (RSSI %d)", bt_addr_le_str(info->addr), info->rssi);

	/* Iterate on the advertising data to see if claims GTBS support */
	bt_data_parse(ad, check_gtbs_support, &connect);

	if (connect) {
		int err;

		err = bt_le_scan_stop();
		if (err != 0) {
			LOG_ERR("Scanning failed to stop (err %d)", err);
			return;
		}

		LOG_INF("Connecting to found CCP server");
		err = bt_conn_le_create(info->addr, BT_CONN_LE_CREATE_CONN,
					BT_LE_CONN_PARAM_DEFAULT, &peer_conn);
		if (err != 0) {
			LOG_ERR("Conn create failed: %d", err);
		}
	}
}

static int scan_and_connect(void)
{
	int err;

	err = bt_le_scan_start(BT_LE_SCAN_PASSIVE, NULL);
	if (err != 0) {
		LOG_ERR("Scanning failed to start (err %d)", err);
		return err;
	}

	LOG_INF("Scanning successfully started");

	err = k_sem_take(&sem_conn_state_change, K_FOREVER);
	if (err != 0) {
		LOG_ERR("failed to take sem_connected (err %d)", err);
		return err;
	}

	if (peer_conn == NULL) {
		return -ENOTCONN;
	}

	err = bt_conn_set_security(peer_conn, BT_SECURITY_L2);
	if (err != 0) {
		LOG_ERR("failed to set security (err %d)", err);
		return err;
	}

	err = k_sem_take(&sem_security_updated, SEM_TIMEOUT);
	if (err != 0) {
		LOG_ERR("failed to take sem_security_updated (err %d)", err);
		return err;
	}

	LOG_INF("Security successfully updated");

	return 0;
}

static void ccp_call_control_client_discover_cb(struct bt_ccp_call_control_client *client, int err,
						struct bt_ccp_call_control_client_bearers *bearers,
						void *user_data)
{
	ARG_UNUSED(client);
	ARG_UNUSED(user_data);

	if (err != 0) {
		LOG_ERR("Discovery failed: %d", err);
		required_action_failed = true;
	} else {

		LOG_INF("Discovery completed with %s%u TBS bearers",
			bearers->gtbs_bearer != NULL ? "GTBS and " : "", bearers->tbs_count);

		(void)memcpy(&client_bearers, bearers, sizeof(client_bearers));
	}

	k_sem_give(&sem_ccp_action_completed);
}

#if defined(CONFIG_BT_TBS_CLIENT_BEARER_PROVIDER_NAME)
static void ccp_call_control_client_read_bearer_provider_name_cb(
	struct bt_ccp_call_control_client_bearer *bearer, int err, const char *name,
	void *user_data)
{
	ARG_UNUSED(user_data);

	if (err != 0) {
		LOG_ERR("Failed to read bearer %p provider name: %d\n", (void *)bearer, err);
		required_action_failed = true;
	} else {
		LOG_INF("Bearer %p provider name: %s", (void *)bearer, name);
	}

	k_sem_give(&sem_ccp_action_completed);
}
#endif /* CONFIG_BT_TBS_CLIENT_BEARER_PROVIDER_NAME */

#if defined(CONFIG_BT_TBS_CLIENT_BEARER_TECHNOLOGY)
static void
ccp_call_control_client_read_bearer_tech_cb(struct bt_ccp_call_control_client_bearer *bearer,
					    int err, enum bt_bearer_tech tech, void *user_data)
{
	ARG_UNUSED(user_data);

	if (err != 0) {
		LOG_ERR("Failed to read bearer %p technology: %d\n", (void *)bearer, err);
		required_action_failed = true;
	} else {
		LOG_INF("Bearer %p technology: %d", (void *)bearer, tech);
	}

	k_sem_give(&sem_ccp_action_completed);
}
#endif /* CONFIG_BT_TBS_CLIENT_BEARER_TECHNOLOGY */

#if defined(CONFIG_BT_TBS_CLIENT_BEARER_UCI)
static void
ccp_call_control_client_read_bearer_uci_cb(struct bt_ccp_call_control_client_bearer *bearer,
					   int err, const char *uci, void *user_data)
{
	if (err != 0) {
		LOG_ERR("Failed to read bearer %p UCI: %d\n", (void *)bearer, err);
		required_action_failed = true;
	} else {
		LOG_INF("Bearer %p UCI: %s", (void *)bearer, uci);
	}

	k_sem_give(&sem_ccp_action_completed);
}
#endif /* CONFIG_BT_TBS_CLIENT_BEARER_UCI */

#if defined(CONFIG_BT_TBS_CLIENT_BEARER_URI_SCHEMES_SUPPORTED_LIST)
static void
ccp_call_control_client_read_bearer_uri_schemes_cb(struct bt_ccp_call_control_client_bearer *bearer,
						   int err, const char *uri_schemes,
						   void *user_data)
{
	ARG_UNUSED(user_data);

	if (err != 0) {
		LOG_ERR("Failed to read bearer %p URI schemes: %d\n", (void *)bearer, err);
		required_action_failed = true;
	} else {
		LOG_INF("Bearer %p URI schemes: %s", (void *)bearer, uri_schemes);
	}

	k_sem_give(&sem_ccp_action_completed);
}
#endif /* CONFIG_BT_TBS_CLIENT_BEARER_URI_SCHEMES_SUPPORTED_LIST */

static int reset_ccp_call_control_client(void)
{
	int err;

	LOG_INF("Resetting");

	if (peer_conn != NULL) {
		err = bt_conn_disconnect(peer_conn, BT_HCI_ERR_REMOTE_USER_TERM_CONN);
		if (err != 0) {
			return err;
		}

		err = k_sem_take(&sem_conn_state_change, K_FOREVER);
		if (err != 0) {
			LOG_ERR("Failed to take sem_conn_state_change: %d", err);
			return err;
		}
	}

	/* If scanning is already stopped it will still return `0` */
	err = bt_le_scan_stop();
	if (err != 0) {
		LOG_ERR("Scanning failed to stop (err %d)", err);
		return err;
	}

	k_sem_reset(&sem_conn_state_change);
	required_action_failed = false;

	return 0;
}

static int discover_services(void)
{
	int err;

	LOG_INF("Discovering GTBS and TBS");

	err = bt_ccp_call_control_client_discover(peer_conn, &call_control_client);
	if (err != 0) {
		LOG_ERR("Failed to discover: %d", err);
		return err;
	}

	err = k_sem_take(&sem_ccp_action_completed, SEM_TIMEOUT);
	if (err != 0) {
		LOG_ERR("Failed to take sem_ccp_action_completed: %d", err);
		return err;
	}

	if (required_action_failed) {
		return -ENODATA;
	}

	return 0;
}

static int read_bearer_name(struct bt_ccp_call_control_client_bearer *bearer)
{
	int err;

	err = bt_ccp_call_control_client_read_bearer_provider_name(bearer);
	if (err != 0) {
		return err;
	}

	err = k_sem_take(&sem_ccp_action_completed, SEM_TIMEOUT);
	if (err != 0) {
		LOG_ERR("Failed to take sem_ccp_action_completed: %d", err);
		return err;
	}

	if (required_action_failed) {
		return -ENODATA;
	}

	return 0;
}

static int read_bearer_uci(struct bt_ccp_call_control_client_bearer *bearer)
{
	int err;

	err = bt_ccp_call_control_client_read_bearer_uci(bearer);
	if (err != 0) {
		return err;
	}

	err = k_sem_take(&sem_ccp_action_completed, SEM_TIMEOUT);
	if (err != 0) {
		LOG_ERR("Failed to take sem_ccp_action_completed: %d", err);
		return err;
	}

	if (required_action_failed) {
		return -ENODATA;
	}

	return 0;
}

static int read_bearer_tech(struct bt_ccp_call_control_client_bearer *bearer)
{
	int err;

	err = bt_ccp_call_control_client_read_bearer_tech(bearer);
	if (err != 0) {
		return err;
	}

	err = k_sem_take(&sem_ccp_action_completed, SEM_TIMEOUT);
	if (err != 0) {
		LOG_ERR("Failed to take sem_ccp_action_completed: %d", err);
		return err;
	}

	if (required_action_failed) {
		return -ENODATA;
	}

	return 0;
}

static int read_bearer_uri_schemes(struct bt_ccp_call_control_client_bearer *bearer)
{
	int err;

	err = bt_ccp_call_control_client_read_bearer_uri_schemes(bearer);
	if (err != 0) {
		return err;
	}

	err = k_sem_take(&sem_ccp_action_completed, SEM_TIMEOUT);
	if (err != 0) {
		LOG_ERR("Failed to take sem_ccp_action_completed: %d", err);
		return err;
	}

	if (required_action_failed) {
		return -ENODATA;
	}

	return 0;
}

static int read_bearer_values(void)
{
	int err;

#if defined(CONFIG_BT_TBS_CLIENT_GTBS)
	if (IS_ENABLED(CONFIG_BT_TBS_CLIENT_BEARER_PROVIDER_NAME)) {
		err = read_bearer_name(client_bearers.gtbs_bearer);
		if (err != 0) {
			LOG_ERR("Failed to read name for GTBS bearer: %d", err);
			return err;
		}
	}

	if (IS_ENABLED(CONFIG_BT_TBS_CLIENT_BEARER_UCI)) {
		err = read_bearer_uci(client_bearers.gtbs_bearer);
		if (err != 0) {
			LOG_ERR("Failed to read UCI for GTBS bearer: %d", err);
			return err;
		}
	}

	if (IS_ENABLED(CONFIG_BT_TBS_CLIENT_BEARER_TECHNOLOGY)) {
		err = read_bearer_tech(client_bearers.gtbs_bearer);
		if (err != 0) {
			LOG_ERR("Failed to read technology for GTBS bearer: %d", err);
			return err;
		}
	}

	if (IS_ENABLED(CONFIG_BT_TBS_CLIENT_BEARER_URI_SCHEMES_SUPPORTED_LIST)) {
		err = read_bearer_uri_schemes(client_bearers.gtbs_bearer);
		if (err != 0) {
			LOG_ERR("Failed to read URI schemes for GTBS bearer: %d", err);
			return err;
		}
	}
#endif /* CONFIG_BT_TBS_CLIENT_GTBS */

#if defined(CONFIG_BT_TBS_CLIENT_TBS)
	for (size_t i = 0U; i < client_bearers.tbs_count; i++) {
		if (IS_ENABLED(CONFIG_BT_TBS_CLIENT_BEARER_PROVIDER_NAME)) {
			err = read_bearer_name(client_bearers.tbs_bearers[i]);
			if (err != 0) {
				LOG_ERR("Failed to read name for bearer[%zu]: %d", i, err);
				return err;
			}
		}

		if (IS_ENABLED(CONFIG_BT_TBS_CLIENT_BEARER_UCI)) {
			err = read_bearer_uci(client_bearers.tbs_bearers[i]);
			if (err != 0) {
				LOG_ERR("Failed to read UCI for bearer[%zu]: %d", i, err);
				return err;
			}
		}

		if (IS_ENABLED(CONFIG_BT_TBS_CLIENT_BEARER_TECHNOLOGY)) {
			err = read_bearer_tech(client_bearers.tbs_bearers[i]);
			if (err != 0) {
				LOG_ERR("Failed to read technology for TBS bearer[%zu]: %d", i,
					err);
				return err;
			}
		}

		if (IS_ENABLED(CONFIG_BT_TBS_CLIENT_BEARER_URI_SCHEMES_SUPPORTED_LIST)) {
			err = read_bearer_uri_schemes(client_bearers.tbs_bearers[i]);
			if (err != 0) {
				LOG_ERR("Failed to read URI schemes for TBS bearer[%zu]: %d", i,
					err);
				return err;
			}
		}
	}
#endif /* CONFIG_BT_TBS_CLIENT_TBS */

	return 0;
}

static int init_ccp_call_control_client(void)
{
	static struct bt_ccp_call_control_client_cb ccp_call_control_client_cbs = {
		.discover = ccp_call_control_client_discover_cb,
#if defined(CONFIG_BT_TBS_CLIENT_BEARER_PROVIDER_NAME)
		.bearer_provider_name = ccp_call_control_client_read_bearer_provider_name_cb,
#endif /* CONFIG_BT_TBS_CLIENT_BEARER_PROVIDER_NAME */
#if defined(CONFIG_BT_TBS_CLIENT_BEARER_UCI)
		.bearer_uci = ccp_call_control_client_read_bearer_uci_cb,
#endif /* CONFIG_BT_TBS_CLIENT_BEARER_UCI */
#if defined(CONFIG_BT_TBS_CLIENT_BEARER_TECHNOLOGY)
		.bearer_tech = ccp_call_control_client_read_bearer_tech_cb,
#endif /* CONFIG_BT_TBS_CLIENT_BEARER_TECHNOLOGY */
#if defined(CONFIG_BT_TBS_CLIENT_BEARER_URI_SCHEMES_SUPPORTED_LIST)
		.bearer_uri_schemes = ccp_call_control_client_read_bearer_uri_schemes_cb,
#endif /* CONFIG_BT_TBS_CLIENT_BEARER_URI_SCHEMES_SUPPORTED_LIST */
	};
	static struct bt_le_scan_cb scan_cbs = {
		.recv = scan_recv_cb,
	};
	int err;

	err = bt_enable(NULL);
	if (err != 0) {
		LOG_ERR("Bluetooth enable failed (err %d)", err);

		return err;
	}

	LOG_DBG("Bluetooth initialized");
	err = bt_le_scan_cb_register(&scan_cbs);
	if (err != 0) {
		LOG_ERR("Bluetooth enable failed (err %d)", err);

		return err;
	}

	err = bt_ccp_call_control_client_register_cb(&ccp_call_control_client_cbs);
	if (err != 0) {
		LOG_ERR("Bluetooth enable failed (err %d)", err);

		return err;
	}

	return 0;
}

int main(void)
{
	int err;

	err = init_ccp_call_control_client();
	if (err != 0) {
		return 0;
	}

	LOG_INF("CCP Call Control Client initialized");

	while (true) {
		err = reset_ccp_call_control_client();
		if (err != 0) {
			break;
		}

		/* Start scanning for CCP servers and connect to the first we find */
		err = scan_and_connect();
		if (err != 0) {
			continue;
		}

		/* Discover TBS and GTBS on the remove server */
		err = discover_services();
		if (err != 0) {
			continue;
		}

		err = read_bearer_values();
		if (err != 0) {
			continue;
		}

		/* Reset if disconnected */
		err = k_sem_take(&sem_conn_state_change, K_FOREVER);
		if (err != 0) {
			LOG_ERR("Failed to take sem_conn_state_change: err %d", err);
			break;
		}
	}

	return 0;
}
```
