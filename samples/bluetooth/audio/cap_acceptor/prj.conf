## CMakeLists.txt
```
# SPDX-License-Identifier: Apache-2.0

cmake_minimum_required(VERSION 3.28.0)
find_package(Zephyr REQUIRED HINTS $ENV{ZEPHYR_BASE})
project(cap_acceptor)

target_sources(app PRIVATE
  src/main.c
)

zephyr_sources_ifdef(CONFIG_SAMPLE_UNICAST src/cap_acceptor_unicast.c)
zephyr_sources_ifdef(CONFIG_SAMPLE_BROADCAST src/cap_acceptor_broadcast.c)

zephyr_library_include_directories(${ZEPHYR_BASE}/samples/bluetooth)
```

## Kconfig
```
# Copyright (c) 2022-2025 Nordic Semiconductor ASA
# SPDX-License-Identifier: Apache-2.0

mainmenu "Bluetooth: Common Audio Profile Acceptor sample"

config SAMPLE_UNICAST
	bool "Whether or not advertise connectable support for unicast audio"
	default y
	select BT_BAP_UNICAST_SERVER
	select BT_ISO_PERIPHERAL
	select BT_ASCS
	select BT_PAC_SNK
	select BT_PAC_SNK_LOC
	select BT_PAC_SRC
	select BT_PAC_SRC_LOC
	select BT_CTLR_PERIPHERAL_ISO if HAS_BT_CTLR
	help
	  If set to true, the sample will start advertising connectable for
	  Broadcast Assistants.

config SAMPLE_BROADCAST
	bool "Whether or not advertise connectable support for broadcast audio"
	default y if !SAMPLE_UNICAST
	select BT_BAP_SCAN_DELEGATOR
	select BT_OBSERVER
	select BT_ISO_SYNC_RECEIVER
	select BT_BAP_BROADCAST_SINK
	select BT_PAC_SNK
	select BT_PAC_SNK_LOC
	select BT_PER_ADV_SYNC_TRANSFER_RECEIVER if (!HAS_BT_CTLR || \
							BT_CTLR_SYNC_TRANSFER_RECEIVER_SUPPORT)
	select BT_CTLR_SYNC_ISO if HAS_BT_CTLR
	help
	  If set to true, the sample will start advertising syncable audio streams

config SAMPLE_SCAN_SELF
	bool "Whether to scan for Broadcast Sources without Broadcast Assistant"
	depends on SAMPLE_BROADCAST
	help
	  If set to true, the sample will start scanning for Broadcast Sources
	  without waiting for a Broadcast Assistant to connect.

config SAMPLE_TARGET_BROADCAST_NAME
	string "Target Broadcast Device Name when self-scanning"
	default ""
	help
	  Name of target broadcast device. If not empty string, sink device
	  will only listen to the specified broadcast source. Not case sensitive.

if SAMPLE_UNICAST

configdefault BT_ASCS_MAX_ASE_SNK_COUNT
	default 2

configdefault BT_ASCS_MAX_ASE_SRC_COUNT
	default 1

# Mandatory to support at least 1 for ASCS
configdefault BT_ATT_PREPARE_COUNT
	default 1

endif

if SAMPLE_BROADCAST

configdefault BT_BAP_BROADCAST_SNK_COUNT
	default 1

configdefault BT_BAP_BROADCAST_SNK_STREAM_COUNT
	default 2

endif

source "Kconfig.zephyr"
```

## prj.conf
```kconfig
CONFIG_BT=y
CONFIG_LOG=y
CONFIG_BT_PERIPHERAL=y
CONFIG_BT_GAP_AUTO_UPDATE_CONN_PARAMS=n
# Set preferred values based on BT_BAP_CONN_PARAM_RELAXED
CONFIG_BT_PERIPHERAL_PREF_MIN_INT=50
CONFIG_BT_PERIPHERAL_PREF_MAX_INT=70
CONFIG_BT_PERIPHERAL_PREF_LATENCY=0
CONFIG_BT_PERIPHERAL_PREF_TIMEOUT=400
CONFIG_BT_GATT_DYNAMIC_DB=y
CONFIG_BT_GATT_CLIENT=y
CONFIG_BT_EXT_ADV=y
CONFIG_BT_DEVICE_NAME="CAP Acceptor"
CONFIG_UTF8=y
CONFIG_BT_AUDIO=y
CONFIG_BT_SMP=y
CONFIG_BT_KEYS_OVERWRITE_OLDEST=y

# CAP
CONFIG_BT_CAP_ACCEPTOR=y
CONFIG_BT_ISO_MAX_CHAN=2

CONFIG_BT_PAC_SNK=y
CONFIG_BT_PAC_SRC=y

# Support long Metadata size for audio configuration
CONFIG_BT_AUDIO_CODEC_CFG_MAX_METADATA_SIZE=24
```

## overlay-bt_ll_sw_split.conf
```kconfig
# Zephyr Bluetooth Controller
CONFIG_BT_LL_SW_SPLIT=y

# Zephyr Controller tested maximum advertising data that can be set in a single HCI command
CONFIG_BT_CTLR_SCAN_DATA_LEN_MAX=191
CONFIG_BT_CTLR_ADV_DATA_LEN_MAX=191

# Support the highest SDU size required by any BAP LC3 presets (155) + 8 bytes of HCI ISO Data
# packet overhead (the Packet_Sequence_Number, ISO_SDU_Length, Packet_Status_Flag fields; and
# the optional Time_Stamp field, if supplied)
CONFIG_BT_CTLR_ISO_TX_BUFFER_SIZE=163
CONFIG_BT_CTLR_ISO_TX_SDU_LEN_MAX=155

CONFIG_BT_CTLR_ISOAL_SINKS=2
CONFIG_BT_CTLR_SYNC_ISO_STREAM_MAX=2
```

## src/main.c
```c
/*
 * Copyright (c) 2024 Nordic Semiconductor ASA
 *
 * SPDX-License-Identifier: Apache-2.0
 */

#include <zephyr/autoconf.h>
#include <errno.h>
#include <stdbool.h>
#include <stddef.h>
#include <stdint.h>

#include <zephyr/bluetooth/addr.h>
#include <zephyr/bluetooth/assigned_numbers.h>
#include <zephyr/bluetooth/audio/audio.h>
#include <zephyr/bluetooth/audio/bap.h>
#include <zephyr/bluetooth/audio/cap.h>
#include <zephyr/bluetooth/audio/lc3.h>
#include <zephyr/bluetooth/audio/pacs.h>
#include <zephyr/bluetooth/bluetooth.h>
#include <zephyr/bluetooth/byteorder.h>
#include <zephyr/bluetooth/conn.h>
#include <zephyr/bluetooth/gap.h>
#include <zephyr/bluetooth/hci.h>
#include <zephyr/bluetooth/hci_types.h>
#include <zephyr/bluetooth/uuid.h>
#include <zephyr/kernel.h>
#include <zephyr/logging/log.h>
#include <zephyr/logging/log_core.h>
#include <zephyr/sys/__assert.h>
#include <zephyr/sys/util.h>
#include <zephyr/sys/util_macro.h>
#include <zephyr/toolchain.h>

#include "cap_acceptor.h"

LOG_MODULE_REGISTER(cap_acceptor, LOG_LEVEL_INF);

#define SUPPORTED_DURATION (BT_AUDIO_CODEC_CAP_DURATION_7_5 | BT_AUDIO_CODEC_CAP_DURATION_10)
#define SUPPORTED_FREQ     BT_AUDIO_CODEC_CAP_FREQ_ANY
#define SUPPORTED_FRAME_SIZE_MIN 30U
#define SUPPORTED_FRAME_SIZE_MAX 155U
#define SEM_TIMEOUT        K_SECONDS(5U)
#define FRAMES_PER_SDU     2U

static const struct bt_data ad[] = {
	BT_DATA_BYTES(BT_DATA_FLAGS, (BT_LE_AD_GENERAL | BT_LE_AD_NO_BREDR)),
	BT_DATA(BT_DATA_NAME_COMPLETE, CONFIG_BT_DEVICE_NAME, sizeof(CONFIG_BT_DEVICE_NAME) - 1),
	BT_DATA_BYTES(BT_DATA_UUID16_SOME,
#if defined(CONFIG_BT_BAP_UNICAST_SERVER)
		      BT_UUID_16_ENCODE(BT_UUID_ASCS_VAL),
#endif /* CONFIG_BT_BAP_UNICAST_SERVER */
		      BT_UUID_16_ENCODE(BT_UUID_CAS_VAL)),
	BT_DATA_BYTES(BT_DATA_SVC_DATA16,
		      BT_UUID_16_ENCODE(BT_UUID_CAS_VAL),
		      BT_AUDIO_UNICAST_ANNOUNCEMENT_TARGETED),
	IF_ENABLED(CONFIG_BT_BAP_UNICAST_SERVER,
		   (BT_DATA_BYTES(BT_DATA_SVC_DATA16,
				  BT_UUID_16_ENCODE(BT_UUID_ASCS_VAL),
				  BT_AUDIO_UNICAST_ANNOUNCEMENT_TARGETED,
				  BT_BYTES_LIST_LE16(SINK_CONTEXT),
				  BT_BYTES_LIST_LE16(SOURCE_CONTEXT),
				  0x00, /* Metadata length */),
	))
	IF_ENABLED(CONFIG_BT_BAP_SCAN_DELEGATOR,
		   (BT_DATA_BYTES(BT_DATA_SVC_DATA16,
				  BT_UUID_16_ENCODE(BT_UUID_BASS_VAL)),
	))
};

static struct bt_le_ext_adv *adv;
static struct peer_config peer;

static K_SEM_DEFINE(sem_state_change, 0U, 1U);

static void connected_cb(struct bt_conn *conn, uint8_t err)
{
	ARG_UNUSED(err);

	LOG_INF("Connected: %s", bt_conn_dst_str(conn));

	peer.conn = bt_conn_ref(conn);
	k_sem_give(&sem_state_change);
}

static void disconnected_cb(struct bt_conn *conn, uint8_t reason)
{
	if (conn != peer.conn) {
		return;
	}

	LOG_INF("Disconnected: %s, reason 0x%02x %s", bt_conn_dst_str(conn),
		reason, bt_hci_err_to_str(reason));

	bt_conn_drop(&peer.conn);
	k_sem_give(&sem_state_change);
}

BT_CONN_CB_DEFINE(conn_callbacks) = {
	.connected = connected_cb,
	.disconnected = disconnected_cb,
};

static int advertise(void)
{
	int err;

	err = bt_le_ext_adv_create(BT_BAP_ADV_PARAM_CONN_QUICK, NULL, &adv);
	if (err != 0) {
		LOG_ERR("Failed to create advertising set: %d", err);

		return err;
	}

	err = bt_le_ext_adv_set_data(adv, ad, ARRAY_SIZE(ad), NULL, 0);
	if (err != 0) {
		LOG_ERR("Failed to set advertising data: %d", err);

		return err;
	}

	err = bt_le_ext_adv_start(adv, BT_LE_EXT_ADV_START_DEFAULT);
	if (err != 0) {
		LOG_ERR("Failed to start advertising set: %d", err);

		return err;
	}

	LOG_INF("Advertising successfully started");

	/* Wait for connection*/
	err = k_sem_take(&sem_state_change, K_FOREVER);
	if (err != 0) {
		LOG_ERR("Failed to take sem_state_change: err %d", err);

		return err;
	}

	return 0;
}

#if defined(CONFIG_BT_BAP_UNICAST_SERVER)
struct bt_cap_stream *stream_alloc(enum bt_audio_dir dir)
{
	struct bt_cap_stream *ret_stream;

	if (dir == BT_AUDIO_DIR_SINK) {
		ret_stream = NULL;
		ARRAY_FOR_EACH_PTR(peer.sink_streams, stream) {
			if (stream->bap_stream.ep == NULL) {
				ret_stream = stream;
			}
		}
	} else if (dir == BT_AUDIO_DIR_SOURCE && peer.source_stream.bap_stream.ep == NULL) {
		ret_stream = &peer.source_stream;
	} else {
		ret_stream = NULL;
	}

	return ret_stream;
}

void stream_released(const struct bt_cap_stream *cap_stream)
{
	if (cap_stream == &peer.source_stream) {
		k_sem_give(&peer.source_stream_sem);
	} else if (IS_ARRAY_ELEMENT(peer.sink_streams, cap_stream)) {
		k_sem_give(&peer.sink_stream_sem);
	} else {
		__ASSERT(false, "Invalid stream: %p", cap_stream);
	}
}
#endif /* CONFIG_BT_BAP_UNICAST_SERVER */

static int reset_cap_acceptor(void)
{
	int err;

	LOG_INF("Resetting");

	if (peer.conn != NULL) {
		err = bt_conn_disconnect(peer.conn, BT_HCI_ERR_REMOTE_USER_TERM_CONN);
		if (err != 0) {
			return err;
		}

		err = k_sem_take(&sem_state_change, K_FOREVER);
		if (err != 0) {
			LOG_ERR("Timeout on disconnect: %d", err);
			return err;
		}
	}

	if (adv != NULL) {
		err = bt_le_ext_adv_stop(adv);
		if (err != 0) {
			LOG_ERR("Failed to stop advertiser: %d", err);
			return err;
		}

		err = bt_le_ext_adv_delete(adv);
		if (err != 0) {
			LOG_ERR("Failed to delete advertiser: %d", err);
			return err;
		}

		adv = NULL;
	}

#if defined(CONFIG_BT_BAP_UNICAST_SERVER)
	if (peer.source_stream.bap_stream.ep != NULL) {
		err = k_sem_take(&peer.source_stream_sem, SEM_TIMEOUT);
		if (err != 0) {
			LOG_ERR("Timeout on source_stream_sem: %d", err);
			return err;
		}
	}

	ARRAY_FOR_EACH_PTR(peer.sink_streams, stream) {
		if (stream->bap_stream.ep != NULL) {
			err = k_sem_take(&peer.sink_stream_sem, SEM_TIMEOUT);
			if (err != 0) {
				LOG_ERR("Timeout on sink_stream_sem: %d", err);
				return err;
			}
		}
	}
#endif /* CONFIG_BT_BAP_UNICAST_SERVER */

	k_sem_reset(&sem_state_change);

	return 0;
}

/** Register the PAC records for PACS */
static int register_pac(enum bt_audio_dir dir, enum bt_audio_context context,
			struct bt_pacs_cap *cap, enum bt_audio_location locations)
{
	int err;

	err = bt_pacs_cap_register(dir, cap);
	if (err != 0) {
		LOG_ERR("Failed to register capabilities: %d", err);

		return err;
	}

	err = bt_pacs_set_location(dir, locations);
	if (err != 0) {
		LOG_ERR("Failed to set location: %d", err);

		return err;
	}

	err = bt_pacs_set_supported_contexts(dir, context);
	if (err != 0 && err != -EALREADY) {
		LOG_ERR("Failed to set supported contexts: %d", err);

		return err;
	}

	err = bt_pacs_set_available_contexts(dir, context);
	if (err != 0 && err != -EALREADY) {
		LOG_ERR("Failed to set available contexts: %d", err);

		return err;
	}

	return 0;
}

static int init_cap_acceptor(void)
{
	const struct bt_pacs_register_param pacs_param = {
		.snk_pac = true,
		.snk_loc = true,
		.src_pac = true,
		.src_loc = true,
	};
	int err;

	err = bt_enable(NULL);
	if (err != 0) {
		LOG_ERR("Bluetooth enable failed: %d", err);

		return 0;
	}

	LOG_INF("Bluetooth initialized");

	err = bt_pacs_register(&pacs_param);
	if (err != 0) {
		LOG_ERR("Could not register PACS (err %d)", err);
		return 0;
	}

	if (IS_ENABLED(CONFIG_BT_PAC_SNK)) {
		static const struct bt_audio_codec_cap lc3_codec_cap_sink = BT_AUDIO_CODEC_CAP_LC3(
			SUPPORTED_FREQ, SUPPORTED_DURATION,
			BT_AUDIO_CODEC_CAP_CHAN_COUNT_SUPPORT(1, 2), SUPPORTED_FRAME_SIZE_MIN,
			SUPPORTED_FRAME_SIZE_MAX, FRAMES_PER_SDU, SINK_CONTEXT);
		static struct bt_pacs_cap sink_cap = {
			.codec_cap = &lc3_codec_cap_sink,
		};
		int err;

		err = register_pac(BT_AUDIO_DIR_SINK, SINK_CONTEXT, &sink_cap,
				   BT_AUDIO_LOCATION_FRONT_LEFT | BT_AUDIO_LOCATION_FRONT_RIGHT);
		if (err != 0) {
			LOG_ERR("Failed to register sink capabilities: %d", err);

			return -ENOEXEC;
		}
	}

	if (IS_ENABLED(CONFIG_BT_PAC_SRC)) {
		static const struct bt_audio_codec_cap lc3_codec_cap_source =
			BT_AUDIO_CODEC_CAP_LC3(SUPPORTED_FREQ, SUPPORTED_DURATION,
					       BT_AUDIO_CODEC_CAP_CHAN_COUNT_SUPPORT(1),
					       SUPPORTED_FRAME_SIZE_MIN, SUPPORTED_FRAME_SIZE_MAX,
					       FRAMES_PER_SDU, SOURCE_CONTEXT);
		static struct bt_pacs_cap source_cap = {
			.codec_cap = &lc3_codec_cap_source,
		};
		int err;

		err = register_pac(BT_AUDIO_DIR_SOURCE, SOURCE_CONTEXT, &source_cap,
				   BT_AUDIO_LOCATION_FRONT_CENTER);
		if (err != 0) {
			LOG_ERR("Failed to register sink capabilities: %d", err);

			return -ENOEXEC;
		}
	}

	return 0;
}

int main(void)
{
	int err;

	err = init_cap_acceptor();
	if (err != 0) {
		return 0;
	}

	if (IS_ENABLED(CONFIG_BT_BAP_UNICAST_SERVER)) {
		err = init_cap_acceptor_unicast(&peer);
		if (err != 0) {
			return 0;
		}
	}

	if (IS_ENABLED(CONFIG_BT_BAP_BROADCAST_SINK)) {
		err = init_cap_acceptor_broadcast();
		if (err != 0) {
			return 0;
		}
	}

	LOG_INF("CAP Acceptor initialized");

	while (true) {
		err = reset_cap_acceptor();
		if (err != 0) {
			LOG_ERR("Failed to reset");

			break;
		}

		/* Start advertising as a CAP Acceptor, which includes setting the required
		 * advertising data based on the roles we support. The Common Audio Service data is
		 * always advertised, as CAP Initiators and CAP Commanders will use this to identify
		 * our device as a CAP Acceptor.
		 */
		err = advertise();
		if (err != 0) {
			continue;
		}

		/* After advertising we expect CAP Initiators to connect to us and setup streams,
		 * and eventually disconnect again. As a CAP Acceptor we just need to react to their
		 * requests and not do anything else.
		 */

		/* Reset if disconnected */
		err = k_sem_take(&sem_state_change, K_FOREVER);
		if (err != 0) {
			LOG_ERR("Failed to take sem_state_change: err %d", err);

			break;
		}
	}

	return 0;
}
```

## src/cap_acceptor.h
```c
/*
 * Copyright (c) 2024 Nordic Semiconductor ASA
 *
 * SPDX-License-Identifier: Apache-2.0
 */

#include <stdint.h>

#include <zephyr/autoconf.h>
#include <zephyr/bluetooth/audio/audio.h>
#include <zephyr/bluetooth/audio/cap.h>
#include <zephyr/bluetooth/conn.h>
#include <zephyr/kernel.h>

#define SINK_CONTEXT        BT_AUDIO_CONTEXT_TYPE_UNSPECIFIED
#define SOURCE_CONTEXT      BT_AUDIO_CONTEXT_TYPE_UNSPECIFIED
#define CAP_ACCEPTOR_MIN_SDU 30U
#define CAP_ACCEPTOR_MAX_SDU 310U /* 48_6_1 (155) * 2 for stereo */

/** Struct to contain information for a specific peer (CAP) device */
struct peer_config {
#if defined(CONFIG_BT_BAP_UNICAST_SERVER)
	/** Stream for the source endpoint */
	struct bt_cap_stream source_stream;
	/** Streams for the sink endpoint */
	struct bt_cap_stream sink_streams[CONFIG_BT_ASCS_MAX_ASE_SNK_COUNT];
	/** Semaphore to help wait for a release operation if the source stream is not idle */
	struct k_sem source_stream_sem;
	/** Semaphore to help wait for a release operation if the sink stream is not idle */
	struct k_sem sink_stream_sem;
	/** Current sequence number for TX */
	uint16_t tx_seq_num;
#endif /* CONFIG_BT_BAP_UNICAST_SERVER */
	/** ACL connection object for the peer device */
	struct bt_conn *conn;
};

/**
 * @brief Initialize the unicast part of the CAP Acceptor
 *
 * @param peer Pointer to the specific peer to initialize the CAP Acceptor for
 *
 * @retval 0 if success
 * @retval -ENOEXEC if callbacks failed to be registered
 */
int init_cap_acceptor_unicast(struct peer_config *peer);

/**
 * @brief Initialize the unicast part of the CAP Acceptor
 *
 * @retval 0 if success
 * @retval -ENOEXEC if callbacks failed to be registered
 */
int init_cap_acceptor_broadcast(void);

/**
 * @brief Request to allocate a CAP stream
 *
 * @param dir Audio direction of the stream to allocate
 *
 * @retval Pointer to the allocated CAP stream
 * @retval NULL if no more CAP streams for the @p dir could be allocated
 */
struct bt_cap_stream *stream_alloc(enum bt_audio_dir dir);

/**
 * Notify about a released stream

 * This is used to handle some state checks in the main.c file.
 *
 * @param cap_stream Pointer to the stream that was released
 */
void stream_released(const struct bt_cap_stream *cap_stream);
```

## src/cap_acceptor_broadcast.c
```c
/** @file
 *  @brief Bluetooth Common Audio Profile (CAP) Acceptor broadcast.
 *
 *  Copyright (c) 2024-2025 Nordic Semiconductor ASA
 *
 *  SPDX-License-Identifier: Apache-2.0
 */

#include <errno.h>
#include <stdbool.h>
#include <stddef.h>
#include <stdint.h>
#include <string.h>
#include <strings.h>

#include <zephyr/autoconf.h>
#include <zephyr/bluetooth/addr.h>
#include <zephyr/bluetooth/assigned_numbers.h>
#include <zephyr/bluetooth/audio/audio.h>
#include <zephyr/bluetooth/audio/bap.h>
#include <zephyr/bluetooth/audio/cap.h>
#include <zephyr/bluetooth/bluetooth.h>
#include <zephyr/bluetooth/conn.h>
#include <zephyr/bluetooth/gap.h>
#include <zephyr/bluetooth/iso.h>
#include <zephyr/bluetooth/uuid.h>
#include <zephyr/kernel.h>
#include <zephyr/logging/log.h>
#include <zephyr/logging/log_core.h>
#include <zephyr/net_buf.h>
#include <zephyr/sys/atomic.h>
#include <zephyr/sys/byteorder.h>
#include <zephyr/sys/util.h>
#include <zephyr/sys/util_macro.h>
#include <zephyr/toolchain.h>

#include "cap_acceptor.h"

LOG_MODULE_REGISTER(cap_acceptor_broadcast, LOG_LEVEL_INF);

#define NAME_LEN                          sizeof(CONFIG_SAMPLE_TARGET_BROADCAST_NAME) + 1U
#define PA_SYNC_INTERVAL_TO_TIMEOUT_RATIO 20U /* Set the timeout relative to interval */
#define PA_SYNC_SKIP                      5U

enum broadcast_flag {
	FLAG_BROADCAST_SYNC_REQUESTED,
	FLAG_BROADCAST_CODE_REQUIRED,
	FLAG_BROADCAST_CODE_RECEIVED,
	FLAG_BROADCAST_SYNCABLE,
	FLAG_BROADCAST_SYNCING,
	FLAG_BROADCAST_SYNCED,
	FLAG_BASE_RECEIVED,
	FLAG_PA_SYNCING,
	FLAG_PA_SYNCED,
	FLAG_SCANNING,
	FLAG_NUM,
};
ATOMIC_DEFINE(flags, FLAG_NUM);

static struct broadcast_sink {
	struct bt_cap_stream broadcast_streams[CONFIG_BT_BAP_BROADCAST_SNK_STREAM_COUNT];
	const struct bt_bap_scan_delegator_recv_state *req_recv_state;
	uint8_t sink_broadcast_code[BT_ISO_BROADCAST_CODE_SIZE];
	struct bt_bap_broadcast_sink *bap_broadcast_sink;
	struct bt_le_per_adv_sync *pa_sync;
	uint8_t received_base[UINT8_MAX];
	uint32_t requested_bis_sync;
	uint32_t broadcast_id;
} broadcast_sink;

uint64_t total_broadcast_rx_iso_packet_count; /* This value is exposed to test code */

/** Starts scanning if it passes a series of check to determine if we are in the right state */
static int check_start_scan(void)
{
	int err;

	if (atomic_test_bit(flags, FLAG_SCANNING)) {
		return -EALREADY;
	}

	if (atomic_test_bit(flags, FLAG_PA_SYNCED)) {
		return -EALREADY;
	}

	if (atomic_test_bit(flags, FLAG_BROADCAST_SYNCED)) {
		return -EALREADY;
	}

	err = bt_le_scan_start(BT_LE_SCAN_ACTIVE, NULL);
	if (err != 0) {
		LOG_ERR("Unable to start scan for CAP initiators: %d", err);

		return err;
	}

	atomic_set_bit(flags, FLAG_SCANNING);

	return 0;
}

static void broadcast_stream_started_cb(struct bt_bap_stream *bap_stream)
{
	LOG_INF("Started bap_stream %p", bap_stream);

	atomic_clear_bit(flags, FLAG_BROADCAST_SYNCING);
	atomic_set_bit(flags, FLAG_BROADCAST_SYNCED);
}

static void broadcast_stream_stopped_cb(struct bt_bap_stream *bap_stream, uint8_t reason)
{
	LOG_INF("Stopped bap_stream %p with reason 0x%02X", bap_stream, reason);

	atomic_clear_bit(flags, FLAG_BROADCAST_SYNCING);
	atomic_clear_bit(flags, FLAG_BROADCAST_SYNCED);

	if (IS_ENABLED(CONFIG_SAMPLE_SCAN_SELF)) {
		(void)check_start_scan();
	}
}

static void broadcast_stream_recv_cb(struct bt_bap_stream *bap_stream,
				     const struct bt_iso_recv_info *info, struct net_buf *buf)
{
	ARG_UNUSED(bap_stream);
	ARG_UNUSED(info);
	ARG_UNUSED(buf);

	/* Triggered every time we receive an HCI data packet from the controller.
	 * A call to this does not indicate valid data
	 * (see the `info->flags` for which flags to check),
	 */

	if ((total_broadcast_rx_iso_packet_count % 100U) == 0U) {
		LOG_INF("Received %llu HCI ISO data packets", total_broadcast_rx_iso_packet_count);
	}

	total_broadcast_rx_iso_packet_count++;
}

static int create_broadcast_sink(void)
{
	int err;

	if (broadcast_sink.bap_broadcast_sink != NULL) {
		return -EALREADY;
	}

	LOG_INF("Creating broadcast sink for broadcast ID 0x%06X", broadcast_sink.broadcast_id);

	err = bt_bap_broadcast_sink_create(broadcast_sink.pa_sync, broadcast_sink.broadcast_id,
					   &broadcast_sink.bap_broadcast_sink);
	if (err != 0) {
		LOG_ERR("Failed to create broadcast sink: %d\n", err);

		return err;
	}

	return 0;
}

/** Performs a series of checks to see if we are ready to sync the broadcast sink */
static void check_sync_broadcast(void)
{
	struct bt_bap_stream *sync_streams[ARRAY_SIZE(broadcast_sink.broadcast_streams)];
	uint32_t sync_bitfield;
	int err;

	if (!atomic_test_bit(flags, FLAG_BASE_RECEIVED)) {
		LOG_DBG("FLAG_BASE_RECEIVED");
		return;
	}

	if (!atomic_test_bit(flags, FLAG_BROADCAST_SYNCABLE)) {
		LOG_DBG("FLAG_BROADCAST_SYNCABLE");
		return;
	}

	if (atomic_test_bit(flags, FLAG_BROADCAST_CODE_REQUIRED) &&
	    !atomic_test_bit(flags, FLAG_BROADCAST_CODE_RECEIVED)) {
		LOG_DBG("FLAG_BROADCAST_CODE_REQUIRED");
		return;
	}

	if (!atomic_test_bit(flags, FLAG_BROADCAST_SYNC_REQUESTED)) {
		LOG_DBG("FLAG_BROADCAST_SYNC_REQUESTED");
		return;
	}

	if (!atomic_test_bit(flags, FLAG_PA_SYNCED)) {
		LOG_DBG("FLAG_PA_SYNCED");
		return;
	}

	if (atomic_test_bit(flags, FLAG_BROADCAST_SYNCED) ||
	    atomic_test_bit(flags, FLAG_BROADCAST_SYNCING)) {
		LOG_DBG("FLAG_BROADCAST_SYNCED");
		return;
	}

	if (broadcast_sink.requested_bis_sync == BT_BAP_BIS_SYNC_NO_PREF) {
		uint32_t base_bis;

		/* Get the first BIS index from the BASE */
		err = bt_bap_base_get_bis_indexes(
			(struct bt_bap_base *)broadcast_sink.received_base, &base_bis);
		if (err != 0) {
			LOG_ERR("Failed to get BIS indexes from BASE: %d", err);

			return;
		}

		sync_bitfield = 0U;
		for (uint8_t i = BT_ISO_BIS_INDEX_MIN; i < BT_ISO_BIS_INDEX_MAX; i++) {
			if (base_bis & BT_ISO_BIS_INDEX_BIT(i)) {
				sync_bitfield = BT_ISO_BIS_INDEX_BIT(i);

				break;
			}
		}
	} else {
		sync_bitfield = broadcast_sink.requested_bis_sync;
	}

	LOG_INF("Syncing to broadcast with bitfield 0x%08X", sync_bitfield);

	ARRAY_FOR_EACH(broadcast_sink.broadcast_streams, i) {
		sync_streams[i] = &broadcast_sink.broadcast_streams[i].bap_stream;
	}

	/* Sync the BIG */
	err = bt_bap_broadcast_sink_sync(broadcast_sink.bap_broadcast_sink, sync_bitfield,
					 sync_streams, broadcast_sink.sink_broadcast_code);
	if (err != 0) {
		LOG_ERR("Failed to sync the broadcast sink: %d", err);
	} else {
		atomic_set_bit(flags, FLAG_BROADCAST_SYNCING);
	}
}

static void base_recv_cb(struct bt_bap_broadcast_sink *sink, const struct bt_bap_base *base,
			 size_t base_size)
{
	ARG_UNUSED(sink);

	memcpy(broadcast_sink.received_base, base, base_size);

	if (!atomic_test_and_set_bit(flags, FLAG_BASE_RECEIVED)) {
		LOG_INF("BASE received");

		check_sync_broadcast();
	}
}

static void syncable_cb(struct bt_bap_broadcast_sink *sink, const struct bt_iso_biginfo *biginfo)
{
	ARG_UNUSED(sink);

	if (!biginfo->encryption) {
		atomic_clear_bit(flags, FLAG_BROADCAST_CODE_REQUIRED);
	} else {
		atomic_set_bit(flags, FLAG_BROADCAST_CODE_REQUIRED);
	}

	if (!atomic_test_and_set_bit(flags, FLAG_BROADCAST_SYNCABLE)) {
		LOG_INF("BIGInfo received");

		check_sync_broadcast();
	}
}

static void sink_started_cb(struct bt_bap_broadcast_sink *sink)
{
	ARG_UNUSED(sink);

	LOG_INF("Broadcast sink started");

	/* Clear requested BIS sync */
	broadcast_sink.requested_bis_sync = 0U;
	atomic_clear_bit(flags, FLAG_BROADCAST_SYNC_REQUESTED);
}

static void sink_stopped_cb(struct bt_bap_broadcast_sink *sink, uint8_t reason)
{
	int err;

	LOG_INF("Broadcast sink stopped with reason 0x%02X", reason);

	err = bt_bap_broadcast_sink_delete(sink);
	if (err != 0) {
		LOG_ERR("Failed to delete Broadcast Sink: %d", err);
	} else {
		broadcast_sink.bap_broadcast_sink = NULL;
	}
}

static void pa_timer_handler(struct k_work *work)
{
	ARG_UNUSED(work);

	atomic_clear_bit(flags, FLAG_PA_SYNCING);

	if (broadcast_sink.pa_sync != NULL) {
		int err;

		err = bt_le_per_adv_sync_delete(broadcast_sink.pa_sync);
		if (err != 0) {
			LOG_ERR("Failed to delete PA sync: %d", err);
		}
	}

	if (broadcast_sink.req_recv_state != NULL) {
		enum bt_bap_pa_state pa_state;
		int err;

		if (broadcast_sink.req_recv_state->pa_sync_state == BT_BAP_PA_STATE_INFO_REQ) {
			pa_state = BT_BAP_PA_STATE_NO_PAST;
		} else {
			pa_state = BT_BAP_PA_STATE_FAILED;
		}

		err = bt_bap_scan_delegator_set_pa_state(broadcast_sink.req_recv_state->src_id,
							 pa_state);
		if (err != 0) {
			LOG_ERR("Failed to set PA state: %d", err);
		}
	}

	LOG_INF("PA sync timeout");
}

static K_WORK_DELAYABLE_DEFINE(pa_timer, pa_timer_handler);

static uint16_t interval_to_sync_timeout(uint16_t pa_interval)
{
	uint16_t pa_timeout;

	if (pa_interval == BT_BAP_PA_INTERVAL_UNKNOWN) {
		/* Use maximum value to maximize chance of success */
		pa_timeout = BT_GAP_PER_ADV_MAX_TIMEOUT;
	} else {
		uint32_t interval_us;
		uint32_t timeout;

		/* Add retries and convert to unit in 10's of ms */
		interval_us = BT_GAP_PER_ADV_INTERVAL_TO_US(pa_interval);
		timeout = BT_GAP_US_TO_PER_ADV_SYNC_TIMEOUT(interval_us) *
			  PA_SYNC_INTERVAL_TO_TIMEOUT_RATIO;

		/* Enforce restraints */
		pa_timeout = CLAMP(timeout, BT_GAP_PER_ADV_MIN_TIMEOUT, BT_GAP_PER_ADV_MAX_TIMEOUT);
	}

	return pa_timeout;
}

static int pa_sync_with_past(struct bt_conn *conn,
			     const struct bt_bap_scan_delegator_recv_state *recv_state,
			     uint16_t pa_interval)
{
	struct bt_le_per_adv_sync_transfer_param param = {0};
	int err;

	param.skip = PA_SYNC_SKIP;
	param.timeout = interval_to_sync_timeout(pa_interval);

	err = bt_le_per_adv_sync_transfer_subscribe(conn, &param);
	if (err != 0) {
		LOG_ERR("Could not do PAST subscribe: %d", err);

		return err;
	}

	err = bt_bap_scan_delegator_set_pa_state(recv_state->src_id, BT_BAP_PA_STATE_INFO_REQ);
	if (err != 0) {
		LOG_ERR("Failed to set PA state to BT_BAP_PA_STATE_INFO_REQ: %d", err);

		return err;
	}

	k_work_reschedule(&pa_timer, K_MSEC(param.timeout * 10));

	return 0;
}

static int pa_sync_without_past(const bt_addr_le_t *addr, uint8_t adv_sid, uint16_t pa_interval)
{
	struct bt_le_per_adv_sync_param param = {0};
	struct bt_le_local_features feature;
	int err;

	err = bt_le_get_local_features(&feature);
	if (err != 0) {
		LOG_ERR("Failed to get local features: %d", err);
		return err;
	}

	bt_addr_le_copy(&param.addr, addr);
	if (BT_FEAT_LE_PER_ADV_ADI_SUPP(feature.features)) {
		param.options = BT_LE_PER_ADV_SYNC_OPT_FILTER_DUPLICATE;
	} else {
		param.options = BT_LE_PER_ADV_SYNC_OPT_NONE;
	}
	param.sid = adv_sid;
	param.skip = PA_SYNC_SKIP;
	param.timeout = interval_to_sync_timeout(pa_interval);

	err = bt_le_per_adv_sync_create(&param, &broadcast_sink.pa_sync);
	if (err != 0) {
		LOG_ERR("Failed to create PA sync: %d", err);

		return err;
	}

	k_work_reschedule(&pa_timer, K_MSEC(param.timeout * 10));

	return 0;
}

static int pa_sync_req_cb(struct bt_conn *conn,
			  const struct bt_bap_scan_delegator_recv_state *recv_state,
			  bool past_avail, uint16_t pa_interval)
{

	LOG_INF("Received request to sync to PA (PAST %savailble): %u", past_avail ? "" : "not ",
		recv_state->pa_sync_state);

	broadcast_sink.req_recv_state = recv_state;

	if (recv_state->pa_sync_state == BT_BAP_PA_STATE_SYNCED ||
	    recv_state->pa_sync_state == BT_BAP_PA_STATE_INFO_REQ ||
	    broadcast_sink.pa_sync != NULL) {
		/* Already syncing */
		LOG_WRN("Rejecting PA sync request because we are already syncing or synced");

		return -EALREADY;
	}

	if (IS_ENABLED(CONFIG_BT_PER_ADV_SYNC_TRANSFER_RECEIVER) && past_avail) {
		int err;

		err = pa_sync_with_past(conn, recv_state, pa_interval);
		if (err != 0) {
			return err;
		}

		LOG_INF("Syncing with PAST");
	} else {
		int err;

		err = pa_sync_without_past(&recv_state->addr, recv_state->adv_sid, pa_interval);
		if (err != 0) {
			return err;
		}

		LOG_INF("Syncing without PAST");
	}

	broadcast_sink.broadcast_id = recv_state->broadcast_id;
	atomic_set_bit(flags, FLAG_PA_SYNCING);

	return 0;
}

static int pa_sync_term_req_cb(struct bt_conn *conn,
			       const struct bt_bap_scan_delegator_recv_state *recv_state)
{
	int err;

	ARG_UNUSED(conn);

	broadcast_sink.req_recv_state = recv_state;

	err = bt_le_per_adv_sync_delete(broadcast_sink.pa_sync);
	if (err != 0) {
		LOG_ERR("Failed to delete PA sync: %d", err);

		return err;
	}

	k_work_cancel_delayable(&pa_timer);
	broadcast_sink.pa_sync = NULL;

	return 0;
}

static void broadcast_code_cb(struct bt_conn *conn,
			      const struct bt_bap_scan_delegator_recv_state *recv_state,
			      const uint8_t broadcast_code[BT_ISO_BROADCAST_CODE_SIZE])
{
	ARG_UNUSED(conn);

	LOG_INF("Broadcast code received for %p", recv_state);

	broadcast_sink.req_recv_state = recv_state;

	(void)memcpy(broadcast_sink.sink_broadcast_code, broadcast_code,
		     BT_ISO_BROADCAST_CODE_SIZE);

	atomic_set_bit(flags, FLAG_BROADCAST_CODE_RECEIVED);
}

static uint32_t get_req_bis_sync(const uint32_t bis_sync_req[CONFIG_BT_BAP_BASS_MAX_SUBGROUPS])
{
	uint32_t bis_sync = 0U;

	for (int i = 0; i < CONFIG_BT_BAP_BASS_MAX_SUBGROUPS; i++) {
		bis_sync |= bis_sync_req[i];
	}

	return bis_sync;
}

static int bis_sync_req_cb(struct bt_conn *conn,
			   const struct bt_bap_scan_delegator_recv_state *recv_state,
			   const uint32_t bis_sync_req[CONFIG_BT_BAP_BASS_MAX_SUBGROUPS])
{
	const uint32_t new_bis_sync_req = get_req_bis_sync(bis_sync_req);

	ARG_UNUSED(conn);

	LOG_INF("BIS sync request received for %p: 0x%08x", recv_state, bis_sync_req[0]);

	if (new_bis_sync_req != BT_BAP_BIS_SYNC_NO_PREF &&
	    sys_count_bits(&new_bis_sync_req, sizeof(new_bis_sync_req)) >
		    CONFIG_BT_BAP_BROADCAST_SNK_STREAM_COUNT) {
		LOG_WRN("Rejecting BIS sync request for 0x%08X as we do not support that "
			"(max %d streams)",
			new_bis_sync_req, CONFIG_BT_BAP_BROADCAST_SNK_STREAM_COUNT);

		return -ENOMEM;
	}

	if (atomic_test_bit(flags, FLAG_BROADCAST_SYNC_REQUESTED) &&
	    broadcast_sink.requested_bis_sync == new_bis_sync_req) {
		LOG_INF("New request (0x%08x) is the same as last request; ignoring",
			new_bis_sync_req);
		return 0; /* no op */
	}

	if (atomic_test_bit(flags, FLAG_BROADCAST_SYNCED)) {
		/* If the BIS sync request is received while we are already
		 * synced, it means that the requested BIS sync has changed.
		 */
		int err;

		LOG_INF("Already synced. Stopping current sync and attempt resyncing");

		/* The stream stopped callback will be called as part of this,
		 * and we do not need to wait for any events from the
		 * controller. Thus, when this returns, the broadcast sink is stopped
		 */
		err = bt_bap_broadcast_sink_stop(broadcast_sink.bap_broadcast_sink);
		if (err != 0) {
			LOG_ERR("Failed to stop Broadcast Sink: %d", err);

			return err;
		}

		/* Broadcast sink will be deleted and set to NULL in `sink_stopped_cb` */

		atomic_clear_bit(flags, FLAG_BROADCAST_SYNCED);
	}

	broadcast_sink.requested_bis_sync = new_bis_sync_req;
	if (broadcast_sink.requested_bis_sync != 0U) {
		atomic_set_bit(flags, FLAG_BROADCAST_SYNC_REQUESTED);
		check_sync_broadcast();
	}

	return 0;
}

static void bap_pa_sync_synced_cb(struct bt_le_per_adv_sync *sync,
				  struct bt_le_per_adv_sync_synced_info *info)
{
	if (sync == broadcast_sink.pa_sync ||
	    (broadcast_sink.req_recv_state != NULL &&
	     bt_addr_le_eq(info->addr, &broadcast_sink.req_recv_state->addr) &&
	     info->sid == broadcast_sink.req_recv_state->adv_sid)) {
		int err;

		LOG_INF("PA sync %p synced for broadcast sink", (void *)sync);

		if (broadcast_sink.pa_sync == NULL) {
			broadcast_sink.pa_sync = sync;
		}

		k_work_cancel_delayable(&pa_timer);
		atomic_set_bit(flags, FLAG_PA_SYNCED);
		atomic_clear_bit(flags, FLAG_PA_SYNCING);

		if (IS_ENABLED(CONFIG_SAMPLE_SCAN_SELF)) {

			err = bt_le_scan_stop();
			if (err != 0) {
				LOG_ERR("Unable to stop scanning: %d", err);
			} else {
				atomic_clear_bit(flags, FLAG_SCANNING);
			}
		}

		err = create_broadcast_sink();
		if (err != 0) {
			LOG_ERR("Failed to create broadcast sink: %d", err);
		} else {
			check_sync_broadcast();
		}
	}
}

static void bap_pa_sync_terminated_cb(struct bt_le_per_adv_sync *sync,
				      const struct bt_le_per_adv_sync_term_info *info)
{
	if (sync == broadcast_sink.pa_sync) {
		int err;

		LOG_INF("PA sync %p lost with reason 0x%02X", (void *)sync, info->reason);

		/* Without PA we cannot sync to any new BIG - Clear data */
		broadcast_sink.pa_sync = NULL;
		k_work_cancel_delayable(&pa_timer);
		atomic_clear_bit(flags, FLAG_BROADCAST_SYNCABLE);
		atomic_clear_bit(flags, FLAG_PA_SYNCED);
		atomic_clear_bit(flags, FLAG_PA_SYNCING);
		atomic_clear_bit(flags, FLAG_BASE_RECEIVED);
		atomic_clear_bit(flags, FLAG_BROADCAST_CODE_REQUIRED);
		atomic_clear_bit(flags, FLAG_BROADCAST_CODE_RECEIVED);
		atomic_clear_bit(flags, FLAG_BROADCAST_SYNC_REQUESTED);

		err = bt_bap_scan_delegator_set_pa_state(broadcast_sink.req_recv_state->src_id,
							 BT_BAP_PA_STATE_NOT_SYNCED);
		if (err != 0) {
			LOG_ERR("Failed to set PA state to BT_BAP_PA_STATE_NOT_SYNCED: %d", err);
		}

		if (IS_ENABLED(CONFIG_SAMPLE_SCAN_SELF)) {
			(void)check_start_scan();
		}
	}
}
static bool scan_check_and_sync_broadcast(struct bt_data *data, void *user_data)
{
	const struct bt_le_scan_recv_info *info = user_data;
	struct bt_le_per_adv_sync_param param = {0};
	struct bt_le_local_features feature;
	struct bt_uuid_16 adv_uuid;
	uint32_t broadcast_id;
	int err;

	if (data->type != BT_DATA_SVC_DATA16) {
		return true;
	}

	if (data->data_len < BT_UUID_SIZE_16 + BT_AUDIO_BROADCAST_ID_SIZE) {
		return true;
	}

	if (!bt_uuid_create(&adv_uuid.uuid, data->data, BT_UUID_SIZE_16)) {
		return true;
	}

	if (bt_uuid_cmp(&adv_uuid.uuid, BT_UUID_BROADCAST_AUDIO)) {
		return true;
	}

	broadcast_id = sys_get_le24(data->data + BT_UUID_SIZE_16);

	LOG_INF("Found broadcaster with ID 0x%06X and addr %s and sid 0x%02X\n", broadcast_id,
		bt_addr_le_str(info->addr), info->sid);

	err = bt_le_get_local_features(&feature);
	if (err != 0) {
		LOG_ERR("Failed to get local features: %d", err);
		return false;
	}

	bt_addr_le_copy(&param.addr, info->addr);
	if (BT_FEAT_LE_PER_ADV_ADI_SUPP(feature.features)) {
		param.options = BT_LE_PER_ADV_SYNC_OPT_FILTER_DUPLICATE;
	} else {
		param.options = BT_LE_PER_ADV_SYNC_OPT_NONE;
	}
	param.sid = info->sid;
	param.skip = PA_SYNC_SKIP;
	param.timeout = interval_to_sync_timeout(info->interval);

	err = bt_le_per_adv_sync_create(&param, &broadcast_sink.pa_sync);
	if (err != 0) {
		LOG_ERR("Failed to create PA sync: %d", err);
	} else {
		LOG_INF("Syncing without PAST from scan");

		broadcast_sink.broadcast_id = broadcast_id;
		atomic_set_bit(flags, FLAG_PA_SYNCING);
		k_work_reschedule(&pa_timer, K_MSEC(param.timeout * 10));

		/* Since we are scanning ourselves, we consider this as broadcast sync has been
		 * requested
		 */
		broadcast_sink.requested_bis_sync = BT_BAP_BIS_SYNC_NO_PREF;
		atomic_set_bit(flags, FLAG_BROADCAST_SYNC_REQUESTED);
	}

	/* Stop parsing */
	return false;
}

static bool is_substring(const char *substr, const char *str)
{
	const size_t str_len = strlen(str);
	const size_t sub_str_len = strlen(substr);

	if (sub_str_len > str_len) {
		return false;
	}

	for (size_t pos = 0U; pos < str_len; pos++) {
		if (pos + sub_str_len > str_len) {
			return false;
		}

		if (strncasecmp(substr, &str[pos], sub_str_len) == 0) {
			return true;
		}
	}

	return false;
}

static bool data_cb(struct bt_data *data, void *user_data)
{
	char *name = user_data;

	switch (data->type) {
	case BT_DATA_NAME_SHORTENED:
	case BT_DATA_NAME_COMPLETE:
	case BT_DATA_BROADCAST_NAME:
		memcpy(name, data->data, MIN(data->data_len, NAME_LEN - 1));
		return false;
	default:
		return true;
	}
}

static void broadcast_scan_recv(const struct bt_le_scan_recv_info *info, struct net_buf_simple *ad)
{
	if (atomic_test_bit(flags, FLAG_PA_SYNCED) || atomic_test_bit(flags, FLAG_PA_SYNCING) ||
	    atomic_test_bit(flags, FLAG_BROADCAST_SYNCED) ||
	    atomic_test_bit(flags, FLAG_BROADCAST_SYNCING)) {
		/* If we are already synced or syncing, we do not care about scan reports */
		return;
	}

	/* Only consider advertisers with periodic advertising */
	if (info->interval != 0U) {
		/* call to bt_data_parse consumes netbufs so shallow clone for verbose output */

		/* If broadcast_sink.req_recv_state is NULL then we have been requested by a
		 * broadcast assistant to sync to a specific broadcast source. In that case we do
		 * not apply our own broadcast name filter.
		 */
		if (broadcast_sink.req_recv_state != NULL &&
		    strlen(CONFIG_SAMPLE_TARGET_BROADCAST_NAME) > 0U) {
			struct net_buf_simple buf_copy;
			char name[NAME_LEN] = {0};

			net_buf_simple_clone(ad, &buf_copy);
			bt_data_parse(&buf_copy, data_cb, name);
			if (!(is_substring(CONFIG_SAMPLE_TARGET_BROADCAST_NAME, name))) {
				return;
			}
		}
		bt_data_parse(ad, scan_check_and_sync_broadcast, (void *)info);
	}
}

int init_cap_acceptor_broadcast(void)
{
	static bool cbs_registered;
	int err;

	if (!cbs_registered) {
		static struct bt_bap_scan_delegator_cb scan_delegator_cbs = {
			.pa_sync_req = pa_sync_req_cb,
			.pa_sync_term_req = pa_sync_term_req_cb,
			.broadcast_code = broadcast_code_cb,
			.bis_sync_req = bis_sync_req_cb,
		};
		static struct bt_bap_broadcast_sink_cb broadcast_sink_cbs = {
			.base_recv = base_recv_cb,
			.syncable = syncable_cb,
			.started = sink_started_cb,
			.stopped = sink_stopped_cb,
		};
		static struct bt_bap_stream_ops broadcast_stream_ops = {
			.started = broadcast_stream_started_cb,
			.stopped = broadcast_stream_stopped_cb,
			.recv = broadcast_stream_recv_cb,
		};
		static struct bt_le_per_adv_sync_cb bap_pa_sync_cb = {
			.synced = bap_pa_sync_synced_cb,
			.term = bap_pa_sync_terminated_cb,
		};
		static struct bt_le_scan_cb bap_scan_cb = {
			.recv = broadcast_scan_recv,
		};

		err = bt_bap_scan_delegator_register(&scan_delegator_cbs);
		if (err != 0) {
			LOG_ERR("Scan delegator register failed (err %d)", err);

			return err;
		}

		err = bt_bap_broadcast_sink_register_cb(&broadcast_sink_cbs);
		if (err != 0) {
			LOG_ERR("Failed to register BAP broadcast sink callbacks: %d", err);

			return -ENOEXEC;
		}

		ARRAY_FOR_EACH_PTR(broadcast_sink.broadcast_streams, stream) {
			bt_cap_stream_ops_register(stream, &broadcast_stream_ops);
		}

		bt_le_per_adv_sync_cb_register(&bap_pa_sync_cb);

		if (IS_ENABLED(CONFIG_SAMPLE_SCAN_SELF)) {
			bt_le_scan_cb_register(&bap_scan_cb);
		}

		cbs_registered = true;
	}

	if (IS_ENABLED(CONFIG_SAMPLE_SCAN_SELF)) {
		err = check_start_scan();
		if (err != 0) {
			LOG_ERR("Unable to start scan for CAP initiators: %d", err);

			return err;
		}
	}

	return 0;
}
```
