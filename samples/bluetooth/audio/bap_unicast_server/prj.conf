## CMakeLists.txt
```
# SPDX-License-Identifier: Apache-2.0

cmake_minimum_required(VERSION 3.28.0)
find_package(Zephyr REQUIRED HINTS $ENV{ZEPHYR_BASE})
project(bap_unicast_server)

target_sources(app PRIVATE
  src/main.c
)

zephyr_sources_ifdef(CONFIG_LIBLC3 src/stream_lc3.c)
zephyr_sources_ifdef(CONFIG_LIBLC3 src/le_audio_playback.c)

zephyr_sources_ifdef(CONFIG_BT_AUDIO_TX src/stream_tx.c)

zephyr_library_include_directories(${ZEPHYR_BASE}/samples/bluetooth)
```

## Kconfig
```
# Copyright (c) 2025 Nordic Semiconductor ASA
# SPDX-License-Identifier: Apache-2.0

# LC3 decode plus audio_codec bring-up push main and sysworkq past their
# defaults. Declared before Kconfig.zephyr so our defaults are searched
# ahead of kernel/Kconfig's defaults.
if LIBLC3

config MAIN_STACK_SIZE
	default 4096

config SYSTEM_WORKQUEUE_STACK_SIZE
	default 4096

endif # LIBLC3

mainmenu "Bluetooth: BAP Unicast Server"

config INFO_REPORTING_INTERVAL
	int "Number of SDUs received between each information report"
	default 1000
	help
	  Determines how often information about received data is logged.
	  Set to 0 to disable reporting.

menu "Audio playback"
	depends on LIBLC3 && I2S && AUDIO_CODEC

config BAP_UNICAST_SERVER_I2S_WORKER_STACK_SIZE
	int "I2S worker thread stack size"
	default 4096
	help
	  Stack size of the thread that copies decoded PCM blocks into the
	  I2S TX mem_slab. Must accommodate the codec driver's write path;
	  4096 B is safe for the NXP SAI + WM8962 combination.

config BAP_UNICAST_SERVER_I2S_WORKER_PRIORITY
	int "I2S worker thread priority (cooperative)"
	default 5
	help
	  Cooperative priority of the I2S worker thread. Lower values run
	  ahead of BAP RX and may starve the host stack; higher values
	  increase the risk of underruns on marginal DMA timing.

config BAP_UNICAST_SERVER_I2S_DMA_BLOCK_COUNT
	int "I2S TX DMA block count"
	default 4
	range 2 16
	help
	  Number of decoded PCM blocks the SAI/DMA can hold. Each block is
	  one SDU worth of audio (up to ~1920 B for 48 kHz / 10 ms stereo).
	  Increase for looser DMA timing, decrease to shorten pause/resume
	  latency.

config BAP_UNICAST_SERVER_PCM_QUEUE_DEPTH
	int "Decode to I2S handoff queue depth"
	default 8
	range 2 32
	help
	  Number of decoded PCM blocks buffered between the BAP RX context
	  and the I2S worker. Larger values absorb SDU jitter; smaller
	  values reduce audio latency.

endmenu

source "Kconfig.zephyr"
```

## sample.yaml
```
sample:
  description: Bluetooth Low Energy Audio Unicast Server sample
  name: Bluetooth Low Energy Audio Unicast Server sample
tests:
  sample.bluetooth.audio.unicast_server:
    harness: bluetooth
    platform_allow:
      - qemu_cortex_m3
      - qemu_x86
      - nrf5340bsim/nrf5340/cpuapp
      - nrf5340dk/nrf5340/cpuapp
      - native_sim
    tags: bluetooth
    integration_platforms:
      - nrf5340dk/nrf5340/cpuapp
    sysbuild: true
  sample.bluetooth.audio.unicast_server.bt_ll_sw_split:
    harness: bluetooth
    platform_allow:
      - nrf52_bsim
      - nrf52dk/nrf52832
      - nrf52840dk/nrf52840
    integration_platforms:
      - nrf52dk/nrf52832
    extra_args: EXTRA_CONF_FILE=overlay-bt_ll_sw_split.conf
    tags: bluetooth
```

## prj.conf
```kconfig
CONFIG_BT=y
CONFIG_LOG=y
CONFIG_BT_SMP=y
CONFIG_BT_PERIPHERAL=y
CONFIG_BT_GAP_AUTO_UPDATE_CONN_PARAMS=n
# Set preferred values based on BT_BAP_CONN_PARAM_RELAXED
CONFIG_BT_PERIPHERAL_PREF_MIN_INT=50
CONFIG_BT_PERIPHERAL_PREF_MAX_INT=70
CONFIG_BT_PERIPHERAL_PREF_LATENCY=0
CONFIG_BT_PERIPHERAL_PREF_TIMEOUT=400
CONFIG_BT_ISO_PERIPHERAL=y
CONFIG_UTF8=y
CONFIG_BT_AUDIO=y
CONFIG_BT_GATT_DYNAMIC_DB=y
CONFIG_BT_BAP_UNICAST_SERVER=y
CONFIG_BT_ASCS=y
CONFIG_BT_PAC_SNK=y
CONFIG_BT_ASCS_MAX_ASE_SNK_COUNT=2
CONFIG_BT_PAC_SRC=y
CONFIG_BT_ASCS_MAX_ASE_SRC_COUNT=1
CONFIG_BT_ISO_TX_BUF_COUNT=2
# Support an ISO channel per ASE
CONFIG_BT_ISO_MAX_CHAN=4

CONFIG_BT_AUDIO_CODEC_CFG_MAX_METADATA_SIZE=10

# Mandatory to support at least 2 for ASCS used for Config Codec for 3 ASE at once
CONFIG_BT_ATT_PREPARE_COUNT=2

CONFIG_BT_EXT_ADV=y
CONFIG_BT_DEVICE_NAME="Unicast Audio Server"

CONFIG_BT_BUF_SYNC_EVT_POOL_COUNT=4
```

## overlay-bt_ll_sw_split.conf
```kconfig
# Zephyr Bluetooth Controller needs 3 Tx Buffers enqueued as the Number of Completed Packets event
# is returned one ISO interval later, i.e. the PDU flush is checked at the prepare of radio events.
CONFIG_BT_ISO_TX_BUF_COUNT=3

# Zephyr Bluetooth Controller
CONFIG_BT_LL_SW_SPLIT=y

# Zephyr Controller tested maximum advertising data that can be set in a single HCI command
CONFIG_BT_CTLR_ADV_DATA_LEN_MAX=191

# Number of supported streams
CONFIG_BT_CTLR_ISOAL_SOURCES=1
CONFIG_BT_CTLR_ISOAL_SINKS=2

# Number of ISO Tx Buffers
CONFIG_BT_CTLR_ISO_TX_BUFFERS=3

# Support the highest SDU size required by any BAP LC3 presets (155) + 8 bytes of HCI ISO Data
# packet overhead (the Packet_Sequence_Number, ISO_SDU_Length, Packet_Status_Flag fields; and
# the optional Time_Stamp field, if supplied)
CONFIG_BT_CTLR_ISO_TX_BUFFER_SIZE=163
CONFIG_BT_CTLR_ISO_TX_SDU_LEN_MAX=155
```

## boards/esp32s31_function_coreboard_esp32s31_hpcore.conf
```kconfig
# For LC3 the following configs are needed
CONFIG_FPU=y
CONFIG_FPU_SHARING=y
CONFIG_LIBLC3=y
# The LC3 codec uses a large amount of stack. This app runs the codec in the BT RX thread, hence
# increase stack size for that thread.
CONFIG_BT_RX_STACK_SIZE=4096
```

## boards/mimxrt1060_evk_mimxrt1062_qspi_C.conf
```kconfig
# SPDX-FileCopyrightText: Copyright The Zephyr Project Contributors
# SPDX-License-Identifier: Apache-2.0

# Enable I2S based audio playback path.
CONFIG_I2S=y
CONFIG_LIBLC3=y
CONFIG_AUDIO=y
CONFIG_AUDIO_CODEC=y

# LE Audio RX needs more ISO buffering and heap than the defaults.
CONFIG_BT_RX_STACK_SIZE=4096
CONFIG_MAIN_STACK_SIZE=4096
CONFIG_HEAP_MEM_POOL_SIZE=65536

# LE Audio unicast RX at 100 Hz (10 ms SDUs) plus the source ASE TX and CIS
# open/close needs more HCI RX headroom than the Kconfig defaults; otherwise
# the H:4 driver keeps deferring packets to bt_rx_thread ("Failed to allocate,
# deferring to rx_thread") and playback stalls. These are the proven values
# from the tmap_peripheral sample, which runs the same bidirectional workload.
CONFIG_BT_ISO_RX_BUF_COUNT=12
CONFIG_BT_BUF_ACL_RX_COUNT_EXTRA=6
CONFIG_BT_BUF_EVT_RX_COUNT=16

# Sink-only (unidirectional) topology: this build only plays audio out to the
# I2S/codec, it never captures audio to send back. Disable the Source PAC and
# zero the source ASE count so the server advertises only sink capabilities.
# The client's discover_sources() step then returns "no source ASEs" and it
# will only bring up sink CIS(es), avoiding the 3-CIS bidirectional ISO load
# that the controller cannot sustain on this platform (manifested as
# "Failed to allocate, deferring to rx_thread" cascades and eventual stall).
CONFIG_BT_PAC_SRC=n
CONFIG_BT_ASCS_MAX_ASE_SRC_COUNT=0

# Align host TX buffer counts with the controller so the host can keep the
# controller's TX pipeline full and does not throttle the bidirectional ISO
# path. The controller reports 8 ACL and 15 ISO TX packets on this platform;
# match them here. Mismatch shows up as the boot-time warnings:
#   "Num of Controller's ACL packets != ACL bt_conn_tx contexts"
#   "Num of Controller's ISO packets != ISO bt_conn_tx contexts"
CONFIG_BT_BUF_ACL_TX_COUNT=8
CONFIG_BT_ISO_TX_BUF_COUNT=15

# Silence the periodic "Incoming audio on stream ..." INFO printk emitted from
# stream_recv_lc3_codec(). A synchronous printk on the BT RX thread at the
# ISO cadence can starve the HCI RX pool and cause audible glitches; there is
# no runtime need for the heartbeat log now that the pipeline is stable.
CONFIG_INFO_REPORTING_INTERVAL=0
```

## src/main.c
```c
/*
 * Copyright (c) 2021-2025 Nordic Semiconductor ASA
 *
 * SPDX-License-Identifier: Apache-2.0
 */

#include <errno.h>
#include <stdbool.h>
#include <stddef.h>
#include <stdint.h>

#include <zephyr/autoconf.h>
#include <zephyr/bluetooth/addr.h>
#include <zephyr/bluetooth/assigned_numbers.h>
#include <zephyr/bluetooth/audio/ascs.h>
#include <zephyr/bluetooth/audio/audio.h>
#include <zephyr/bluetooth/audio/bap.h>
#include <zephyr/bluetooth/audio/lc3.h>
#include <zephyr/bluetooth/audio/pacs.h>
#include <zephyr/bluetooth/bluetooth.h>
#include <zephyr/bluetooth/byteorder.h>
#include <zephyr/bluetooth/conn.h>
#include <zephyr/bluetooth/gap.h>
#include <zephyr/bluetooth/hci.h>
#include <zephyr/bluetooth/hci_types.h>
#include <zephyr/bluetooth/iso.h>
#include <zephyr/bluetooth/uuid.h>
#include <zephyr/kernel.h>
#include <zephyr/net_buf.h>
#include <zephyr/sys/__assert.h>
#include <zephyr/sys/byteorder.h>
#include <zephyr/sys/clock.h>
#include <zephyr/sys/printk.h>
#include <zephyr/sys/util.h>
#include <zephyr/sys/util_macro.h>
#include <zephyr/sys/clock.h>
#include <zephyr/toolchain.h>
#include <zephyr/types.h>

#include "stream_tx.h"

#define AVAILABLE_SINK_CONTEXT  (BT_AUDIO_CONTEXT_TYPE_UNSPECIFIED | \
				 BT_AUDIO_CONTEXT_TYPE_CONVERSATIONAL | \
				 BT_AUDIO_CONTEXT_TYPE_MEDIA | \
				 BT_AUDIO_CONTEXT_TYPE_GAME | \
				 BT_AUDIO_CONTEXT_TYPE_INSTRUCTIONAL)

#define AVAILABLE_SOURCE_CONTEXT (BT_AUDIO_CONTEXT_TYPE_UNSPECIFIED | \
				  BT_AUDIO_CONTEXT_TYPE_CONVERSATIONAL | \
				  BT_AUDIO_CONTEXT_TYPE_MEDIA | \
				  BT_AUDIO_CONTEXT_TYPE_GAME)
#define SUPPORTED_FRAME_SIZE_MIN STREAM_TX_MIN_SDU_SIZE
#define SUPPORTED_FRAME_SIZE_MAX STREAM_TX_MAX_SDU_SIZE

static const struct bt_audio_codec_cap lc3_codec_cap = BT_AUDIO_CODEC_CAP_LC3(
	BT_AUDIO_CODEC_CAP_FREQ_ANY, BT_AUDIO_CODEC_CAP_DURATION_10,
	BT_AUDIO_CODEC_CAP_CHAN_COUNT_SUPPORT(1), SUPPORTED_FRAME_SIZE_MIN,
	SUPPORTED_FRAME_SIZE_MAX, 1u,
	(BT_AUDIO_CONTEXT_TYPE_CONVERSATIONAL | BT_AUDIO_CONTEXT_TYPE_MEDIA));

static struct bt_conn *default_conn;
static struct audio_sink {
	struct bt_bap_stream stream;
	size_t recv_cnt;
} sink_streams[CONFIG_BT_ASCS_MAX_ASE_SNK_COUNT];
static struct audio_source {
	struct bt_bap_stream stream;
	uint16_t seq_num;
} source_streams[CONFIG_BT_ASCS_MAX_ASE_SRC_COUNT];
static size_t configured_source_stream_count;

static const struct bt_bap_qos_cfg_pref qos_pref =
	BT_BAP_QOS_CFG_PREF(true, BT_GAP_LE_PHY_2M, 0x02U, 10U, 40000U, 40000U, 40000U, 40000U);

static K_SEM_DEFINE(sem_disconnected, 0U, 1U);

static uint8_t unicast_server_addata[] = {
	BT_UUID_16_ENCODE(BT_UUID_ASCS_VAL), /* ASCS UUID */
	BT_AUDIO_UNICAST_ANNOUNCEMENT_TARGETED, /* Target Announcement */
	BT_BYTES_LIST_LE16(AVAILABLE_SINK_CONTEXT),
	BT_BYTES_LIST_LE16(AVAILABLE_SOURCE_CONTEXT),
	0x00U, /* Metadata length */
};

/* TODO: Expand with BAP data */
static const struct bt_data ad[] = {
	BT_DATA_BYTES(BT_DATA_FLAGS, (BT_LE_AD_GENERAL | BT_LE_AD_NO_BREDR)),
	BT_DATA_BYTES(BT_DATA_UUID16_ALL, BT_UUID_16_ENCODE(BT_UUID_ASCS_VAL)),
	BT_DATA(BT_DATA_SVC_DATA16, unicast_server_addata, ARRAY_SIZE(unicast_server_addata)),
	BT_DATA(BT_DATA_NAME_COMPLETE, CONFIG_BT_DEVICE_NAME, sizeof(CONFIG_BT_DEVICE_NAME) - 1),
};

#if defined(CONFIG_LIBLC3)

#include "lc3.h"

#define MAX_SAMPLE_RATE         48000U
#define MAX_FRAME_DURATION_US   10000U
#define MAX_NUM_SAMPLES         ((MAX_FRAME_DURATION_US * MAX_SAMPLE_RATE) / USEC_PER_SEC)

static lc3_decoder_t lc3_decoder;
static lc3_decoder_mem_48k_t lc3_decoder_mem;
static int frames_per_sdu;

#endif

void print_hex(const uint8_t *ptr, size_t len)
{
	while (len != 0U) {
		printk("%02x", *ptr);
		ptr++;
		len--;
	}
}

static bool print_cb(struct bt_data *data, void *user_data)
{
	const char *str = (const char *)user_data;

	printk("%s: type 0x%02x value_len %u\n", str, data->type, data->data_len);
	print_hex(data->data, data->data_len);
	printk("\n");

	return true;
}

static void print_codec_cfg(const struct bt_audio_codec_cfg *codec_cfg)
{
	printk("codec_cfg 0x%02x cid 0x%04x vid 0x%04x count %u\n", codec_cfg->id, codec_cfg->cid,
	       codec_cfg->vid, codec_cfg->data_len);

	if (codec_cfg->id == BT_HCI_CODING_FORMAT_LC3) {
		enum bt_audio_location chan_allocation;
		int ret;

		/* LC3 uses the generic LTV format - other codecs might do as well */

		bt_audio_data_parse(codec_cfg->data, codec_cfg->data_len, print_cb, "data");

		ret = bt_audio_codec_cfg_get_freq(codec_cfg);
		if (ret > 0) {
			printk("  Frequency: %d Hz\n", bt_audio_codec_cfg_freq_to_freq_hz(ret));
		}

		ret = bt_audio_codec_cfg_get_frame_dur(codec_cfg);
		if (ret >= 0) {
			printk("  Frame Duration: %d us\n",
			       bt_audio_codec_cfg_frame_dur_to_frame_dur_us(ret));
		}

		ret = bt_audio_codec_cfg_get_chan_allocation(codec_cfg, &chan_allocation, false);
		if (ret == 0) {
			printk("  Channel allocation: 0x%x\n", chan_allocation);
		}

		printk("  Octets per frame: %d (negative means value not present)\n",
		       bt_audio_codec_cfg_get_octets_per_frame(codec_cfg));
		printk("  Frames per SDU: %d\n",
		       bt_audio_codec_cfg_get_frame_blocks_per_sdu(codec_cfg, true));
	} else {
		print_hex(codec_cfg->data, codec_cfg->data_len);
	}

	bt_audio_data_parse(codec_cfg->meta, codec_cfg->meta_len, print_cb, "meta");
}

static void print_qos(const struct bt_bap_qos_cfg *qos)
{
	printk("QoS: interval %u framing 0x%02x phy 0x%02x sdu %u "
	       "rtn %u latency %u pd %u\n",
	       qos->interval, qos->framing, qos->phy, qos->sdu,
	       qos->rtn, qos->latency, qos->pd);
}

static enum bt_audio_dir stream_dir(const struct bt_bap_stream *stream)
{
	for (size_t i = 0U; i < ARRAY_SIZE(source_streams); i++) {
		if (stream == &source_streams[i].stream) {
			return BT_AUDIO_DIR_SOURCE;
		}
	}

	for (size_t i = 0U; i < ARRAY_SIZE(sink_streams); i++) {
		if (stream == &sink_streams[i].stream) {
			return BT_AUDIO_DIR_SINK;
		}
	}

	__ASSERT(false, "Invalid stream %p", stream);
	return 0;
}

static struct bt_bap_stream *stream_alloc(enum bt_audio_dir dir)
{
	if (dir == BT_AUDIO_DIR_SOURCE) {
		for (size_t i = 0U; i < ARRAY_SIZE(source_streams); i++) {
			struct bt_bap_stream *stream = &source_streams[i].stream;

			if (!stream->conn) {
				return stream;
			}
		}
	} else {
		for (size_t i = 0U; i < ARRAY_SIZE(sink_streams); i++) {
			struct bt_bap_stream *stream = &sink_streams[i].stream;

			if (!stream->conn) {
				return stream;
			}
		}
	}

	return NULL;
}

static int lc3_config(struct bt_conn *conn, const struct bt_bap_ep *ep, enum bt_audio_dir dir,
		      const struct bt_audio_codec_cfg *codec_cfg, struct bt_bap_stream **stream,
		      struct bt_bap_qos_cfg_pref *const pref, struct bt_bap_ascs_rsp *rsp)
{
	printk("ASE Codec Config: conn %p ep %p dir %u\n", conn, ep, dir);

	print_codec_cfg(codec_cfg);

	*stream = stream_alloc(dir);
	if (*stream == NULL) {
		printk("No streams available\n");
		*rsp = BT_BAP_ASCS_RSP(BT_BAP_ASCS_RSP_CODE_NO_MEM, BT_BAP_ASCS_REASON_NONE);

		return -ENOMEM;
	}

	printk("ASE Codec Config stream %p\n", *stream);

	if (dir == BT_AUDIO_DIR_SOURCE) {
		configured_source_stream_count++;
	}

	*pref = qos_pref;

#if defined(CONFIG_LIBLC3)
	/* Nothing to free as static memory is used */
	lc3_decoder = NULL;
#endif

	return 0;
}

static int lc3_reconfig(struct bt_bap_stream *stream, enum bt_audio_dir dir,
			const struct bt_audio_codec_cfg *codec_cfg,
			struct bt_bap_qos_cfg_pref *const pref, struct bt_bap_ascs_rsp *rsp)
{
	ARG_UNUSED(dir);
	ARG_UNUSED(pref);

	printk("ASE Codec Reconfig: stream %p\n", stream);

	print_codec_cfg(codec_cfg);

#if defined(CONFIG_LIBLC3)
	/* Nothing to free as static memory is used */
	lc3_decoder = NULL;
#endif

	*rsp = BT_BAP_ASCS_RSP(BT_BAP_ASCS_RSP_CODE_CONF_UNSUPPORTED, BT_BAP_ASCS_REASON_NONE);

	/* We only support one QoS at the moment, reject changes */
	return -ENOEXEC;
}

static int lc3_qos(struct bt_bap_stream *stream, const struct bt_bap_qos_cfg *qos,
		   struct bt_bap_ascs_rsp *rsp)
{
	ARG_UNUSED(rsp);

	printk("QoS: stream %p qos %p\n", stream, qos);

	print_qos(qos);

	return 0;
}

static int lc3_enable(struct bt_bap_stream *stream, const uint8_t meta[], size_t meta_len,
		      struct bt_bap_ascs_rsp *rsp)
{
	ARG_UNUSED(meta);

	printk("Enable: stream %p meta_len %zu\n", stream, meta_len);

#if defined(CONFIG_LIBLC3)
	{
		int frame_duration_us;
		int freq;
		int ret;

		ret = bt_audio_codec_cfg_get_freq(stream->codec_cfg);
		if (ret > 0) {
			freq = bt_audio_codec_cfg_freq_to_freq_hz(ret);
		} else {
			printk("Error: Codec frequency not set, cannot start codec.");
			*rsp = BT_BAP_ASCS_RSP(BT_BAP_ASCS_RSP_CODE_CONF_INVALID,
					       BT_BAP_ASCS_REASON_CODEC_DATA);
			return ret;
		}

		ret = bt_audio_codec_cfg_get_frame_dur(stream->codec_cfg);
		if (ret >= 0) {
			frame_duration_us = bt_audio_codec_cfg_frame_dur_to_frame_dur_us(ret);
		} else {
			printk("Error: Frame duration not set, cannot start codec: %d", ret);
			*rsp = BT_BAP_ASCS_RSP(BT_BAP_ASCS_RSP_CODE_CONF_INVALID,
					       BT_BAP_ASCS_REASON_CODEC_DATA);
			return ret;
		}

		frames_per_sdu =
			bt_audio_codec_cfg_get_frame_blocks_per_sdu(stream->codec_cfg, true);

		lc3_decoder = lc3_setup_decoder(frame_duration_us,
						freq,
						0, /* No resampling */
						&lc3_decoder_mem);

		if (lc3_decoder == NULL) {
			printk("ERROR: Failed to setup LC3 encoder - wrong parameters?\n");
			*rsp = BT_BAP_ASCS_RSP(BT_BAP_ASCS_RSP_CODE_CONF_INVALID,
					       BT_BAP_ASCS_REASON_CODEC_DATA);
			return -1;
		}
	}
#else
	ARG_UNUSED(rsp);
#endif

	return 0;
}

static int lc3_start(struct bt_bap_stream *stream, struct bt_bap_ascs_rsp *rsp)
{
	ARG_UNUSED(rsp);

	printk("Start: stream %p\n", stream);

	for (size_t i = 0U; i < configured_source_stream_count; i++) {
		if (stream == &source_streams[i].stream) {
			source_streams[i].seq_num = 0U;
			break;
		}
	}

	return 0;
}

static bool data_func_cb(struct bt_data *data, void *user_data)
{
	struct bt_bap_ascs_rsp *rsp = (struct bt_bap_ascs_rsp *)user_data;

	if (!BT_AUDIO_METADATA_TYPE_IS_KNOWN(data->type)) {
		printk("Invalid metadata type %u or length %u\n", data->type, data->data_len);
		*rsp = BT_BAP_ASCS_RSP(BT_BAP_ASCS_RSP_CODE_METADATA_REJECTED, data->type);

		return -EINVAL;
	}

	return true;
}

static int lc3_metadata(struct bt_bap_stream *stream, const uint8_t meta[], size_t meta_len,
			struct bt_bap_ascs_rsp *rsp)
{
	printk("Metadata: stream %p meta_len %zu\n", stream, meta_len);

	return bt_audio_data_parse(meta, meta_len, data_func_cb, rsp);
}

static int lc3_disable(struct bt_bap_stream *stream, struct bt_bap_ascs_rsp *rsp)
{
	ARG_UNUSED(rsp);

	printk("Disable: stream %p\n", stream);

	return 0;
}

static int lc3_stop(struct bt_bap_stream *stream, struct bt_bap_ascs_rsp *rsp)
{
	ARG_UNUSED(rsp);

	printk("Stop: stream %p\n", stream);

	return 0;
}

static int lc3_release(struct bt_bap_stream *stream, struct bt_bap_ascs_rsp *rsp)
{
	ARG_UNUSED(rsp);

	printk("Release: stream %p\n", stream);
	return 0;
}

static struct bt_bap_unicast_server_register_param param = {
	CONFIG_BT_ASCS_MAX_ASE_SNK_COUNT,
	CONFIG_BT_ASCS_MAX_ASE_SRC_COUNT
};

static const struct bt_bap_unicast_server_cb unicast_server_cb = {
	.config = lc3_config,
	.reconfig = lc3_reconfig,
	.qos = lc3_qos,
	.enable = lc3_enable,
	.start = lc3_start,
	.metadata = lc3_metadata,
	.disable = lc3_disable,
	.stop = lc3_stop,
	.release = lc3_release,
};


#if defined(CONFIG_LIBLC3)

static void stream_recv_lc3_codec(struct bt_bap_stream *stream,
				  const struct bt_iso_recv_info *info,
				  struct net_buf *buf)
{
	static int16_t audio_buf[MAX_NUM_SAMPLES];

	struct audio_sink *sink_stream = CONTAINER_OF(stream, struct audio_sink, stream);
	const bool valid_data = (info->flags & BT_ISO_FLAGS_VALID) != 0;
	const int octets_per_frame = buf->len / frames_per_sdu;

	if (valid_data) {
		sink_stream->recv_cnt++;

		if (CONFIG_INFO_REPORTING_INTERVAL > 0 &&
		    (sink_stream->recv_cnt % CONFIG_INFO_REPORTING_INTERVAL) == 0U) {
			printk("Incoming audio on stream %p len %u (%zu)\n", stream, buf->len,
			       sink_stream->recv_cnt);
		}
	} else {
		printk("Bad packet: 0x%02X\n", info->flags);
	}

	if (lc3_decoder == NULL) {
		printk("LC3 decoder not setup, cannot decode data.\n");
		return;
	}

	for (int i = 0; i < frames_per_sdu; i++) {
		/* Passing NULL performs PLC */
		const int err = lc3_decode(
			lc3_decoder, valid_data ? net_buf_pull_mem(buf, octets_per_frame) : NULL,
			octets_per_frame, LC3_PCM_FORMAT_S16, audio_buf, 1);

		if (err == 1) {
			printk("[%d]: Decoder performed PLC\n", i);
		} else if (err < 0) {
			printk("[%d]: Decoder failed - wrong parameters?: %d\n", i, err);
		}
	}
}

#else

static void stream_recv(struct bt_bap_stream *stream,
			const struct bt_iso_recv_info *info,
			struct net_buf *buf)
{
	if (info->flags & BT_ISO_FLAGS_VALID) {
		struct audio_sink *sink_stream = CONTAINER_OF(stream, struct audio_sink, stream);

		sink_stream->recv_cnt++;

		if (CONFIG_INFO_REPORTING_INTERVAL > 0 &&
		    (sink_stream->recv_cnt % CONFIG_INFO_REPORTING_INTERVAL) == 0U) {
			printk("Incoming audio on stream %p len %u\n", stream, buf->len);
		}
	}
}

#endif

static void stream_stopped(struct bt_bap_stream *stream, uint8_t reason)
{
	printk("Audio Stream %p stopped with reason 0x%02X\n", stream, reason);

	if (IS_ENABLED(CONFIG_BT_AUDIO_TX) && stream_dir(stream) == BT_AUDIO_DIR_SOURCE) {
		const int err = stream_tx_unregister(stream);

		if (err != 0) {
			printk("Failed to register stream %p for TX: %d\n", stream, err);
		}
	}
}

static void stream_started(struct bt_bap_stream *stream)
{
	struct bt_iso_info info;
	int err;

	err = bt_iso_chan_get_info(stream->iso, &info);
	__ASSERT(err == 0, "Failed to get ISO chan info: %d", err);

	printk("Audio Stream %p started  with CIG_ID %u and CIS_ID %u\n", stream,
	       info.unicast.cig_id, info.unicast.cis_id);

	if (stream_dir(stream) == BT_AUDIO_DIR_SINK) {
		struct audio_sink *sink_stream = CONTAINER_OF(stream, struct audio_sink, stream);

		sink_stream->recv_cnt = 0U;
	} else if (IS_ENABLED(CONFIG_BT_AUDIO_TX)) {
		const int err = stream_tx_register(stream);

		if (err != 0) {
			printk("Failed to register stream %p for TX: %d\n", stream, err);
		}
	}
}

static void stream_enabled_cb(struct bt_bap_stream *stream)
{
	/* The unicast server is responsible for starting sink ASEs after the
	 * client has enabled them.
	 */
	if (stream_dir(stream) == BT_AUDIO_DIR_SINK) {
		const int err = bt_bap_stream_start(stream);

		if (err != 0) {
			printk("Failed to start stream %p: %d", stream, err);
		}
	}
}

static struct bt_bap_stream_ops stream_ops = {
#if defined(CONFIG_LIBLC3)
	.recv = stream_recv_lc3_codec,
#else
	.recv = stream_recv,
#endif
	.stopped = stream_stopped,
	.started = stream_started,
	.enabled = stream_enabled_cb,
};

static void connected(struct bt_conn *conn, uint8_t err)
{
	if (err != 0) {
		printk("Failed to connect to %s %u %s\n", bt_conn_dst_str(conn),
		       err, bt_hci_err_to_str(err));

		default_conn = NULL;
		return;
	}

	printk("Connected: %s\n", bt_conn_dst_str(conn));
	default_conn = bt_conn_ref(conn);
}

static void disconnected(struct bt_conn *conn, uint8_t reason)
{
	if (conn != default_conn) {
		return;
	}

	printk("Disconnected: %s, reason 0x%02x %s\n", bt_conn_dst_str(conn),
	       reason, bt_hci_err_to_str(reason));

	bt_conn_drop(&default_conn);

	k_sem_give(&sem_disconnected);
}

BT_CONN_CB_DEFINE(conn_callbacks) = {
	.connected = connected,
	.disconnected = disconnected,
};

static struct bt_pacs_cap cap_sink = {
	.codec_cap = &lc3_codec_cap,
};

static struct bt_pacs_cap cap_source = {
	.codec_cap = &lc3_codec_cap,
};

static int set_location(void)
{
	int err;

	if (IS_ENABLED(CONFIG_BT_PAC_SNK_LOC)) {
		err = bt_pacs_set_location(BT_AUDIO_DIR_SINK,
					   (BT_AUDIO_LOCATION_FRONT_LEFT |
					    BT_AUDIO_LOCATION_FRONT_RIGHT));
		if (err != 0) {
			printk("Failed to set sink location (err %d)\n", err);
			return err;
		}
	}

	if (IS_ENABLED(CONFIG_BT_PAC_SRC_LOC)) {
		err = bt_pacs_set_location(BT_AUDIO_DIR_SOURCE,
					   BT_AUDIO_LOCATION_FRONT_CENTER);
		if (err != 0) {
			printk("Failed to set source location (err %d)\n", err);
			return err;
		}
	}

	printk("Location successfully set\n");

	return 0;
}

static int set_supported_contexts(void)
{
	int err;

	if (IS_ENABLED(CONFIG_BT_PAC_SNK)) {
		err = bt_pacs_set_supported_contexts(BT_AUDIO_DIR_SINK,
						     AVAILABLE_SINK_CONTEXT);
		if (err != 0) {
			printk("Failed to set sink supported contexts (err %d)\n",
			       err);

			return err;
		}
	}

	if (IS_ENABLED(CONFIG_BT_PAC_SRC)) {
		err = bt_pacs_set_supported_contexts(BT_AUDIO_DIR_SOURCE,
						     AVAILABLE_SOURCE_CONTEXT);
		if (err != 0) {
			printk("Failed to set source supported contexts (err %d)\n",
			       err);

			return err;
		}
	}

	printk("Supported contexts successfully set\n");

	return 0;
}

static int set_available_contexts(void)
{
	int err;

	if (IS_ENABLED(CONFIG_BT_PAC_SNK)) {
		err = bt_pacs_set_available_contexts(BT_AUDIO_DIR_SINK,
						     AVAILABLE_SINK_CONTEXT);
		if (err != 0) {
			printk("Failed to set sink available contexts (err %d)\n", err);
			return err;
		}
	}

	if (IS_ENABLED(CONFIG_BT_PAC_SRC)) {
		err = bt_pacs_set_available_contexts(BT_AUDIO_DIR_SOURCE,
						     AVAILABLE_SOURCE_CONTEXT);
		if (err != 0) {
			printk("Failed to set source available contexts (err %d)\n", err);
			return err;
		}
	}

	printk("Available contexts successfully set\n");
	return 0;
}


int main(void)
{
	struct bt_le_ext_adv *adv;
	const struct bt_pacs_register_param pacs_param = {
		.snk_pac = true,
		.snk_loc = true,
		.src_pac = true,
		.src_loc = true,
	};
	int err;

	err = bt_enable(NULL);
	if (err != 0) {
		printk("Bluetooth init failed (err %d)\n", err);
		return 0;
	}

	printk("Bluetooth initialized\n");

	err = bt_pacs_register(&pacs_param);
	if (err != 0) {
		printk("Could not register PACS (err %d)\n", err);
		return 0;
	}

	if (IS_ENABLED(CONFIG_BT_AUDIO_TX)) {
		stream_tx_init();
	}

	err = bt_bap_unicast_server_register(&param);
	if (err != 0) {
		printk("Could not register unicast server (err %d)\n", err);
		return 0;
	}

	err = bt_bap_unicast_server_register_cb(&unicast_server_cb);
	if (err != 0) {
		printk("Could not register unicast server callbacks (err %d)\n", err);
		return 0;
	}

	err = bt_pacs_cap_register(BT_AUDIO_DIR_SINK, &cap_sink);
	if (err != 0) {
		printk("Could not register sink capability (err %d)\n", err);
		return 0;
	}

	err = bt_pacs_cap_register(BT_AUDIO_DIR_SOURCE, &cap_source);
	if (err != 0) {
		printk("Could not register source capability (err %d)\n", err);
		return 0;
	}

	for (size_t i = 0U; i < ARRAY_SIZE(sink_streams); i++) {
		bt_bap_stream_cb_register(&sink_streams[i].stream, &stream_ops);
	}

	for (size_t i = 0U; i < ARRAY_SIZE(source_streams); i++) {
		bt_bap_stream_cb_register(&source_streams[i].stream,
					    &stream_ops);
	}

	err = set_location();
	if (err != 0) {
		return 0;
	}

	err = set_supported_contexts();
	if (err != 0) {
		return 0;
	}

	err = set_available_contexts();
	if (err != 0) {
		return 0;
	}

	/* Create a connectable advertising set */
	err = bt_le_ext_adv_create(BT_BAP_ADV_PARAM_CONN_QUICK, NULL, &adv);
	if (err != 0) {
		printk("Failed to create advertising set (err %d)\n", err);
		return 0;
	}

	err = bt_le_ext_adv_set_data(adv, ad, ARRAY_SIZE(ad), NULL, 0);
	if (err != 0) {
		printk("Failed to set advertising data (err %d)\n", err);
		return 0;
	}

	while (true) {
		err = bt_le_ext_adv_start(adv, BT_LE_EXT_ADV_START_DEFAULT);
		if (err != 0) {
			printk("Failed to start advertising set (err %d)\n", err);
			return 0;
		}

		printk("Advertising successfully started\n");

		err = k_sem_take(&sem_disconnected, K_FOREVER);
		if (err != 0) {
			printk("failed to take sem_disconnected (err %d)\n", err);
			return 0;
		}

		/* reset data */
		configured_source_stream_count = 0U;
	}
	return 0;
}
```

## src/le_audio_playback.c
```c
/*
 * SPDX-FileCopyrightText: Copyright The Zephyr Project Contributors
 * SPDX-License-Identifier: Apache-2.0
 */

/*
 * Audio playback pipeline: LC3 -> PCM -> I2S -> external codec.
 *
 * We use both the I2S and the audio_codec APIs on purpose. The
 * audio_codec_write/start/stop/register_done_callback path integrates data
 * transport into the codec driver, but it is only implemented by codec
 * drivers that embed the DMA/serializer engine themselves (see
 * samples/bluetooth/audio/bap_broadcast_sink/src/hw_codec.c). Codecs that
 * only program registers over I2C/SPI (WM8962, TLV320, etc.) rely on the
 * SoC's SAI/I2S peripheral to move samples, so the sample must drive I2S
 * directly for data transport and use audio_codec_configure() /
 * audio_codec_set_property() for codec-side setup and volume/mute.
 */

#include <errno.h>
#include <stdbool.h>
#include <stddef.h>
#include <stdint.h>
#include <string.h>

#include <zephyr/device.h>
#include <zephyr/devicetree.h>
#include <zephyr/kernel.h>
#include <zephyr/net_buf.h>
#include <zephyr/sys/atomic.h>
#include <zephyr/sys/printk.h>
#include <zephyr/sys/util.h>

#include "le_audio_playback.h"

#if !DT_HAS_ALIAS(i2s_codec_tx) || !DT_NODE_EXISTS(DT_NODELABEL(audio_codec)) || \
	!IS_ENABLED(CONFIG_I2S) || !IS_ENABLED(CONFIG_AUDIO_CODEC)

int le_audio_playback_init(void)
{
	printk("le_audio_playback: I2S/codec alias not present, playback disabled\n");
	return 0;
}

int le_audio_playback_stream_start(const struct le_audio_pcm_cfg *cfg)
{
	ARG_UNUSED(cfg);
	return 0;
}

void le_audio_playback_stream_stop(void) { }

void le_audio_playback_stream_recv(struct net_buf *buf)
{
	ARG_UNUSED(buf);
}

void le_audio_playback_set_volume(uint8_t vcs_volume) { ARG_UNUSED(vcs_volume); }

void le_audio_playback_set_mute(bool mute) { ARG_UNUSED(mute); }

#else

#include <zephyr/audio/codec.h>
#include <zephyr/drivers/i2s.h>

#include <lc3.h>

#define I2S_CODEC_TX_NODE DT_ALIAS(i2s_codec_tx)
#define I2S_TIMEOUT_MS    2000U
#define SAMPLE_BIT_WIDTH  16U
#define PCM_MAX_CHAN      2U

/* Worst-case block: 48 kHz, 10 ms, stereo, 16-bit = 480 * 2 * 2 = 1920 B. */
#define LC3_MAX_SAMPLES_PER_FRAME (48U * 10U)  /* 48 kHz * 10 ms per channel */
#define PCM_MAX_BLOCK_BYTES       (LC3_MAX_SAMPLES_PER_FRAME * PCM_MAX_CHAN * sizeof(int16_t))

/* Depth of the I2S DMA queue managed by i2s_configure(). */
#define I2S_MEM_SLAB_BLOCKS ((uint32_t)CONFIG_BAP_UNICAST_SERVER_I2S_DMA_BLOCK_COUNT)

/* Depth of the decode -> I2S worker handoff queue. */
#define PCM_MSGQ_DEPTH ((uint32_t)CONFIG_BAP_UNICAST_SERVER_PCM_QUEUE_DEPTH)

/* i2s_buf_write() allocates from this slab and copies our worker's block into it. */
#if CONFIG_NOCACHE_MEMORY
#define __I2S_NOCACHE __attribute__((__section__(".nocache")))
#else
#define __I2S_NOCACHE
#endif

static __I2S_NOCACHE __aligned(4) uint8_t
	i2s_slab_buffer[CONFIG_BAP_UNICAST_SERVER_I2S_DMA_BLOCK_COUNT * PCM_MAX_BLOCK_BYTES];
static struct k_mem_slab i2s_mem_slab;

/* Producer/consumer queue between stream_recv() (BAP RX context) and the I2S worker. */
K_MSGQ_DEFINE(pcm_msgq, PCM_MAX_BLOCK_BYTES, PCM_MSGQ_DEPTH, 4);

static const struct device *const codec_tx  = DEVICE_DT_GET(I2S_CODEC_TX_NODE);
static const struct device *const codec_dev = DEVICE_DT_GET(DT_NODELABEL(audio_codec));

/* Two LC3 decoder contexts for stereo. Sized for the worst-case 48 kHz / 10 ms. */
static lc3_decoder_mem_48k_t decoder_mem[PCM_MAX_CHAN];
static lc3_decoder_t         decoders[PCM_MAX_CHAN];

/* Shared state: active_cfg, samples_per_frame, pcm_block_bytes, out_chan_cnt
 * and decoders[] are mutated only by bringup_work_handler and only while
 * running == 0. Consumers (stream_recv, i2s_worker) atomic_get(&running)
 * before reading any of the cfg fields; the atomic_set release on the
 * producer publishes cfg to the consumers via matching acquire on the reader.
 */
static struct le_audio_pcm_cfg active_cfg;
static uint32_t               samples_per_frame; /* per-channel samples per LC3 frame */
static uint32_t               pcm_block_bytes;   /* per-SDU decoded PCM size */
static uint8_t                out_chan_cnt;      /* channels sent to I2S (always 2) */
static atomic_t               running;
static atomic_t               i2s_configured;    /* set after first successful i2s_configure() */

/* Cached VCS state re-applied after every codec (re)configure. VCS defines volume as
 * 0..255; most codec drivers expect a smaller linear range (WM8962 uses a 7-bit 0..127
 * output-volume register). Boards with a different codec should adjust apply_volume().
 *
 * Default to full scale (255 -> WM8962 register 127, +6 dB). The WM8962 output-volume
 * curve is heavily bottom-weighted: only the top of the 0..127 range is clearly audible,
 * so a mid VCS value maps to a near-inaudible register setting. Start at max so playback
 * is loud by default; a VCS client can still turn it down via le_audio_playback_set_volume().
 */
static uint8_t                cached_vcs_volume = 255U;
static bool                   cached_mute;


static K_THREAD_STACK_DEFINE(i2s_worker_stack, CONFIG_BAP_UNICAST_SERVER_I2S_WORKER_STACK_SIZE);
static struct k_thread i2s_worker_thread;
static k_tid_t         i2s_worker_tid;

/* Deferred bring-up: stream_start() runs in the BAP RX workqueue context; doing the
 * codec control-bus transactions and mem_slab reinit inline starves host callbacks and
 * causes some Centrals to abort the setup. stream_stop() is a flag flip and stays inline.
 */
static struct k_work           bringup_work;
static struct le_audio_pcm_cfg pending_cfg;
static bool                    pending_valid;

/* Wakes the i2s worker after stream_stop parked it on the sem. */
static K_SEM_DEFINE(resume_sem, 0, 1);

static void bringup_work_handler(struct k_work *work);

static void apply_volume(void)
{
	audio_property_value_t val;
	int ret;

	val.vol = (int)(((uint32_t)cached_vcs_volume * 127U) / 255U);
	ret = audio_codec_set_property(codec_dev, AUDIO_PROPERTY_OUTPUT_VOLUME,
				       AUDIO_CHANNEL_ALL, val);
	if (ret != 0) {
		printk("codec volume set failed: %d\n", ret);
	}

	val.mute = cached_mute;
	ret = audio_codec_set_property(codec_dev, AUDIO_PROPERTY_OUTPUT_MUTE,
				       AUDIO_CHANNEL_ALL, val);
	if (ret != 0) {
		printk("codec mute set failed: %d\n", ret);
	}

	ret = audio_codec_apply_properties(codec_dev);
	if (ret != 0) {
		printk("codec apply_properties failed: %d\n", ret);
	}
}

static void i2s_worker(void *a, void *b, void *c)
{
	ARG_UNUSED(a);
	ARG_UNUSED(b);
	ARG_UNUSED(c);

	/* Static: sized to the worst-case block. Keeping this off the thread
	 * stack avoids overflowing i2s_worker_stack into adjacent .bss.
	 */
	static uint8_t block[PCM_MAX_BLOCK_BYTES];

	while (true) {
		if (!atomic_get(&running)) {
			/* While parked we stop feeding the driver's TX queue; the outstanding
			 * DMA blocks drain and the driver auto-transitions to READY. This lets
			 * us avoid I2S_TRIGGER_DROP, whose disable path in some driver
			 * implementations busy-waits on FIFO empty under irq_lock and hangs
			 * once the transmitter has already been disabled.
			 */
			(void)k_sem_take(&resume_sem, K_FOREVER);
			continue;
		}

		/* i2s_buf_write() is paced by the driver freeing a DMA block per transfer.
		 * On brief SDU gaps we push silence so the codec keeps seeing valid frames.
		 */
		if (k_msgq_get(&pcm_msgq, block, K_NO_WAIT) != 0) {
			memset(block, 0, pcm_block_bytes);
		}

		int ret = i2s_buf_write(codec_tx, block, pcm_block_bytes);

		if (ret < 0) {
			printk("i2s_buf_write failed: %d\n", ret);
		}
	}
}

static int configure_i2s_and_codec(uint32_t sample_rate)
{
	struct i2s_config i2s_cfg;
	struct audio_codec_cfg codec_cfg;

	i2s_cfg.word_size       = SAMPLE_BIT_WIDTH;
	i2s_cfg.channels        = out_chan_cnt;
	i2s_cfg.format          = I2S_FMT_DATA_FORMAT_I2S;
	i2s_cfg.options         = I2S_OPT_BIT_CLK_CONTROLLER | I2S_OPT_FRAME_CLK_CONTROLLER;
	i2s_cfg.frame_clk_freq  = sample_rate;
	i2s_cfg.mem_slab        = &i2s_mem_slab;
	i2s_cfg.block_size      = pcm_block_bytes;
	i2s_cfg.timeout         = I2S_TIMEOUT_MS;

	codec_cfg.dai_route                  = AUDIO_ROUTE_PLAYBACK;
	codec_cfg.dai_type                   = AUDIO_DAI_TYPE_I2S;
	codec_cfg.dai_cfg.i2s.word_size      = SAMPLE_BIT_WIDTH;
	codec_cfg.dai_cfg.i2s.channels       = out_chan_cnt;
	codec_cfg.dai_cfg.i2s.format         = I2S_FMT_DATA_FORMAT_I2S;
	codec_cfg.dai_cfg.i2s.options        = I2S_OPT_FRAME_CLK_TARGET | I2S_OPT_BIT_CLK_TARGET;
	codec_cfg.dai_cfg.i2s.frame_clk_freq = sample_rate;
	codec_cfg.dai_cfg.i2s.mem_slab       = &i2s_mem_slab;
	codec_cfg.dai_cfg.i2s.block_size     = pcm_block_bytes;

	/* Configure the I2S controller (MCLK/BCLK source) before the codec so the codec
	 * sees a stable MCLK when it locks its internal PLL/FLL.
	 */
	int ret = i2s_configure(codec_tx, I2S_DIR_TX, &i2s_cfg);

	if (ret != 0) {
		printk("i2s_configure failed: %d\n", ret);
		return ret;
	}

	ret = audio_codec_configure(codec_dev, &codec_cfg);
	if (ret != 0) {
		printk("audio_codec_configure failed: %d\n", ret);
		return ret;
	}

	/* Give the codec time to lock its internal PLL/FLL onto MCLK after
	 * i2s_configure() enabled the SAI clocks. WM8962 needs ~30 ms; 50 ms
	 * covers similar codecs. Drivers that report ready state via a callback
	 * can skip this.
	 */
	k_msleep(50);

	ret = k_mem_slab_init(&i2s_mem_slab, i2s_slab_buffer, pcm_block_bytes,
			      I2S_MEM_SLAB_BLOCKS);
	if (ret < 0) {
		printk("k_mem_slab_init failed: %d\n", ret);
		return ret;
	}

	return 0;
}

int le_audio_playback_init(void)
{
	if (!device_is_ready(codec_tx)) {
		printk("%s not ready\n", codec_tx->name);
		return -EIO;
	}
	if (!device_is_ready(codec_dev)) {
		printk("%s not ready\n", codec_dev->name);
		return -EIO;
	}

	k_work_init(&bringup_work, bringup_work_handler);

	i2s_worker_tid = k_thread_create(&i2s_worker_thread, i2s_worker_stack,
					 K_THREAD_STACK_SIZEOF(i2s_worker_stack),
					 i2s_worker, NULL, NULL, NULL,
					 K_PRIO_COOP(CONFIG_BAP_UNICAST_SERVER_I2S_WORKER_PRIORITY),
					 0, K_NO_WAIT);
	k_thread_name_set(i2s_worker_tid, "le_audio_i2s");

	return 0;
}

int le_audio_playback_stream_start(const struct le_audio_pcm_cfg *cfg)
{
	if (cfg->chan_cnt == 0U || cfg->chan_cnt > PCM_MAX_CHAN) {
		printk("Unsupported chan_cnt %u\n", cfg->chan_cnt);
		return -EINVAL;
	}
	if (cfg->frame_blocks_per_sdu != 1U) {
		printk("Unsupported frame_blocks_per_sdu %u\n", cfg->frame_blocks_per_sdu);
		return -EINVAL;
	}

	pending_cfg   = *cfg;
	pending_valid = true;
	(void)k_work_submit(&bringup_work);
	return 0;
}

static void bringup_work_handler(struct k_work *work)
{
	ARG_UNUSED(work);

	if (!pending_valid) {
		return;
	}
	pending_valid = false;

	if (atomic_get(&running)) {
		return;
	}

	const struct le_audio_pcm_cfg *cfg = &pending_cfg;

	const bool cfg_changed = !atomic_get(&i2s_configured) ||
		cfg->freq_hz != active_cfg.freq_hz ||
		cfg->chan_cnt != active_cfg.chan_cnt ||
		cfg->frame_duration_us != active_cfg.frame_duration_us ||
		cfg->octets_per_frame != active_cfg.octets_per_frame;

	active_cfg        = *cfg;
	samples_per_frame = (cfg->freq_hz / 1000U) * (cfg->frame_duration_us / 1000U);
	out_chan_cnt      = PCM_MAX_CHAN;
	pcm_block_bytes   = samples_per_frame * out_chan_cnt * sizeof(int16_t);
	if (pcm_block_bytes > PCM_MAX_BLOCK_BYTES) {
		printk("pcm_block_bytes %u exceeds max %u\n",
		       pcm_block_bytes, (unsigned int)PCM_MAX_BLOCK_BYTES);
		return;
	}

	for (uint8_t c = 0U; c < cfg->chan_cnt; c++) {
		decoders[c] = lc3_setup_decoder((int)cfg->frame_duration_us,
						(int)cfg->freq_hz, 0,
						&decoder_mem[c]);
		if (decoders[c] == NULL) {
			printk("lc3_setup_decoder ch%u failed\n", c);
			return;
		}
	}

	k_msgq_purge(&pcm_msgq);

	if (cfg_changed) {
		int ret = configure_i2s_and_codec(cfg->freq_hz);

		if (ret != 0) {
			return;
		}
		atomic_set(&i2s_configured, 1);
	}

	apply_volume();

	/* Prime the DMA queue with silence so START has valid frames to transmit
	 * from the moment the transmitter is enabled.
	 */
	static uint8_t silence[PCM_MAX_BLOCK_BYTES];

	memset(silence, 0, pcm_block_bytes);
	for (uint32_t i = 0; i < I2S_MEM_SLAB_BLOCKS - 1U; i++) {
		int wret = i2s_buf_write(codec_tx, silence, pcm_block_bytes);

		if (wret < 0) {
			printk("silence pre-fill %u failed: %d\n", i, wret);
			return;
		}
	}

	/* Best-effort START. -EIO is expected on quick pause/resume when the driver is
	 * still draining a previous session; the blocks we just queued flow through the
	 * existing DMA loop unchanged. Otherwise this transitions from READY to RUNNING.
	 */
	(void)i2s_trigger(codec_tx, I2S_DIR_TX, I2S_TRIGGER_START);

	/* Publish cfg to consumers: atomic_set release pairs with atomic_get
	 * acquire in stream_recv() / i2s_worker().
	 */
	atomic_set(&running, 1);
	k_sem_give(&resume_sem);

	printk("le_audio_playback: %u Hz, %u ch, %u us frame, %u B/frame\n",
	       cfg->freq_hz, cfg->chan_cnt, cfg->frame_duration_us,
	       cfg->octets_per_frame);
}

void le_audio_playback_stream_stop(void)
{
	/* Flag flip only: the worker parks on resume_sem, feeding stops, the driver
	 * drains and auto-transitions to READY. Never call I2S_TRIGGER_DROP - some
	 * driver implementations busy-wait on FIFO empty and hang once the transmitter
	 * has already been disabled.
	 */
	atomic_set(&running, 0);
}

void le_audio_playback_stream_recv(struct net_buf *buf)
{
	/* Called from the BT RX WQ context - keep the stack footprint small. */
	static int16_t pcm[LC3_MAX_SAMPLES_PER_FRAME * PCM_MAX_CHAN];

	if (!atomic_get(&running) || decoders[0] == NULL) {
		return;
	}

	const uint16_t opf = active_cfg.octets_per_frame;
	const uint16_t expected = (uint16_t)(opf * active_cfg.chan_cnt);

	if (buf->len == 0U) {
		return;
	}

	if (active_cfg.chan_cnt == 1U) {
		const void *in = (buf->len >= opf) ? net_buf_pull_mem(buf, opf) : NULL;
		int err = lc3_decode(decoders[0], in, in ? opf : 0,
				     LC3_PCM_FORMAT_S16, pcm, 1);
		if (err < 0) {
			return;
		}
		/* Duplicate mono into both I2S channels. */
		for (int i = (int)samples_per_frame - 1; i >= 0; i--) {
			pcm[i * 2 + 0] = pcm[i];
			pcm[i * 2 + 1] = pcm[i];
		}
	} else {
		const bool have_data = buf->len >= expected;
		const void *in_l = have_data ? net_buf_pull_mem(buf, opf) : NULL;
		const void *in_r = have_data ? net_buf_pull_mem(buf, opf) : NULL;

		int err = lc3_decode(decoders[0], in_l, in_l ? opf : 0,
				     LC3_PCM_FORMAT_S16, &pcm[0], 2);
		if (err < 0) {
			return;
		}
		err = lc3_decode(decoders[1], in_r, in_r ? opf : 0,
				 LC3_PCM_FORMAT_S16, &pcm[1], 2);
		if (err < 0) {
			return;
		}
	}

	(void)k_msgq_put(&pcm_msgq, pcm, K_NO_WAIT);
}

void le_audio_playback_set_volume(uint8_t vcs_volume)
{
	cached_vcs_volume = vcs_volume;
	if (atomic_get(&i2s_configured)) {
		apply_volume();
	}
}

void le_audio_playback_set_mute(bool mute)
{
	cached_mute = mute;
	if (atomic_get(&i2s_configured)) {
		apply_volume();
	}
}

#endif /* DT_HAS_ALIAS(i2s_codec_tx) && DT_NODE_EXISTS(DT_NODELABEL(audio_codec)) */
```

## src/le_audio_playback.h
```c
/*
 * SPDX-FileCopyrightText: Copyright The Zephyr Project Contributors
 * SPDX-License-Identifier: Apache-2.0
 */

#ifndef SAMPLE_BAP_UNICAST_SERVER_LE_AUDIO_PLAYBACK_H_
#define SAMPLE_BAP_UNICAST_SERVER_LE_AUDIO_PLAYBACK_H_

#include <stdbool.h>
#include <stdint.h>

#include <zephyr/bluetooth/audio/audio.h>
#include <zephyr/bluetooth/iso.h>
#include <zephyr/net_buf.h>

struct le_audio_pcm_cfg {
	uint32_t freq_hz;             /* 48000, 32000, 16000 */
	uint32_t frame_duration_us;   /* 7500 or 10000 */
	uint16_t octets_per_frame;    /* per-channel LC3 frame size */
	uint8_t  chan_cnt;            /* 1 or 2 */
	uint8_t  frame_blocks_per_sdu;/* usually 1 */
};

int le_audio_playback_init(void);
int le_audio_playback_stream_start(const struct le_audio_pcm_cfg *cfg);
void le_audio_playback_stream_stop(void);
void le_audio_playback_stream_recv(struct net_buf *buf);

/* Apply a VCS-scale (0..255) output volume to the codec. Cached and re-applied
 * on the next codec (re)configure.
 */
void le_audio_playback_set_volume(uint8_t vcs_volume);
void le_audio_playback_set_mute(bool mute);

#endif /* SAMPLE_BAP_UNICAST_SERVER_LE_AUDIO_PLAYBACK_H_ */
```

## src/stream_lc3.h
```c
/*
 * Copyright (c) 2024 Nordic Semiconductor ASA
 *
 * SPDX-License-Identifier: Apache-2.0
 */

#ifndef STREAM_LC3_H
#define STREAM_LC3_H

#include <stdint.h>

#include <zephyr/bluetooth/assigned_numbers.h>
#include <zephyr/bluetooth/audio/audio.h>
#include <zephyr/net_buf.h>
#include <zephyr/sys/clock.h>

/* Since the lc3.h header file is not available when CONFIG_LIBLC3=n, we need to guard the include
 * and use of it
 */
#if defined(CONFIG_LIBLC3)
/* Header file for the liblc3 */
#include <lc3.h>

struct stream_lc3_tx {
	uint32_t freq_hz;
	uint32_t frame_duration_us;
	uint16_t octets_per_frame;
	uint8_t frame_blocks_per_sdu;
	uint8_t chan_cnt;
	enum bt_audio_location chan_allocation;
	lc3_encoder_t encoder;
	lc3_encoder_mem_48k_t encoder_mem;
};
#endif /* CONFIG_LIBLC3 */

/* Opaque definition to avoid including stream_tx.h */
struct tx_stream;

/*
 * @brief Initialize LC3 encoder for a stream
 *
 * This will initialize the encoder for the provided TX stream
 */
int stream_lc3_init(struct tx_stream *stream);

/**
 * Add LC3 encoded data to the provided buffer from the provided stream
 *
 * @param stream The TX stream to add data from
 * @param buf The buffer to store the encoded audio data in
 */
void stream_lc3_add_data(struct tx_stream *stream, struct net_buf *buf);

#endif /* STREAM_LC3_H */
```

## src/stream_tx.c
```c
/*
 * Copyright (c) 2024-2025 Nordic Semiconductor ASA
 *
 * SPDX-License-Identifier: Apache-2.0
 */

#include <zephyr/autoconf.h>
#include <errno.h>
#include <stdbool.h>
#include <stddef.h>
#include <stdint.h>

#include <zephyr/bluetooth/audio/cap.h>
#include <zephyr/bluetooth/audio/bap.h>
#include <zephyr/bluetooth/bluetooth.h>
#include <zephyr/bluetooth/hci_types.h>
#include <zephyr/bluetooth/iso.h>
#include <zephyr/kernel.h>
#include <zephyr/kernel/thread_stack.h>
#include <zephyr/logging/log.h>
#include <zephyr/logging/log_core.h>
#include <zephyr/net_buf.h>
#include <zephyr/sys/__assert.h>
#include <zephyr/sys/byteorder.h>
#include <zephyr/sys/util.h>
#include <zephyr/sys/util_macro.h>
#include <zephyr/toolchain.h>
#include <zephyr/types.h>

#include "stream_lc3.h"
#include "stream_tx.h"

LOG_MODULE_REGISTER(stream_tx, LOG_LEVEL_INF);

static struct tx_stream tx_streams[CONFIG_BT_ASCS_MAX_ASE_SRC_COUNT];

static bool stream_is_streaming(const struct bt_bap_stream *bap_stream)
{
	struct bt_bap_ep_info ep_info;
	int err;

	if (bap_stream == NULL) {
		return false;
	}

	/* No-op if stream is not configured */
	if (bap_stream->ep == NULL) {
		return false;
	}

	err = bt_bap_ep_get_info(bap_stream->ep, &ep_info);
	if (err != 0) {
		return false;
	}

	return ep_info.state == BT_BAP_EP_STATE_STREAMING;
}

static void tx_thread_func(void *arg1, void *arg2, void *arg3)
{
	NET_BUF_POOL_FIXED_DEFINE(tx_pool, CONFIG_BT_ISO_TX_BUF_COUNT,
				  BT_ISO_SDU_BUF_SIZE(CONFIG_BT_ISO_TX_MTU),
				  CONFIG_BT_CONN_TX_USER_DATA_SIZE, NULL);
	static uint8_t mock_data[CONFIG_BT_ISO_TX_MTU];

	ARG_UNUSED(arg1);
	ARG_UNUSED(arg2);
	ARG_UNUSED(arg3);

	for (size_t i = 0U; i < ARRAY_SIZE(mock_data); i++) {
		mock_data[i] = (uint8_t)i;
	}

	/* This loop will attempt to send on all streams in the streaming state in a round robin
	 * fashion.
	 * The TX is controlled by the number of buffers configured, and increasing
	 * CONFIG_BT_ISO_TX_BUF_COUNT will allow for more streams in parallel, or to submit more
	 * buffers per stream.
	 * Once a buffer has been freed by the stack, it triggers the next TX.
	 */
	while (true) {
		int err = -ENOEXEC;

		for (size_t i = 0U; i < ARRAY_SIZE(tx_streams); i++) {
			struct bt_bap_stream *bap_stream = tx_streams[i].bap_stream;

			if (stream_is_streaming(bap_stream)) {
				uint16_t sdu_len;
				struct net_buf *buf;

				buf = net_buf_alloc(&tx_pool, K_FOREVER);
				net_buf_reserve(buf, BT_ISO_CHAN_SEND_RESERVE);

				if (IS_ENABLED(CONFIG_LIBLC3) &&
				    bap_stream->codec_cfg->id == BT_HCI_CODING_FORMAT_LC3) {
					stream_lc3_add_data(&tx_streams[i], buf);
				} else {
					__ASSERT(bap_stream->qos->sdu <= ARRAY_SIZE(mock_data),
						 "Configured codec SDU len %u does not match mock "
						 "data size %zu",
						 bap_stream->qos->sdu, ARRAY_SIZE(mock_data));
					net_buf_add_mem(buf, mock_data, bap_stream->qos->sdu);
				}

				sdu_len = buf->len;

				err = bt_bap_stream_send(bap_stream, buf, tx_streams[i].seq_num);
				if (err == 0) {
					tx_streams[i].seq_num++;

					if (CONFIG_INFO_REPORTING_INTERVAL > 0 &&
					    (tx_streams[i].seq_num %
					     CONFIG_INFO_REPORTING_INTERVAL) == 0U) {
						LOG_INF("Stream %p: Sent %u total SDUs of size %u",
							bap_stream, tx_streams[i].seq_num, sdu_len);
					}
				} else {
					LOG_ERR("Unable to send: %d", err);
					net_buf_unref(buf);
				}
			} /* No-op if stream is not streaming */
		}

		if (err != 0) {
			/* In case of any errors, retry with a delay */
			k_sleep(K_MSEC(10));
		}
	}
}

int stream_tx_register(struct bt_bap_stream *bap_stream)
{
	if (bap_stream == NULL) {
		return -EINVAL;
	}

	for (size_t i = 0U; i < ARRAY_SIZE(tx_streams); i++) {
		if (tx_streams[i].bap_stream == NULL) {
			tx_streams[i].bap_stream = bap_stream;
			tx_streams[i].seq_num = 0U;

			if (IS_ENABLED(CONFIG_LIBLC3) &&
			    bap_stream->codec_cfg->id == BT_HCI_CODING_FORMAT_LC3) {
				const int err = stream_lc3_init(&tx_streams[i]);

				if (err != 0) {
					tx_streams[i].bap_stream = NULL;

					return err;
				}
			}

			LOG_INF("Registered %p for TX", bap_stream);
			if (bap_stream->qos->sdu > CONFIG_BT_ISO_TX_MTU) {
				LOG_WRN("Stream configured for SDUs larger (%u) than "
					"CONFIG_BT_ISO_TX_MTU (%d)",
					bap_stream->qos->sdu, CONFIG_BT_ISO_TX_MTU);
			}

			return 0;
		}
	}

	return -ENOMEM;
}

int stream_tx_unregister(struct bt_bap_stream *bap_stream)
{
	if (bap_stream == NULL) {
		return -EINVAL;
	}

	for (size_t i = 0U; i < ARRAY_SIZE(tx_streams); i++) {
		if (tx_streams[i].bap_stream == bap_stream) {
			tx_streams[i].bap_stream = NULL;

			LOG_INF("Unregistered %p for TX", bap_stream);

			return 0;
		}
	}

	return -ENODATA;
}

void stream_tx_init(void)
{
	static bool thread_started;

	if (!thread_started) {
		static K_KERNEL_STACK_DEFINE(tx_thread_stack,
					     IS_ENABLED(CONFIG_LIBLC3) ? 4096U : 1024U);
		const int tx_thread_prio = K_PRIO_PREEMPT(5);
		static struct k_thread tx_thread;

		k_thread_create(&tx_thread, tx_thread_stack, K_KERNEL_STACK_SIZEOF(tx_thread_stack),
				tx_thread_func, NULL, NULL, NULL, tx_thread_prio, 0, K_NO_WAIT);
		k_thread_name_set(&tx_thread, "TX thread");
		thread_started = true;
	}
}
```
