## CMakeLists.txt
```
# SPDX-License-Identifier: Apache-2.0

cmake_minimum_required(VERSION 3.20.0)

find_package(Zephyr REQUIRED HINTS $ENV{ZEPHYR_BASE})
project(gpio_shakti_app)

target_sources(app PRIVATE src/main.c)
# zephyr_library_include_directories(include(zephyr(drivers(gpio_shakti.h))))
if(CONFIG_XIP)
    zephyr_code_relocate(src/main.c ROM_TEXT NOCOPY)
    zephyr_code_relocate(src/main.c ROM_DATA)
    zephyr_code_relocate(src/main.c ROM_BSS)
endif()
```

## prj.conf
```kconfig
CONFIG_GPIO=y
CONFIG_GPIO_SHAKTI=y
CONFIG_XIP=n
CONFIG_FLASH=y
CONFIG_FLASH_BASE_ADDRESS=0x90000000
```

## src/main.c
```c
#include <zephyr/kernel.h>
#include <stdio.h>
#include <zephyr/drivers/gpio_shakti.h>

void main(){
    
    const struct device *dev = DEVICE_DT_GET(DT_NODELABEL(gpio0)); //DEVICE_DT_GET_ONE(shakti_gpio0) This can also be used to define the device.
    printk("Hello World! %s\n", CONFIG_BOARD);
    gpio_shakti_init(dev);
    gpio_shakti_pin_configure(dev, 1, GPIO_OUTPUT);
    gpio_shakti_pin_set_raw(dev, 1, 1);

    // while(1){
    //     gpio_shakti_pin_set_raw(dev, 1, 1);
    //     for (int i=0; i<20; i++){}
    //     gpio_shakti_pin_clear_raw(dev, 1);
    // }
}
```
