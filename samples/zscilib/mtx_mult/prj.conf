## CMakeLists.txt
```
# SPDX-License-Identifier: Apache-2.0

cmake_minimum_required(VERSION 3.20.0)

find_package(Zephyr REQUIRED HINTS $ENV{ZEPHYR_BASE})

project(mtxmult)

target_sources(app PRIVATE src/main.c)
```

## sample.yaml
```
sample:
  description: Demonstrates matrix multiplication using zscilib.
  name: zscilib matrix multiply
tests:
  sample.mtx_mult:
    tags: zscilib
    platform_allow: mps2_an521 mps3_an547
    harness: console
    harness_config:
      type: multi_line
      regex:
        - "14.000000 17.000000 20.000000 23.000000"
        - "35.000000 44.000000 53.000000 62.000000"
        - "56.000000 71.000000 86.000000 101.000000"
        - "7.000000 9.000000 11.000000 13.000000"
```

## prj.conf
```kconfig
CONFIG_STDOUT_CONSOLE=y
CONFIG_SERIAL=y
CONFIG_FPU=y
CONFIG_TEST=y
CONFIG_THREAD_RUNTIME_STATS=y
CONFIG_NEWLIB_LIBC=y
CONFIG_NEWLIB_LIBC_FLOAT_PRINTF=y

CONFIG_MAIN_STACK_SIZE=4096

CONFIG_ZSL=y
CONFIG_ZSL_PLATFORM_OPT=2
CONFIG_ZSL_SINGLE_PRECISION=n
CONFIG_ZSL_VECTOR_INLINE=n
CONFIG_ZSL_MATRIX_INLINE=n
CONFIG_ZSL_BOUNDS_CHECKS=y
```

## src/main.c
```c
/*
 * Copyright (c) 2019 Kevin Townsend
 *
 * SPDX-License-Identifier: Apache-2.0
 */

#include <stdio.h>
#include <zephyr/kernel.h>
#include <zsl/zsl.h>
#include <zsl/matrices.h>

void test_mtx_mult_demo(void)
{
	int rc;

	ZSL_MATRIX_DEF(ma, 4, 3);       /* 4x3 matrix */
	ZSL_MATRIX_DEF(mb, 3, 4);       /* 3x4 matrix */
	ZSL_MATRIX_DEF(mc, 4, 4);       /* Resulting 4x4 matrix. */

	zsl_real_t ma_data[12] = {
		1.0, 2.0, 3.0,
		4.0, 5.0, 6.0,
		7.0, 8.0, 9.0,
		1.0, 1.0, 1.0
	};

	zsl_real_t mb_data[12] = {
		1.0, 2.0, 3.0, 4.0,
		5.0, 6.0, 7.0, 8.0,
		1.0, 1.0, 1.0, 1.0
	};

	/* Assign data to input matrices. */
	ma.data = ma_data;
	mb.data = mb_data;

	/* Initialise output matrix. */
	zsl_mtx_init(&mc, NULL);

	/* Multiply ma x mb. */
	rc = zsl_mtx_mult(&ma, &mb, &mc);
	if (rc) {
		printf("Error performing matrix multuplication: %d\n", rc);
		return;
	}

	printf("mtx multiply output (4x3 * 3x4 = 4x4):\n\n");
	zsl_mtx_print(&mc);
}

void main(void)
{
	printf("zscilib matrix mult demo\n\n");

	test_mtx_mult_demo();

	while (1) {
		k_sleep(K_FOREVER);
	}
}
```
