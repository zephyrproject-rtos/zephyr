## prj.conf
```kconfig
# Use standard security profile for maximum performance.

# all printf, fprintf to stdout go to console
CONFIG_STDOUT_CONSOLE=y

CONFIG_FLOAT=y
CONFIG_SSE=y
CONFIG_FP_SHARING=y
CONFIG_AUTOMATIC_FP_ENABLING=y
CONFIG_SSE_FP_MATH=y
CONFIG_NUM_COMMAND_PACKETS=20

# eliminate timer interrupts during the benchmark
CONFIG_SYS_CLOCK_TICKS_PER_SEC=1
```

## prj_atom.conf
```kconfig
# Use standard security profile for maximum performance.

# all printf, fprintf to stdout go to console
CONFIG_STDOUT_CONSOLE=y

CONFIG_FLOAT=y
CONFIG_SSE=y
CONFIG_FP_SHARING=y
CONFIG_SSE_FP_MATH=y
CONFIG_NUM_COMMAND_PACKETS=20

# eliminate timer interrupts during the benchmark
CONFIG_SYS_CLOCK_TICKS_PER_SEC=1
```

## prj_console_float_generic.conf
```kconfig
# Use standard security profile for maximum performance.
CONFIG_ENHANCED_SECURITY=n

# all printf, fprintf to stdout go to console
CONFIG_STDOUT_CONSOLE=y

CONFIG_FLOAT=y
CONFIG_SSE=y
CONFIG_FP_SHARING=y
CONFIG_AUTOMATIC_FP_ENABLING=y
CONFIG_SSE_FP_MATH=y
CONFIG_NUM_COMMAND_PACKETS=20

# eliminate timer interrupts during the benchmark
CONFIG_SYS_CLOCK_TICKS_PER_SEC=1
```

## prj_console_float_pc8253.conf
```kconfig
# Use standard security profile for maximum performance.
CONFIG_ENHANCED_SECURITY=n

# all printf, fprintf to stdout go to console
CONFIG_STDOUT_CONSOLE=y

CONFIG_FLOAT=y
CONFIG_SSE=y
CONFIG_FP_SHARING=y
CONFIG_AUTOMATIC_FP_ENABLING=y
CONFIG_SSE_FP_MATH=y
CONFIG_NUM_COMMAND_PACKETS=20

# minimize timer interrupts during the benchmark
# due the limitation of the i8253 divider register
# system timer tick period can't be set long
CONFIG_SYS_CLOCK_TICKS_PER_SEC=100
```

## prj_console_nofloat_generic.conf
```kconfig
# Use standard security profile for maximum performance.
CONFIG_ENHANCED_SECURITY=n

# all printf, fprintf to stdout go to console
CONFIG_STDOUT_CONSOLE=y
CONFIG_NUM_COMMAND_PACKETS=20

# eliminate timer interrupts during the benchmark
CONFIG_SYS_CLOCK_TICKS_PER_SEC=1
```

## prj_console_nofloat_pc8253.conf
```kconfig
# Use standard security profile for maximum performance.
CONFIG_ENHANCED_SECURITY=n

# all printf, fprintf to stdout go to console
CONFIG_STDOUT_CONSOLE=y
CONFIG_NUM_COMMAND_PACKETS=20

# minimize timer interrupts during the benchmark
# due the limitation of the i8253 divider register
# system timer tick period can't be set long
CONFIG_SYS_CLOCK_TICKS_PER_SEC=100
```

## src/config.h
```c
/* config.h */

/*
 * Copyright (c) 1997-2010, 2014-2015 Wind River Systems, Inc.
 *
 * Redistribution and use in source and binary forms, with or without
 * modification, are permitted provided that the following conditions are met:
 *
 * 1) Redistributions of source code must retain the above copyright notice,
 * this list of conditions and the following disclaimer.
 *
 * 2) Redistributions in binary form must reproduce the above copyright notice,
 * this list of conditions and the following disclaimer in the documentation
 * and/or other materials provided with the distribution.
 *
 * 3) Neither the name of Wind River Systems nor the names of its contributors
 * may be used to endorse or promote products derived from this software without
 * specific prior written permission.
 *
 * THIS SOFTWARE IS PROVIDED BY THE COPYRIGHT HOLDERS AND CONTRIBUTORS "AS IS"
 * AND ANY EXPRESS OR IMPLIED WARRANTIES, INCLUDING, BUT NOT LIMITED TO, THE
 * IMPLIED WARRANTIES OF MERCHANTABILITY AND FITNESS FOR A PARTICULAR PURPOSE
 * ARE DISCLAIMED. IN NO EVENT SHALL THE COPYRIGHT HOLDER OR CONTRIBUTORS BE
 * LIABLE FOR ANY DIRECT, INDIRECT, INCIDENTAL, SPECIAL, EXEMPLARY, OR
 * CONSEQUENTIAL DAMAGES (INCLUDING, BUT NOT LIMITED TO, PROCUREMENT OF
 * SUBSTITUTE GOODS OR SERVICES; LOSS OF USE, DATA, OR PROFITS; OR BUSINESS
 * INTERRUPTION) HOWEVER CAUSED AND ON ANY THEORY OF LIABILITY, WHETHER IN
 * CONTRACT, STRICT LIABILITY, OR TORT (INCLUDING NEGLIGENCE OR OTHERWISE)
 * ARISING IN ANY WAY OUT OF THE USE OF THIS SOFTWARE, EVEN IF ADVISED OF THE
 * POSSIBILITY OF SUCH DAMAGE.
 */

#ifndef _CONFIG_H
#define _CONFIG_H

/* Max size of a message string */
#define MAX_MSG 256

/* flag for performing the kernel call benchmark */
#define MICROKERNEL_CALL_BENCH

/* flag for performing the Mailbox benchmark */
#define MAILBOX_BENCH

/* flag for performing the Sema benchmark */
#define SEMA_BENCH

/* flag for performing the FIFO benchmark */
#define FIFO_BENCH

/* flag for performing the Mutex benchmark */
#define MUTEX_BENCH

/* flag for performing the Memory Map benchmark */
#define MEMMAP_BENCH

/* flag for performing the Memory Pool benchmark*/
#define MEMPOOL_BENCH

/* flag for performing the Pipes benchmark */
#define PIPE_BENCH

/* flag for performing the Event benchmark */
#define EVENT_BENCH

#endif /* _CONFIG_H */
```

## src/event_b.c
```c
/* event_b.c */

/*
 * Copyright (c) 1997-2014 Wind River Systems, Inc.
 *
 * Licensed under the Apache License, Version 2.0 (the "License");
 * you may not use this file except in compliance with the License.
 * You may obtain a copy of the License at
 *
 *     http://www.apache.org/licenses/LICENSE-2.0
 *
 * Unless required by applicable law or agreed to in writing, software
 * distributed under the License is distributed on an "AS IS" BASIS,
 * WITHOUT WARRANTIES OR CONDITIONS OF ANY KIND, either express or implied.
 * See the License for the specific language governing permissions and
 * limitations under the License.
 */

#include "master.h"

#ifdef EVENT_BENCH

/* #define EVENT_CHECK */
#ifdef EVENT_CHECK
static char EventSignalErr[] = "------------ Error signalling event.\n";
static char EventTestErr[] = "------------ Error testing event.\n";
static char EventHandlerErr[] = "------------ Error in event handler.\n";
#endif

/* global Event value */
volatile int nEventValue;

/*
 * Function prototypes.
 */
int example_handler (int event);

/*
 * Function declarations.
 */

/**
 *
 * @brief Event signal speed test
 *
 * @return N/A
 */
void event_test(void)
{
	int nReturn;
	int nCounter;
	uint32_t et; /* elapsed time */

	PRINT_STRING(dashline, output_file);
	et = BENCH_START();
	for (nCounter = 0; nCounter < NR_OF_EVENT_RUNS; nCounter++) {
		nReturn = task_event_send(TEST_EVENT);
#ifdef EVENT_CHECK
		if (nReturn != RC_OK) {
			PRINT_STRING(EventSignalErr, output_file);
			return; /* error */
		}
#endif /* EVENT_CHECK */
	}
	et = TIME_STAMP_DELTA_GET(et);
	check_result();

	PRINT_F(output_file, FORMAT, "Signal enabled event",
			SYS_CLOCK_HW_CYCLES_TO_NS_AVG(et, NR_OF_EVENT_RUNS));

	et = BENCH_START();
	for (nCounter = 0; nCounter < NR_OF_EVENT_RUNS; nCounter++) {
		nReturn = task_event_send(TEST_EVENT);
#ifdef EVENT_CHECK
		if (nReturn != RC_OK) {
			PRINT_STRING(EventSignalErr, output_file);
			task_sleep(SLEEP_TIME);
			return; /* error */
		}
#endif /* EVENT_CHECK */
		nReturn = task_event_recv(TEST_EVENT);
#ifdef EVENT_CHECK
		if (nReturn != RC_OK) {
			PRINT_STRING(EventTestErr, output_file);
			task_sleep(SLEEP_TIME);
			return; /* error */
		}
#endif /* EVENT_CHECK */
	}
	et = TIME_STAMP_DELTA_GET(et);
	check_result();

	PRINT_F(output_file, FORMAT, "Signal event & Test event",
			SYS_CLOCK_HW_CYCLES_TO_NS_AVG(et, NR_OF_EVENT_RUNS));

	et = BENCH_START();
	for (nCounter = 0; nCounter < NR_OF_EVENT_RUNS; nCounter++) {
		nReturn = task_event_send(TEST_EVENT);
#ifdef EVENT_CHECK
		if (nReturn != RC_OK) {
			PRINT_STRING(EventSignalErr, output_file);
			return; /* error */
		}
#endif /* EVENT_CHECK */
		nReturn = task_event_recv_wait(TEST_EVENT);
#ifdef EVENT_CHECK
		if (nReturn != RC_OK) {
			PRINT_STRING(EventTestErr, output_file);
			return; /* error */
		}
#endif /* EVENT_CHECK */
	}
	et = TIME_STAMP_DELTA_GET(et);
	check_result();

	PRINT_F(output_file, FORMAT, "Signal event & TestW event",
			SYS_CLOCK_HW_CYCLES_TO_NS_AVG(et, NR_OF_EVENT_RUNS));

	PRINT_STRING("| Signal event with installed handler"
				 "                                         |\n", output_file);
	nReturn = task_event_handler_set (TEST_EVENT, example_handler);
	if (nReturn != RC_OK) {
		PRINT_F(output_file, "-------- Error installing event handler.\n");
		task_sleep(SLEEP_TIME);
		return; /* error */
	}

	for (nCounter = 0; nCounter < NR_OF_EVENT_RUNS; nCounter++) {
		nReturn = task_event_send(TEST_EVENT);
#ifdef EVENT_CHECK
		if (nReturn != RC_OK) {
			PRINT_STRING(EventSignalErr, output_file);
			task_sleep(SLEEP_TIME);
			return; /* error */
		}
		if (nEventValue != TEST_EVENT + 1) {
			PRINT_STRING(EventHandlerErr, output_file);
			task_sleep(SLEEP_TIME);
			return; /* error */
		}
#endif /* EVENT_CHECK */
		nEventValue = 0;
	}

	nReturn = task_event_handler_set (TEST_EVENT, NULL);
	if (nReturn != RC_OK) {
		PRINT_F(output_file, "Error removing event handler.\n");
		task_sleep(SLEEP_TIME);
		return; /* error */
	}

	PRINT_STRING("|    Handler responds OK"
				 "                                                      |\n",
				 output_file);

	return; /* success */
}


/**
 *
 * @brief Event handler for the tests
 *
 * The event handler for the test. Sets up nEventValue global variable.
 * This variable is used in the main test.
 *
 * @return 1
 */
int example_handler (int event)
{
	nEventValue = event + 1;

	return 1;
}

#endif /* EVENT_BENCH */
```

## src/fifo_b.c
```c
/* fifo_b.c */

/*
 * Copyright (c) 1997-2010, 2013-2014 Wind River Systems, Inc.
 *
 * Licensed under the Apache License, Version 2.0 (the "License");
 * you may not use this file except in compliance with the License.
 * You may obtain a copy of the License at
 *
 *     http://www.apache.org/licenses/LICENSE-2.0
 *
 * Unless required by applicable law or agreed to in writing, software
 * distributed under the License is distributed on an "AS IS" BASIS,
 * WITHOUT WARRANTIES OR CONDITIONS OF ANY KIND, either express or implied.
 * See the License for the specific language governing permissions and
 * limitations under the License.
 */

#include "master.h"

#ifdef FIFO_BENCH

/**
 *
 * @brief Queue transfer speed test
 *
 * @return N/A
 */
void queue_test(void)
{
	uint32_t et; /* elapsed time */
	int i;

	PRINT_STRING(dashline, output_file);
	et = BENCH_START();
	for (i = 0; i < NR_OF_FIFO_RUNS; i++) {
		task_fifo_put(DEMOQX1, data_bench, TICKS_UNLIMITED);
	}
	et = TIME_STAMP_DELTA_GET(et);

	PRINT_F(output_file, FORMAT, "enqueue 1 byte msg in FIFO",
			SYS_CLOCK_HW_CYCLES_TO_NS_AVG(et, NR_OF_FIFO_RUNS));

	et = BENCH_START();
	for (i = 0; i < NR_OF_FIFO_RUNS; i++) {
		task_fifo_get_wait(DEMOQX1, data_bench);
	}
	et = TIME_STAMP_DELTA_GET(et);
	check_result();

	PRINT_F(output_file, FORMAT, "dequeue 1 byte msg in FIFO",
			SYS_CLOCK_HW_CYCLES_TO_NS_AVG(et, NR_OF_FIFO_RUNS));

	et = BENCH_START();
	for (i = 0; i < NR_OF_FIFO_RUNS; i++) {
		task_fifo_put(DEMOQX4, data_bench, TICKS_UNLIMITED);
	}
	et = TIME_STAMP_DELTA_GET(et);
	check_result();

	PRINT_F(output_file, FORMAT, "enqueue 4 bytes msg in FIFO",
			SYS_CLOCK_HW_CYCLES_TO_NS_AVG(et, NR_OF_FIFO_RUNS));

	et = BENCH_START();
	for (i = 0; i < NR_OF_FIFO_RUNS; i++) {
		task_fifo_get_wait(DEMOQX4, data_bench);
	}
	et = TIME_STAMP_DELTA_GET(et);
	check_result();

	PRINT_F(output_file, FORMAT, "dequeue 4 bytes msg in FIFO",
			SYS_CLOCK_HW_CYCLES_TO_NS_AVG(et, NR_OF_FIFO_RUNS));

	task_sem_give(STARTRCV);

	et = BENCH_START();
	for (i = 0; i < NR_OF_FIFO_RUNS; i++) {
		task_fifo_put(DEMOQX1, data_bench, TICKS_UNLIMITED);
	}
	et = TIME_STAMP_DELTA_GET(et);
	check_result();

	PRINT_F(output_file, FORMAT,
			"enqueue 1 byte msg in FIFO to a waiting higher priority task",
			SYS_CLOCK_HW_CYCLES_TO_NS_AVG(et, NR_OF_FIFO_RUNS));

	et = BENCH_START();
	for (i = 0; i < NR_OF_FIFO_RUNS; i++) {
		task_fifo_put(DEMOQX4, data_bench, TICKS_UNLIMITED);
	}
	et = TIME_STAMP_DELTA_GET(et);
	check_result();

	PRINT_F(output_file, FORMAT,
			"enqueue 4 bytes in FIFO to a waiting higher priority task",
			SYS_CLOCK_HW_CYCLES_TO_NS_AVG(et, NR_OF_FIFO_RUNS));
}

#endif /* FIFO_BENCH */
```

## src/fifo_r.c
```c
/* fifo_r.c */

/*
 * Copyright (c) 1997-2010, 2013-2014 Wind River Systems, Inc.
 *
 * Licensed under the Apache License, Version 2.0 (the "License");
 * you may not use this file except in compliance with the License.
 * You may obtain a copy of the License at
 *
 *     http://www.apache.org/licenses/LICENSE-2.0
 *
 * Unless required by applicable law or agreed to in writing, software
 * distributed under the License is distributed on an "AS IS" BASIS,
 * WITHOUT WARRANTIES OR CONDITIONS OF ANY KIND, either express or implied.
 * See the License for the specific language governing permissions and
 * limitations under the License.
 */

#include "receiver.h"
#include "master.h"

#ifdef FIFO_BENCH

/* queue transfer speed test */
/**
 *
 * @brief Data receive task
 *
 * @return N/A
 */
void dequtask(void)
{
	int x, i;

	for (i = 0; i < NR_OF_FIFO_RUNS; i++) {
		task_fifo_get(DEMOQX1, &x, TICKS_UNLIMITED);
	}

	for (i = 0; i < NR_OF_FIFO_RUNS; i++) {
		task_fifo_get(DEMOQX4, &x, TICKS_UNLIMITED);
	}
}

#endif /* FIFO_BENCH */
```

## src/mailbox_b.c
```c
/* mailbox_b.c */

/*
 * Copyright (c) 1997-2010, 2013-2014 Wind River Systems, Inc.
 *
 * Licensed under the Apache License, Version 2.0 (the "License");
 * you may not use this file except in compliance with the License.
 * You may obtain a copy of the License at
 *
 *     http://www.apache.org/licenses/LICENSE-2.0
 *
 * Unless required by applicable law or agreed to in writing, software
 * distributed under the License is distributed on an "AS IS" BASIS,
 * WITHOUT WARRANTIES OR CONDITIONS OF ANY KIND, either express or implied.
 * See the License for the specific language governing permissions and
 * limitations under the License.
 */

#include "master.h"

#ifdef MAILBOX_BENCH

static struct k_msg Message;

#ifdef FLOAT
#define PRINT_HEADER()                                                       \
	PRINT_STRING                                                             \
	   ("|   size(B) |       time/packet (usec)       |          MB/sec" \
	    "                |\n", output_file);
#define PRINT_ONE_RESULT()                                                   \
	PRINT_F(output_file, "|%11lu|%32.3f|%32f|\n", putsize, puttime / 1000.0, \
	     (1000.0 * putsize) / puttime)

#define PRINT_OVERHEAD()                                                     \
	PRINT_F(output_file,						\
	     "| message overhead:  %10.3f     usec/packet                   "\
	     "            |\n", EmptyMsgPutTime / 1000.0)

#define PRINT_XFER_RATE()                                                     \
	double NettoTransferRate;                                                 \
	NettoTransferRate = 1000.0 * (putsize >> 1) / (puttime - EmptyMsgPutTime);\
	PRINT_F(output_file,						\
	     "| raw transfer rate:     %10.3f MB/sec (without"		\
	     " overhead)                 |\n", NettoTransferRate)

#else
#define PRINT_HEADER()                                                       \
	PRINT_STRING                                                             \
	   ("|   size(B) |       time/packet (nsec)       |          KB/sec" \
	    "                |\n", output_file);

#define PRINT_ONE_RESULT()                                                   \
	PRINT_F(output_file, "|%11lu|%32lu|%32lu|\n", putsize, puttime,	\
	     (uint32_t)((1000000 * (uint64_t)putsize) / puttime))

#define PRINT_OVERHEAD()                                                     \
	PRINT_F(output_file,						\
	     "| message overhead:  %10u     nsec/packet                     "\
	     "          |\n", EmptyMsgPutTime)

#define PRINT_XFER_RATE()                                                    \
	PRINT_F(output_file, "| raw transfer rate:     %10lu KB/sec (without" \
	     " overhead)                 |\n",                               \
	     (uint32_t)(1000000 * (uint64_t)(putsize >> 1)                   \
	     / (puttime - EmptyMsgPutTime)))

#endif


/*
 * Function prototypes.
 */
void mailbox_put(uint32_t size, int count, uint32_t *time);

/*
 * Function declarations.
 */

/**
 *
 * @brief Mailbox transfer speed test
 *
 * @return N/A
 */
void mailbox_test(void)
{
	uint32_t putsize;
	uint32_t puttime;
	int putcount;
	unsigned int EmptyMsgPutTime;
	GetInfo getinfo;

	PRINT_STRING(dashline, output_file);
	PRINT_STRING("|                "
				 "M A I L B O X   M E A S U R E M E N T S"
				 "                      |\n", output_file);
	PRINT_STRING(dashline, output_file);
	PRINT_STRING("| Send mailbox message to waiting high "
				 "priority task and wait                 |\n", output_file);
	PRINT_F(output_file, "| repeat for %4d times and take the "
			"average                                  |\n",
			NR_OF_MBOX_RUNS);
	PRINT_STRING(dashline, output_file);
	PRINT_HEADER();
	PRINT_STRING(dashline, output_file);
	task_sem_reset(SEM0);
	task_sem_give(STARTRCV);

	putcount = NR_OF_MBOX_RUNS;

	putsize = 0;
	mailbox_put(putsize, putcount, &puttime);
	/* waiting for ack */
	task_fifo_get(MB_COMM, &getinfo, TICKS_UNLIMITED);
	PRINT_ONE_RESULT();
	EmptyMsgPutTime = puttime;
	for (putsize = 8; putsize <= MESSAGE_SIZE; putsize <<= 1) {
		mailbox_put(putsize, putcount, &puttime);
		/* waiting for ack */
		task_fifo_get(MB_COMM, &getinfo, TICKS_UNLIMITED);
		PRINT_ONE_RESULT();
	}
	PRINT_STRING(dashline, output_file);
	PRINT_OVERHEAD();
	PRINT_XFER_RATE();
}


/**
 *
 * @brief Write the number of data chunks into the mailbox
 *
 * @param size    The size of the data chunk.
 * @param count   Number of data chunks.
 * @param time    The total time.
 *
 * @return N/A
 */
void mailbox_put(uint32_t size, int count, uint32_t *time)
{
	int i;
	unsigned int t;

	Message.rx_task = ANYTASK;
	Message.tx_data = data_bench;
	Message.size = size;

	/* first sync with the receiver */
	task_sem_give(SEM0);
	t = BENCH_START();
	for (i = 0; i < count; i++) {
		task_mbox_put(MAILB1, 1, &Message, TICKS_UNLIMITED);
	}
	t = TIME_STAMP_DELTA_GET(t);
	*time = SYS_CLOCK_HW_CYCLES_TO_NS_AVG(t, count);
	check_result();
}

#endif /* MAILBOX_BENCH */
```

## src/mailbox_r.c
```c
/* mailbox_r.c */

/*
 * Copyright (c) 1997-2010, 2013-2014 Wind River Systems, Inc.
 *
 * Licensed under the Apache License, Version 2.0 (the "License");
 * you may not use this file except in compliance with the License.
 * You may obtain a copy of the License at
 *
 *     http://www.apache.org/licenses/LICENSE-2.0
 *
 * Unless required by applicable law or agreed to in writing, software
 * distributed under the License is distributed on an "AS IS" BASIS,
 * WITHOUT WARRANTIES OR CONDITIONS OF ANY KIND, either express or implied.
 * See the License for the specific language governing permissions and
 * limitations under the License.
 */

#include "receiver.h"
#include "master.h"

#ifdef MAILBOX_BENCH

/*
 * Function prototypes.
 */
int mailbox_get(kmbox_t mailbox,int size,int count,unsigned int* time);

/*
 * Function declarations.
 */

/* mailbox transfer speed test */

/**
 *
 * @brief Receive task
 *
 * @return N/A
 */
void mailrecvtask(void)
{
	int getsize;
	unsigned int gettime;
	int getcount;
	GetInfo getinfo;

	getcount = NR_OF_MBOX_RUNS;

	getsize = 0;
	mailbox_get(MAILB1, getsize, getcount, &gettime);
	getinfo.time = gettime;
	getinfo.size = getsize;
	getinfo.count = getcount;
	task_fifo_put_wait(MB_COMM, &getinfo); /* acknowledge to master */

	for (getsize = 8; getsize <= MESSAGE_SIZE; getsize <<= 1) {
		mailbox_get(MAILB1, getsize, getcount, &gettime);
		getinfo.time = gettime;
		getinfo.size = getsize;
		getinfo.count = getcount;
		task_fifo_put_wait(MB_COMM, &getinfo); /* acknowledge to master */
	}
}


/**
 *
 * @brief Receive data portions from the specified mailbox
 *
 * @return 0
 *
 * @param mailbox   The mailbox to read data from.
 * @param size      Size of each data portion.
 * @param count     Number of data portions.
 * @param time      Resulting time.
 */
int mailbox_get(kmbox_t mailbox, int size, int count, unsigned int* time)
{
	int i;
	unsigned int t;
	struct k_msg Message;

	Message.tx_task = ANYTASK;
	Message.rx_data = data_recv;
	Message.size = size;

	/* sync with the sender */
	task_sem_take_wait(SEM0);
	t = BENCH_START();
	for (i = 0; i < count; i++) {
		task_mbox_get(mailbox, &Message, TICKS_UNLIMITED);
	}

	t = TIME_STAMP_DELTA_GET(t);
	*time = SYS_CLOCK_HW_CYCLES_TO_NS_AVG(t, count);
	if (bench_test_end() < 0) {
		PRINT_OVERFLOW_ERROR();
	}
	return 0;
}

#endif /* MAILBOX_BENCH */
```

## src/master.c
```c
/* master.c */

/*
 * Copyright (c) 1997-2010,2013-2015 Wind River Systems, Inc.
 *
 * Licensed under the Apache License, Version 2.0 (the "License");
 * you may not use this file except in compliance with the License.
 * You may obtain a copy of the License at
 *
 *     http://www.apache.org/licenses/LICENSE-2.0
 *
 * Unless required by applicable law or agreed to in writing, software
 * distributed under the License is distributed on an "AS IS" BASIS,
 * WITHOUT WARRANTIES OR CONDITIONS OF ANY KIND, either express or implied.
 * See the License for the specific language governing permissions and
 * limitations under the License.
 */

/*
	File Naming information.
	------------------------
	Files that end with:
		_B : Is a file that contains a benchmark function
		_R : Is a file that contains the receiver task
			 of a benchmark function
 */

#include "master.h"

char Msg[MAX_MSG];
char data_bench[OCTET_TO_SIZEOFUNIT(MESSAGE_SIZE)];

#ifdef PIPE_BENCH
kpipe_t TestPipes[] = {PIPE_NOBUFF, PIPE_SMALLBUFF, PIPE_BIGBUFF};
#endif
const char dashline[] =
	"|--------------------------------------"
	"---------------------------------------|\n";
char sline[SLINE_LEN + 1];
const char newline[] = "\n";

FILE * output_file;

/*
 * Time in timer cycles necessary to read time.
 * Used for correction in time measurements.
 */
uint32_t tm_off;

/**
 *
 * @brief Check for keypress
 *
 * @return 1 when a keyboard key is pressed, or 0 if no keyboard support
 */
int kbhit(void)
{
	return 0;
}


/**
 *
 * @brief Prepares the test output
 *
 * @return N/A
 *
 * @param continuously   Run test till the user presses the key.
 * @param autorun        Expect user input.
 */
void init_output(int *continuously, int *autorun)
{
	ARG_UNUSED(continuously);
	ARG_UNUSED(autorun);

	/*
	 * send all printf and fprintf to console
	 */
	output_file = stdout;
}

/**
 *
 * @brief Close output for the test
 *
 * @return N/A
 */
void output_close(void)
{
}

/* no need to wait for user key press when using console */
#define WAIT_FOR_USER() {}


/**
 *
 * @brief Perform all selected benchmarks
 * see config.h to select or to unselect
 *
 * @return N/A
 */
void BenchTask(void)
{
	int autorun = 0, continuously = 0;

	init_output(&continuously, &autorun);
	bench_test_init();

	PRINT_STRING(newline, output_file);
	do {
		PRINT_STRING(dashline, output_file);
		PRINT_STRING("|          S I M P L E   S E R V I C E    "
					 "M E A S U R E M E N T S  |  nsec    |\n",
					 output_file);
		PRINT_STRING(dashline, output_file);
		task_start(RECVTASK);
		call_test();
		queue_test();
		sema_test();
		mutex_test();
		memorymap_test();
		mempool_test();
		event_test();
		mailbox_test();
		pipe_test();
		PRINT_STRING("|         END OF TESTS                     "
					 "                                   |\n",
					 output_file);
		PRINT_STRING(dashline, output_file);
		PRINT_STRING("PROJECT EXECUTION SUCCESSFUL\n",output_file);
	} while (continuously && !kbhit());

	WAIT_FOR_USER();

	if (autorun) {
		task_sleep(SECONDS(2));
	}

	output_close();
}


/**
 *
 * @brief Dummy test
 *
 * @return N/A
 */
void dummy_test(void)
{
	return;
}
```

## src/master.h
```c
/* master.h */

/*
 * Copyright (c) 1997-2010, 2014-2015 Wind River Systems, Inc.
 *
 * Licensed under the Apache License, Version 2.0 (the "License");
 * you may not use this file except in compliance with the License.
 * You may obtain a copy of the License at
 *
 *     http://www.apache.org/licenses/LICENSE-2.0
 *
 * Unless required by applicable law or agreed to in writing, software
 * distributed under the License is distributed on an "AS IS" BASIS,
 * WITHOUT WARRANTIES OR CONDITIONS OF ANY KIND, either express or implied.
 * See the License for the specific language governing permissions and
 * limitations under the License.
 */

#ifndef _MASTER_H
#define _MASTER_H

#include <microkernel.h>

#include <stdio.h>

#include "receiver.h"

#include <timestamp.h>

#include <string.h>

#include <misc/util.h>

/* uncomment the define below to use floating point arithmetic */
/* #define FLOAT */

/* printf format defines. */
#define FORMAT "| %-65s|%10lu|\n"

/* global defines */
/* number of nsec per usec */
#define NSEC_PER_USEC 1000

/* length of the output line */
#define SLINE_LEN 256

#define SLEEP_TIME ((sys_clock_ticks_per_sec / 4) > 0? sys_clock_ticks_per_sec / 4: 1)
#define WAIT_TIME ((sys_clock_ticks_per_sec / 10) > 0? sys_clock_ticks_per_sec / 10: 1)
#define NR_OF_NOP_RUNS 10000
#define NR_OF_FIFO_RUNS 500
#define NR_OF_SEMA_RUNS 500
#define NR_OF_MUTEX_RUNS 1000
#define NR_OF_POOL_RUNS 1000
#define NR_OF_MAP_RUNS 1000
#define NR_OF_EVENT_RUNS  1000
#define NR_OF_MBOX_RUNS 128
#define NR_OF_PIPE_RUNS 256
#define SEMA_WAIT_TIME (5 * sys_clock_ticks_per_sec)
/* global data */
extern char Msg[MAX_MSG];
extern char data_bench[OCTET_TO_SIZEOFUNIT(MESSAGE_SIZE)];
extern kpipe_t TestPipes[];
extern FILE * output_file;
extern const char dashline[];
extern const char newline[];
extern char sline[];

/* dummy_test is a function that is mapped when we */
/* do not want to test a specific Benchmark */
extern void dummy_test(void);

/* other external functions */
#ifdef MICROKERNEL_CALL_BENCH
extern void call_test(void);
#else
#define call_test dummy_test
#endif

#ifdef MAILBOX_BENCH
extern void mailbox_test(void);
#else
#define mailbox_test dummy_test
#endif

#ifdef SEMA_BENCH
extern void sema_test(void);
#else
#define sema_test dummy_test
#endif

#ifdef FIFO_BENCH
extern void queue_test(void);
#else
#define queue_test dummy_test
#endif

#ifdef MUTEX_BENCH
extern void mutex_test(void);
#else
#define mutex_test dummy_test
#endif

#ifdef MEMMAP_BENCH
extern void memorymap_test(void);
#else
#define memorymap_test dummy_test
#endif

#ifdef MEMPOOL_BENCH
extern void mempool_test(void);
#else
#define mempool_test dummy_test
#endif

#ifdef PIPE_BENCH
extern void pipe_test(void);
#else
#define pipe_test dummy_test
#endif

#ifdef EVENT_BENCH
extern void event_test(void);
#else
#define event_test dummy_test
#endif

/* PRINT_STRING
 * Macro to print an ASCII NULL terminated string. fprintf is used
 * so output can go to console.
 */
#define PRINT_STRING(string, stream)  fprintf(stream, string)

/* PRINT_F
 * Macro to print a formatted output string. fprintf is used when
 * Assumed that sline character array of SLINE_LEN + 1 characters
 * is defined in the main file
 */

#define PRINT_F(stream, fmt, ...)					\
{													\
	snprintf(sline, SLINE_LEN, fmt, ##__VA_ARGS__);	\
	PRINT_STRING(sline, stream);					\
}

#define PRINT_OVERFLOW_ERROR()						\
	PRINT_F(output_file, __FILE__":%d Error: tick occurred\n", __LINE__)

static inline uint32_t BENCH_START(void)
{
	uint32_t et;

	bench_test_start();
	et = TIME_STAMP_DELTA_GET(0);
	return et;
}

#define check_result()				\
{									\
	if (bench_test_end() < 0) {		\
		PRINT_OVERFLOW_ERROR();		\
		return; /* error */			\
	}								\
}


#endif /* _MASTER_H */
```

## src/memcfg.h
```c
/* memcfg.h */

/*
 * Copyright (c) 1997-2010, 2014 Wind River Systems, Inc.
 *
 * Redistribution and use in source and binary forms, with or without
 * modification, are permitted provided that the following conditions are met:
 *
 * 1) Redistributions of source code must retain the above copyright notice,
 * this list of conditions and the following disclaimer.
 *
 * 2) Redistributions in binary form must reproduce the above copyright notice,
 * this list of conditions and the following disclaimer in the documentation
 * and/or other materials provided with the distribution.
 *
 * 3) Neither the name of Wind River Systems nor the names of its contributors
 * may be used to endorse or promote products derived from this software without
 * specific prior written permission.
 *
 * THIS SOFTWARE IS PROVIDED BY THE COPYRIGHT HOLDERS AND CONTRIBUTORS "AS IS"
 * AND ANY EXPRESS OR IMPLIED WARRANTIES, INCLUDING, BUT NOT LIMITED TO, THE
 * IMPLIED WARRANTIES OF MERCHANTABILITY AND FITNESS FOR A PARTICULAR PURPOSE
 * ARE DISCLAIMED. IN NO EVENT SHALL THE COPYRIGHT HOLDER OR CONTRIBUTORS BE
 * LIABLE FOR ANY DIRECT, INDIRECT, INCIDENTAL, SPECIAL, EXEMPLARY, OR
 * CONSEQUENTIAL DAMAGES (INCLUDING, BUT NOT LIMITED TO, PROCUREMENT OF
 * SUBSTITUTE GOODS OR SERVICES; LOSS OF USE, DATA, OR PROFITS; OR BUSINESS
 * INTERRUPTION) HOWEVER CAUSED AND ON ANY THEORY OF LIABILITY, WHETHER IN
 * CONTRACT, STRICT LIABILITY, OR TORT (INCLUDING NEGLIGENCE OR OTHERWISE)
 * ARISING IN ANY WAY OUT OF THE USE OF THIS SOFTWARE, EVEN IF ADVISED OF THE
 * POSSIBILITY OF SUCH DAMAGE.
 */

#ifndef MESSAGE_H
#define MESSAGE_H

#define MESSAGE_SIZE        8192
#define MESSAGE_SIZE_PIPE   4096	/* must be smaller than MESSAGE_SIZE */

#endif
```

## src/memmap_b.c
```c
/* memmap_b.c */

/*
 * Copyright (c) 1997-2010, 2013-2014 Wind River Systems, Inc.
 *
 * Licensed under the Apache License, Version 2.0 (the "License");
 * you may not use this file except in compliance with the License.
 * You may obtain a copy of the License at
 *
 *     http://www.apache.org/licenses/LICENSE-2.0
 *
 * Unless required by applicable law or agreed to in writing, software
 * distributed under the License is distributed on an "AS IS" BASIS,
 * WITHOUT WARRANTIES OR CONDITIONS OF ANY KIND, either express or implied.
 * See the License for the specific language governing permissions and
 * limitations under the License.
 */

#include "master.h"
#include <zephyr.h>

#ifdef MEMMAP_BENCH


/**
 *
 * @brief Memory map get/free test
 *
 * @return N/A
 */
void memorymap_test(void)
{
	uint32_t et; /* elapsed time */
	int i;
	void* p;

	PRINT_STRING(dashline, output_file);
	et = BENCH_START();
	for (i = 0; i < NR_OF_MAP_RUNS; i++) {
		task_mem_map_alloc_wait(MAP1, &p);
		task_mem_map_free(MAP1, &p);
	}
	et = TIME_STAMP_DELTA_GET(et);
	check_result();

	PRINT_F(output_file, FORMAT, "average alloc and dealloc memory page",
			SYS_CLOCK_HW_CYCLES_TO_NS_AVG(et, (2 * NR_OF_MAP_RUNS)));
}

#endif /* MEMMAP_BENCH */
```

## src/mempool_b.c
```c
/* mempool_b.c */

/*
 * Copyright (c) 1997-2010, 2013-2014 Wind River Systems, Inc.
 *
 * Licensed under the Apache License, Version 2.0 (the "License");
 * you may not use this file except in compliance with the License.
 * You may obtain a copy of the License at
 *
 *     http://www.apache.org/licenses/LICENSE-2.0
 *
 * Unless required by applicable law or agreed to in writing, software
 * distributed under the License is distributed on an "AS IS" BASIS,
 * WITHOUT WARRANTIES OR CONDITIONS OF ANY KIND, either express or implied.
 * See the License for the specific language governing permissions and
 * limitations under the License.
 */

#include "master.h"

#ifdef MEMPOOL_BENCH

/**
 *
 * @brief Memory pool get/free test
 *
 * @return N/A
 */
void mempool_test(void)
{
	uint32_t et; /* elapsed time */
	int i;
	struct k_block block;

	PRINT_STRING(dashline, output_file);
	et = BENCH_START();
	for (i = 0; i < NR_OF_POOL_RUNS; i++) {
		task_mem_pool_alloc_wait(&block, DEMOPOOL, 16);
		task_mem_pool_free(&block);
	}
	et = TIME_STAMP_DELTA_GET(et);
	check_result();

	PRINT_F(output_file, FORMAT,
			"average alloc and dealloc memory pool block",
			SYS_CLOCK_HW_CYCLES_TO_NS_AVG(et, (2 * NR_OF_POOL_RUNS)));
}

#endif /* MEMPOOL_BENCH */
```

## src/mutex_b.c
```c
/* mutex_b.c */

/*
 * Copyright (c) 1997-2010, 2013-2015 Wind River Systems, Inc.
 *
 * Licensed under the Apache License, Version 2.0 (the "License");
 * you may not use this file except in compliance with the License.
 * You may obtain a copy of the License at
 *
 *     http://www.apache.org/licenses/LICENSE-2.0
 *
 * Unless required by applicable law or agreed to in writing, software
 * distributed under the License is distributed on an "AS IS" BASIS,
 * WITHOUT WARRANTIES OR CONDITIONS OF ANY KIND, either express or implied.
 * See the License for the specific language governing permissions and
 * limitations under the License.
 */

#include "master.h"

#ifdef MUTEX_BENCH

/**
 *
 * @brief Mutex lock/unlock test
 *
 * @return N/A
 */
void mutex_test(void)
{
	uint32_t et; /* elapsed time */
	int i;

	PRINT_STRING(dashline, output_file);
	et = BENCH_START();
	for (i = 0; i < NR_OF_MUTEX_RUNS; i++) {
		task_mutex_lock(DEMO_MUTEX, TICKS_UNLIMITED);
		task_mutex_unlock(DEMO_MUTEX);
	}
	et = TIME_STAMP_DELTA_GET(et);
	check_result();

	PRINT_F(output_file, FORMAT, "average lock and unlock mutex",
			SYS_CLOCK_HW_CYCLES_TO_NS_AVG(et, (2 * NR_OF_MUTEX_RUNS)));
}

#endif /* MUTEX_BENCH */
```
