## prj.conf
```kconfig
CONFIG_STDOUT_CONSOLE=y
CONFIG_SYS_LOG=y
CONFIG_SYS_LOG_DEFAULT_LEVEL=4
CONFIG_ARC_INIT=n
CONFIG_GPIO=y

#USB related configs
CONFIG_USB=y
CONFIG_USB_DW=y
CONFIG_USB_DEVICE_STACK=y
CONFIG_SYS_LOG_USB_DW_LEVEL=3
CONFIG_USB_MASS_STORAGE=y
CONFIG_SYS_LOG_USB_LEVEL=3
CONFIG_SYS_LOG_USB_MASS_STORAGE_LEVEL=4

# Not required but can't get the disk access layers to be built without this.
# To be removed once the KConfig coupling is resolved. But if both the USB
# host and embedded target FS code needs to access the disk fs contents,
# this is required.
CONFIG_FILE_SYSTEM=y

#SPI flash related configs
CONFIG_DISK_ACCESS_FLASH=y
CONFIG_FS_FAT_FLASH_DISK_W25QXXDV=y
CONFIG_FLASH=y
CONFIG_SPI=y
CONFIG_SPI_CS_GPIO=y
CONFIG_SPI_0_CS_GPIO_PIN=24

#Want RAM DISK instead ? comment the whole flash block and uncomment
#CONFIG_DISK_ACCESS_RAM=y
```

## src/main.c
```c
/*
 * Copyright (c) 2016 Intel Corporation.
 *
 * Licensed under the Apache License, Version 2.0 (the "License");
 * you may not use this file except in compliance with the License.
 * You may obtain a copy of the License at
 *
 *     http://www.apache.org/licenses/LICENSE-2.0
 *
 * Unless required by applicable law or agreed to in writing, software
 * distributed under the License is distributed on an "AS IS" BASIS,
 * WITHOUT WARRANTIES OR CONDITIONS OF ANY KIND, either express or implied.
 * See the License for the specific language governing permissions and
 * limitations under the License.
 */

/* Sample to put the device in USB mass storage mode backed on a 16k RAMDisk. */

#include <zephyr.h>
#include <logging/sys_log.h>

void main(void)
{
	/* Nothing to be done other than the selecting appropriate build
	 * config options. Everything is driven from the USB host side.
	 */
	SYS_LOG_INF("The device is put in USB mass storage mode.\n");
}
```
