## CMakeLists.txt
```
# SPDX-License-Identifier: Apache-2.0

cmake_minimum_required(VERSION 3.20.0)

find_package(Zephyr REQUIRED HINTS $ENV{ZEPHYR_BASE})
project(motor)

target_sources(app PRIVATE src/main.c)

if(CONFIG_XIP)
    zephyr_code_relocate(src/main.c ROM_TEXT NOCOPY)
    zephyr_code_relocate(src/main.c ROM_DATA)
    zephyr_code_relocate(src/main.c ROM_BSS)
endif()
```

## prj.conf
```kconfig
CONFIG_PWM=y
CONFIG_PWM_SHAKTI=y
CONFIG_GPIO=y
CONFIG_GPIO_SHAKTI=y
```

## src/main.c
```c
#include <zephyr/kernel.h>
#include <zephyr/device.h>
#include <zephyr/devicetree.h>

#include <stdio.h>
#include <string.h>

#include <zephyr/drivers/gpio.h>
#include <zephyr/logging/log.h>
LOG_MODULE_REGISTER(app, LOG_LEVEL_INF);
#include <zephyr/drivers/pwm.h>

/* pwmcfg Bit Offsets */
#define PWM_0 0


void main()
{
    
    const struct device *dev = DEVICE_DT_GET(DT_NODELABEL(gpio0)); //DEVICE_DT_GET_ONE(shakti_gpio0) This can also be used to define the device.
    const struct device *dev1 = DEVICE_DT_GET(DT_NODELABEL(pwm0));
    int ret;
    //ret = gpio_pin_configure(dev, 9, 0);
    ret = gpio_pin_configure(dev, 2, 1);
    pwm_set_cycles(dev1,PWM_0, 100, 50, PWM_POLARITY_NORMAL);
    ret = gpio_port_set_bits_raw(dev,2);
    while(1)
    {
    for(int i=0;i<10000;i++);
    ret = gpio_port_toggle_bits(dev, 2);
    
    }
}
```
