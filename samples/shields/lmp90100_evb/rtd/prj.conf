## CMakeLists.txt
```
# SPDX-License-Identifier: Apache-2.0

cmake_minimum_required(VERSION 3.28.0)

# This sample is specific to lmp90100_evb shield. Enforce -DSHIELD option
set(SHIELD lmp90100_evb)

find_package(Zephyr REQUIRED HINTS $ENV{ZEPHYR_BASE})
project(lmp90100_evb_rtd)

FILE(GLOB app_sources src/*.c)
target_sources(app PRIVATE ${app_sources})
```

## sample.yaml
```
sample:
  description: Demonstration of the LMP90100 EVB with RTD sensor
  name: LMP90100 EVB RTD
tests:
  sample.shields.lmp90100_evb.rtd:
    platform_allow: frdm_k64f
    harness: shield
    tags: shield
    depends_on: arduino_spi
```

## prj.conf
```kconfig
CONFIG_LOG=y
CONFIG_ADC=y
CONFIG_CBPRINTF_FP_SUPPORT=y
```

## app.overlay
```dts
/*
 * Copyright (c) 2019-2024 Vestas Wind Systems A/S
 *
 * SPDX-License-Identifier: Apache-2.0
 */

/ {
	zephyr,user {
		io-channels = <&lmp90100_lmp90100_evb 0>;
	};
};

&lmp90100_lmp90100_evb {
	#address-cells = <1>;
	#size-cells = <0>;

	rtd-current = <1000>;

	channel@0 {
		reg = <0>;
		zephyr,gain = "ADC_GAIN_1";
		zephyr,reference = "ADC_REF_EXTERNAL1";
		zephyr,acquisition-time = <ADC_ACQ_TIME(ADC_ACQ_TIME_TICKS, 0)>;
		zephyr,resolution = <24>;
		zephyr,differential;
		zephyr,input-positive = <0>;
		zephyr,input-negative = <1>;
	};
};
```

## src/main.c
```c
/*
 * Copyright (c) 2019-2024 Vestas Wind Systems A/S
 *
 * SPDX-License-Identifier: Apache-2.0
 */

#include <zephyr/kernel.h>
#include <zephyr/device.h>
#include <zephyr/drivers/adc.h>
#include <stdio.h>
#include <math.h>

#define LOG_LEVEL CONFIG_LOG_DEFAULT_LEVEL
#include <zephyr/logging/log.h>
LOG_MODULE_REGISTER(main);

/* Nominal RTD (PT100) resistance in ohms */
#define RTD_NOMINAL_RESISTANCE 100

/* ADC maximum value (taking sign bit into consideration) */
#define ADC_MAX(resolution) BIT_MASK(resolution - 1)

/* Bottom resistor value in ohms */
#define BOTTOM_RESISTANCE 2000

static double rtd_temperature(int nom, double resistance)
{
	const double a0 =  3.90802E-3;
	const double b0 = -0.58020E-6;
	double temp;

	temp = -nom * a0;
	temp += sqrt((nom * nom) * (a0 * a0) - 4.0 * nom * b0 *
		     (nom - resistance));
	temp /= 2.0 * nom * b0;

	return temp;
}

int main(void)
{
	const struct adc_dt_spec ch_cfg = ADC_DT_SPEC_GET(DT_PATH(zephyr_user));
	double adc_max = ADC_MAX(ch_cfg.resolution);
	double resistance;
	int32_t buffer;
	int err;
	struct adc_sequence seq = {
		.buffer = &buffer,
		.buffer_size = sizeof(buffer),
	};

	if (!adc_is_ready_dt(&ch_cfg)) {
		LOG_ERROR("LMP90100 device not ready");
		return 0;
	}

	err = adc_channel_setup_dt(&ch_cfg);
	if (err != 0) {
		LOG_ERROR("failed to setup ADC channel (err %d)", err);
		return 0;
	}

	err = adc_sequence_init_dt(&ch_cfg, &seq);
	if (err != 0) {
		LOG_ERROR("failed to initialize ADC sequence (err %d)", err);
		return 0;
	}

	while (true) {
		err = adc_read_dt(&ch_cfg, &seq);
		if (err != 0) {
			LOG_ERROR("failed to read ADC (err %d)", err);
		} else {
			resistance = (buffer / adc_max) * BOTTOM_RESISTANCE;
			printf("R: %.02f ohm\n", resistance);
			printf("T: %.02f degC\n",
				rtd_temperature(RTD_NOMINAL_RESISTANCE,
						resistance));
		}

		k_sleep(K_MSEC(1000));
	}
	return 0;
}
```
