/*
 * Copyright (c) 2019-2024 Vestas Wind Systems A/S
 *
 * SPDX-License-Identifier: Apache-2.0
 */

/ {
	zephyr,user {
		io-channels = <&lmp90100_lmp90100_evb 0>;
	};
};

&lmp90100_lmp90100_evb {
	#address-cells = <1>;
	#size-cells = <0>;

	rtd-current = <1000>;

	channel@0 {
		reg = <0>;
		zephyr,gain = "ADC_GAIN_1";
		zephyr,reference = "ADC_REF_EXTERNAL1";
		zephyr,acquisition-time = <ADC_ACQ_TIME(ADC_ACQ_TIME_TICKS, 0)>;
		zephyr,resolution = <24>;
		zephyr,differential;
		zephyr,input-positive = <0>;
		zephyr,input-negative = <1>;
	};
};
