## CMakeLists.txt
```
# Copyright (c) 2025 Renesas Electronics Corporation
# SPDX-License-Identifier: Apache-2.0

cmake_minimum_required(VERSION 3.28.0)
find_package(Zephyr REQUIRED HINTS $ENV{ZEPHYR_BASE})
project(rtk0eg0019b01002bj)

target_sources(app PRIVATE src/main.c)

if(CONFIG_INPUT_RENESAS_RA_QE_TOUCH_CFG)
  zephyr_include_directories(src)
  zephyr_sources(src/qe_touch_config.c)
endif()
```

## sample.yaml
```
sample:
  name: RTK0EG0019B01002BJ Capacitive Touch Application Shield
tests:
  sample.shields.rtk0eg0019b01002bj:
    harness: shield
    tags: shield
    platform_allow:
      - rssk_ra2l1
    extra_args: SHIELD=rtk0eg0019b01002bj
```

## prj.conf
```kconfig
# Copyright (c) 2025 Renesas Electronics Corporation
# SPDX-License-Identifier: Apache-2.0

CONFIG_LOG=y
CONFIG_LOG_MODE_MINIMAL=y

CONFIG_INPUT=y
CONFIG_INPUT_EVENT_DUMP=y
CONFIG_GPIO=y
```

## src/main.c
```c
/*
 * Copyright (c) 2025 Renesas Electronics Corporation
 *
 * SPDX-License-Identifier: Apache-2.0
 */

#include <stdint.h>
#include <zephyr/device.h>
#include <zephyr/drivers/gpio.h>
#include <zephyr/input/input.h>
#include <zephyr/input/input_renesas_ra_ctsu.h>
#include <zephyr/sys/printk.h>

#ifdef CONFIG_INPUT_RENESAS_RA_QE_TOUCH_CFG
#include "qe_touch_config.h"
#endif /* CONFIG_INPUT_RENESAS_RA_QE_TOUCH_CFG*/

#define BUTTON1 DT_NODELABEL(rtk0eg0019b01002bj_bt1)
#define BUTTON2 DT_NODELABEL(rtk0eg0019b01002bj_bt2)
#define BUTTON3 DT_NODELABEL(rtk0eg0019b01002bj_bt3)
#define SLIDER  DT_NODELABEL(rtk0eg0019b01002bj_slider)
#define WHEEL   DT_NODELABEL(rtk0eg0019b01002bj_wheel)

#define QE_TOUCH_CFG1 DT_CHILD(DT_NODELABEL(rtk0eg0019b01002bj_ctsu), group1)
#define QE_TOUCH_CFG2 DT_CHILD(DT_NODELABEL(rtk0eg0019b01002bj_ctsu), group2)
#define QE_TOUCH_CFG3 DT_CHILD(DT_NODELABEL(rtk0eg0019b01002bj_ctsu), group3)

#define NUM_ROWS DT_PROP_LEN(DT_PATH(zephyr_user), rtk0eg0019b01002bj_led_row_gpios)
#define NUM_COLS DT_PROP_LEN(DT_PATH(zephyr_user), rtk0eg0019b01002bj_led_col_gpios)

#define LED_MATRIX_ROWS(idx, nodeid)                                                               \
	GPIO_DT_SPEC_GET_BY_IDX(nodeid, rtk0eg0019b01002bj_led_row_gpios, idx)
#define LED_MATRIX_COLS(idx, nodeid)                                                               \
	GPIO_DT_SPEC_GET_BY_IDX(nodeid, rtk0eg0019b01002bj_led_col_gpios, idx)

#define BUTTON_LED_NUM (3U)

#define SLIDER_LED_NUM    (5U)
#define SLIDER_RESOLUTION (100)

#define WHEEL_LED_NUM           (8U)
#define WHEEL_RESOLUTION_DEGREE (360)

static const struct gpio_dt_spec led_row[NUM_ROWS] = {
	LISTIFY(NUM_ROWS, LED_MATRIX_ROWS, (,), DT_PATH(zephyr_user)),
};

static const struct gpio_dt_spec led_col[NUM_COLS] = {
	LISTIFY(NUM_COLS, LED_MATRIX_COLS, (,), DT_PATH(zephyr_user)),
};

static const unsigned int wheel_leds_lut[WHEEL_LED_NUM] = {0, 1, 2, 3, 4, 5, 6, 7};
static const unsigned int slider_leds_lut[SLIDER_LED_NUM] = {8, 9, 10, 11, 12};
static const unsigned int button_leds_lut[BUTTON_LED_NUM] = {13, 14, 15};

static void rtk0eg0019b01002bj_led_output(unsigned int led_idx, bool on)
{
	/* Refer to RTK0EG0022S01001BJ - Design Package for the Touch Application board layout */
	static const unsigned int led_map[NUM_ROWS * NUM_COLS][2] = {
		{0, 0}, {1, 0}, {2, 0}, {3, 0}, {0, 1}, {1, 1}, {2, 1}, {3, 1},
		{0, 3}, {1, 3}, {2, 3}, {3, 3}, {0, 2}, {1, 2}, {2, 2}, {3, 2},
	};
	const struct gpio_dt_spec *p_led_row = &led_row[led_map[led_idx][0]];
	const struct gpio_dt_spec *p_led_col = &led_col[led_map[led_idx][1]];

	gpio_pin_set_dt(p_led_row, on ? 1 : 0);
	gpio_pin_set_dt(p_led_col, on ? 1 : 0);
}

static void rtk0eg0019b01002bj_led_init(void)
{
	for (int i = 0; i < NUM_ROWS; i++) {
		gpio_pin_configure_dt(&led_row[i], GPIO_OUTPUT_INACTIVE);
	}

	for (int i = 0; i < NUM_COLS; i++) {
		gpio_pin_configure_dt(&led_col[i], GPIO_OUTPUT_INACTIVE);
	}
}

static void blink_leds(unsigned int duration_ms)
{
	for (int i = 0; i < 5; i++) {
		/* Turn all LEDs ON */
		for (int j = 0; j < NUM_ROWS * NUM_COLS; j++) {
			rtk0eg0019b01002bj_led_output(j, true);
		}
		k_msleep(duration_ms);

		/* Turn all LEDs OFF */
		for (int j = 0; j < NUM_ROWS * NUM_COLS; j++) {
			rtk0eg0019b01002bj_led_output(j, false);
		}
		k_msleep(duration_ms);
	}
}

static inline unsigned int wheel_get_current_step(unsigned int value)
{
	return (value * WHEEL_LED_NUM) / WHEEL_RESOLUTION_DEGREE;
}

static inline unsigned int slider_get_current_step(unsigned int value)
{
	return (value * SLIDER_LED_NUM) / SLIDER_RESOLUTION;
}

static void rtk0eg0019b01002bj_evt_handler(struct input_event *evt, void *user_data)
{
	unsigned int led_idx;

	/* Set all LEDs to OFF */
	for (int i = 0; i < NUM_ROWS * NUM_COLS; i++) {
		rtk0eg0019b01002bj_led_output(i, false);
	}

	switch (evt->code) {
	case INPUT_KEY_0: {
		led_idx = button_leds_lut[0];
		break;
	}
	case INPUT_KEY_1: {
		led_idx = button_leds_lut[1];
		break;
	}
	case INPUT_KEY_2: {
		led_idx = button_leds_lut[2];
		break;
	}
	case INPUT_ABS_WHEEL: {
		led_idx = wheel_get_current_step(evt->value) + wheel_leds_lut[0];
		break;
	}
	case INPUT_ABS_THROTTLE: {
		led_idx = slider_get_current_step(evt->value) + slider_leds_lut[0];
		break;
	}
	default:
		/* Unexpected event */
		return;
	}

	rtk0eg0019b01002bj_led_output(led_idx, true);
}

INPUT_CALLBACK_DEFINE_NAMED(DEVICE_DT_GET(BUTTON1), rtk0eg0019b01002bj_evt_handler, NULL, button1);
INPUT_CALLBACK_DEFINE_NAMED(DEVICE_DT_GET(BUTTON2), rtk0eg0019b01002bj_evt_handler, NULL, button2);
INPUT_CALLBACK_DEFINE_NAMED(DEVICE_DT_GET(BUTTON3), rtk0eg0019b01002bj_evt_handler, NULL, button3);
INPUT_CALLBACK_DEFINE_NAMED(DEVICE_DT_GET(SLIDER), rtk0eg0019b01002bj_evt_handler, NULL, slider);
INPUT_CALLBACK_DEFINE_NAMED(DEVICE_DT_GET(WHEEL), rtk0eg0019b01002bj_evt_handler, NULL, wheel);

int main(void)
{
#ifdef CONFIG_INPUT_RENESAS_RA_QE_TOUCH_CFG
	const struct device *qe_touch_cfg1 = DEVICE_DT_GET(QE_TOUCH_CFG1);
	const struct device *qe_touch_cfg2 = DEVICE_DT_GET(QE_TOUCH_CFG2);
	const struct device *qe_touch_cfg3 = DEVICE_DT_GET(QE_TOUCH_CFG3);
	int ret;
#endif
	rtk0eg0019b01002bj_led_init();

	/* Blink all leds 5 times, each time is 200ms */
	blink_leds(200);

#ifdef CONFIG_INPUT_RENESAS_RA_QE_TOUCH_CFG
	ret = renesas_ra_ctsu_group_configure(
		qe_touch_cfg1, (struct renesas_ra_ctsu_touch_cfg *)&g_qe_touch_instance_config01);
	if (ret < 0) {
		printk("Failed to configure QE Touch Group 1: %d\n", ret);
		return ret;
	}

	ret = renesas_ra_ctsu_group_configure(
		qe_touch_cfg2, (struct renesas_ra_ctsu_touch_cfg *)&g_qe_touch_instance_config02);
	if (ret < 0) {
		printk("Failed to configure QE Touch Group 2: %d\n", ret);
		return ret;
	}

	ret = renesas_ra_ctsu_group_configure(
		qe_touch_cfg3, (struct renesas_ra_ctsu_touch_cfg *)&g_qe_touch_instance_config03);
	if (ret < 0) {
		printk("Failed to configure QE Touch Group 3: %d\n", ret);
		return ret;
	}
#endif

	printk("rtk0eg0019b01002bj sample started\n");
	return 0;
}
```

## src/qe_touch_config.c
```c
/*
 * Copyright (c) 2025 Renesas Electronics Corporation
 *
 * SPDX-License-Identifier: Apache-2.0
 */

/* Generated content from Renesas QE Capacitive Touch */

#include "qe_touch_config.h"

volatile uint8_t g_qe_touch_flag;
volatile ctsu_event_t g_qe_ctsu_event;

void qe_touch_callback(touch_callback_args_t *p_args)
{
	g_qe_touch_flag = 1;
	g_qe_ctsu_event = p_args->event;
}

/* CTSU Related Information for [CONFIG01] configuration. */

const ctsu_element_cfg_t g_qe_ctsu_element_cfg_config01[] = {
	{.ssdiv = CTSU_SSDIV_4000, .so = 0x000, .snum = 0x07, .sdpa = 0x1F},
	{.ssdiv = CTSU_SSDIV_4000, .so = 0x00F, .snum = 0x07, .sdpa = 0x1F},
	{.ssdiv = CTSU_SSDIV_4000, .so = 0x007, .snum = 0x07, .sdpa = 0x1F},
};

const ctsu_cfg_t g_qe_ctsu_cfg_config01 = {
	.cap = CTSU_CAP_SOFTWARE,

	.txvsel = CTSU_TXVSEL_INTERNAL_POWER,
	.txvsel2 = CTSU_TXVSEL_MODE,

	.atune12 = CTSU_ATUNE12_40UA,
	.md = CTSU_MODE_SELF_MULTI_SCAN,
	.posel = CTSU_POSEL_SAME_PULSE,

	.ctsuchac0 = 0x01,  /* ch0-ch7 enable mask */
	.ctsuchac1 = 0x0E,  /* ch8-ch15 enable mask */
	.ctsuchac2 = 0x00,  /* ch16-ch23 enable mask */
	.ctsuchac3 = 0x00,  /* ch24-ch31 enable mask */
	.ctsuchac4 = 0x00,  /* ch32-ch39 enable mask */
	.ctsuchtrc0 = 0x01, /* ch0-ch7 mutual tx mask */
	.ctsuchtrc1 = 0x00, /* ch8-ch15 mutual tx mask */
	.ctsuchtrc2 = 0x00, /* ch16-ch23 mutual tx mask */
	.ctsuchtrc3 = 0x00, /* ch24-ch31 mutual tx mask */
	.ctsuchtrc4 = 0x00, /* ch32-ch39 mutual tx mask */
	.num_rx = 3,
	.num_tx = 0,
	.p_elements = g_qe_ctsu_element_cfg_config01,

#if (CTSU_TARGET_VALUE_CONFIG_SUPPORT == 1)
	.tuning_self_target_value = 4608,
	.tuning_mutual_target_value = 10240,
#endif

	.num_moving_average = 4,
	.p_callback = &qe_touch_callback,
#if (CTSU_CFG_DTC_SUPPORT_ENABLE == 1)
	.p_transfer_tx = &g_transfer0,
	.p_transfer_rx = &g_transfer1,
#else
	.p_transfer_tx = NULL,
	.p_transfer_rx = NULL,
#endif

	.write_irq = CTSU_WRITE_IRQn,
	.read_irq = CTSU_READ_IRQn,
	.end_irq = CTSU_END_IRQn,

};

ctsu_instance_ctrl_t g_qe_ctsu_ctrl_config01;

const ctsu_instance_t g_qe_ctsu_instance_config01 = {
	.p_ctrl = &g_qe_ctsu_ctrl_config01,
	.p_cfg = &g_qe_ctsu_cfg_config01,
	.p_api = &g_ctsu_on_ctsu,
};

/* Touch Related Information for [CONFIG01] configuration. */

#define QE_TOUCH_CONFIG01_NUM_BUTTONS    (3)
#define QE_TOUCH_CONFIG01_NUM_SLIDERS    (0)
#define QE_TOUCH_CONFIG01_NUM_WHEELS     (0)
#define QE_TOUCH_CONFIG01_NUM_TOUCH_PADS (0)

#if (QE_TOUCH_CONFIG01_NUM_BUTTONS != 0)
const touch_button_cfg_t g_qe_touch_button_cfg_config01[] = {
	{
		.elem_index = 2,
		.threshold = 261,
		.hysteresis = 13,
	},
	{
		.elem_index = 1,
		.threshold = 226,
		.hysteresis = 11,
	},
	{
		.elem_index = 0,
		.threshold = 306,
		.hysteresis = 15,
	},
};
#endif

#if (QE_TOUCH_CONFIG01_NUM_SLIDERS != 0)
const touch_slider_cfg_t g_qe_touch_slider_cfg_config01[] = {NULL};
#endif

#if (QE_TOUCH_CONFIG01_NUM_WHEELS != 0)
const touch_wheel_cfg_t g_qe_touch_wheel_cfg_config01[] = {NULL};
#endif

#if (QE_TOUCH_CONFIG01_NUM_TOUCH_PADS != 0)
const touch_pad_cfg_t g_qe_touch_touch_pad_cfg_config01 = {NULL};
#endif

const touch_cfg_t g_qe_touch_cfg_config01 = {
	.p_buttons = g_qe_touch_button_cfg_config01,
	.p_sliders = NULL,
	.p_wheels = NULL,
#if (TOUCH_CFG_PAD_ENABLE != 0)
	.p_pad = NULL,
#endif
	.num_buttons = QE_TOUCH_CONFIG01_NUM_BUTTONS,
	.num_sliders = QE_TOUCH_CONFIG01_NUM_SLIDERS,
	.num_wheels = QE_TOUCH_CONFIG01_NUM_WHEELS,

	.number = 0,
#if ((TOUCH_CFG_UART_MONITOR_SUPPORT == 1) || (TOUCH_CFG_UART_TUNING_SUPPORT == 1))
	.p_uart_instance = &g_uart_qe,
#else
	.p_uart_instance = NULL,
#endif

	.on_freq = 3,
	.off_freq = 3,
	.drift_freq = 255,
	.cancel_freq = 0,

	.p_ctsu_instance = &g_qe_ctsu_instance_config01,
};

touch_instance_ctrl_t g_qe_touch_ctrl_config01;

const touch_instance_t g_qe_touch_instance_config01 = {
	.p_ctrl = &g_qe_touch_ctrl_config01,
	.p_cfg = &g_qe_touch_cfg_config01,
	.p_api = &g_touch_on_ctsu,
};

/* CTSU Related Information for [CONFIG02] configuration. */

const ctsu_element_cfg_t g_qe_ctsu_element_cfg_config02[] = {
	{.ssdiv = CTSU_SSDIV_4000, .so = 0x021, .snum = 0x07, .sdpa = 0x0F},
	{.ssdiv = CTSU_SSDIV_4000, .so = 0x032, .snum = 0x07, .sdpa = 0x0F},
	{.ssdiv = CTSU_SSDIV_4000, .so = 0x02C, .snum = 0x07, .sdpa = 0x0F},
	{.ssdiv = CTSU_SSDIV_4000, .so = 0x034, .snum = 0x07, .sdpa = 0x0F},
	{.ssdiv = CTSU_SSDIV_4000, .so = 0x032, .snum = 0x07, .sdpa = 0x0F},
};

const ctsu_cfg_t g_qe_ctsu_cfg_config02 = {
	.cap = CTSU_CAP_SOFTWARE,

	.txvsel = CTSU_TXVSEL_INTERNAL_POWER,
	.txvsel2 = CTSU_TXVSEL_MODE,

	.atune12 = CTSU_ATUNE12_40UA,
	.md = CTSU_MODE_SELF_MULTI_SCAN,
	.posel = CTSU_POSEL_SAME_PULSE,

	.ctsuchac0 = 0xF4,  /* ch0-ch7 enable mask */
	.ctsuchac1 = 0x01,  /* ch8-ch15 enable mask */
	.ctsuchac2 = 0x00,  /* ch16-ch23 enable mask */
	.ctsuchac3 = 0x00,  /* ch24-ch31 enable mask */
	.ctsuchac4 = 0x00,  /* ch32-ch39 enable mask */
	.ctsuchtrc0 = 0x00, /* ch0-ch7 mutual tx mask */
	.ctsuchtrc1 = 0x01, /* ch8-ch15 mutual tx mask */
	.ctsuchtrc2 = 0x00, /* ch16-ch23 mutual tx mask */
	.ctsuchtrc3 = 0x00, /* ch24-ch31 mutual tx mask */
	.ctsuchtrc4 = 0x00, /* ch32-ch39 mutual tx mask */
	.num_rx = 5,
	.num_tx = 0,
	.p_elements = g_qe_ctsu_element_cfg_config02,

#if (CTSU_TARGET_VALUE_CONFIG_SUPPORT == 1)
	.tuning_self_target_value = 4608,
	.tuning_mutual_target_value = 10240,
#endif

	.num_moving_average = 4,
	.p_callback = &qe_touch_callback,
#if (CTSU_CFG_DTC_SUPPORT_ENABLE == 1)
	.p_transfer_tx = &g_transfer0,
	.p_transfer_rx = &g_transfer1,
#else
	.p_transfer_tx = NULL,
	.p_transfer_rx = NULL,
#endif

	.write_irq = CTSU_WRITE_IRQn,
	.read_irq = CTSU_READ_IRQn,
	.end_irq = CTSU_END_IRQn,

};

ctsu_instance_ctrl_t g_qe_ctsu_ctrl_config02;

const ctsu_instance_t g_qe_ctsu_instance_config02 = {
	.p_ctrl = &g_qe_ctsu_ctrl_config02,
	.p_cfg = &g_qe_ctsu_cfg_config02,
	.p_api = &g_ctsu_on_ctsu,
};

/* Touch Related Information for [CONFIG02] configuration. */

#define QE_TOUCH_CONFIG02_NUM_BUTTONS    (0)
#define QE_TOUCH_CONFIG02_NUM_SLIDERS    (1)
#define QE_TOUCH_CONFIG02_NUM_WHEELS     (0)
#define QE_TOUCH_CONFIG02_NUM_TOUCH_PADS (0)

#if (QE_TOUCH_CONFIG02_NUM_BUTTONS != 0)
const touch_button_cfg_t g_qe_touch_button_cfg_config02[] = {NULL};
#endif

const uint8_t g_qe_touch_elem_slider_config02_slider00[] = {1, 0, 2, 4, 3};

#if (QE_TOUCH_CONFIG02_NUM_SLIDERS != 0)
const touch_slider_cfg_t g_qe_touch_slider_cfg_config02[] = {
	{
		.p_elem_index = g_qe_touch_elem_slider_config02_slider00,
		.num_elements = 5,
		.threshold = 570,
	},
};
#endif

#if (QE_TOUCH_CONFIG02_NUM_WHEELS != 0)
const touch_wheel_cfg_t g_qe_touch_wheel_cfg_config02[] = {NULL};
#endif

#if (QE_TOUCH_CONFIG02_NUM_TOUCH_PADS != 0)
const touch_pad_cfg_t g_qe_touch_touch_pad_cfg_config02 = {NULL};
#endif

const touch_cfg_t g_qe_touch_cfg_config02 = {
	.p_buttons = NULL,
	.p_sliders = g_qe_touch_slider_cfg_config02,
	.p_wheels = NULL,
#if (TOUCH_CFG_PAD_ENABLE != 0)
	.p_pad = NULL,
#endif
	.num_buttons = QE_TOUCH_CONFIG02_NUM_BUTTONS,
	.num_sliders = QE_TOUCH_CONFIG02_NUM_SLIDERS,
	.num_wheels = QE_TOUCH_CONFIG02_NUM_WHEELS,

	.number = 1,
#if ((TOUCH_CFG_UART_MONITOR_SUPPORT == 1) || (TOUCH_CFG_UART_TUNING_SUPPORT == 1))
	.p_uart_instance = &g_uart_qe,
#else
	.p_uart_instance = NULL,
#endif

	.on_freq = 3,
	.off_freq = 3,
	.drift_freq = 255,
	.cancel_freq = 0,

	.p_ctsu_instance = &g_qe_ctsu_instance_config02,
};

touch_instance_ctrl_t g_qe_touch_ctrl_config02;

const touch_instance_t g_qe_touch_instance_config02 = {
	.p_ctrl = &g_qe_touch_ctrl_config02,
	.p_cfg = &g_qe_touch_cfg_config02,
	.p_api = &g_touch_on_ctsu,
};

/* CTSU Related Information for [CONFIG03] configuration. */

const ctsu_element_cfg_t g_qe_ctsu_element_cfg_config03[] = {
	{.ssdiv = CTSU_SSDIV_4000, .so = 0x03F, .snum = 0x07, .sdpa = 0x0F},
	{.ssdiv = CTSU_SSDIV_4000, .so = 0x03D, .snum = 0x07, .sdpa = 0x0F},
	{.ssdiv = CTSU_SSDIV_4000, .so = 0x041, .snum = 0x07, .sdpa = 0x0F},
	{.ssdiv = CTSU_SSDIV_4000, .so = 0x037, .snum = 0x07, .sdpa = 0x0F},
};

const ctsu_cfg_t g_qe_ctsu_cfg_config03 = {
	.cap = CTSU_CAP_SOFTWARE,

	.txvsel = CTSU_TXVSEL_INTERNAL_POWER,
	.txvsel2 = CTSU_TXVSEL_MODE,

	.atune12 = CTSU_ATUNE12_40UA,
	.md = CTSU_MODE_SELF_MULTI_SCAN,
	.posel = CTSU_POSEL_SAME_PULSE,

	.ctsuchac0 = 0x00,  /* ch0-ch7 enable mask */
	.ctsuchac1 = 0x40,  /* ch8-ch15 enable mask */
	.ctsuchac2 = 0xA4,  /* ch16-ch23 enable mask */
	.ctsuchac3 = 0x00,  /* ch24-ch31 enable mask */
	.ctsuchac4 = 0x01,  /* ch32-ch39 enable mask */
	.ctsuchtrc0 = 0x00, /* ch0-ch7 mutual tx mask */
	.ctsuchtrc1 = 0x40, /* ch8-ch15 mutual tx mask */
	.ctsuchtrc2 = 0x00, /* ch16-ch23 mutual tx mask */
	.ctsuchtrc3 = 0x00, /* ch24-ch31 mutual tx mask */
	.ctsuchtrc4 = 0x00, /* ch32-ch39 mutual tx mask */
	.num_rx = 4,
	.num_tx = 0,
	.p_elements = g_qe_ctsu_element_cfg_config03,

#if (CTSU_TARGET_VALUE_CONFIG_SUPPORT == 1)
	.tuning_self_target_value = 4608,
	.tuning_mutual_target_value = 10240,
#endif

	.num_moving_average = 4,
	.p_callback = &qe_touch_callback,
#if (CTSU_CFG_DTC_SUPPORT_ENABLE == 1)
	.p_transfer_tx = &g_transfer0,
	.p_transfer_rx = &g_transfer1,
#else
	.p_transfer_tx = NULL,
	.p_transfer_rx = NULL,
#endif

	.write_irq = CTSU_WRITE_IRQn,
	.read_irq = CTSU_READ_IRQn,
	.end_irq = CTSU_END_IRQn,

};

ctsu_instance_ctrl_t g_qe_ctsu_ctrl_config03;

const ctsu_instance_t g_qe_ctsu_instance_config03 = {
	.p_ctrl = &g_qe_ctsu_ctrl_config03,
	.p_cfg = &g_qe_ctsu_cfg_config03,
	.p_api = &g_ctsu_on_ctsu,
};

/* Touch Related Information for [CONFIG03] configuration. */

#define QE_TOUCH_CONFIG03_NUM_BUTTONS    (0)
#define QE_TOUCH_CONFIG03_NUM_SLIDERS    (0)
#define QE_TOUCH_CONFIG03_NUM_WHEELS     (1)
#define QE_TOUCH_CONFIG03_NUM_TOUCH_PADS (0)

#if (QE_TOUCH_CONFIG03_NUM_BUTTONS != 0)
const touch_button_cfg_t g_qe_touch_button_cfg_config03[] = {NULL};
#endif

#if (QE_TOUCH_CONFIG03_NUM_SLIDERS != 0)
const touch_slider_cfg_t g_qe_touch_slider_cfg_config03[] = {NULL};
#endif

const uint8_t g_qe_touch_elem_wheel_config03_wheel00[] = {0, 1, 2, 3};

#if (QE_TOUCH_CONFIG03_NUM_WHEELS != 0)
const touch_wheel_cfg_t g_qe_touch_wheel_cfg_config03[] = {
	{
		.p_elem_index = g_qe_touch_elem_wheel_config03_wheel00,
		.num_elements = 4,
		.threshold = 585,
	},
};
#endif

#if (QE_TOUCH_CONFIG03_NUM_TOUCH_PADS != 0)
const touch_pad_cfg_t g_qe_touch_touch_pad_cfg_config03 = {NULL};
#endif

const touch_cfg_t g_qe_touch_cfg_config03 = {
	.p_buttons = NULL,
	.p_sliders = NULL,
	.p_wheels = g_qe_touch_wheel_cfg_config03,
#if (TOUCH_CFG_PAD_ENABLE != 0)
	.p_pad = NULL,
#endif
	.num_buttons = QE_TOUCH_CONFIG03_NUM_BUTTONS,
	.num_sliders = QE_TOUCH_CONFIG03_NUM_SLIDERS,
	.num_wheels = QE_TOUCH_CONFIG03_NUM_WHEELS,

	.number = 2,
#if ((TOUCH_CFG_UART_MONITOR_SUPPORT == 1) || (TOUCH_CFG_UART_TUNING_SUPPORT == 1))
	.p_uart_instance = &g_uart_qe,
#else
	.p_uart_instance = NULL,
#endif

	.on_freq = 3,
	.off_freq = 3,
	.drift_freq = 255,
	.cancel_freq = 0,

	.p_ctsu_instance = &g_qe_ctsu_instance_config03,
};

touch_instance_ctrl_t g_qe_touch_ctrl_config03;

const touch_instance_t g_qe_touch_instance_config03 = {
	.p_ctrl = &g_qe_touch_ctrl_config03,
	.p_cfg = &g_qe_touch_cfg_config03,
	.p_api = &g_touch_on_ctsu,
};
```

## src/qe_touch_config.h
```c
/*
 * Copyright (c) 2025 Renesas Electronics Corporation
 *
 * SPDX-License-Identifier: Apache-2.0
 */

#ifndef QE_TOUCH_CONFIG_H
#define QE_TOUCH_CONFIG_H

/* Generated content from Renesas QE Capacitive Touch */

#include <hal_data.h>
#include "qe_touch_define.h"

extern const ctsu_instance_t g_qe_ctsu_instance_config01;
extern const ctsu_instance_t g_qe_ctsu_instance_config02;
extern const ctsu_instance_t g_qe_ctsu_instance_config03;
extern const touch_instance_t g_qe_touch_instance_config01;
extern const touch_instance_t g_qe_touch_instance_config02;
extern const touch_instance_t g_qe_touch_instance_config03;

extern volatile uint8_t g_qe_touch_flag;
extern volatile ctsu_event_t g_qe_ctsu_event;

extern void qe_touch_callback(touch_callback_args_t *p_args);

#endif /* QE_TOUCH_CONFIG_H */
```

## src/qe_touch_define.h
```c
/*
 * Copyright (c) 2025 Renesas Electronics Corporation
 *
 * SPDX-License-Identifier: Apache-2.0
 */

#ifndef QE_TOUCH_DEFINE_H
#define QE_TOUCH_DEFINE_H

/* Generated content from Renesas QE Capacitive Touch */

#define QE_TOUCH_VERSION (0x0410)

#define CTSU_CFG_NUM_SELF_ELEMENTS (12)

#define CTSU_CFG_NUM_MUTUAL_ELEMENTS (0)
#define CTSU_CFG_NUM_CFC             (0)
#define CTSU_CFG_NUM_CFC_TX          (0)

#define TOUCH_CFG_MONITOR_ENABLE (1)
#define TOUCH_CFG_NUM_BUTTONS    (3)
#define TOUCH_CFG_NUM_SLIDERS    (1)
#define TOUCH_CFG_NUM_WHEELS     (1)
#define TOUCH_CFG_PAD_ENABLE     (0)

#define QE_TOUCH_MACRO_CTSU_IP_KIND (2)

#define CTSU_CFG_VCC_MV           (5000)
#define CTSU_CFG_LOW_VOLTAGE_MODE (0)

#define CTSU_CFG_PCLK_DIVISION (0)

#define CTSU_CFG_TSCAP_PORT (0x010C)

#define CTSU_CFG_NUM_SUMULTI (3)
#define CTSU_CFG_SUMULTI0    (0x3F)
#define CTSU_CFG_SUMULTI1    (0x36)
#define CTSU_CFG_SUMULTI2    (0x48)

#define CTSU_CFG_CALIB_RTRIM_SUPPORT     (0)
#define CTSU_CFG_TEMP_CORRECTION_SUPPORT (0)
#define CTSU_CFG_TEMP_CORRECTION_TS      (0)
#define CTSU_CFG_TEMP_CORRECTION_TIME    (0)

#define CTSU_CFG_TARGET_VALUE_QE_SUPPORT (1)

#define CTSU_CFG_MAJORITY_MODE                 (1)
#define CTSU_CFG_NUM_AUTOJUDGE_SELF_ELEMENTS   (0)
#define CTSU_CFG_NUM_AUTOJUDGE_MUTUAL_ELEMENTS (0)

#define CONFIG01_INDEX_BUTTON00 (2)
#define CONFIG01_MASK_BUTTON00  (1ULL << CONFIG01_INDEX_BUTTON00)
#define CONFIG01_INDEX_BUTTON01 (1)
#define CONFIG01_MASK_BUTTON01  (1ULL << CONFIG01_INDEX_BUTTON01)
#define CONFIG01_INDEX_BUTTON02 (0)
#define CONFIG01_MASK_BUTTON02  (1ULL << CONFIG01_INDEX_BUTTON02)

#endif /* QE_TOUCH_DEFINE_H */
```
