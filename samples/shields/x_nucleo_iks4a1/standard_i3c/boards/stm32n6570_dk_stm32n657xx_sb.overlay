/*
 * SPDX-FileCopyrightText: Copyright The Zephyr Project Contributors
 * SPDX-License-Identifier: Apache-2.0
 */

/* i3c1 shares PH9/PC1 with i2c1, which also feeds the CSI camera connector. */
&i2c1 {
	status = "disabled";
};

&i3c1 {
	status = "okay";
};
