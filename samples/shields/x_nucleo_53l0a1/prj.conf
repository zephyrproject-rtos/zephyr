## CMakeLists.txt
```
# SPDX-License-Identifier: Apache-2.0

cmake_minimum_required(VERSION 3.28.0)

# This sample is specific to x_nucleo_53l0a1 shield. Enforce -DSHIELD option
set(SHIELD x_nucleo_53l0a1)

find_package(Zephyr REQUIRED HINTS $ENV{ZEPHYR_BASE})

project(x_nucleo_53l0a1)
FILE(GLOB app_sources src/*.c)
target_sources(app PRIVATE ${app_sources})
```

## sample.yaml
```
sample:
  name: X-NUCLEO-53L0A1 time-of-flight distance sensor shield
tests:
  sample.shields.x_nucleo_53l0a1:
    harness: shield
    tags: shield
    depends_on: arduino_i2c
    filter: dt_enabled_alias_with_parent_compat("sw0", "gpio-keys")
    integration_platforms:
      - nucleo_g431rb/stm32g431xx
```

## prj.conf
```kconfig
# SPDX-FileCopyrightText: Copyright The Zephyr Project Contributors
# SPDX-License-Identifier: Apache-2.0

CONFIG_SENSOR=y
CONFIG_GPIO=y
```

## src/main.c
```c
/*
 * Copyright (c) 2021 Titouan Christophe
 *
 * SPDX-License-Identifier: Apache-2.0
 */

#include <zephyr/kernel.h>
#include <zephyr/device.h>
#include <zephyr/drivers/sensor.h>
#include <zephyr/drivers/gpio.h>

#include "display_7seg.h"

/*
 * Get button configuration from the devicetree sw0 alias. This is mandatory.
 */
#define SW0_NODE        DT_ALIAS(sw0)
#if !DT_NODE_HAS_STATUS_OKAY(SW0_NODE)
#error "Unsupported board: sw0 devicetree alias is not defined"
#endif

#define N_MODES ARRAY_SIZE(modes)
#define N_SENSORS ARRAY_SIZE(sensors)
#define LEFT   sensors[0]
#define CENTER sensors[1]
#define RIGHT  sensors[2]

typedef void (*fsm_state)(void);

static int64_t last_mode_change;

static const struct device *const sensors[] = {
	DEVICE_DT_GET(DT_NODELABEL(vl53l0x_l_x_nucleo_53l0a1)),
	DEVICE_DT_GET(DT_NODELABEL(vl53l0x_c_x_nucleo_53l0a1)),
	DEVICE_DT_GET(DT_NODELABEL(vl53l0x_r_x_nucleo_53l0a1)),
};

static void mode_show_distance(void)
{
	int ret;
	double distance;
	struct sensor_value value;

	ret = sensor_sample_fetch(CENTER);
	if (ret) {
		printk("sensor_sample_fetch(%s) failed -> %d\n", CENTER->name, ret);
		display_chars(TEXT_Err);
		return;
	}

	ret = sensor_channel_get(CENTER, SENSOR_CHAN_DISTANCE, &value);
	if (ret) {
		printk("sensor_channel_get(%s) failed -> %d\n", CENTER->name, ret);
		display_chars(TEXT_Err);
		return;
	}
	distance = sensor_value_to_double(&value);
	if (distance < 1.25) {
		display_number(100 * distance, 10);
	} else {
		display_chars(DISPLAY_OFF);
	}
}

static void mode_show_presence(void)
{
	int i, ret;
	struct sensor_value value;
	uint8_t text[4] = { CHAR_OFF, CHAR_OFF, CHAR_OFF, CHAR_OFF };

	for (i = 0; i < N_SENSORS; i++) {
		ret = sensor_sample_fetch(sensors[i]);
		if (ret) {
			printk("sensor_sample_fetch(%s) failed -> %d\n",
			       sensors[i]->name, ret);
			display_chars(TEXT_Err);
			return;
		}
		ret = sensor_channel_get(sensors[i],
					 SENSOR_CHAN_PROX,
					 &value);
		if (ret) {
			printk("sensor_channel_get(%s) failed -> %d\n",
			       sensors[i]->name, ret);
			display_chars(TEXT_Err);
			return;
		}

		if (value.val1) {
			text[i] = CHAR_UNDERSCORE | CHAR_DASH | CHAR_OVERLINE;
		}
	}
	display_chars(text);
}

static size_t current_mode;
static fsm_state modes[] = {
	mode_show_distance,
	mode_show_presence,
};

static void change_mode(const struct device *dev, struct gpio_callback *cb, uint32_t pins)
{
	(void) dev;
	(void) cb;
	(void) pins;

	int64_t now = k_uptime_get();

	if (now - last_mode_change > 300) {
		current_mode = (current_mode + 1) % N_MODES;
		last_mode_change = now;
	}
}


int main(void)
{
	struct gpio_callback button_cb_data;
	const uint8_t Hello[4] = { CHAR_H, CHAR_E, CHAR_PIPE | CHAR_1, CHAR_0 };
	const struct gpio_dt_spec button = GPIO_DT_SPEC_GET(SW0_NODE, gpios);

	display_chars(Hello);
	k_sleep(K_MSEC(1000));

	if (!gpio_is_ready_dt(&button)) {
		printk("Error: button device %s is not ready\n",
		       button.port->name);
		return 0;
	}

	gpio_pin_configure_dt(&button, GPIO_INPUT);
	gpio_pin_interrupt_configure_dt(&button, GPIO_INT_EDGE_RISING);
	gpio_init_callback(&button_cb_data, change_mode, BIT(button.pin));
	gpio_add_callback(button.port, &button_cb_data);

	while (1) {
		modes[current_mode]();
	}
	return 0;
}
```

## src/display_7seg.c
```c
/*
 * Copyright (c) 2021 Titouan Christophe
 *
 * SPDX-License-Identifier: Apache-2.0
 */

#include "display_7seg.h"

#include <zephyr/device.h>
#include <zephyr/drivers/gpio.h>
#include <zephyr/sys/printk.h>

const uint8_t DISPLAY_OFF[4] = { CHAR_OFF, CHAR_OFF, CHAR_OFF, CHAR_OFF };
const uint8_t TEXT_Err[4] = { CHAR_E, CHAR_r, CHAR_r, CHAR_OFF };

static bool initialized;
static const struct device *const expander1 =
				DEVICE_DT_GET(DT_NODELABEL(expander1_x_nucleo_53l0a1));
static const struct device *const expander2 =
				DEVICE_DT_GET(DT_NODELABEL(expander2_x_nucleo_53l0a1));
static const uint8_t digits[16] = {
	CHAR_0,
	CHAR_1,
	CHAR_2,
	CHAR_3,
	CHAR_4,
	CHAR_5,
	CHAR_6,
	CHAR_7,
	CHAR_8,
	CHAR_9,
	CHAR_A,
	CHAR_b,
	CHAR_C,
	CHAR_d,
	CHAR_E,
	CHAR_F,
};

static const int max_positive_for_base[17] = {
	0,
	1,
	16,
	81,
	256,
	625,
	1296,
	2401,
	4096,
	6561,
	10000,
	14641,
	20736,
	28561,
	38416,
	50625,
	65536,
};

static const int max_negative_for_base[17] = {
	-0,
	-1,
	-8,
	-27,
	-64,
	-125,
	-216,
	-343,
	-512,
	-729,
	-1000,
	-1331,
	-1728,
	-2197,
	-2744,
	-3375,
	-4096,
};

static int init_display(void)
{
	int ret;

	for (int i = 0; i < 14; i++) {
		ret = gpio_pin_configure(expander1, i, GPIO_OUTPUT | GPIO_OUTPUT_INIT_HIGH);
		if (ret) {
			printk("Error in configure pin %d on expander1: %d", i, ret);
			return ret;
		}
		ret = gpio_pin_configure(expander2, i, GPIO_OUTPUT | GPIO_OUTPUT_INIT_HIGH);
		if (ret) {
			printk("Error in configure pin %d on expander2: %d", i, ret);
			return ret;
		}
	}

	initialized = true;
	return 0;
}


int display_chars(const uint8_t chars[4])
{
	int r;
	uint16_t port1, port2;

	if (!initialized) {
		r = init_display();
		if (r) {
			return r;
		}
	}

	port1 = ((chars[3] & 0x7f) << 7) | (chars[2] & 0x7f);
	port2 = ((chars[1] & 0x7f) << 7) | (chars[0] & 0x7f);

	/* Common anode: invert the output (LOW = led on) */
	r = gpio_port_set_masked(expander1, 0x3fff, port1 ^ 0x3fff);
	if (r) {
		return r;
	}
	return gpio_port_set_masked(expander2, 0x3fff, port2 ^ 0x3fff);
}

int display_number(int num, unsigned int base)
{
	int d, i, neg = 0;
	uint8_t representation[4] = { CHAR_E, CHAR_r, CHAR_r, CHAR_OFF };

	/* Unsupported base */
	if (base > 16) {
		return -EINVAL;
	}

	/* Number too large to be displayed */
	if (num <= max_negative_for_base[base] || num >= max_positive_for_base[base]) {
		return -EINVAL;
	}

	if (num < 0) {
		num = -num;
		representation[0] = CHAR_DASH;
		neg = 1;
	}

	for (i = 3; i >= neg; i--) {
		if (num > 0 || i == 3) {
			d = num % base;
			representation[i] = digits[d];
			num /= base;
		} else {
			representation[i] = CHAR_OFF;
		}
	}
	return display_chars(representation);
}
```

## src/display_7seg.h
```c
#ifndef DISPLAY_7SEG_HEADER
#define DISPLAY_7SEG_HEADER

/*
 * Copyright (c) 2021 Titouan Christophe
 *
 * SPDX-License-Identifier: Apache-2.0
 */

#include <stdbool.h>
#include <stdint.h>

/*
 *    3
 *   ---
 * 1|   |5
 *   -2-
 * 0|   |6
 *   ---
 *    4
 */

#define CHAR_OFF        (0)

#define CHAR_0          (BIT(0) | BIT(1) | BIT(3) | BIT(4) | BIT(5) | BIT(6))
#define CHAR_1          (BIT(5) | BIT(6))
#define CHAR_2          (BIT(0) | BIT(2) | BIT(3) | BIT(4) | BIT(5))
#define CHAR_3          (BIT(2) | BIT(3) | BIT(4) | BIT(5) | BIT(6))
#define CHAR_4          (BIT(1) | BIT(2) | BIT(5) | BIT(6))
#define CHAR_5          (BIT(1) | BIT(2) | BIT(3) | BIT(4) | BIT(6))
#define CHAR_6          (BIT(0) | BIT(1) | BIT(2) | BIT(3) | BIT(4) | BIT(6))
#define CHAR_7          (BIT(3) | BIT(5) | BIT(6))
#define CHAR_8          (BIT(0) | BIT(1) | BIT(2) | BIT(3) | BIT(4) | BIT(5) | BIT(6))
#define CHAR_9          (BIT(1) | BIT(2) | BIT(3) | BIT(4) | BIT(5) | BIT(6))

#define CHAR_A          (BIT(0) | BIT(1) | BIT(2) | BIT(3) | BIT(5) | BIT(6))
#define CHAR_C          (BIT(0) | BIT(1) | BIT(3) | BIT(4))
#define CHAR_E          (BIT(0) | BIT(1) | BIT(2) | BIT(3) | BIT(4))
#define CHAR_F          (BIT(0) | BIT(1) | BIT(2) | BIT(3))
#define CHAR_H          (BIT(0) | BIT(1) | BIT(2) | BIT(5) | BIT(6))
#define CHAR_L          (BIT(0) | BIT(1) | BIT(4))
#define CHAR_P          (BIT(0) | BIT(1) | BIT(2) | BIT(3) | BIT(5))
#define CHAR_U          (BIT(0) | BIT(1) | BIT(4) | BIT(5) | BIT(6))

#define CHAR_b          (BIT(0) | BIT(1) | BIT(2) | BIT(4) | BIT(6))
#define CHAR_d          (BIT(0) | BIT(2) | BIT(4) | BIT(5) | BIT(6))
#define CHAR_h          (BIT(0) | BIT(1) | BIT(2) | BIT(6))
#define CHAR_i          (BIT(6))
#define CHAR_o          (BIT(0) | BIT(2) | BIT(4) | BIT(6))
#define CHAR_r          (BIT(0) | BIT(2))
#define CHAR_t          (BIT(0) | BIT(1) | BIT(2) | BIT(4))
#define CHAR_u          (BIT(0) | BIT(4) | BIT(6))

#define CHAR_DASH       (BIT(2))
#define CHAR_OVERLINE   (BIT(3))
#define CHAR_UNDERSCORE (BIT(4))
#define CHAR_PIPE       (BIT(0) | BIT(1))

extern const uint8_t DISPLAY_OFF[4];
extern const uint8_t TEXT_Err[4];

/**
 * @brief      Display characters on the 4x7seg display
 * @param[in]  chars  The characters to be displayed
 * @return     0 on success, nonzero on error
 */
int display_chars(const uint8_t chars[4]);

/**
 * @brief      Display a number on the 4x7seg display
 * @param[in]  num   The number to be displayed
 * @param[in]  base  The base into which the number shall be displayed
 * @return     0 on success, nonzero on error
 */
int display_number(int num, unsigned int base);

#endif
```
