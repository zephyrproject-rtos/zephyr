## samples/shields/mikroe_eeram_33v_click/sample.yaml
```yaml
sample:
  name: EERAM 3.3V Click Sample
tests:
  sample.shields.mikroe_eeram_33v_click:
    tags:
      - drivers
      - eeprom
      - shield
    platform_allow:
      - apollo510_evb
    extra_args: SHIELD="ambiq_mikrobus_i2c;mikroe_eeram_33v_click"
    depends_on:
      - i2c
    filter: dt_alias_exists("eeprom-0")
    harness: console
    harness_config:
      type: one_line
      regex:
        - "EEPROM driver test PASSED"
```

## samples/shields/npm1300_ek/sample.yaml
```yaml
# Copyright (c) 2023 Nordic Semiconductor ASA
# SPDX-License-Identifier: Apache-2.0

sample:
  name: nPM1300 EK
tests:
  sample.shields.npm1300_ek:
    platform_allow: nrf52dk_nrf52832
    harness: shield
    tags: shield
    extra_args: SHIELD=npm1300_ek
    depends_on: arduino_i2c
```

## samples/shields/npm6001_ek/sample.yaml
```yaml
# Copyright (c) 2022 Nordic Semiconductor ASA
# SPDX-License-Identifier: Apache-2.0

sample:
  name: nPM6001 EK
tests:
  sample.shields.npm6001_ek:
    harness: shield
    tags: shield
    depends_on: arduino_i2c
```

## samples/shields/rtk0eg0019b01002bj/sample.yaml
```yaml
sample:
  name: RTK0EG0019B01002BJ Capacitive Touch Application Shield
tests:
  sample.shields.rtk0eg0019b01002bj:
    harness: shield
    tags: shield
    platform_allow:
      - rssk_ra2l1
    extra_args: SHIELD=rtk0eg0019b01002bj
```

## samples/shields/x_nucleo_53l0a1/sample.yaml
```yaml
sample:
  name: X-NUCLEO-53L0A1 time-of-flight distance sensor shield
tests:
  sample.shields.x_nucleo_53l0a1:
    harness: shield
    tags: shield
    depends_on: arduino_i2c
    filter: dt_enabled_alias_with_parent_compat("sw0", "gpio-keys")
```

## samples/shields/x_nucleo_cca02m1/sample.yaml
```yaml
sample:
  name: X-NUCLEO-CCA02M1 sensor shield
tests:
  test:
    harness: shield
    tags: shield
    depends_on: arduino_i2s
```

## samples/shields/x_nucleo_iks01a1/sample.yaml
```yaml
sample:
  name: X-NUCLEO-IKS01A1 sensor shield
tests:
  sample.shields.x_nucleo_iks01a1:
    platform_exclude:
      - disco_l475_iot1
      - pan1781_evb
      - pan1782_evb
    harness: shield
    tags: shield
    depends_on:
      - arduino_i2c
      - arduino_gpio
```

## samples/shields/x_nucleo_iks01a2/sample.yaml
```yaml
sample:
  name: X-NUCLEO-IKS01A2 sensor shield
tests:
  sample.shields..x_nucleo_iks01a2:
    harness: shield
    tags: shield
    pre-filter: dt_label_enabled("arduino_i2c") and dt_label_enabled("arduino_gpio")
    platform_exclude: disco_l475_iot1 stm32mp157c_dk2
```

## samples/shields/x_nucleo_iks01a3/sensorhub/boards/stm32mp157c_dk2.conf
```kconfig
# Copyright (c) 2019 STMicroelectronics
#
# SPDX-License-Identifier: Apache-2.0

CONFIG_LSM6DSO_TRIGGER_OWN_THREAD=n
CONFIG_LSM6DSO_TRIGGER_NONE=y
```

## samples/shields/x_nucleo_iks01a3/sensorhub/sample.yaml
```yaml
sample:
  name: X-NUCLEO-IKS01A3 sensor shield
tests:
  sample.shields.x_nucleo_iks01a3.sensorhub:
    harness: shield
    tags: shield
    depends_on:
      - arduino_i2c
      - arduino_gpio
    platform_exclude:
      - disco_l475_iot1/stm32l475xx
      - lpcxpresso55s16/lpc55s16
      - mimxrt1010_evk/mimxrt1011
```

## samples/shields/x_nucleo_iks01a3/standard/boards/stm32mp157c_dk2.conf
```kconfig
# Copyright (c) 2019 STMicroelectronics
#
# SPDX-License-Identifier: Apache-2.0

CONFIG_LPS22HH_TRIGGER_OWN_THREAD=n
CONFIG_LPS22HH_TRIGGER_NONE=y
CONFIG_LIS2DW12_TRIGGER_OWN_THREAD=n
CONFIG_LIS2DW12_TRIGGER_NONE=y
CONFIG_LSM6DSO_TRIGGER_OWN_THREAD=n
CONFIG_LSM6DSO_TRIGGER_NONE=y

# DIL24 section
CONFIG_LIS2DE12_ENABLE_TEMP=n
```

## samples/shields/x_nucleo_iks01a3/standard/sample.yaml
```yaml
sample:
  name: X-NUCLEO-IKS01A3 sensor shield
common:
  min_ram: 16
tests:
  sample.shields.x_nucleo_iks01a3.standard:
    harness: shield
    tags: shield
    depends_on:
      - arduino_i2c
      - arduino_gpio
    platform_exclude:
      - disco_l475_iot1
      - lpcxpresso55s16
      - pan1781_evb
      - pan1782_evb
      - mimxrt1010_evk
```

## samples/shields/x_nucleo_iks02a1/microphone/sample.yaml
```yaml
sample:
  name: X-NUCLEO-IKS02A1 sensor shield
tests:
  sample.shields.x_nucleo_iks02a1.microphone:
    harness: shield
    tags: shield
    depends_on: arduino_i2s
```

## samples/shields/x_nucleo_iks02a1/sensorhub/sample.yaml
```yaml
sample:
  name: X-NUCLEO-IKS02A1 sensor shield
tests:
  sample.shields.x_nucleo_iks02a1.sensorhub:
    harness: shield
    tags: shield
    depends_on: arduino_i2c arduino_gpio
    platform_exclude: disco_l475_iot1 lpcxpresso55s16 stm32mp157c_dk2 pan1781_evb pan1782_evb
```

## samples/shields/x_nucleo_iks02a1/standard/sample.yaml
```yaml
sample:
  name: X-NUCLEO-IKS02A1 sensor shield
common:
  min_ram: 16
tests:
  sample.shields.x_nucleo_iks02a1.standard:
    harness: shield
    tags: shield
    depends_on:
      - arduino_i2c
      - arduino_gpio
    platform_exclude:
      - disco_l475_iot1/stm32l475xx
      - lpcxpresso55s16/lpc55s16
      - stm32mp157c_dk2/stm32mp157cxx
      - pan1781_evb/nrf52820
      - pan1782_evb/nrf52833
      - mimxrt1010_evk/mimxrt1011
```

## samples/shields/x_nucleo_iks4a1/sensorhub2/sample.yaml
```yaml
sample:
  name: X-NUCLEO-IKS01A4 sensor shield
tests:
  sample.shields.x_nucleo_iks4a1.sensorhub2:
    harness: shield
    tags: shield
    depends_on: arduino_i2c arduino_gpio
    platform_exclude:
      - disco_l475_iot1/stm32l475xx
      - lpcxpresso55s16/lpc55s16
      - pan1781_evb/nrf52820
      - pan1782_evb/nrf52833
      - stm32mp157c_dk2/stm32mp157cxx
```

## samples/shields/x_nucleo_iks4a1/standard/sample.yaml
```yaml
sample:
  name: X-NUCLEO-IKS01A4 sensor shield
common:
  min_ram: 16
tests:
  sample.shields.x_nucleo_iks4a1.standard:
    harness: shield
    tags: shield
    depends_on: arduino_i2c arduino_gpio
    platform_exclude:
      - disco_l475_iot1/stm32l475xx
      - lpcxpresso55s16/lpc55s16
      - mimxrt1010_evk/mimxrt1011
      - pan1781_evb/nrf52820
      - pan1782_evb/nrf52833
      - stm32mp157c_dk2/stm32mp157cxx
```

## samples/shields/x_nucleo_nfc04a1/sample.yaml
```yaml
sample:
  name: X-NUCLEO-NFC04A1 shield
common:
  min_ram: 16
tests:
  sample.shields.x_nucleo_nfc04a1.standard:
    harness: shield
    tags: shield
    depends_on:
      - arduino_i2c
      - arduino_gpio
    platform_exclude:
      - hifive1
      - mimxrt1010_evk
      - hifive1_revb
      - rv32m1_vega_zero_riscy
      - rv32m1_vega_ri5cy
```

## samples/smp/pktqueue/sample.yaml
```yaml
sample:
  description: Processing multiple queues in
    a number of threads
  name: SMP Pktqueue
common:
    tags: introduction
    harness: console
    harness_config:
      type: multi_line
      ordered: yes
      regex:
        - "RESULT: OK(.*)"

tests:
  sample.smp.pktqueue:
    tags: introduction
    filter: (CONFIG_MP_NUM_CPUS > 1)
```

## samples/spi_loopback/sample.yaml
```yaml
sample:
  description: SPI application sample, the simplest Zephyr
    application
  name: spi_loopback  
common:
  tags: introduction
  integration_platforms:
    - native_posix
  harness: console
  harness_config:
    type: one_line
    regex:
      - "spi_loopback! (.*)"
tests:
  sample.spi_loopback:
    tags: introduction
```

## samples/storage/zsai/boards/nrf52840dk_nrf52840.conf
```kconfig
#
# Copyright (c) 2023
#
# SPDX-License-Identifier: Apache-2.0
#

CONFIG_SOC_FLASH_NRF_ZSAI=y
CONFIG_SOC_FLASH_NRF=y
CONFIG_FLASH=y
```

## samples/storage/zsai/sample.yaml
```yaml
sample:
  description: ZSAI usage sample
    application
  name: ZSAI sample
common:
  tags: introduction storage zsai
tests:
  storage.zai.with_erase:
    extra_args:
      - DTC_OVERLAY_FILE=zsai_with_erase.overlay
      - OVERLAY_CONFIG=zsai_simulator.conf
    platform_allow: qemu_x86 native_posix
    integration_platforms:
      - native_posix
    harness: console
    harness_config:
      type: multi_line
      regex:
        - "Starting ZSAI sample on *"
        - "Device uses write block size 1"
        - "Device has size 65536"
        - "Device requires erase prior to write"
        - "For offset 65496, got page with offset 61440 and size 4096"
        - "Erase was ok"
        - "Writing DATA to device"
        - "Reading device back to buffer"
        - "Data and buffer matches"
  storage.zsai.without_erase:
    extra_args:
      - DTC_OVERLAY_FILE=zsai_without_erase.overlay
      - OVERLAY_CONFIG=zsai_simulator.conf
    platform_allow: qemu_x86 native_posix
    integration_platforms:
      - native_posix
    harness: console
    harness_config:
      type: multi_line
      regex:
        - "Starting ZSAI sample on *"
        - "Device uses write block size 4"
        - "Device has size 65536"
        - "Writing DATA to device"
        - "Reading device back to buffer"
        - "Data and buffer matches"
  storage.zsai.nrf:
    extra_args: OVERLAY_CONFIG=boards/nrf52840dk_nrf52840.conf
    platform_allow: nrf52840dk_nrf52840
    integration_platforms:
      - nrf52840dk_nrf52840
```

## samples/subsys/app_event_manager/sample.yaml
```yaml
sample:
  description: Sample showing Application Event Manager usage
  name: Application Event Manager sample
common:
  harness: console
  integration_platforms:
    - qemu_cortex_m3
    - nrf52dk_nrf52832
    - nrf52840dk_nrf52840
    - nrf9160dk_nrf9160_ns
    - nrf21540dk_nrf52840
  harness_config:
    type: multi_line
    ordered: false
    regex:
      - "config_event"
      - "measurement_event"
      - "control_event"
      - "ack_event"
      - "Average value3: 45"
tests:
  samples.app_event_manager:
    build_only: false
```

## samples/subsys/audio/sof/boards/intel_adsp_cavs15.conf
```kconfig
CONFIG_APOLLOLAKE=y
CONFIG_INTEL_DMIC=y
CONFIG_INTEL_SSP=y
CONFIG_LP_MEMORY_BANKS=2
CONFIG_HP_MEMORY_BANKS=8
CONFIG_PERFORMANCE_COUNTERS=y
CONFIG_COMP_SRC_TINY=y
```

## samples/subsys/audio/sof/boards/nxp_adsp_imx8m.conf
```kconfig
CONFIG_IMX8M=y
CONFIG_HAVE_AGENT=n
CONFIG_FORMAT_CONVERT_HIFI3=n
CONFIG_KPB_FORCE_COPY_TYPE_NORMAL=n
```
