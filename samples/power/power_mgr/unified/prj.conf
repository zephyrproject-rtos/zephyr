## prj.conf
```kconfig
CONFIG_SYS_POWER_MANAGEMENT=y
CONFIG_SYS_POWER_LOW_POWER_STATE=y
CONFIG_SYS_POWER_DEEP_SLEEP=y
CONFIG_DEVICE_POWER_MANAGEMENT=y
CONFIG_TICKLESS_IDLE=y
CONFIG_RTC=y
CONFIG_GPIO=y

CONFIG_KERNEL_V2=y
CONFIG_MDEF=n
CONFIG_INIT_STACKS=y
CONFIG_COMPILER_OPT="-O0"
CONFIG_SYS_CLOCK_TICKS_PER_SEC=100
CONFIG_NUM_COOP_PRIORITIES=0
CONFIG_NUM_PREEMPT_PRIORITIES=1
```

## src/main.c
```c
#include "../../microkernel/src/main.c"
```
