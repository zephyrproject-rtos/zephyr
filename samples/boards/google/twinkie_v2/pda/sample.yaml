## samples/boards/google/twinkie_v2/pda/sample.yaml
```yaml
sample:
  name: Twinkie V2 usb Vbus snooper
tests:
  sample.board.google_twinkie_v2:
    platform_allow: google_twinkie_v2
    tags: usb
```

## samples/boards/google_kukui/sample.yaml
```yaml
sample:
  name: Kukui general features
tests:
  sample.board.google_kukui:
    platform_allow: google_kukui/stm32f098xx
    tags: ec
```

## samples/boards/google_pda/Kconfig
```kconfig
# Private config options for eSPI sample app

# Copyright (c) 2019 Intel Corporation
# SPDX-License-Identifier: Apache-2.0

config STM32_UCPD
        bool "USBC TCPC device controller driver"
        depends on SOC_FAMILY_STM32
        default y
	select USE_STM32_LL_BUS
	select USE_STM32_LL_SYSTEM
	select USE_STM32_LL_RCC
	select USE_STM32_LL_DMA
        select USE_STM32_LL_UCPD
        help
          Enable USBC TCPC support on the STM32 G0, G4, L5, and U5 family of
          processors.

source "Kconfig.zephyr"
```

## samples/boards/google_twinkie_v2_pda/sample.yaml
```yaml
sample:
  name: Twinkie V2 usb Vbus snooper
tests:
  sample.board.google_twinkie_v2:
    platform_allow: google_twinkie_v2/stm32g0b1xx
    tags: usb
```

## samples/boards/infineon/autanalog/lp_audio/sample.yaml
```yaml
# SPDX-FileCopyrightText: <text>Copyright (c) 2026 Infineon Technologies AG,
# or an affiliate of Infineon Technologies AG. All rights reserved.</text>
#
# SPDX-License-Identifier: Apache-2.0

sample:
  name: AutAnalog low-power audio sample
common:
  tags:
    - adc
    - comparator
  depends_on:
    - adc
  filter: dt_node_has_prop("/zephyr,user","io-channels")

tests:
  sample.boards.infineon.autanalog.lp_audio:
    platform_allow:
      - kit_pse84_eval/pse846gps2dbzc4a/m55
    integration_platforms:
      - kit_pse84_eval/pse846gps2dbzc4a/m55
    harness: console
    timeout: 30
    harness_config:
      type: multi_line
      regex:
        - "AutAnalog LP audio sample"
        - "Opamp .+ ready"
        - "Comparators ready"
        - "ADC ready"
        - "Frame \\d+: \\d+ samples"
```

## samples/boards/infineon/autanalog/multi_seq/sample.yaml
```yaml
# SPDX-FileCopyrightText: <text>Copyright (c) 2026 Infineon Technologies AG,
# or an affiliate of Infineon Technologies AG. All rights reserved.</text>
#
# SPDX-License-Identifier: Apache-2.0

sample:
  name: AutAnalog ADC multi-sequencer sample
common:
  tags:
    - adc
  depends_on:
    - adc
  filter: dt_node_has_prop("/zephyr,user","io-channels")

tests:
  sample.boards.infineon.autanalog_multi_seq:
    platform_allow:
      - kit_pse84_eval/pse846gps2dbzc4a/m55
    integration_platforms:
      - kit_pse84_eval/pse846gps2dbzc4a/m55
    harness: console
    timeout: 10
    harness_config:
      type: multi_line
      regex:
        - "ADC reading\\[\\d+\\]:"
        - "- .+, channel \\d+: -?\\d+"
```

## samples/boards/infineon/cy8ckit_062s2_ai_dual_dual_core/sample.yaml
```yaml
sample:
  name: Dual Core Sample for CY8CKIT-062S2-AI-DUAL
  description: |
    Dual core sample application for CY8CKIT-062S2-AI-DUAL board.
    CM0+ core handles button press to toggle LED0 and starts CM4 core.
    CM4 core blinks LED1 continuously.

common:
  sysbuild: true
  harness: console
  harness_config:
    type: multi_line
    regex:
      - "Hello from CM0\\+ - Dual Core Sample"
      - "Hello from CM4 - Dual Core Sample"
      - "CM0\\+ initialized - Button press will toggle LED0"
      - "Starting CM4 core\\.\\.\\."
      - "CM4 core started - CM0\\+ now handling button/LED0"
      - "CM4 initialized - LED1 will blink continuously"
      - "Button pressed - LED0 toggled to ON"
      - "Button pressed - LED0 toggled to OFF"
      - "LED1 blinking - ON"
      - "LED1 blinking - OFF"
```

## samples/boards/infineon/low_power_modes/boards/kit_pse84_eval_pse846gps2dbzc4a_m55.conf
```kconfig
# SPDX-FileCopyrightText: Copyright (c) 2026 Infineon Technologies AG,
# SPDX-FileCopyrightText: or an affiliate of Infineon Technologies AG. All rights reserved.
#
# SPDX-License-Identifier: Apache-2.0

# CM55 DUT configuration for the low-power modes sample.  The CM33-NS (TF-M)
# companion built from this same sample uses only the common settings in
# prj.conf.
CONFIG_PM_DEVICE=y
# Device runtime PM is enabled automatically by every transaction driver in this
# sample (I2C, SPI, DMIC, I2S, SDHC): each takes a pm_device_runtime_get/put
# reference around its active window, so the peripheral is reference counted per
# transaction instead of being frozen by the system-managed policy. The second
# UART instance (SCB5) opts in per node via zephyr,pm-device-runtime-auto and
# takes a reference around its interrupt-driven TX/RX sessions. Free-running or
# always-on peripherals (PWM, counter, UART console) do not call runtime
# get/put and remain system managed.
CONFIG_PM_DEVICE_RUNTIME=y
# System-managed device PM defaults to disabled once PM_DEVICE_RUNTIME is set
# (Kconfig: "default y if !PM_DEVICE_RUNTIME"). The non-runtime peripherals in
# this sample still rely on it, so without this the PM subsystem never calls
# their SUSPEND/RESUME pm_action around a regular (retained) DeepSleep.
CONFIG_PM_DEVICE_SYSTEM_MANAGED=y
CONFIG_POWEROFF=y
CONFIG_PWM=y
CONFIG_COUNTER=y
CONFIG_SPI=y
CONFIG_I2C=y
CONFIG_DMA=y
CONFIG_AUDIO=y
CONFIG_AUDIO_DMIC=y
CONFIG_I2S=y
CONFIG_SDHC=y

# Second UART instance (SCB5) loopback self-test uses the interrupt-driven API
# to drive the UART driver's restricted-scope device runtime PM get/put paths.
CONFIG_UART_INTERRUPT_DRIVEN=y

# The suspend-to-RAM (DS-RAM) entry path runs on the idle thread stack and is
# far deeper than a plain WFI idle: ifx_pm_s2ram_enter() saves FPU/SCB/MPU/NVIC
# context and calls arch_pm_s2ram_suspend(). The default 320-byte idle stack
# overflows (K_ERR_STACK_CHK_FAIL). Enlarge it so the S2RAM path fits.
CONFIG_IDLE_STACK_SIZE=2048
```

## samples/boards/infineon/wifi_station/sample.yaml
```yaml
sample:
  name: Infineon CYW43XX WiFi Station
tests:
  sample.board.infineon.wifi_station:
    platform_allow: cy8cproto_062_4343w
    tags: cyw43xxx
    harness: console
    harness_config:
      type: multi_line
      regex:
        - "WLAN MAC Address"
        - "WHD VERSION"
        - "infineon_wifi_sta: Connecting to AP"
        - "infineon_wifi_sta: Connected to AP"
        - "net_dhcpv4: Received:"
        - "infineon_wifi_sta: Your address:"
        - "infineon_wifi_sta: Subnet:"
        - "infineon_wifi_sta: Router:"
    filter: dt_compat_enabled("infineon,cyw43xxx-wifi-sdio")
```

## samples/boards/infineon/xmc7200/enable_cm7/sample.yaml
```yaml
sample:
  description: Enables the M7_0 and M7_1 cores
  name: XMC7200 M0+ Start

common:
  platform_allow:
    - kit_xmc72_evk/xmc7200d_e272k8384/m0p
  tags: introduction
  harness: console
  harness_config:
    type: one_line
    regex:
      - "CM0 - kit_xmc72_evk/xmc7200d_e272k8384/m0p"

tests:
  sample.boards.m0plus_start:
    extra_args: EXTRA_CFLAGS=-DENABLE_CM7_0=1

  sample.boards.m7_0_start:
    extra_args: EXTRA_CFLAGS=-DENABLE_CM7_1=0

  sample.boards.m7_1_start:
    extra_args: EXTRA_CFLAGS=-DENABLE_CM7_0=0
```

## samples/boards/infineon/xmc7200_itcm_dtcm/sample.yaml
```yaml
sample:
  description: Sample to illustrate how to use ITCM and DTCM
  name: XMC7200 ITCM and DTCM
tests:
  sample.boards.xmc7200_itcm_dtcm:
    platform_allow:
      - kit_xmc72_evk/xmc7200d_e272k8384/m7_0
      - kit_xmc72_evk/xmc7200d_e272k8384/m7_1
    tags: introduction
    harness: console
    harness_config:
      type: multi_line
      regex:
        - "memory_info address:    00000001 \\(ITCM\\)"
        - "ret address:            20000000 \\(DTCM\\)"
        - "button_pressed address: 10...... \\(FLASH\\)"
        - "led address:            28...... \\(RAM\\)"
```

## samples/boards/intel/adsp/code_relocation/sample.yaml
```yaml
sample:
  description: Code relocation sample for Intel ADSP Cavs.
  name: cavs_code_reloc
tests:
  sample.intel_adsp.code_relocation:
    platform_allow: intel_adsp/cavs25
    tags: linker
```

## samples/boards/intel_adsp/code_relocation/sample.yaml
```yaml
sample:
  description: Code relocation sample for Intel ADSP Cavs.
  name: cavs_code_reloc
```

## samples/boards/intel_s1000_crb/audio/sample.yaml
```yaml
sample:
  name: 2-way Audio Forwarding Sample
tests:
  sample.board.intel_s1000_crb.audio:
    platform_allow: intel_s1000_crb
    tags: audio
```

## samples/boards/intel_s1000_crb/dmic/sample.yaml
```yaml
sample:
  name: DMIC Audio Sample
tests:
  sample.board.intel_s1000_crb.dmic:
    platform_allow: intel_s1000_crb
    tags: dmic
```

## samples/boards/intel_s1000_crb/i2s/sample.yaml
```yaml
sample:
  name: I2S Audio Sample
tests:
  sample.board.intel_s1000_crb.i2s:
    platform_allow: intel_s1000_crb
    tags: i2s
```

## samples/boards/intel_socfpga/cli/boards/intel_socfpga_agilex_socdk.conf
```kconfig
# Copyright (c) 2021-2023, Intel Corporation.
# SPDX-License-Identifier: Apache-2.0

# FPGA Bridge
CONFIG_FPGA_BRIDGE=y
CONFIG_FPGA_BRIDGE_INTEL=y
CONFIG_FPGA_BRIDGE_SHELL=y

# Misc
CONFIG_HEAP_MEM_POOL_SIZE=16384
CONFIG_SHELL_STACK_SIZE=5120

# Enable QSPI Flash
CONFIG_FLASH=y
CONFIG_FLASH_PAGE_LAYOUT=y

# Setting the Shell prompt
CONFIG_SHELL_PROMPT_UART="agilex$ "

# Configure print buffer size
CONFIG_SHELL_PRINTF_BUFF_SIZE=128

# Enable File System Shell
CONFIG_FILE_SYSTEM_SHELL=y

# Enable timer driver
CONFIG_COUNTER=y

# Enable Timer shell commands
CONFIG_COUNTER_SHELL=y

# Enable I2C Console
CONFIG_I2C=y
CONFIG_I2C_SHELL=y
CONFIG_I2C_SMBUS_SUPPORTED=n

# GPIO Controller
CONFIG_GPIO=y
CONFIG_GPIO_INTEL_SOCFPGA=y
CONFIG_GPIO_SHELL=y

# Enable Disk access
CONFIG_DISK_ACCESS=y

# Enable SDMMC
CONFIG_DISK_DRIVERS=y
CONFIG_DISK_DRIVER_SDMMC=y

# File System Setting
CONFIG_FILE_SYSTEM=y
CONFIG_FAT_FILESYSTEM_ELM=y

# Enable SDHC
CONFIG_SDHC=y

# PSCI support Enable
CONFIG_PM_CPU_OPS=y
CONFIG_PM_CPU_OPS_PSCI=y

#SiP SVC Service
CONFIG_ARM_SIP_SVC_DRIVER=y
CONFIG_ARM_SIP_SVC_SUBSYS=y
CONFIG_ARM_SIP_SVC_SUBSYS_SINGLY_OPEN=y

#SiP SVC Service Shell
CONFIG_ARM_SIP_SVC_SUBSYS_SHELL=y

# Enable USB DWC2 Host stack
CONFIG_USB_HOST_CLASS_DRIVER=y
CONFIG_USB_HOST_MSC_DRIVER=y
CONFIG_DISK_DRIVER_USB2=y
CONFIG_USBH_SHELL=n
```

## samples/boards/intel_socfpga/cli/sample.yaml
```yaml
sample:
  name: Agilex general features
tests:
  sample.board.intel_socfpga.cli:
    platform_allow: intel_socfpga
    tags: agilexfpga
```

## samples/boards/intel_socfpga/intel_socfpga_agilex5_socdk/dma/sample.yaml
```yaml
sample:
  description: DMA Driver sample application for Intel SoC FPGA Agilex5 boards.
  name: DMA
common:
    tags: drivers dma
    integration_platforms:
      - intel_socfpga_agilex5_socdk
    harness: console
    harness_config:
        type: multi_line
        ordered: true
        regex:
            - "DMA driver testing for Memory to Memory transfer"
            - "Successfully transferred"
    filter: dt_compat_enabled("snps,designware-dma-axi")
    depends_on: dma
```

## samples/boards/intel_socfpga/intel_socfpga_agilex5_socdk/shell/sample.yaml
```yaml
sample:
  description: Shell sample, this is to provide command line interface for Intel SoC FPGA Agilex5 boards.
  name: shell
common:
    tags: introduction
    integration_platforms:
      - intel_socfpga_agilex5_socdk
    harness: console
    harness_config:
      type: one_line
      regex:
        - "shell"
```

## samples/boards/intel_socfpga/intel_socfpga_agilex_socdk/shell/sample.yaml
```yaml
sample:
  description: Shell sample, this is to provide command line interface for Intel SoC FPGA Agilex boards.
  name: shell
common:
    tags: introduction
    integration_platforms:
      - intel_socfpga_agilex_socdk
    harness: console
    harness_config:
      type: one_line
      regex:
        - "shell"
```

## samples/boards/intel_socfpga/sample.yaml
```yaml
sample:
  name: Agilex general features
tests:
  sample.board.intel_socfpga:
    platform_allow: intel_socfpga
    tags: agilexfpga
```

## samples/boards/mec15xxevb_assy6853/power_management/sample.yaml
```yaml
sample:
  name: MEC150x board sample power management tests
tests:
  sample.board.mec15xxevb_assy6853.pm:
    platform_allow: mec15xxevb_assy6853
    tags: board pm
    harness: console
    harness_config:
      type: multi_line
      ordered: false
      regex:
        - "Wake from Light Sleep"
        - "Wake from Deep Sleep"
      repeat: 3
```

## samples/boards/mec172xevb_assy6906/qmspi_ldma/sample.yaml
```yaml
sample:
  description: mec172xevb_assy6906/mec172x_nsz QMSPI-LDMA testing
  name: mec172xevb_assy9606 test
tests:
  sample.board.mec172xevb_assy6906.qmspi_ldma:
    harness: spi
    platform_allow: mec172xevb_assy6906/mec172x_nsz
    tags: spi
    depends_on:
      - spi
      - gpio
```

## samples/boards/mec172xevb_assy6906/rom_api/sample.yaml
```yaml
sample:
  description: MEC172x EVB ROM API sample application
  name: rom_api
common:
  tags: crypto
  harness: console
  harness_config:
    type: one_line
    ordered: false
tests:
  sample.boards.mec172xevb_assy6906.rom_api:
    platform_allow: mec172xevb_assy6906
```
