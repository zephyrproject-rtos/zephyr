## CMakeLists.txt
```
# SPDX-License-Identifier: Apache-2.0

cmake_minimum_required(VERSION 3.20.0)
find_package(Zephyr REQUIRED HINTS $ENV{ZEPHYR_BASE})
project(usb_host_sample)

target_sources(app PRIVATE src/main.c)
```

## prj.conf
```kconfig
# Enable USB Host support
CONFIG_USB_HOST_STACK=y
CONFIG_UHC_DRIVER=y

# Enable logging
CONFIG_LOG=y
CONFIG_USBH_LOG_LEVEL_DBG=y
CONFIG_UHC_DRIVER_LOG_LEVEL_DBG=y

# Enable shell for USB host commands
CONFIG_SHELL=y
CONFIG_USBH_SHELL=y

# GPIO for VBUS control
CONFIG_GPIO=y
```

## boards/lpcxpresso54s018.overlay
```dts
/*
 * Copyright (c) 2024 NXP
 * SPDX-License-Identifier: Apache-2.0
 */

/ {
	gpio_keys {
		compatible = "gpio-keys";
		usb_vbus: usb_vbus {
			gpios = <&gpio1 6 GPIO_ACTIVE_HIGH>;
			label = "USB VBUS Enable";
		};
	};
};

/* For USB host mode, the application needs to:
 * 1. Configure USB controller for host mode
 * 2. Enable VBUS through GPIO1.6
 * This sample demonstrates basic host enumeration
 */

&gpio1 {
	status = "okay";
};
```

## src/main.c
```c
/*
 * Copyright (c) 2024 NXP
 * SPDX-License-Identifier: Apache-2.0
 */

#include <zephyr/kernel.h>
#include <zephyr/sys/printk.h>
#include <zephyr/usb/usbh.h>
#include <zephyr/logging/log.h>
#include <zephyr/device.h>
#include <zephyr/drivers/gpio.h>

LOG_MODULE_REGISTER(usb_host_sample, LOG_LEVEL_INF);

static void usb_host_status_cb(struct usb_device *udev,
			       const struct usbh_message *const msg)
{
	if (msg->type == USBH_MSG_DEVICE_ADDED) {
		LOG_INF("USB device connected");
		LOG_INF("  VID: 0x%04x, PID: 0x%04x",
			le16_to_cpu(udev->descriptor.idVendor),
			le16_to_cpu(udev->descriptor.idProduct));
		LOG_INF("  Device class: 0x%02x", udev->descriptor.bDeviceClass);
	} else if (msg->type == USBH_MSG_DEVICE_REMOVED) {
		LOG_INF("USB device disconnected");
	}
}

int main(void)
{
	int ret;

	LOG_INF("USB Host sample application");
	LOG_INF("Waiting for USB device to be connected...");

	/* Initialize USB host stack */
	ret = usbh_init();
	if (ret != 0) {
		LOG_ERR("Failed to initialize USB host stack: %d", ret);
		return ret;
	}

	/* Register callback for USB device events */
	ret = usbh_register_callback(usb_host_status_cb);
	if (ret != 0) {
		LOG_ERR("Failed to register USB host callback: %d", ret);
		return ret;
	}

	/* Enable USB host controller */
	ret = usbh_enable();
	if (ret != 0) {
		LOG_ERR("Failed to enable USB host: %d", ret);
		return ret;
	}

	LOG_INF("USB host initialized successfully");

	/* Main loop */
	while (1) {
		k_sleep(K_SECONDS(1));
	}

	return 0;
}
```
