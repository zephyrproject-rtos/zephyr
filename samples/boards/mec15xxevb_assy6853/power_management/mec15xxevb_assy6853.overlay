/*
 * Copyright (c) 2022 Microchip Technology Inc.
 *
 * SPDX-License-Identifier: Apache-2.0
 */

#include <zephyr/dt-bindings/clock/mchp_xec_pcr.h>

/ {
};
&pcr {
	status = "okay";
	pll-32k-src = <MCHP_XEC_PLL_CLK32K_SRC_SIL_OSC>;
	periph-32k-src = <MCHP_XEC_PERIPH_CLK32K_SRC_SO_SO>;

	/* debug only, not using 32KHZ_IN pin */
	pinctrl-0 = <&tst_clk_out_gpio060>;

	pinctrl-names = "default";
};
