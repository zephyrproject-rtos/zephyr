/*
 * Copyright (c) 2026 Espressif Systems (Shanghai) Co., Ltd.
 *
 * SPDX-License-Identifier: Apache-2.0
 */

#include "esp32c5_devkitc_hpcore_flash.dtsi"

/ {
	chosen {
		zephyr,code-partition = &slot0_partition;
	};
};
