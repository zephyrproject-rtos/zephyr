## CMakeLists.txt
```
# SPDX-License-Identifier: Apache-2.0

cmake_minimum_required(VERSION 3.28.0)
find_package(Zephyr REQUIRED HINTS $ENV{ZEPHYR_BASE})
project(esp32_light_sleep)

target_sources(app PRIVATE src/main.c)
```

## sample.yaml
```
sample:
  description: Sample application to test ESP32 light-sleep mode
  name: ESP32 Light-sleep
tests:
  sample.boards.esp32.light_sleep:
    platform_allow:
    - esp32_devkitc/esp32/procpu
    - esp32c3_devkitc
    - esp32s2_devkitc
    - esp32s3_devkitc/esp32s3/procpu
    - esp8684_devkitm
    tags: esp32
    build_only: true
    extra_configs:
    - CONFIG_ESP32_SLEEP_POWER_DOWN_FLASH=y
  sample.board.esp32.light_sleep.periph_pd:
    platform_allow:
    - esp32c5_devkitc/esp32c5/hpcore
    - esp32c6_devkitc/esp32c6/hpcore
    - esp32h2_devkitm
    tags: esp32
    build_only: true
    extra_configs:
    - CONFIG_ESP32_SLEEP_POWER_DOWN_FLASH=y
    - CONFIG_ESP32_PM_POWER_DOWN_PERIPHERAL_IN_LIGHT_SLEEP=y
    - CONFIG_HEAP_MEM_POOL_SIZE=8192
```

## prj.conf
```kconfig
CONFIG_PM=y
CONFIG_PM_DEVICE=y
CONFIG_COUNTER=y
CONFIG_LOG=y
CONFIG_LOG_MODE_MINIMAL=y
CONFIG_SOC_LOG_LEVEL_DBG=y
CONFIG_SOC_FAMILY_ESPRESSIF_PM_SLEEP_STATS=y
```

## app.overlay
```dts
/*
 * Copyright (c) 2026 Espressif Systems (Shanghai) Co., Ltd.
 * SPDX-License-Identifier: Apache-2.0
 */

&light_sleep {
	/* Increase residency time to document that flash power down needs
	 * extra residency time to accommodate the power down/up process.
	 */
	min-residency-us = <3000>;
};

&rtc_timer {

	/* Configure device as wakeup source */
	wakeup-source;
	status = "okay";
};
```

## src/main.c
```c
/*
 * Copyright (c) 2022-2026 Espressif Systems (Shanghai) Co., Ltd.
 *
 * SPDX-License-Identifier: Apache-2.0
 */
#include <zephyr/kernel.h>
#include <zephyr/pm/pm.h>
#include <zephyr/pm/device.h>
#include <esp_sleep.h>
#include <esp_timer.h>

/* Add an extra delay when sleeping to make sure that light sleep
 * is chosen.
 */
#define LIGHT_SLP_EXTRA_DELAY (50000UL)

void dev_enable_wakeup(const struct device *dev)
{
	if (!device_is_ready(dev)) {
		printk("%s: device not ready\n", dev->name);
	}

	if (pm_device_wakeup_is_capable(dev) && !pm_device_wakeup_enable(dev, true)) {
		printk("%s: could not enable wakeup source\n", dev->name);
	}
}

int main(void)
{
	const struct device *const dev_rtc = DEVICE_DT_GET(DT_NODELABEL(rtc_timer));

	dev_enable_wakeup(dev_rtc);

	while (true) {
		printk("Entering light sleep\n");
		/* To make sure the complete line is printed before entering sleep mode,
		 * need to wait until UART TX FIFO is empty
		 */
		k_busy_wait(10000);

		/* Get timestamp before entering sleep */
		int64_t t_before_ms = k_uptime_get();

		/* Sleep triggers the idle thread, which makes the pm subsystem select some
		 * pre-defined power state. Light sleep is used here because there is enough
		 * time to consider it, energy-wise, worthy.
		 */
		k_sleep(K_USEC(DT_PROP(DT_NODELABEL(light_sleep), min_residency_us) +
					LIGHT_SLP_EXTRA_DELAY));
		/* Execution continues here after wakeup */
		/* Get timestamp after waking up from sleep */
		int64_t t_after_ms = k_uptime_get();

		/* Determine wake up reason */
		const char *wakeup_reason;

		if (esp_sleep_get_wakeup_causes() & BIT(ESP_SLEEP_WAKEUP_TIMER)) {
			wakeup_reason = "timer";
		} else {
			wakeup_reason = "other";
		}

		printk("Returned from light sleep, reason: %s, t=%lld ms, slept for %lld ms\n",
				wakeup_reason, t_after_ms, (t_after_ms - t_before_ms));
	}

	return 0;
}
```
