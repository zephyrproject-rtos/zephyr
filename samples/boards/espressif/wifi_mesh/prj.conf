## CMakeLists.txt
```
# SPDX-License-Identifier: Apache-2.0

cmake_minimum_required(VERSION 3.28.0)

find_package(Zephyr REQUIRED HINTS $ENV{ZEPHYR_BASE})
project(wifi_mesh)

target_sources(app PRIVATE src/main.c src/mesh_shell.c)
```

## Kconfig
```
# Copyright (c) 2026 Espressif Systems (Shanghai) Co., Ltd.
# SPDX-License-Identifier: Apache-2.0

mainmenu "Wi-Fi mesh sample"

source "Kconfig.zephyr"
```

## prj.conf
```kconfig
# Wi-Fi mesh
CONFIG_WIFI=y
CONFIG_WIFI_NM=y
CONFIG_WIFI_ESP32=y
CONFIG_WIFI_ESP32_MESH=y

# A router is required for the mesh to elect a root: self-organized election
# is driven by router reachability. The router credentials default to
# placeholders and must be set to the router in use, at runtime through
# esp_wifi_mesh_set_config() in main.c, before esp_wifi_mesh_start() is called.

# The mesh stack manages the Wi-Fi interface directly. The network stack is
# only used to instantiate the Wi-Fi interface; this sample exchanges data
# over the mesh transport, not over IP.
CONFIG_NETWORKING=y
CONFIG_NET_L2_ETHERNET=y
CONFIG_NET_L2_WIFI_MGMT=y

# Event loop used by the mesh stack to post MESH_EVENT notifications.
CONFIG_NET_MGMT=y
CONFIG_NET_MGMT_EVENT=y

# No IP is brought up in this sample.
CONFIG_NET_CONFIG_AUTO_INIT=n

# Single system heap shared by the Wi-Fi driver and the mesh stack. Most of it
# holds the Wi-Fi RX/TX buffer pools (see ESP_WIFI_*_BUFFER_NUM), which grow
# with the number of simultaneous direct links a node carries. The same image
# is flashed to every board and any node may be elected root, so this is sized
# for the worst case: a node hosting several direct children. On hardware a
# root serving five direct children needs roughly 112 KB; a leaf needs far
# less. Raise this further for a wider tree (higher MESH_MAX_CONNECTIONS).
CONFIG_HEAP_MEM_POOL_SIZE=114688

CONFIG_LOG=y
CONFIG_MAIN_STACK_SIZE=4096

# Interactive "mesh" shell: status, send, table, autotx.
CONFIG_SHELL=y
```

## src/main.c
```c
/*
 * Copyright (c) 2026 Espressif Systems (Shanghai) Co., Ltd.
 *
 * SPDX-License-Identifier: Apache-2.0
 */

#include <zephyr/kernel.h>
#include <zephyr/logging/log.h>
#include <zephyr/net/net_if.h>
#include <zephyr/drivers/wifi/esp_wifi/esp_wifi_mesh.h>

#include "mesh_demo.h"

LOG_MODULE_REGISTER(wifi_mesh, LOG_LEVEL_INF);

/*
 * Self-organizing Wi-Fi mesh sample.
 *
 * Every node runs Wi-Fi in combined AP and station mode. The station side
 * links upward to a parent, the softAP side accepts children. Nodes elect a
 * root among themselves; only the root reaches the router (external network).
 * The Wi-Fi driver performs the mesh bring-up; this sample reacts to mesh
 * events, logs received mesh messages, and drives the mesh from a shell.
 */

#define MESH_TX_PERIOD     K_SECONDS(5)
#define MESH_RX_TIMEOUT_MS 1000

static uint8_t rx_buf[128];

bool mesh_running;
bool mesh_autotx;

static void mesh_event(enum esp_wifi_mesh_event event, const struct esp_wifi_mesh_event_info *info)
{
	switch (event) {
	case ESP_WIFI_MESH_EVENT_STARTED:
		mesh_running = true;
		LOG_INF("mesh started, layer %d", info->layer);
		break;
	case ESP_WIFI_MESH_EVENT_STOPPED:
		mesh_running = false;
		LOG_INF("mesh stopped");
		break;
	case ESP_WIFI_MESH_EVENT_PARENT_CONNECTED:
		LOG_INF("parent connected, layer %d%s", info->layer,
			info->is_root ? " (root)" : "");
		break;
	case ESP_WIFI_MESH_EVENT_PARENT_DISCONNECTED:
		LOG_INF("parent disconnected, reason %d", info->reason);
		break;
	case ESP_WIFI_MESH_EVENT_NO_PARENT_FOUND:
		LOG_INF("no parent found, scanning");
		break;
	case ESP_WIFI_MESH_EVENT_FIND_NETWORK:
		LOG_INF("find network");
		break;
	case ESP_WIFI_MESH_EVENT_CHILD_CONNECTED:
		LOG_INF("child connected");
		break;
	case ESP_WIFI_MESH_EVENT_CHILD_DISCONNECTED:
		LOG_INF("child disconnected");
		break;
	case ESP_WIFI_MESH_EVENT_ROUTING_TABLE_CHANGE:
		LOG_INF("routing table size %d", info->routing_table_size);
		break;
	case ESP_WIFI_MESH_EVENT_LAYER_CHANGE:
		LOG_INF("layer changed to %d", info->layer);
		break;
	case ESP_WIFI_MESH_EVENT_TODS_REACHABLE:
		LOG_INF("root external network reachable");
		break;
	case ESP_WIFI_MESH_EVENT_TODS_UNREACHABLE:
		LOG_INF("root external network unreachable");
		break;
	default:
		break;
	}
}

static void mesh_rx_task(void *p1, void *p2, void *p3)
{
	ARG_UNUSED(p1);
	ARG_UNUSED(p2);
	ARG_UNUSED(p3);

	while (1) {
		size_t len = sizeof(rx_buf);

		if (!mesh_running) {
			k_sleep(K_MSEC(200));
			continue;
		}

		if (esp_wifi_mesh_recv(rx_buf, &len, MESH_RX_TIMEOUT_MS) == 0) {
			/* Terminate before logging: a peer may send a payload
			 * that is not NUL-terminated or fills the whole buffer.
			 */
			rx_buf[MIN(len, sizeof(rx_buf) - 1)] = '\0';
			LOG_INF("rx %d bytes: %s", (int)len, (char *)rx_buf);
		}
	}
}

/*
 * Optional periodic sender, off by default and toggled with "mesh autotx".
 * When enabled it sends a "hello seq=N" message every few seconds so the mesh
 * can be exercised without typing "mesh send" by hand.
 */
static void mesh_tx_task(void *p1, void *p2, void *p3)
{
	ARG_UNUSED(p1);
	ARG_UNUSED(p2);
	ARG_UNUSED(p3);

	uint8_t tx_buf[64];
	uint32_t seq = 0;

	while (1) {
		k_sleep(MESH_TX_PERIOD);

		if (!mesh_running || !mesh_autotx) {
			continue;
		}

		int len = snprintk((char *)tx_buf, sizeof(tx_buf), "hello seq=%u", seq++) + 1;

		esp_wifi_mesh_send(tx_buf, len);
	}
}

K_THREAD_DEFINE(mesh_rx_id, 4096, mesh_rx_task, NULL, NULL, NULL, 5, 0, 0);
K_THREAD_DEFINE(mesh_tx_id, 4096, mesh_tx_task, NULL, NULL, NULL, 5, 0, 0);

int main(void)
{
	if (net_if_get_first_wifi() == NULL) {
		LOG_ERR("no Wi-Fi interface found");
		return -ENODEV;
	}

	esp_wifi_mesh_event_cb_register(mesh_event);

	/*
	 * Mesh credentials and tree limits are runtime-configurable; set them
	 * here before esp_wifi_mesh_start() rather than through Kconfig. These
	 * values match the driver's built-in defaults: replace them with your
	 * router's credentials and a mesh ID unique to your network.
	 */
	struct esp_wifi_mesh_config mesh_cfg = {
		.ssid = "myssid",
		.password = "mypassword",
		.mesh_password = "meshpassword",
		.channel = 0,
		.mesh_id = {0x12, 0x34, 0x56, 0x78, 0x9a, 0xbc},
		.authmode = WIFI_SECURITY_TYPE_PSK,
		.num_layers = CONFIG_WIFI_ESP32_MESH_MAX_LAYER,
		.max_connections = CONFIG_WIFI_ESP32_MESH_MAX_CONNECTIONS,
	};

	if (esp_wifi_mesh_set_config(&mesh_cfg) != 0) {
		LOG_ERR("invalid mesh configuration");
		return -EINVAL;
	}

	if (esp_wifi_mesh_start() != 0) {
		LOG_ERR("Wi-Fi mesh start failed");
		return -EIO;
	}

	LOG_INF("Wi-Fi mesh starting (router SSID \"%s\"), use the \"mesh\" shell commands",
		mesh_cfg.ssid);
	return 0;
}
```

## src/mesh_demo.h
```c
/*
 * Copyright (c) 2026 Espressif Systems (Shanghai) Co., Ltd.
 *
 * SPDX-License-Identifier: Apache-2.0
 */

#ifndef MESH_DEMO_H
#define MESH_DEMO_H

#include <stdbool.h>

/* Set once the mesh has started; the tx/rx demo tasks gate on it. */
extern bool mesh_running;

/* Toggled by the "mesh autotx" shell command; drives the periodic sender. */
extern bool mesh_autotx;

#endif /* MESH_DEMO_H */
```

## src/mesh_shell.c
```c
/*
 * Copyright (c) 2026 Espressif Systems (Shanghai) Co., Ltd.
 *
 * SPDX-License-Identifier: Apache-2.0
 *
 * Interactive "mesh" shell for the raw-mesh sample: inspect the node state,
 * send a message over the mesh, dump the routing table, and toggle the
 * periodic demo sender.
 */

#include <string.h>

#include <zephyr/kernel.h>
#include <zephyr/shell/shell.h>
#include <zephyr/drivers/wifi/esp_wifi/esp_wifi_mesh.h>

#include "mesh_demo.h"

/* Bounded by the mesh tree size (max layers * children per node). */
#define MESH_TABLE_MAX                                                                             \
	(CONFIG_WIFI_ESP32_MESH_MAX_LAYER * CONFIG_WIFI_ESP32_MESH_MAX_CONNECTIONS + 1)

static int cmd_mesh_status(const struct shell *sh, size_t argc, char *argv[])
{
	ARG_UNUSED(argc);
	ARG_UNUSED(argv);

	struct esp_wifi_mesh_status status;

	if (!mesh_running) {
		shell_print(sh, "mesh not running");
		return 0;
	}

	esp_wifi_mesh_get_status(&status);

	shell_print(sh, "layer:         %d", status.layer);
	shell_print(sh, "role:          %s", status.is_root ? "root" : "node");
	shell_print(sh, "routing table: %d node(s)", status.routing_table_size);
	shell_print(sh, "toDS:          %s", status.tods_reachable ? "reachable" : "unreachable");
	shell_print(sh, "autotx:        %s", mesh_autotx ? "on" : "off");

	return 0;
}

static int cmd_mesh_send(const struct shell *sh, size_t argc, char *argv[])
{
	if (!mesh_running) {
		shell_error(sh, "mesh not running");
		return -ENOEXEC;
	}

	/* Send the message text plus its terminating NUL so the peer can log it. */
	size_t len = strlen(argv[1]) + 1;

	if (esp_wifi_mesh_send((const uint8_t *)argv[1], len) != 0) {
		shell_error(sh, "mesh send failed");
		return -EIO;
	}

	shell_print(sh, "sent %d bytes over mesh", (int)len);
	return 0;
}

static int cmd_mesh_table(const struct shell *sh, size_t argc, char *argv[])
{
	ARG_UNUSED(argc);
	ARG_UNUSED(argv);

	static struct esp_wifi_mesh_addr macs[MESH_TABLE_MAX];
	size_t count = 0;

	if (!mesh_running) {
		shell_error(sh, "mesh not running");
		return -ENOEXEC;
	}

	if (esp_wifi_mesh_get_routing_table(macs, MESH_TABLE_MAX, &count) != 0) {
		shell_error(sh, "cannot read routing table");
		return -EIO;
	}

	shell_print(sh, "routing table: %d node(s)", (int)count);
	for (size_t i = 0; i < count; i++) {
		shell_print(sh, "%2d: %02x:%02x:%02x:%02x:%02x:%02x", (int)i, macs[i].addr[0],
			    macs[i].addr[1], macs[i].addr[2], macs[i].addr[3], macs[i].addr[4],
			    macs[i].addr[5]);
	}

	return 0;
}

static int cmd_mesh_autotx(const struct shell *sh, size_t argc, char *argv[])
{
	if (strcmp(argv[1], "on") == 0) {
		mesh_autotx = true;
	} else if (strcmp(argv[1], "off") == 0) {
		mesh_autotx = false;
	} else {
		shell_error(sh, "usage: mesh autotx <on|off>");
		return -EINVAL;
	}

	shell_print(sh, "periodic tx %s", mesh_autotx ? "enabled" : "disabled");
	return 0;
}

SHELL_STATIC_SUBCMD_SET_CREATE(
	sub_mesh,
	SHELL_CMD_ARG(autotx, NULL, "Toggle the periodic sender: mesh autotx <on|off>",
		      cmd_mesh_autotx, 2, 0),
	SHELL_CMD_ARG(send, NULL, "Send a message over the mesh: mesh send <text>", cmd_mesh_send,
		      2, 0),
	SHELL_CMD_ARG(status, NULL, "Show this node's mesh status", cmd_mesh_status, 1, 0),
	SHELL_CMD_ARG(table, NULL, "Dump the mesh routing table", cmd_mesh_table, 1, 0),
	SHELL_SUBCMD_SET_END);

SHELL_CMD_REGISTER(mesh, &sub_mesh, "Wi-Fi mesh commands", NULL);
```
