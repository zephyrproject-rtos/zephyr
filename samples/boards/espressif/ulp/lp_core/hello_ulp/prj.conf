## CMakeLists.txt
```
# SPDX-License-Identifier: Apache-2.0

cmake_minimum_required(VERSION 3.20.0)

set(REMOTE_ZEPHYR_DIR ${CMAKE_CURRENT_BINARY_DIR}/../hello_ulp_lpcore/zephyr)

find_package(Zephyr REQUIRED HINTS $ENV{ZEPHYR_BASE})

message(STATUS "${CONFIG_BOARD_TARGET} compile as Master in this sample")
project(hello_ulp_hpcore)

target_sources(app PRIVATE src/main.c)
```

## Kconfig.sysbuild
```
# Copyright 2022 NXP
#
# SPDX-License-Identifier: Apache-2.0

source "share/sysbuild/Kconfig"

config ULP_REMOTE_BOARD
	string
	default "esp32c6_devkitc/esp32c6/lpcore" if $(BOARD) = "esp32c6_devkitc"
```

## sample.yaml
```
sample:
  name: ESP32C6 LP_CORE Hello World Sample
tests:
  sample.boards.espressif.ulp.lp_core.hello_ulp:
    platform_allow:
      - esp32c6_devkitc/esp32c6/hpcore
    tags:
      - samples
    sysbuild: true
```

## prj.conf
```kconfig
CONFIG_ULP_COPROC_ENABLED=y
CONFIG_POWEROFF=y
```

## app.overlay
```dts
/*
 * Copyright (c) 2025 Espressif Systems (Shanghai) Co., Ltd.
 *
 * SPDX-License-Identifier: Apache-2.0
 */

#include <mem.h>

&lp_uart {
	status = "okay";
};

&sramlp {
	reg = <0x50000000 DT_SIZE_K(8)>;
};
```

## src/main.c
```c
/*
 * Copyright (c) 2025 Espressif Systems (Shanghai) Co., Ltd.
 *
 * SPDX-License-Identifier: Apache-2.0
 */

#include <stdio.h>
#include <zephyr/sys/poweroff.h>
#include <esp_sleep.h>
#include <ulp_lp_core.h>
#include <zephyr/kernel.h>

int main(void)
{
	while (1) {
		k_sleep(K_MSEC(1000));
	}

	return 0;
}
```
