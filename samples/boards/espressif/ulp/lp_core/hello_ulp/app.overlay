/*
 * Copyright (c) 2025 Espressif Systems (Shanghai) Co., Ltd.
 *
 * SPDX-License-Identifier: Apache-2.0
 */

#include <mem.h>

&lp_uart {
	status = "okay";
};

&sramlp {
	reg = <0x50000000 DT_SIZE_K(8)>;
};
