## CMakeLists.txt
```
# Copyright (c) 2025 Espressif Systems (Shanghai) Co., Ltd.
# SPDX-License-Identifier: Apache-2.0

cmake_minimum_required(VERSION 3.28.0)

set(REMOTE_ZEPHYR_DIR ${CMAKE_CURRENT_BINARY_DIR}/../interrupt_ulp_lpcore/zephyr)

find_package(Zephyr REQUIRED HINTS $ENV{ZEPHYR_BASE})

message(STATUS "${CONFIG_BOARD_TARGET} compile as Master in this sample")
project(interrupt_ulp_hpcore)

target_sources(app PRIVATE src/main.c)
```

## Kconfig.sysbuild
```
# Copyright (c) 2025 Espressif Systems (Shanghai) Co., Ltd.
# SPDX-License-Identifier: Apache-2.0

source "share/sysbuild/Kconfig"

config ULP_REMOTE_BOARD
	string
	default "esp32c6_devkitc/esp32c6/lpcore" if $(BOARD) = "esp32c6_devkitc"
	default "esp32c5_devkitc/esp32c5/lpcore" if $(BOARD) = "esp32c5_devkitc"
```

## sample.yaml
```
sample:
  name: ESP32-C6 LP_CORE Interrupt Sample
tests:
  sample.boards.espressif.ulp.lp_core.interrupt_ulp:
    platform_allow:
      - esp32c6_devkitc/esp32c6/hpcore
    tags:
      - samples
    sysbuild: true
```

## prj.conf
```kconfig
CONFIG_ULP_COPROC_ENABLED=y
CONFIG_POWEROFF=y
CONFIG_HWINFO=y
```

## app.overlay
```dts
/*
 * Copyright (c) 2025 Espressif Systems (Shanghai) Co., Ltd.
 *
 * SPDX-License-Identifier: Apache-2.0
 */

&lp_uart {
	status = "okay";
};
```

## src/main.c
```c
/*
 * Copyright (c) 2025 Espressif Systems (Shanghai) Co., Ltd.
 *
 * SPDX-License-Identifier: Apache-2.0
 */

#include <stdio.h>
#include <ulp_lp_core.h>
#include <zephyr/kernel.h>
#include <zephyr/drivers/hwinfo.h>
#include <zephyr/sys/poweroff.h>

int main(void)
{
	uint32_t cause;

	hwinfo_get_reset_cause(&cause);
	printf("Reset cause: 0x%x\n", cause);

	printf("Triggering ULP interrupt...\n");
	ulp_lp_core_sw_intr_trigger();
	k_sleep(K_MSEC(1000));

	printf("HP core entering deep sleep...\n");
	sys_poweroff();

	return 0;
}
```
