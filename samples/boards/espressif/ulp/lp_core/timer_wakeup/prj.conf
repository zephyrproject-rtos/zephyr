## CMakeLists.txt
```
# Copyright (c) 2026 Espressif Systems (Shanghai) Co., Ltd.
# SPDX-License-Identifier: Apache-2.0

cmake_minimum_required(VERSION 3.28.0)

set(REMOTE_ZEPHYR_DIR ${CMAKE_CURRENT_BINARY_DIR}/../timer_wakeup_lpcore/zephyr)

find_package(Zephyr REQUIRED HINTS $ENV{ZEPHYR_BASE})

project(timer_wakeup_hpcore)

target_sources(app PRIVATE src/main.c)
```

## Kconfig.sysbuild
```
# Copyright (c) 2026 Espressif Systems (Shanghai) Co., Ltd.
# SPDX-License-Identifier: Apache-2.0

source "share/sysbuild/Kconfig"

config ULP_REMOTE_BOARD
	string
	default "esp32c5_devkitc/esp32c5/lpcore" if $(BOARD) = "esp32c5_devkitc"
	default "esp32c6_devkitc/esp32c6/lpcore" if $(BOARD) = "esp32c6_devkitc"
	default "esp32p4x_function_ev_board/esp32p4/lpcore" if $(BOARD) = "esp32p4x_function_ev_board"
	default "esp32s31_function_coreboard/esp32s31/lpcore" if $(BOARD) = "esp32s31_function_coreboard"
```

## sample.yaml
```
sample:
  name: ESP32-C6 LP Core Timer Wakeup Sample
tests:
  sample.boards.esp32.ulp.lp_core.timer_wakeup:
    platform_allow:
      - esp32c6_devkitc/esp32c6/hpcore
    tags:
      - samples
    sysbuild: true
    harness: console
    harness_config:
      type: multi_line
      ordered: true
      regex:
        - "First boot, LP core will wake us every"
        - "HP core entering deep sleep"
        - "Woke up from LP core! Wake count:"
```

## prj.conf
```kconfig
CONFIG_SOC_FAMILY_ESPRESSIF_ULP_ENABLED=y
CONFIG_SOC_FAMILY_ESPRESSIF_ULP_LP_CORE_WAKEUP_SOURCE_LP_TIMER=y
CONFIG_SOC_FAMILY_ESPRESSIF_ULP_LP_CORE_LP_TIMER_SLEEP_DURATION_US=2000000
CONFIG_POWEROFF=y
CONFIG_HWINFO=y
```

## src/main.c
```c
/*
 * Copyright (c) 2026 Espressif Systems (Shanghai) Co., Ltd.
 *
 * SPDX-License-Identifier: Apache-2.0
 */

#include <stdio.h>
#include <zephyr/kernel.h>
#include <zephyr/drivers/hwinfo.h>
#include <zephyr/sys/poweroff.h>
#include <esp_attr.h>

static RTC_DATA_ATTR uint32_t wake_count;

int main(void)
{
	uint32_t cause;

	hwinfo_get_reset_cause(&cause);

	if (cause & RESET_LOW_POWER_WAKE) {
		wake_count++;
		printf("Woke up from LP core! Wake count: %d\n", wake_count);
	} else {
		wake_count = 0;
		printf("First boot, LP core will wake us every %d ms\n",
		       CONFIG_SOC_FAMILY_ESPRESSIF_ULP_LP_CORE_LP_TIMER_SLEEP_DURATION_US / 1000);
	}

	printf("HP core entering deep sleep...\n");
	sys_poweroff();

	return 0;
}
```
