## CMakeLists.txt
```
# Copyright (c) 2026 Espressif Systems (Shanghai) Co., Ltd.
# SPDX-License-Identifier: Apache-2.0

cmake_minimum_required(VERSION 3.28.0)

set(REMOTE_ZEPHYR_DIR ${CMAKE_CURRENT_BINARY_DIR}/../gpio_wakeup_lpcore/zephyr)

find_package(Zephyr REQUIRED HINTS $ENV{ZEPHYR_BASE})

project(gpio_wakeup_hpcore)

target_sources(app PRIVATE src/main.c)
```

## Kconfig.sysbuild
```
# Copyright (c) 2026 Espressif Systems (Shanghai) Co., Ltd.
# SPDX-License-Identifier: Apache-2.0

source "share/sysbuild/Kconfig"

config ULP_REMOTE_BOARD
	string
	default "esp32c6_devkitc/esp32c6/lpcore" if $(BOARD) = "esp32c6_devkitc"
```

## sample.yaml
```
sample:
  name: ESP32-C6 LP Core GPIO Wakeup Sample
tests:
  sample.boards.espressif.ulp.lp_core.gpio_wakeup:
    platform_allow:
      - esp32c6_devkitc/esp32c6/hpcore
    tags:
      - samples
    sysbuild: true
```

## prj.conf
```kconfig
CONFIG_SOC_FAMILY_ESPRESSIF_ULP_ENABLED=y
CONFIG_SOC_FAMILY_ESPRESSIF_ULP_LP_CORE_WAKEUP_SOURCE_LP_IO=y
CONFIG_POWEROFF=y
CONFIG_HWINFO=y
```

## src/main.c
```c
/*
 * Copyright (c) 2026 Espressif Systems (Shanghai) Co., Ltd.
 *
 * SPDX-License-Identifier: Apache-2.0
 */

#include <stdio.h>
#include <zephyr/kernel.h>
#include <zephyr/drivers/hwinfo.h>
#include <zephyr/sys/poweroff.h>
#include <esp_attr.h>

static RTC_DATA_ATTR uint32_t wake_count;

int main(void)
{
	uint32_t cause;

	hwinfo_get_reset_cause(&cause);

	if (cause & RESET_LOW_POWER_WAKE) {
		wake_count++;
		printf("Woke up from LP core (LP IO)! Wake count: %d\n", wake_count);
	} else {
		wake_count = 0;
		printf("First boot, LP core will wake us on LP GPIO level\n");
	}

	printf("HP core entering deep sleep...\n");
	sys_poweroff();

	return 0;
}
```
