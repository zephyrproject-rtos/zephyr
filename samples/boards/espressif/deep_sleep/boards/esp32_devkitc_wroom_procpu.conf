## samples/boards/espressif/deep_sleep/sample.yaml
```yaml
sample:
  description: Sample application to test ESP32 deep-sleep mode
  name: ESP32 Deep-sleep
tests:
  sample.esp32.deep_sleep.build_only:
    build_only: true
    platform_allow:
      - esp32_devkitc/esp32/procpu
      - esp32s3_devkitm/esp32s3/procpu
      - esp32s2_devkitc
      - esp32c3_devkitm
      - esp32c6_devkitc/esp32c6/hpcore
      - esp8684_devkitm
  sample.esp32.deep_sleep.dut:
    extra_args:
      - CONFIG_EXAMPLE_EXT1_WAKEUP=n
      - CONFIG_EXAMPLE_GPIO_WAKEUP=n
      - CONFIG_EXAMPLE_WAKEUP_TIME_SEC=1
      - CONFIG_ESP32_USE_UNSUPPORTED_REVISION=y
    platform_allow:
      - esp32_devkitc/esp32/procpu
      - esp32s3_devkitm/esp32s3/procpu
      - esp32s2_devkitc
      - esp32c3_devkitm
      - esp32c6_devkitc/esp32c6/hpcore
      - esp8684_devkitm
    tags: esp32
    harness: console
    harness_config:
      type: multi_line
      regex:
        - "Powering off"
        - "Wake up from timer"
```

## samples/boards/espressif/esp154_sniffer/sample.yaml
```yaml
sample:
  name: esp154_sniffer
  description: IEEE 802.15.4 frame sniffer skeleton for Espressif (H2/C6/C5)
common:
  tags:
    - ieee802154
    - espressif
  filter: dt_chosen_enabled("zephyr,ieee802154")
tests:
  sample.apps.esp154_sniffer.build:
    build_only: true
    platform_allow:
      - esp32c6_devkitc
      - esp32h2_devkitm
      - esp32c5_devkitc
```

## samples/boards/espressif/espnow/Kconfig
```kconfig
# Copyright (c) 2026 Rapyuta Robotics
# SPDX-License-Identifier: Apache-2.0

mainmenu "ESP-NOW Sample"

menu "ESP-NOW Configuration"

choice ESPNOW_ROLE
	prompt "Device role"
	default ESPNOW_ROLE_BIDIR
	help
	  SENDER:   transmits heartbeat beacons only.
	  RECEIVER: listens only (no beacon thread).
	  BIDIR:    transmits beacons AND receives -- loopback test with two devices.

config ESPNOW_ROLE_SENDER
	bool "Sender"

config ESPNOW_ROLE_RECEIVER
	bool "Receiver"

config ESPNOW_ROLE_BIDIR
	bool "Both (send + receive)"

endchoice

config ESPNOW_CHANNEL
	int "Wi-Fi channel"
	range 1 13
	default 1
	help
	  Both devices must use the same channel.

config ESPNOW_BEACON_INTERVAL_S
	int "Beacon interval (seconds)"
	range 1 60
	default 5
	depends on ESPNOW_ROLE_SENDER || ESPNOW_ROLE_BIDIR

endmenu

source "Kconfig.zephyr"
```

## samples/boards/espressif/flash_encryption/sample.yaml
```yaml
sample:
  description: Sample application to test ESP32 flash encryption
  name: flash_encryption
tests:
  sample.board.esp32:
    platform_allow:
      - esp32_devkitc/esp32/procpu
      - yd_esp32/esp32/procpu
    tags: esp32
    build_only: true
```

## samples/boards/espressif/flash_ipm/Kconfig.sysbuild
```kconfig
# Copyright 2025 Espressif
#
# SPDX-License-Identifier: Apache-2.0

source "share/sysbuild/Kconfig"
```

## samples/boards/espressif/flash_ipm/sample.yaml
```yaml
sample:
  name: ESP32 Flash IPM Sample
tests:
  sample.espressif.flash_ipm:
    platform_allow:
      - esp32s3_devkitc/esp32s3/procpu
    tags:
      - samples
      - ipm
```

## samples/boards/espressif/light_sleep/sample.yaml
```yaml
sample:
  description: Sample application to test ESP32 light-sleep mode
  name: ESP32 Light-sleep
tests:
  sample.boards.esp32.light_sleep:
    platform_allow:
    - esp32_devkitc/esp32/procpu
    - esp32c3_devkitc
    - esp32s2_devkitc
    - esp32s3_devkitc/esp32s3/procpu
    - esp8684_devkitm
    tags: esp32
    build_only: true
    extra_configs:
    - CONFIG_ESP32_SLEEP_POWER_DOWN_FLASH=y
  sample.board.esp32.light_sleep.periph_pd:
    platform_allow:
    - esp32c5_devkitc/esp32c5/hpcore
    - esp32c6_devkitc/esp32c6/hpcore
    - esp32h2_devkitm
    tags: esp32
    build_only: true
    extra_configs:
    - CONFIG_ESP32_SLEEP_POWER_DOWN_FLASH=y
    - CONFIG_ESP32_PM_POWER_DOWN_PERIPHERAL_IN_LIGHT_SLEEP=y
    - CONFIG_HEAP_MEM_POOL_SIZE=8192
```

## samples/boards/espressif/qdec_trigger/sample.yaml
```yaml
sample:
  description: ESP32 PCNT per-unit threshold trigger sample
  name: ESP32 qdec per-unit trigger
tests:
  sample.esp32.qdec_trigger:
    build_only: true
    tags:
      - samples
      - sensor
    platform_allow:
      - esp32_devkitc/esp32/procpu
      - esp32s2_saola
      - esp32s3_devkitc/esp32s3/procpu
      - esp32c5_devkitc/esp32c5/hpcore
      - esp32c6_devkitc/esp32c6/hpcore
      - esp32h2_devkitm/esp32h2
      - esp32p4_function_ev_board/esp32p4/hpcore
    depends_on: pinctrl
```

## samples/boards/espressif/serial_flasher/sample.yaml
```yaml
sample:
  description: ESP Serial Flasher sample code
  name: zephyr_flasher
tests:
  sample.esp_flasher.zephyr_example:
    platform_allow:
      - esp32_devkitc_wroom
      - esp32_devkitc_wrover
    tags: esp32
```

## samples/boards/espressif/spiram_test/sample.yaml
```yaml
sample:
  description: Application to test memory allocation from SPIRAM
  name: spiram_test
common:
  harness: console
  harness_config:
    type: multi_line
    regex:
      - "SPIRAM mem test pass"
      - "Internal mem test pass"
tests:
  sample.boards.esp32.spiram:
    platform_allow: esp32_devkitc/esp32/procpu
    tags: esp32
  sample.boards.esp32s2.spiram:
    platform_allow: esp32s2_devkitc
    tags: esp32s2
  sample.boards.esp32s3.spiram:
    platform_allow: esp32s3_devkitc/esp32s3/procpu
    tags: esp32s3
  sample.boards.esp32c5.spiram:
    platform_allow: esp32c5_devkitc/esp32c5/hpcore
    tags: esp32c5
  sample.boards.esp32p4.spiram:
    platform_allow: esp32p4_function_ev_board/esp32p4/hpcore
    tags: esp32p4
  sample.boards.esp32s3.spiram.octal_80m:
    platform_allow: esp32s3_devkitc/esp32s3/procpu
    tags: esp32s3
    extra_configs:
      - CONFIG_SPIRAM_SPEED_80M=y
      - CONFIG_SPIRAM_MODE_OCT=y
```

## samples/boards/espressif/ulp/lp_core/blinky_ulp/sample.yaml
```yaml
sample:
  name: ESP32C6 LP_CORE blinky World Sample
tests:
  sample.boards.espressif.ulp.lp_core.blinky_ulp:
    platform_allow:
      - esp32c6_devkitc/esp32c6/hpcore
    tags:
      - samples
```

## samples/boards/espressif/ulp/lp_core/debug_ulp/Kconfig.sysbuild
```kconfig
# Copyright (c) 2025 Espressif Systems (Shanghai) Co., Ltd.
# SPDX-License-Identifier: Apache-2.0

source "share/sysbuild/Kconfig"

config ULP_REMOTE_BOARD
	string
	default "esp32c6_devkitc/esp32c6/lpcore" if $(BOARD) = "esp32c6_devkitc"
```

## samples/boards/espressif/ulp/lp_core/debug_ulp/sample.yaml
```yaml
sample:
  name: ESP32C6 LP_CORE Debug Sample
tests:
  sample.boards.espressif.ulp.lp_core.debug_ulp:
    platform_allow:
      - esp32c6_devkitc/esp32c6/hpcore
    tags:
      - samples
    sysbuild: true
```

## samples/boards/espressif/ulp/lp_core/echo_ulp/sample.yaml
```yaml
sample:
  name: ESP32-C6 LP_CORE Echo Sample
tests:
  sample.boards.espressif.ulp.lp_core.echo_ulp:
    platform_allow:
      - esp32c6_devkitc/esp32c6/hpcore
    tags:
      - samples
    sysbuild: true
```

## samples/boards/espressif/ulp/lp_core/gpio_wakeup/Kconfig.sysbuild
```kconfig
# Copyright (c) 2026 Espressif Systems (Shanghai) Co., Ltd.
# SPDX-License-Identifier: Apache-2.0

source "share/sysbuild/Kconfig"

config ULP_REMOTE_BOARD
	string
	default "esp32c6_devkitc/esp32c6/lpcore" if $(BOARD) = "esp32c6_devkitc"
```

## samples/boards/espressif/ulp/lp_core/gpio_wakeup/sample.yaml
```yaml
sample:
  name: ESP32-C6 LP Core GPIO Wakeup Sample
tests:
  sample.boards.espressif.ulp.lp_core.gpio_wakeup:
    platform_allow:
      - esp32c6_devkitc/esp32c6/hpcore
    tags:
      - samples
    sysbuild: true
```

## samples/boards/espressif/ulp/lp_core/hello_ulp/Kconfig.sysbuild
```kconfig
# Copyright 2022 NXP
#
# SPDX-License-Identifier: Apache-2.0

source "share/sysbuild/Kconfig"

config ULP_REMOTE_BOARD
	string
	default "esp32c6_devkitc/esp32c6/lpcore" if $(BOARD) = "esp32c6_devkitc"
```

## samples/boards/espressif/ulp/lp_core/hello_ulp/sample.yaml
```yaml
sample:
  name: ESP32C6 LP_CORE Hello World Sample
tests:
  sample.boards.espressif.ulp.lp_core.hello_ulp:
    platform_allow:
      - esp32c6_devkitc/esp32c6/hpcore
    tags:
      - samples
```

## samples/boards/espressif/ulp/lp_core/interrupt_ulp/sample.yaml
```yaml
sample:
  name: ESP32-C6 LP_CORE Interrupt Sample
tests:
  sample.boards.espressif.ulp.lp_core.interrupt_ulp:
    platform_allow:
      - esp32c6_devkitc/esp32c6/hpcore
    tags:
      - samples
    sysbuild: true
```

## samples/boards/espressif/ulp/lp_core/timer_wakeup/Kconfig.sysbuild
```kconfig
# Copyright (c) 2026 Espressif Systems (Shanghai) Co., Ltd.
# SPDX-License-Identifier: Apache-2.0

source "share/sysbuild/Kconfig"

config ULP_REMOTE_BOARD
	string
	default "esp32c5_devkitc/esp32c5/lpcore" if $(BOARD) = "esp32c5_devkitc"
	default "esp32c6_devkitc/esp32c6/lpcore" if $(BOARD) = "esp32c6_devkitc"
	default "esp32p4x_function_ev_board/esp32p4/lpcore" if $(BOARD) = "esp32p4x_function_ev_board"
```

## samples/boards/espressif/ulp/lp_core/timer_wakeup/sample.yaml
```yaml
sample:
  name: ESP32-C6 LP Core Timer Wakeup Sample
tests:
  sample.boards.espressif.ulp.lp_core.timer_wakeup:
    platform_allow:
      - esp32c6_devkitc/esp32c6/hpcore
    tags:
      - samples
    sysbuild: true
    harness: console
    harness_config:
      type: multi_line
      ordered: true
      regex:
        - "First boot, LP core will wake us every"
        - "HP core entering deep sleep"
        - "Woke up from LP core! Wake count:"
```

## samples/boards/espressif/wifi_mesh_ip/boards/esp32_devkitc_procpu.conf
```kconfig
# The original ESP32 has a smaller DRAM budget than the newer SoCs, and the
# defaults in prj.conf are sized for a root node carrying several children. Trim
# the mesh fan-out and the Wi-Fi buffer pools so the heap still fits alongside
# the IP stack. A node built this way works as a leaf child; it does not have
# the buffers to host a wide sub-tree.
CONFIG_WIFI_ESP32_MESH_MAX_CONNECTIONS=1
CONFIG_ESP32_WIFI_STATIC_RX_BUFFER_NUM=4
CONFIG_ESP32_WIFI_DYNAMIC_RX_BUFFER_NUM=8
CONFIG_ESP32_WIFI_DYNAMIC_TX_BUFFER_NUM=8
CONFIG_WIFI_ESP32_MESH_XON_QSIZE=16
CONFIG_HEAP_MEM_POOL_SIZE=98304
```

## samples/boards/espressif/xt_wdt/sample.yaml
```yaml
sample:
  description: Application to test XT WDT
  name: xt_wdt_sample
tests:
  sample.board.esp32.xt_wdt:
    platform_allow:
      - esp32c3_devkitc
      - esp32s2_devkitc
      - esp32s3_devkitc/esp32s3/procpu
    tags: esp32
```
