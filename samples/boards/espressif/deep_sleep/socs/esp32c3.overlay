/*
 * Copyright (c) 2022 Espressif Systems (Shanghai) Co., Ltd.
 *
 * SPDX-License-Identifier: Apache-2.0
 */

/ {
	aliases {
		/* On ESP32-C3, only GPIO0~5 can be used
		 * as wake-up sources
		 */
		wakeup-button = &sample_button;
	};

	gpio_keys {
		compatible = "gpio-keys";
		sample_button: sample_button {
			gpios = <&gpio0 0 (GPIO_PULL_DOWN | GPIO_ACTIVE_HIGH)>;
		};
	};
};
