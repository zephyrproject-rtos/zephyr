/*
 * Copyright (c) 2026 Espressif Systems (Shanghai) Co., Ltd.
 *
 * SPDX-License-Identifier: Apache-2.0
 */

/ {
	aliases {
		/* On ESP32-C61, only GPIO0~6 can be used
		 * as wake-up sources
		 */
		wakeup-pins = &wakeup_pins;
	};

	gpio_keys {
		compatible = "gpio-keys";

		wakeup_pins: wakeup_pins {
			gpios = <&gpio0 2 (GPIO_PULL_DOWN | GPIO_ACTIVE_HIGH | GPIO_INT_WAKEUP)>,
				<&gpio0 3 (GPIO_PULL_DOWN | GPIO_ACTIVE_HIGH | GPIO_INT_WAKEUP)>;
		};
	};
};
