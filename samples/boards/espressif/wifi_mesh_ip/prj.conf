## CMakeLists.txt
```
# SPDX-License-Identifier: Apache-2.0

cmake_minimum_required(VERSION 3.28.0)

find_package(Zephyr REQUIRED HINTS $ENV{ZEPHYR_BASE})
project(wifi_mesh_ip)

target_sources(app PRIVATE src/main.c src/mesh_bridge.c src/mesh_shell.c)
```

## Kconfig
```
# Copyright (c) 2026 Espressif Systems (Shanghai) Co., Ltd.
# SPDX-License-Identifier: Apache-2.0

mainmenu "Wi-Fi mesh IP sample"

source "Kconfig.zephyr"
```

## prj.conf
```kconfig
# Wi-Fi mesh with IP over mesh
CONFIG_WIFI=y
CONFIG_WIFI_NM=y
CONFIG_WIFI_ESP32=y
CONFIG_WIFI_ESP32_MESH=y

# Carry IP over the mesh: builds the Ethernet-over-mesh transport interface in
# the driver. The root NATs child traffic out its station uplink.
CONFIG_WIFI_ESP32_MESH_IP=y

# Router the elected root associates to for external access. The credentials
# default to placeholders and must be set to the router in use, at runtime
# through esp_wifi_mesh_set_config() (see esp_wifi_mesh.h), before calling
# esp_wifi_mesh_start().

CONFIG_NETWORKING=y
CONFIG_NET_L2_ETHERNET=y
CONFIG_NET_L2_WIFI_MGMT=y

# IP subsystems used by the bridge: DHCP client (station and child), DHCP
# server and NAT (root), and sockets for the reachability probe.
CONFIG_NET_IPV4=y
CONFIG_NET_UDP=y
CONFIG_NET_TCP=y
CONFIG_NET_SOCKETS=y
CONFIG_NET_DHCPV4=y
CONFIG_NET_DHCPV4_SERVER=y
CONFIG_NET_IPV4_NAT=y
CONFIG_NET_IPV4_ROUTE=y
CONFIG_NET_IPV4_FORWARDING=y

# Event loop used by the mesh stack to post MESH_EVENT notifications.
CONFIG_NET_MGMT=y
CONFIG_NET_MGMT_EVENT=y
CONFIG_NET_MGMT_EVENT_INFO=y

# The mesh transport cannot carry the ARP broadcast a child would use to
# resolve the root gateway. Instead the root periodically broadcasts a
# gratuitous ARP, which the mesh fans out to every child, so each child learns
# the gateway link address through the normal ARP receive path.
CONFIG_NET_ARP_GRATUITOUS=y
CONFIG_NET_ARP_GRATUITOUS_TRANSMISSION=y
CONFIG_NET_ARP_GRATUITOUS_INTERVAL=10

# The station and the mesh bridge are two interfaces, each needing an address.
CONFIG_NET_IF_MAX_IPV4_COUNT=2
CONFIG_NET_IF_MAX_IPV6_COUNT=2

# IP is brought up explicitly once the mesh link is established.
CONFIG_NET_CONFIG_AUTO_INIT=n

# The mesh event callback runs on the Wi-Fi event task, and on the root it
# brings up the IP stack (DHCP server, NAT, routes) from there. Raise the event
# task stack above its 2048-byte default to accommodate that work.
CONFIG_ESP32_WIFI_EVENT_TASK_STACK_SIZE=4096

# Single system heap shared by the Wi-Fi driver, the mesh stack and the IP
# stack. The same image is flashed to every board and any node may become
# root, so this is sized for the root, which carries the most: the Wi-Fi
# RX/TX pools for its direct children plus the DHCP server, NAT and routing
# state for the sub-network. A root serving several children was verified at
# 128 KB on hardware; a leaf child needs far less.
CONFIG_HEAP_MEM_POOL_SIZE=131072

# The root serves DHCP to the whole mesh sub-network, not just its direct
# children, so the address pool must cover the expected node count.
CONFIG_NET_DHCPV4_SERVER_ADDR_COUNT=16

# The root installs one masquerade rule per forwarded protocol (TCP, UDP,
# ICMP); size the table for exactly those.
CONFIG_NET_IPV4_IPTABLE_RULE_MAX_NUM=3

# The root NATs the whole mesh sub-network, so the connection-tracking table
# must hold the concurrent flows of all children, not just a handful. The
# default of 10 is too small for a 16-node pool; size it to match.
CONFIG_NET_IPV4_CONN_TRACK_MAX_NUM=32

CONFIG_LOG=y
CONFIG_MAIN_STACK_SIZE=4096

# Shell for interactive inspection: the net shell drives the IP-over-mesh
# check (ping the external network from a child, list the mesh interface and
# its DHCP address, show the route to the root), and the mesh commands report
# the node's mesh role and routing table.
CONFIG_SHELL=y
CONFIG_NET_SHELL=y

# The net shell "iptables" command is the NAT rule editor; this sample
# installs its NAT rules from code, so drop it and avoid pulling the extra
# option-parser dependency into the shell.
CONFIG_NET_SHELL_IP_TABLE_SUPPORTED=n
```

## boards/esp32_devkitc_procpu.conf
```kconfig
# The original ESP32 has a smaller DRAM budget than the newer SoCs, and the
# defaults in prj.conf are sized for a root node carrying several children. Trim
# the mesh fan-out and the Wi-Fi buffer pools so the heap still fits alongside
# the IP stack. A node built this way works as a leaf child; it does not have
# the buffers to host a wide sub-tree.
CONFIG_WIFI_ESP32_MESH_MAX_CONNECTIONS=1
CONFIG_ESP32_WIFI_STATIC_RX_BUFFER_NUM=4
CONFIG_ESP32_WIFI_DYNAMIC_RX_BUFFER_NUM=8
CONFIG_ESP32_WIFI_DYNAMIC_TX_BUFFER_NUM=8
CONFIG_WIFI_ESP32_MESH_XON_QSIZE=16
CONFIG_HEAP_MEM_POOL_SIZE=98304
```

## boards/esp32s2_devkitc.conf
```kconfig
# The ESP32-S2 has a smaller DRAM budget than the other supported SoCs, and the
# defaults in prj.conf are sized for a root node carrying several children. Trim
# the mesh fan-out and the Wi-Fi buffer pools so the heap still fits alongside
# the IP stack. A node built this way works as a leaf child; it does not have
# the buffers to host a wide sub-tree.
CONFIG_WIFI_ESP32_MESH_MAX_CONNECTIONS=1
CONFIG_ESP32_WIFI_STATIC_RX_BUFFER_NUM=4
CONFIG_ESP32_WIFI_DYNAMIC_RX_BUFFER_NUM=8
CONFIG_ESP32_WIFI_DYNAMIC_TX_BUFFER_NUM=8
CONFIG_WIFI_ESP32_MESH_XON_QSIZE=16
CONFIG_HEAP_MEM_POOL_SIZE=98304
```

## src/main.c
```c
/*
 * Copyright (c) 2026 Espressif Systems (Shanghai) Co., Ltd.
 *
 * SPDX-License-Identifier: Apache-2.0
 */

#include <zephyr/kernel.h>
#include <zephyr/logging/log.h>
#include <zephyr/net/net_if.h>
#include <zephyr/drivers/wifi/esp_wifi/esp_wifi_mesh.h>

#include "mesh_bridge.h"

LOG_MODULE_REGISTER(wifi_mesh_ip, LOG_LEVEL_INF);

/*
 * IP-over-mesh sample.
 *
 * Every node runs Wi-Fi in combined AP and station mode and self-organizes
 * into a mesh; only the root reaches the router. IP is carried over the mesh
 * so sockets run unmodified on every node: the root serves DHCP and NATs child
 * traffic out its station uplink, and a child reaches the external network
 * through the root. The Wi-Fi driver performs the mesh bring-up and provides
 * the Ethernet-over-mesh transport; this sample wires the IP layer on top.
 */

static void mesh_event(enum esp_wifi_mesh_event event, const struct esp_wifi_mesh_event_info *info)
{
	switch (event) {
	case ESP_WIFI_MESH_EVENT_STARTED:
		LOG_INF("mesh started, layer %d", info->layer);
		break;
	case ESP_WIFI_MESH_EVENT_STOPPED:
		LOG_INF("mesh stopped");
		break;
	case ESP_WIFI_MESH_EVENT_PARENT_CONNECTED:
		LOG_INF("parent connected, layer %d%s", info->layer,
			info->is_root ? " (root)" : "");
		if (info->is_root) {
			struct net_if *sta = net_if_get_first_wifi();

			if (sta != NULL) {
				mesh_bridge_setup_root(sta);
			}
		} else {
			mesh_bridge_setup_child();
		}
		break;
	case ESP_WIFI_MESH_EVENT_PARENT_DISCONNECTED:
		LOG_INF("parent disconnected, reason %d", info->reason);
		break;
	case ESP_WIFI_MESH_EVENT_NO_PARENT_FOUND:
		LOG_INF("no parent found, scanning");
		break;
	case ESP_WIFI_MESH_EVENT_FIND_NETWORK:
		LOG_INF("find network");
		break;
	case ESP_WIFI_MESH_EVENT_CHILD_CONNECTED:
		LOG_INF("child connected");
		break;
	case ESP_WIFI_MESH_EVENT_CHILD_DISCONNECTED:
		LOG_INF("child disconnected");
		break;
	case ESP_WIFI_MESH_EVENT_ROUTING_TABLE_CHANGE:
		LOG_INF("routing table size %d", info->routing_table_size);
		break;
	case ESP_WIFI_MESH_EVENT_LAYER_CHANGE:
		LOG_INF("layer changed to %d", info->layer);
		break;
	case ESP_WIFI_MESH_EVENT_TODS_REACHABLE:
		LOG_INF("root external network reachable");
		break;
	case ESP_WIFI_MESH_EVENT_TODS_UNREACHABLE:
		LOG_INF("root external network unreachable");
		break;
	default:
		break;
	}
}

int main(void)
{
	if (net_if_get_first_wifi() == NULL) {
		LOG_ERR("no Wi-Fi interface found");
		return -ENODEV;
	}

	esp_wifi_mesh_event_cb_register(mesh_event);

	/*
	 * Mesh credentials and tree limits are runtime-configurable; set them
	 * here before esp_wifi_mesh_start() rather than through Kconfig. These
	 * values match the driver's built-in defaults: replace them with your
	 * router's credentials and a mesh ID unique to your network.
	 */
	struct esp_wifi_mesh_config mesh_cfg = {
		.ssid = "myssid",
		.password = "mypassword",
		.mesh_password = "meshpassword",
		.channel = 0,
		.mesh_id = {0x12, 0x34, 0x56, 0x78, 0x9a, 0xbc},
		.authmode = WIFI_SECURITY_TYPE_PSK,
		.num_layers = CONFIG_WIFI_ESP32_MESH_MAX_LAYER,
		.max_connections = CONFIG_WIFI_ESP32_MESH_MAX_CONNECTIONS,
	};

	if (esp_wifi_mesh_set_config(&mesh_cfg) != 0) {
		LOG_ERR("invalid mesh configuration");
		return -EINVAL;
	}

	if (esp_wifi_mesh_start() != 0) {
		LOG_ERR("Wi-Fi mesh start failed");
		return -EIO;
	}

	LOG_INF("Wi-Fi mesh starting (router SSID \"%s\")", mesh_cfg.ssid);
	return 0;
}
```

## src/mesh_bridge.c
```c
/*
 * Copyright (c) 2026 Espressif Systems (Shanghai) Co., Ltd.
 *
 * SPDX-License-Identifier: Apache-2.0
 *
 * IP-over-mesh policy for the sample: address the mesh interface, drive DHCP,
 * NAT and routing on the root, and request an address on a child. The
 * Ethernet-over-mesh transport itself is provided by the Wi-Fi driver
 * (esp_wifi_mesh_netif_get()); this file only wires the IP layer on top.
 */

#include <zephyr/kernel.h>
#include <zephyr/logging/log.h>
#include <zephyr/net/net_if.h>
#include <zephyr/net/ethernet.h>
#include <zephyr/net/dhcpv4.h>
#include <zephyr/net/dhcpv4_server.h>
#include <zephyr/net/ipv4_nat.h>
#include <zephyr/net/net_mgmt.h>
#include <zephyr/net/net_event.h>
#include <zephyr/drivers/wifi/esp_wifi/esp_wifi_mesh.h>

#include "mesh_bridge.h"

LOG_MODULE_DECLARE(wifi_mesh_ip, LOG_LEVEL_INF);

static struct net_mgmt_event_callback mesh_dhcp_cb;
static struct net_mgmt_event_callback mesh_uplink_cb;

/* Root serves this private subnet to the mesh; .1 is the root itself. */
#define MESH_SUBNET_A 192
#define MESH_SUBNET_B 168
#define MESH_SUBNET_C 4

/*
 * When the root station gets its uplink lease, register the router as the
 * default router and announce toDS reachability so the mesh starts admitting
 * child traffic bound for the external network; before the uplink is up there
 * is nowhere to forward it.
 */
static void mesh_uplink_bound(struct net_mgmt_event_callback *cb, uint64_t mgmt_event,
			      struct net_if *iface)
{
	ARG_UNUSED(cb);

	if (mgmt_event == NET_EVENT_IPV4_DHCP_BOUND) {
		struct net_in_addr gw = net_if_ipv4_get_gw(iface);

		net_if_ipv4_router_add(iface, &gw, true, 0);
		esp_wifi_mesh_set_tods_reachable(true);
	}
}

static void mesh_dhcp_bound(struct net_mgmt_event_callback *cb, uint64_t mgmt_event,
			    struct net_if *iface)
{
	static atomic_t bound_once;

	ARG_UNUSED(cb);

	if (mgmt_event != NET_EVENT_IPV4_DHCP_BOUND) {
		return;
	}

	/*
	 * DHCP raises BOUND on the initial lease and again on every renewal;
	 * only report the first one. The lease's router option already points
	 * off-subnet traffic at the root.
	 */
	if (atomic_set(&bound_once, 1) != 0) {
		return;
	}

	char buf[NET_IPV4_ADDR_LEN];
	struct net_if_addr *ifaddr = &net_if_get_config(iface)->ip.ipv4->unicast[0].ipv4;

	LOG_INF("child got IP %s over mesh",
		net_addr_ntop(AF_INET, &ifaddr->address.in_addr, buf, sizeof(buf)));
}

/*
 * Root: own the mesh subnet gateway address, serve DHCP to the children, and
 * masquerade their traffic out the station interface toward the router. The
 * Zephyr network stack does the DHCP, NAT and forwarding; only the addresses
 * and the rule are set here.
 */
#if defined(CONFIG_NET_DHCPV4_SERVER) && defined(CONFIG_NET_IPV4_NAT)
void mesh_bridge_setup_root(struct net_if *sta_iface)
{
	struct net_if *mesh_iface = esp_wifi_mesh_netif_get();
	struct net_in_addr gw = {{{MESH_SUBNET_A, MESH_SUBNET_B, MESH_SUBNET_C, 1}}};
	struct net_in_addr netmask = {{{255, 255, 255, 0}}};
	struct net_in_addr pool_start = {{{MESH_SUBNET_A, MESH_SUBNET_B, MESH_SUBNET_C, 2}}};

	/*
	 * The mesh stack drives the station to the router, bypassing the normal
	 * connect path that would bring the station interface up. Force it up so
	 * the network stack can obtain the uplink address and route.
	 */
	esp_wifi_mesh_bind_sta_rx();
	net_mgmt_init_event_callback(&mesh_uplink_cb, mesh_uplink_bound, NET_EVENT_IPV4_DHCP_BOUND);
	net_mgmt_add_event_callback(&mesh_uplink_cb);

	net_if_carrier_on(sta_iface);
	net_if_dormant_off(sta_iface);
	net_dhcpv4_start(sta_iface);

	net_if_ipv4_addr_add(mesh_iface, &gw, NET_ADDR_MANUAL, 0);
	net_if_ipv4_set_netmask_by_addr(mesh_iface, &gw, &netmask);
	/* The DHCP server hands out the interface gateway as the router option. */
	net_if_ipv4_set_gw(mesh_iface, &gw);

	/*
	 * Add an explicit connected route for the mesh subnet over the mesh
	 * interface. When IPv4 forwarding is enabled the forwarding lookup does
	 * not resolve on-link subnets on its own, so a reply masqueraded back to
	 * a child would otherwise follow the default route out the station. The
	 * route carries no next hop, which makes the stack resolve the child
	 * address directly on the mesh interface.
	 */
	struct net_in_addr subnet = {{{MESH_SUBNET_A, MESH_SUBNET_B, MESH_SUBNET_C, 0}}};

	if (net_if_ipv4_route_add(mesh_iface, &subnet, 24, NULL, UINT32_MAX) < 0) {
		LOG_ERR("mesh subnet route add failed");
	}

	if (net_dhcpv4_server_start(mesh_iface, &pool_start) < 0) {
		LOG_ERR("mesh DHCP server start failed");
	}

	/* NAT is per protocol, so masquerade TCP, UDP and ICMP. */
	static const enum net_ip_protocol protos[] = {
		NET_IPPROTO_TCP,
		NET_IPPROTO_UDP,
		NET_IPPROTO_ICMP,
	};

	for (size_t i = 0; i < ARRAY_SIZE(protos); i++) {
		struct net_iptable_rule_params rule = {0};

		rule.input_iface_idx = net_if_get_by_iface(mesh_iface);
		rule.output_iface_idx = net_if_get_by_iface(sta_iface);
		memcpy(rule.src, (uint8_t[]){MESH_SUBNET_A, MESH_SUBNET_B, MESH_SUBNET_C, 0}, 4);
		memcpy(rule.src_mask, (uint8_t[]){255, 255, 255, 0}, 4);
		rule.proto = protos[i];
		rule.priority = 5;

		if (net_ipv4_table_rule_add(&rule) < 0) {
			LOG_ERR("mesh NAT rule add failed (proto %d)", protos[i]);
		}
	}

	LOG_INF("mesh root IP: gateway %d.%d.%d.1, DHCP + NAT up", MESH_SUBNET_A, MESH_SUBNET_B,
		MESH_SUBNET_C);
}
#else
/*
 * Child-only build: the DHCP server and NAT the root relay needs are disabled,
 * so a node built this way cannot serve the mesh subnet. Useful on a SoC whose
 * RAM does not fit the root configuration.
 */
void mesh_bridge_setup_root(struct net_if *sta_iface)
{
	ARG_UNUSED(sta_iface);

	LOG_ERR("elected root, but this image is built without the DHCP server "
		"and NAT the root needs (CONFIG_NET_DHCPV4_SERVER, "
		"CONFIG_NET_IPV4_NAT); the mesh subnet has no gateway");
}
#endif /* CONFIG_NET_DHCPV4_SERVER && CONFIG_NET_IPV4_NAT */

/* Child: get an address from the root's DHCP server over the mesh. */
void mesh_bridge_setup_child(void)
{
	net_mgmt_init_event_callback(&mesh_dhcp_cb, mesh_dhcp_bound, NET_EVENT_IPV4_DHCP_BOUND);
	net_mgmt_add_event_callback(&mesh_dhcp_cb);

	net_dhcpv4_start(esp_wifi_mesh_netif_get());
	LOG_INF("mesh child IP: requesting address over mesh");
}
```

## src/mesh_bridge.h
```c
/*
 * Copyright (c) 2026 Espressif Systems (Shanghai) Co., Ltd.
 *
 * SPDX-License-Identifier: Apache-2.0
 */

#ifndef MESH_BRIDGE_H
#define MESH_BRIDGE_H

#include <zephyr/net/net_if.h>

/**
 * @brief Bring up the root-side IP bridge.
 *
 * Runs on the node elected root. Starts the DHCP server that leases addresses
 * to the mesh sub-network over the mesh interface, and installs the NAT rules
 * that masquerade child traffic out the station uplink so the whole mesh
 * reaches the external network through the root.
 *
 * @param sta_iface Station interface providing the external uplink.
 */
void mesh_bridge_setup_root(struct net_if *sta_iface);

/**
 * @brief Bring up the child-side IP bridge.
 *
 * Runs on a non-root node. Starts a DHCP client on the mesh interface to
 * obtain an address from the root's DHCP server over the mesh transport,
 * giving the node IP connectivity through the root.
 */
void mesh_bridge_setup_child(void);

#endif /* MESH_BRIDGE_H */
```

## src/mesh_shell.c
```c
/*
 * Copyright (c) 2026 Espressif Systems (Shanghai) Co., Ltd.
 *
 * SPDX-License-Identifier: Apache-2.0
 *
 * Interactive "mesh" shell for the IP-over-mesh sample: report the node's
 * mesh role and dump the routing table. The IP-level checks (ping, interface
 * and route inspection) use the built-in net shell.
 */

#include <zephyr/kernel.h>
#include <zephyr/shell/shell.h>
#include <zephyr/drivers/wifi/esp_wifi/esp_wifi_mesh.h>

/* Bounded by the mesh tree size (max layers * children per node). */
#define MESH_TABLE_MAX                                                                             \
	(CONFIG_WIFI_ESP32_MESH_MAX_LAYER * CONFIG_WIFI_ESP32_MESH_MAX_CONNECTIONS + 1)

static int cmd_mesh_status(const struct shell *sh, size_t argc, char *argv[])
{
	ARG_UNUSED(argc);
	ARG_UNUSED(argv);

	struct esp_wifi_mesh_status status;

	esp_wifi_mesh_get_status(&status);

	shell_print(sh, "layer:         %d", status.layer);
	shell_print(sh, "role:          %s", status.is_root ? "root" : "node");
	shell_print(sh, "routing table: %d node(s)", status.routing_table_size);
	shell_print(sh, "toDS:          %s", status.tods_reachable ? "reachable" : "unreachable");

	return 0;
}

static int cmd_mesh_table(const struct shell *sh, size_t argc, char *argv[])
{
	ARG_UNUSED(argc);
	ARG_UNUSED(argv);

	static struct esp_wifi_mesh_addr macs[MESH_TABLE_MAX];
	size_t count = 0;

	if (esp_wifi_mesh_get_routing_table(macs, MESH_TABLE_MAX, &count) != 0) {
		shell_error(sh, "cannot read routing table");
		return -EIO;
	}

	shell_print(sh, "routing table: %d node(s)", (int)count);
	for (size_t i = 0; i < count; i++) {
		shell_print(sh, "%2d: %02x:%02x:%02x:%02x:%02x:%02x", (int)i, macs[i].addr[0],
			    macs[i].addr[1], macs[i].addr[2], macs[i].addr[3], macs[i].addr[4],
			    macs[i].addr[5]);
	}

	return 0;
}

SHELL_STATIC_SUBCMD_SET_CREATE(sub_mesh,
			       SHELL_CMD_ARG(status, NULL, "Show this node's mesh status",
					     cmd_mesh_status, 1, 0),
			       SHELL_CMD_ARG(table, NULL, "Dump the mesh routing table",
					     cmd_mesh_table, 1, 0),
			       SHELL_SUBCMD_SET_END);

SHELL_CMD_REGISTER(mesh, &sub_mesh, "Wi-Fi mesh commands", NULL);
```
