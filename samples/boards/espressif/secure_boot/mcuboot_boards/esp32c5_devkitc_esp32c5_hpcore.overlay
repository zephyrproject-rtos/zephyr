/*
 * Copyright (c) 2026 Espressif Systems (Shanghai) Co., Ltd.
 *
 * SPDX-License-Identifier: Apache-2.0
 */

#include "../boards/boot_0x2000_84k.dtsi"

/ {
	chosen {
		zephyr,code-partition = &boot_partition;
	};
};
