/*
 * Copyright (c) 2026 Espressif Systems (Shanghai) Co., Ltd.
 *
 * SPDX-License-Identifier: Apache-2.0
 */

#include "boot_0x0_68k.dtsi"

/ {
	chosen {
		zephyr,code-partition = &slot0_partition;
	};
};
