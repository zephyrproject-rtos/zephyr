## CMakeLists.txt
```
# SPDX-License-Identifier: Apache-2.0

cmake_minimum_required(VERSION 3.20.0)
find_package(Zephyr REQUIRED HINTS $ENV{ZEPHYR_BASE})
project(wifi_ble_lvgl)

target_sources(app PRIVATE 
    src/main.c
    src/wifi_manager.c
    src/ble_gatt.c
    src/nvs_storage.c
    src/ui_manager.c
)
```

## prj.conf
```kconfig
# WiFi BLE Provisioning with LVGL UI Configuration

# Console and logging
CONFIG_CONSOLE=y
CONFIG_UART_CONSOLE=y
CONFIG_SERIAL=y
CONFIG_LOG=y
CONFIG_LOG_DEFAULT_LEVEL=3

# Optimize logging to reduce message drops
CONFIG_LOG_BUFFER_SIZE=4096
CONFIG_LOG_PROCESS_THREAD_STACK_SIZE=2048
CONFIG_UART_INTERRUPT_DRIVEN=y

# WiFi Configuration
CONFIG_WIFI=y
CONFIG_WIFI_ESP32=y
CONFIG_NET_L2_WIFI_MGMT=y
CONFIG_WIFI_LOG_LEVEL_INF=y

# Networking
CONFIG_NETWORKING=y
CONFIG_NET_IPV4=y
CONFIG_NET_IPV6=n
CONFIG_NET_DHCPV4=y
CONFIG_NET_CONFIG_SETTINGS=y
CONFIG_NET_CONFIG_INIT_TIMEOUT=0

# BLE Configuration
CONFIG_BT=y
CONFIG_BT_PERIPHERAL=y
CONFIG_BT_DEVICE_NAME="ESP32_S3_BOX3_BLE"
CONFIG_BT_DEVICE_APPEARANCE=833
CONFIG_BT_SMP=n
CONFIG_BT_BONDABLE=n
CONFIG_BT_CONN_PARAM_UPDATE_TIMEOUT=5000

# GATT Configuration
CONFIG_BT_GATT_SERVICE_CHANGED=y
CONFIG_BT_GATT_CACHING=y
CONFIG_BT_GATT_ENFORCE_SUBSCRIPTION=n
CONFIG_BT_ATT_PREPARE_COUNT=2
CONFIG_BT_L2CAP_TX_BUF_COUNT=8
CONFIG_BT_L2CAP_TX_MTU=247
CONFIG_BT_BUF_ACL_RX_SIZE=251
CONFIG_BT_BUF_ACL_TX_SIZE=251

# NVS (Non-Volatile Storage) Configuration
CONFIG_NVS=y
CONFIG_FLASH=y
CONFIG_FLASH_MAP=y
CONFIG_FLASH_PAGE_LAYOUT=y

# JSON support for BLE data parsing
CONFIG_JSON_LIBRARY=y

# LVGL Configuration - Optimized for memory
CONFIG_DISPLAY=y
CONFIG_LVGL=y
CONFIG_LV_Z_AUTO_INIT=n
CONFIG_LV_Z_MEM_POOL_SIZE=16384
CONFIG_LV_Z_VDB_SIZE=32
CONFIG_LV_DPI_DEF=130
CONFIG_LV_Z_BITS_PER_PIXEL=16
CONFIG_LV_COLOR_DEPTH_16=y
CONFIG_LV_COLOR_16_SWAP=y

# Touch input support
CONFIG_INPUT=y
CONFIG_INPUT_GT911=y
CONFIG_INPUT_GT911_INTERRUPT=y

# LVGL Fonts - Only essential fonts
CONFIG_LV_FONT_MONTSERRAT_14=y
CONFIG_LV_FONT_MONTSERRAT_16=y

# Memory configuration - Optimized for ESP32-S3
CONFIG_HEAP_MEM_POOL_SIZE=71680
CONFIG_MAIN_STACK_SIZE=4096
CONFIG_SYSTEM_WORKQUEUE_STACK_SIZE=2048
CONFIG_BT_RX_STACK_SIZE=1536
CONFIG_NET_TX_STACK_SIZE=1536
CONFIG_NET_RX_STACK_SIZE=1536

# GPIO for buttons and status
CONFIG_GPIO=y

# Enable reboot functionality
CONFIG_REBOOT=y
```

## src/main.c
```c
/*
 * Copyright (c) 2026 NotioNext Ltd.
 *
 * SPDX-License-Identifier: Apache-2.0
 */

#include <zephyr/kernel.h>
#include <zephyr/logging/log.h>
#include <zephyr/device.h>
#include <zephyr/drivers/gpio.h>
#include <zephyr/sys/reboot.h>

#include "nvs_storage.h"
#include "wifi_manager.h"
#include "ble_gatt.h"
#include "ui_manager.h"

LOG_MODULE_REGISTER(main, LOG_LEVEL_INF);

/* Button configuration for factory reset */
#define SW0_NODE DT_ALIAS(sw0)
#if DT_NODE_EXISTS(SW0_NODE)
static const struct gpio_dt_spec button = GPIO_DT_SPEC_GET(SW0_NODE, gpios);
static struct gpio_callback button_cb_data;
#define BUTTON_AVAILABLE 1
#else
#define BUTTON_AVAILABLE 0
#endif

static bool factory_reset_requested = false;

#ifdef BUTTON_AVAILABLE
#if BUTTON_AVAILABLE
static void button_pressed(const struct device *dev, struct gpio_callback *cb, uint32_t pins)
{
    static int64_t last_press_time = 0;
    static int press_count = 0;
    int64_t current_time = k_uptime_get();

    /* Reset counter if more than 5 seconds since last press */
    if (current_time - last_press_time > 5000) {
        press_count = 0;
    }

    press_count++;
    last_press_time = current_time;

    LOG_INF("Button pressed %d times", press_count);

    /* Factory reset on 5 consecutive presses within 5 seconds */
    if (press_count >= 5) {
        LOG_WRN("Factory reset requested!");
        factory_reset_requested = true;
        press_count = 0;
    }
}

static int init_button(void)
{
    int ret;

    if (!gpio_is_ready_dt(&button)) {
        LOG_ERR("Button device not ready");
        return -ENODEV;
    }

    ret = gpio_pin_configure_dt(&button, GPIO_INPUT);
    if (ret < 0) {
        LOG_ERR("Failed to configure button pin: %d", ret);
        return ret;
    }

    ret = gpio_pin_interrupt_configure_dt(&button, GPIO_INT_EDGE_TO_ACTIVE);
    if (ret < 0) {
        LOG_ERR("Failed to configure button interrupt: %d", ret);
        return ret;
    }

    gpio_init_callback(&button_cb_data, button_pressed, BIT(button.pin));
    gpio_add_callback(button.port, &button_cb_data);

    LOG_INF("Button initialized - press 5 times quickly for factory reset");
    return 0;
}
#endif
#endif

static void factory_reset(void)
{
    LOG_WRN("Performing factory reset...");

    /* Clear WiFi credentials */
    int ret = nvs_clear_wifi_credentials();
    if (ret < 0) {
        LOG_ERR("Failed to clear WiFi credentials: %d", ret);
    } else {
        LOG_INF("WiFi credentials cleared");
    }

    /* Disconnect from WiFi if connected */
    if (wifi_is_connected()) {
        wifi_disconnect();
    }

    LOG_INF("Factory reset complete, rebooting...");
    k_sleep(K_SECONDS(2));
    sys_reboot(SYS_REBOOT_COLD);
}

static void status_thread(void)
{
    char ip_str[16];
    bool last_wifi_status = false;

    while (1) {
        if (factory_reset_requested) {
            factory_reset();
        }

        /* Check for WiFi status changes and update UI safely */
        bool current_wifi_status = wifi_is_connected();
        if (current_wifi_status != last_wifi_status) {
            LOG_INF("WiFi status changed: %s", current_wifi_status ? "Connected" : "Disconnected");
            /* Don't call ui_set_wifi_status here as it's handled by WiFi manager callbacks */
            last_wifi_status = current_wifi_status;
        }

        /* Update IP address if connected */
        if (current_wifi_status && wifi_get_ip_address(ip_str, sizeof(ip_str)) == 0) {
            /* IP address update is handled by WiFi manager callbacks */
        }

        k_sleep(K_SECONDS(5)); /* Check less frequently to reduce conflicts */
    }
}

K_THREAD_DEFINE(status_tid, 1536, status_thread, NULL, NULL, NULL, 7, 0, 0);

int main(void)
{
    int ret;

    LOG_INF("WiFi BLE Provisioning with LVGL UI Example");
    LOG_INF("Board: %s", CONFIG_BOARD);

#if BUTTON_AVAILABLE
    /* Initialize button */
    ret = init_button();
    if (ret < 0) {
        LOG_ERR("Failed to initialize button: %d", ret);
    }
#endif

    /* Initialize UI manager first */
    ret = ui_manager_init();
    if (ret < 0) {
        LOG_ERR("Failed to initialize UI manager: %d", ret);
        return ret;
    }

    /* Initialize NVS storage */
    ret = nvs_storage_init();
    if (ret < 0) {
        LOG_ERR("Failed to initialize NVS storage: %d", ret);
        return ret;
    }

    /* Initialize WiFi manager */
    ret = wifi_manager_init();
    if (ret < 0) {
        LOG_ERR("Failed to initialize WiFi manager: %d", ret);
        return ret;
    }

    /* Check for stored WiFi credentials and try to connect */
    if (nvs_has_wifi_credentials()) {
        LOG_INF("Found stored WiFi credentials, attempting to connect...");
        ret = wifi_connect_stored();
        if (ret == 0) {
            LOG_INF("Successfully connected using stored credentials");
            ui_set_wifi_status(true);
        } else {
            LOG_WRN("Failed to connect using stored credentials, starting BLE provisioning");
            ui_set_wifi_status(false);
        }
    } else {
        LOG_INF("No stored WiFi credentials found, starting BLE provisioning");
        ui_set_wifi_status(false);
    }

    /* Initialize and start BLE GATT service */
    ret = ble_gatt_init();
    if (ret < 0) {
        LOG_ERR("Failed to initialize BLE GATT: %d", ret);
        return ret;
    }

    ret = ble_start_advertising();
    if (ret < 0) {
        LOG_ERR("Failed to start BLE advertising: %d", ret);
        return ret;
    }

    LOG_INF("System initialized successfully");
    LOG_INF("Device is ready for WiFi provisioning via BLE");
    LOG_INF("Use the LVGL UI to navigate through the provisioning process");
    LOG_INF("Connect with a BLE client and send WiFi credentials in JSON format:");
    LOG_INF("{\"ssid\":\"YourWiFiSSID\",\"password\":\"YourWiFiPassword\",\"save_credentials\":true}");

    /* Main loop */
    while (1) {
        /* Print status every 30 seconds */
        if (wifi_is_connected()) {
            LOG_INF("WiFi Status: Connected");
            wifi_get_status();
        } else {
            LOG_INF("WiFi Status: Disconnected - BLE provisioning active");
        }

        k_sleep(K_SECONDS(30));
    }

    return 0;
}
```

## src/ble_gatt.c
```c
/*
 * Copyright (c) 2026 NotioNext Ltd.
 *
 * SPDX-License-Identifier: Apache-2.0
 */

#include "ble_gatt.h"
#include "wifi_manager.h"
#include "nvs_storage.h"
#include "ui_manager.h"
#include <zephyr/logging/log.h>
#include <zephyr/bluetooth/bluetooth.h>
#include <zephyr/bluetooth/hci.h>
#include <zephyr/bluetooth/conn.h>
#include <zephyr/bluetooth/uuid.h>
#include <zephyr/bluetooth/gatt.h>
#include <zephyr/data/json.h>
#include <zephyr/kernel.h>
#include <string.h>

LOG_MODULE_REGISTER(ble_gatt, LOG_LEVEL_INF);

/* External reference to UI initialization status */
extern bool ui_initialized;

/* Work queue for WiFi operations */
static struct k_work_q wifi_work_q;
static K_THREAD_STACK_DEFINE(wifi_work_stack, 3072);

/* Work item for WiFi connection */
static struct k_work wifi_connect_work;
static char pending_ssid[64];
static char pending_password[64];
static bool pending_save_credentials;

/* WiFi Provisioning Service UUID: 12345678-1234-1234-1234-123456789abc */
#define BT_UUID_WIFI_PROV_SERVICE BT_UUID_DECLARE_128( \
    BT_UUID_128_ENCODE(0x12345678, 0x1234, 0x1234, 0x1234, 0x123456789abc))

/* WiFi Credentials Characteristic UUID: 12345678-1234-1234-1234-123456789abd */
#define BT_UUID_WIFI_CREDS_CHAR BT_UUID_DECLARE_128( \
    BT_UUID_128_ENCODE(0x12345678, 0x1234, 0x1234, 0x1234, 0x123456789abd))

/* WiFi Status Characteristic UUID: 12345678-1234-1234-1234-123456789abe */
#define BT_UUID_WIFI_STATUS_CHAR BT_UUID_DECLARE_128( \
    BT_UUID_128_ENCODE(0x12345678, 0x1234, 0x1234, 0x1234, 0x123456789abe))

static struct bt_conn *current_conn;
static bool notify_enabled = false;

/* JSON parsing structures */
struct wifi_credentials {
    const char *ssid;
    const char *password;
    bool save_credentials;
};

static void wifi_connect_work_handler(struct k_work *work)
{
    int ret;

    LOG_INF("WiFi work handler: Starting connection process");

    /* Validate input parameters */
    if (strlen(pending_ssid) == 0) {
        LOG_ERR("Invalid SSID");
        ui_send_event(UI_EVENT_WIFI_FAILED, NULL);
        return;
    }

    if (strlen(pending_password) == 0) {
        LOG_ERR("Invalid password");
        ui_send_event(UI_EVENT_WIFI_FAILED, NULL);
        return;
    }

    LOG_INF("WiFi work handler: Attempting connection to SSID: %s", pending_ssid);

    /* Send connecting event to UI */
    ui_send_event(UI_EVENT_WIFI_CONNECTING, NULL);

    /* Try to connect to WiFi - this is now non-blocking */
    ret = wifi_connect(pending_ssid, pending_password);
    if (ret != 0) {
        LOG_ERR("WiFi connection request failed with error: %d", ret);
        ui_send_event(UI_EVENT_WIFI_FAILED, NULL);

        /* Send failure notification */
        const char *response = "{\"status\":\"failed\",\"message\":\"WiFi connection request failed\"}";
        ret = ble_send_notification(response, strlen(response));
        if (ret < 0) {
            LOG_WRN("Failed to send failure notification: %d", ret);
        }
        return;
    }

    LOG_INF("WiFi connection request submitted successfully");

    /* Save credentials if requested - do this immediately since connection is async */
    if (pending_save_credentials) {
        ret = nvs_save_wifi_credentials(pending_ssid, pending_password);
        if (ret < 0) {
            LOG_ERR("Failed to save credentials to NVS: %d", ret);
        } else {
            LOG_INF("Credentials saved to NVS successfully");
        }
    }

    LOG_INF("WiFi work handler: Completed - waiting for connection result");
}

static const struct json_obj_descr wifi_creds_descr[] = {
    JSON_OBJ_DESCR_PRIM(struct wifi_credentials, ssid, JSON_TOK_STRING),
    JSON_OBJ_DESCR_PRIM(struct wifi_credentials, password, JSON_TOK_STRING),
    JSON_OBJ_DESCR_PRIM(struct wifi_credentials, save_credentials, JSON_TOK_TRUE),
};

static ssize_t write_wifi_creds(struct bt_conn *conn,
                               const struct bt_gatt_attr *attr,
                               const void *buf, uint16_t len, uint16_t offset,
                               uint8_t flags)
{
    char json_buf[256];
    struct wifi_credentials creds = {0};
    int ret;

    LOG_INF("=== BLE Write Handler Called ===");
    LOG_INF("Length: %d, Offset: %d, Flags: 0x%02x", len, offset, flags);

    if (offset != 0) {
        LOG_ERR("Write with offset not supported (offset=%d)", offset);
        return BT_GATT_ERR(BT_ATT_ERR_INVALID_OFFSET);
    }

    if (len == 0) {
        LOG_ERR("Empty write request");
        return BT_GATT_ERR(BT_ATT_ERR_INVALID_ATTRIBUTE_LEN);
    }

    if (len >= sizeof(json_buf)) {
        LOG_ERR("Data too large: %d >= %d", len, (int)sizeof(json_buf));
        return BT_GATT_ERR(BT_ATT_ERR_INVALID_ATTRIBUTE_LEN);
    }

    /* Copy and null-terminate the data */
    memcpy(json_buf, buf, len);
    json_buf[len] = '\0';

    LOG_INF("Received data (%d bytes): '%s'", len, json_buf);

    /* Send BLE receiving event to UI immediately when we get data */
    ui_send_event(UI_EVENT_BLE_RECEIVING, NULL);
    LOG_INF("BLE receiving event sent to UI");

    /* Parse JSON */
    ret = json_obj_parse(json_buf, len, wifi_creds_descr,
                        ARRAY_SIZE(wifi_creds_descr), &creds);
    if (ret < 0) {
        LOG_ERR("JSON parsing failed: %d", ret);
        LOG_ERR("Raw data: %s", json_buf);
        return BT_GATT_ERR(BT_ATT_ERR_INVALID_ATTRIBUTE_LEN);
    }

    if (!creds.ssid || strlen(creds.ssid) == 0) {
        LOG_ERR("Missing or empty SSID");
        return BT_GATT_ERR(BT_ATT_ERR_INVALID_ATTRIBUTE_LEN);
    }

    if (!creds.password || strlen(creds.password) == 0) {
        LOG_ERR("Missing or empty password");
        return BT_GATT_ERR(BT_ATT_ERR_INVALID_ATTRIBUTE_LEN);
    }

    LOG_INF("Parsed credentials successfully:");
    LOG_INF("  SSID: '%s' (len=%d)", creds.ssid, (int)strlen(creds.ssid));
    LOG_INF("  Password: '%s' (len=%d)", creds.password, (int)strlen(creds.password));
    LOG_INF("  Save: %s", creds.save_credentials ? "true" : "false");

    /* Store credentials for work queue processing */
    memset(pending_ssid, 0, sizeof(pending_ssid));
    memset(pending_password, 0, sizeof(pending_password));

    strncpy(pending_ssid, creds.ssid, sizeof(pending_ssid) - 1);
    pending_ssid[sizeof(pending_ssid) - 1] = '\0';

    strncpy(pending_password, creds.password, sizeof(pending_password) - 1);
    pending_password[sizeof(pending_password) - 1] = '\0';

    pending_save_credentials = creds.save_credentials;

    LOG_INF("Stored credentials - SSID: %s, Password length: %d",
            pending_ssid, (int)strlen(pending_password));

    /* Submit work to dedicated work queue - no UI calls from here */
    LOG_INF("Submitting WiFi connection work to work queue");
    k_work_submit_to_queue(&wifi_work_q, &wifi_connect_work);

    LOG_INF("=== Write Handler Complete ===");
    return len;
}

static ssize_t read_wifi_status(struct bt_conn *conn,
                               const struct bt_gatt_attr *attr,
                               void *buf, uint16_t len, uint16_t offset)
{
    char status_buf[128];
    const char *status_msg;

    LOG_INF("GATT Read operation on status characteristic");

    if (wifi_is_connected()) {
        status_msg = "{\"status\":\"connected\",\"message\":\"WiFi is connected\"}";
    } else {
        status_msg = "{\"status\":\"disconnected\",\"message\":\"WiFi is not connected\"}";
    }

    strcpy(status_buf, status_msg);

    return bt_gatt_attr_read(conn, attr, buf, len, offset, status_buf, strlen(status_buf));
}

static void wifi_status_ccc_cfg_changed(const struct bt_gatt_attr *attr, uint16_t value)
{
    notify_enabled = (value == BT_GATT_CCC_NOTIFY);
    LOG_INF("WiFi status notifications %s", notify_enabled ? "enabled" : "disabled");
}

/* WiFi Provisioning Service Definition */
BT_GATT_SERVICE_DEFINE(wifi_prov_svc,
    BT_GATT_PRIMARY_SERVICE(BT_UUID_WIFI_PROV_SERVICE),

    /* WiFi Credentials Characteristic - Support both write types */
    BT_GATT_CHARACTERISTIC(BT_UUID_WIFI_CREDS_CHAR,
                          BT_GATT_CHRC_WRITE | BT_GATT_CHRC_WRITE_WITHOUT_RESP,
                          BT_GATT_PERM_WRITE,
                          NULL, write_wifi_creds, NULL),

    /* WiFi Status Characteristic */
    BT_GATT_CHARACTERISTIC(BT_UUID_WIFI_STATUS_CHAR,
                          BT_GATT_CHRC_READ | BT_GATT_CHRC_NOTIFY,
                          BT_GATT_PERM_READ,
                          read_wifi_status, NULL, NULL),
    BT_GATT_CCC(wifi_status_ccc_cfg_changed,
                BT_GATT_PERM_READ | BT_GATT_PERM_WRITE),
);

static const struct bt_data ad[] = {
    BT_DATA_BYTES(BT_DATA_FLAGS, (BT_LE_AD_GENERAL | BT_LE_AD_NO_BREDR)),
    BT_DATA(BT_DATA_NAME_COMPLETE, "ESP32_S3_BOX3_BLE", 24),
};

static const struct bt_data sd[] = {
    BT_DATA_BYTES(BT_DATA_UUID128_ALL,
                  BT_UUID_128_ENCODE(0x12345678, 0x1234, 0x1234, 0x1234, 0x123456789abc)),
};

static void connected(struct bt_conn *conn, uint8_t err)
{
    char addr[BT_ADDR_LE_STR_LEN];

    bt_addr_le_to_str(bt_conn_get_dst(conn), addr, sizeof(addr));

    if (err) {
        LOG_ERR("Failed to connect to %s (%u)", addr, err);
        return;
    }

    LOG_INF("Connected %s", addr);
    current_conn = bt_conn_ref(conn);

    /* Log connection parameters */
    struct bt_conn_info info;
    if (bt_conn_get_info(conn, &info) == 0) {
        LOG_INF("Connection info - Type: %d, Role: %d", info.type, info.role);
        if (info.type == BT_CONN_TYPE_LE) {
            LOG_INF("LE connection - Latency: %d, Timeout: %d",
                    info.le.latency, info.le.timeout);
        }
    }

    /* Try to get MTU information */
    LOG_INF("Current GATT MTU: %d bytes", bt_gatt_get_mtu(conn));

    LOG_INF("BLE connected - ready to receive credentials");
}

static void disconnected(struct bt_conn *conn, uint8_t reason)
{
    char addr[BT_ADDR_LE_STR_LEN];

    bt_addr_le_to_str(bt_conn_get_dst(conn), addr, sizeof(addr));

    LOG_INF("Disconnected from %s (reason 0x%02x)", addr, reason);

    if (current_conn) {
        bt_conn_unref(current_conn);
        current_conn = NULL;
    }
    notify_enabled = false;
}

BT_CONN_CB_DEFINE(conn_callbacks) = {
    .connected = connected,
    .disconnected = disconnected,
};

int ble_gatt_init(void)
{
    int err;

    /* Initialize work queue for WiFi operations */
    k_work_queue_init(&wifi_work_q);
    k_work_queue_start(&wifi_work_q, wifi_work_stack,
                       K_THREAD_STACK_SIZEOF(wifi_work_stack),
                       K_PRIO_COOP(3), NULL);

    LOG_INF("WiFi work queue initialized with stack size %d",
            (int)K_THREAD_STACK_SIZEOF(wifi_work_stack));

    /* Initialize work item */
    k_work_init(&wifi_connect_work, wifi_connect_work_handler);

    err = bt_enable(NULL);
    if (err) {
        LOG_ERR("Bluetooth init failed (err %d)", err);
        return err;
    }

    LOG_INF("Bluetooth initialized");
    LOG_INF("GATT service registered with UUIDs:");
    LOG_INF("  Service: 12345678-1234-1234-1234-123456789abc");
    LOG_INF("  Credentials: 12345678-1234-1234-1234-123456789abd");
    LOG_INF("  Status: 12345678-1234-1234-1234-123456789abe");
    return 0;
}

int ble_start_advertising(void)
{
    int err;

    err = bt_le_adv_start(BT_LE_ADV_CONN_FAST_1, ad, ARRAY_SIZE(ad), sd, ARRAY_SIZE(sd));
    if (err) {
        LOG_ERR("Advertising failed to start (err %d)", err);
        return err;
    }

    LOG_INF("Advertising successfully started");
    return 0;
}

int ble_stop_advertising(void)
{
    int err;

    err = bt_le_adv_stop();
    if (err) {
        LOG_ERR("Advertising failed to stop (err %d)", err);
        return err;
    }

    LOG_INF("Advertising stopped");
    return 0;
}

int ble_send_notification(const void *data, uint16_t len)
{
    if (!current_conn || !notify_enabled) {
        LOG_WRN("No connection or notifications not enabled");
        return -ENOTCONN;
    }

    return bt_gatt_notify(current_conn, &wifi_prov_svc.attrs[4], data, len);
}
```

## src/ble_gatt.h
```c
/*
 * Copyright (c) 2026 NotioNext Ltd.
 *
 * SPDX-License-Identifier: Apache-2.0
 */

#ifndef BLE_GATT_H
#define BLE_GATT_H

#include <zephyr/kernel.h>
#include <zephyr/bluetooth/bluetooth.h>
#include <zephyr/bluetooth/gatt.h>

/**
 * @brief Initialize BLE GATT service for WiFi provisioning
 * @return 0 on success, negative error code on failure
 */
int ble_gatt_init(void);

/**
 * @brief Start BLE advertising
 * @return 0 on success, negative error code on failure
 */
int ble_start_advertising(void);

/**
 * @brief Stop BLE advertising
 * @return 0 on success, negative error code on failure
 */
int ble_stop_advertising(void);

/**
 * @brief Send notification to connected client
 * @param data Data to send
 * @param len Length of data
 * @return 0 on success, negative error code on failure
 */
int ble_send_notification(const void *data, uint16_t len);

#endif /* BLE_GATT_H */
```

## src/nvs_storage.c
```c
/*
 * Copyright (c) 2026 NotioNext Ltd.
 *
 * SPDX-License-Identifier: Apache-2.0
 */

#include "nvs_storage.h"
#include <zephyr/logging/log.h>
#include <zephyr/storage/flash_map.h>
#include <zephyr/devicetree.h>
#include <string.h>

LOG_MODULE_REGISTER(nvs_storage, LOG_LEVEL_INF);

static struct nvs_fs fs;

int nvs_storage_init(void)
{
    int rc = 0;

    /* Use the storage partition defined in DTS */
    fs.flash_device = FIXED_PARTITION_DEVICE(storage_partition);
    if (!device_is_ready(fs.flash_device)) {
        LOG_ERR("Flash device not ready");
        return -ENODEV;
    }

    fs.offset = FIXED_PARTITION_OFFSET(storage_partition);
    fs.sector_size = 4096; /* Standard flash sector size */
    fs.sector_count = FIXED_PARTITION_SIZE(storage_partition) / fs.sector_size;

    LOG_INF("NVS: offset=0x%lx, size=%d, sector_size=%d, sector_count=%d",
            (unsigned long)fs.offset, FIXED_PARTITION_SIZE(storage_partition),
            fs.sector_size, fs.sector_count);

    rc = nvs_mount(&fs);
    if (rc) {
        LOG_ERR("Flash Init failed: %d", rc);
        return rc;
    }

    LOG_INF("NVS storage initialized successfully");
    return 0;
}

int nvs_save_wifi_credentials(const char *ssid, const char *password)
{
    int rc;

    if (!ssid || !password) {
        return -EINVAL;
    }

    if (strlen(ssid) >= MAX_SSID_LEN || strlen(password) >= MAX_PASSWORD_LEN) {
        LOG_ERR("SSID or password too long");
        return -EINVAL;
    }

    /* Save SSID */
    rc = nvs_write(&fs, WIFI_SSID_KEY, ssid, strlen(ssid) + 1);
    if (rc < 0) {
        LOG_ERR("Failed to write SSID: %d", rc);
        return rc;
    }

    /* Save password */
    rc = nvs_write(&fs, WIFI_PASSWORD_KEY, password, strlen(password) + 1);
    if (rc < 0) {
        LOG_ERR("Failed to write password: %d", rc);
        return rc;
    }

    /* Mark credentials as valid */
    uint8_t valid = 1;
    rc = nvs_write(&fs, WIFI_CREDENTIALS_VALID_KEY, &valid, sizeof(valid));
    if (rc < 0) {
        LOG_ERR("Failed to write credentials valid flag: %d", rc);
        return rc;
    }

    LOG_INF("WiFi credentials saved successfully - SSID: %s", ssid);
    return 0;
}

int nvs_read_wifi_credentials(char *ssid, char *password)
{
    int rc;

    if (!ssid || !password) {
        return -EINVAL;
    }

    /* Check if credentials are valid */
    if (!nvs_has_wifi_credentials()) {
        return -ENOENT;
    }

    /* Read SSID */
    rc = nvs_read(&fs, WIFI_SSID_KEY, ssid, MAX_SSID_LEN);
    if (rc < 0) {
        LOG_ERR("Failed to read SSID: %d", rc);
        return rc;
    }

    /* Read password */
    rc = nvs_read(&fs, WIFI_PASSWORD_KEY, password, MAX_PASSWORD_LEN);
    if (rc < 0) {
        LOG_ERR("Failed to read password: %d", rc);
        return rc;
    }

    LOG_INF("WiFi credentials read successfully - SSID: %s", ssid);
    return 0;
}

bool nvs_has_wifi_credentials(void)
{
    uint8_t valid = 0;
    int rc = nvs_read(&fs, WIFI_CREDENTIALS_VALID_KEY, &valid, sizeof(valid));

    if (rc < 0) {
        LOG_DBG("No valid credentials flag found: %d", rc);
        return false;
    }

    return (valid == 1);
}

int nvs_clear_wifi_credentials(void)
{
    int rc;

    /* Delete all WiFi credential keys */
    rc = nvs_delete(&fs, WIFI_SSID_KEY);
    if (rc < 0 && rc != -ENOENT) {
        LOG_ERR("Failed to delete SSID: %d", rc);
        return rc;
    }

    rc = nvs_delete(&fs, WIFI_PASSWORD_KEY);
    if (rc < 0 && rc != -ENOENT) {
        LOG_ERR("Failed to delete password: %d", rc);
        return rc;
    }

    rc = nvs_delete(&fs, WIFI_CREDENTIALS_VALID_KEY);
    if (rc < 0 && rc != -ENOENT) {
        LOG_ERR("Failed to delete credentials valid flag: %d", rc);
        return rc;
    }

    LOG_INF("WiFi credentials cleared successfully");
    return 0;
}
```

## src/nvs_storage.h
```c
/*
 * Copyright (c) 2026 NotioNext Ltd.
 *
 * SPDX-License-Identifier: Apache-2.0
 */

#ifndef NVS_STORAGE_H
#define NVS_STORAGE_H

#include <zephyr/kernel.h>
#include <zephyr/storage/flash_map.h>
#include <zephyr/fs/nvs.h>

#define WIFI_SSID_KEY 1
#define WIFI_PASSWORD_KEY 2
#define WIFI_CREDENTIALS_VALID_KEY 3

#define MAX_SSID_LEN 32
#define MAX_PASSWORD_LEN 64

/**
 * @brief Initialize NVS storage
 * @return 0 on success, negative error code on failure
 */
int nvs_storage_init(void);

/**
 * @brief Save WiFi credentials to NVS
 * @param ssid WiFi SSID
 * @param password WiFi password
 * @return 0 on success, negative error code on failure
 */
int nvs_save_wifi_credentials(const char *ssid, const char *password);

/**
 * @brief Read WiFi credentials from NVS
 * @param ssid Buffer to store SSID (must be at least MAX_SSID_LEN bytes)
 * @param password Buffer to store password (must be at least MAX_PASSWORD_LEN bytes)
 * @return 0 on success, negative error code on failure
 */
int nvs_read_wifi_credentials(char *ssid, char *password);

/**
 * @brief Check if valid WiFi credentials exist in NVS
 * @return true if credentials exist, false otherwise
 */
bool nvs_has_wifi_credentials(void);

/**
 * @brief Clear WiFi credentials from NVS
 * @return 0 on success, negative error code on failure
 */
int nvs_clear_wifi_credentials(void);

#endif /* NVS_STORAGE_H */
```

## src/ui_manager.c
```c
/*
 * Copyright (c) 2026 NotioNext Ltd.
 *
 * SPDX-License-Identifier: Apache-2.0
 */

#include "ui_manager.h"
#include <zephyr/logging/log.h>
#include <zephyr/kernel.h>
#include <zephyr/device.h>
#include <zephyr/drivers/display.h>
#include <zephyr/drivers/gpio.h>
#include <zephyr/input/input.h>
#include <lvgl_zephyr.h>
#include <string.h>

LOG_MODULE_REGISTER(ui_manager, LOG_LEVEL_INF);

/* Color definitions - Minimalistic theme */
#define COLOR_WHITE          lv_color_hex(0xFFFFFF)   /* White background */
#define COLOR_BLACK          lv_color_hex(0x000000)   /* Black text */
#define COLOR_GRAY           lv_color_hex(0x666666)   /* Gray text */
#define COLOR_BUTTON         lv_color_hex(0x007BFF)   /* Modern blue button */
#define COLOR_BUTTON_TEXT    lv_color_hex(0xFFFFFF)   /* White button text */
#define COLOR_SUCCESS        lv_color_hex(0x28A745)   /* Green for success */
#define COLOR_ERROR          lv_color_hex(0xDC3545)   /* Red for error */
#define COLOR_WARNING        lv_color_hex(0xFFC107)   /* Orange for warning */

/* UI Objects */
static lv_obj_t *screen_main;
static lv_obj_t *screen_ip_display;

/* Main Screen Objects */
static lv_obj_t *btn_device_ip;
static lv_obj_t *label_device_ip;
static lv_obj_t *label_status;

/* IP Display Screen Objects */
static lv_obj_t *label_ip_title;
static lv_obj_t *label_ip_address;
static lv_obj_t *btn_back;

/* Current screen state */
static ui_screen_t current_screen = UI_SCREEN_MAIN;
static bool wifi_connected = false;
static char device_ip_str[16] = "Not Connected";
static char wifi_ssid[33] = "";  /* WiFi SSID storage (max 32 chars + null terminator) */

/* Event queue */
#define UI_EVENT_QUEUE_SIZE 10
static struct k_msgq ui_event_queue;
static char ui_event_buffer[UI_EVENT_QUEUE_SIZE * sizeof(ui_event_t)];
bool ui_initialized = false;

/* UI thread */
static struct k_thread ui_thread;
static K_THREAD_STACK_DEFINE(ui_thread_stack, 2048);

/* Forward declarations */
static void create_main_screen(void);
static void create_ip_display_screen(void);
static void show_screen(ui_screen_t screen);
static void ui_thread_entry(void *p1, void *p2, void *p3);
static void enable_backlight(void);

/* Backlight GPIO */
#define BACKLIGHT_NODE DT_PATH(leds, lcd_backlight)
#define GT911_NODE DT_NODELABEL(gt911)
static const struct gpio_dt_spec backlight = GPIO_DT_SPEC_GET(BACKLIGHT_NODE, gpios);

/* Touch input variables with debouncing */
static int16_t touch_x = -1;
static int16_t touch_y = -1;
static bool touch_pressed = false;
static int64_t last_touch_time = 0;
static bool touch_handled = false;

#define TOUCH_DEBOUNCE_MS 300  /* 300ms debounce time */

static void enable_backlight(void)
{
    LOG_INF("Configuring backlight...");

    if (!gpio_is_ready_dt(&backlight)) {
        LOG_ERR("Backlight GPIO not ready");
        return;
    }

    int ret = gpio_pin_configure_dt(&backlight, GPIO_OUTPUT_ACTIVE);
    if (ret < 0) {
        LOG_ERR("Failed to configure backlight GPIO: %d", ret);
        return;
    }

    gpio_pin_set_dt(&backlight, 1);
    LOG_INF("Backlight enabled successfully");
}

static void input_callback(struct input_event *evt, void *user_data)
{
    switch (evt->code) {
    case INPUT_ABS_X:
        touch_x = evt->value;
        break;

    case INPUT_ABS_Y:
        touch_y = evt->value;
        break;

    case INPUT_BTN_TOUCH:
        if (evt->value == 1) {
            touch_pressed = true;
            touch_handled = false;  /* Reset handled flag on new touch */
        } else {
            touch_pressed = false;
            touch_x = -1;
            touch_y = -1;
        }
        break;

    default:
        break;
    }

    /* Handle touch events with debouncing */
    if (evt->sync && touch_pressed && touch_x >= 0 && touch_y >= 0 && !touch_handled) {
        int64_t current_time = k_uptime_get();

        /* Check debounce time */
        if (current_time - last_touch_time < TOUCH_DEBOUNCE_MS) {
            return;  /* Ignore touch within debounce period */
        }

        LOG_INF("Touch detected at (%d, %d)", touch_x, touch_y);
        last_touch_time = current_time;
        touch_handled = true;  /* Mark this touch as handled */

        /* Check which screen is active and handle touch accordingly */
        if (current_screen == UI_SCREEN_MAIN && btn_device_ip && wifi_connected) {
            lv_area_t btn_area;
            lv_obj_get_coords(btn_device_ip, &btn_area);

            LOG_INF("Device IP button area: (%d,%d) to (%d,%d)",
                    btn_area.x1, btn_area.y1, btn_area.x2, btn_area.y2);

            if (touch_x >= btn_area.x1 && touch_x <= btn_area.x2 &&
                touch_y >= btn_area.y1 && touch_y <= btn_area.y2) {
                LOG_INF("Device IP button touched!");
                ui_send_event(UI_EVENT_DEVICE_IP_PRESSED, NULL);
            }
        } else if (current_screen == UI_SCREEN_IP_DISPLAY && btn_back) {
            lv_area_t btn_area;
            lv_obj_get_coords(btn_back, &btn_area);

            LOG_INF("Back button area: (%d,%d) to (%d,%d)",
                    btn_area.x1, btn_area.y1, btn_area.x2, btn_area.y2);

            if (touch_x >= btn_area.x1 && touch_x <= btn_area.x2 &&
                touch_y >= btn_area.y1 && touch_y <= btn_area.y2) {
                LOG_INF("Back button touched!");
                show_screen(UI_SCREEN_MAIN);
            }
        } else {
            /* No action needed for other screens or conditions */
        }
    }
}

INPUT_CALLBACK_DEFINE(DEVICE_DT_GET(GT911_NODE), input_callback, NULL);

/* Button event handlers */
static void device_ip_btn_event_handler(lv_event_t *e)
{
    lv_event_code_t code = lv_event_get_code(e);
    if (code == LV_EVENT_CLICKED) {
        LOG_INF("Device IP button clicked");
        ui_send_event(UI_EVENT_DEVICE_IP_PRESSED, NULL);
    }
}

static void back_btn_event_handler(lv_event_t *e)
{
    lv_event_code_t code = lv_event_get_code(e);
    if (code == LV_EVENT_CLICKED) {
        LOG_INF("Back button clicked");
        show_screen(UI_SCREEN_MAIN);
    }
}

static void create_main_screen(void)
{
    /* Create main screen with white background */
    screen_main = lv_obj_create(NULL);
    lv_obj_set_style_bg_color(screen_main, COLOR_WHITE, 0);
    lv_obj_set_style_bg_opa(screen_main, LV_OPA_COVER, 0);

    /* Status label - centered */
    label_status = lv_label_create(screen_main);
    lv_label_set_text(label_status, "WiFi BLE Provisioning Ready\n\nUse provision_wifi.py to send\nWiFi credentials via Bluetooth\n\n(Check README.rst for details)");
    lv_obj_set_style_text_color(label_status, COLOR_BLACK, 0);
    lv_obj_set_style_text_font(label_status, &lv_font_montserrat_16, 0);
    lv_obj_set_style_text_align(label_status, LV_TEXT_ALIGN_CENTER, 0);
    lv_obj_set_width(label_status, 280);
    lv_obj_align(label_status, LV_ALIGN_CENTER, 0, 0);

    /* Device IP button (initially hidden) - centered */
    btn_device_ip = lv_btn_create(screen_main);
    lv_obj_set_size(btn_device_ip, 160, 50);
    lv_obj_align(btn_device_ip, LV_ALIGN_CENTER, 0, 20);
    lv_obj_set_style_bg_color(btn_device_ip, COLOR_BUTTON, 0);
    lv_obj_set_style_border_width(btn_device_ip, 0, 0);
    lv_obj_set_style_radius(btn_device_ip, 12, 0);
    lv_obj_set_style_shadow_width(btn_device_ip, 4, 0);
    lv_obj_set_style_shadow_color(btn_device_ip, lv_color_hex(0x000000), 0);
    lv_obj_set_style_shadow_opa(btn_device_ip, LV_OPA_20, 0);
    lv_obj_add_event_cb(btn_device_ip, device_ip_btn_event_handler, LV_EVENT_CLICKED, NULL);
    lv_obj_add_flag(btn_device_ip, LV_OBJ_FLAG_HIDDEN);

    /* Device IP button label - centered */
    label_device_ip = lv_label_create(btn_device_ip);
    lv_label_set_text(label_device_ip, "DEVICE IP");
    lv_obj_set_style_text_color(label_device_ip, COLOR_BUTTON_TEXT, 0);
    lv_obj_set_style_text_font(label_device_ip, &lv_font_montserrat_16, 0);
    lv_obj_center(label_device_ip);

    LOG_INF("Main screen created");
}

static void create_ip_display_screen(void)
{
    /* Create IP display screen with white background */
    screen_ip_display = lv_obj_create(NULL);
    lv_obj_set_style_bg_color(screen_ip_display, COLOR_WHITE, 0);
    lv_obj_set_style_bg_opa(screen_ip_display, LV_OPA_COVER, 0);

    /* IP title label - centered */
    label_ip_title = lv_label_create(screen_ip_display);
    lv_label_set_text(label_ip_title, "Device IP Address");
    lv_obj_set_style_text_color(label_ip_title, COLOR_BLACK, 0);
    lv_obj_set_style_text_font(label_ip_title, &lv_font_montserrat_16, 0);
    lv_obj_set_style_text_align(label_ip_title, LV_TEXT_ALIGN_CENTER, 0);
    lv_obj_align(label_ip_title, LV_ALIGN_CENTER, 0, -50);

    /* IP address label - centered */
    label_ip_address = lv_label_create(screen_ip_display);
    lv_label_set_text(label_ip_address, device_ip_str);
    lv_obj_set_style_text_color(label_ip_address, COLOR_BLACK, 0);
    lv_obj_set_style_text_font(label_ip_address, &lv_font_montserrat_16, 0);
    lv_obj_set_style_text_align(label_ip_address, LV_TEXT_ALIGN_CENTER, 0);
    lv_obj_align(label_ip_address, LV_ALIGN_CENTER, 0, -10);

    /* Back button - centered */
    btn_back = lv_btn_create(screen_ip_display);
    lv_obj_set_size(btn_back, 120, 45);
    lv_obj_align(btn_back, LV_ALIGN_CENTER, 0, 40);
    lv_obj_set_style_bg_color(btn_back, COLOR_BUTTON, 0);
    lv_obj_set_style_border_width(btn_back, 0, 0);
    lv_obj_set_style_radius(btn_back, 12, 0);
    lv_obj_set_style_shadow_width(btn_back, 4, 0);
    lv_obj_set_style_shadow_color(btn_back, lv_color_hex(0x000000), 0);
    lv_obj_set_style_shadow_opa(btn_back, LV_OPA_20, 0);
    lv_obj_add_event_cb(btn_back, back_btn_event_handler, LV_EVENT_CLICKED, NULL);

    /* Back button label - centered */
    lv_obj_t *label_back = lv_label_create(btn_back);
    lv_label_set_text(label_back, "BACK");
    lv_obj_set_style_text_color(label_back, COLOR_BUTTON_TEXT, 0);
    lv_obj_set_style_text_font(label_back, &lv_font_montserrat_14, 0);
    lv_obj_center(label_back);

    LOG_INF("IP display screen created");
}

static void show_screen(ui_screen_t screen)
{
    switch (screen) {
    case UI_SCREEN_MAIN:
        lv_scr_load(screen_main);
        current_screen = UI_SCREEN_MAIN;
        LOG_INF("Showing main screen");
        break;

    case UI_SCREEN_IP_DISPLAY:
        /* Update IP address label before showing the screen */
        if (label_ip_address) {
            lv_label_set_text(label_ip_address, device_ip_str);
        }
        lv_scr_load(screen_ip_display);
        current_screen = UI_SCREEN_IP_DISPLAY;
        LOG_INF("Showing IP display screen with IP: %s", device_ip_str);
        break;

    default:
        LOG_WRN("Unknown screen requested: %d", screen);
        break;
    }
}

static void handle_ui_event(ui_event_t event)
{
    switch (event) {
    case UI_EVENT_DEVICE_IP_PRESSED:
        LOG_INF("Handling DEVICE_IP_PRESSED event");
        show_screen(UI_SCREEN_IP_DISPLAY);
        break;


    case UI_EVENT_RESET_STATUS:
        LOG_INF("Handling RESET_STATUS event");
        if (current_screen == UI_SCREEN_MAIN && !wifi_connected) {
            lv_label_set_text(label_status, "WiFi BLE Provisioning Ready");
            lv_obj_set_style_text_color(label_status, COLOR_BLACK, 0);
        }
        break;

    case UI_EVENT_WIFI_CONNECTING:
        LOG_INF("Handling WIFI_CONNECTING event");
        if (current_screen == UI_SCREEN_MAIN) {
            lv_label_set_text(label_status, "Connecting to WiFi...");
            lv_obj_set_style_text_color(label_status, COLOR_BLACK, 0);
            /* Center the connecting message */
            lv_obj_align(label_status, LV_ALIGN_CENTER, 0, 0);
        }
        break;

    case UI_EVENT_WIFI_CONNECTED:
        LOG_INF("Handling WIFI_CONNECTED event");
        wifi_connected = true;
        if (current_screen == UI_SCREEN_MAIN) {
            char success_msg[80];
            if (strlen(wifi_ssid) > 0) {
                snprintf(success_msg, sizeof(success_msg), "WiFi Connected Successfully\nto %s", wifi_ssid);
            } else {
                snprintf(success_msg, sizeof(success_msg), "WiFi Connected Successfully!");
            }
            lv_label_set_text(label_status, success_msg);
            lv_obj_set_style_text_color(label_status, COLOR_BLACK, 0);
            /* Move status to higher position for connected state only */
            lv_obj_align(label_status, LV_ALIGN_CENTER, 0, -40);
            lv_obj_clear_flag(btn_device_ip, LV_OBJ_FLAG_HIDDEN);
            LOG_INF("Device IP button is now visible");
        }
        break;

    case UI_EVENT_WIFI_FAILED:
        LOG_INF("Handling WIFI_FAILED event");
        if (current_screen == UI_SCREEN_MAIN) {
            lv_label_set_text(label_status, "WiFi Connection Failed!");
            lv_obj_set_style_text_color(label_status, COLOR_BLACK, 0);
            /* Center the failed message */
            lv_obj_align(label_status, LV_ALIGN_CENTER, 0, 0);
        }
        break;

    default:
        LOG_WRN("Unknown UI event: %d", event);
        break;
    }
}

static void ui_thread_entry(void *p1, void *p2, void *p3)
{
    ui_event_t event;

    LOG_INF("UI thread started");

    while (1) {
        /* Process UI events */
        if (k_msgq_get(&ui_event_queue, &event, K_NO_WAIT) == 0) {
            handle_ui_event(event);
        }

        /* Handle LVGL tasks */
        lv_timer_handler();

        /* Small delay to prevent busy waiting */
        k_sleep(K_MSEC(10));
    }
}

int ui_manager_init(void)
{
    const struct device *display_dev;
    const struct device *gt911_dev;

    LOG_INF("Initializing UI manager");

    /* Check if GT911 touch is ready */
    gt911_dev = DEVICE_DT_GET(GT911_NODE);
    if (!device_is_ready(gt911_dev)) {
        LOG_ERR("GT911 touch controller not ready!");
        return -ENODEV;
    }
    LOG_INF("GT911 touch controller ready");

    /* Get display device */
    display_dev = DEVICE_DT_GET(DT_CHOSEN(zephyr_display));
    if (!device_is_ready(display_dev)) {
        LOG_ERR("Display device not ready");
        return -ENODEV;
    }
    LOG_INF("Display device is ready");

    /* Enable backlight */
    enable_backlight();

    /* Turn on display */
    LOG_INF("Turning on display...");
    display_blanking_off(display_dev);

    /* Wait for display to stabilize */
    k_sleep(K_MSEC(200));

    /* Initialize LVGL */
    LOG_INF("Initializing LVGL...");
    lv_init();
    LOG_INF("LVGL core initialized");

    /* Initialize LVGL display driver */
    int ret = lvgl_init();
    if (ret != 0) {
        LOG_ERR("Failed to initialize LVGL display driver: %d", ret);
        return ret;
    }
    LOG_INF("LVGL display driver initialized successfully");

    /* Initialize event queue */
    k_msgq_init(&ui_event_queue, ui_event_buffer, sizeof(ui_event_t), UI_EVENT_QUEUE_SIZE);
    ui_initialized = true;

    /* Create all screens */
    create_main_screen();
    create_ip_display_screen();

    /* Show initial screen */
    show_screen(UI_SCREEN_MAIN);

    /* Start UI thread */
    k_thread_create(&ui_thread, ui_thread_stack,
                    K_THREAD_STACK_SIZEOF(ui_thread_stack),
                    ui_thread_entry, NULL, NULL, NULL,
                    K_PRIO_COOP(7), 0, K_NO_WAIT);
    k_thread_name_set(&ui_thread, "ui_thread");

    LOG_INF("UI manager initialized successfully");
    return 0;
}

void ui_send_event(ui_event_t event, void *data)
{
    if (!ui_initialized) {
        LOG_WRN("UI not initialized, ignoring event %d", event);
        return;
    }

    int ret = k_msgq_put(&ui_event_queue, &event, K_NO_WAIT);
    if (ret != 0) {
        LOG_WRN("Failed to send UI event %d: %d", event, ret);
    }
}

void ui_update_ip_address(const char *ip_address)
{
    if (ip_address) {
        strncpy(device_ip_str, ip_address, sizeof(device_ip_str) - 1);
        device_ip_str[sizeof(device_ip_str) - 1] = '\0';
    } else {
        strcpy(device_ip_str, "Not Connected");
    }

    /* Always update IP display label if it exists */
    if (label_ip_address) {
        lv_label_set_text(label_ip_address, device_ip_str);
    }

    LOG_INF("IP address updated: %s", device_ip_str);
}

void ui_set_wifi_status(bool connected)
{
    wifi_connected = connected;

    if (connected) {
        LOG_INF("WiFi connected - sending UI event");
        ui_send_event(UI_EVENT_WIFI_CONNECTED, NULL);
    } else {
        /* Hide Device IP button when disconnected */
        if (current_screen == UI_SCREEN_MAIN && btn_device_ip) {
            lv_obj_add_flag(btn_device_ip, LV_OBJ_FLAG_HIDDEN);
        }
        ui_update_ip_address(NULL);
        /* Clear SSID when disconnected */
        wifi_ssid[0] = '\0';
    }
}

void ui_set_wifi_ssid(const char *ssid)
{
    if (ssid) {
        strncpy(wifi_ssid, ssid, sizeof(wifi_ssid) - 1);
        wifi_ssid[sizeof(wifi_ssid) - 1] = '\0';
        LOG_INF("WiFi SSID updated: %s", wifi_ssid);
    } else {
        wifi_ssid[0] = '\0';
        LOG_INF("WiFi SSID cleared");
    }
}
```

## src/ui_manager.h
```c
/*
 * Copyright (c) 2026 NotioNext Ltd.
 *
 * SPDX-License-Identifier: Apache-2.0
 */

#ifndef UI_MANAGER_H
#define UI_MANAGER_H

#include <zephyr/kernel.h>
#include <lvgl.h>

/* UI Screen States */
typedef enum {
    UI_SCREEN_MAIN,         /* Main screen with Device IP button */
    UI_SCREEN_IP_DISPLAY,   /* IP display screen */
} ui_screen_t;

/* UI Events */
typedef enum {
    UI_EVENT_DEVICE_IP_PRESSED,
    UI_EVENT_WIFI_CONNECTING,
    UI_EVENT_WIFI_CONNECTED,
    UI_EVENT_WIFI_FAILED,
    UI_EVENT_BLE_RECEIVING,
    UI_EVENT_RESET_STATUS,
} ui_event_t;

/**
 * @brief Initialize UI manager and LVGL
 * @return 0 on success, negative error code on failure
 */
int ui_manager_init(void);

/**
 * @brief Send event to UI manager
 * @param event UI event to process
 * @param data Optional event data
 */
void ui_send_event(ui_event_t event, void *data);

/**
 * @brief Update device IP address display
 * @param ip_address IP address string
 */
void ui_update_ip_address(const char *ip_address);

/**
 * @brief Set WiFi connection status
 * @param connected true if connected, false otherwise
 */
void ui_set_wifi_status(bool connected);

/**
 * @brief Set WiFi SSID for display
 * @param ssid WiFi network name
 */
void ui_set_wifi_ssid(const char *ssid);

/* External UI initialization status */
extern bool ui_initialized;

#endif /* UI_MANAGER_H */
```

## src/wifi_manager.h
```c
/*
 * Copyright (c) 2026 NotioNext Ltd.
 *
 * SPDX-License-Identifier: Apache-2.0
 */

#ifndef WIFI_MANAGER_H
#define WIFI_MANAGER_H

#include <zephyr/kernel.h>
#include <zephyr/net/wifi_mgmt.h>

/**
 * @brief Initialize WiFi manager
 * @return 0 on success, negative error code on failure
 */
int wifi_manager_init(void);

/**
 * @brief Connect to WiFi using provided credentials
 * @param ssid WiFi SSID
 * @param password WiFi password
 * @return 0 on success, negative error code on failure
 */
int wifi_connect(const char *ssid, const char *password);

/**
 * @brief Disconnect from WiFi
 * @return 0 on success, negative error code on failure
 */
int wifi_disconnect(void);

/**
 * @brief Check if WiFi is connected
 * @return true if connected, false otherwise
 */
bool wifi_is_connected(void);

/**
 * @brief Get current WiFi status
 * @return WiFi status
 */
int wifi_get_status(void);

/**
 * @brief Try to connect using stored credentials
 * @return 0 on success, negative error code on failure
 */
int wifi_connect_stored(void);

/**
 * @brief Get device IP address as string
 * @param ip_str Buffer to store IP address string
 * @param len Buffer length
 * @return 0 on success, negative error code on failure
 */
int wifi_get_ip_address(char *ip_str, size_t len);

#endif /* WIFI_MANAGER_H */
```
