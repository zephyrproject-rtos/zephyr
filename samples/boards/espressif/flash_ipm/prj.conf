## CMakeLists.txt
```
# SPDX-License-Identifier: Apache-2.0

cmake_minimum_required(VERSION 3.28.0)

set(REMOTE_ZEPHYR_DIR ${CMAKE_CURRENT_BINARY_DIR}/../flash_ipm_remote/zephyr)

find_package(Zephyr REQUIRED HINTS $ENV{ZEPHYR_BASE})

message(STATUS "${BOARD} compile as Master in this sample")
project(flash_ipm)

target_sources(app PRIVATE src/main.c)
```

## Kconfig.sysbuild
```
# Copyright 2025 Espressif
#
# SPDX-License-Identifier: Apache-2.0

source "share/sysbuild/Kconfig"
```

## sample.yaml
```
sample:
  name: ESP32 Flash IPM Sample
tests:
  sample.espressif.flash_ipm:
    platform_allow:
      - esp32s3_devkitc/esp32s3/procpu
    tags:
      - samples
      - ipm
```

## prj.conf
```kconfig
CONFIG_LOG=y
CONFIG_IPM=y
CONFIG_SHELL=y
CONFIG_FLASH=y
CONFIG_FLASH_SHELL=y
CONFIG_FLASH_SHELL_TEST_COMMANDS=y
CONFIG_ESP_FLASH_ASYNC=y
#CONFIG_ESP_FLASH_ASYNC_WORK=y
CONFIG_ESP_FLASH_ASYNC_IPM=y
```

## socs/esp32s3_procpu.overlay
```dts
/*
 * Copyright (c) 2025 Espressif Systems (Shanghai) Co., Ltd.
 *
 * SPDX-License-Identifier: Apache-2.0
 */

&ipm0 {
	status = "okay";
};
```

## src/main.c
```c
/*
 * Copyright (c) 2017 Linaro Limited
 *
 * SPDX-License-Identifier: Apache-2.0
 */

#include <stdio.h>

int main(void)
{
	printf("Flash IPM enabled shell sample");

	return 0;
}
```
