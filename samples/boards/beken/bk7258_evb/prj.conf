## CMakeLists.txt
```
# Copyright (c) 2026 Beken Corporation
# SPDX-License-Identifier: Apache-2.0

cmake_minimum_required(VERSION 3.20.0)

find_package(Zephyr REQUIRED HINTS $ENV{ZEPHYR_BASE})

project(bk7258_bringup)

target_sources(app PRIVATE src/main.c)
```

## prj.conf
```kconfig
# Copyright (c) 2026 Beken Corporation
# SPDX-License-Identifier: Apache-2.0
#
# Configuration for the board bring-up self test.
#
# Goal: characters out, characters in, and k_sleep timing correct. So it is
# deliberately minimal: console only, no shell and no logging (one less
# layer that can be misconfigured).

CONFIG_CONSOLE=y
CONFIG_SERIAL=y
CONFIG_UART_CONSOLE=y
CONFIG_PRINTK=y

# The self test uses k_sleep to verify SysTick timing
CONFIG_SYS_CLOCK_TICKS_PER_SEC=1000

# No logging subsystem (less console noise, one less class of config error)
CONFIG_LOG=n

# Zephyr has no SMP support for this architecture
CONFIG_SMP=n
```

## src/main.c
```c
/*
 * Copyright (c) 2026 Beken Corporation
 *
 * SPDX-License-Identifier: Apache-2.0
 *
 * Board bring-up self test.
 *
 * Why this prints so many lines instead of a plain "hello": on the very first
 * boot, "nothing comes out" has a dozen possible causes. This program turns each
 * failure into a *distinguishable* symptom, which narrows the search
 * immediately.
 *
 * Four stages, each with its own observable result:
 *
 *   [1] banner      reset worked, code runs, UART TX works
 *   [2] clock regs  peripheral registers are readable (bus works), and shows
 *                   what clock the bootloader left behind
 *   [3] heartbeat   SysTick counts correctly (k_sleep(1s) really is 1 s)
 *   [4] echo        reads the console port and prints whatever it receives
 *
 * Stage 4 is a check with a negative expected result on this board: the console
 * port belongs to the firmware the device ships with, which is also reading it,
 * so nothing typed reaches this image and nothing should be echoed. Silence
 * there is the pass condition, not a failure; the board documentation explains
 * why.
 */

#include <zephyr/device.h>
#include <zephyr/drivers/uart.h>
#include <zephyr/kernel.h>
#include <zephyr/sys/printk.h>

/*
 * KERNEL_VERSION_STRING lives in <zephyr/version.h> (generated by CMake at
 * build time). <zephyr/kernel.h> does *not* pull it in: neither kernel.h,
 * kernel_includes.h nor init.h includes version.h (checked against 4.4.2).
 * Forgetting the include gives 'KERNEL_VERSION_STRING' undeclared.
 */
#include <zephyr/version.h>

#include <soc.h>

/*
 * Stage 2: read the clock register.
 *
 * SYS_CPU_CLK_DIV_MODE1 is at 0x44010020. The reference vendor project runs
 * with CPU_FREQ_HZ = 120000000.
 */

static void report_clock(void)
{
	uint32_t reg = soc_bk7258_read_clk_div_mode1();
	uint32_t clkdiv_core = reg & 0xFU;
	uint32_t cksel_core = (reg >> 4) & 0x3U;
	uint32_t clkdiv_uart0 = (reg >> SOC_SYS_CLKDIV_UART0_SHIFT) & 0x3U;
	uint32_t clksel_uart0 = (reg & SOC_SYS_CLKSEL_UART0_BIT) ? 1U : 0U;

	printk("[2] SYS_CPU_CLK_DIV_MODE1 = 0x%08x\n", reg);
	printk("    clkdiv_core = %u\n", clkdiv_core);
	printk("    cksel_core  = %u   (known: 2 = 320MHz, 3 = 480MHz)\n", cksel_core);
	printk("    clkdiv_uart0= %u\n", clkdiv_uart0);
	printk("    clksel_uart0= %u   (0 = XTAL 26MHz, 1 = APLL)\n", clksel_uart0);

	printk("    CONFIG_SYS_CLOCK_HW_CYCLES_PER_SEC = %u\n",
	       (unsigned int)CONFIG_SYS_CLOCK_HW_CYCLES_PER_SEC);

	/*
	 * No pass/fail verdict here, only raw facts. The real criterion is
	 * the heartbeat interval in stage 3: if five sleeps take about five
	 * seconds, timing is right and the clock configuration is indirectly
	 * confirmed; if it is noticeably fast or slow, scale
	 * CONFIG_SYS_CLOCK_HW_CYCLES_PER_SEC proportionally.
	 * (UART baud rate is verified directly by "are the characters
	 * readable".)
	 */
	if (clksel_uart0 != 0U) {
		printk("    !! UART0 clocked from APLL, not XTAL: the driver\n"
		       "       clk_div assumption does not hold\n");
	}
}

/*
 * Stage 4: read the console port and report whatever arrives.
 */

static void echo_forever(const struct device *uart)
{
	uint8_t c;

	printk("[4] echo: nothing is expected here -- the console port belongs to\n");
	printk("    the firmware the device ships with, which is reading it\n");

	while (true) {
		if (uart_poll_in(uart, &c) == 0) {
			printk("ECHO:%c (0x%02x)\n", (c >= 0x20 && c < 0x7F) ? c : '.', c);
		}
		k_usleep(1000);
	}
}

/*
 * main
 */

int main(void)
{
	const struct device *uart = DEVICE_DT_GET(DT_CHOSEN(zephyr_console));
	int i;
	int64_t t0, t1;

	/* Stage 1: banner */
	printk("\n\n");
	printk("==================================================\n");
	printk("  BK7258 board bring-up self test\n");
	printk("==================================================\n");
	printk("[1] banner OK -- reset, execution and UART TX all work\n");
	printk("    board      : %s\n", CONFIG_BOARD_TARGET);
	printk("    SoC        : %s\n", CONFIG_SOC);
	printk("    Zephyr     : %s\n", KERNEL_VERSION_STRING);
	printk("    console    : %s\n", uart->name);
	printk("    Hello World! bk7258\n\n");

	if (!device_is_ready(uart)) {
		printk("!! console device not ready -- yet this line printed,\n"
		       "   so TX works; check what device_is_ready means here\n");
	}

	/* Stage 2: clock */
	report_clock();
	printk("\n");

	/* Stage 3: heartbeat */
	printk("[3] heartbeat: 5x k_sleep(1s), total should be ~5 s\n");
	for (i = 1; i <= 5; i++) {
		t0 = k_uptime_get();
		k_sleep(K_SECONDS(1));
		t1 = k_uptime_get();
		printk("    tick %d/%d   uptime=%lld ms   interval=%lld ms\n", i, 5, k_uptime_get(),
		       t1 - t0);
	}
	printk("    done. if the interval is far from 1000 ms, scale\n"
	       "    CONFIG_SYS_CLOCK_HW_CYCLES_PER_SEC proportionally\n\n");

	/* Stage 4: echo */
	echo_forever(uart);

	return 0; /* unreachable */
}
```
