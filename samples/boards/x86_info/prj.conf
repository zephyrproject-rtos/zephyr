## CMakeLists.txt
```
# SPDX-License-Identifier: Apache-2.0
# Copyright (c) 2019 Intel Corp.

cmake_minimum_required(VERSION 3.8.2)

include($ENV{ZEPHYR_BASE}/cmake/app/boilerplate.cmake NO_POLICY_SCOPE)
project(x86_info)

target_sources(app PRIVATE src/main.c)
target_sources(app PRIVATE src/timer.c)
target_sources(app PRIVATE src/memmap.c)
target_sources_ifdef(CONFIG_ACPI app PRIVATE src/acpi.c)
target_sources_ifdef(CONFIG_MULTIBOOT app PRIVATE src/multiboot.c)
```

## sample.yaml
```
sample:
  description: Tool to illustrate the use of some x86-specific kernel
    interfaces, and also to provide information about x86-based platforms
    (memory map, CPU information, timer frequencies) useful when bringing
    up new boards.
  name: x86 platform information tool
```

## prj.conf
```kconfig
CONFIG_X86_ACPI=y
CONFIG_MULTIBOOT_INFO=y
CONFIG_MULTIBOOT_MEMMAP=y
CONFIG_MULTIBOOT_FRAMEBUF=y
CONFIG_COUNTER=y
CONFIG_COUNTER_CMOS=y
```

## src/main.c
```c
/*
 * SPDX-License-Identifier: Apache-2.0
 * Copyright (c) 2019 Intel Corp.
 */

#include <zephyr.h>
#include "x86_info.h"

__weak void multiboot(void)
{
	printk("MULTIBOOT: Not supported in this build.\n\n");
}

__weak void acpi(void)
{
	printk("ACPI: Not supported in this build.\n\n");
}

void main(void)
{
	printk("\n\nx86_info: the Zephyr x86 platform information tool\n\n");

	multiboot();
	acpi();
	timer();

	printk("x86_info: complete\n");
}
```

## src/acpi.c
```c
/*
 * SPDX-License-Identifier: Apache-2.0
 * Copyright (c) 2019 Intel Corp.
 */

#include <zephyr.h>
#include <arch/x86/acpi.h>

void acpi(void)
{
	int nr_cpus;

	for (nr_cpus = 0; z_x86_acpi_get_cpu(nr_cpus); ++nr_cpus) {
		/* count number of CPUs present */
	}

	if (nr_cpus == 0) {
		printk("ACPI: no RSDT/MADT found\n\n");
	} else {
		printk("ACPI: %d CPUs found\n", nr_cpus);

		for (int i = 0; i < nr_cpus; ++i) {
			struct x86_acpi_cpu *cpu = z_x86_acpi_get_cpu(i);
			printk("\tCPU #%d: APIC ID 0x%02x\n", i, cpu->id);
		}
	}

	printk("\n");
}
```

## src/multiboot.c
```c
/*
 * SPDX-License-Identifier: Apache-2.0
 * Copyright (c) 2019 Intel Corp.
 */

#include <zephyr.h>
#include <arch/x86/multiboot.h>

void multiboot(void)
{
#ifndef CONFIG_MULTIBOOT_INFO
	printk("MULTIBOOT: info struct NOT preserved.\n\n");
#else
	/*
	 * If flags == 0, then either we didn't copy the flags from a real
	 * multiboot info struct because the loader didn't provide one, or
	 * (highly unlikely) we DID get a valid struct, but it was empty.
	 */

	if (!multiboot_info.flags) {
		printk("MULTIBOOT: info struct UNAVAILABLE or EMPTY.\n\n");
	} else {
		printk("MULTIBOOT: boot info structure available.\n");
		printk("\tFlags = 0x%08x\n", multiboot_info.flags);
	}

	if (multiboot_info.flags & MULTIBOOT_INFO_FLAGS_MEM) {
		printk("\tBasic memory map: lower = %dK, upper = %dK.\n",
			multiboot_info.mem_lower,
			multiboot_info.mem_upper);
	} else {
		printk("\tNo basic memory map available.\n");
	}

	if (multiboot_info.flags & MULTIBOOT_INFO_FLAGS_MMAP) {
		printk("\tExtended memory map was at 0x%08x (%d bytes).\n",
			multiboot_info.mmap_addr,
			multiboot_info.mmap_length);
	} else {
		printk("\tNo extended memory map available.\n");
	}

	if (multiboot_info.flags & MULTIBOOT_INFO_FLAGS_FB) {
		printk("\tFramebuffer %dbpp %dX%d (pitch %d) @ %08x.\n",
			multiboot_info.fb_bpp,
			multiboot_info.fb_width,
			multiboot_info.fb_height,
			multiboot_info.fb_pitch,
			multiboot_info.fb_addr_lo);
	} else {
		printk("\tFramebuffer data not present.\n");
	}
#endif
	printk("\n");
}
```

## src/x86_info.h
```c
/*
 * SPDX-License-Identifier: Apache-2.0
 * Copyright (c) 2019 Intel Corp.
 */

extern void multiboot(void);
extern void acpi(void);
extern void timer(void);
```
