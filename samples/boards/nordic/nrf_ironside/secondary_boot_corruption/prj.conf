## CMakeLists.txt
```
#
# Copyright (c) 2025 Nordic Semiconductor ASA
#
# SPDX-License-Identifier: LicenseRef-Nordic-5-Clause
#

cmake_minimum_required(VERSION 3.13.1)

find_package(Zephyr REQUIRED HINTS $ENV{ZEPHYR_BASE})

project(secondary_boot_primary)

target_sources(app PRIVATE
  src/main.c
  )
```

## sample.yaml
```
sample:
  name: Secondary Boot Corruption Sample
  description: |
    Demonstrates secondary image boot after primary image corruption on nRF54H20DK.
    The primary image corrupts protected memory and reboots, triggering the system
    to boot the secondary image instead.

common:
  sysbuild: true
  harness: console
  harness_config:
    type: multi_line
    regex:
      - "=== Hello World from Primary Image ==="
      - "=== Hello World from Secondary Image ==="

tests:
  sample.boards.nordic.nrf_ironside.secondary_boot_corruption:
    tags:
      - sysbuild
      - nrf_ironside
    platform_allow:
      - nrf54h20dk/nrf54h20/cpuapp
    integration_platforms:
      - nrf54h20dk/nrf54h20/cpuapp
```

## prj.conf
```kconfig
#
# Copyright (c) 2025 Nordic Semiconductor ASA
#
# SPDX-License-Identifier: LicenseRef-Nordic-5-Clause
#

# Disable the MPU to allow the sample to corrupt itself
CONFIG_ARM_MPU=n

CONFIG_ASSERT=y
```

## src/main.c
```c
/*
 * Copyright (c) 2025 Nordic Semiconductor ASA.
 *
 * SPDX-License-Identifier: Apache-2.0
 */

#include <zephyr/kernel.h>
#include <zephyr/sys/printk.h>
#include <zephyr/sys/reboot.h>
#include <zephyr/linker/linker-defs.h>
#include <string.h>

int main(void)
{
	printk("=== Hello World from Primary Image ===\n");

	__ASSERT((uint32_t)__rom_region_start == 0xe030000,
			 "For nRF54H20 the protectedmem starts at 0xe030000");

	printk("Corrupting the PROTECTEDMEM\n");
	/* (This is only possible because we have disabled CONFIG_ARM_MPU). */

	*((volatile uint32_t *)__rom_region_start + 0) = 0x5EB0;
	*((volatile uint32_t *)__rom_region_start + 4) = 0x5EB0;
	*((volatile uint32_t *)__rom_region_start + 8) = 0x5EB0;
	*((volatile uint32_t *)__rom_region_start + 12) = 0x5EB0;

	printk("Rebooting\n");

	sys_reboot(SYS_REBOOT_COLD);

	return 0;
}
```
