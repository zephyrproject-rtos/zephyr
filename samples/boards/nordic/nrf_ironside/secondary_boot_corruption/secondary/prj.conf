## CMakeLists.txt
```
# Copyright (c) 2025 Nordic Semiconductor ASA
# SPDX-License-Identifier: LicenseRef-Nordic-5-Clause

cmake_minimum_required(VERSION 3.13.1)
find_package(Zephyr REQUIRED HINTS $ENV{ZEPHYR_BASE})
project(secondary_boot_secondary)

# Create marker file to identify this as secondary firmware for gen_uicr.py
file(WRITE ${CMAKE_CURRENT_BINARY_DIR}/is_secondary_firmware.txt "")

target_sources(app PRIVATE src/main.c)
```

## prj.conf
```kconfig
#
# Copyright (c) 2025 Nordic Semiconductor ASA
#
# SPDX-License-Identifier: LicenseRef-Nordic-5-Clause
#

# NB: Must match secondary_partition in DT
# Secondary partition is at 0x1b0000
CONFIG_FLASH_LOAD_OFFSET=0x1b0000
```

## src/main.c
```c
/*
 * Copyright (c) 2025 Nordic Semiconductor ASA.
 *
 * SPDX-License-Identifier: Apache-2.0
 */

#include <zephyr/kernel.h>
#include <zephyr/sys/printk.h>

int main(void)
{
	printk("=== Hello World from Secondary Image ===\n");

	while (1) {
		k_msleep(3000);
		printk("Secondary image heartbeat\n");
	}

	return 0;
}
```
