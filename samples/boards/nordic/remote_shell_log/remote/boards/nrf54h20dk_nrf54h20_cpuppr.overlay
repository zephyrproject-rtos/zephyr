/*
 * Copyright (c) 2026 Nordic Semiconductor ASA
 *
 * SPDX-License-Identifier: Apache-2.0
 */

&cpuppr_vevif {
	status = "okay";
};

&cpuapp_bellboard {
	status = "okay";
};

ipc0: &cpuapp_cpuppr_ipc {
	status = "okay";
};

&uart135 {
	status = "disabled";
};
