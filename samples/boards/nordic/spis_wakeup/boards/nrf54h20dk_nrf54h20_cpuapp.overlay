/*
 * Copyright (c) 2025 Nordic Semiconductor ASA
 * SPDX-License-Identifier: Apache-2.0
 */

#include "nrf54h20dk_nrf54h20_common.dtsi"

/* LED1 will be used by the cpurad core. */
/ {
	aliases {
		/delete-property/ led1;
	};
};

/delete-node/ &led1;
