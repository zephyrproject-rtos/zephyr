/*
 * Copyright (c) 2025 Nordic Semiconductor ASA
 * SPDX-License-Identifier: Apache-2.0
 */

#include "nrf54h20dk_nrf54h20_common.dtsi"

&spi131 {
	interrupt-parent = <&cpuppr_clic>;
	status = "reserved";
};

&uart135 {
	interrupt-parent = <&cpuppr_clic>;
	status = "reserved";
};
