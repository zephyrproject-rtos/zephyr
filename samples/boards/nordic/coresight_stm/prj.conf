## CMakeLists.txt
```
#
# Copyright (c) 2024 Nordic Semiconductor ASA
#
# SPDX-License-Identifier: Apache-2.0
#

cmake_minimum_required(VERSION 3.28.0)

find_package(Zephyr REQUIRED HINTS $ENV{ZEPHYR_BASE})

if(NOT (CONFIG_BOARD_NRF54H20DK_NRF54H20_CPUAPP))
  message(FATAL_ERROR "${BOARD}/${BOARD_QUALIFIERS} is not supported for this sample")
endif()

project(nrf_coresight_stm)

target_sources(app PRIVATE src/main.c)

if(CONFIG_CPP)
  # When testing for C++ force test file C++ compilation
  set_source_files_properties(src/main.c PROPERTIES LANGUAGE CXX)
endif()
```

## Kconfig.sysbuild
```
# Copyright 2024 Nordic Semiconductor ASA
#
# SPDX-License-Identifier: Apache-2.0

source "share/sysbuild/Kconfig"

config APP_CPUPPR_RUN
	bool "Use PPR"

config APP_CPUFLPR_RUN
	bool "Use FLPR"
```

## sample.yaml
```
sample:
  name: Logging using Coresight STM on nrf54h20

common:
  tags: coresight_stm
  sysbuild: true
  platform_allow:
    - nrf54h20dk/nrf54h20/cpuapp
  integration_platforms:
    - nrf54h20dk/nrf54h20/cpuapp

tests:
  sample.boards.nrf.coresight_stm.dict:
    harness: pytest
    harness_config:
      pytest_dut_scope: session
      pytest_root:
        - "pytest/test_stm.py::test_sample_STM_dictionary_mode"
    required_snippets:
      - nordic-log-stm-dict
    extra_args:
      - SB_CONFIG_APP_CPUPPR_RUN=y
      - SB_CONFIG_APP_CPUFLPR_RUN=y

  sample.boards.nrf.coresight_stm.tpiu.dict:
    harness: console
    harness_config:
      fixture: jlink_trace_pro
    required_snippets:
      - nordic-log-stm-tpiu-dict
    extra_args:
      - SB_CONFIG_APP_CPUPPR_RUN=y
      - SB_CONFIG_APP_CPUFLPR_RUN=y

  sample.boards.nrf.coresight_stm:
    harness: pytest
    harness_config:
      pytest_dut_scope: session
      pytest_root:
        - "pytest/test_stm.py::test_sample_STM_decoded"
    required_snippets:
      - nordic-log-stm
    extra_args:
      - SB_CONFIG_APP_CPUPPR_RUN=y
      - SB_CONFIG_APP_CPUFLPR_RUN=y

  sample.boards.nrf.coresight_stm.rtt:
    harness: pytest
    harness_config:
      pytest_dut_scope: session
      pytest_root:
        - "pytest/test_stm.py::test_sample_STM_decoded"
    required_snippets:
      - nordic-log-stm
    extra_configs:
      - CONFIG_DEBUG_NRF_ETR_BACKEND_RTT=y
      - CONFIG_SEGGER_RTT_BUFFER_SIZE_UP=8192
    extra_args:
      - SB_CONFIG_APP_CPUPPR_RUN=y
      - SB_CONFIG_APP_CPUFLPR_RUN=y

  sample.boards.nrf.coresight_stm.local_uart:
    harness: console
    harness_config:
      type: multi_line
      ordered: true
      regex:
        - "test with 64bit argument 4398046511104"
        - "Timing for log message with 0 arguments:"
        - "Timing for log message with 1 argument:"
        - "Timing for log message with 2 arguments:"
        - "Timing for log message with 3 arguments:"
        - "Timing for log_message with string:"
```

## prj.conf
```kconfig
CONFIG_LOG=y
CONFIG_SOC_NRF54H20_CPURAD_ENABLE=y
CONFIG_PM=y
CONFIG_CPU_LOAD=y
```

## boards/nrf54h20dk_nrf54h20_cpuapp.overlay
```dts
/*
 * Copyright (c) 2024 Nordic Semiconductor
 * SPDX-License-Identifier: Apache-2.0
 */

&cpuppr_vpr {
	status = "okay";
};

&cpuflpr_vpr {
	status = "okay";
};
```

## src/main.c
```c
/*
 * Copyright (c) 2024 Nordic Semiconductor ASA
 *
 * SPDX-License-Identifier: Apache-2.0
 */

#include <zephyr/kernel.h>
#include <zephyr/logging/log.h>
#include <zephyr/sys/cpu_load.h>

#ifdef CONFIG_LOG_FRONTEND_STMESP
#include <zephyr/logging/log_frontend_stmesp.h>
#endif

LOG_MODULE_REGISTER(app);

#ifdef CONFIG_CPP
#include "cpp_logger.hpp"
#endif

#define TEST_LOG(rpt, item)                                                                        \
	({                                                                                         \
		uint32_t key = irq_lock();                                                         \
		__DEBRACKET item;                                                                  \
		uint32_t t = k_cycle_get_32();                                                     \
		for (uint32_t i = 0; i < rpt; i++) {                                               \
			__DEBRACKET item;                                                          \
		}                                                                                  \
		t = k_cycle_get_32() - t;                                                          \
		irq_unlock(key);                                                                   \
		k_msleep(400);                                                                     \
		t;                                                                                 \
	})

static const char *core_name;

static void get_core_name(void)
{
	static const char app[] = "cpuapp";
	static const char rad[] = "cpurad";
	static const char ppr[] = "cpuppr";
	static const char flpr[] = "cpuflpr";
	static const char unknown[] = "unknown";
	static const char board[] = CONFIG_BOARD_TARGET;

	if ((uintptr_t)strstr(board, app) != 0) {
		core_name = app;
	} else if ((uintptr_t)strstr(board, rad) != 0) {
		core_name = rad;
	} else if ((uintptr_t)strstr(board, ppr) != 0) {
		core_name = ppr;
	} else if ((uintptr_t)strstr(board, flpr) != 0) {
		core_name = flpr;
	} else {
		core_name = unknown;
	}
}

static uint32_t t_to_ns(uint32_t t, uint32_t rpt, uint32_t freq)
{
	return (uint32_t)(((uint64_t)t * 1000000000) / (uint64_t)(rpt * freq));
}

static void timing_report(uint32_t t, uint32_t rpt, const char *str)
{
	uint32_t ns = t_to_ns(t, rpt, CONFIG_SYS_CLOCK_HW_CYCLES_PER_SEC);

	LOG_RAW("%s: Timing for %s: %d.%dus\n", core_name, str, ns / 1000, (ns % 1000) / 10);
}

int main(void)
{
	uint32_t t;
	uint32_t delta;
	uint32_t rpt = 10;
	uint32_t t0, t1, t2, t3, t_s;
	char str[] = "test string";
	int load;

	k_msleep(15000);

	get_core_name();

#ifdef CONFIG_CPP
	CppLogger cpp_logger;

	cpp_logger.log_test();
#endif

	if (IS_ENABLED(CONFIG_CPU_LOAD)) {
		(void)cpu_load_get(true);
	}

	t = k_cycle_get_32();
	delta = k_cycle_get_32() - t;

	t0 = TEST_LOG(rpt, (LOG_INF("test no arguments")));
	t0 -= delta;

	t1 = TEST_LOG(rpt, (LOG_INF("test with one argument %d", 100)));
	t1 -= delta;

	t2 = TEST_LOG(rpt, (LOG_INF("test with two arguments %d %d", 100, 10)));
	t2 -= delta;

	t3 = TEST_LOG(rpt, (LOG_INF("test with three arguments %d %d %d", 100, 10, 1)));
	t3 -= delta;

	t_s = TEST_LOG(rpt, (LOG_INF("test with string %s", str)));
	t_s -= delta;

	TEST_LOG(rpt, (LOG_INF("test with 64bit argument %llu", 2LLU << 41)));

#ifdef CONFIG_LOG_FRONTEND_STMESP
	uint32_t rpt_tp = 20;
	uint32_t t_tp, t_tpd;

	t_tp = TEST_LOG(rpt_tp, (log_frontend_stmesp_tp(5)));
	t_tp -= delta;

	t_tpd = TEST_LOG(rpt_tp, (log_frontend_stmesp_tp_d32(6, 10)));
	t_tpd -= delta;
#endif

	timing_report(t0, rpt, "log message with 0 arguments");
	timing_report(t1, rpt, "log message with 1 argument");
	timing_report(t2, rpt, "log message with 2 arguments");
	timing_report(t3, rpt, "log message with 3 arguments");
	timing_report(t_s, rpt, "log_message with string");

#ifdef CONFIG_LOG_FRONTEND_STMESP
	timing_report(t_tp, rpt_tp, "tracepoint");
	timing_report(t_tpd, rpt_tp, "tracepoint_d32");
#endif

	/* Needed in coverage run to separate STM logs from printk() */
	k_msleep(400);
	if (IS_ENABLED(CONFIG_CPU_LOAD)) {
		load = cpu_load_get(true);
		LOG_INF("CPU load: %d.%d", load / 10, load % 10);
	}
	return 0;
}
```

## src/cpp_logger.hpp
```c
/*
 * Copyright (c) 2024 Nordic Semiconductor ASA
 *
 * SPDX-License-Identifier: Apache-2.0
 */

#ifndef CPP_LOGGER_H_
#define CPP_LOGGER_H_

#ifdef __cplusplus

#include <zephyr/logging/log.h>

class CppLogger
{
public:
	void log_test(void)
	{
		LOG_MODULE_DECLARE(app);

		LOG_INF("test from C++ class");
	}
};

#endif /* __cplusplus */

#endif /* CPP_LOGGER_H_ */
```
