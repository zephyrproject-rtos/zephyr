## CMakeLists.txt
```
# SPDX-License-Identifier: Apache-2.0

cmake_minimum_required(VERSION 3.28.0)

find_package(Zephyr REQUIRED HINTS $ENV{ZEPHYR_BASE})
project(nrfx_sample)

target_sources(app PRIVATE src/main.c)
```

## Kconfig
```
# Copyright (c) 2021 Nordic Semiconductor ASA
# SPDX-License-Identifier: Apache-2.0

source "Kconfig.zephyr"

config NRFX_GPIOTE0
	default y if SOC_SERIES_NRF51 || \
		     SOC_SERIES_NRF52 || \
		     (SOC_SERIES_NRF53 && !TRUSTED_EXECUTION_NONSECURE) || \
		     (SOC_SERIES_NRF91 && !TRUSTED_EXECUTION_NONSECURE)

config NRFX_GPIOTE1
	default y if (SOC_SERIES_NRF53 && TRUSTED_EXECUTION_NONSECURE) || \
		     (SOC_SERIES_NRF91 && TRUSTED_EXECUTION_NONSECURE)

config NRFX_GPIOTE20
	default y if SOC_SERIES_NRF71
```

## prj.conf
```kconfig
CONFIG_GPIO=n
CONFIG_LOG=y
CONFIG_LOG_PROCESS_THREAD_SLEEP_MS=100
CONFIG_NRFX_GPPI=y
CONFIG_NRFX_GPIOTE=y
```

## boards/nrf7120dk_nrf7120_cpuapp.overlay
```dts
/*
 * Copyright (c) 2026 Nordic Semiconductor ASA
 * SPDX-License-Identifier: Apache-2.0
 */

/ {
	aliases {
		led0 = &led1;  /* LED1 is on gpio1 pin 10 */
		sw0 = &button0; /* Button0 is on gpio1 pin 13 */
	};
};

&gpio1 {
	status = "okay";
	gpiote-instance = <&gpiote20>;
};

&gpiote20 {
	status = "okay";
	owned-channels = <0 1>;
};
```

## src/main.c
```c
/*
 * Copyright (c) 2019 Nordic Semiconductor ASA
 *
 * SPDX-License-Identifier: Apache-2.0
 */

#include <zephyr/kernel.h>

#include <gpiote_nrfx.h>
#include <nrfx_gpiote.h>
#include <helpers/nrfx_gppi.h>

#include <zephyr/logging/log.h>
#include <zephyr/irq.h>
LOG_MODULE_REGISTER(nrfx_sample, LOG_LEVEL_INF);

#define INPUT_PIN	NRF_DT_GPIOS_TO_PSEL(DT_ALIAS(sw0), gpios)
#define OUTPUT_PIN	NRF_DT_GPIOS_TO_PSEL(DT_ALIAS(led0), gpios)

#define GPIOTE_INST	NRF_DT_GPIOTE_INST(DT_ALIAS(sw0), gpios)
#define GPIOTE_NODE	DT_NODELABEL(_CONCAT(gpiote, GPIOTE_INST))

BUILD_ASSERT(NRF_DT_GPIOTE_INST(DT_ALIAS(led0), gpios) == GPIOTE_INST,
	"Both sw0 and led0 GPIOs must use the same GPIOTE instance");

static void button_handler(nrfx_gpiote_pin_t pin,
			   nrfx_gpiote_trigger_t trigger,
			   void *context)
{
	LOG_INF("GPIO input event callback");
}

int main(void)
{
	LOG_INF("nrfx_gpiote sample on %s", CONFIG_BOARD);

	int rv;
	uint8_t in_channel, out_channel;
	nrfx_gppi_handle_t ppi_handle;
	static nrfx_gpiote_t *gpiote = &GPIOTE_NRFX_INST_BY_NODE(GPIOTE_NODE);

	/* Connect GPIOTE instance IRQ to irq handler */
	IRQ_CONNECT(DT_IRQN(GPIOTE_NODE), DT_IRQ(GPIOTE_NODE, priority), nrfx_gpiote_irq_handler,
		    &GPIOTE_NRFX_INST_BY_NODE(GPIOTE_NODE), 0);

	/* Initialize GPIOTE (the interrupt priority passed as the parameter
	 * here is ignored, see nrfx_glue.h).
	 */
	rv = nrfx_gpiote_init(gpiote, 0);
	if (rv != 0) {
		LOG_ERR("nrfx_gpiote_init error: %d", rv);
		return 0;
	}

	rv = nrfx_gpiote_channel_alloc(gpiote, &in_channel);
	if (rv != 0) {
		LOG_ERR("Failed to allocate in_channel, error: %d", rv);
		return 0;
	}

	rv = nrfx_gpiote_channel_alloc(gpiote, &out_channel);
	if (rv != 0) {
		LOG_ERR("Failed to allocate out_channel, error: %d", rv);
		return 0;
	}

	/* Initialize input pin to generate event on high to low transition
	 * (falling edge) and call button_handler()
	 */
	static const nrf_gpio_pin_pull_t pull_config = NRF_GPIO_PIN_PULLUP;
	nrfx_gpiote_trigger_config_t trigger_config = {
		.trigger = NRFX_GPIOTE_TRIGGER_HITOLO,
		.p_in_channel = &in_channel,
	};
	static const nrfx_gpiote_handler_config_t handler_config = {
		.handler = button_handler,
	};
	nrfx_gpiote_input_pin_config_t input_config = {
		.p_pull_config = &pull_config,
		.p_trigger_config = &trigger_config,
		.p_handler_config = &handler_config
	};

	rv = nrfx_gpiote_input_configure(gpiote, INPUT_PIN, &input_config);
	if (rv != 0) {
		LOG_ERR("nrfx_gpiote_input_configure error: %d", rv);
		return 0;
	}

	/* Initialize output pin. SET task will turn the LED on,
	 * CLR will turn it off and OUT will toggle it.
	 */
	static const nrfx_gpiote_output_config_t output_config = {
		.drive = NRF_GPIO_PIN_S0S1,
		.input_connect = NRF_GPIO_PIN_INPUT_DISCONNECT,
		.pull = NRF_GPIO_PIN_NOPULL,
	};
	const nrfx_gpiote_task_config_t task_config = {
		.task_ch = out_channel,
		.polarity = NRF_GPIOTE_POLARITY_TOGGLE,
		.init_val = 1,
	};
	rv = nrfx_gpiote_output_configure(gpiote, OUTPUT_PIN,
					   &output_config,
					   &task_config);
	if (rv != 0) {
		LOG_ERR("nrfx_gpiote_output_configure error: %d", rv);
		return 0;
	}

	nrfx_gpiote_trigger_enable(gpiote, INPUT_PIN, true);
	nrfx_gpiote_out_task_enable(gpiote, OUTPUT_PIN);

	LOG_INF("nrfx_gpiote initialized");

	/* Configure endpoints of the channel so that the input pin event is
	 * connected with the output pin OUT task. This means that each time
	 * the button is pressed, the LED pin will be toggled.
	 */
	rv = nrfx_gppi_conn_alloc(nrfx_gpiote_in_event_address_get(gpiote, INPUT_PIN),
				   nrfx_gpiote_out_task_address_get(gpiote, OUTPUT_PIN),
				   &ppi_handle);
	if (rv < 0) {
		LOG_ERR("nrfx_gppi_conn_alloc error: %d", rv);
		return 0;
	}

	/* Enable the channel. */
	nrfx_gppi_conn_enable(ppi_handle);

	LOG_INF("(D)PPI configured, leaving main()");
	return 0;
}
```
