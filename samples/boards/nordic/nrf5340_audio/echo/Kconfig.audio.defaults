## samples/boards/nordic/system_off/sample.yaml
```yaml
sample:
  name: Low Power State Sample for nRF5x
common:
  tags: power
tests:
  sample.boards.nrf.system_off:
    integration_platforms:
      - nrf52840dk/nrf52840
    platform_allow:
      - nrf51dk/nrf51822
      - nrf52840dk/nrf52840
      - nrf52dk/nrf52832
      - nrf5340dk/nrf5340/cpuapp
      - nrf54l15dk/nrf54l05/cpuapp
      - nrf54l15dk/nrf54l10/cpuapp
      - nrf54l15dk/nrf54l15/cpuapp
      - nrf54l20pdk/nrf54l20/cpuapp
    harness: console
    harness_config:
      type: multi_line
      ordered: true
      regex:
        - "system off demo"
        - "Retained data not supported"
        - "Entering system off; press sw0 to restart"
  sample.boards.nrf.system_off.retained_mem:
    integration_platforms:
      - nrf52840dk/nrf52840
    platform_allow:
      - nrf52840dk/nrf52840
      - nrf52dk/nrf52832
      - nrf5340dk/nrf5340/cpuapp
      - nrf54l15dk/nrf54l05/cpuapp
      - nrf54l15dk/nrf54l10/cpuapp
      - nrf54l15dk/nrf54l15/cpuapp
      - nrf54l20pdk/nrf54l20/cpuapp
    extra_configs:
      - CONFIG_APP_USE_RETAINED_MEM=y
    harness: console
    harness_config:
      type: multi_line
      ordered: true
      regex:
        - "system off demo"
        - "Retained data: INVALID"
        - "Boot count: 1"
        - "Off count: 0"
        - "Active Ticks:"
        - "Entering system off; press sw0 to restart"
  sample.boards.nrf.system_off.grtc_wakeup:
    platform_allow:
      - nrf54l15dk/nrf54l05/cpuapp
      - nrf54l15dk/nrf54l10/cpuapp
      - nrf54l15dk/nrf54l15/cpuapp
      - nrf54l20pdk/nrf54l20/cpuapp
    extra_configs:
      - CONFIG_GRTC_WAKEUP_ENABLE=y
      - CONFIG_GPIO_WAKEUP_ENABLE=n
    harness: console
    harness_config:
      type: multi_line
      ordered: true
      regex:
        - "system off demo"
        - "Retained data not supported"
        - "Entering system off; wait 2 seconds to restart"
        - "system off demo"
        - "Retained data not supported"
        - "Entering system off; wait 2 seconds to restart"
        - "system off demo"
        - "Wakeup from System OFF by GRTC."
        - "Retained data not supported"
        - "Entering system off; wait 2 seconds to restart"
  sample.boards.nrf.system_off.retained_mem.grtc_wakeup:
    platform_allow:
      - nrf54l15dk/nrf54l05/cpuapp
      - nrf54l15dk/nrf54l10/cpuapp
      - nrf54l15dk/nrf54l15/cpuapp
      - nrf54l20pdk/nrf54l20/cpuapp
    extra_configs:
      - CONFIG_APP_USE_RETAINED_MEM=y
      - CONFIG_GRTC_WAKEUP_ENABLE=y
      - CONFIG_GPIO_WAKEUP_ENABLE=n
    harness: console
    harness_config:
      type: multi_line
      ordered: true
      regex:
        - "system off demo"
        - "Retained data: INVALID"
        - "Boot count: 1"
        - "Off count: 0"
        - "Active Ticks:"
        - "Entering system off; wait 2 seconds to restart"
        - "system off demo"
        - "Retained data: valid"
        - "Boot count: 2"
        - "Off count: 1"
        - "Active Ticks:"
        - "Entering system off; wait 2 seconds to restart"
        - "Wakeup from System OFF by GRTC."
  sample.boards.nrf.system_off.lpcomp_wakeup:
    extra_args: DTC_OVERLAY_FILE="boards/nrf54l15dk_nrf54l15_cpuapp_comparator.overlay"
    platform_allow:
      - nrf54l15dk/nrf54l15/cpuapp
    extra_configs:
      - CONFIG_LPCOMP_WAKEUP_ENABLE=y
      - CONFIG_GPIO_WAKEUP_ENABLE=n
      - CONFIG_COMPARATOR=y
    harness: console
    harness_config:
      type: multi_line
      ordered: true
      regex:
        - "system off demo"
        - "Retained data not supported"
        - "Entering system off; change signal level at comparator input to restart"
  sample.boards.nrf.system_off.retained_mem.lpcomp_wakeup:
    extra_args:
      - "DTC_OVERLAY_FILE=
         boards/nrf54l15dk_nrf54l15_cpuapp_comparator.overlay;
         boards/nrf54l15dk_nrf54l15_cpuapp.overlay"
    platform_allow:
      - nrf54l15dk/nrf54l15/cpuapp
    extra_configs:
      - CONFIG_APP_USE_RETAINED_MEM=y
      - CONFIG_GPIO_WAKEUP_ENABLE=n
      - CONFIG_LPCOMP_WAKEUP_ENABLE=y
      - CONFIG_RETAINED_MEM=y
      - CONFIG_COMPARATOR=y
    harness: console
    harness_config:
      type: multi_line
      ordered: true
      regex:
        - "system off demo"
        - "Retained data: INVALID"
        - "Boot count: 1"
        - "Off count: 0"
        - "Active Ticks:"
        - "Entering system off; change signal level at comparator input to restart"
```

## samples/boards/npcm400_evb/spip_flash/sample.yaml
```yaml
sample:
  description: npcm400_evb SPIP flash testing
  name: npcm400_evb spip flash test
tests:
  sample.board.npcm400_evb.spip_flash:
    harness: spi
    platform_allow: npcm400_evb
    tags: spi
    depends_on:
      - spi
      - gpio
```

## samples/boards/npcx7m6fb_evb/demo/sample.yaml
```yaml
sample:
  name: Console example on NPCX7M5FB EVB
tests:
  sample.board.npcx7m6fb_evb_demo.console:
    platform_whitelist: npcx7m6fb_evb_demo
    tags: board
```

## samples/boards/nrf/adc_battery/sample.yaml
```yaml
sample:
  name: Settings subsystem sample
tests:
  sample.board.nrf.adc:
    build_only: true
    platform_whitelist: nrf52840_pca10056
    tags: nrf52 adc battery
```

## samples/boards/nrf/battery/Kconfig
```kconfig
# Copyright(c) 2020 Intive
# SPDX-License-Identifier: Apache-2.0

choice
	prompt "Mode of battery measurement"
	default BATT_MODE_VOLT_DIV
	help
	  Specify method in which battery voltage should be mesaured

config BATT_MODE_VOLT_DIV
	bool "Use voltage divider"
	depends on BOARD_NRF52_PCA20020

config BATT_MODE_DIRECT
	bool "Direct on MCU"

endchoice

source "Kconfig.zephyr"
```

## samples/boards/nrf/battery/sample.yaml
```yaml
sample:
  name: Measure battery voltage
tests:
  sample.boards.nrf.battery:
    build_only: true
    platform_allow:
      - particle_xenon/nrf52840
      - thingy52/nrf52832
    tags: battery
    integration_platforms:
      - particle_xenon/nrf52840
```

## samples/boards/nrf/clock_control/sample.yaml
```yaml
sample:
  name: Clock control sample for nRF
tests:
  sample.boards.nrf.clock_control:
    filter: CONFIG_CLOCK_CONTROL_NRF2
    integration_platforms:
      - nrf54h20dk/nrf54h20/cpuapp
```
