## samples/boards/nordic/nrf5340_audio/echo/Kconfig.audio.defaults
```kconfig
#
# Copyright (c) 2022 Nordic Semiconductor ASA
#
# SPDX-License-Identifier: LicenseRef-Nordic-5-Clause
#

# Audio sync timer
config NRFX_TIMER1
	default y

# Audio sync timer
config NRFX_DPPI
	default y
```

## samples/boards/nordic/nrf5340_audio/echo/Kconfig.defaults
```kconfig
#
# Copyright (c) 2022 Nordic Semiconductor ASA
#
# SPDX-License-Identifier: LicenseRef-Nordic-5-Clause
#

config REBOOT
	default y

config MAIN_THREAD_PRIORITY
	default 10

config MAIN_STACK_SIZE
	default 1800

config SYSTEM_WORKQUEUE_STACK_SIZE
	default 1200

# As long as thread names are used, config must be set to "y"
config THREAD_NAME
	default y

config NCS_INCLUDE_RPMSG_CHILD_IMAGE
	default !BT_LL_ACS_NRF53

# Workaround to not use fatal_error.c in NCS. Note that the system may still
# reset on error depending on the build configuraion
config RESET_ON_FATAL_ERROR
	default n

# Default Config for Debug and Release build
config HW_CODEC_CIRRUS_LOGIC
	default y

config BT
	default y

config BOARD_ENABLE_DCDC_APP
	default y

config BOARD_ENABLE_DCDC_NET
	default y

config BOARD_ENABLE_CPUNET
	default y

config ZBUS
	default y

config ZBUS_RUNTIME_OBSERVERS
	default y

config ZBUS_MSG_SUBSCRIBER
	default y

config SENSOR
	default y

config REGULATOR
	default y

config CONTIN_ARRAY
	default y

config NRFX_I2S0
	default y

config PCM_MIX
	default y

config PSCM
	default y

config DATA_FIFO
	default y

# Enable NRFX_CLOCK for ACLK control
config NRFX_CLOCK
	default y

config I2C
	default y

choice LIBC_IMPLEMENTATION
	# NOTE: Since we are not using minimal libc, error codes from
	#       minimal libc are not used
	default NEWLIB_LIBC
endchoice

# Audio codec LC3 related defines
# FPU_SHARING enables preservation of the hardware floating point registers
# across context switches to allow multiple threads to perform concurrent
# floating point operations.
config FPU
	default y

config FPU_SHARING
	default y

# Enable SDHC interface
config DISK_DRIVERS
	default y

config DISK_DRIVER_SDMMC
	default y

# Enable SPI interface
config SPI
	default y

# Enable ADC for board version readback
config ADC
	default y

# Allocate buffer on RAM for transferring chunck of data
# from Flash to SPI
config SPI_NRFX_RAM_BUFFER_SIZE
	default 8

# Config the file system
config FILE_SYSTEM
	default y

config FAT_FILESYSTEM_ELM
	default y

config FS_FATFS_LFN
	default y
choice FS_FATFS_LFN_MODE
	# Using stack for LFN work queue
	default FS_FATFS_LFN_MODE_STACK
endchoice

# exFAT enabled to support longer file names and higher transfer speed
config FS_FATFS_EXFAT
	default y

# Set the maximum file name length to 255
config FS_FATFS_MAX_LFN
	default 255

config WATCHDOG
	default y

config TASK_WDT
	default y
```

## samples/boards/nordic/nrf5340_audio/echo/sample.yaml
```yaml
sample:
  name: nRF5340 Audio echo example
  description: LE Audio implementation converted into echo example
common:
  integration_platforms:
    - nrf5340_audio_dk_nrf5340_cpuapp
tests:
  sample.boards.nordic.nrf5340_audio.echo:
    build_only: true
    platform_allow: nrf5340_audio_dk_nrf5340_cpuapp
    platform_exclude: nrf5340_audio_dk_nrf5340_cpuapp_ns
    tags: ci_build
    extra_args: CONF_FILE="prj.conf"
```

## samples/boards/nordic/nrf5340_audio/echo/src/drivers/Kconfig
```kconfig
#
# Copyright (c) 2022 Nordic Semiconductor ASA
#
# SPDX-License-Identifier: LicenseRef-Nordic-5-Clause
#

menu "Drivers"

#----------------------------------------------------------------------------#
menu "Thread priorities"

config CS47L63_THREAD_PRIO
	int "Priority for CS47L63 thread"
	default 5
	help
	  This is a preemptible thread

endmenu # Thread priorities

#----------------------------------------------------------------------------#
menu "Stack sizes"

config CS47L63_STACK_SIZE
	int "Stack size for CS47L63"
	default 700

endmenu # Stack sizes

#----------------------------------------------------------------------------#
menu "Log levels"

module = CS47L63
module-str = cs47l63
source "subsys/logging/Kconfig.template.log_config"

endmenu # Log levels
endmenu # Drivers
```

## samples/boards/nordic/nrf5340_audio/echo/src/modules/Kconfig
```kconfig
#
# Copyright (c) 2022 Nordic Semiconductor ASA
#
# SPDX-License-Identifier: LicenseRef-Nordic-5-Clause
#

menu "Modules"

config BUTTON_DEBOUNCE_MS
	int "Button debounce time in ms"
	default 50

config AUDIO_SYNC_TIMER_USES_RTC
	bool
	default !BT_LL_ACS_NRF53
	select NRFX_RTC0


menu "I2S"

config I2S_LRCK_FREQ_HZ
	int
	default AUDIO_SAMPLE_RATE_HZ
	help
	 The sample rate of I2S. For now this is tied directly to
	 AUDIO_SAMPLE_RATE_HZ
	 Note that this setting is only valid in I2S master mode.

config I2S_CH_NUM
	int
	default 2
	help
	 The I2S driver itself supports both mono and stereo.
	 Parts of the implementation are configured for only stereo.

endmenu # I2S

#----------------------------------------------------------------------------#
menu "Log levels"

module = MODULE_BUTTON_HANDLER
module-str = module-button-handler
source "subsys/logging/Kconfig.template.log_config"

module = MODULE_HW_CODEC
module-str = module-hw-codec
source "subsys/logging/Kconfig.template.log_config"

module = MODULE_LED
module-str = module-led
source "subsys/logging/Kconfig.template.log_config"

module = MODULE_NRF5340_AUDIO_DK
module-str = module-nrf5340-audio_dk
source "subsys/logging/Kconfig.template.log_config"

endmenu # Log levels

#----------------------------------------------------------------------------#
menu "Thread priorities"

config BUTTON_PUBLISH_THREAD_PRIO
	int "Priority for button publish thread"
	default 5
	help
	  This is a preemptible thread.
	  This thread will publish button events to zbus.

config VOLUME_MSG_SUB_THREAD_PRIO
	int "Priority for volume message subscribe thread"
	default 5
	help
	  This is a preemptible thread.
	  This thread will subscribe to volume events from zbus.

endmenu # Thread priorities

#----------------------------------------------------------------------------#
menu "Stack sizes"

config BUTTON_PUBLISH_STACK_SIZE
	int "Stack size for button publish thread"
	default 450

config VOLUME_MSG_SUB_STACK_SIZE
	int "Stack size for volume message subscribe thread"
	default 768

endmenu # Stack sizes

#----------------------------------------------------------------------------#
menu "Zbus"

config VOLUME_MSG_SUB_QUEUE_SIZE
	int "Queue size for volume message subscriber"
	default 4

endmenu # Zbus

#----------------------------------------------------------------------------#

endmenu # Modules
```

## samples/boards/nordic/nrf5340_audio/echo/src/utils/Kconfig
```kconfig
#
# Copyright (c) 2022 Nordic Semiconductor ASA
#
# SPDX-License-Identifier: LicenseRef-Nordic-5-Clause
#


menu "Utils"

menu "FIFO"

config FIFO_FRAME_SPLIT_NUM
	int "Number of blocks to make up one frame of audio data"
	default 10
	help
	  Easy DMA in I2S requires two buffers to be filled before I2S
	  transmission will begin. In order to reduce latency, an audio
	  frame can be split into multiple blocks with this parameter. USB
	  sends data in 1 ms blocks, so we need the split to match that.
	  Since we set frame size to 10 ms for USB, 10 is selected as
	  FRAME_SPLIT_NUM

config FIFO_TX_FRAME_COUNT
	int "Max number of audio frames in TX slab"
	default 3
	help
	  FIFO_TX is the buffer that holds decoded audio data before it
	  is sent to I2S

config FIFO_RX_FRAME_COUNT
	int "Max number of audio frames in RX slab"
	default 1
	help
	  FIFO_RX is the buffer that holds uncompressed audio data coming
	  from  I2S

endmenu # FIFO

#----------------------------------------------------------------------------#
menu "Log levels"

module = BOARD_VERSION
module-str = board-version
source "subsys/logging/Kconfig.template.log_config"

module = ERROR_HANDLER
module-str = error-handler
source "subsys/logging/Kconfig.template.log_config"

module = FW_INFO
module-str = fw-info
source "subsys/logging/Kconfig.template.log_config"

module = I2S_HANDLER
module-str = i2s-handler
source "subsys/logging/Kconfig.template.log_config"

module = CUSTOM_BTN_HANDLER
module-str = custom-btn-handler
source "subsys/logging/Kconfig.template.log_config"

endmenu # Log levels
endmenu # Utils
```

## samples/boards/nordic/nrf_ironside/secondary_boot_corruption/sample.yaml
```yaml
sample:
  name: Secondary Boot Corruption Sample
  description: |
    Demonstrates secondary image boot after primary image corruption on nRF54H20DK.
    The primary image corrupts protected memory and reboots, triggering the system
    to boot the secondary image instead.

common:
  sysbuild: true
  harness: console
  harness_config:
    type: multi_line
    regex:
      - "=== Hello World from Primary Image ==="
      - "=== Hello World from Secondary Image ==="

tests:
  sample.boards.nordic.nrf_ironside.secondary_boot_corruption:
    tags:
      - sysbuild
      - nrf_ironside
    platform_allow:
      - nrf54h20dk/nrf54h20/cpuapp
    integration_platforms:
      - nrf54h20dk/nrf54h20/cpuapp
```

## samples/boards/nordic/nrf_ironside/update/Kconfig
```kconfig
# Copyright (c) 2025 Nordic Semiconductor ASA
# SPDX-License-Identifier: Apache-2.0

config UPDATE_BLOB_ADDRESS
	hex "Address of the update blob"
	default 0xe100000
	help
	  Address of the update blob. The default value matches the placement of the
	  update blobs delivered with the IRONside SE firmware.

source "Kconfig.zephyr"
```

## samples/boards/nordic/nrf_ironside/update/sample.yaml
```yaml
sample:
  name: Nordic IronSide SE update service
  description: Demonstrates how to update the Nordic IronSide SE firmware
common:
  build_only: true
  tags: nrf_ironside
  integration_platforms:
    - nrf54h20dk/nrf54h20/cpuapp/iron

tests:
  sample.boards.nordic.nrf_ironside.update:
    platform_allow: nrf54h20dk/nrf54h20/cpuapp/iron
```

## samples/boards/nordic/nrf_sys_event/sample.yaml
```yaml
sample:
  name: nRF System events
common:
  harness: console
  harness_config:
    type: one_line
    regex:
      - "constant latency mode disabled"
tests:
  sample.boards.nordic.nrf_sys_event:
    platform_allow:
      - nrf52dk/nrf52810
      - nrf52dk/nrf52832
      - nrf52833dk/nrf52820
      - nrf52833dk/nrf52833
      - nrf52840dk/nrf52811
      - nrf52840dk/nrf52840
      - nrf5340dk/nrf5340/cpuapp
      - nrf5340dk/nrf5340/cpunet
      - nrf54h20dk/nrf54h20/cpuapp
      - nrf54h20dk/nrf54h20/cpurad
      - nrf54l15dk/nrf54l15/cpuapp
      - nrf7120dk/nrf7120/cpuapp
      - ophelia4ev/nrf54l15/cpuapp
    integration_platforms:
      - nrf52840dk/nrf52840
      - nrf5340dk/nrf5340/cpuapp
      - nrf5340dk/nrf5340/cpunet
      - nrf54h20dk/nrf54h20/cpuapp
      - nrf54h20dk/nrf54h20/cpurad
      - nrf54l15dk/nrf54l15/cpuapp
      - nrf7120dk/nrf7120/cpuapp
      - ophelia4ev/nrf54l15/cpuapp
  sample.boards.nordic.nrf_sys_event.force_constlat:
    platform_allow:
      - nrf52dk/nrf52810
      - nrf52dk/nrf52832
      - nrf52833dk/nrf52820
      - nrf52833dk/nrf52833
      - nrf52840dk/nrf52811
      - nrf52840dk/nrf52840
      - nrf5340dk/nrf5340/cpuapp
      - nrf5340dk/nrf5340/cpunet
      - nrf54h20dk/nrf54h20/cpuapp
      - nrf54h20dk/nrf54h20/cpurad
      - nrf54l15dk/nrf54l15/cpuapp
      - nrf7120dk/nrf7120/cpuapp
      - ophelia4ev/nrf54l15/cpuapp
    integration_platforms:
      - nrf52840dk/nrf52840
      - nrf5340dk/nrf5340/cpuapp
      - nrf5340dk/nrf5340/cpunet
      - nrf54h20dk/nrf54h20/cpuapp
      - nrf54h20dk/nrf54h20/cpurad
      - nrf54l15dk/nrf54l15/cpuapp
      - nrf7120dk/nrf7120/cpuapp
      - ophelia4ev/nrf54l15/cpuapp
    extra_configs:
      - CONFIG_SOC_NRF_FORCE_CONSTLAT=y
  sample.boards.nordic.nrf_sys_event.rramc_wakeup:
    harness: pytest
    harness_config:
      pytest_root:
        - "pytest/test_reg_event.py::test_rramc_wakeup"
    extra_configs:
      - CONFIG_NRF_SYS_EVENT_IRQ_LATENCY=y
    platform_allow:
      - nrf54l15dk/nrf54l15/cpuapp
      - nrf54lm20dk/nrf54lm20a/cpuapp
    integration_platforms:
      - nrf54l15dk/nrf54l15/cpuapp
```

## samples/boards/nordic/nrfx/Kconfig
```kconfig
# Copyright (c) 2021 Nordic Semiconductor ASA
# SPDX-License-Identifier: Apache-2.0

source "Kconfig.zephyr"

config NRFX_GPIOTE0
	default y if SOC_SERIES_NRF51 || \
		     SOC_SERIES_NRF52 || \
		     (SOC_SERIES_NRF53 && !TRUSTED_EXECUTION_NONSECURE) || \
		     (SOC_SERIES_NRF91 && !TRUSTED_EXECUTION_NONSECURE)

config NRFX_GPIOTE1
	default y if (SOC_SERIES_NRF53 && TRUSTED_EXECUTION_NONSECURE) || \
		     (SOC_SERIES_NRF91 && TRUSTED_EXECUTION_NONSECURE)
```

## samples/boards/nordic/spis_async/sample.yaml
```yaml
sample:
  name: SPI slave async callback
tests:
  sample.drivers.spis.async:
    tags:
      - drivers
      - spi
    depends_on: spi
    platform_allow:
      - xiao_ble/nrf52840/sense
    integration_platforms:
      - xiao_ble/nrf52840/sense
    harness: console
    harness_config:
      type: one_line
      regex:
        - ".*spis_async: Waiting for SPI master transfer"
```

## samples/boards/nordic/spis_wakeup/Kconfig.sysbuild
```kconfig
# Copyright (c) 2025 Nordic Semiconductor ASA
# SPDX-License-Identifier: Apache-2.0

source "$(ZEPHYR_BASE)/share/sysbuild/Kconfig"

choice REMOTE_NRF54H20_CORE
	prompt "Remote nRF54h20 core"
	default REMOTE_NRF54H20_CPURAD_CORE
	depends on SOC_NRF54H20_CPUAPP

config REMOTE_NRF54H20_CPUPPR_CORE
	bool "ppr core"

config REMOTE_NRF54H20_CPURAD_CORE
	bool "cpurad"

endchoice

config REMOTE_BOARD
	string
	default "$(BOARD)/nrf54h20/cpurad" if SOC_NRF54H20_CPUAPP && REMOTE_NRF54H20_CPURAD_CORE
	default "$(BOARD)/nrf54h20/cpuppr/xip" if SOC_NRF54H20_CPUAPP && REMOTE_NRF54H20_CPUPPR_CORE
```

## samples/boards/nordic/spis_wakeup/boards/nrf54h20dk_nrf54h20_cpuapp.conf
```kconfig
# Copyright (c) 2025 Nordic Semiconductor ASA
# SPDX-License-Identifier: Apache-2.0

CONFIG_SOC_NRF54H20_CPURAD_ENABLE=y
```

## samples/boards/nordic/spis_wakeup/sample.yaml
```yaml
common:
  sysbuild: true
  depends_on: spi
  tags:
    - spi
  harness: console
  harness_config:
    fixture: spi_loopback
    type: multi_line
    ordered: true
    regex:
      - ".*SPIS: waiting for SPI transfer"
      - ".*SPIS: woken up by"

sample:
  name: SPI wakeup sample
tests:
  sample.drivers.spis.wakeup:
    platform_allow:
      - nrf54h20dk/nrf54h20/cpuapp
    integration_platforms:
      - nrf54h20dk/nrf54h20/cpuapp
    extra_args:
      - SB_CONFIG_REMOTE_NRF54H20_CPURAD_CORE=y
      - spis_wakeup_SNIPPET=nordic-rad
  sample.drivers.spis.wakeup.ppr:
    platform_allow:
      - nrf54h20dk/nrf54h20/cpuapp
    integration_platforms:
      - nrf54h20dk/nrf54h20/cpuapp
    extra_args:
      - SB_CONFIG_REMOTE_NRF54H20_CPUPPR_CORE=y
      - spis_wakeup_SNIPPET=nordic-ppr-xip
```

## samples/boards/nordic/system_off/Kconfig
```kconfig
# Copyright (c) 2021 Nordic Semiconductor ASA
# SPDX-License-Identifier: Apache-2.0

mainmenu "Nordic SYSTEM_OFF demo"

config APP_USE_RETAINED_MEM
	bool "Use state retention in system off using retained_mem driver"
	select RETAINED_MEM

config GPIO_WAKEUP_ENABLE
	bool "Use button to wake up device from system off"
	default y
	help
	  Enable system off wakeup from pressing sw0 button.

config GRTC_WAKEUP_ENABLE
	bool "Use GRTC to wake up device from system off"
	help
	  Enable system off wakeup from GRTC.

config LPCOMP_WAKEUP_ENABLE
	bool "Use COMP to wake up device from system off"
	help
	  Enable system off wakeup from analog comparator.

source "Kconfig.zephyr"
```
