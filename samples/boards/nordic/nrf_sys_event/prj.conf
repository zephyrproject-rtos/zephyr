## CMakeLists.txt
```
# Copyright 2024 Nordic Semiconductor ASA
# SPDX-License-Identifier: Apache-2.0

cmake_minimum_required(VERSION 3.28.0)
find_package(Zephyr REQUIRED HINTS $ENV{ZEPHYR_BASE})
project(soc_sys_event)

FILE(GLOB app_sources src/*.c)
target_sources(app PRIVATE ${app_sources})
```

## sample.yaml
```
sample:
  name: nRF System events
common:
  harness: console
  harness_config:
    type: one_line
    regex:
      - "constant latency mode disabled"
tests:
  sample.boards.nordic.nrf_sys_event:
    platform_allow:
      - nrf52dk/nrf52810
      - nrf52dk/nrf52832
      - nrf52833dk/nrf52820
      - nrf52833dk/nrf52833
      - nrf52840dk/nrf52811
      - nrf52840dk/nrf52840
      - nrf5340dk/nrf5340/cpuapp
      - nrf5340dk/nrf5340/cpunet
      - nrf54h20dk/nrf54h20/cpuapp
      - nrf54h20dk/nrf54h20/cpurad
      - nrf54l15dk/nrf54l15/cpuapp
      - ophelia4ev/nrf54l15/cpuapp
    integration_platforms:
      - nrf52840dk/nrf52840
      - nrf5340dk/nrf5340/cpuapp
      - nrf5340dk/nrf5340/cpunet
      - nrf54h20dk/nrf54h20/cpuapp
      - nrf54h20dk/nrf54h20/cpurad
      - nrf54l15dk/nrf54l15/cpuapp
      - ophelia4ev/nrf54l15/cpuapp
  sample.boards.nordic.nrf_sys_event.force_constlat:
    platform_allow:
      - nrf52dk/nrf52810
      - nrf52dk/nrf52832
      - nrf52833dk/nrf52820
      - nrf52833dk/nrf52833
      - nrf52840dk/nrf52811
      - nrf52840dk/nrf52840
      - nrf5340dk/nrf5340/cpuapp
      - nrf5340dk/nrf5340/cpunet
      - nrf54h20dk/nrf54h20/cpuapp
      - nrf54h20dk/nrf54h20/cpurad
      - nrf54l15dk/nrf54l15/cpuapp
      - ophelia4ev/nrf54l15/cpuapp
    integration_platforms:
      - nrf52840dk/nrf52840
      - nrf5340dk/nrf5340/cpuapp
      - nrf5340dk/nrf5340/cpunet
      - nrf54h20dk/nrf54h20/cpuapp
      - nrf54h20dk/nrf54h20/cpurad
      - nrf54l15dk/nrf54l15/cpuapp
      - ophelia4ev/nrf54l15/cpuapp
    extra_configs:
      - CONFIG_SOC_NRF_FORCE_CONSTLAT=y
  sample.boards.nordic.nrf_sys_event.rramc_wakeup:
    harness: pytest
    harness_config:
      pytest_root:
        - "pytest/test_reg_event.py::test_rramc_wakeup"
    extra_configs:
      - CONFIG_NRF_SYS_EVENT_IRQ_LATENCY=y
    platform_allow:
      - nrf54l15dk/nrf54l15/cpuapp
    integration_platforms:
      - nrf54l15dk/nrf54l15/cpuapp
```

## prj.conf
```kconfig
# Copyright 2024 Nordic Semiconductor ASA
# SPDX-License-Identifier: Apache-2.0

CONFIG_NRF_SYS_EVENT=y
CONFIG_COUNTER=y
CONFIG_NRF_SYS_EVENT_IRQ_LATENCY=n
```

## boards/nrf54l15dk_nrf54l15_cpuapp.overlay
```dts
/*
 * Copyright (c) 2025 Nordic Semiconductor ASA
 * SPDX-License-Identifier: Apache-2.0
 */

sample_counter: &timer20 {
	status = "okay";
};
```

## boards/nrf54l15dk_nrf54l15_cpuflpr_xip.overlay
```dts
/*
 * Copyright (c) 2025 Nordic Semiconductor ASA
 * SPDX-License-Identifier: Apache-2.0
 */

#include "nrf54l15dk_nrf54l15_common.dtsi"
```

## boards/nrf7120dk_nrf7120_cpuapp.overlay
```dts
/*
 * Copyright (c) 2026 Nordic Semiconductor ASA
 * SPDX-License-Identifier: Apache-2.0
 */

sample_counter: &timer20 {
	status = "okay";
};
```

## socs/nrf54lm20b_cpuapp.overlay
```dts
/*
 * Copyright (c) 2026 Nordic Semiconductor ASA
 * SPDX-License-Identifier: Apache-2.0
 */

#include "nrf54lm20_cpuapp_common.dtsi"
```

## socs/nrf54lv10a_cpuapp.overlay
```dts
/*
 * Copyright (c) 2026 Nordic Semiconductor ASA
 *
 * SPDX-License-Identifier: Apache-2.0
 */

sample_counter: &timer20 {
	status = "okay";
};
```

## src/main.c
```c
/*
 * Copyright (c) 2024 Nordic Semiconductor ASA
 *
 * SPDX-License-Identifier: Apache-2.0
 */

#include <nrf_sys_event.h>
#include <zephyr/drivers/counter.h>
#include <zephyr/cache.h>
#include <stdio.h>

#ifdef CONFIG_NRF_SYS_EVENT_IRQ_LATENCY
#define ALARM_CH 0
#define TIMEOUT_US 100

enum rramc_mode {
	/* Default mode where RRAMC goes to low power state and had approx.15 us wake up time. */
	RRAMC_DEFAULT,
	/* Using nrf_sys_event API to schedule a PPI wake up before expected interrupt. */
	RRAMC_PPI_WAKEUP,
	/* Using nrf_sys_event API to change the power mode of RRAMC to 0 us wake up time. */
	RRAMC_POWER_MODE,
};

static void counter_handler(const struct device *counter_dev, uint8_t ch_id,
			    uint32_t ticks, void *user_data)
{
	k_sem_give((struct k_sem *)user_data);
}

static uint32_t counter_alarm_execute(const struct device *counter_dev,
				      struct counter_alarm_cfg *alarm_cfg, k_timeout_t timeout)
{
	struct k_sem sem;
	uint32_t now;
	int err;

	k_sem_init(&sem, 0, 1);
	alarm_cfg->user_data = &sem;

	now = k_cycle_get_32();
	err = counter_set_channel_alarm(counter_dev, ALARM_CH, alarm_cfg);
	if (err < 0) {
		printf("Failed to set the counter alarm.\n");
		return 0;
	}
	err = k_sem_take(&sem, timeout);
	if (err < 0) {
		printf("Failed waiting for counter alarm.\n");
		return 0;
	}

	return k_cycle_get_32() - now;
}

static void sys_event_irq_latency_run(enum rramc_mode mode)
{
	const struct device *counter = DEVICE_DT_GET(DT_NODELABEL(sample_counter));
	struct counter_alarm_cfg alarm_cfg;
	uint32_t delay = TIMEOUT_US;
	uint32_t delay_adj = 4;
	uint32_t rpt = 10;
	uint32_t cyc;
	int event_handle;
	const char *mode_str = (mode == RRAMC_DEFAULT) ? "default RRAMC mode" :
		(mode == RRAMC_PPI_WAKEUP) ? "RRAMC waken by PPI" : "RRAMC Standby mode";

	counter_start(counter);
	alarm_cfg.flags = 0;
	alarm_cfg.ticks = counter_us_to_ticks(counter, delay);
	alarm_cfg.callback = counter_handler;

	cyc = 0;
	for (int i = 0; i < rpt; i++) {
		sys_cache_instr_invd_all();
		if (mode != RRAMC_DEFAULT) {
			uint32_t t = (mode == RRAMC_PPI_WAKEUP) ? (delay + delay_adj) : 0;

			event_handle = nrf_sys_event_register(t, true);
			if (mode == RRAMC_PPI_WAKEUP && event_handle == 32) {
				printk("err\n");
			}
		}

		cyc += counter_alarm_execute(counter, &alarm_cfg, K_USEC(delay + 100));
		if (mode != RRAMC_DEFAULT) {
			(void)nrf_sys_event_unregister(event_handle, false);
		}
	}

	cyc /= rpt;
	printf("Alarm set for %d us, execution took:%d (%s)\n", delay, cyc, mode_str);

	counter_stop(counter);
}

static void sys_event_irq_latency(void)
{
	sys_event_irq_latency_run(RRAMC_DEFAULT);
	sys_event_irq_latency_run(RRAMC_POWER_MODE);
	sys_event_irq_latency_run(RRAMC_PPI_WAKEUP);
}
#endif /* CONFIG_NRF_SYS_EVENT_IRQ_LATENCY */

int main(void)
{
	printf("request global constant latency mode\n");
	if (nrf_sys_event_request_global_constlat()) {
		printf("failed to request global constant latency mode\n");
		return 0;
	}
	printf("constant latency mode enabled\n");

	printf("request global constant latency mode again\n");
	if (nrf_sys_event_request_global_constlat()) {
		printf("failed to request global constant latency mode\n");
		return 0;
	}

	printf("release global constant latency mode\n");
	printf("constant latency mode will remain enabled\n");
	if (nrf_sys_event_release_global_constlat()) {
		printf("failed to release global constant latency mode\n");
		return 0;
	}

	printf("release global constant latency mode again\n");
	printf("constant latency mode will be disabled\n");
	if (nrf_sys_event_release_global_constlat()) {
		printf("failed to release global constant latency mode\n");
		return 0;
	}

	printf("constant latency mode disabled\n");

#ifdef CONFIG_NRF_SYS_EVENT_IRQ_LATENCY
	sys_event_irq_latency();

	printf("All done\n");
#endif
	return 0;
}
```
