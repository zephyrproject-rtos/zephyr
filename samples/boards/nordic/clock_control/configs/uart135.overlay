/*
 * Copyright (c) 2024 Nordic Semiconductor ASA
 *
 * SPDX-License-Identifier: Apache-2.0
 */

/ {
	aliases {
		sample-device = &uart135;
	};
};

&uart135 {
	memory-regions = <&cpuapp_dma_region>;
	status = "okay";
};

&fll16m {
	status = "okay";
};
