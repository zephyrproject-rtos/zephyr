## CMakeLists.txt
```
# Copyright (c) 2024 Nordic Semiconductor ASA
# SPDX-License-Identifier: Apache-2.0

cmake_minimum_required(VERSION 3.20.0)
find_package(Zephyr REQUIRED HINTS $ENV{ZEPHYR_BASE})
project(nrf_audiopll)

target_sources(app PRIVATE src/main.c)
```

## sample.yaml
```
# Copyright (c) 2024 Nordic Semiconductor ASA
# SPDX-License-Identifier: Apache-2.0

sample:
  name: AudioPLL clock control sample
common:
  platform_allow:
    - nrf54h20dk/nrf54h20/cpuapp
  harness: console
  harness_config:
    type: one_line
    regex:
      - "sample complete"
tests:
  sample.boards.nrf.audiopll:
```

## prj.conf
```kconfig
# Copyright (c) 2024 Nordic Semiconductor ASA
# SPDX-License-Identifier: Apache-2.0

CONFIG_CLOCK_CONTROL=y
CONFIG_CLOCK_CONTROL_LOG_LEVEL_DBG=y
CONFIG_LOG=y
```

## boards/nrf54h20dk_nrf54h20_cpuapp.overlay
```dts
/*
 * Copyright (c) 2025 Nordic Semiconductor ASA
 *
 * SPDX-License-Identifier: Apache-2.0
 */

&audiopll {
	status = "okay";
	freq-fraction = <0>;
	prescaler-div = <12>;
};
```

## src/main.c
```c
/*
 * Copyright (c) 2025 Nordic Semiconductor ASA
 *
 * SPDX-License-Identifier: Apache-2.0
 */

#include <zephyr/kernel.h>
#include <zephyr/drivers/clock_control.h>
#include <zephyr/drivers/clock_control/nrf_clock_control.h>

#define SAMPLE_AUDIOPLL_NODE DT_NODELABEL(audiopll)

#define SAMPLE_SET_FREQ_VAL            2000
#define SAMPLE_SET_PRESCALER_VAL       NRF_CLOCK_CONTROL_AUDIOPLL_DIV_4
#define SAMPLE_SET_FREQ_INC_INC_VAL    10
#define SAMPLE_SET_FREQ_INC_PERIOD_VAL 100

static const struct device *audiopll = DEVICE_DT_GET(SAMPLE_AUDIOPLL_NODE);

int main(void)
{
	int ret;

	ret = nrf_clock_control_audiopll_set_freq(audiopll, SAMPLE_SET_FREQ_VAL);
	if (ret) {
		printk("failed to set audiopll frequency fraction\n");
		return 0;
	}

	ret = nrf_clock_control_audiopll_set_prescaler(audiopll, SAMPLE_SET_PRESCALER_VAL);
	if (ret) {
		printk("failed to set audiopll prescaler divider\n");
		return 0;
	}

	ret = nrf_clock_control_audiopll_set_freq_inc(audiopll,
						      SAMPLE_SET_FREQ_INC_INC_VAL,
						      SAMPLE_SET_FREQ_INC_PERIOD_VAL);
	if (ret) {
		printk("failed to set audiopll freq inc\n");
		return 0;
	}

	ret = clock_control_on(audiopll, NULL);
	if (ret) {
		printk("failed to turn on audiopll\n");
		return 0;
	}

	k_msleep(1000);

	ret = clock_control_off(audiopll, NULL);
	if (ret) {
		printk("failed to turn off audiopll\n");
		return 0;
	}

	printk("sample complete\n");
	return 0;
}
```
