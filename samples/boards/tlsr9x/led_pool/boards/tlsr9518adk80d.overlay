/*
 * Copyright (c) 2024 Telink Semiconductor
 *
 * SPDX-License-Identifier: Apache-2.0
 */

/ {
	led_pool{
		compatible = "gpio-leds";

		out {
			gpios = <&gpiob 6 GPIO_ACTIVE_HIGH>,
					<&gpiob 4 GPIO_ACTIVE_HIGH>;
		};
	};
};
