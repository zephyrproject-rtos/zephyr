/*
 * Copyright (c) 2025 Telink Semiconductor
 *
 * SPDX-License-Identifier: Apache-2.0
 */

&flash {
	partitions {
		factory_partition: partition@ff000 {
			label = "factory-data";
			reg = <0xff000 0x1000>;
		};
	};
};
