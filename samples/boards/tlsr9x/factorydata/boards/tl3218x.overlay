/*
 * Copyright (c) 2025 Telink Semiconductor
 *
 * SPDX-License-Identifier: Apache-2.0
 */

&flash {
	partitions {
		factory_partition: partition@102000 {
			label = "factory-data";
			reg = <0x102000 0x800>;
		};
	};
};
