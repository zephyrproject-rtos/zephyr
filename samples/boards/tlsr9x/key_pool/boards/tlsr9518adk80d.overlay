/*
 * Copyright (c) 2024 Telink Semiconductor
 *
 * SPDX-License-Identifier: Apache-2.0
 */

/ {
	/* Short TL_Key1 (J20 pin 15) to ground (J50 pin 15-23) */
	key_pool{
		compatible = "gpio-keys";

		inp {
			gpios = <&gpioc 3 (GPIO_ACTIVE_LOW | GPIO_PULL_UP)>,
					<&gpioc 1 (GPIO_ACTIVE_LOW | GPIO_PULL_UP)>;
		};
	};
};
