/*
 * SPDX-License-Identifier: Apache-2.0
 *
 * Copyright (c) 2026 Silicon Laboratories Inc.
 */

/ {
	aliases {
		rtc = &rtc0;
	};
};

&rtc0 {
	status = "okay";
	wakeup-source;
	wakeup-ctrls = <&wuc0 SIWX91X_WUC_RTC_ALARM>;
};
