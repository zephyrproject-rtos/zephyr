## CMakeLists.txt
```
# SPDX-License-Identifier: Apache-2.0

cmake_minimum_required(VERSION 3.20.0)

find_package(Zephyr REQUIRED HINTS $ENV{ZEPHYR_BASE})
project(google_kukui)

FILE(GLOB app_sources src/*.c)
target_sources(app PRIVATE ${app_sources})
```

## sample.yaml
```
sample:
  name: Kukui general features
tests:
  sample.board.google_kukui:
    platform_allow: google_kukui/stm32f098xx
    tags: ec
```

## prj.conf
```kconfig
# Enable all useful shell commands (i.e. those with driver support)
CONFIG_SHELL=y
CONFIG_SHELL_BACKENDS=y
CONFIG_SHELL_BACKEND_SERIAL=y
CONFIG_GPIO_SHELL=y
CONFIG_I2C_SHELL=y
```

## src/main.c
```c
/*
 * Copyright 2020 Google LLC
 *
 * SPDX-License-Identifier: Apache-2.0
 */

#include <zephyr/kernel.h>
#include <zephyr/sys/printk.h>

int main(void)
{
	printk("Welcome to Google Kukui\n");
	return 0;
}
```
