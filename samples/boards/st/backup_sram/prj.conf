## CMakeLists.txt
```
# SPDX-License-Identifier: Apache-2.0

cmake_minimum_required(VERSION 3.28.0)
find_package(Zephyr REQUIRED HINTS $ENV{ZEPHYR_BASE})
project(stm32_backup_sram)

FILE(GLOB app_sources src/*.c)
target_sources(app PRIVATE ${app_sources})
```

## sample.yaml
```
sample:
  description: Usage of backup SRAM on STM32
  name: stm32_backup_sram
tests:
  sample.boards.stm32.backup_sram:
    depends_on: backup_sram
    build_only: true
    filter: dt_compat_enabled("st,stm32-backup-sram")
    vendor_allow:
      - st
    integration_platforms:
      - nucleo_f207zg/stm32f207xx
```

## prj.conf
```kconfig
# SPDX-FileCopyrightText: Copyright The Zephyr Project Contributors
# SPDX-License-Identifier: Apache-2.0

CONFIG_STM32_BACKUP_SRAM=y
```

## boards/b_u585i_iot02a.overlay
```dts
/*
 * SPDX-License-Identifier: Apache-2.0
 *
 * Copyright (c) 2023 STMicroelectronics
 */

&backup_sram {
	status = "okay";
};
```

## boards/nucleo_h563zi.overlay
```dts
/*
 * SPDX-License-Identifier: Apache-2.0
 *
 * Copyright (c) 2024 Thorsten Spätling <thorsten.spaetling@vierling.de>
 */

&backup_sram {
	status = "okay";
};
```

## boards/nucleo_u545re_q.overlay
```dts
/*
 * SPDX-License-Identifier: Apache-2.0
 *
 * Copyright (c) 2026 Smile
 */

&backup_sram {
	status = "okay";
};
```

## boards/stm32n6570_dk_stm32n657xx_sb.overlay
```dts
/*
 * SPDX-License-Identifier: Apache-2.0
 *
 * Copyright (c) 2026 Tobias Meyer <tobias.meyer@hula.earth>
 */

&backup_sram {
	status = "okay";
};
```

## src/main.c
```c
/*
 * Copyright (c) 2021 Teslabs Engineering S.L.
 *
 * SPDX-License-Identifier: Apache-2.0
 */

#include <zephyr/cache.h>
#include <zephyr/device.h>
#include <zephyr/kernel.h>
#include <zephyr/sys/printk.h>

#if DT_HAS_COMPAT_STATUS_OKAY(st_stm32_backup_sram)
#define BACKUP_DEV_COMPAT st_stm32_backup_sram
#endif

#define BACKUP_MAGIC 0x600DCE11

struct backup_store {
	uint32_t value;
	uint32_t magic;
};

/** Value stored in backup SRAM. */
__stm32_backup_sram_section struct backup_store backup;

int main(void)
{
	const struct device *const dev = DEVICE_DT_GET_ONE(BACKUP_DEV_COMPAT);

	if (!device_is_ready(dev)) {
		printk("ERROR: BackUp SRAM device is not ready\n");
		return 0;
	}

	if (backup.magic != BACKUP_MAGIC) {
		backup.magic = BACKUP_MAGIC;
		backup.value = 0;
		printk("Invalid magic in backup SRAM structure - resetting value.\n");
	}

	printk("Current value in backup SRAM (%p): %d\n", &backup.value, backup.value);

	backup.value++;

#if defined(CONFIG_CACHE_MANAGEMENT) && defined(CONFIG_DCACHE)
	int err = sys_cache_data_flush_range(&backup, sizeof(backup));

	if (err != 0) {
		printk("Failed to flush the data cache (err: %d)\n", err);
		return 0;
	}
#endif /* defined(CONFIG_CACHE_MANAGEMENT) && defined(CONFIG_DCACHE) */

	printk("Next reported value should be: %d\n", backup.value);
	printk("Keep VBAT power source and reset the board now!\n");
	return 0;
}
```
