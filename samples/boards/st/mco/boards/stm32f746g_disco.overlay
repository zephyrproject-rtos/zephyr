/* The clock that is output must be enabled. */
&clk_lse {
	status = "okay";
};

&clk_hse {
	status = "okay";
};

/* See reference manual (RM0385):
 *   0b01: LSE oscillator selected
 */
#define MCO1_SEL_LSE 1

&mco1 {
	status = "okay";
	clocks = <&rcc STM32_SRC_LSE MCO1_SEL(MCO1_SEL_LSE)>;
	prescaler = <MCO1_PRE(MCO_PRE_DIV_2)>;
	pinctrl-0 = <&rcc_mco_1_pa8>; /* D10 (CN7) */
	pinctrl-names = "default";
};

/* See reference manual (RM0385):
 *   0b10: HSE oscillator clock selected
 */
#define MCO2_SEL_HSE 2

&mco2 {
	status = "okay";
	clocks = <&rcc STM32_SRC_HSE MCO2_SEL(MCO2_SEL_HSE)>;
	prescaler = <MCO2_PRE(MCO_PRE_DIV_5)>;
	pinctrl-0 = <&rcc_mco_2_pc9>; /* uSD_D1 (CN3 pin 8) */
	pinctrl-names = "default";
};
