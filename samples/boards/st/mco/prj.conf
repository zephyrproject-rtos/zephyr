## CMakeLists.txt
```
# SPDX-License-Identifier: Apache-2.0

cmake_minimum_required(VERSION 3.28.0)
find_package(Zephyr REQUIRED HINTS $ENV{ZEPHYR_BASE})
project(mco)

target_sources(app PRIVATE src/main.c)
```

## sample.yaml
```
sample:
  name: STM32 microcontroller clock output (MCO) example
tests:
  sample.board.stm32.mco:
    build_only: true
    platform_allow:
      - nucleo_c5a3zg
      - nucleo_f411re
      - nucleo_f446ze
      - stm32f746g_disco
      - nucleo_u5a5zj_q
      - nucleo_wba55cg
      - nucleo_wl55jc
      - stm32n6570_dk/stm32n657xx/sb
    integration_platforms:
      - stm32f746g_disco
    tags: board
```

## prj.conf
```kconfig
# SPDX-FileCopyrightText: Copyright The Zephyr Project Contributors
# SPDX-License-Identifier: Apache-2.0

# Empty
```

## boards/nucleo_c5a3zg.overlay
```dts
/*
 * SPDX-License-Identifier: Apache-2.0
 *
 * Copyright (c) 2026 STMicroelectronics
 */

&mco1 {
	clocks = <&rcc STM32_SRC_PSIS MCO1_SEL(MCO1_SEL_PSIS)>;
	prescaler = <MCO1_PRE(MCO_PRE_DIV_2)>;
	pinctrl-0 = <&rcc_mco1_pa8>;
	pinctrl-names = "default";
	status = "okay";
};

&mco2 {
	clocks = <&rcc STM32_SRC_HSE MCO2_SEL(MCO2_SEL_HSE)>;
	prescaler = <MCO2_PRE(MCO_PRE_DIV_8)>;
	pinctrl-0 = <&rcc_mco2_pa9>;
	pinctrl-names = "default";
	status = "okay";
};
```

## boards/nucleo_f072rb.overlay
```dts
/*
 * Copyright (c) 2026 Witekio
 *
 * SPDX-License-Identifier: Apache-2.0
 */

/* The clock that is output must be enabled. */
&clk_lse {
	status = "okay";
};

&mco1 {
	clocks = <&rcc STM32_SRC_LSE MCO1_SEL(MCO_SEL_LSE)>;
	prescaler = <MCO1_PRE(MCO_PRE_DIV_1)>;
	pinctrl-0 = <&rcc_mco_pa8>;
	pinctrl-names = "default";
	status = "okay";
};
```

## boards/nucleo_f411re.overlay
```dts
/*
 * SPDX-FileCopyrightText: Copyright The Zephyr Project Contributors
 * SPDX-License-Identifier: Apache-2.0
 */

/* Enable the PLLI2s and set it as clock source for the MCO2 (with prescaler 5) */

&plli2s {
	div-m = <8>;
	mul-n = <100>;
	div-r = <2>;
	clocks = <&clk_hse>;
	status = "okay";
};

/* Enable HSI as it will be output on MCO pin by this sample */
&clk_hsi {
	status = "okay";
};

/* see RefMan RM0383 */
&mco1 {
	/* Select One of the line below for clock source */
	clocks = <&rcc STM32_SRC_HSI MCO1_SEL(0)>;
	/*	clocks = <&rcc STM32_SRC_LSE MCO1_SEL(1)>; */
	/*	clocks = <&rcc STM32_SRC_HSE MCO1_SEL(2)>; */
	/*	clocks = <&rcc STM32_SRC_PLL_P MCO1_SEL(3)>; */
	prescaler = <MCO1_PRE(MCO_PRE_DIV_2)>;
	pinctrl-0 = <&rcc_mco_1_pa8>;
	pinctrl-names = "default";
	status = "okay";
};

&mco2 {
	clocks = <&rcc STM32_SRC_PLLI2S_R MCO2_SEL(1)>;
	prescaler = <MCO2_PRE(MCO_PRE_DIV_5)>;
	pinctrl-0 = <&rcc_mco_2_pc9>;
	pinctrl-names = "default";
	status = "okay";
};
```

## boards/nucleo_f429zi.overlay
```dts
/*
 * SPDX-FileCopyrightText: Copyright The Zephyr Project Contributors
 * SPDX-License-Identifier: Apache-2.0
 */

/* The clock that is output must be enabled. */
&clk_hse {
	status = "okay";
};

/* See reference manual (RM0090):
 *   0b010: HSE clock selected
 */
#define MCO_SEL_HSE 2

/* See reference manual (RM0090):
 *   0b100: MCO divided by 2
 */
#define MCO_PRE_DIV_2 4

&mco1 {
	clocks = <&rcc STM32_SRC_HSE MCO1_SEL(MCO_SEL_HSE)>;
	prescaler = <MCO1_PRE(MCO_PRE_DIV_2)>;
	pinctrl-0 = <&rcc_mco_1_pa8>;
	pinctrl-names = "default";
	status = "okay";
};

&mco2 {
	clocks = <&rcc STM32_SRC_HSE MCO2_SEL(MCO_SEL_HSE)>;
	prescaler = <MCO2_PRE(MCO_PRE_DIV_2)>;
	pinctrl-0 = <&rcc_mco_2_pc9>;
	pinctrl-names = "default";
	status = "okay";
};
```

## boards/nucleo_f446ze.overlay
```dts
/*
 * SPDX-FileCopyrightText: Copyright The Zephyr Project Contributors
 * SPDX-License-Identifier: Apache-2.0
 */

/* Enable the PLLI2s and set it as clock source for the MCO2 (with prescaler 2) : 25MHz */

&plli2s {
	div-m = <8>;
	mul-n = <100>;
	div-r = <2>;
	clocks = <&clk_hse>;
	status = "okay";
};

/* see RefMan RM0390 */
&mco1 {
	/* Select One of the line below for clock source */
	/*	clocks = <&rcc STM32_SRC_HSI MCO1_SEL(0)>; */
	/*	clocks = <&rcc STM32_SRC_LSE MCO1_SEL(1)>; */
	clocks = <&rcc STM32_SRC_HSE MCO1_SEL(2)>;
	/*	clocks = <&rcc STM32_SRC_PLL_P MCO1_SEL(3)>;*/
	prescaler = <MCO1_PRE(MCO_PRE_DIV_1)>;
	pinctrl-0 = <&rcc_mco_1_pa8>;
	pinctrl-names = "default";
	status = "okay";
};

&mco2 {
	clocks = <&rcc STM32_SRC_PLLI2S_R MCO2_SEL(1)>;
	prescaler = <MCO2_PRE(MCO_PRE_DIV_2)>;
	pinctrl-0 = <&rcc_mco_2_pc9>;
	pinctrl-names = "default";
	status = "okay";
};
```

## boards/nucleo_g0b1re.overlay
```dts
/*
 * SPDX-FileCopyrightText: Copyright The Zephyr Project Contributors
 * SPDX-License-Identifier: Apache-2.0
 */

&mco1 {
	status = "okay";
	clocks = <&rcc STM32_SRC_LSI MCO1_SEL(MCO_SEL_LSI)>;
	prescaler = <MCO1_PRE(MCO_PRE_DIV_1)>;
	pinctrl-0 = <&rcc_mco_pa8>;
	pinctrl-names = "default";
};

&mco2 {
	status = "okay";
	clocks = <&rcc STM32_SRC_HSI MCO2_SEL(MCO_SEL_HSI16)>;
	prescaler = <MCO2_PRE(MCO_PRE_DIV_16)>;
	pinctrl-0 = <&rcc_mco_2_pa15>;
	pinctrl-names = "default";
};
```

## src/main.c
```c
/*
 * Copyright (c) 2024 Joakim Andersson
 *
 * SPDX-License-Identifier: Apache-2.0
 */

#include <zephyr/kernel.h>
#include <zephyr/drivers/pinctrl.h>

int main(void)
{

	/* This sample demonstrates MCO usage via Device Tree.
	 * MCO configuration is performed in the Device Tree overlay files.
	 * Each MCO will be enabled automatically by the driver during device
	 * initialization. This sample checks that all MCOs are ready - if so,
	 * the selected clock should be visible on the chosen GPIO pin.
	 */

#if DT_NODE_HAS_STATUS_OKAY(DT_NODELABEL(mco1))
	const struct device *dev1;

	dev1 = DEVICE_DT_GET(DT_NODELABEL(mco1));
	if (device_is_ready(dev1)) {
		printk("MCO1 device successfully configured\n");
	} else {
		printk("MCO1 device not ready\n");
		return -1;
	}
#endif /* mco1 */

#if DT_NODE_HAS_STATUS_OKAY(DT_NODELABEL(mco2))
	const struct device *dev2;

	dev2 = DEVICE_DT_GET(DT_NODELABEL(mco2));
	if (device_is_ready(dev2)) {
		printk("MCO2 device successfully configured\n");
	} else {
		printk("MCO2 device not ready\n");
		return -1;
	}
#endif /* mco2 */

	printk("\nDisplayed the status of all MCO devices - end of example.\n");
	return 0;
}
```
