## CMakeLists.txt
```
# SPDX-License-Identifier: Apache-2.0

cmake_minimum_required(VERSION 3.28.0)
find_package(Zephyr REQUIRED HINTS $ENV{ZEPHYR_BASE})
project(i2c_timing)

FILE(GLOB app_sources src/*.c)
target_sources(app PRIVATE ${app_sources})
```

## sample.yaml
```
sample:
  name: STM32 I2C V2 timing
tests:
  sample.boards.stm32.i2c_timing:
    depends_on: i2c
    tags:
      - drivers
      - i2c
    filter: dt_compat_enabled("st,stm32-i2c-v2")
    platform_allow:
      - nucleo_l476rg
      - nucleo_wb55rg
    harness: console
    harness_config:
      type: one_line
      regex:
        - "I2C freq. I2C_BITRATE_*"
```

## prj.conf
```kconfig
# SPDX-FileCopyrightText: Copyright The Zephyr Project Contributors
# SPDX-License-Identifier: Apache-2.0

CONFIG_I2C=y
CONFIG_I2C_STM32_V2_TIMING=y
CONFIG_LOG=y
CONFIG_I2C_LOG_LEVEL_INF=y
```

## boards/nucleo_l476rg.overlay
```dts
/*
 * SPDX-FileCopyrightText: Copyright The Zephyr Project Contributors
 * SPDX-License-Identifier: Apache-2.0
 */

/ {
	aliases {
		i2c-0 = &i2c1;
	};
};

&i2c1 {
	/delete-property/ clock-frequency;
	clock-frequency = <I2C_BITRATE_FAST>;
};
```

## boards/nucleo_wb55rg.overlay
```dts
/ {
	aliases {
		i2c-0 = &i2c1;
	};
};

&i2c1 {
	/delete-property/ clock-frequency;
	clock-frequency = <I2C_BITRATE_FAST>;
};
```

## src/main.c
```c
/*
 * Copyright (c) 2023 STMicroelectronics
 *
 * SPDX-License-Identifier: Apache-2.0
 */



#include <zephyr/drivers/i2c.h>
#include <zephyr/kernel.h>


#if DT_NODE_HAS_STATUS_OKAY(DT_ALIAS(i2c_0))
#define I2C_DEV_NODE	DT_ALIAS(i2c_0)
#else
#error "Please set the correct I2C device"
#endif

int main(void)
{
	const struct device *const i2c_dev = DEVICE_DT_GET(I2C_DEV_NODE);
	uint32_t i2c_cfg;

	if (!device_is_ready(i2c_dev)) {
		printk("I2C device is not ready\n");
		return -1;
	}

	/* Verify i2c_get_config() */
	if (i2c_get_config(i2c_dev, (uint32_t *)&i2c_cfg)) {
		printk("I2C get_config failed\n");
		return -1;
	}

	/* I2C BIT RATE */
	printk("\nI2C freq.");

	if ((I2C_SPEED_GET(i2c_cfg) == 1) &&
		(DT_PROP(I2C_DEV_NODE, clock_frequency) == 100000)) {
		printk(" I2C_BITRATE_STANDARD\n");
	} else if ((I2C_SPEED_GET(i2c_cfg) == 2) &&
		(DT_PROP(I2C_DEV_NODE, clock_frequency) == 400000)) {
		printk(" I2C_BITRATE_FAST\n");
	} else if ((I2C_SPEED_GET(i2c_cfg) == 3) &&
		(DT_PROP(I2C_DEV_NODE, clock_frequency) == 1000000)) {
		printk(" I2C_SPEED_FAST_PLUS\n");
	} else {
		printk(" I2C speed mismatch (%d)\n", I2C_SPEED_GET(i2c_cfg));
	}

	return 0;
}
```
