## CMakeLists.txt
```
# SPDX-License-Identifier: Apache-2.0

cmake_minimum_required(VERSION 3.28.0)

find_package(Zephyr REQUIRED HINTS $ENV{ZEPHYR_BASE})
project(circular_dma)

target_sources(app PRIVATE src/main.c)
```

## sample.yaml
```
sample:
  name: UART driver sample
tests:
  sample.boards.stm32.uart.circular_dma:
    integration_platforms:
      - nucleo_g071rb
    tags:
      - serial
      - uart
    filter: dt_chosen_enabled("zephyr,shell-uart") and CONFIG_SOC_FAMILY_STM32
    harness: keyboard
```

## prj.conf
```kconfig
# SPDX-FileCopyrightText: Copyright The Zephyr Project Contributors
# SPDX-License-Identifier: Apache-2.0

CONFIG_SERIAL=y
CONFIG_UART_ASYNC_API=y
CONFIG_RING_BUFFER=y
```

## boards/nucleo_c031c6.overlay
```dts
/*
 * Copyright (c) 2024 STMicroelectronics
 *
 * SPDX-License-Identifier: Apache-2.0
 */

&usart2 {
	dmas = <&dmamux1 53 STM32_DMA_PERIPH_TX>,
	       <&dmamux1 52 (STM32_DMA_PERIPH_RX | STM32_DMA_MEM_8BITS | STM32_DMA_MODE_CYCLIC)>;
	dma-names = "tx", "rx";
	fifo-enable;
};

&dma1 {
	status = "okay";
};

&dmamux1 {
	status = "okay";
};
```

## boards/nucleo_f091rc.overlay
```dts
/*
 * Copyright (c) 2024 STMicroelectronics
 *
 * SPDX-License-Identifier: Apache-2.0
 */

&usart2 {
	dmas = <&dma1 4 STM32_DMA_PERIPH_TX>,
	       <&dma1 5 (STM32_DMA_PERIPH_RX | STM32_DMA_MEM_8BITS | STM32_DMA_MODE_CYCLIC)>;
	dma-names = "tx", "rx";
	fifo-enable;
};

&dma1 {
	status = "okay";
};
```

## boards/nucleo_f401re.overlay
```dts
/*
 * SPDX-FileCopyrightText: Copyright The Zephyr Project Contributors
 *
 * SPDX-License-Identifier: Apache-2.0
 */

&usart2 {
	dmas = <&dma1 6 4 STM32_DMA_PERIPH_TX STM32_DMA_FIFO_FULL>,
	       <&dma1 5 4 (STM32_DMA_PERIPH_RX | STM32_DMA_MODE_CYCLIC | STM32_DMA_MEM_8BITS)
		STM32_DMA_FIFO_FULL>;
	dma-names = "tx", "rx";
};

&dma1 {
	status = "okay";
};
```

## boards/nucleo_g071rb.overlay
```dts
/*
 * Copyright (c) 2024 STMicroelectronics
 *
 * SPDX-License-Identifier: Apache-2.0
 */

&usart2 {
	dmas = <&dmamux1 0 53 STM32_DMA_PERIPH_TX>,
	       <&dmamux1 3 52 (STM32_DMA_PERIPH_RX | STM32_DMA_MEM_8BITS | STM32_DMA_MODE_CYCLIC)>;
	dma-names = "tx", "rx";
	fifo-enable;
};

&dma1 {
	status = "okay";
};

&dmamux1 {
	status = "okay";
};
```

## boards/nucleo_u575zi_q.overlay
```dts
/*
 * Copyright (c) 2025 STMicroelectronics
 *
 * SPDX-License-Identifier: Apache-2.0
 */

&usart1 {
	dmas = <&gpdma1 25 STM32_DMA_PERIPH_TX>,
	       <&gpdma1 24 (STM32_DMA_MODE_CYCLIC | STM32_DMA_PERIPH_RX | STM32_DMA_MEM_8BITS)>;
	dma-names = "tx", "rx";
	fifo-enable;
};

&gpdma1 {
	status = "okay";
};
```

## boards/nucleo_wba55cg.overlay
```dts
/*
 * Copyright (c) 2025 STMicroelectronics
 *
 * SPDX-License-Identifier: Apache-2.0
 */

&usart1 {
	dmas = <&gpdma1 12 STM32_DMA_PERIPH_TX>,
	       <&gpdma1 11 (STM32_DMA_MODE_CYCLIC | STM32_DMA_PERIPH_RX | STM32_DMA_MEM_8BITS)>;
	dma-names = "tx", "rx";
	fifo-enable;
};

&gpdma1 {
	status = "okay";
};
```

## src/main.c
```c
/*
 * Copyright (c) 2024 STMicroelectronics
 *
 * SPDX-License-Identifier: Apache-2.0
 */

#include <zephyr/kernel.h>
#include <zephyr/device.h>
#include <zephyr/devicetree.h>
#include <zephyr/drivers/uart.h>
#include <zephyr/sys/ring_buffer.h>
#include <zephyr/sys/printk.h>
#include <string.h>

#define RING_BUF_SIZE 1000
#define RX_BUF_SIZE   10

#define RECEIVE_TIMEOUT 0

#define STACK_SIZE 1024

#define UART_DEVICE_NODE DT_CHOSEN(zephyr_shell_uart)

static const struct device *const uart_dev = DEVICE_DT_GET(UART_DEVICE_NODE);

/* uart configuration structure */
const struct uart_config uart_cfg = {.baudrate = DT_PROP(UART_DEVICE_NODE, current_speed),
				     .parity = UART_CFG_PARITY_NONE,
				     .stop_bits = UART_CFG_STOP_BITS_1,
				     .data_bits = UART_CFG_DATA_BITS_8,
				     .flow_ctrl = UART_CFG_FLOW_CTRL_NONE};

/* define a ring buffer to get raw bytes*/
RING_BUF_DECLARE(ring_buf, RING_BUF_SIZE);

/* define uart rx buffer */
static uint8_t rx_buffer[RX_BUF_SIZE];

/* define thread  stack size */
static K_THREAD_STACK_DEFINE(uart_rx_stack, STACK_SIZE);

/* struct uart_event async_evt */
static struct k_thread uart_rx_thread_data = {0};

void print_uart(char *buf, int len)
{
	for (int i = 0; i < len; i++) {

		if ((buf[i] == '\n' || buf[i] == '\r')) {
			uart_poll_out(uart_dev, '\n');
		} else {
			uart_poll_out(uart_dev, buf[i]);
		}
	}
}

/* Data processing thread */
static void uart_rx_thread(void *p1, void *p2, void *p3)
{
	uint8_t rx_data[RX_BUF_SIZE];
	size_t len;

	while (1) {

		/* Check if there's data in the ring buffer */
		len = ring_buf_get(&ring_buf, rx_data, sizeof(rx_data));

		if (len > 0) {

			/* Process `len` bytes of data */
			print_uart(rx_data, len);
		}
	}
}

void uart_cb(const struct device *dev, struct uart_event *evt, void *user_data)
{
	switch (evt->type) {
	case UART_RX_RDY:
		/* Data received; place into ring buffer */
		ring_buf_put(&ring_buf, evt->data.rx.buf + evt->data.rx.offset, evt->data.rx.len);

		break;

	case UART_RX_DISABLED:
		/* Re-enable RX */
		uart_rx_enable(uart_dev, rx_buffer, sizeof(rx_buffer), RECEIVE_TIMEOUT);

		break;

	default:
		break;
	}
}

int main(void)
{
	if (!device_is_ready(uart_dev)) {
		printk("UART device not ready\n");
		return -ENODEV;
	}

	/* uart configuration parameters */
	int err = uart_configure(uart_dev, &uart_cfg);

	if (err == -ENOSYS) {
		printk("Configuration is not supported by device or driver,"
			" check the UART settings configuration\n");
		return -ENOSYS;
	}

	/* Configure uart callback */
	err = uart_callback_set(uart_dev, uart_cb, NULL);
	if (err < 0) {
		printk("Failed to set UART callback: %d\n", err);
		return err;
	}

	/* enable uart reception */
	err = uart_rx_enable(uart_dev, rx_buffer, sizeof(rx_buffer), RECEIVE_TIMEOUT);
	if (err < 0) {
		printk("Failed to enable UART reception: %d\n", err);
		return err;
	}

	printk("\n Enter message to fill RX buffer size :\n");

	/* start uart data processing thread */
	k_tid_t tid = k_thread_create(&uart_rx_thread_data, uart_rx_stack,
				      K_THREAD_STACK_SIZEOF(uart_rx_stack), uart_rx_thread, NULL,
				      NULL, NULL, 5, 0, K_NO_WAIT);
	k_thread_name_set(tid, "RX_thread");
}
```
