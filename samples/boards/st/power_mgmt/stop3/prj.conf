## CMakeLists.txt
```
# SPDX-License-Identifier: Apache-2.0

cmake_minimum_required(VERSION 3.28.0)
find_package(Zephyr REQUIRED HINTS $ENV{ZEPHYR_BASE})
project(stm32_pm_stop3)

target_sources(app PRIVATE src/main.c)
```

## sample.yaml
```
sample:
  name: STM32 STOP3 Power Management
tests:
  sample.boards.stm32.power_mgmt.stop3:
    tags:
      - LED
      - power
    harness: console
    platform_allow: nucleo_u575zi_q
    harness_config:
      type: one_line
      regex:
        - "Device ready"
    extra_args: "CONFIG_DEBUG=y"
```

## prj.conf
```kconfig
# SPDX-FileCopyrightText: Copyright The Zephyr Project Contributors
# SPDX-License-Identifier: Apache-2.0

CONFIG_PM=y
CONFIG_PM_DEVICE=y
CONFIG_PM_DEVICE_RUNTIME=y
CONFIG_PM_DEVICE_SYSTEM_MANAGED=y
CONFIG_ASSERT=y
CONFIG_GPIO=y
```

## boards/nucleo_u385rg_q.overlay
```dts
/*
 * SPDX-License-Identifier: Apache-2.0
 *
 * Copyright (c) 2026 STMicroelectronics
 */

/ {
	chosen {
		st,lptim-stdby-timer = &rtc;
	};
};

&cpu0 {
	cpu-power-states = <&stop0 &stop1 &stop2 &stop3>;
};

&rtc {
	prescaler = <32768>;
	status = "okay";
};
```

## boards/nucleo_u575zi_q.overlay
```dts
/*
 * SPDX-License-Identifier: Apache-2.0
 *
 * Copyright (c) 2024 STMicroelectronics
 */

/ {
	chosen {
		st,lptim-stdby-timer = &rtc;
	};
};

&cpu0 {
	cpu-power-states = <&stop0 &stop1 &stop2 &stop3>;
};

&rtc {
	clocks = <&rcc STM32_CLOCK_BUS_APB3 0x00200000>,
		 <&rcc STM32_SRC_LSI RTC_SEL(2)>;
	prescaler = <32768>;
	status = "okay";
};
```

## src/main.c
```c
/*
 * Copyright (c) 2024 STMicroelectronics
 *
 * SPDX-License-Identifier: Apache-2.0
 */

#include <zephyr/kernel.h>
#include <zephyr/device.h>
#include <zephyr/devicetree.h>
#include <zephyr/drivers/gpio.h>
#include <zephyr/sys/printk.h>
#include <stm32_ll_pwr.h>
#include <stm32_gpio_shared.h>

#define SLEEP_TIME_MS   2000

static const struct gpio_dt_spec led =
	GPIO_DT_SPEC_GET(DT_ALIAS(led0), gpios);

int main(void)
{
	bool led_is_on = true;

	/* Compute GPIO port to be passed to LL_PWR_EnableGPIOPullUp etc. */
	const struct gpio_stm32_config *cfg = led.port->config;
	uint32_t pwr_port = ((uint32_t)LL_PWR_GPIO_PORTA) + (cfg->port * 8);

	__ASSERT_NO_MSG(gpio_is_ready_dt(&led));

	printk("Device ready\n");
	gpio_pin_configure_dt(&led, GPIO_OUTPUT_ACTIVE);

	/* Enable the pull-up/pull-down feature globally.
	 * User can decide to not use this feature to further reduce power consumption
	 *
	 * This configuration is active only in STOP3 mode, so no need to disable it
	 * during wake up
	 */
	LL_PWR_EnablePUPDConfig();

	while (true) {
		gpio_pin_set(led.port, led.pin, (int)led_is_on);
		/* In STOP3, GPIOs are disabled. Only pull-up/pull-down can be enabled.
		 * So we enable pull-up/pull-down based on LED status
		 */
		if (led_is_on) {
			LL_PWR_DisableGPIOPullDown(pwr_port, (1 << led.pin));
			LL_PWR_EnableGPIOPullUp(pwr_port, (1 << led.pin));
		} else {
			LL_PWR_DisableGPIOPullUp(pwr_port, (1 << led.pin));
			LL_PWR_EnableGPIOPullDown(pwr_port, (1 << led.pin));
		}

		k_msleep(SLEEP_TIME_MS);
		led_is_on = !led_is_on;
	}
	return 0;
}
```
