## CMakeLists.txt
```
# SPDX-License-Identifier: Apache-2.0

cmake_minimum_required(VERSION 3.28.0)
find_package(Zephyr REQUIRED HINTS $ENV{ZEPHYR_BASE})
project(stm32_pm_blinky)

target_sources(app PRIVATE src/main.c)
```

## sample.yaml
```
sample:
  name: STM32 GPIO Power Management
tests:
  sample.boards.stm32.power_mgmt.blinky:
    tags:
      - LED
      - power
    harness: console
    harness_config:
      type: one_line
      regex:
        - "Device ready"
    filter: dt_compat_enabled("zephyr,power-state") and
            dt_enabled_alias_with_parent_compat("led0", "gpio-leds") and
            (dt_compat_enabled("st,stm32-lptim") or
            dt_chosen_enabled("zephyr,system-timer-companion"))
    extra_args: "CONFIG_DEBUG=y"
    integration_platforms:
      - nucleo_wb55rg
      - nucleo_f429zi
      - nucleo_c071rb
```

## prj.conf
```kconfig
# SPDX-FileCopyrightText: Copyright The Zephyr Project Contributors
# SPDX-License-Identifier: Apache-2.0

CONFIG_PM=y
CONFIG_PM_DEVICE=y
CONFIG_PM_DEVICE_RUNTIME=y
CONFIG_PM_DEVICE_SYSTEM_MANAGED=y
CONFIG_ASSERT=y
CONFIG_GPIO=y

# un-comment to allow debugging while in low-power mode
# (inhibits reduced power consumption from being observed)
#CONFIG_DEBUG=y
```

## boards/nucleo_f429zi.conf
```kconfig
# SPDX-FileCopyrightText: Copyright The Zephyr Project Contributors
# SPDX-License-Identifier: Apache-2.0

# Increase IDLE stack for the IDLE timer
CONFIG_IDLE_STACK_SIZE=640
```

## boards/stm32l562e_dk.conf
```kconfig
# SPDX-FileCopyrightText: Copyright The Zephyr Project Contributors
# SPDX-License-Identifier: Apache-2.0

# Disable DEBUG in order to enter core low power states.
# WARNING: requires to erase the device (using STM32CubeProgrammer for instance)
# for next flashing actions
CONFIG_DEBUG=y
```

## boards/arduino_uno_q.overlay
```dts
/*
 * SPDX-FileCopyrightText: Copyright The Zephyr Project Contributors
 * SPDX-License-Identifier: Apache-2.0
 */

&stm32_lp_tick_source {
	/*
	 * Default LPTIM period is 2 seconds. This means that application will
	 * be woken up every 2 seconds to reload its counter.
	 * This behavior can be tuned in 2 ways:
	 *
	 * A] Extend the default period by setting a prescaler.
	 *    New period = 2sec * st,prescaler
	 *    Check the lptim bindings to see the impact on CONFIG_SYS_CLOCK_TICKS_PER_SEC
	 *    and LPTIM precision.
	 * B] Provide the LPTIM timeout definition.
	 *    In this case New period = st,timeout
	 *    Then st,prescaler should be defined with the following constraint:
	 *    st,timeout < st,prescaler * 2
	 */

	/* The following setting will define LPTIM period as 32 sec */
	st,prescaler = <16>;

	/* Uncomment this line to have LPTIM period of 5 seconds */
	/* st,timeout = <5>; */
};
```

## boards/b_u585i_iot02a.overlay
```dts
/*
 * SPDX-FileCopyrightText: Copyright The Zephyr Project Contributors
 * SPDX-License-Identifier: Apache-2.0
 */

&lptim1 {
	/*
	 * Default LPTIM period is 2 seconds. This means that application will
	 * be woken up every 2 seconds to reload its counter.
	 * This behavior can be tuned in 2 ways:
	 *
	 * A] Extend the default period by setting a prescaler.
	 *    New period = 2sec * st,prescaler
	 *    Check the lptim bindings to see the impact on CONFIG_SYS_CLOCK_TICKS_PER_SEC
	 *    and LPTIM precision.
	 * B] Provide the LPTIM timeout definition.
	 *    In this case New period = st,timeout
	 *    Then st,prescaler should be defined with the following constraint:
	 *    st,timeout < st,prescaler * 2
	 */

	/* The following setting will define LPTIM period as 32 sec */
	st,prescaler = <16>;

	/* Uncomment this line to have LPTIM period of 5 seconds */
	/* st,timeout = <5>; */
};
```

## boards/nucleo_h753zi.overlay
```dts
/*
 * Copyright (c) 2026 Google LLC
 *
 * SPDX-License-Identifier: Apache-2.0
 */

/ {
	chosen {
		zephyr,system-timer = &lptim1;
	};
};

&lptim1 {
	/*
	 * To use LPTIM1 as system timer, two clock sources need to be provided:
	 *   APB1 bus clock that powers the register interface of LPTIM1,
	 *   LSI that powers the timer's counter.
	 */
	clocks = <&rcc STM32_CLOCK(APB1, 9)>,
		 <&rcc STM32_SRC_LSI LPTIM1_SEL(4)>;
	st,prescaler = <1>;
	status = "okay";
};
```

## boards/nucleo_wb55rg.overlay
```dts
/*
 * SPDX-FileCopyrightText: Copyright The Zephyr Project Contributors
 * SPDX-License-Identifier: Apache-2.0
 */

&lptim1 {
	/*
	 * Default LPTIM period is 2 seconds. This means that application will
	 * be woken up every 2 seconds to reload its counter.
	 * This behavior can be tuned in 2 ways:
	 *
	 * A] Extend the default period by setting a prescaler.
	 *    New period = 2sec * st,prescaler
	 *    Check the lptim bindings to see the impact on CONFIG_SYS_CLOCK_TICKS_PER_SEC
	 *    and LPTIM precision.
	 * B] Provide the LPTIM timeout definition.
	 *    In this case New period = st,timeout
	 *    Then st,prescaler should be defined with the following constraint:
	 *    st,timeout < st,prescaler * 2
	 */

	/* The following setting will define LPTIM period as 8 sec */
	st,prescaler = <4>;

	/* Uncomment this line to have LPTIM period of 5 seconds */
	/* st,timeout = <5>; */
};
```

## boards/nucleo_wba55cg.overlay
```dts
/*
 * SPDX-FileCopyrightText: Copyright The Zephyr Project Contributors
 * SPDX-License-Identifier: Apache-2.0
 */

&stm32_lp_tick_source {
	/*
	 * Default LPTIM period is 2 seconds. This means that application will
	 * be woken up every 2 seconds to reload its counter.
	 * This behavior can be tuned in 2 ways:
	 *
	 * A] Extend the default period by setting a prescaler.
	 *    New period = 2sec * st,prescaler
	 *    Check the lptim bindings to see the impact on CONFIG_SYS_CLOCK_TICKS_PER_SEC
	 *    and LPTIM precision.
	 * B] Provide the LPTIM timeout definition.
	 *    In this case New period = st,timeout
	 *    Then st,prescaler should be defined with the following constraint:
	 *    st,timeout < st,prescaler * 2
	 */

	/* The following setting will define LPTIM period as 8 sec */
	st,prescaler = <4>;

	/* This line defines a LPTIM period of 5 seconds */
	st,timeout = <5>;
};
```

## src/main.c
```c
/*
 * Copyright (c) 2021 Linaro Limited
 *
 * SPDX-License-Identifier: Apache-2.0
 */

#include <zephyr/kernel.h>
#include <zephyr/device.h>
#include <zephyr/devicetree.h>
#include <zephyr/drivers/gpio.h>
#include <zephyr/sys/clock.h>
#include <zephyr/sys/printk.h>
#include <zephyr/pm/device_runtime.h>

#if DT_NODE_HAS_PROP(DT_CHOSEN(zephyr_system_timer), st_timeout)
/* st,timeout is set. Application can be woken up exactly on expected tick */
#define SLEEP_TIME_MS   (DT_PROP(DT_CHOSEN(zephyr_system_timer), st_timeout) * 1000)
#else
#define SLEEP_TIME_MS   2000
#endif

#define STM32_GPIO_PM_ENABLE(node_id) \
	pm_device_runtime_enable(DEVICE_DT_GET(node_id));

static const struct gpio_dt_spec led =
	GPIO_DT_SPEC_GET(DT_ALIAS(led0), gpios);

int main(void)
{
	bool led_is_on = true;

	__ASSERT_NO_MSG(gpio_is_ready_dt(&led));

	/* Enable device runtime PM on each GPIO port.
	 * GPIO configuration is lost but it may result in lower power consumption.
	 */
	DT_FOREACH_STATUS_OKAY(st_stm32_gpio, STM32_GPIO_PM_ENABLE)

	printk("Blinking every %u seconds\n", SLEEP_TIME_MS / MSEC_PER_SEC);

	while (true) {
		gpio_pin_configure_dt(&led, GPIO_OUTPUT_ACTIVE);
		gpio_pin_set(led.port, led.pin, (int)led_is_on);
		if (led_is_on == false) {
			/* Release resource to release device clock */
			gpio_pin_configure(led.port, led.pin, GPIO_DISCONNECTED);
		}
		k_msleep(SLEEP_TIME_MS);
		if (led_is_on == true) {
			/* Release resource to release device clock */
			gpio_pin_configure(led.port, led.pin, GPIO_DISCONNECTED);
		}
		led_is_on = !led_is_on;
	}
	return 0;
}
```
