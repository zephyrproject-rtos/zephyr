## samples/boards/st/pwm/breathing_led_dma/sample.yaml
```yaml
sample:
  name: PWM with DMA sample
tests:
  sample.boards.stm32.uart.circular_dma:
    integration_platforms:
      - nucleo_f412zg
    tags:
      - pwm
      - dma
    filter: dt_chosen_enabled("zephyr,shell-uart") and CONFIG_SOC_FAMILY_STM32
    harness: keyboard
```

## samples/boards/st/pwm/mastermode/Kconfig
```kconfig
# Copyright (c) 2025 Matthias Plöger <matze.ploeger@gmx.de>
# SPDX-License-Identifier: Apache-2.0

menu "Zephyr"
source "Kconfig.zephyr"
endmenu

module = MAIN
module-str = MAIN
source "subsys/logging/Kconfig.template.log_config"
```

## samples/boards/st/pwm/mastermode/sample.yaml
```yaml
sample:
  name: STM32 pwm mastermode
tests:
  sample.boards.stm32.pwm.mastermode:
    depends_on: pwm
    tags:
      - drivers
      - pwm
    filter: dt_compat_enabled("st,stm32-timers")
    platform_allow:
      - nucleo_g070rb
      - nucleo_g071rb
    harness: console
    harness_config:
      type: one_line
      regex:
        - "TRGO event will be generated every.*"
```

## samples/boards/st/sensortile_box_pro/sensors-on-board/sample.yaml
```yaml
sample:
  description: SensorTile.box Pro board testing
  name: SensorTile.box Pro test
tests:
  sample.board.sensortile_box_pro.sensors-on-board:
    harness: sensor
    platform_allow: sensortile_box_pro
    tags: sensors
    depends_on:
      - i2c
      - spi
      - gpio
```

## samples/boards/st/spi_master/sample.yaml
```yaml
# SPDX-License-Identifier: Apache-2.0

sample:
  name: SPI Master with DMA
  description: |
    Demonstrates SPI master communication with DMA support on STM32 boards.
    Continuously sends messages to an SPI slave and displays the responses.

tests:
  sample.boards.st.spi_master:
    harness: console
    platform_allow:
      - nucleo_l4r5zi
    tags:
      - spi
      - stm32
      - dma
      - gpio
    vendor_allow:
      - st
    integration_platforms:
      - nucleo_l4r5zi
    harness_config:
      type: multi_line
      ordered: true
      regex:
        - "SPI Master Sample"
        - "SPI device ready"
        - "Starting SPI communication loop"
        - "TX string:"
```

## samples/boards/st/steval_stwinbx1/sensors/sample.yaml
```yaml
sample:
  description: STWIN.box board testing
  name: STWIN.box board test
tests:
  sample.board.steval_stwinbx1.sensors:
    harness: sensor
    platform_allow: steval_stwinbx1
    tags: sensors
    depends_on:
      - i2c
      - spi
      - gpio
```

## samples/boards/st/stm32_syscfg_itline/Kconfig
```kconfig
# Private config options for STM32 SYSCFG itline sample app

# Copyright (c) 2024 Etienne Raquin
# SPDX-License-Identifier: Apache-2.0

mainmenu "STM32 SYSCFG itline sample application"

config NUM_IRQS
	default 44

config NUM_2ND_LEVEL_AGGREGATORS
	default 4

config MAX_IRQ_PER_AGGREGATOR
	default 3

config 2ND_LVL_ISR_TBL_OFFSET
	default 32

config 2ND_LVL_INTR_00_OFFSET
	default 21

config 2ND_LVL_INTR_01_OFFSET
	default 22

config 2ND_LVL_INTR_02_OFFSET
	default 24

config 2ND_LVL_INTR_03_OFFSET
	default 26

config SYSCFG_STM32
	default y

config SHARED_INTERRUPTS
	default n

source "Kconfig.zephyr"
```

## samples/boards/st/swap_bank/Kconfig
```kconfig
# Copyright (c) 2024 STMicroelectronics.
#
# SPDX-License-Identifier: Apache-2.0

config FLASH_STM32_EXTRA
	bool "Extended operation for flash option byte control"
	default y
	select USE_STM32_HAL_FLASH
	select USE_STM32_HAL_FLASH_EX

source "Kconfig.zephyr"
```

## samples/boards/st/swap_bank/sample.yaml
```yaml
sample:
  name: swap flash banks, valid if flash has 2 banks
tests:
  sample.board.stm32.crc:
    tags: board
    filter: dt_compat_enabled("st,stm32-flash-controller")
    harness: console
    harness_config:
      type: one_line
      regex:
        - "Running on bank(.*)"
    platform_allow:
      - b_u585i_iot02a
      - stm32h7b3i_dk
      - stm32h573i_dk
```

## samples/boards/st/timer_mastermode/sample.yaml
```yaml
sample:
  name: STM32 timer mastermode
tests:
  sample.boards.stm32.timer_mastermode:
    depends_on: pwm
    tags:
      - drivers
      - pwm
    filter: dt_compat_enabled("st,stm32-timers")
    platform_allow:
      - nucleo_g070rb
      - nucleo_g071rb
    harness: console
    harness_config:
      type: one_line
      regex:
        - "TRGO event will be generated every.*"
```

## samples/boards/st/uart/circular_dma/sample.yaml
```yaml
sample:
  name: UART driver sample
tests:
  sample.boards.stm32.uart.circular_dma:
    integration_platforms:
      - nucleo_g071rb
    tags:
      - serial
      - uart
    filter: dt_chosen_enabled("zephyr,shell-uart") and CONFIG_SOC_FAMILY_STM32
    harness: keyboard
```

## samples/boards/st/uart/single_wire/sample.yaml
```yaml
sample:
  name: STM32 Single Wire UART sample
tests:
  sample.boards.stm32.uart.single_wire:
    platform_allow:
      - stm32f3_disco
      - nucleo_wba55cg
    tags:
      - drivers
      - uart
    harness: console
    harness_config:
      fixture: single_line_uart_loopback
      type: one_line
      regex:
        - "Received c"
```

## samples/boards/stm32/backup_reset/sample.yaml
```yaml
sample:
  description: Usage of backup SRAM on STM32
  name: stm32_backup_reset
tests:
  sample.boards.stm32.backup_reset:
    depends_on: backup_sram
    build_only: true
    filter: dt_compat_enabled("st,stm32-backup-sram")
```

## samples/boards/stm32/backup_sram/sample.yaml
```yaml
sample:
  description: Usage of backup SRAM on STM32
  name: stm32_backup_sram
tests:
  sample.boards.stm32.backup_sram:
    depends_on: backup_sram
    build_only: true
    filter: dt_compat_enabled("st,stm32-backup-sram")
```

## samples/boards/stm32/bluetooth/gui_hci_uart/sample.yaml
```yaml
sample:
  name: Bluetooth ST GUI HCI UART
  description: Allows BlueNRG-based boards to connect to BlueNRG GUI application via UART
tests:
  sample.boards.stm32.gui_hci_uart:
    harness: bluetooth
    platform_allow:
      - sensortile_box_pro
      - disco_l475_iot1
    tags:
      - uart
      - bluetooth
```

## samples/boards/stm32/bluetooth/interactive_gui/sample.yaml
```yaml
sample:
  name: Bluetooth ST Interactive GUI
  description: Allows BlueNRG-based boards to connect to BlueNRG GUI application via UART
tests:
  sample.boards.stm32.bluetooth.interactive_gui:
    harness: bluetooth
    platform_allow:
      - sensortile_box_pro
      - disco_l475_iot1
    tags:
      - uart
      - bluetooth
```

## samples/boards/stm32/ccm/sample.yaml
```yaml
sample:
  name: CCM usages example
tests:
  sample.board.stm32.ccm:
    platform_allow: olimex_stm32_e407
    tags: board
```

## samples/boards/stm32/h7_dual_core/sample.yaml
```yaml
sample:
  description: Usage of stm32 hsem ipm driver
  name: stm32_h7_dual_core
tests:
  sample.boards.stm32.h7_dual_core:
    depends_on: mailbox
    build_only: true
    filter: dt_compat_enabled("st,stm32-hsem-mailbox")
```

## samples/boards/stm32/hello_world_xip/sample.yaml
```yaml
sample:
  description: Hello World sample, the simplest Zephyr from external flash
    application
  name: hello world
common:
  tags: introduction
  integration_platforms:
    - native_posix
  harness: console
  harness_config:
    type: one_line
    regex:
      - "Hello World! (.*)"
tests:
  sample.basic.helloworld:
    tags: introduction
```

## samples/boards/stm32/i2c_timing/sample.yaml
```yaml
sample:
  name: STM32 I2C V2 timing
tests:
  sample.boards.stm32.i2c_timing:
    depends_on: i2c
    tags:
      - drivers
      - i2c
    filter: dt_compat_enabled("st,stm32-i2c-v2")
    platform_allow: nucleo_l476rg nucleo_wb55rg
    harness: console
    harness_config:
      type: one_line
      regex:
        - "I2C freq. I2C_BITRATE_*"
```

## samples/boards/stm32/pm_lptim/sample.yaml
```yaml
sample:
  name: Power Management LP Timer
tests:
  sample.boards.stm32.pm_lptim.lsi:
    build_only: true
    depends_on: lptim
    filter: dt_compat_enabled_with_alias("gpio-leds", "led0") and
            dt_compat_enabled("st,stm32-lptim")
  sample.boards.stm32.pm_lptim.lse:
    build_only: true
    depends_on: lptim
    filter: dt_compat_enabled_with_alias("gpio-leds", "led0") and
            dt_compat_enabled("st,stm32-lptim")
    extra_configs:
      - CONFIG_STM32_LPTIM_CLOCK_LSE=y
```
