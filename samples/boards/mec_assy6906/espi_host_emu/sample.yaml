## samples/boards/mec_assy6906/espi_host_emu/sample.yaml
```yaml
sample:
  name: Exercise eSPI driver with an emulated eSPI host
tests:
  sample.boards.mec_assy6906.espi_host_emu:
    build_only: true
    platform_allow:
      - mec_assy6906_mech1723nlj
      - mec_assy6906_mech1723nsz
    tags: drivers espi
```

## samples/boards/mec_assy6941/espi_host_emu/sample.yaml
```yaml
sample:
  name: Exercise eSPI driver with an emulated eSPI host
tests:
  sample.boards.mec_assy6941.espi_host_emu:
    build_only: true
    platform_allow:
      - mec_assy6941_mec1743qlj
      - mec_assy6941_mec1743qsz
      - mec_assy6941_mec1753qlj
      - mec_assy6941_mec1753qsz
    tags: drivers espi
```

## samples/boards/mec_assy6941/espi_target/sample.yaml
```yaml
sample:
  name: Exercise eSPI driver connected to real eSPI Host controller
tests:
  sample.boards.mec_assy6941.espi_target:
    build_only: true
    platform_allow:
      - mec_assy6941_mec1743qlj
      - mec_assy6941_mec1743qsz
      - mec_assy6941_mec1753qlj
      - mec_assy6941_mec1753qsz
    tags: drivers espi
```

## samples/boards/mec_assy6941/qspi/boards/mec_assy6941_mec1753qlj.conf
```kconfig
# MEC1743Q-LJ package does not include an internal SPI flash.
# We use the Microchip assembly 6xxx dongle connected to EVB J18.
# The dongle has a Winbond W25Q128JV SPI flash which supports SFDP
# and quad mode.
CONFIG_SPI_NOR_SFDP_MINIMAL=y
```

## samples/boards/mec_assy6941/qspi/sample.yaml
```yaml
tests:
  boards.mec_assy6941.qspi:
    build_only: true
    platform_allow:
      - mec_assy6941_mec1743qlj
      - mec_assy6941_mec1743qsz
      - mec_assy6941_mec1753qlj
      - mec_assy6941_mec1753qsz
    tags: drivers spi
```

## samples/boards/microbit/display/sample.yaml
```yaml
sample:
  name: BB micro:bit Display
tests:
  test:
    platform_whitelist: bbc_microbit
    tags: display
```

## samples/boards/microbit/pong/sample.yaml
```yaml
sample:
  name: Pong game using BBC Micro:bit
tests:
  test:
    platform_whitelist: bbc_microbit
    tags: microbit mesh bluetooth
```

## samples/boards/microbit/sound/sample.yaml
```yaml
sample:
  name: BBC micro:bit Sound
tests:
  test:
    platform_whitelist: bbc_microbit
    tags: sound
```

## samples/boards/mimxrt1060_evk/system_off/sample.yaml
```yaml
sample:
  name: Low Power State Sample for mimxrt1060_evk/mimxrt1062
common:
  tags: power
tests:
  sample.boards.mimxrt1060_evk.system_off:
    build_only: true
    platform_allow:
      - mimxrt1060_evk/mimxrt1062
      - mimxrt1060_evkb/mimxrt1062
    integration_platforms:
      - mimxrt1060_evk/mimxrt1062
```

## samples/boards/mimxrt1170_evk_cm7/magic_addr/sample.yaml
```yaml
sample:
  description: RT1170 FLEXRAM Magic Addr example
  name: magic addr
common:
  integration_platforms:
    - mimxrt1170_evk_cm7
    - mimxrt1160_evk_cm7
tests:
  sample.boards.mimxrt1170_evk.magic_addr:
    platform_allow:
      - mimxrt1170_evk_cm7
      - mimxrt1160_evk_cm7
```

## samples/boards/mimxrt595_evk_cm33/system_off/sample.yaml
```yaml
#
# Copyright 2022, NXP
#
# SPDX-License-Identifier: Apache-2.0
#
sample:
  name: Deep Power Down State Sample for mimxrt595_evk
common:
  tags: power
tests:
  sample.boards.mimxrt595_evk_cm33.system_off:
    build_only: true
    platform_allow: mimxrt595_evk_cm33
```

## samples/boards/nordic/audiopll/sample.yaml
```yaml
# Copyright (c) 2024 Nordic Semiconductor ASA
# SPDX-License-Identifier: Apache-2.0

sample:
  name: AudioPLL clock control sample
common:
  platform_allow:
    - nrf54h20dk/nrf54h20/cpuapp
  harness: console
  harness_config:
    type: one_line
    regex:
      - "sample complete"
tests:
  sample.boards.nrf.audiopll:
```

## samples/boards/nordic/battery/sample.yaml
```yaml
sample:
  name: Measure battery voltage
tests:
  sample.boards.nrf.battery:
    build_only: true
    platform_allow:
      - particle_xenon
      - thingy52/nrf52832
    tags: battery
    integration_platforms:
      - particle_xenon
```

## samples/boards/nordic/clock_control/Kconfig
```kconfig
# Copyright (c) 2024 Nordic Semiconductor ASA
# SPDX-License-Identifier: Apache-2.0

config SAMPLE_CLOCK_FREQUENCY_HZ
	int "Frequency specification to request from clock in Hz"
	default 0
	help
	  0  -> ignore frequency
	  >0 -> use at minimum selected frequency. To select the
	        highest supported frequency use UINT32_MAX.

config SAMPLE_CLOCK_ACCURACY_PPM
	int "Accuracy specification to request from clock in PPM"
	default 0
	help
	  0  -> ignore accuracy
	  1  -> use max accuracy
	  >1 -> use at minimum selected accuracy

config SAMPLE_CLOCK_PRECISION
	int "Precision specification to request from clock"
	default 0
	help
	  0  -> low precision
	  1  -> high precision

config SAMPLE_PRE_REQUEST_TIMEOUT
	int "Time to wait after boot before requesting clock specs in seconds"
	default 2
	help
	  The distributed clock domains may need time to initialize
	  before a clock request can be met.

config SAMPLE_KEEP_REQUEST_TIMEOUT
	int "Time to keep request alive in seconds"
	default 2

source "Kconfig.zephyr"
```

## samples/boards/nordic/clock_control/sample.yaml
```yaml
sample:
  name: Clock control sample
common:
  platform_allow:
    - nrf54h20dk/nrf54h20/cpuapp
  harness: console
  harness_config:
    type: one_line
    regex:
      - "clock spec request released"
tests:
  sample.boards.nrf.clock_control.fll16m:
    filter: dt_nodelabel_enabled("fll16m")
    extra_args:
      - CONF_FILE="configs/fll16m.conf"
      - DTC_OVERLAY_FILE="configs/fll16m.overlay"
  sample.boards.nrf.clock_control.lfclk:
    filter: dt_nodelabel_enabled("lfclk")
    extra_args:
      - CONF_FILE="configs/lfclk.conf"
      - DTC_OVERLAY_FILE="configs/lfclk.overlay"
  sample.boards.nrf.clock_control.uart135:
    filter: dt_nodelabel_enabled("uart135")
    extra_args:
      - CONF_FILE="configs/uart135.conf"
      - DTC_OVERLAY_FILE="configs/uart135.overlay"
  sample.boards.nrf.clock_control.cpuapp_hsfll:
    filter: dt_nodelabel_enabled("cpuapp_hsfll")
    extra_args:
      - CONF_FILE="configs/cpuapp_hsfll.conf"
      - DTC_OVERLAY_FILE="configs/cpuapp_hsfll.overlay"
  sample.boards.nrf.clock_control.global_hsfll:
    filter: dt_nodelabel_enabled("hsfll120")
    extra_args:
      - CONF_FILE="configs/global_hsfll.conf"
      - DTC_OVERLAY_FILE="configs/global_hsfll.overlay"
  sample.boards.nrf.clock_control.global_hsfll.req_low_freq_n:
    filter: dt_nodelabel_enabled("hsfll120")
    extra_configs:
      - CONFIG_CLOCK_CONTROL_NRF2_GLOBAL_HSFLL_REQ_LOW_FREQ=n
    extra_args:
      - CONF_FILE="configs/global_hsfll.conf"
      - DTC_OVERLAY_FILE="configs/global_hsfll.overlay"
```

## samples/boards/nordic/clock_skew/Kconfig
```kconfig
# Copyright (c) 2020, Nordic Semiconductor ASA
# SPDX-License-Identifier: Apache-2.0

config APP_ENABLE_HFXO
	bool "Use HFXO as HFCLK source"
	help
	  Turn on the high-frequency clock, which means switching to the
	  crystal as a source rather than the internal oscillator.

source "Kconfig.zephyr"
```

## samples/boards/nordic/clock_skew/sample.yaml
```yaml
sample:
  name: Clock Skew Sample for nRF
tests:
  sample.boards.nrf.clock_skew:
    build_only: true
    platform_allow:
      - nrf52840dk/nrf52840
      - nrf52dk/nrf52832
      - nrf51dk/nrf51822
    tags: power
    integration_platforms:
      - nrf52840dk/nrf52840
```

## samples/boards/nordic/coproc_launcher/boards/nrf54h20dk_nrf54h20_cpuapp.conf
```kconfig
# Copyright (c) 2026 Nordic Semiconductor ASA
# SPDX-License-Identifier: Apache-2.0

# Free GPIO and UART for coprocessors
CONFIG_GPIO=n
CONFIG_SERIAL=n
CONFIG_CONSOLE=n
CONFIG_UART_CONSOLE=n

CONFIG_PM=y
```

## samples/boards/nordic/coresight_stm/Kconfig.sysbuild
```kconfig
# Copyright 2024 Nordic Semiconductor ASA
#
# SPDX-License-Identifier: Apache-2.0

source "share/sysbuild/Kconfig"

config APP_CPUPPR_RUN
	bool "Use PPR"

config APP_CPUFLPR_RUN
	bool "Use FLPR"
```

## samples/boards/nordic/coresight_stm/sample.yaml
```yaml
sample:
  name: Logging using Coresight STM on nrf54h20

common:
  tags: stm
  sysbuild: true
  platform_allow:
    - nrf54h20dk/nrf54h20/cpuapp
  integration_platforms:
    - nrf54h20dk/nrf54h20/cpuapp

tests:
  sample.boards.nrf.coresight_stm.dict:
    harness: pytest
    harness_config:
      pytest_dut_scope: session
      pytest_root:
        - "pytest/test_stm.py::test_sample_STM_dictionary_mode"
    required_snippets:
      - nordic-log-stm-dict
    extra_args:
      - SB_CONFIG_APP_CPUPPR_RUN=y
      - SB_CONFIG_APP_CPUFLPR_RUN=y

  sample.boards.nrf.coresight_stm:
    harness: pytest
    harness_config:
      pytest_dut_scope: session
      pytest_root:
        - "pytest/test_stm.py::test_sample_STM_decoded"
    required_snippets:
      - nordic-log-stm
    extra_args:
      - SB_CONFIG_APP_CPUPPR_RUN=y
      - SB_CONFIG_APP_CPUFLPR_RUN=y

  sample.boards.nrf.coresight_stm.local_uart:
    harness: console
    harness_config:
      type: multi_line
      ordered: true
      regex:
        - "Timing for log message with 0 arguments:"
        - "Timing for log message with 1 argument:"
        - "Timing for log message with 2 arguments:"
        - "Timing for log message with 3 arguments:"
        - "Timing for log_message with string:"
```

## samples/boards/nordic/coresight_stm_shell/remote/boards/nrf54h20dk_nrf54h20_cpuflpr.conf
```kconfig
# Copyright (c) 2026 Nordic Semiconductor ASA
# SPDX-License-Identifier: Apache-2.0
#
# CPUFLPR has limited RAM.
CONFIG_MULTITHREADING=n

CONFIG_KERNEL_SHELL=n
CONFIG_THREAD_MONITOR=n
CONFIG_THREAD_RUNTIME_STATS=n
CONFIG_STATS=n
CONFIG_STATS_SHELL=n
CONFIG_DEVICE_SHELL=n
CONFIG_INIT_STACKS=n
CONFIG_THREAD_STACK_INFO=n
```

## samples/boards/nordic/coresight_stm_shell/sample.yaml
```yaml
# Copyright (c) 2026 Nordic Semiconductor ASA
# SPDX-License-Identifier: Apache-2.0

sample:
  name: Coresight STM logging with remote shell on nRF54H20

common:
  tags:
    - logging
    - shell
  platform_allow:
    - nrf54h20dk/nrf54h20/cpuapp
  integration_platforms:
    - nrf54h20dk/nrf54h20/cpuapp

tests:
  sample.boards.nrf.coresight_stm_shell:
    required_snippets:
      - nordic-log-stm
    harness: pytest
```

## samples/boards/nordic/mesh/onoff_level_lighting_vnd_app/sample.yaml
```yaml
sample:
  name: Bluetooth Mesh
tests:
  sample.bluetooth.mesh.onoff_level_lighting_vnd:
    platform_allow: nrf52840dk/nrf52840
    tags: bluetooth
    harness: bluetooth
```

## samples/boards/nordic/nrf5340_audio/echo/Kconfig
```kconfig
#
# Copyright (c) 2018 Nordic Semiconductor ASA
#
# SPDX-License-Identifier: LicenseRef-Nordic-5-Clause
#

menuconfig NRF5340_AUDIO
	 bool "nRF5340 Audio [EXPERIMENTAL]"
	 select EXPERIMENTAL

if NRF5340_AUDIO

rsource "Kconfig.defaults"
rsource "Kconfig.audio"
rsource "Kconfig.audio.defaults"
rsource "src/drivers/Kconfig"
rsource "src/modules/Kconfig"
rsource "src/utils/Kconfig"

config ONBOARD_MIC
	bool "Build with the onboard microphone"
	default y
	help
	 Use the onboard microphone, if no then the line in will be used


#----------------------------------------------------------------------------#

menu "Logging"

module = MAIN
module-str = main
source "subsys/logging/Kconfig.template.log_config"

module = NRF5340_AUDIO_COMMON
module-str = nrf5340_audio_common
source "subsys/logging/Kconfig.template.log_config"

config PRINT_STACK_USAGE_MS
	depends on THREAD_ANALYZER && INIT_STACKS
	int "Print stack usage every x milliseconds"
	default 5000

endmenu # Log levels

#----------------------------------------------------------------------------#
endif # NRF5340_AUDIO

source "Kconfig.zephyr"
```

## samples/boards/nordic/nrf5340_audio/echo/Kconfig.audio
```kconfig
#
# Copyright (c) 2022 Nordic Semiconductor ASA
#
# SPDX-License-Identifier: LicenseRef-Nordic-5-Clause
#

rsource "Kconfig.defaults"

menu "Audio"

config AUDIO_FRAME_DURATION_US
	int
	default 10000
	help
	  Audio frame duration in µs.

choice AUDIO_SYSTEM_SAMPLE_RATE
	prompt "System audio sample rate"
	default AUDIO_SAMPLE_RATE_48000_HZ
	help
	  This configuration reflects the system sample rate, but the audio data may be resampled to
	  another sample rate before encoding, and after decoding.

config AUDIO_SAMPLE_RATE_16000_HZ
	bool "16 kHz"
	help
	  Sample rate of 16kHz is currently only valid for I2S/line-in.

config AUDIO_SAMPLE_RATE_24000_HZ
	bool "24 kHz"
	help
	  Sample rate of 24kHz is currently only valid for I2S/line-in.

config AUDIO_SAMPLE_RATE_48000_HZ
	bool "48 kHz"
	help
	  Sample rate of 48kHz is valid for both I2S/line-in and USB.
endchoice

config AUDIO_SAMPLE_RATE_HZ
	int
	default 16000 if AUDIO_SAMPLE_RATE_16000_HZ
	default 24000 if AUDIO_SAMPLE_RATE_24000_HZ
	default 48000 if AUDIO_SAMPLE_RATE_48000_HZ
	help
	  I2S supports 16, 24, and 48 kHz sample rates for both input and output.
	  USB supports only 48 kHz for input.

choice AUDIO_BIT_DEPTH
	prompt "Audio bit depth"
	default AUDIO_BIT_DEPTH_16
	help
	  Select the bit depth for audio.

config AUDIO_BIT_DEPTH_16
	bool "16 bit audio"

config AUDIO_BIT_DEPTH_32
	bool "32 bit audio"
endchoice

config AUDIO_BIT_DEPTH_BITS
	int
	default 16 if AUDIO_BIT_DEPTH_16
	default 32 if AUDIO_BIT_DEPTH_32
	help
	  Bit depth of one sample in storage.

config AUDIO_BIT_DEPTH_OCTETS
	int
	default 2 if AUDIO_BIT_DEPTH_16
	default 4 if AUDIO_BIT_DEPTH_32
	help
	  Bit depth of one sample in storage given in octets.


config AUDIO_MAX_PRES_DLY_US
	int "The maximum presentation delay"
	default 60000
	help
	  The maximum allowable presentation delay in microseconds.
	  Increasing this will also increase the FIFO buffers to allow buffering.

#----------------------------------------------------------------------------#
menu "Log levels"

module = AUDIO_SYNC_TIMER
module-str = audio-sync-timer
source "subsys/logging/Kconfig.template.log_config"


endmenu # Log levels

#----------------------------------------------------------------------------#
menu "Thread priorities"

config BUTTON_MSG_SUB_THREAD_PRIO
	int "Thread priority for button subscriber"
	default 5
	help
	  This is a preemptible thread.
	  This thread will subscribe to button events from zbus.

config CONTENT_CONTROL_MSG_SUB_THREAD_PRIO
	int "Thread priority for content control subscriber"
	default 5
	help
	  This is a preemptible thread.
	  This thread will subscribe to content control events from zbus.

endmenu # Thread priorities

#----------------------------------------------------------------------------#
menu "Stack sizes"


config BUTTON_MSG_SUB_STACK_SIZE
	int "Stack size for button subscriber"
	default 2048

config CONTENT_CONTROL_MSG_SUB_STACK_SIZE
	int "Stack size for content control subscriber"
	default 1024

endmenu # Stack sizes

#----------------------------------------------------------------------------#
menu "Zbus"

config BUTTON_MSG_SUB_QUEUE_SIZE
	int "Queue size for button subscriber"
	default 4

config CONTENT_CONTROL_MSG_SUB_QUEUE_SIZE
	int "Queue size for content control subscriber"
	default 4

endmenu # Zbus
endmenu # Audio
```
