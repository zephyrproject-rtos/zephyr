## CMakeLists.txt
```
# SPDX-License-Identifier: Apache-2.0

cmake_minimum_required(VERSION 3.20.0)
find_package(Zephyr REQUIRED HINTS $ENV{ZEPHYR_BASE})
project(google_twinkie)

FILE(GLOB app_sources src/*.c)
target_sources(app PRIVATE ${app_sources})
```

## prj.conf
```kconfig
CONFIG_SMF=y

CONFIG_USB_DEVICE_STACK=y
CONFIG_USB_DEVICE_SN="123456789"
CONFIG_USB_DEVICE_MANUFACTURER="Google"
CONFIG_USB_DEVICE_PRODUCT="Twinkie V2"
CONFIG_USB_DEVICE_VID=0x18d1
CONFIG_USB_DEVICE_PID=1234

CONFIG_BOOTLOADER_MCUBOOT=y
CONFIG_USB_DEVICE_STACK=y
CONFIG_USB_DFU_CLASS=y
CONFIG_IMG_MANAGER=y
CONFIG_FLASH=y
CONFIG_FLASH_PAGE_LAYOUT=y
CONFIG_USB_COMPOSITE_DEVICE=y
CONFIG_USB_CDC_ACM_RINGBUF_SIZE=512

CONFIG_STDOUT_CONSOLE=y
CONFIG_SERIAL=y
CONFIG_CONSOLE=y
CONFIG_UART_CONSOLE=y
#CONFIG_UART_LINE_CTRL=y
CONFIG_UART_INTERRUPT_DRIVEN=y

CONFIG_USB_DEVICE_LOG_LEVEL_ERR=y
CONFIG_USB_DRIVER_LOG_LEVEL_ERR=y

CONFIG_PRINTK=y
CONFIG_SHELL=y
# CONFIG_SHELL_MINIMAL=y
CONFIG_SHELL_STACK_SIZE=1024
CONFIG_SHELL_BACKEND_SERIAL=y

CONFIG_THREAD_MONITOR=y
CONFIG_INIT_STACKS=y
CONFIG_BOOT_BANNER=n
CONFIG_THREAD_NAME=y
CONFIG_LOG=n
CONFIG_CBPRINTF_NANO=y

CONFIG_ADC=y
CONFIG_ADC_STM32=y
CONFIG_ADC_SHELL=y
# CONFIG_SENSOR=y
CONFIG_GPIO=y

CONFIG_ISR_SHARE_IRQ=y

CONFIG_ADC_STM32_SHARED_IRQS=n
```

## src/controls.h
```c
#ifndef _CONTROLS_H_
#define _CONTROLS_H_

int controls_init(void);
void en_cc1(bool en);
void en_cc2(bool en);
#endif
```

## src/meas.h
```c
#ifndef __MEAS_H__
#define __MEAS_H__

int meas_init(void);
void meas_vbus(int32_t *v);
void meas_cbus(int32_t *c);
void meas_vcc1(int32_t *v);
void meas_vcc2(int32_t *v);
void meas_ccon(int32_t *c);
void meas_all(int32_t *buf);

#endif
```

## src/model.c
```c
/*
 * Copyright (c) 2022 The Chromium OS Authors
 *
 * SPDX-License-Identifier: Apache-2.0
 */

#include <string.h>
#include <zephyr/kernel.h>
#include <zephyr/drivers/gpio.h>
#include <zephyr/drivers/uart.h>
#include <zephyr/sys/ring_buffer.h>

#include <stm32g0xx_ll_bus.h>
#include <stm32g0xx_ll_system.h>
#include <stm32g0xx_ll_dma.h>
#include <stm32g0xx_ll_rcc.h>
#include <stm32g0xx_ll_gpio.h>
#include <stm32g0xx_ll_ucpd.h>

#include "meas.h"
#include "controls.h"
#include "view.h"
#include "model.h"

#define UCPD_IRQ		8
#define DMA1_CHANNEL1_IRQ	9
#define DMA1_CHANNEL1_PRIO	2
#define UCPD_PRIO		2

#define MODEL_THREAD_STACK_SIZE 500
#define MODEL_THREAD_PRIORITY 5

/* STM32 UCPD parameters */
static LL_UCPD_InitTypeDef ucpd_params;

#define MOD_BUFFERS 20

#define PACKET_HEADER_LEN 20
#define PD_SAMPLES 492
#define PACKET_BYTE_SIZE (PACKET_HEADER_LEN + PD_SAMPLES)
#define MAX_PACKET_XFER_SIZE 64

struct packet_type_t {
	uint16_t unused1: 4;
	uint16_t polarity: 2;
	uint16_t lost: 1;
	uint16_t partial: 1;
	uint16_t version: 4;
	uint16_t type: 4;
};

struct header_t {
	uint32_t sequence;
        uint16_t cc1_voltage;
        uint16_t cc2_voltage;
        uint16_t vcon_current;
        uint16_t vbus_voltage;
        uint16_t vbus_current;
        struct packet_type_t packet_type;
	uint16_t data_len;
	uint16_t unused;
};

struct packet_t {
	struct header_t header;
	uint8_t data[PD_SAMPLES];
};

struct model_t {
	const struct device *dev;
	struct packet_t packet;
	uint8_t dma_buffer[PD_SAMPLES];
	k_tid_t tid;
	bool start;

	uint8_t mod_buff[MOD_BUFFERS][PD_SAMPLES];
	uint16_t mod_size[MOD_BUFFERS];
	struct packet_type_t sop[MOD_BUFFERS];
	uint8_t mw;
	uint8_t mr;
} model;

struct sniffer_config {
	uint8_t read_line;
} sniff_cfg;

K_THREAD_STACK_DEFINE(model_stack_area, MODEL_THREAD_STACK_SIZE);
static struct k_thread model_thread_data;
static int pd_line;

void start_snooper(bool s)
{
	model.start = s;
	if (s) {
		model.packet.header.sequence = 0;
		view_set_snoop(VS_SNOOP3);
	} else {
		view_set_snoop(VS_SNOOP0);
	}
}

void reset_sniffer() {
	model.packet.header.sequence = 0;
}

void set_readline(uint8_t line_mask) {
	if (line_mask > 3)
		line_mask = 1;
	sniff_cfg.read_line = line_mask;
	if (line_mask & BIT(1))
		LL_UCPD_SetCCPin(UCPD1, LL_UCPD_CCPIN_CC2);
	else
		LL_UCPD_SetCCPin(UCPD1, LL_UCPD_CCPIN_CC1);
}

void set_role(uint8_t role_mask) {
	if (role_mask & BIT(0))
		LL_UCPD_SetSNKRole(UCPD1);
	else
		LL_UCPD_SetSRCRole(UCPD1);

	uint8_t Rp = role_mask & (BIT(1) | BIT(2));

	switch (Rp) {
	case 0:
		LL_UCPD_SetRpResistor(UCPD1, LL_UCPD_RESISTOR_NONE);
		break;
	case BIT(1):
		LL_UCPD_SetRpResistor(UCPD1, LL_UCPD_RESISTOR_DEFAULT);
		break;
	case BIT(2):
		LL_UCPD_SetRpResistor(UCPD1, LL_UCPD_RESISTOR_1_5A);
		break;
	case (BIT(1) | BIT(2)):
		LL_UCPD_SetRpResistor(UCPD1, LL_UCPD_RESISTOR_3_0A);
	}
}

#define SAMPLE_WINDOW		100

static void model_thread(void *arg1, void *arg2, void *arg3)
{
	int32_t vbus_v, vbus_c;
	int32_t vcon_c;
	int32_t cc_v[2];
	struct model_t *sm = (struct model_t *)arg1;
	uint8_t cc_pin;

	while (1) {
		if (sm->start) {
			meas_vbus(&vbus_v);
			meas_cbus(&vbus_c);
			meas_vcc1(&cc_v[0]);
       			meas_vcc2(&cc_v[1]);
       			meas_ccon(&vcon_c);

			if ((cc_v[0] < 2000) && (cc_v[0] > 1300)) {
				if (get_view_connection() & BIT(0))
					LL_UCPD_SetCCPin(UCPD1, LL_UCPD_CCPIN_CC1);
				else
					LL_UCPD_SetCCPin(UCPD1, LL_UCPD_CCPIN_CC2);
				view_set_connection(VS_CC1_CONN);
				pd_line = 1;
			}
			else if ((cc_v[1] < 2000) && (cc_v[1] > 1300)) {
				if (get_view_connection() & BIT(1))
					LL_UCPD_SetCCPin(UCPD1, LL_UCPD_CCPIN_CC2);
				else
					LL_UCPD_SetCCPin(UCPD1, LL_UCPD_CCPIN_CC1);
				view_set_connection(VS_CC2_CONN);
				pd_line = 2;
			}
			else {
				view_set_connection(VS_NO_CONN);
			}

			if (sm->mw != sm->mr) {
				sm->packet.header.sequence++;
				sm->packet.header.vbus_voltage = vbus_v;
				sm->packet.header.vbus_current = vbus_c;
				sm->packet.header.cc1_voltage = cc_v[0];
				sm->packet.header.cc2_voltage = cc_v[1];
				sm->packet.header.vcon_current = vcon_c;

				sm->packet.header.packet_type = sm->sop[sm->mr];
				sm->packet.header.data_len = sm->mod_size[sm->mr];
				memcpy(sm->packet.data, sm->mod_buff[sm->mr], sm->mod_size[sm->mr]);

				for (int i = 0; i < PACKET_BYTE_SIZE; i += MAX_PACKET_XFER_SIZE) {
					uart_fifo_fill(sm->dev, (const uint8_t *)&sm->packet + i, MAX_PACKET_XFER_SIZE);
				}
			//	uart_fifo_fill(sm->dev, (const uint8_t *)&sm->packet + 128, 128);
			//	uart_fifo_fill(sm->dev, (const uint8_t *)&sm->packet + 256, 128);
			//	uart_fifo_fill(sm->dev, (const uint8_t *)&sm->packet + 384, 128);

				sm->mr++;
				if (sm->mr == MOD_BUFFERS) {
					sm->mr = 0;
				}
			}
		}
		k_usleep(500);
	}
}

#define MY_DEV_IRQ 12
#define MY_DEV_PRIO  2
#define MY_ISR_ARG  NULL
#define MY_IRQ_FLAGS 0

static void ucpd_isr(void *arg)
{
	struct model_t *sm = &model;

//	if (LL_UCPD_IsActiveFlag_RxNE(UCPD1)) {
//		sm->header.timestamp++;
//	}
	if (LL_UCPD_IsActiveFlag_TypeCEventCC1(UCPD1) || LL_UCPD_IsActiveFlag_TypeCEventCC2(UCPD1)) {
#if 0
		if (LL_UCPD_GetTypeCVstateCC1(UCPD1) > LL_UCPD_GetTypeCVstateCC2(UCPD1)) {
			pd_line = 1;
			LL_UCPD_SetCCPin(UCPD1, LL_UCPD_CCPIN_CC1);
			view_set_connection(VS_CC1_CONN);
//			sm->mw = 0;
//			sm->mr = 0;
		} else if (LL_UCPD_GetTypeCVstateCC2(UCPD1) > LL_UCPD_GetTypeCVstateCC1(UCPD1)) {
			pd_line = 2;
			LL_UCPD_SetCCPin(UCPD1, LL_UCPD_CCPIN_CC2);
			view_set_connection(VS_CC2_CONN);
//			sm->mw = 0;
//			sm->mr = 0;
		} else {
			view_set_connection(VS_NO_CONN);
		}
#endif
		LL_UCPD_ClearFlag_TypeCEventCC1(UCPD1);
		LL_UCPD_ClearFlag_TypeCEventCC2(UCPD1);
	}

	if (LL_UCPD_IsActiveFlag_RxErr(UCPD1)) {
		LL_DMA_DisableChannel(DMA1, LL_DMA_CHANNEL_1);
		LL_DMA_SetDataLength(DMA1, LL_DMA_CHANNEL_1, PD_SAMPLES);
		memcpy(sm->mod_buff[sm->mw], sm->dma_buffer, PD_SAMPLES);
		sm->mod_size[sm->mw] = LL_UCPD_ReadRxPaySize(UCPD1);
		sm->sop[sm->mr].type = LL_UCPD_ReadRxOrderSet(UCPD1);
                sm->sop[sm->mw].polarity = pd_line;
		sm->sop[sm->mw].partial = true;
		sm->mw++;
		if (sm->mw == MOD_BUFFERS) {
			sm->mw = 0;
		}
		LL_DMA_EnableChannel(DMA1, LL_DMA_CHANNEL_1);
		k_wakeup(sm->tid);
	}

	if (LL_UCPD_IsActiveFlag_RxMsgEnd(UCPD1)) {
		LL_DMA_DisableChannel(DMA1, LL_DMA_CHANNEL_1);
		LL_DMA_SetDataLength(DMA1, LL_DMA_CHANNEL_1, PD_SAMPLES);
		memcpy(sm->mod_buff[sm->mw], sm->dma_buffer, PD_SAMPLES);
		sm->sop[sm->mr].type = LL_UCPD_ReadRxOrderSet(UCPD1);
		sm->sop[sm->mw].polarity = pd_line;
		sm->sop[sm->mw].partial = false;
		sm->mod_size[sm->mw] = LL_UCPD_ReadRxPaySize(UCPD1);
		sm->mw++;
		if (sm->mw == MOD_BUFFERS) {
			sm->mw = 0;
		}
		LL_DMA_EnableChannel(DMA1, LL_DMA_CHANNEL_1);
		k_wakeup(sm->tid);
		LL_UCPD_ClearFlag_RxMsgEnd(UCPD1);
	}
}

void select_pull_up(uint8_t pull_mask) {
	if (pull_mask & BIT(0)) LL_UCPD_SetccEnable(UCPD1, LL_UCPD_CCENABLE_CC2);
	else LL_UCPD_SetccEnable(UCPD1, LL_UCPD_CCENABLE_CC1);

	if (pull_mask & ~BIT(0)) set_role(pull_mask & ~BIT(0));
	else {
		LL_UCPD_SetccEnable(UCPD1, LL_UCPD_CCENABLE_CC1CC2);
		set_role(0);
	}
}

static void update_stm32g0x_cc_line(void)
{
	SYSCFG->CFGR1 |= SYSCFG_CFGR1_UCPD1_STROBE_Msk;
}

enum pd_cc_t {
	PD_OFF,
	PD_BOTH,
	PD_CC1,
	PD_CC2
};

static void pd_on_cc(enum pd_cc_t p)
{
	switch (p) {
	case PD_OFF:
		LL_UCPD_TypeCDetectionCC1Disable(UCPD1);
		LL_UCPD_TypeCDetectionCC2Disable(UCPD1);
		break;
	case PD_BOTH:
		LL_UCPD_TypeCDetectionCC1Enable(UCPD1);
		LL_UCPD_TypeCDetectionCC2Enable(UCPD1);
		break;
	case PD_CC1:
		LL_UCPD_TypeCDetectionCC2Disable(UCPD1);
		LL_UCPD_TypeCDetectionCC1Enable(UCPD1);
		break;
	case PD_CC2:
		LL_UCPD_TypeCDetectionCC1Disable(UCPD1);
		LL_UCPD_TypeCDetectionCC2Enable(UCPD1);
		break;
	}
}

int model_init(const struct device *dev)
{
        int ret;

	model.dev = dev;
	model.mw = 0;
	model.mr = 0;

	update_stm32g0x_cc_line();

	/** Configure CC pins */

	/* Set PIN A8 as analog */
	LL_GPIO_SetPinMode(GPIOA, LL_GPIO_PIN_8, LL_GPIO_MODE_ANALOG);

	/* Set PIN B15 as analog */
	LL_GPIO_SetPinMode(GPIOB, LL_GPIO_PIN_15, LL_GPIO_MODE_ANALOG);

	/** Configure DMA */

	/* DMA CLOCK */
	LL_AHB1_GRP1_EnableClock(LL_AHB1_GRP1_PERIPH_DMA1);

	LL_DMA_DisableChannel(DMA1, LL_DMA_CHANNEL_1);

	/* DMA from UCPD RXDR register */
	LL_DMA_ConfigAddresses(DMA1, LL_DMA_CHANNEL_1, (uint32_t)&UCPD1->RXDR, (uint32_t)model.dma_buffer, LL_DMA_DIRECTION_PERIPH_TO_MEMORY);

	LL_DMA_SetMode(DMA1, LL_DMA_CHANNEL_1, LL_DMA_MODE_NORMAL);

	LL_DMA_SetPeriphIncMode(DMA1, LL_DMA_CHANNEL_1, LL_DMA_PERIPH_NOINCREMENT);

	LL_DMA_SetMemoryIncMode(DMA1, LL_DMA_CHANNEL_1, LL_DMA_MEMORY_INCREMENT);

	LL_DMA_SetPeriphSize(DMA1, LL_DMA_CHANNEL_1, LL_DMA_PDATAALIGN_BYTE);

	LL_DMA_SetMemorySize(DMA1, LL_DMA_CHANNEL_1, LL_DMA_MDATAALIGN_BYTE);

	LL_DMA_SetChannelPriorityLevel(DMA1, LL_DMA_CHANNEL_1, LL_DMA_PRIORITY_VERYHIGH);

	LL_DMA_SetDataLength(DMA1, LL_DMA_CHANNEL_1, PD_SAMPLES);

	LL_DMA_SetPeriphRequest(DMA1, LL_DMA_CHANNEL_1, LL_DMAMUX_REQ_UCPD1_RX);

	LL_DMA_EnableChannel(DMA1, LL_DMA_CHANNEL_1);

	model.packet.header.sequence = 0;

	/** Configure UCPD */

	ucpd_params.psc_ucpdclk = 0;
	ucpd_params.transwin = 7;
	ucpd_params.IfrGap = 16;
	ucpd_params.HbitClockDiv = 26;

	/*
	 * The UCPD port is disabled in the LL_UCPD_Init function
	 *
	 * NOTE: For proper Power Management operation, this function
	 *       should not be used because it circumvents the zephyr
	 *       clock API. Instead, DTS clock settings and the zephyr
	 *       clock API should be used to enable clocks.
	 */
	ret = LL_UCPD_Init(UCPD1, &ucpd_params);
        if (ret == SUCCESS) {
		/* ORDSET */
		LL_UCPD_SetRxOrderSet(UCPD1, LL_UCPD_ORDERSET_SOP |
					     LL_UCPD_ORDERSET_SOP1 |
					     LL_UCPD_RXORDSET_SOP2 |
					     LL_UCPD_ORDERED_SET_HARD_RESET |
					     LL_UCPD_RXORDSET_SOP1_DEBUG |
					     LL_UCPD_RXORDSET_SOP2_DEBUG |
					     LL_UCPD_RXORDSET_CABLE_RESET);

		/* ENABLE DMA */
		LL_UCPD_RxDMAEnable(UCPD1);

		/* Enable UCPD port */
		LL_UCPD_Enable(UCPD1);
		start_snooper(false);

		pd_on_cc(PD_BOTH);
		update_stm32g0x_cc_line();

		LL_UCPD_EnableIT_RxNE(UCPD1);
		set_readline(1);

		LL_UCPD_EnableIT_TypeCEventCC1(UCPD1);
		LL_UCPD_EnableIT_TypeCEventCC2(UCPD1);
		LL_UCPD_ClearFlag_TypeCEventCC1(UCPD1);
		LL_UCPD_ClearFlag_TypeCEventCC2(UCPD1);

		LL_UCPD_SetccEnable(UCPD1, LL_UCPD_CCENABLE_CC1CC2);

		LL_UCPD_EnableIT_RxMsgEnd(UCPD1);
		LL_UCPD_ClearFlag_RxMsgEnd(UCPD1);

		LL_UCPD_RxEnable(UCPD1);

		IRQ_CONNECT(UCPD_IRQ, UCPD_PRIO, ucpd_isr, 0, 0);
		irq_enable(UCPD_IRQ);
	} else {
		return -EIO;
	}

	LL_UCPD_SetSNKRole(UCPD1);

	en_cc1(true);
	en_cc2(true);

	model.tid = k_thread_create(&model_thread_data, model_stack_area,
			K_THREAD_STACK_SIZEOF(model_stack_area),
			model_thread,
			&model, NULL, NULL,
			MODEL_THREAD_PRIORITY, 0, K_NO_WAIT);

	return 0;
}
```

## src/model.h
```c
#ifndef _MODEL_H_
#define _MODEL_H_

#include <zephyr/kernel.h>

int model_init(const struct device *dev);

void set_readline(uint8_t line_mask);

void reset_sniffer();

void set_role(uint8_t role_mask);

void start_snooper(bool s);

void select_pull_up(uint8_t pull_mask);

#endif
```

## src/shell.c
```c
#include <zephyr/kernel.h>
#include <zephyr/usb/usb_device.h>
#include <zephyr/device.h>
#include <zephyr/drivers/uart.h>
#include <zephyr/shell/shell.h>
#include <zephyr/drivers/usb/usb_dc.h>

#include "view.h"
#include "meas.h"
#include "model.h"

/* 1000 msec = 1 sec */
#define SLEEP_TIME_MS   500

#if 0
static int led_wrapper(const struct shell *shell, size_t argc, char **argv, void* data) {
	enum led_t color = (enum led_t) data;

	set_led(color);
	return 0;
}

SHELL_SUBCMD_DICT_SET_CREATE(led_options, led_wrapper,
        (off, LED_OFF), (red, LED_RED), (green, LED_GREEN), (blue, LED_BLUE)
);

SHELL_CMD_REGISTER(led, &led_options, "Switch selected LED on or off", led_wrapper);
#endif

static int meas_wrapper(const struct shell *shell, size_t argc, char **argv) {
        int32_t vbus = 0;
        int32_t cbus = 0;
        int32_t vcc1 = 0;
        int32_t vcc2 = 0;
        int32_t ccon = 0;

	meas_vbus(&vbus);
        meas_cbus(&cbus);
        meas_vcc1(&vcc1);
        meas_vcc2(&vcc2);
        meas_ccon(&ccon);

        shell_print(shell, "vbus: %i, cbus: %i, vcc1: %i, vcc2: %i, ccon: %i", vbus, cbus, vcc1, vcc2, ccon);
	return 0;
}

SHELL_CMD_REGISTER(read, NULL, "Reads the current and voltage of the selected line", meas_wrapper);

static int cmd_meas_cc2(const struct shell *shell, size_t argc, char **argv) {
	int32_t out;

	if (argc == 2 && *argv[1] == 'c') {
		meas_ccon(&out);
		shell_print(shell, "current of cc2: %i", out);
	}
	else {
		meas_vcc2(&out);
		shell_print(shell, "voltage of cc2: %i", out);
	}

	return 0;
}

static int cmd_meas_vb(const struct shell *shell, size_t argc, char **argv) {
	int32_t out;

	if (argc == 2 && *argv[1] == 'c') {
		meas_cbus(&out);
		shell_print(shell, "current of vbus: %i", out);
	}
	else {
		meas_vbus(&out);
		shell_print(shell, "voltage of vbus: %i", out);
	}

	return 0;
}

static int cmd_meas_cc1(const struct shell *shell, size_t argc, char **argv) {
	int32_t out;

	meas_vcc1(&out);
	shell_print(shell, "voltage of cc1: %i\n", out);

	return 0;
}

SHELL_STATIC_SUBCMD_SET_CREATE(sub_meas,
        SHELL_CMD(cc1, NULL, "Print cc1 voltage.", cmd_meas_cc1),
        SHELL_CMD(cc2, NULL, "Print cc2 voltage or current.", cmd_meas_cc2),
        SHELL_CMD(vb, NULL, "Print vbus voltage or current.", cmd_meas_vb),
        SHELL_SUBCMD_SET_END
);

SHELL_CMD_REGISTER(meas, &sub_meas, "Reads current and voltage of all lines", NULL);

static int cmd_version(const struct shell *shell, size_t argc, char**argv) {
	ARG_UNUSED(argc);
	ARG_UNUSED(argv);

	shell_print(shell, "Twinkie version 2.0.1");

	return 0;
}

SHELL_CMD_REGISTER(version, NULL, "Show kernel version", cmd_version);

static int cmd_reset(const struct shell *shell, size_t argc, char**argv) {
	reset_sniffer();
	usb_dc_reset();

	return 0;
}

SHELL_CMD_REGISTER(reset, NULL, "Resets the usb", cmd_reset);

static int cmd_snoop(const struct shell *shell, size_t argc, char**argv) {
	if (argc >= 2 && *argv[1] <= '3' && *argv[1] >= '0') {
		view_set_snoop((enum view_snoop_t) (*argv[1] - '0'));
//		set_readline(*argv[1] - '0');
	}

	return 0;
}

SHELL_CMD_REGISTER(snoop, NULL, "Sets the snoop CC line", cmd_snoop);

static int cmd_start(const struct shell *shell, size_t argc, char**argv)
{
	start_snooper(true);
	return 0;
}
SHELL_CMD_REGISTER(start, NULL, "Start snooper", cmd_start);

static int cmd_stop(const struct shell *shell, size_t argc, char**argv)
{
	start_snooper(false);
	return 0;
}
SHELL_CMD_REGISTER(stop, NULL, "Stop snooper", cmd_stop);



static int cmd_role_source(const struct shell *shell, size_t argc, char**argv) {
	uint8_t Rp = *argv[1] - '0';

	set_role(Rp * 2);

	return 0;
}

static int cmd_role_sink(const struct shell *shell, size_t argc, char**argv) {
	uint8_t Rp = *argv[1] - '0';

	set_role(Rp * 2 + 1);

	return 0;
}

SHELL_STATIC_SUBCMD_SET_CREATE(sub_role,
        SHELL_CMD(source, NULL, "Sets role as source", cmd_role_source),
	SHELL_CMD(sink, NULL, "Sets role as sink", cmd_role_sink),
        SHELL_SUBCMD_SET_END
);
SHELL_CMD_REGISTER(role, &sub_role, "Sets role as sink or source", NULL);

static int cmd_rpull(const struct shell *shell, size_t argc, char**argv, void* data) {
	uint8_t pull_mask = (uint32_t) data;

	select_pull_up(pull_mask);

	return 0;
}


SHELL_SUBCMD_DICT_SET_CREATE(rpull_options, cmd_rpull,
        (cc1_rd, 0), (cc1_ru, 2), (cc1_r1, 4), (cc1_r3, 6),
	(cc2_rd, 1), (cc2_ru, 3), (cc2_r1, 5), (cc2_r3, 7)

);

SHELL_CMD_REGISTER(rpull, &rpull_options, "Place pull resistor", cmd_rpull);
```

## src/view.h
```c
#ifndef _VIEW_H_
#define _VIEW_H_

enum view_snoop_t {
	VS_SNOOP0,
	VS_SNOOP1,
	VS_SNOOP2,
	VS_SNOOP3
};

enum view_connection_t {
	VS_NO_CONN,
	VS_CC1_CONN,
	VS_CC2_CONN
};

void view_set_snoop(enum view_snoop_t vs);
void view_set_connection(enum view_connection_t vc);
int get_view_connection();

#endif
```
