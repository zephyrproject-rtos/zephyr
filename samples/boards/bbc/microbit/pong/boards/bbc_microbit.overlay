/ {
	zephyr,user {
		/* period is always set dynamically by the application */
		pwms = <&sw_pwm 0 0 PWM_POLARITY_NORMAL>;
	};
};

&sw_pwm {
	status = "okay";
	channel-gpios = <&edge_connector 0 GPIO_ACTIVE_HIGH>;
};
