/*
 * Copyright (c) 2020 STMicroelectronics
 *
 * SPDX-License-Identifier: Apache-2.0
 */

&spi1 {
	dmas = <&dma1 3 1 0x20440 0x04
		&dma1 2 1 0x20480 0x04>;
	dma-names = "tx", "rx";
};

&dma1 {
	status = "okay";
};

&dma2 {
	status = "okay";
};
