/*
 * Copyright (c) 2024 STMicroelectronics
 *
 * SPDX-License-Identifier: Apache-2.0
 */

/ {
	aliases {
		sw-wkup = &user_button_1;
	};
};

&user_button_1 {
	wakeup-source;
};

&pwr {
	status = "okay";
};
