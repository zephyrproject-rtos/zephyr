## samples/boards/stm32/power_mgmt/blinky/sample.yaml
```yaml
sample:
  name: STM32 GPIO Power Management
tests:
  sample.boards.stm32.power_mgmt.blinky:
    tags: LED power
    harness: console
    harness_config:
      type: one_line
      regex:
        - "Device ready"
    filter: dt_compat_enabled("zephyr,power-state") and
            dt_enabled_alias_with_parent_compat("led0", "gpio-leds") and
            dt_compat_enabled("st,stm32-lptim")
```

## samples/boards/stm32/power_mgmt/serial_wakeup/sample.yaml
```yaml
sample:
  name: STM32 Power Management Serial Wakeup
tests:
  sample.boards.stm32.power_mgmt.serial_wakeup:
    tags:
      - UART
      - Wake
      - up
      - power
    harness: console
    harness_config:
      type: multi_line
      regex:
        - "Device is wakeup capable"
        - "Wakeup source enable ok"
        - "Wakeup source enabled"
    integration_platforms:
      - nucleo_wb55rg
    filter: dt_compat_enabled("zephyr,power-state")
    extra_args: "CONFIG_DEBUG=y"
    platform_allow: nucleo_wb55rg
```

## samples/boards/stm32/power_mgmt/standby_shutdown/sample.yaml
```yaml
sample:
  name: STM32 GPIO Power Management
tests:
  sample.boards.stm32.power_mgmt.standby_shutdown:
    platform_allow: nucleo_l476rg disco_l475_iot1
    tags: LED power
    harness: console
    harness_config:
      type: multi_line
      regex:
        - "Reset cause: Reset pin"
        - "Device ready: .*"
        - "Press and hold the user button:"
        - "when LED2 is OFF to enter to Shutdown Mode"
        - "when LED2 is ON to enter to Standby Mode"
    filter: dt_compat_enabled("zephyr,power-state") and
            dt_enabled_alias_with_parent_compat("led0", "gpio-leds") and
            dt_compat_enabled("st,stm32-lptim")
    extra_args: "CONFIG_DEBUG=y"
```

## samples/boards/stm32/power_mgmt/stm32wb_ble/sample.yaml
```yaml
sample:
  name: Bluetooth shutdown
tests:
  sample.boards.stm32.pm.stm32wb_ble_pm:
    harness: bluetooth
    platform_allow: nucleo_wb55rg
    tags: bluetooth pm
```

## samples/boards/stm32/power_mgmt/wkup_pins/sample.yaml
```yaml
sample:
  name: GPIO As A Wake-up Pin Source
tests:
  sample.boards.stm32.power_mgmt.wkup_pins:
    build_only: true
    filter: dt_enabled_alias_with_parent_compat("wkup-src",
      "gpio-keys") and dt_compat_enabled("st,stm32-pwr")
    platform_allow:
      - nucleo_l4r5zi
      - nucleo_u575zi_q
      - nucleo_u5a5zj_q
      - nucleo_wl55jc
```

## samples/boards/stm32/power_mgmt/wkup_pins_gpio/sample.yaml
```yaml
sample:
  name: STM32 wake-up pins with gpio demo
tests:
  sample.boards.stm32.power_mgmt.wkup_pins_gpio:
    build_only: true
    platform_allow:
      - nucleo_u5a5zj_q
      - nucleo_l4r5zi
      - nucleo_wl55jc
    tags:
      - power
    filter: dt_enabled_alias_with_parent_compat("sw-wkup",
      "gpio-keys") and dt_compat_enabled("st,stm32-pwr")
    extra_args: "CONFIG_DEBUG=y"
```

## samples/boards/stm32/stm32l1_disco/pm_rtc/sample.yaml
```yaml
sample:
  name: Power Management & RTC Timer driver sample for STM32L1_disco
tests:
  sample.boards.stm32.stm32l1_disco.pm_rtc:
    build_only: true
    platform_allow: stm32l1_disco
    tags: power
```

## samples/boards/stm32/stm32l1_disco/rtc_systemclock/sample.yaml
```yaml
sample:
  name: RTC Timer driver Sample for STM32L1_disco
tests:
  sample.boards.stm32.stm32l1_disco.rtc_systemclock:
    build_only: true
    platform_allow: stm32l1_disco
    tags: power
```

## samples/boards/stm32/usbc/sink/sample.yaml
```yaml
sample:
  name: USBC SINK
tests:
  sample.usbc.sink:
    depends_on: tcpc
    tags: usbc
    platform_allow: stm32g081b_eval
    harness: console
    harness_config:
      type: one_line
      regex:
        - "Unattached.SNK"
```

## samples/boards/tdk_robokit1/sample.yaml
```yaml
sample:
  description: TDK RoboKit1 Test App for Sensors
  name: tdk_robokit1

tests:
  sample.boards.tdk_robokit1:
    platform_allow: tdk_robokit1
    tags: rtio sensor
```

## samples/boards/ti/cc13x2_cc26x2/system_off/sample.yaml
```yaml
sample:
  name: Low Power State Sample for TI CC13x2/CC26x2
tests:
  sample.boards.ti.cc13x2_cc26x2.system_off:
    build_only: true
    platform_whitelist: cc1352r1_launchxl
    tags: power
```

## samples/boards/ti/mspm0/timer_capture/sample.yaml
```yaml
sample:
  description: input capture for pwm signal, time and duration
    application
  name: timer capture
```

## samples/boards/tlsr9x/ipc_speed_test/sample.yaml
```yaml
sample:
  name: IPC Speed Test
tests:
  samples.boards.tlsr9x.ipc_speed_test:
    tags: IPS LED gpio
    filter: dt_enabled_alias_with_parent_compat("led0", "gpio-leds")
    depends_on: gpio
    harness: IPC
    integration_platforms:
      - frdm_k64f
```

## samples/boards/tlsr9x/net_wifi_mgmt/Kconfig
```kconfig
# Copyright (c) 2024 Telink Semiconductor
# SPDX-License-Identifier: Apache-2.0

config SAMPLE_CONNECT_PARAM_MANUAL
	bool "Set connection parameters manually"
	help
	  Manual mode requires the user to set connection parameters manually

if SAMPLE_CONNECT_PARAM_MANUAL
config SAMPLE_CONNECT_PARAM_WIFI_SSID
	string "WIFI SSID - Network name"
	default "my_network"
config SAMPLE_CONNECT_PARAM_WIFI_PSK
	string "WIFI PSK - Network password key"
	default "my_passwd"
config SAMPLE_AP_ENABLE_PARAM_CHANNEL
	int "WIFI AP channel"
	default 1
config SAMPLE_AP_ENABLE_PARAM_WIFI_SSID
	string "WIFI AP SSID - Network name"
	default "my_ap_network"
config SAMPLE_AP_ENABLE_PARAM_WIFI_PSK
	string "WIFI AP PSK - Network password key"
	default "my_ap_passwd"
endif

source "Kconfig.zephyr"
```

## samples/boards/tlsr9x/pwm_pool/Kconfig
```kconfig
# Copyright (c) 2024 Telink Semiconductor
# SPDX-License-Identifier: Apache-2.0

config PWM_POOL_APP_STATIC
	bool "Sample of setting static PWM values"
	depends on DT_HAS_TELINK_B9X_PWM_ENABLED

source "Kconfig.zephyr"
```

## samples/boards/tlsr9x/sock_simple/Kconfig
```kconfig
# Copyright (c) 2024 Telink Semiconductor
# SPDX-License-Identifier: Apache-2.0

config SAMPLE_WIFI_SSID
	string "WIFI SSID - Network name"

config SAMPLE_WIFI_PASSWORD
	string "WIFI PSK - Network password"

menu "Application related configuration"

choice APP_SOCKET_TYPE
	prompt "Socket type used for data exchange"
	default APP_SOCKET_UDP

config APP_SOCKET_UDP
	bool "Use UDP IPV4 socket"

config APP_SOCKET_UDP_IPV6
	bool "Use UDP IPV6 socket"

config APP_SOCKET_TCP
	bool "Use TCP IPV4 socket"

config APP_SOCKET_TCP_IPV6
	bool "Use TCP IPV6 socket"

endchoice

endmenu

source "Kconfig.zephyr"
```

## samples/boards/up_squared/gpio_counter/sample.yaml
```yaml
sample:
  description: Example of using GPIOs on UP Squared board
  name: Example of using GPIOs on UP Squared board
tests:
  sample.board.up_squared.gpio_counter:
    platform_allow: up_squared
    tags: gpio
    integration_platforms:
      - up_squared
```

## samples/boards/x86_info/sample.yaml
```yaml
sample:
  description: Tool to illustrate the use of some x86-specific kernel
    interfaces, and also to provide information about x86-based platforms
    (memory map, CPU information, timer frequencies) useful when bringing
    up new boards.
  name: x86 platform information tool
```

## samples/boards/xuantie/hello_world/sample.yaml
```yaml
sample:
  name: xuantie smp hello world

common:
  tags:
    - xuantie
    - smp
  harness: console
  harness_config:
    type: one_line
    regex:
      - "Hello World Sample End"

tests:
  sample.boards.xuantie.smp.hello_world:
    tags:
      - xuantie
      - smp
```

## samples/camera/sample.yaml
```yaml
sample:
  name: Camera Sample
tests:
  test:
    build_only: true
    platform_whitelist: nucleo_l496zg
    tags: camera
```

## samples/cbs/edf/sample.yaml
```yaml
sample:
  description: An Earliest Deadline First with Constant Bandwidth Server CBS sample
  name: EDF with CBS sample
common:
  tags:
    - EDF
    - CBS
tests:
  sample.cbs.edf:
    build_only: true
    platform_allow:
      - qemu_riscv32
      - qemu_cortex_a53
    integration_platforms:
      - qemu_riscv32
    tags:
      - cbs
      - edf
```

## samples/cbs/simple/sample.yaml
```yaml
sample:
  description: A basic Constant Bandwidth Server sample
  name: basic CBS sample
common:
  tags:
    - CBS
tests:
  sample.cbs.simple:
    build_only: true
    platform_allow:
      - qemu_riscv32
      - qemu_cortex_a53
    integration_platforms:
      - qemu_riscv32
    tags: cbs
```

## samples/chipyard/executorch/sample.yaml
```yaml
sample:
  description: A simple example demonstrating XNNPack library
  name: xnnpack 
common:
  tags: introduction
  integration_platforms:
    - spike_riscv64
  harness: console
  harness_config:
    type: one_line
```
