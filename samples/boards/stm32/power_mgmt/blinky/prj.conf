## CMakeLists.txt
```
# SPDX-License-Identifier: Apache-2.0

cmake_minimum_required(VERSION 3.20.0)
find_package(Zephyr REQUIRED HINTS $ENV{ZEPHYR_BASE})
project(stm32_pm_blinky)

target_sources(app PRIVATE src/main.c)
```

## sample.yaml
```
sample:
  name: STM32 GPIO Power Management
tests:
  sample.boards.stm32.power_mgmt.blinky:
    tags:
      - LED
      - power
    harness: console
    harness_config:
      type: one_line
      regex:
        - "Device ready"
    filter: dt_compat_enabled("zephyr,power-state") and
            dt_enabled_alias_with_parent_compat("led0", "gpio-leds") and
            (dt_compat_enabled("st,stm32-lptim") or
            dt_chosen_enabled("zephyr,cortex-m-idle-timer"))
    extra_args: "CONFIG_DEBUG=y"
    integration_platforms:
      - nucleo_wb55rg/stm32wb55xx
      - nucleo_f429zi/stm32f429xx
```

## prj.conf
```kconfig
CONFIG_GPIO=y
CONFIG_PM=y
CONFIG_PM_DEVICE=y
CONFIG_PM_DEVICE_RUNTIME=y
CONFIG_PM_DEVICE_SYSTEM_MANAGED=y
CONFIG_ASSERT=y
```

## boards/nucleo_f103rb.conf
```kconfig
CONFIG_CORTEX_M_SYSTICK_IDLE_TIMER=y
CONFIG_COUNTER=y
```

## boards/nucleo_wba55cg.conf
```kconfig
CONFIG_SYS_CLOCK_TICKS_PER_SEC=2048
```

## boards/nucleo_wb55rg.overlay
```dts
 /*
  * give a prescaler to the lptim clock : LSE / 32 = 1024Hz
  * so that the sleep period is of 64s in the sample application
  * with a LPTIM1 prescaler of <1> to <8>, CONFIG_SYS_CLOCK_TICKS_PER_SEC is 4096
  * with a LPTIM1 prescaler >= <16>, CONFIG_SYS_CLOCK_TICKS_PER_SEC is LSE / prescaler
  */
&stm32_lp_tick_source {
	st,prescaler = <32>;
};
```

## boards/nucleo_wba55cg.overlay
```dts
 /*
  * give a prescaler to the lptim clock : LSE / 32 = 1024Hz
  * so that the sleep period is of 64s in the sample application
  * with a LPTIM1 prescaler of <1> to <8>, CONFIG_SYS_CLOCK_TICKS_PER_SEC is 4096
  * with a LPTIM1 prescaler >= <16>, CONFIG_SYS_CLOCK_TICKS_PER_SEC is LSE / prescaler
  */
&stm32_lp_tick_source {
	st,counter-value = <15>;
	st,prescaler = <8>;
};
```

## boards/stm32h735g_disco.overlay
```dts
&cpu0 {
	cpu-power-states = <&stop_svos5_flps>;
};
```

## src/main.c
```c
/*
 * Copyright (c) 2021 Linaro Limited
 *
 * SPDX-License-Identifier: Apache-2.0
 */

#include <zephyr/kernel.h>
#include <zephyr/device.h>
#include <zephyr/devicetree.h>
#include <zephyr/drivers/gpio.h>
#include <zephyr/sys/printk.h>

/* define SLEEP_TIME_MS higher than <st,counter-value> in ms */
#if DT_PROP(DT_NODELABEL(stm32_lp_tick_source), st_counter_value)
#define SLEEP_TIME_MS   (DT_PROP(DT_NODELABEL(stm32_lp_tick_source), st_counter_value) * 1400)
#else
#define SLEEP_TIME_MS   2000
#endif

static const struct gpio_dt_spec led =
	GPIO_DT_SPEC_GET(DT_ALIAS(led0), gpios);

int main(void)
{
	bool led_is_on = true;

	__ASSERT_NO_MSG(gpio_is_ready_dt(&led));

	printk("Device ready\n");

	while (true) {
		gpio_pin_configure_dt(&led, GPIO_OUTPUT_ACTIVE);
		gpio_pin_set(led.port, led.pin, (int)led_is_on);
		if (led_is_on == false) {
			/* Release resource to release device clock */
			gpio_pin_configure(led.port, led.pin, GPIO_DISCONNECTED);
		}
		k_msleep(SLEEP_TIME_MS);
		if (led_is_on == true) {
			/* Release resource to release device clock */
			gpio_pin_configure(led.port, led.pin, GPIO_DISCONNECTED);
		}
		led_is_on = !led_is_on;
	}
	return 0;
}
```
