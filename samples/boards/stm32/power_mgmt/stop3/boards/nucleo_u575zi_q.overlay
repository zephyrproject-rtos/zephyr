/*
 * SPDX-License-Identifier: Apache-2.0
 *
 * Copyright (c) 2024 STMicroelectronics
 */

/ {
	chosen {
		st,lptim-stdby-timer = &rtc;
	};
};

&cpu0 {
	cpu-power-states = <&stop0 &stop1 &stop2 &stop3>;
};

&rtc {
	status = "okay";
	clocks = <&rcc STM32_CLOCK_BUS_APB3 0x00200000>,
			<&rcc STM32_SRC_LSI RTC_SEL(2)>;
	prescaler = <32768>;
};
