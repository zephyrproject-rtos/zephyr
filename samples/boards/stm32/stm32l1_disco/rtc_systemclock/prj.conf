## CMakeLists.txt
```
# SPDX-License-Identifier: Apache-2.0

cmake_minimum_required(VERSION 3.13.1)
find_package(Zephyr REQUIRED HINTS $ENV{ZEPHYR_BASE})
project(stm32_stm32l1disco_rtc_systemclock)

FILE(GLOB app_sources src/*.c)
target_sources(app PRIVATE ${app_sources})
```

## sample.yaml
```
sample:
  name: RTC Timer driver Sample for STM32L1_disco
tests:
  sample.boards.stm32.stm32l1_disco.rtc_systemclock:
    build_only: true
    platform_allow: stm32l1_disco
    tags: power
```

## prj.conf
```kconfig
#TODO check if select board this way

#overwrite board config
CONFIG_SOC_STM32L151XB=n
CONFIG_SOC_STM32L152XC=y

CONFIG_COUNTER_RTC_STM32=n
#CONFIG_CORTEX_M_SYSTICK=n
CONFIG_SYS_CLOCK_HW_CYCLES_PER_SEC=128
CONFIG_STM32_RTC_TIMER_LSE=y
#CONFIG_STM32_RTC_TIMER_LSE_BYPASS=y

#if want power management, the rtc will be used as kernel system clock
CONFIG_SYS_POWER_MANAGEMENT=y
CONFIG_PM_SLEEP_STATES=y
CONFIG_PM_DEEP_SLEEP_STATES=n
#CONFIG_SYS_PM_MIN_RESIDENCY_SLEEP_1=1


###### DEBUGGING TOOLS ######
#CONFIG_OPENOCD_SUPPORT=y
#CONFIG_DEBUG=y
#CONFIG_ASSERT=y
```

## src/main.c
```c
/*
 * Copyright (c) 2020 Abel Sensors
 *
 * SPDX-License-Identifier: Apache-2.0
 */

#include <zephyr.h>
#include <soc.h>
#include <device.h>

/* size of stack area used by each thread */
#define STACKSIZE 1024

/* scheduling priority used by each thread */
#define PRIORITY 7

void check_rtc_dev(void)
{
	printk("check_rtc_dev init on %u\n", z_timer_cycle_get_32());

		if ( irq_is_enabled(DT_IRQN(DT_NODELABEL(rtc))) ) {
			printk("RTC IRQ enabled\n");
		}
		else{
			printk("RTC IRQ disabled\n");
		}

	printk("check_rtc_dev terminated on %u\n", z_timer_cycle_get_32());

	k_sleep(K_FOREVER);
}


void check_busy_wait(void)
{
	uint32_t busy_wait_msec = 0;
	printk("check_busy_wait init on %u\n", z_timer_cycle_get_32());

	while(1){
		busy_wait_msec = 1*MSEC_PER_SEC;
		printk("check_busy_wait busy_wait for %u msec on %u\n", busy_wait_msec, z_timer_cycle_get_32());
		k_busy_wait(busy_wait_msec*USEC_PER_MSEC);

		printk("check_busy_wait ready on %u\n", z_timer_cycle_get_32());

		busy_wait_msec = 156;
		printk("check_busy_wait busy_wait for %u msec on %u\n", busy_wait_msec, z_timer_cycle_get_32());
		k_busy_wait(busy_wait_msec*USEC_PER_MSEC);

		printk("check_busy_wait ready on %u\n", z_timer_cycle_get_32());
	}

}

void check_sleep(void)
{
	uint32_t sleep_msec = 0;
	printk("check_sleep init on %u\n", z_timer_cycle_get_32());

	while(1){
		sleep_msec = 15500;
		printk("check_sleep sleep for %u msec on %u\n", sleep_msec, z_timer_cycle_get_32());
		k_sleep(K_MSEC(sleep_msec));

		printk("check_sleep awake on %u\n", z_timer_cycle_get_32());

		sleep_msec = 156;
		printk("check_sleep sleep for %u msec on %u\n", sleep_msec, z_timer_cycle_get_32());
		k_sleep(K_MSEC(sleep_msec));

		printk("check_sleep awake on %u\n", z_timer_cycle_get_32());
	}
}

K_THREAD_DEFINE(check_rtc_dev_id, STACKSIZE, check_rtc_dev, NULL, NULL, NULL,
		PRIORITY, 0, 0);

//K_THREAD_DEFINE(check_busy_wait_id, STACKSIZE, check_busy_wait, NULL, NULL, NULL,
//		PRIORITY, 0, 0);

K_THREAD_DEFINE(check_sleep_id, STACKSIZE, check_sleep, NULL, NULL, NULL,
		PRIORITY, 0, 0);
```
