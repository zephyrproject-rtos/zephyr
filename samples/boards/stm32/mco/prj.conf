## sample.yaml
```
sample:
  name: STM32 microcontroller clock output (MCO) example
tests:
  sample.board.stm32.mco:
    platform_allow: nucleo_u5a5zj_q
    tags: board
```

## prj.conf
```kconfig
# Set MCO1 source to desired clock.
CONFIG_CLOCK_STM32_MCO1_SRC_LSE=y
CONFIG_CLOCK_STM32_MCO1_DIV=1
```

## boards/nucleo_u5a5zj_q.overlay
```dts
/* The clock that is output must be enabled. */
&clk_lse {
	status = "okay";
};

/ {
	zephyr,user {
		/* Select MCO pin to use. */
		pinctrl-0 = <&rcc_mco_pa8>;
		pinctrl-names = "default";
	};
};
```

## src/main.c
```c
/*
 * Copyright (c) 2024 Joakim Andersson
 *
 * SPDX-License-Identifier: Apache-2.0
 */

#include <zephyr/kernel.h>
#include <zephyr/drivers/pinctrl.h>

/* Define the pinctrl information for the MCO pin. */
PINCTRL_DT_DEFINE(DT_PATH(zephyr_user));

int main(void)
{
	/* Configure the MCO pin using pinctrl in order to set the alternate function of the pin. */
	const struct pinctrl_dev_config *pcfg = PINCTRL_DT_DEV_CONFIG_GET(DT_PATH(zephyr_user));
	(void)pinctrl_apply_state(pcfg, PINCTRL_STATE_DEFAULT);

	printk("\nMCO pin configured, end of example.\n");
	return 0;
}
```
