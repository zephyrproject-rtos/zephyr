## samples/boards/bbc_microbit/display/sample.yaml
```yaml
sample:
  name: BB micro:bit Display
tests:
  sample.board.bbc_microbit.display:
    platform_allow: bbc_microbit/nrf51822
    tags: display
```

## samples/boards/bbc_microbit/line_follower_robot/sample.yaml
```yaml
sample:
  name: BBC micro:bit Line follower robot
tests:
  sample.board.bbc_microbit.line_follower_robot:
    platform_allow: bbc_microbit/nrf51822
    tags:
      - microbit
      - line-follower
      - robot
      - car
```

## samples/boards/bbc_microbit/pong/sample.yaml
```yaml
sample:
  name: Pong game using BBC Micro:bit
tests:
  sample.board.bbc_microbit.pong:
    platform_allow: bbc_microbit/nrf51822
    tags:
      - microbit
      - mesh
      - bluetooth
```

## samples/boards/bbc_microbit/sound/sample.yaml
```yaml
sample:
  name: BBC micro:bit Sound
tests:
  sample.board.bbc_microbit.sound:
    platform_allow:
      - bbc_microbit/nrf51822
      - bbc_microbit_v2/nrf52833
    tags: sound
```

## samples/boards/cc3220sf_launchxl/simplelink_shell/sample.yaml
```yaml
sample:
  description: 'WLAN Command shell for CC3220SF_LAUNCHXL'
  name: WLAN command shell example
tests:
  test:
    build_only: true
    platform_whitelist: cc3220sf_launchxl
    tags: samples simplelink_shell
```

## samples/boards/cc3220sf_launchxl/wifi_echo/sample.yaml
```yaml
sample:
  description: 'Socket echo sample over CC3220SF WiFi'
  name: WiFi Socket Echo Example
tests:
  test:
    build_only: true
    platform_whitelist: cc3220sf_launchxl
    tags: samples wifi_echo
```

## samples/boards/enjoydigital/litex/i2s/sample.yaml
```yaml
sample:
  description: I2S sample

  name: i2s example
tests:
  sample.drivers.i2s.litex:
    tags: introduction
    harness: console
    platform_allow: litex_vexriscv
    harness_config:
      type: one_line
      regex:
        - "i2s example (.*)"
```

## samples/boards/esp32/deep_sleep/Kconfig
```kconfig
# Copyright (c) 2022 Espressif Systems (Shanghai) Co., Ltd.
# SPDX-License-Identifier: Apache-2.0

mainmenu "Espressif Deep Sleep demo"

config EXAMPLE_EXT1_WAKEUP
	bool "Enable wakeup from GPIO"
	depends on !SOC_ESP32C3
	help
	  This option enables wake up from deep sleep from GPIO2 and
	  GPIO4. They should be connected to LOW to avoid floating pins.
	  When triggering a wake up, connect one or both of the pins to
	  HIGH. Note that floating pins may trigger a wake up.

config EXAMPLE_GPIO_WAKEUP
	bool "Enable wakeup from GPIO"
	depends on SOC_ESP32C3
	help
	  This option enables wake up from GPIO, only GPIO0~5 can be used
	  to wake up. Be aware that when low level is used to trigger wakeup,
	  an external pull-up resistance must be used.

source "Kconfig.zephyr"
```

## samples/boards/esp32/deep_sleep/sample.yaml
```yaml
sample:
  description: Espressif Deep Sleep sample app
  name: ESP Deep Sleep
tests:
  sample.boards.esp32.deep_sleep:
    build_only: true
    tags: pm
    platform_allow:
      - esp32_devkitc_wrover
      - esp32c3_devkitm
      - esp32s2_saola
      - esp32s3_devkitm
```

## samples/boards/esp32/ethernet/sample.yaml
```yaml
sample:
  description: Sample application to test ESP32 Ethernet
  name: ESP32 Ethernet
tests:
  sample.board.esp32.ethernet:
    platform_allow: esp32_ethernet_kit/esp32/procpu
    tags: esp32
    build_only: true
```

## samples/boards/esp32/flash_encryption/sample.yaml
```yaml
sample:
  description: Sample application to test ESP32 flash encryption
  name: flash_encryption
tests:
  sample.board.esp32:
    platform_allow:
      - esp32_devkitc_wroom/esp32/procpu
      - esp32_devkitc_wrover/esp32/procpu
      - yd_esp32/esp32/procpu
    tags: esp32
```

## samples/boards/esp32/flash_memory_mapped/sample.yaml
```yaml
sample:
  description: Sample application to test memory-mapped flash region
  name: flash_memory_mapped
tests:
  sample.board.esp32.flash_memory_mapped:
    platform_allow:
      - esp32_devkitc_wroom/esp32/procpu
      - esp32c3_devkitm
      - esp32s3_devkitm/esp32s3/procpu
    tags: esp32
```

## samples/boards/esp32/ipm/sample.yaml
```yaml
sample:
  name: ESP32 IPM Sample
tests:
  sample.boards.esp32.ipm:
    platform_allow: esp32_devkitc_wroom esp32_devkitc_wrover
    tags:
      - samples
      - ipm
```

## samples/boards/esp32/light_sleep/sample.yaml
```yaml
sample:
  description: Sample application to test ESP32 light-sleep mode
  name: ESP32 Light-sleep
tests:
  sample.board.esp32.light_sleep:
    platform_allow:
    - esp32_devkitc_wroom/esp32/procpu
    - esp32c3_devkitm
    tags: esp32
    build_only: true
```

## samples/boards/esp32/spiram_test/boards/esp32.conf
```kconfig
CONFIG_ESP_HEAP_MEM_POOL_REGION_1_SIZE=100000
CONFIG_ESP_HEAP_SEARCH_ALL_REGIONS=n
```

## samples/boards/esp32/spiram_test/sample.yaml
```yaml
sample:
  description: Application to test memory allocation from SPIRAM
  name: spiram_test
tests:
  sample.board.esp32.spiram:
    platform_allow: esp32_devkitc_wrover/esp32/procpu
    tags: esp32
    harness: console
    harness_config:
      type: multi_line
      regex:
        - "SPIRAM mem test pass"
        - "Internal mem test pass"
```

## samples/boards/esp32/touch/sample.yaml
```yaml
sample:
  name: touch
tests:
  sample.board.esp32.touch:
    platform_allow: xiao_esp32s3/esp32s3/procpu
    tags:
      - esp32
      - touch
      - input
```

## samples/boards/esp32/wifi/ap/Kconfig
```kconfig
# Copyright (c) 2023 Espressif Systems (Shanghai) Co., Ltd.
# SPDX-License-Identifier: Apache-2.0

menu "ESP32_AP_SAMPLE"

config WIFI_SSID
	string "Wi-Fi SSID"
	default "myssid"
	help
		MQTT payload buffer is used for receiving large payload data. This buffer
		is usually used to store data from MQTT_EVT_PUBLISH events.

config WIFI_PSK
	string "Wi-Fi PSK"
	default "mypassword" if	!STA_AUTH_MODE_NONE
	default "" if STA_AUTH_MODE_NONE
	help
		MQTT payload buffer is used for receiving large payload data. This buffer
		is usually used to store data from MQTT_EVT_PUBLISH events.

choice  STA_AUTH_MODE_SELECT
	prompt "Security Option"
	default STA_AUTH_MODE_NONE

config STA_AUTH_MODE_NONE
	bool "Open Security"
	help
	  Enable for Open Security

config STA_AUTH_MODE_WPA2
	bool "WPA2 Security"
	help
	  Enable for WPA2 Security

endchoice

endmenu
source "Kconfig.zephyr"
```

## samples/boards/esp32/wifi/ap/sample.yaml
```yaml
sample:
  description: Espressif Wi-Fi AP sample app
  name: Wi-Fi AP
tests:
  sample.boards.esp32.wifi.ap:
    build_only: true
    tags: wifi
    platform_allow:
      - esp32_devkitc_wrover
      - esp32c3_devkitm
      - esp32s2_saola
      - esp32s3_devkitm
```

## samples/boards/esp32/wifi/sta/Kconfig
```kconfig
# Copyright (c) 2023 Espressif Systems (Shanghai) Co., Ltd.
# SPDX-License-Identifier: Apache-2.0

menu "ESP32_STA_SAMPLE"

config WIFI_SSID
	string "Wi-Fi SSID"
	default "myssid"
	help
		MQTT payload buffer is used for receiving large payload data. This buffer
		is usually used to store data from MQTT_EVT_PUBLISH events.

config WIFI_PSK
	string "Wi-Fi PSK"
	default "mypassword" if	!STA_AUTH_MODE_NONE
	default "" if STA_AUTH_MODE_NONE
	help
		MQTT payload buffer is used for receiving large payload data. This buffer
		is usually used to store data from MQTT_EVT_PUBLISH events.

choice STA_AUTH_MODE_SELECT
	prompt "Security Option"
	default STA_AUTH_MODE_WPA3

config STA_AUTH_MODE_NONE
	bool "Open Security"
	help
	  Enable for Open Security

config STA_AUTH_MODE_WPA2
	bool "WPA2 Security"
	help
	  Enable for WPA2 Security

config STA_AUTH_MODE_WPA3
	bool "WPA3 Security"
	select ESP_WIFI_ENABLE_WPA3_SAE
	help
		Enable for WPA3 Security

endchoice

endmenu
source "Kconfig.zephyr"
```

## samples/boards/esp32/wifi/sta/sample.yaml
```yaml
sample:
  description: Espressif Wi-Fi station sample app
  name: Wi-Fi station
tests:
  sample.boards.esp32.wifi.sta:
    build_only: true
    tags:
      - net
      - wifi
    platform_allow:
      - esp32_devkitc_wrover
      - esp32c3_devkitm
      - esp32s2_saola
      - esp32s3_devkitm
```

## samples/boards/esp32/wifi_station/boards/esp32s2_saola.conf
```kconfig
CONFIG_HEAP_MEM_POOL_SIZE=37760

# when enabling NET_SHELL, the following
# helps to optimize memory footprint
CONFIG_ESP32_WIFI_STATIC_RX_BUFFER_NUM=8
CONFIG_ESP32_WIFI_DYNAMIC_RX_BUFFER_NUM=8
CONFIG_ESP32_WIFI_DYNAMIC_TX_BUFFER_NUM=8
CONFIG_ESP32_WIFI_IRAM_OPT=n
CONFIG_ESP32_WIFI_RX_IRAM_OPT=n
```

## samples/boards/espressif/deep_sleep/Kconfig
```kconfig
# Copyright (c) 2022-2026 Espressif Systems (Shanghai) Co., Ltd.
# SPDX-License-Identifier: Apache-2.0

mainmenu "Espressif Deep Sleep demo"

config EXAMPLE_WAKEUP_TIME_SEC
	int "Wakeup time in seconds"
	default 5
	help
	  This option sets the time in seconds after which the device
	  will wake up from deep sleep. The value must be greater than 0.

source "Kconfig.zephyr"
```
