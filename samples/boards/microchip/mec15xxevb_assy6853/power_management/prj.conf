## CMakeLists.txt
```
# SPDX-License-Identifier: Apache-2.0

cmake_minimum_required(VERSION 3.28.0)
find_package(Zephyr REQUIRED HINTS $ENV{ZEPHYR_BASE})
project(mec15_brd_test)

FILE(GLOB app_sources src/*.c)
target_sources(app PRIVATE ${app_sources})
```

## prj.conf
```kconfig
# Enable config log
CONFIG_LOG=y

# Logging thread frequency higher than SUSPEND_TO_IDLE
CONFIG_LOG_PROCESS_THREAD_SLEEP_MS=2100

CONFIG_THREAD_NAME=y
# Enable test clock out in MEC1501 this will give indication in MCHP_060

# Enable additional drivers to evaluate power consumption without activity
CONFIG_PECI=y

CONFIG_IDLE_STACK_SIZE=512
```

## mec15xxevb_assy6853.overlay
```dts
/*
 * Copyright (c) 2022 Microchip Technology Inc.
 *
 * SPDX-License-Identifier: Apache-2.0
 */

#include <zephyr/dt-bindings/clock/mchp_xec_pcr.h>

/ {};

&pcr {
	pll-32k-src = <MCHP_XEC_PLL_CLK32K_SRC_SIL_OSC>;
	periph-32k-src = <MCHP_XEC_PERIPH_CLK32K_SRC_SO_SO>;

	/* debug only, not using 32KHZ_IN pin */
	pinctrl-0 = <&tst_clk_out_gpio060>;

	pinctrl-names = "default";
	status = "okay";
};
```

## src/main.c
```c
/*
 * Copyright (c) 2020 Intel Corporation
 *
 * SPDX-License-Identifier: Apache-2.0
 */

#define LOG_LEVEL LOG_LEVEL_INF
#include <zephyr/logging/log.h>
LOG_MODULE_DECLARE(mec15_brd_test);
#include "power_mgmt.h"

#define MAX_CYCLES 5ul

int main(void)
{
	test_pwr_mgmt_singlethread(false, MAX_CYCLES);

	test_pwr_mgmt_singlethread(true, MAX_CYCLES);

	test_pwr_mgmt_multithread(false, MAX_CYCLES);

	test_pwr_mgmt_multithread(true, MAX_CYCLES);
	return 0;
}
```
