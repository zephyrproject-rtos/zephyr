/*
 * Copyright (c) 2022 Espressif Systems (Shanghai) Co., Ltd.
 *
 * SPDX-License-Identifier: Apache-2.0
 */

&flash0 {
	write-block-size = <32>;
};

/{
	chosen {
		zephyr,code-partition = &slot0_partition;
	};
};
