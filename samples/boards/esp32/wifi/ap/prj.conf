## CMakeLists.txt
```
# SPDX-License-Identifier: Apache-2.0

cmake_minimum_required(VERSION 3.20.0)
find_package(Zephyr REQUIRED HINTS $ENV{ZEPHYR_BASE})
project(esp_wifi_ap)

target_sources(app PRIVATE src/main.c)
zephyr_include_directories(. ${ZEPHYR_BASE}/subsys/net/ip)
```

## Kconfig
```
# Copyright (c) 2023 Espressif Systems (Shanghai) Co., Ltd.
# SPDX-License-Identifier: Apache-2.0

menu "ESP32_AP_SAMPLE"

config WIFI_SSID
	string "Wi-Fi SSID"
	default "myssid"
	help
		MQTT payload buffer is used for receiving large payload data. This buffer
		is usually used to store data from MQTT_EVT_PUBLISH events.

config WIFI_PSK
	string "Wi-Fi PSK"
	default "mypassword" if	!STA_AUTH_MODE_NONE
	default "" if STA_AUTH_MODE_NONE
	help
		MQTT payload buffer is used for receiving large payload data. This buffer
		is usually used to store data from MQTT_EVT_PUBLISH events.

choice  STA_AUTH_MODE_SELECT
	prompt "Security Option"
	default STA_AUTH_MODE_NONE

config STA_AUTH_MODE_NONE
	bool "Open Security"
	help
	  Enable for Open Security

config STA_AUTH_MODE_WPA2
	bool "WPA2 Security"
	help
	  Enable for WPA2 Security

endchoice

endmenu
source "Kconfig.zephyr"
```

## sample.yaml
```
sample:
  description: Espressif Wi-Fi AP sample app
  name: Wi-Fi AP
tests:
  sample.boards.esp32.wifi.ap:
    build_only: true
    tags: wifi
    platform_allow:
      - esp32_devkitc_wrover
      - esp32c3_devkitm
      - esp32s2_saola
      - esp32s3_devkitm
```

## prj.conf
```kconfig
CONFIG_NETWORKING=y
CONFIG_WIFI=y
CONFIG_TEST_RANDOM_GENERATOR=y
CONFIG_NET_PKT_RX_COUNT=5
CONFIG_NET_PKT_TX_COUNT=5
CONFIG_NET_BUF_RX_COUNT=10
CONFIG_NET_BUF_TX_COUNT=10
CONFIG_NET_MAX_CONTEXTS=5
CONFIG_NET_DHCPV4=y
CONFIG_DNS_RESOLVER=y
CONFIG_NET_IPV4=y
CONFIG_NET_IPV6=n
CONFIG_NET_TCP=y
CONFIG_INIT_STACKS=y
CONFIG_NET_L2_ETHERNET=y
CONFIG_ESP32_WIFI_IRAM_OPT=y
CONFIG_ESP32_WIFI_RX_IRAM_OPT=y
CONFIG_LOG=y
```

## src/main.c
```c
/*
 * Copyright (c) 2023 Espressif Systems (Shanghai) Co., Ltd.
 * SPDX-License-Identifier: Apache-2.0
 */

#include <zephyr/kernel.h>
#include <zephyr/device.h>
#include <zephyr/devicetree.h>
#include <zephyr/net/wifi_mgmt.h>
#include <zephyr/net/net_if.h>
#include <zephyr/net/dhcpv4.h>

#include <zephyr/logging/log.h>
LOG_MODULE_REGISTER(esp_wifi_ap, CONFIG_LOG_DEFAULT_LEVEL);

#include "net_private.h"

struct wifi_data {
	struct net_mgmt_event_callback wifi_mgmt_cb;
};

static struct wifi_data wifi_ctx;
static uint8_t wifi_ssid[] = CONFIG_WIFI_SSID;
static size_t wifi_ssid_len = sizeof(CONFIG_WIFI_SSID) - 1;
static uint8_t wifi_psk[] = CONFIG_WIFI_PSK;
static size_t wifi_psk_len = sizeof(CONFIG_WIFI_PSK) - 1;

static void wifi_mgmt_event_handler(struct net_mgmt_event_callback *cb, uint32_t mgmt_event,
				    struct net_if *iface)
{
	struct wifi_data *wifi_cb = CONTAINER_OF(cb, struct wifi_data, wifi_mgmt_cb);
	const struct wifi_status *status = cb->info;

	switch (mgmt_event) {
	case NET_EVENT_WIFI_CONNECT_RESULT:
		LOG_INF("Station connected");
		break;
	case NET_EVENT_WIFI_DISCONNECT_RESULT:
		LOG_INF("Station disconnected");
		break;
	default:
		break;
	}
}

void wifi_init_ap(void)
{
	struct net_if *iface = net_if_get_default();
	int err;

	net_mgmt_init_event_callback(
		&wifi_ctx.wifi_mgmt_cb, wifi_mgmt_event_handler,
		(NET_EVENT_WIFI_CONNECT_RESULT | NET_EVENT_WIFI_DISCONNECT_RESULT));
	net_mgmt_add_event_callback(&wifi_ctx.wifi_mgmt_cb);

	struct wifi_connect_req_params params = {
		.ssid = wifi_ssid,
		.ssid_length = wifi_ssid_len,
		.channel = WIFI_CHANNEL_ANY,
#if defined(CONFIG_STA_AUTH_MODE_WPA2)
		.psk = wifi_psk,
		.psk_length = wifi_psk_len,
		.security = WIFI_SECURITY_TYPE_PSK,
#else
		.security = WIFI_SECURITY_TYPE_NONE,
#endif
	};

	LOG_INF("Enabling Wi-Fi AP %s with auth mode: %s", params.ssid,
		wifi_security_txt(params.security));

	err = net_mgmt(NET_REQUEST_WIFI_AP_ENABLE, iface, &params, sizeof(params));
	if (err) {
		LOG_ERR("AP mode enable failed: %s\n", strerror(-err));
		return;
	}
}

int main(void)
{
	wifi_init_ap();

	return 0;
}
```
