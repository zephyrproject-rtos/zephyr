## CMakeLists.txt
```
# SPDX-License-Identifier: Apache-2.0

cmake_minimum_required(VERSION 3.20.0)

find_package(Zephyr REQUIRED HINTS $ENV{ZEPHYR_BASE})
project(spiram_test)

target_sources(app PRIVATE src/main.c)
```

## sample.yaml
```
sample:
  description: Application to test memory allocation from SPIRAM
  name: spiram_test
tests:
  sample.board.esp32.spiram:
    platform_allow: esp32_devkitc_wrover/esp32/procpu
    tags: esp32
    harness: console
    harness_config:
      type: multi_line
      regex:
        - "SPIRAM mem test pass"
        - "Internal mem test pass"
```

## prj.conf
```kconfig
CONFIG_ESP_SPIRAM=y
CONFIG_ESP_HEAP_MIN_EXTRAM_THRESHOLD=2048
CONFIG_HEAP_MEM_POOL_SIZE=98304
CONFIG_ESP_HEAP_SEARCH_ALL_REGIONS=n
```

## boards/esp32.conf
```kconfig
CONFIG_ESP_HEAP_MEM_POOL_REGION_1_SIZE=100000
CONFIG_ESP_HEAP_SEARCH_ALL_REGIONS=n
```

## src/main.c
```c
/*
 * Copyright (c) 2021 Espressif Systems (Shanghai) Co., Ltd.
 *
 * SPDX-License-Identifier: Apache-2.0
 */

#include <zephyr/kernel.h>
#include <zephyr/sys/printk.h>
#include <soc/soc_memory_layout.h>
#include <zephyr/multi_heap/shared_multi_heap.h>

int main(void)
{
	int *m_ext, *m_int;

	m_ext = shared_multi_heap_aligned_alloc(SMH_REG_ATTR_EXTERNAL, 32, 4096);

	if (!esp_ptr_external_ram(m_ext)) {
		printk("SPIRAM mem test failed\n");
	} else {
		printk("SPIRAM mem test pass\n");
	}

	shared_multi_heap_free(m_ext);

	m_int = k_malloc(4096);
	if (!esp_ptr_internal(m_int)) {
		printk("Internal mem test failed\n");
	} else {
		printk("Internal mem test pass\n");
	}

	k_free(m_int);

	return 0;
}
```
