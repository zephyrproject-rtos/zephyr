## samples/boards/nxp/s32/netc/Kconfig
```kconfig
# Private config options for NXP S32 NETC sample app

# Copyright 2022 NXP
# SPDX-License-Identifier: Apache-2.0

mainmenu "NXP S32 NETC sample application"

config NET_SAMPLE_IFACE2_MY_IPV6_ADDR
	string "My IPv6 address for second interface"
	help
	  The value depends on your network setup.

config NET_SAMPLE_IFACE2_MY_IPV4_ADDR
	string "My IPv4 address for second interface"
	help
	  The value depends on your network setup.

config NET_SAMPLE_IFACE2_MY_IPV4_NETMASK
	string "My IPv4 netmask for second interface"
	default "255.255.255.0"
	help
	  Static netmask to use.

source "Kconfig.zephyr"
```

## samples/boards/nxp/s32/psi5/sample.yaml
```yaml
sample:
  description: Sample for using PSI5 driver
  name: NXP S32 PSI5 sample

tests:
  sample.boards.nxp_s32.psi5:
    platform_allow:
      - s32z2xxdc2/s32z270/rtu0
      - s32z2xxdc2/s32z270/rtu1
      - s32z2xxdc2@D/s32z270/rtu0
      - s32z2xxdc2@D/s32z270/rtu1
    depends_on: psi5
    tags: psi5
    harness: console
```

## samples/boards/nxp/s32/sent/sample.yaml
```yaml
sample:
  description: Sample for using SENT driver
  name: NXP S32 SENT sample

tests:
  sample.boards.nxp_s32.sent:
    platform_allow:
      - s32z2xxdc2/s32z270/rtu0
      - s32z2xxdc2/s32z270/rtu1
      - s32z2xxdc2@D/s32z270/rtu0
      - s32z2xxdc2@D/s32z270/rtu1
    depends_on: sent
    tags: sent
    harness: console
```

## samples/boards/nxp/slcd/sample.yaml
```yaml
sample:
  description: SLCD (Segment LCD) 4-digit demo
  name: NXP SLCD
common:
  tags:
    - pytest
    - auxdisplay
    - slcd
tests:
  sample.boards.nxp.slcd:
    depends_on:
      - auxdisplay
      - slcd
    filter: CONFIG_AUXDISPLAY_MCUX_SLCD and dt_compat_enabled("nxp,slcd")
    integration_platforms:
      - frdm_mcxc444
      - frdm_mcxa266
    harness: pytest
```

## samples/boards/nxp_s32/i3c_at24c01_eeprom/dts/bindings/atmel,at24-i3c.yaml
```yaml
# Copyright 2022 NXP
# SPDX-License-Identifier: Apache-2.0

description: Atmel AT24 (or compatible) I2C EEPROM on I3C bus

compatible: "atmel,at24-i3c"

include: [i3c-device.yaml]
```

## samples/boards/nxp_s32/i3c_at24c01_eeprom/sample.yaml
```yaml
# Copyright 2022 NXP
# SPDX-License-Identifier: Apache-2.0

sample:
  name: Sample for communitcate Microchip AT24C01C-XHM EEPROM through I3C driver.
tests:
  sample.boards.nxp_s32.i3c.at24c01c.eeprom:
    tags: i3c
    platform_allow: s32z270dc2_rtu0_r52 s32z270dc2_rtu1_r52
    harness: console
    harness_config:
        type: one_line
        regex:
            - "EEPROM read/write successful"
```

## samples/boards/olimex_stm32_e407/ccm/sample.yaml
```yaml
sample:
  name: CCM usages example on Olimex STM32-E407
tests:
  sample.board.olimex_stm32_e407.ccm:
    platform_allow: olimex_stm32_e407
    tags: board
```

## samples/boards/openhwgroup/sim_fail/sample.yaml
```yaml
# Copyright 2024 CISPA Helmholtz Center for Information Security gGmbH
# SPDX-License-Identifier: Apache-2.0
sample:
  description: Test failure sample adapted for CVA6 testbench
  name: Test failure test
common:
  tags: introduction
  integration_platforms:
    - native_sim
  harness: console
  harness_config:
    type: one_line
    regex:
      - "Test Failure (.*)"
tests:
  sample.basic.helloworld:
    tags: introduction
```

## samples/boards/openhwgroup/sim_hello_world/sample.yaml
```yaml
# Copyright 2024 CISPA Helmholtz Center for Information Security gGmbH
# SPDX-License-Identifier: Apache-2.0
sample:
  description: Hello World sample adapted for CVA6 testbench
  name: hello world test
common:
  tags: introduction
  integration_platforms:
    - native_sim
  harness: console
  harness_config:
    type: one_line
    regex:
      - "Hello World! (.*)"
tests:
  sample.basic.helloworld:
    tags: introduction
```

## samples/boards/panther/mqtt_over_wifi/ap/sample.yaml
```yaml
sample:
    description: Panther board demo with MQTT and Wifi
    name: Panther Board Demo
tests:
-   test:
        build_only: true
        platform_whitelist: panther
        tags: samples
```

## samples/boards/panther/mqtt_over_wifi/sensor/sample.yaml
```yaml
sample:
  description: Panther Board Demo over Wifi
  name: Panther Board Demo (Sensor Subsystem)
tests:
-   test:
        build_only: true
        platform_whitelist: panther_ss
        tags: samples
```

## samples/boards/phytec/reel_board/mesh_badge/sample.yaml
```yaml
sample:
  description: reel board mesh badge sample
  name: mesh badge
tests:
  sample.board.reel_board.mesh_badge:
    platform_allow: reel_board
    tags:
      - samples
      - sensor
    harness: sensor
```

## samples/boards/pine64_pinetime/sample.yaml
```yaml
sample:
  name: Pine64 PineTime board testing
tests:
  sample.board.pinetime_devkit0:
    platform_allow: pinetime_devkit0
    tags: samples board
```

## samples/boards/qemu_cortex_a53/reserved_memory/dts/bindings/sample_driver.yaml
```yaml
description: Sample Driver

compatible: "sample_driver"

include:
  - name: base.yaml
    property-allowlist: ['reg', 'label']

properties:
    memory-region:
      type: phandle
      required: false
      description: phandle to the reserved memory child node
```

## samples/boards/qemu_cortex_a53/reserved_memory/sample.yaml
```yaml
sample:
  description: Reserved memory sample application
  name: reserved memory
tests:
  sample.board.qemu_cortex_a53.reserved_memory:
    platform_allow: qemu_cortex_a53
    tags: sample board reserved_memory
    build_only: true
```

## samples/boards/quark_se_c1000/power_mgr/sample.yaml
```yaml
sample:
  name: Power management demo
tests:
  test:
    filter: (CONFIG_SOC_QUARK_SE_C1000 or CONFIG_SOC_QUARK_SE_C1000_SS)
    tags: power
    depends_on: rtc
```

## samples/boards/raspberrypi/rpi_board_info/sample.yaml
```yaml
sample:
  name: Raspberry Pi Board Info
  description: |
    Retrieves Raspberry Pi board information using the VideoCore
    firmware interface and prints details such as board type,
    processor, memory size, and manufacturer.

tests:
  sample.boards.raspberrypi.rpi_board_info:
    tags:
      - rpi
      - firmware
    platform_allow:
      - rpi_4b
    skip: true
```

## samples/boards/raspberrypi/rpi_pico/shell_bootloader/sample.yaml
```yaml
# Copyright (c) 2026 Vincent Jardin <vjardin@free.fr>, Free Mobile
# SPDX-License-Identifier: Apache-2.0

sample:
  name: Shell Bootloader
  description: |
    Shell sample with USB BOOTSEL reboot support for RP2040/RP2350.
    Provides a "reboot bootloader" shell command and a 1200-baud USB
    trigger to enter BOOTSEL mode without pressing the physical button.
tests:
  sample.boards.raspberrypi.rpi_pico.shell_bootloader:
    tags:
      - shell
      - usb
    platform_allow:
      - rpi_pico
      - rpi_pico2/rp2350a/m33
    build_only: true
    required_snippets:
      - cdc-acm-console
```

## samples/boards/reel_board/demo/sample.yaml
```yaml
sample:
  description: reel Board sample
  name: reel Board sample
tests:
  test:
    platform_whitelist: reel_board
    tags: samples sensor
    harness: sensor
```

## samples/boards/reel_board/env_logger/sample.yaml
```yaml
sample:
  name: Environmental Logger
tests:
  sample.bluetooth.peripheral:
    harness: bluetooth
    platform_whitelist: reel_board
    tags: bluetooth
```

## samples/boards/reel_board/mesh_badge/sample.yaml
```yaml
sample:
  description: reel board mesh badge sample
  name: mesh badge
tests:
  sample.board.reel_board.mesh_badge:
    platform_allow: reel_board/nrf52840
    tags:
      - samples
      - sensor
    harness: sensor
```

## samples/boards/renesas/comparator/Kconfig
```kconfig
# Copyright (c) 2025 Renesas Electronics Corporation
# SPDX-License-Identifier: Apache-2.0

mainmenu "Comparator sample additional options"

source "Kconfig.zephyr"

ZEPHYR_USER := zephyr,user

config DAC_REFERENCE_SOURCE
	bool
	select DAC
	default y if $(dt_node_has_prop,/$(ZEPHYR_USER),vref-dac)
```

## samples/boards/renesas/comparator/sample.yaml
```yaml
sample:
  name: Comparator
tests:
  sample.boards.renesas.comparator:
    build_only: true
    platform_allow:
      - ek_ra8m1
      - ek_ra8d1
      - fpb_ra8e1
    tags: comparator
```

## samples/boards/renesas/elc/sample.yaml
```yaml
sample:
  name: renesas_elc
tests:
  sample.boards.renesas.elc:
    tags: renesas_elc
    filter: dt_node_enabled("renesas,ra-elc")
    harness: console
    harness_config:
      type: multi_line
      ordered: true
      regex:
        - "PWM generator configured: period=[0-9]+ ns, pulse=[0-9]+ ns"
        - "PWM captured: period=[0-9]+ ns"
        - "Generate ELC software event to stop PWM generator."
        - "PWM generator stopped by the ELC link as expected."
        - "Generate ELC software event to start PWM generator."
        - "PWM captured: period=[0-9]+ ns"
        - "PWM generator started by the ELC link as expected."
```

## samples/boards/renesas/lvd/sample.yaml
```yaml
sample:
  name: Low Voltage Detector (LVD)
tests:
  sample.boards.renesas.lvd:
    build_only: true
    platform_allow:
      - rsk_rx130@512kb
    tags: lvd
```
