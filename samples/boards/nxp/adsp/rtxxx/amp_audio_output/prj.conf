## CMakeLists.txt
```
# Copyright 2025 NXP
# SPDX-License-Identifier: Apache-2.0

cmake_minimum_required(VERSION 3.28.0)

find_package(Zephyr HINTS $ENV{ZEPHYR_BASE})

project(amp_audio_output)
target_sources(app PRIVATE src/main.c)

include("${CMAKE_CURRENT_LIST_DIR}/../common/dsp-load.cmake")
```

## sample.yaml
```
sample:
  name: i.MX RTxxx AMP audio output sample
  description:
    Audio output application using the i.MX RTxxx devices as AMP systems.
common:
  sysbuild: true
  min_ram: 1024
  min_flash: 1024
  platform_allow:
    - mimxrt685_evk/mimxrt685s/cm33
    - mimxrt700_evk/mimxrt798s/cm33_cpu0
  harness: console
  harness_config:
    type: one_line
    regex:
      - "Hello World! (.*)"
tests:
  sample.nxp.adsp.amp_audio_output:
    tags: tests
```

## prj.conf
```kconfig
CONFIG_NXP_RTXXX_DSP_CTRL=y
```

## boards/mimxrt685_evk_mimxrt685s_cm33.overlay
```dts
/*
 * Copyright 2025 NXP
 *
 * SPDX-License-Identifier: Apache-2.0
 */

#include <nxp/imxrt/imxrt6xx/nxp_rt6xx_hifi4memsplit.dtsi>

&dsp {
	status = "okay";
};
```

## boards/mimxrt700_evk_mimxrt798s_cm33_cpu0.overlay
```dts
/*
 * Copyright 2025 NXP
 *
 * SPDX-License-Identifier: Apache-2.0
 */

&flexcomm2 {
	status = "disabled";
};

&flexcomm2_lpi2c2 {
	status = "disabled";
};

&gpio0 {
	status = "disabled";
};
```

## src/main.c
```c
/*
 * Copyright 2025 NXP
 *
 * SPDX-License-Identifier: Apache-2.0
 */

#include <zephyr/kernel.h>

#include <dsp.h>

int main(void)
{
	printk("Hello World! %s\n", CONFIG_BOARD_TARGET);

	printk("[ARM] Starting DSP...\n");
	dsp_start();

	return 0;
}
```
