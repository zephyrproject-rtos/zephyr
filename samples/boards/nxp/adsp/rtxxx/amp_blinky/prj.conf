## CMakeLists.txt
```
# Copyright 2025 - 2026 NXP
# SPDX-License-Identifier: Apache-2.0

cmake_minimum_required(VERSION 3.28.0)

find_package(Zephyr HINTS $ENV{ZEPHYR_BASE})

project(amp_blinky)
target_sources(app PRIVATE src/main.c)

if(CONFIG_BOARD_MIMXRT700_EVK_MIMXRT798S_CM33_CPU0)
  message(FATAL_ERROR "This example is not supported on the selected board.")
endif()
```

## sample.yaml
```
sample:
  name: i.MX RTxxx AMP blinky sample
  description:
    LED blinking application using the i.MX RTxxx devices as AMP systems.
common:
  sysbuild: true
  min_ram: 1024
  min_flash: 1024
  platform_allow:
    - mimxrt685_evk/mimxrt685s/cm33
    - mimxrt700_evk/mimxrt798s/cm33_cpu0
  harness: console
  harness_config:
    type: one_line
    regex:
      - "Hello World! (.*)"
tests:
  sample.nxp.adsp.amp_blinky:
    tags: tests
```

## sysbuild.conf
```
# Copyright 2025 - 2026 NXP
# SPDX-License-Identifier: Apache-2.0

SB_CONFIG_NXP_IMXRT_BUILD_AMP_DSP=y
```

## prj.conf
```kconfig
CONFIG_NXP_RTXXX_ADSP_CTRL=y
```

## src/main.c
```c
/*
 * Copyright 2025 NXP
 *
 * SPDX-License-Identifier: Apache-2.0
 */

#include <zephyr/kernel.h>

#include "dsp.h"

int main(void)
{
	printk("Hello World! %s\n", CONFIG_BOARD_TARGET);

	printk("[ARM] Starting DSP...\n");
	dsp_start();

	return 0;
}
```
