/*
 * Copyright 2025 NXP
 *
 * SPDX-License-Identifier: Apache-2.0
 */

#include <zephyr/dt-bindings/memory-attr/memory-attr-arm.h>

/ {
	chosen {
		zephyr,ipc_shm = &sram_shared_mem_m33;
		zephyr,ipc = &mailbox_b;
	};

	mailbox_b: ipm-mbox {
		compatible = "zephyr,mbox-ipm";
		mboxes = <&mbox1_b 0>, <&mbox1_b 1>;
		mbox-names = "tx", "rx";
	};

	/* Define memory regions */
	sram_shared_mem_m33: memory@20580000 {
		compatible = "zephyr,memory-region", "mmio-sram";
		reg = <0x20580000 DT_SIZE_K(16)>;
		zephyr,memory-region = "SRAM_SHARED_M33";
		zephyr,memory-attr = <DT_MEM_ARM(ATTR_MPU_IO)>;
	};
};
