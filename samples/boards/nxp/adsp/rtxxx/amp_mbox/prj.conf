## CMakeLists.txt
```
# Copyright 2025 - 2026 NXP
# SPDX-License-Identifier: Apache-2.0

cmake_minimum_required(VERSION 3.28.0)

find_package(Zephyr HINTS $ENV{ZEPHYR_BASE})

project(amp_mbox)
target_sources(app PRIVATE src/main.c)
```

## sample.yaml
```
sample:
  name: i.MX RTxxx AMP mbox saple
  description:
    Mailbox communication sample using the i.MX RTxxx devices as AMP systems.
common:
  sysbuild: true
  min_ram: 1024
  min_flash: 1024
  platform_allow:
    - mimxrt685_evk/mimxrt685s/cm33
  harness: console
  harness_config:
    type: one_line
    regex:
      - "Hello World! (.*)"
tests:
  sample.nxp.adsp.amp_mbox:
    tags: tests
```

## prj.conf
```kconfig
CONFIG_NXP_RTXXX_DSP_CTRL=y
CONFIG_MBOX=y
```

## boards/mimxrt685_evk_mimxrt685s_cm33.conf
```kconfig
CONFIG_INIT_AUDIO_PLL=y
CONFIG_INIT_SYS_PLL=y
```

## app.overlay
```dts
&adsp {
    status = "okay";
};
```

## boards/mimxrt685_evk_mimxrt685s_cm33.overlay
```dts
/*
 * Copyright 2025 NXP
 *
 * SPDX-License-Identifier: Apache-2.0
 */

#include <nxp/nxp_rt6xx_hifi4memsplit.dtsi>

&adsp {
    status = "okay";
};
```

## boards/mimxrt700_evk_mimxrt798s_cm33_cpu0.overlay
```dts
/*
 * Copyright 2025 NXP
 *
 * SPDX-License-Identifier: Apache-2.0
 */

/ {
	aliases {
		mbox = &mbox4_a;
	};
};
```

## src/main.c
```c
/*
 * Copyright 2025 NXP
 *
 * SPDX-License-Identifier: Apache-2.0
 */

#include <zephyr/kernel.h>
#include <zephyr/drivers/mbox.h>

#include <dsp.h>

static const struct device *mbox = DEVICE_DT_GET(DT_ALIAS(mbox));
static mbox_channel_id_t mbox_ch;

static uint32_t mbox_data = 0x12345678;

int main(void)
{
	printk("Hello World! %s\n", CONFIG_BOARD_TARGET);

	if (!device_is_ready(mbox)) {
		return 0;
	}
	mbox_set_enabled(mbox, mbox_ch, true);

	printk("[ARM] Starting DSP...\n");
	dsp_start();
	k_msleep(1000);

	struct mbox_msg msg = {.data = &mbox_data, .size = sizeof(mbox_data)};

	printk("[ARM] Sending mbox message...\n");
	if (mbox_send(mbox, mbox_ch, &msg) < 0) {
		printk("[ARM] mbox send failed!\n");
	}

	k_msleep(1000);
	printk("[ARM] Sending mbox IPI...\n");
	if (mbox_send(mbox, mbox_ch, NULL) < 0) {
		printk("[ARM] mbox IPI failed!\n");
	}

	return 0;
}
```
