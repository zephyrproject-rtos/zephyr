## CMakeLists.txt
```
# SPDX-License-Identifier: Apache-2.0

cmake_minimum_required(VERSION 3.28.0)
find_package(Zephyr REQUIRED HINTS $ENV{ZEPHYR_BASE})
project(number_crunching)

# defines targets and sources
target_sources(app PRIVATE
  src/main.c
  src/math_ops.c
)
zephyr_include_directories(include)

if(DEFINED ENV{LIB_LOCATION})
  message(STATUS "LIB_LOCATION environment variable defined")

  # contains a "proprietary" library we will link to
  # this should set the INCLUDE_DIR, LIB_DIR and LIB_NAME variables
  add_subdirectory($ENV{LIB_LOCATION} ${CMAKE_CURRENT_BINARY_DIR}/proprietary)

  # this is an example for NatureDSP backend
  target_sources(app PRIVATE
    src/nature_dsp_wrapper.c
  )

  if(INCLUDE_DIR)
    zephyr_include_directories($ENV{LIB_LOCATION}/${INCLUDE_DIR})
  endif()

  if(LIB_DIR AND LIB_NAME)
    zephyr_link_libraries($ENV{LIB_LOCATION}/${LIB_DIR}/${LIB_NAME})
  endif()
else()
  message(STATUS "LIB_LOCATION environment variable NOT defined")
  # this is an example for CMSIS-DSP backend
  target_sources(app PRIVATE
    src/cmsis_dsp_wrapper.c
  )
endif()
```

## sample.yaml
```
sample:
  description: An application that demonstrates
    how to integrate a proprietary library which
    executes math functions on target.
  name: Proprietary Library
tests:
  sample.app_dev.number_crunching:
    platform_allow:
      - native_sim
      - imx8mp_evk/mimx8ml8/adsp
    integration_platforms:
      - native_sim
      - imx8mp_evk/mimx8ml8/adsp
    tags: external
    harness: console
    harness_config:
      type: multi_line
      regex:
        - "Number crunching example!"
        - "[Library Test]"
```

## prj.conf
```kconfig
CONFIG_STDOUT_CONSOLE=y
CONFIG_REQUIRES_FLOAT_PRINTF=y
CONFIG_MAIN_STACK_SIZE=3072

#for CMSIS-DSP
CONFIG_REQUIRES_FULL_LIBC=y

CONFIG_CMSIS_DSP=y

# for FFT
# for arm_power
```

## src/main.c
```c
/*
 * Copyright 2024 NXP
 *
 * SPDX-License-Identifier: Apache-2.0
 */

/**
 * Number crunching sample:
 * calling functions from an out of tree static library
 */

#include <zephyr/kernel.h>
#include <stdio.h>

#include <math_ops.h>

int main(void)
{
	printk("\r\nNumber crunching example!\r\n\n");

	test_vec_sum_int16_op();

	test_power_int16_op();

	test_power_int32_op();

	test_fft_op();

	test_iir_op();

	test_fir_blms_op();

	return 0;
}
```

## include/math_ops.h
```c
/*
 * Copyright 2024 NXP
 *
 * SPDX-License-Identifier: Apache-2.0
 */

#include <zephyr/kernel.h>

/* test vector sum on int16_t elements */
void test_vec_sum_int16_op(void);
/**
 * @brief Vector Sum - makes pair wise saturated summation of vectors
 *
 * @param[in]		*input1 - points to the first input vector
 * @param[in]		*input2 - points to the second input vector
 * @param[out]		*output - points to the output vector
 * @param[in]		length - number of samples in each vector
 *
 * @return none
 */
void vec_sum_int16(const int16_t *input1, const int16_t *input2,
		   int16_t *output, uint32_t length);

/* test sum of the squares of the int16_t vector elements */
void test_power_int16_op(void);
/**
 * @brief Power of a Vector - makes sum of the squares of the elements of
 *			      an int16_t vector
 *
 * @param[in]		*input - points to the input vector
 * @param[in]		length - size of the input vector
 * @param[in]		rsh - right shift of result
 * @param[out]		*output - sum of the squares value
 *
 * @return none
 *
 * @details
 * For NatureDSP, rsh is in range 0...31 and output may scaled down with
 * saturation by rsh bits.
 *
 * For CMSIS-DSP, intermediate multiplication yields a 2.30 format,
 * and this result is added without saturation to a 64-bit accumulator
 * in 34.30 format.
 *
 * Therefore, for some cases, rsh is not used, it can be ignored.
 */
void vec_power_int16(const int16_t *input, int64_t *output, int rsh, uint32_t length);

/* test sum of the squares of the int32_t vector elements */
void test_power_int32_op(void);
/**
 * @brief Power of a Vector - makes sum of the squares of the elements of
 *			      an int32_t vector
 *
 * @param[in]		*input - points to the input vector
 * @param[in]		length - size of the input vector
 * @param[in]		rsh - right shift of result
 * @param[out]		*output - sum of the squares value
 *
 * @return none
 *
 * @details
 * For NatureDSP, rsh is in range 31...62 and output may scaled down with
 * saturation by rsh bits.
 *
 * For CMSIS-DSP, intermediate multiplication yields a 2.62 format,
 * and this result is truncated to 2.48 format by discarding the lower 14 bits.
 * The 2.48 result is then added without saturation to a 64-bit accumulator
 * in 16.48 format.
 *
 * Therefore, for some cases, rsh is not used, it can be ignored.
 */
void vec_power_int32(const int32_t *input, int64_t *output, int rsh, uint32_t length);

/* test Fast Fourier Transform (FFT) */
void test_fft_op(void);
/**
 * @brief Fast Fourier Transform on Real Data - make FFT on real data
 *
 * @param[in]		*input - points to the input buffer
 * @param[in]		length - length of the FFT
 * @param[out]		*output - points to the output buffer
 *
 * @return none
 */
void fft_real32(int32_t *input, int32_t *output, int length);

/* test Bi-quad Real Block Infinite Impulse Response (IIR) Filter */
void test_iir_op(void);
/**
 * @brief Bi-quad Real Block IIR - makes a real IIR filter
 *				   (cascaded IIR direct form I using
 *				   5 coefficients per bi-quad + gain term)
 *
 * @param[in]		M - number of bi-quad sections
 * @param[in]		*coef_sos - points to the filter coefficients
 * @param[in]		*coef_g - points to the scale factor for each section
 * @param[in]		*input - points to the block of input data
 * @param[in]		blockSize - number of samples to process
 * @param[out]		*output - points to the block of output data
 *
 * @return none
 */
void real_block_iir_32(int M, const int32_t *coef_sos, const int16_t *coef_g,
		       const int32_t *input, int32_t *output, int block_size);

/* test Least Mean Square (LMS) Filter for Real Data */
void test_fir_blms_op(void);
/**
 * @brief Blockwise Adaptive LMS Algorithm for Real Data - performs filtering of
 *				reference samples 'ref', computation of
 *				error 'err' over a block of
 *				input samples 'input'
 *
 * @param[in]		*coef - points to coefficient buffer
 * @param[in]		*input -points to the block of input data
 * @param[in]		*ref - points to the block of reference data
 * @param[in]		mu - step size that controls filter coefficient updates
 * @param[in]		blockSize - number of samples to process
 * @param[in]		M - number of filter coefficients
 * @param[out]		*output - points to the block of output data
 * @param[out]		*err - points to the block of error data
 *
 * @return	none
 */
void lms_iir_32(int32_t *err, int32_t *coef, int32_t *input, int32_t *ref,
		int32_t mu, int block_size, int M);
```

## src/cmsis_dsp_wrapper.c
```c
/*
 * Copyright 2024 NXP
 *
 * SPDX-License-Identifier: Apache-2.0
 */

#include <zephyr/kernel.h>
#include <stdio.h>

#include <arm_math.h>

void vec_sum_int16(const int16_t *in_a, const int16_t *in_b, int16_t *out, uint32_t length)
{
	printk("[Backend] CMSIS-DSP module\n");
	arm_add_q15(in_a, in_b, out, length);
}

void vec_power_int16(const int16_t *in, int64_t *out, int rsh, uint32_t length)
{
	printk("[Backend] CMSIS-DSP module\n");
	arm_power_q15(in, length, out);
}

void vec_power_int32(const int32_t *in, int64_t *out, int rsh, uint32_t length)
{
	printk("[Backend] CMSIS-DSP module\n");
	arm_power_q31(in, length, out);
}

void fft_real32(int32_t *in, int32_t *out, int length)
{
	/* Instance structure for the Q31 RFFT */
	arm_rfft_instance_q31 rFFT;

	printk("[Backend] CMSIS-DSP module\n");

	/*
	 * Initialize the FFT
	 * value = 0: forward transform
	 * value = 1: enables bit reversal of output
	 */
	arm_rfft_init_q31(&rFFT, length, 0, 1);
	/* Apply FFT */
	arm_rfft_q31(&rFFT, in, out);
}

void real_block_iir_32(int M, const int32_t *coef_sos, const int16_t *coef_g,
		       const int32_t *in, int32_t *out, int block_size)
{
	/* Instance of the Q31 Biquad cascade structure */
	arm_biquad_casd_df1_inst_q31 handle;
	/*
	 * State variables array
	 * Each Bi-quad stage has 4 state variables.
	 * The state array has a total length of 4*M values.
	 */
	q31_t biquadStateBandQ31[4 * M];

	printk("[Backend] CMSIS-DSP module\n");

	/*
	 * Initialize the state and coefficient buffers for all Bi-quad sections
	 * value = 2: Shift to be applied after the accumulator
	 */
	arm_biquad_cascade_df1_init_q31(&handle, M, coef_sos, &biquadStateBandQ31[0], 2);
	/* Call the Q31 Bi-quad Cascade DF1 process function */
	arm_biquad_cascade_df1_q31(&handle, in, out, block_size);
}

void lms_iir_32(int32_t *err, int32_t *coef, int32_t *input, int32_t *ref,
		int32_t mu, int block_size, int M)
{
	arm_lms_instance_q31 handle;

	printk("[Backend] CMSIS-DSP module\n");
	arm_lms_init_q31(&handle, M, coef, ref, mu, block_size, 0);
	arm_lms_q31(&handle, input, ref, coef, err, block_size);
}
```

## src/math_ops.c
```c
/*
 * Copyright 2024 NXP
 *
 * SPDX-License-Identifier: Apache-2.0
 */

#include <zephyr/kernel.h>
#include <stdlib.h>

#include <math_ops.h>
#include <input.h>

static int start, stop;

static inline int test_near_equal_q15(uint32_t length, const int16_t *in_a,
				      const int16_t *in_b, int16_t threshold)
{
	int i;

	for (i = 0; i < length; i++) {
		if (abs(in_a[i] - in_b[i]) > threshold) {
			return 0;
		}
	}

	return 1;
}

void test_vec_sum_int16_op(void)
{
	int16_t output[VEC_LENGTH];
	int ret = 1; /* test passed successfully */

	printk("[Library Test] == Vector Sum test  ==\r\n");
	start = k_cycle_get_32();

	/* Run test function */
	vec_sum_int16(in_a, in_b, output, VEC_LENGTH);
	stop = k_cycle_get_32();

	/* Validate output */
	ret = test_near_equal_q15(VEC_LENGTH, output, ref_add, ABS_ERROR_THRESH_Q15);

	printk("[Library Test] Vector Sum takes %d cycles\r\n", stop - start);
	printk("[Library Test] == Vector Sum test end with %d ==\r\n\r\n", ret);
}

void test_power_int16_op(void)
{
	int64_t output;
	int ret = 1; /* test passed successfully */

	printk("[Library Test] == Vector power sum test  ==\r\n");
	start = k_cycle_get_32();

	/* Run test function */
	vec_power_int16(in_a, &output, 0, VEC_LENGTH);
	stop = k_cycle_get_32();

	/* Validate output */
	if (output != ref_power_16[0]) {
		printk("[Library Test] Mismatch: expected %lld result %lld\r\n",
		       ref_power_16[0], output);
		ret = 0; /* test failed */
	}

	printk("[Library Test] Vector power sum takes %d cycles\r\n", stop - start);
	printk("[Library Test] == Vector power sum test end with %d ==\r\n\r\n", ret);
}

void test_power_int32_op(void)
{
	int64_t output;

	printk("[Library Test] == Vector power sum test  ==\r\n");
	start = k_cycle_get_32();

	/* Run test function */
	vec_power_int32(fir_in_ref, &output, RSH, FIR_LENGTH);
	stop = k_cycle_get_32();

	printk("[Library Test] Vector power sum takes %d cycles\r\n", stop - start);
	printk("[Library Test] == Vector power sum test end ==\r\n\r\n");
}

void test_fft_op(void)
{
	int i;
	int32_t fft_in[FFT_LENGTH];

	/* Create input */
	for (i = 0; i < FFT_LENGTH; i++) {
		fft_in[i] = FFT_LENGTH * (1 + i % 2); /* only real part */
	}

	printk("[Library Test] == Fast Fourier Transform on Real Data test  ==\r\n");
	start = k_cycle_get_32();

	/* Run test function */
	fft_real32(fft_in, fft_out, FFT_LENGTH);
	stop = k_cycle_get_32();

	printk("[Library Test] Fast Fourier Transform on Real Data takes %d cycles\r\n",
	       stop - start);
	printk("[Library Test] == Fast Fourier Transform on Real Data test end ==\r\n\r\n");
}

void test_iir_op(void)
{
	printk("[Library Test] == Bi-quad Real Block IIR test  ==\r\n");
	start = k_cycle_get_32();

	/* Run test function */
	real_block_iir_32(IIR_M, coef_sos, coef_g, iir_in, iir_out, IIR_LENGTH);
	stop = k_cycle_get_32();

	printk("[Library Test] Bi-quad Real Block IIR takes %d cycles\r\n", stop - start);
	printk("[Library Test] == Bi-quad Real Block IIR end ==\r\n\r\n");
}

void test_fir_blms_op(void)
{
	int i;
	int32_t fir_coef[FIR_M];
	int32_t fir_in[FIR_LENGTH];
	int32_t fir_ref[FIR_LENGTH + FIR_M];

	for (i = 0; i < FIR_M; i++) {
		fir_coef[i] = fir_coef_ref[i];
	}
	for (i = 0; i < FIR_LENGTH; i++) {
		fir_in[i] = fir_in_ref[i];
	}
	for (i = 0; i < FIR_LENGTH + FIR_M; i++) {
		fir_ref[i] = fir_ref_ref[i];
	}

	printk("[Library Test] == Least Mean Square (LMS) Filter for Real Data test  ==\r\n");
	start = k_cycle_get_32();

	/* Run test function */
	lms_iir_32(fir_err, fir_coef, fir_in, fir_ref, MU, FIR_LENGTH, FIR_M);
	stop = k_cycle_get_32();

	printk("[Library Test] Least Mean Square (LMS) Filter for Real Data test takes %d cycles\r\n",
	       stop - start);
	printk("[Library Test] == Least Mean Square (LMS) Filter for Real Data test end ==\r\n\r\n");
}
```

## src/nature_dsp_wrapper.c
```c
/*
 * Copyright 2024 NXP
 *
 * SPDX-License-Identifier: Apache-2.0
 */

#include <zephyr/kernel.h>
#include <stdio.h>

#include <NatureDSP_Signal.h>

/**
 * For fft_real32x32, scaling options are:
 * 2 - 32-bit dynamic scaling
 * 3 - fixed scaling before each stage
 */
#define FFT_SCALING_OPTION 3
#define RSH 31

void vec_sum_int16(const int16_t *in_a, const int16_t *in_b, int16_t *out, uint32_t length)
{
	printk("[Backend] NatureDSP library\n");
	vec_add16x16(out, in_a, in_b, length);
}

void vec_power_int16(const int16_t *in, int64_t *out, int rsh, uint32_t length)
{
	printk("[Backend] NatureDSP library\n");
	out[0] = vec_power16x16(in, rsh, length);
}

void vec_power_int32(const int32_t *in, int64_t *out, int rsh, uint32_t length)
{
	printk("[Backend] NatureDSP library\n");
	out[0] = vec_power32x32(in, rsh, length);
}

void fft_real32(int32_t *in, int32_t *out, int length)
{
	/* FFT handle for 32x32 */
	extern const fft_handle_t rfft32_32;

	printk("[Backend] NatureDSP library\n");

	/* Apply FFT */
	fft_real32x32(out, in, rfft32_32, FFT_SCALING_OPTION);
}

void real_block_iir_32(int M, const int32_t *coef_sos, const int16_t *coef_g,
		       const int32_t *in, int32_t *out, int block_size)
{
	bqriir32x32_df1_handle_t handle;
	static int32_t objmem[256] = {};

	printk("[Backend] NatureDSP library\n");
	/*
	 * Initialization routine for IIR filters
	 * value = 0: total gain shift amount applied to output signal
	 *
	 * Returns: handle to the object
	 */
	handle = bqriir32x32_df1_init(objmem, M, coef_sos, coef_g, 0);
	/*
	 * Call Bi-quad Real Block IIR
	 * value = NULL: scratch memory area (for fixed-point functions only)
	 *
	 * The filter calculates block_size output samples using
	 * coef_sos and coef_g matrices.
	 */
	bqriir32x32_df1(handle, NULL, out, in, block_size);
}

void lms_iir_32(int32_t *err, int32_t *coef, int32_t *input, int32_t *ref,
		int32_t mu, int block_size, int M)
{
	int64_t norm64;

	printk("[Backend] NatureDSP library\n");

	/*
	 * Compute the normalization factor,
	 * which is the power of the reference signal times block_size,
	 * where block_size is the number of samples to process
	 */
	vec_power_int32(ref, &norm64, RSH, block_size);
	/*
	 * Call Blockwise Adaptive LMS Algorithm for Real Data
	 * value = NULL: scratch memory area (for fixed-point functions only)
	 *
	 * The filter calculates block_size output samples using
	 * coef_sos and coef_g matrices.
	 */
	fir_blms32x32(err, coef, input, ref, norm64, mu, block_size, M);
}
```
