## CMakeLists.txt
```
# SPDX-FileCopyrightText: Copyright 2026 NXP
# SPDX-License-Identifier: Apache-2.0

cmake_minimum_required(VERSION 3.28.0)
find_package(Zephyr REQUIRED HINTS $ENV{ZEPHYR_BASE})
project(mcxe32b_standby_cpu1)

target_sources(app PRIVATE src/main.c)
```

## prj.conf
```kconfig
# SPDX-FileCopyrightText: Copyright 2026 NXP
# SPDX-License-Identifier: Apache-2.0

CONFIG_CONSOLE=n
CONFIG_UART_CONSOLE=n
CONFIG_SERIAL=n
CONFIG_UART_INTERRUPT_DRIVEN=n
CONFIG_PRINTK=n
CONFIG_BOOT_BANNER=n
CONFIG_CACHE_MANAGEMENT=y
CONFIG_BUILD_OUTPUT_HEX=y
CONFIG_ARM_MPU=y
CONFIG_USE_DT_CODE_PARTITION=y
CONFIG_ROM_START_OFFSET=0
```

## app.overlay
```dts
/*
 * SPDX-FileCopyrightText: Copyright 2026 NXP
 *
 * SPDX-License-Identifier: Apache-2.0
 */

&stdby_ram {
	compatible = "zephyr,memory-region", "mmio-sram";
	zephyr,memory-region = "STDBY_MAILBOX";
	zephyr,memory-attr = <DT_MEM_ARM(ATTR_MPU_RAM_NOCACHE)>;
};

&sram1 {
	reg = <0x2042c000 DT_SIZE_K(16)>;
};

&lpuart_5 {
	status = "disabled";
};
```

## src/main.c
```c
/*
 * SPDX-FileCopyrightText: Copyright 2026 NXP
 *
 * SPDX-License-Identifier: Apache-2.0
 */

#include <zephyr/cache.h>
#include <zephyr/kernel.h>
#include <soc.h>

#include "../../src/standby.h"

int main(void)
{
	struct standby_data *const shared =
		(struct standby_data *)DT_REG_ADDR(DT_NODELABEL(stdby_ram));

	sys_cache_instr_enable();
	sys_cache_data_enable();
	shared->state = CPU1_READY;
	__DSB();

	while (shared->request != CPU1_STOP) {
		k_sleep(K_MSEC(1));
	}

	(void)irq_lock();
#if defined(CONFIG_ZERO_LATENCY_IRQS)
	(void)arch_zli_lock();
#endif
	SysTick->CTRL = 0U;
	for (size_t i = 0; i < ARRAY_SIZE(NVIC->ICER); i++) {
		NVIC->ICER[i] = UINT32_MAX;
		NVIC->ICPR[i] = UINT32_MAX;
	}
	SCB->ICSR = SCB_ICSR_PENDSTCLR_Msk | SCB_ICSR_PENDSVCLR_Msk;
	if (sys_cache_data_flush_all() < 0) {
		shared->state = CPU1_ERROR;
	} else {
		sys_cache_data_disable();
		shared->state = CPU1_PARKED;
	}
	__DSB();
	__ISB();

	for (;;) {
		__WFI();
	}
}
```
