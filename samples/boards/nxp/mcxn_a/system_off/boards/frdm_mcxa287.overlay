/*
 * SPDX-FileCopyrightText: Copyright 2026 NXP
 *
 * SPDX-License-Identifier: Apache-2.0
 */

/* Deep Power Down on MCXAxx7 can retain ONLY SRAM arrays A0 and A3 (per the
 * reference manual, "Deep Power Down mode"); A1/A2 lose power regardless of the
 * VBAT retention config. Point zephyr,sram at A3 (16 KB at 0x20004000) so the
 * retained .noinit cycle counter lands in a DPD-retainable array and survives
 * the system-off wake reset.
 */
&sram0 {
	reg = <0x20004000 0x4000>;
};
