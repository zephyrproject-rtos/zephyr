## CMakeLists.txt
```
# SPDX-FileCopyrightText: Copyright 2026 NXP
# SPDX-License-Identifier: Apache-2.0

cmake_minimum_required(VERSION 3.28.0)
find_package(Zephyr REQUIRED HINTS $ENV{ZEPHYR_BASE})
project(system_off)

target_sources(app PRIVATE src/main.c)
```

## Kconfig
```
# SPDX-FileCopyrightText: Copyright 2026 NXP
# SPDX-License-Identifier: Apache-2.0

mainmenu "NXP MCX system off sample"

choice
	prompt "Deep Power Down wakeup source"
	default SAMPLE_SYSTEM_OFF_WAKEUP_TIMER
	help
	  Select how the SoC is woken from Deep Power Down (system off).

config SAMPLE_SYSTEM_OFF_WAKEUP_TIMER
	bool "Timed wakeup"
	help
	  Wake after a fixed delay using a low-power timer.

config SAMPLE_SYSTEM_OFF_WAKEUP_BUTTON
	bool "Button wakeup"
	help
	  Wake on a user button press.

endchoice

config SAMPLE_APP_TEST_CYCLES
	int "Number of system-off cycles to execute"
	range 1 1000
	default 10
	help
	  Number of times the sample arms the wakeup source and enters system
	  off before it stops. The completed cycle count is kept in retained
	  SRAM across each Deep Power Down wake reset so a test harness can
	  confirm every wakeup happened.

source "Kconfig.zephyr"
```

## sample.yaml
```
# SPDX-FileCopyrightText: Copyright 2026 NXP
# SPDX-License-Identifier: Apache-2.0

sample:
  name: System Off for NXP MCX

common:
  tags:
    - power
    - poweroff
  platform_allow:
    - frdm_mcxn947/mcxn947/cpu0
    - mcx_n5xx_evk/mcxn547/cpu0
    - mcx_n9xx_evk/mcxn947/cpu0
    - frdm_mcxn236
    - frdm_mcxa153
    - frdm_mcxa156
    - frdm_mcxa344
    - frdm_mcxa266
    - frdm_mcxa346
    - frdm_mcxa366
  integration_platforms:
    - frdm_mcxn947/mcxn947/cpu0
    - frdm_mcxa156
  harness: console
  harness_config:
    type: one_line
    regex:
      - "system off demo"

tests:
  sample.boards.nxp.mcxn_a.system_off.timer:
    timeout: 120
    harness_config:
      type: one_line
      regex:
        - "Completed 10 system-off cycles"
    extra_configs:
      - CONFIG_SAMPLE_SYSTEM_OFF_WAKEUP_TIMER=y
  sample.boards.nxp.mcxn_a.system_off.button:
    timeout: 300
    extra_configs:
      - CONFIG_SAMPLE_SYSTEM_OFF_WAKEUP_BUTTON=y
```

## prj.conf
```kconfig
# SPDX-FileCopyrightText: Copyright 2026 NXP
# SPDX-License-Identifier: Apache-2.0

CONFIG_POWEROFF=y
CONFIG_WUC=y
CONFIG_COUNTER=y
CONFIG_COUNTER_MCUX_LPTMR_ALARM=y

# The cycle counter is seeded on a cold boot and left untouched on a Deep Power
# Down wake, told apart from the CMC reset cause reported through hwinfo.
CONFIG_HWINFO=y
```

## app.overlay
```dts
/*
 * SPDX-FileCopyrightText: Copyright 2026 NXP
 *
 * SPDX-License-Identifier: Apache-2.0
 */

&lptmr0 {
	status = "okay";
	clock-frequency = <16384>;
	timer-mode-sel = <0>;
};
```

## mcx.overlay
```dts
/*
 * SPDX-FileCopyrightText: Copyright 2026 NXP
 *
 * SPDX-License-Identifier: Apache-2.0
 */

&lptmr0 {
	clock-frequency = <16384>;
	timer-mode-sel = <0>;
	status = "okay";
};
```

## mcxn.overlay
```dts
/*
 * SPDX-FileCopyrightText: Copyright 2026 NXP
 *
 * SPDX-License-Identifier: Apache-2.0
 */

/* Deep Power Down only retains RAMA on MCXN, so point zephyr,sram at RAMA1-RAMA3
 * (24 KB at 0x20002000, clear of the boot ROM scratch in RAMA0). The retained
 * cycle counter (.noinit) then lands in RAM the VBAT LDO keeps alive across the
 * system-off wake reset.
 */
&sram0 {
	reg = <0x20002000 0x6000>;
};
```

## boards/frdm_mcxa287.overlay
```dts
/*
 * SPDX-FileCopyrightText: Copyright 2026 NXP
 *
 * SPDX-License-Identifier: Apache-2.0
 */

/* Deep Power Down on MCXAxx7 can retain ONLY SRAM arrays A0 and A3 (per the
 * reference manual, "Deep Power Down mode"); A1/A2 lose power regardless of the
 * VBAT retention config. Point zephyr,sram at A3 (16 KB at 0x20004000) so the
 * retained .noinit cycle counter lands in a DPD-retainable array and survives
 * the system-off wake reset.
 */
&sram0 {
	reg = <0x20004000 0x4000>;
};
```

## boards/frdm_mcxa577.overlay
```dts
/*
 * SPDX-FileCopyrightText: Copyright 2026 NXP
 *
 * SPDX-License-Identifier: Apache-2.0
 */

/* Deep Power Down on MCXAxx7 can retain ONLY SRAM arrays A0 and A3 (per the
 * reference manual, "Deep Power Down mode"); A1/A2 lose power regardless of the
 * VBAT retention config. Point zephyr,sram at A3 (16 KB at 0x20004000) so the
 * retained .noinit cycle counter lands in a DPD-retainable array and survives
 * the system-off wake reset.
 */
&sram0 {
	reg = <0x20004000 0x4000>;
};

&lptmr0 {
	clock-frequency = <16384>;
	timer-mode-sel = <0>;
	status = "okay";
};
```

## src/main.c
```c
/*
 * SPDX-FileCopyrightText: Copyright 2026 NXP
 *
 * SPDX-License-Identifier: Apache-2.0
 */

#include <zephyr/kernel.h>
#include <zephyr/device.h>
#include <zephyr/sys/poweroff.h>
#include <zephyr/drivers/wuc.h>
#include <zephyr/drivers/hwinfo.h>
#include <zephyr/toolchain.h>

#if defined(CONFIG_SAMPLE_SYSTEM_OFF_WAKEUP_TIMER)
#include <zephyr/drivers/counter.h>

#define WAKEUP_DELAY_S 5U
static const struct device *const lptmr = DEVICE_DT_GET(DT_NODELABEL(lptmr0));
#else
/* The wakeup button (a WUU external pin) is described per board and aliased as
 * "wakeup-button".
 */
static const struct wuc_dt_spec wakeup = WUC_DT_SPEC_GET(DT_ALIAS(wakeup_button));
#endif

/*
 * Deep Power Down gates every SRAM array, so the cycle counter that has to
 * survive the power-off/wake reset must live in an array whose low-power
 * retention is armed before entering Deep Power Down. This mirrors the SoC
 * suspend-to-RAM retention path; a production application would share that code.
 *
 *   - MCXN / MCXAxx7: the VBAT backup SRAM regulator retains RAMA. The linker
 *     places .noinit (and so the counter) in RAMA because the board overlay
 *     points zephyr,sram there.
 *   - other MCXA: the SPC SRAM retention LDO retains every array, so the counter
 *     is retained wherever it lands.
 */
#if defined(CONFIG_SOC_FAMILY_MCXN) || defined(CONFIG_SOC_SERIES_MCXAXX7)
#include <fsl_vbat.h>

#define VBAT0_ADDR ((VBAT_Type *)DT_REG_ADDR(DT_INST(0, nxp_vbat)))
#define MCXN_RAMA_ALL						\
	(kVBAT_SramArray0 | kVBAT_SramArray1 | kVBAT_SramArray2 | kVBAT_SramArray3)

static void retain_counter_ram(void)
{
	if (!VBAT_CheckFRO16kEnabled(VBAT0_ADDR)) {
		VBAT_EnableFRO16k(VBAT0_ADDR, true);
	}
	VBAT_UngateFRO16k(VBAT0_ADDR, kVBAT_EnableClockToVddSys);
	if (!VBAT_CheckBandgapEnabled(VBAT0_ADDR)) {
		(void)VBAT_EnableBandgap(VBAT0_ADDR, true);
	}
	VBAT_EnableBandgapRefreshMode(VBAT0_ADDR, true);
	(void)VBAT_EnableBackupSRAMRegulator(VBAT0_ADDR, true);
	VBAT_RetainSRAMsInLowPowerModes(VBAT0_ADDR, MCXN_RAMA_ALL);
}
#elif defined(CONFIG_SOC_FAMILY_MCXA)
#include <fsl_spc.h>

#define SPC0_ADDR ((SPC_Type *)DT_REG_ADDR(DT_INST(0, nxp_spc)))

static void retain_counter_ram(void)
{
	SPC_EnableSRAMLdo(SPC0_ADDR, true);
	SPC_RetainSRAMArray(SPC0_ADDR, 0xFU);
}
#else
static void retain_counter_ram(void)
{
}
#endif

/* Retained across the Deep Power Down reset (see retain_counter_ram()).
 * Left uninitialised so the C runtime never clears it; a cold boot is
 * detected from the reset cause and seeds it explicitly.
 */
static __noinit uint32_t cycles;

#if defined(CONFIG_SAMPLE_SYSTEM_OFF_WAKEUP_TIMER)
static void wakeup_alarm_cb(const struct device *dev, uint8_t chan_id, uint32_t ticks,
			    void *user_data)
{
	ARG_UNUSED(dev);
	ARG_UNUSED(chan_id);
	ARG_UNUSED(ticks);
	ARG_UNUSED(user_data);
}

static int arm_timer_wakeup(void)
{
	struct counter_alarm_cfg cfg = {
		.callback = wakeup_alarm_cb,
		.ticks = counter_us_to_ticks(lptmr, (uint64_t)WAKEUP_DELAY_S * USEC_PER_SEC),
		.flags = 0,
	};

	(void)counter_start(lptmr);

	return counter_set_channel_alarm(lptmr, 0, &cfg);
}
#endif

int main(void)
{
	uint32_t reset_cause = 0U;
	bool woke;
	int ret;

	(void)hwinfo_get_reset_cause(&reset_cause);
	(void)hwinfo_clear_reset_cause();
	woke = (reset_cause & RESET_LOW_POWER_WAKE) != 0U;

	if (!woke) {
		/* Cold boot: seed the retained counter. */
		cycles = 0U;
	}

	printk("%s system off demo\n", CONFIG_BOARD);
	if (woke) {
		printk("Woke from system off; retained count %u/%u\n", cycles,
		       CONFIG_SAMPLE_APP_TEST_CYCLES);
	}

	if (cycles >= CONFIG_SAMPLE_APP_TEST_CYCLES) {
		printk("Completed %u system-off cycles\n", CONFIG_SAMPLE_APP_TEST_CYCLES);
		return 0;
	}

#if defined(CONFIG_SAMPLE_SYSTEM_OFF_WAKEUP_TIMER)
	if (!device_is_ready(lptmr)) {
		printk("LPTMR counter device not ready\n");
		return 0;
	}

	/* LPTMR0 is the system-timer companion, so the counter driver arms it as
	 * a wakeup source when the alarm is set - nothing else is needed here.
	 */
	ret = arm_timer_wakeup();
	if (ret < 0) {
		printk("Failed to arm LPTMR wakeup (%d)\n", ret);
		return 0;
	}
#else
	if (!device_is_ready(wakeup.dev)) {
		printk("WUC device %s not ready\n", wakeup.dev->name);
		return 0;
	}

	ret = wuc_enable_wakeup_source_dt(&wakeup);
	if (ret < 0) {
		printk("Failed to enable wakeup source (%d)\n", ret);
		return 0;
	}
#endif

	cycles++;
	retain_counter_ram();

#if defined(CONFIG_SAMPLE_SYSTEM_OFF_WAKEUP_TIMER)
	printk("Entering system off (cycle %u/%u); the timer wakes it in %u s\r\n", cycles,
	       CONFIG_SAMPLE_APP_TEST_CYCLES, WAKEUP_DELAY_S);
#else
	printk("Entering system off (cycle %u/%u); trigger the wakeup pin to restart\r\n", cycles,
	       CONFIG_SAMPLE_APP_TEST_CYCLES);
#endif

	sys_poweroff();

	/* Deep Power Down wakes through the reset routine, so this is never
	 * reached on a working system off.
	 */
	printk("ERROR: System off failed\n");

	return 0;
}
```
