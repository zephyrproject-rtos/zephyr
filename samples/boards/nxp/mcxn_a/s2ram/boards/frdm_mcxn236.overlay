/*
 * SPDX-FileCopyrightText: Copyright 2026 NXP
 *
 * SPDX-License-Identifier: Apache-2.0
 */

/* Constrain zephyr,sram to RAMA1-RAMA3 (24 KB at 0x20002000) so the whole
 * retained working set is both kept across Deep Power Down and kept clear of
 * the boot ROM scratch.
 */
&sram0 {
	reg = <0x20002000 0x6000>;
};

/* Suspend-to-RAM is opt-in (the SoC disables it by default); enable it here. */
&deeppowerdown {
	status = "okay";
};
