## CMakeLists.txt
```
# Copyright (c) 2021 Nordic Semiconductor ASA
#
# SPDX-License-Identifier: Apache-2.0
#

cmake_minimum_required(VERSION 3.20.0)

find_package(Zephyr REQUIRED HINTS $ENV{ZEPHYR_BASE})

if(CONFIG_BOARD_NRF5340DK_NRF5340_CPUNET OR
   CONFIG_BOARD_NRF5340BSIM_NRF5340_CPUNET)
  message(INFO " ${BOARD}${BOARD_QUALIFIERS} used for Network Core")
else()
  message(FATAL_ERROR "${BOARD}${BOARD_QUALIFIERS} is not supported for this sample")
endif()

project(sync_rtc_net)

target_sources(app PRIVATE src/main.c)
```

## sample.yaml
```
sample:
  description: This app shows how RTCs are synchronized
      on nrf53 cores.
  name: nRF53 Synchronized RTC sample (net)
common:
  harness: remote
tests:
  sample.boards.nrf.nrf53_sync_rtc.net:
    platform_allow: nrf5340dk_nrf5340_cpunet
    integration_platforms:
      - nrf5340dk_nrf5340_cpunet
```

## prj.conf
```kconfig
CONFIG_LOG=y
CONFIG_NRF53_SYNC_RTC=y
CONFIG_SOC_NRF53_RTC_PRETICK=n
CONFIG_MBOX=y
CONFIG_MBOX_NRFX_IPC=y

CONFIG_IPM=n
```

## boards/nrf5340bsim_nrf5340_cpunet.conf
```kconfig
CONFIG_BUILD_OUTPUT_EXE=n
```

## boards/nrf5340dk_nrf5340_cpunet_mbox.conf
```kconfig
CONFIG_MBOX=y
CONFIG_MBOX_NRFX_IPC=y

CONFIG_IPM=n
CONFIG_IPM_MSG_CH_2_ENABLE=n
CONFIG_IPM_MSG_CH_2_RX=n
```

## boards/nrf5340dk_nrf5340_cpunet_mbox.overlay
```dts
/*
 * Copyright (c) 2021 Nordic Semiconductor ASA
 *
 * SPDX-License-Identifier: Apache-2.0
 */

/ {
	soc {
		/delete-node/ ipc@41012000;

		mbox: mbox@41012000 {
			compatible = "nordic,mbox-nrf-ipc";
			reg = <0x41012000 0x1000>;
			tx-mask = <0x0000ffff>;
			rx-mask = <0x0000ffff>;
			interrupts = <18 NRF_DEFAULT_IRQ_PRIORITY>;
			#mbox-cells = <1>;
			status = "okay";
		};
	};
};
```

## src/main.c
```c
/*
 * Copyright (c) 2021 Nordic Semiconductor ASA
 *
 * SPDX-License-Identifier: Apache-2.0
 */

#include <zephyr/kernel.h>
#include <zephyr/drivers/mbox.h>
#include <hal/nrf_ipc.h>
#include <zephyr/drivers/ipm.h>
#include <zephyr/sys/printk.h>
#include <zephyr/drivers/timer/nrf_rtc_timer.h>
#include <zephyr/logging/log.h>
LOG_MODULE_REGISTER(main);

#if (CONFIG_SOC_SERIES_BSIM_NRFXX)
extern uint32_t shared_cell_buffer;
static uint32_t shared_cell = (uintptr_t)&shared_cell_buffer;
#else
static uint32_t shared_cell = 0x20070000;
#endif

static void sync_callback(void)
{
	int32_t offset = z_nrf_rtc_timer_nrf53net_offset_get();

	__ASSERT(offset >= 0, "Synchronization should be completed");

	uint32_t timestamp = sys_clock_tick_get_32() + offset;
	uint32_t app_timestamp = *(volatile uint32_t *)shared_cell;

	LOG_INF("Local timestamp: %u, application core timestamp: %u",
		timestamp, app_timestamp);
}

static void mbox_callback(const struct device *dev, uint32_t channel,
			  void *user_data, struct mbox_msg *data)
{
	sync_callback();
}

static int mbox_init(void)
{
	const struct device *dev;
	struct mbox_channel channel;
	int err;

	dev = COND_CODE_1(CONFIG_MBOX, (DEVICE_DT_GET(DT_NODELABEL(mbox))), (NULL));
	if (dev == NULL) {
		return -ENODEV;
	}

	mbox_init_channel(&channel, dev, 2);

	err = mbox_register_callback(&channel, mbox_callback, NULL);
	if (err < 0) {
		return err;
	}

	return mbox_set_enabled(&channel, true);
}

int main(void)
{
	int err;

	LOG_INF("Synchronization using mbox driver");
	err = mbox_init();
	if (err < 0) {
		LOG_ERR("Failed to initialize sync RTC listener (err:%d)", err);
	}
	return 0;
}
```
