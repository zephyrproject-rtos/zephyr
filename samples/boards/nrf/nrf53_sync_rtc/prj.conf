## CMakeLists.txt
```
# Copyright (c) 2021 Nordic Semiconductor ASA
#
# SPDX-License-Identifier: Apache-2.0
#

cmake_minimum_required(VERSION 3.20.0)

find_package(Zephyr REQUIRED HINTS $ENV{ZEPHYR_BASE})

if(CONFIG_BOARD_NRF5340DK_NRF5340_CPUAPP OR
   CONFIG_BOARD_NRF5340BSIM_NRF5340_CPUAPP)
  message(INFO " ${BOARD}${BOARD_QUALIFIERS} used for Application Core")
else()
  message(FATAL_ERROR "${BOARD}${BOARD_QUALIFIERS} is not supported for this sample")
endif()

project(sync_rtc)

enable_language(C ASM)

target_sources(app PRIVATE src/main.c)
```

## Kconfig.sysbuild
```
# Copyright 2023 Nordic Semiconductor ASA
#
# SPDX-License-Identifier: Apache-2.0

source "share/sysbuild/Kconfig"

config NET_CORE_BOARD
string
	default "nrf5340dk/nrf5340/cpunet" if $(BOARD) = "nrf5340dk"
	default "nrf5340bsim_nrf5340_cpunet" if $(BOARD) = "nrf5340bsim_nrf5340_cpuapp"
	default "nrf5340bsim/nrf5340/cpunet" if $(BOARD)$(BOARD_IDENTIFIER) = "nrf5340bsim/nrf5340/cpuapp"
```

## sample.yaml
```
sample:
  description: This app shows how RTCs are synchronized
      on nrf53 cores.
  name: nRF53 Synchronized RTC sample
common:
  sysbuild: true
tests:
  sample.boards.nrf.nrf53_sync_rtc.real_hw:
    platform_allow:
      - nrf5340dk/nrf5340/cpuapp
    integration_platforms:
      - nrf5340dk/nrf5340/cpuapp
    harness: remote
  sample.boards.nrf.nrf53_sync_rtc.simu:
    platform_allow:
      - nrf5340bsim_nrf5340_cpuapp
    harness: console
    harness_config:
      type: multi_line
      ordered: false
      regex:
        - "main: Synchronization using mbox driver"
        - "sync_rtc: Updated timestamp to synchronized RTC by .* ticks"
        - "main: IPC send at .* ticks"
        - "main: Local timestamp: .*, application core timestamp:"
```

## prj.conf
```kconfig
CONFIG_SOC_NRF53_CPUNET_ENABLE=y
CONFIG_LOG=y
CONFIG_NRF53_SYNC_RTC=y
CONFIG_IPM=n
CONFIG_MBOX=y
CONFIG_MBOX_NRFX_IPC=y
```

## boards/nrf5340dk_nrf5340_cpuapp_mbox.conf
```kconfig
CONFIG_IPM=n
CONFIG_MBOX=y
CONFIG_MBOX_NRFX_IPC=y
```

## boards/nrf5340dk_nrf5340_cpuapp_mbox.overlay
```dts
/*
 * Copyright (c) 2021 Nordic Semiconductor ASA
 *
 * SPDX-License-Identifier: Apache-2.0
 */

/ {
	soc {
		peripheral@50000000 {
			/delete-node/ ipc@2a000;

			mbox: mbox@2a000 {
				compatible = "nordic,mbox-nrf-ipc";
				reg = <0x2a000 0x1000>;
				tx-mask = <0x0000ffff>;
				rx-mask = <0x0000ffff>;
				interrupts = <42 NRF_DEFAULT_IRQ_PRIORITY>;
				#mbox-cells = <1>;
				status = "okay";
			};
		};
	};
};
```

## src/main.c
```c
/*
 * Copyright (c) 2021 Nordic Semiconductor ASA
 *
 * SPDX-License-Identifier: Apache-2.0
 */

#include <zephyr/kernel.h>
#include <zephyr/device.h>
#include <hal/nrf_ipc.h>
#include <zephyr/sys/printk.h>
#include <zephyr/logging/log.h>
LOG_MODULE_REGISTER(main);

#if (CONFIG_SOC_SERIES_BSIM_NRFXX)
#include "nsi_cpu_if.h"

/* For simulation, we can define shared memory variables linkable from
 * other MCUs just by using NATIVE_SIMULATOR_IF
 */
NATIVE_SIMULATOR_IF uint32_t shared_cell_buffer;
static uint32_t shared_cell = (uintptr_t)&shared_cell_buffer;
#else
static uint32_t shared_cell = 0x20070000;
#endif

static void timeout_handler(struct k_timer *timer)
{
	nrf_ipc_task_t task = offsetof(NRF_IPC_Type, TASKS_SEND[2]);
	uint32_t now = sys_clock_tick_get_32();

	*(volatile uint32_t *)shared_cell = now;
	nrf_ipc_task_trigger(NRF_IPC, task);

	LOG_INF("IPC send at %d ticks", now);

	/* Do it only for the first second. */
	if (now > sys_clock_hw_cycles_per_sec()) {
		k_timer_stop(timer);
	}
}

K_TIMER_DEFINE(timer, timeout_handler, NULL);

int main(void)
{
	LOG_INF("Synchronization using %s driver", IS_ENABLED(CONFIG_MBOX) ? "mbox" : "ipm");
	k_timer_start(&timer, K_MSEC(50), K_MSEC(50));
	return 0;
}
```
