## samples/boards/nrf/clock_skew/sample.yaml
```yaml
sample:
  name: Clock Skew Sample for nRF
tests:
  sample.boards.nrf.clock_skew:
    build_only: true
    platform_allow: nrf52840dk_nrf52840 nrf52dk_nrf52832 nrf51dk_nrf51422
    tags: power
    integration_platforms:
      - nrf52840dk_nrf52840
```

## samples/boards/nrf/coresight_stm/Kconfig.sysbuild
```kconfig
# Copyright 2024 Nordic Semiconductor ASA
#
# SPDX-License-Identifier: Apache-2.0

source "share/sysbuild/Kconfig"

config RAD_CORE_BOARD
string
	default "nrf54h20dk/nrf54h20/cpurad" if $(BOARD) = "nrf54h20dk"
```

## samples/boards/nrf/coresight_stm/sample.yaml
```yaml
sample:
  name: Logging using Coresight STM on nrf54h20
common:
  sysbuild: true
tests:
  sample.boards.nrf.coresight_stm.dict:
    platform_allow:
      - nrf54h20dk/nrf54h20/cpuapp
    integration_platforms:
      - nrf54h20dk/nrf54h20/cpuapp
    build_only: true
    required_snippets:
      - nordic-log-stm-dict
```

## samples/boards/nrf/dynamic_pinctrl/Kconfig
```kconfig
# Copyright (c) 2021 Nordic Semiconductor ASA
# SPDX-License-Identifier: Apache-2.0

mainmenu "Dynamic pin control sample"

config REMAP_INIT_PRIORITY
	int "Remap routine initialization priority"
	default 50
	help
	  Initialization priority of the remap routine within the PRE_KERNEL1 level.
	  This priority must be greater than GPIO_INIT_PRIORITY and lower than
	  UART_INIT_PRIORITY.

source "Kconfig.zephyr"
```

## samples/boards/nrf/ieee802154/802154_rpmsg/sample.yaml
```yaml
sample:
  description: Allows Zephyr to provide 802.15.4 connectivity
    for nRF devices via RPMsg.
  name: 802.15.4 RPMsg serialization
tests:
  sample.boards.nrf.802154_rpmsg:
    build_only: true
    platform_allow:
      - nrf5340dk/nrf5340/cpunet
      - nrf5340bsim_nrf5340_cpunet
```

## samples/boards/nrf/mesh/onoff-app/sample.yaml
```yaml
sample:
  name: Bluetooth Mesh
tests:
  sample.bluetooth.mesh.onoff:
    platform_allow: nrf52840dk_nrf52840
    tags: bluetooth
    harness: bluetooth
```

## samples/boards/nrf/mesh/onoff_level_lighting_vnd_app/sample.yaml
```yaml
sample:
  name: Bluetooth Mesh
tests:
  sample.bluetooth.mesh.onoff_level_lighting_vnd:
    platform_allow: nrf52840dk_nrf52840
    tags: bluetooth
    harness: bluetooth
  sample.bluetooth.mesh.onoff_level_lighting_vnd.mcumgr:
    platform_allow: nrf52840dk_nrf52840
    tags: bluetooth
    harness: bluetooth
    extra_args: OVERLAY_CONFIG="prj_smp_svr.conf"
```

## samples/boards/nrf/nrf2_clock_control/Kconfig
```kconfig
# Copyright (c) 2024 Nordic Semiconductor ASA
# SPDX-License-Identifier: Apache-2.0

config SAMPLE_CLOCK_FREQUENCY_HZ
	int "Frequency specification to request from clock in Hz"

config SAMPLE_CLOCK_ACCURACY_PPM
	int "Accuracy specification to request from clock in PPM"

config SAMPLE_CLOCK_PRECISION
	int "Precision specification to request from clock"

config SAMPLE_PRE_REQUEST_TIMEOUT
	int "Time to wait after boot before requesting clock specs in seconds"
	default 2
	help
	  The distributed clock domains may need time to initialize
	  before a clock request can be met.

config SAMPLE_KEEP_REQUEST_TIMEOUT
	int "Time to keep request alive in seconds"
	default 2

source "Kconfig.zephyr"
```

## samples/boards/nrf/nrf2_clock_control/sample.yaml
```yaml
sample:
  name: nRF2 clock control sample
common:
    platform_allow: nrf54h20dk/nrf54h20/cpuapp
tests:
  sample.boards.nrf.clock_control.fll16m:
    filter: dt_nodelabel_enabled("fll16m")
    extra_args:
      - CONF_FILE="configs/fll16m.conf"
      - DTC_OVERLAY_FILE="configs/fll16m.overlay"
  sample.boards.nrf.clock_control.lfclk:
    filter: dt_nodelabel_enabled("lfclk")
    extra_args:
      - CONF_FILE="configs/lfclk.conf"
      - DTC_OVERLAY_FILE="configs/lfclk.overlay"
  sample.boards.nrf.clock_control.uart135:
    filter: dt_nodelabel_enabled("uart135")
    extra_args:
      - CONF_FILE="configs/uart135.conf"
      - DTC_OVERLAY_FILE="configs/uart135.overlay"
  sample.boards.nrf.clock_control.cpuapp_hsfll:
    filter: dt_nodelabel_enabled("cpuapp_hsfll")
    extra_args:
      - CONF_FILE="configs/cpuapp_hsfll.conf"
      - DTC_OVERLAY_FILE="configs/cpuapp_hsfll.overlay"
```

## samples/boards/nrf/nrf53_sync_rtc/Kconfig.sysbuild
```kconfig
# Copyright 2023 Nordic Semiconductor ASA
#
# SPDX-License-Identifier: Apache-2.0

source "share/sysbuild/Kconfig"

config NET_CORE_BOARD
string
	default "nrf5340dk/nrf5340/cpunet" if $(BOARD) = "nrf5340dk"
	default "nrf5340bsim_nrf5340_cpunet" if $(BOARD) = "nrf5340bsim_nrf5340_cpuapp"
	default "nrf5340bsim/nrf5340/cpunet" if $(BOARD)$(BOARD_IDENTIFIER) = "nrf5340bsim/nrf5340/cpuapp"
```

## samples/boards/nrf/nrf53_sync_rtc/net/boards/nrf5340dk_nrf5340_cpunet_mbox.conf
```kconfig
CONFIG_MBOX=y
CONFIG_MBOX_NRFX_IPC=y

CONFIG_IPM=n
CONFIG_IPM_MSG_CH_2_ENABLE=n
CONFIG_IPM_MSG_CH_2_RX=n
```

## samples/boards/nrf/nrf53_sync_rtc/net/sample.yaml
```yaml
sample:
  description: This app shows how RTCs are synchronized
      on nrf53 cores.
  name: nRF53 Synchronized RTC sample (net)
common:
  harness: remote
tests:
  sample.boards.nrf.nrf53_sync_rtc.net:
    platform_allow: nrf5340dk_nrf5340_cpunet
    integration_platforms:
      - nrf5340dk_nrf5340_cpunet
```

## samples/boards/nrf/nrf53_sync_rtc/sample.yaml
```yaml
sample:
    description: This app shows how RTCs are synchronized
        on nrf53 cores.
    name: nRF53 Synchronized RTC sample
tests:
    sample.boards.nrf.nrf53_sync_rtc:
        platform_allow: nrf5340dk_nrf5340_cpuapp
        integration_platforms:
          - nrf5340dk_nrf5340_cpuapp
        build_only: true
    sample.boards.nrf.nrf53_sync_rtc_mbox:
        platform_allow: nrf5340dk_nrf5340_cpuapp
        integration_platforms:
          - nrf5340dk_nrf5340_cpuapp
        build_only: true
        extra_args: OVERLAY_CONFIG="boards/nrf5340dk_nrf5340_cpuapp_mbox.conf"
          NET_OVERLAY_CONF="boards/nrf5340dk_nrf5340_cpunet_mbox.conf"
```

## samples/boards/nrf/nrf_led_matrix/sample.yaml
```yaml
sample:
  name: nRF LED matrix sample
tests:
  sample.boards.nrf.nrf_led_matrix:
    filter: dt_compat_enabled("nordic,nrf-led-matrix")
    integration_platforms:
      - bbc_microbit_v2/nrf52833
      - bbc_microbit/nrf51822
    harness: console
    harness_config:
      type: multi_line
      ordered: true
      regex:
        - "nRF LED matrix sample on .*"
        - "Started"
```

## samples/boards/nrf/nrfx/Kconfig
```kconfig
# Copyright (c) 2021 Nordic Semiconductor ASA
# SPDX-License-Identifier: Apache-2.0

config NRFX_DPPI
	default HAS_HW_NRF_DPPIC

config NRFX_PPI
	default HAS_HW_NRF_PPI

config NRFX_GPIOTE0
	default y if SOC_SERIES_NRF51X || \
		     SOC_SERIES_NRF52X || \
		     (SOC_SERIES_NRF53X && !TRUSTED_EXECUTION_NONSECURE) || \
		     (SOC_SERIES_NRF91X && !TRUSTED_EXECUTION_NONSECURE)

config NRFX_GPIOTE1
	default y if (SOC_SERIES_NRF53X && TRUSTED_EXECUTION_NONSECURE) || \
		     (SOC_SERIES_NRF91X && TRUSTED_EXECUTION_NONSECURE)

source "Kconfig.zephyr"
```

## samples/boards/nrf/nrfx/sample.yaml
```yaml
sample:
  name: nrfx use example
tests:
  sample.boards.nrf.nrfx:
    platform_allow: nrf52840dk_nrf52840 nrf9160dk_nrf9160
    integration_platforms:
      - nrf52840dk_nrf52840
    tags: board
    harness: console
    harness_config:
      type: multi_line
      ordered: true
      regex:
        - "nrfx_gpiote initialized"
        - "\\(D\\)PPI configured, leaving main()"
```

## samples/boards/nrf/nrfx_prs/sample.yaml
```yaml
sample:
  name: nrfx Peripheral Resource Sharing example
tests:
  sample.boards.nrf.nrfx_prs:
    platform_allow:
      - nrf5340dk/nrf5340/cpuapp
      - nrf9160dk/nrf9160
    integration_platforms:
      - nrf5340dk/nrf5340/cpuapp
      - nrf9160dk/nrf9160
    tags: nrfx
    harness: console
    harness_config:
      type: multi_line
      ordered: true
      regex:
        - "nrfx PRS example on .*"
        - "-> press \".*\" to trigger a transfer"
        - "-> press \".*\" to switch the type of peripheral"
```

## samples/boards/nrf/power_mgr/sample.yaml
```yaml
sample:
  name: Low Power State Sample for nRF5x
tests:
  sample.board.nrf52.pm.low_power_state:
    platform_whitelist: nrf52840_pca10056 nrf52_pca10040 nrf51_pca10028
    timeout: 150
    tags: power
    harness: console
    harness_config:
      type: multi_line
      regex:
        - "--> Entering to SYS_POWER_STATE_SLEEP_3 state."
        - "--> Exited from SYS_POWER_STATE_SLEEP_3 state."
        - "--> Entering to SYS_POWER_STATE_SLEEP_2 state."
        - "--> Exited from SYS_POWER_STATE_SLEEP_2 state."
```

## samples/boards/nrf/s2ram/sample.yaml
```yaml
sample:
  name: S2RAM Sample for nRF5x
common:
  tags: power
tests:
  sample.boards.nrf.s2ram:
    platform_allow: nrf5340dk_nrf5340_cpuapp
    harness: remote
```

## samples/boards/nrf/system_off/Kconfig
```kconfig
# Copyright (c) 2021 Nordic Semiconductor ASA
# SPDX-License-Identifier: Apache-2.0

mainmenu "Nordic SYSTEM_OFF demo"

config APP_RETENTION
	bool "Enable state retention in system off"
	depends on SOC_COMPATIBLE_NRF52X
	help
	  On some Nordic chips this application supports retaining
	  memory while in system off.  Select this to enable the
	  feature.

source "Kconfig.zephyr"
```

## samples/boards/nrf/system_off/sample.yaml
```yaml
sample:
  name: Low Power State Sample for nRF5x
common:
  tags: power
  integration_platforms:
    - nrf52840dk/nrf52840
tests:
  sample.boards.nrf.system_off:
    build_only: true
    platform_allow:
      - nrf52840dk/nrf52840
      - nrf52dk/nrf52832
      - nrf51dk/nrf51822
  sample.boards.nrf.system_off.retained:
    build_only: true
    platform_allow:
      - nrf52840dk/nrf52840
      - nrf52dk/nrf52832
    extra_configs:
      - CONFIG_APP_RETENTION=y
```

## samples/boards/nrf52/mesh/onoff-app/sample.yaml
```yaml
sample:
  name: Bluetooth Mesh
tests:
  sample.bluetooth.mesh.onoff:
    platform_whitelist: nrf52840_pca10056
    tags: bluetooth
    harness: bluetooth
```

## samples/boards/nrf52/mesh/onoff_level_lighting_vnd_app/sample.yaml
```yaml
sample:
  name: Bluetooth Mesh
tests:
  sample.bluetooth.mesh.onoff_level_lighting_vnd:
    platform_whitelist: nrf52840_pca10056
    tags: bluetooth
    harness: bluetooth
```
