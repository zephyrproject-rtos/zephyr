## sample.yaml
```
sample:
    description: Panther board demo with MQTT and Wifi
    name: Panther Board Demo
tests:
-   test:
        build_only: true
        platform_whitelist: panther
        tags: samples
```

## prj.conf
```kconfig
# Enable OS Awareness
CONFIG_DEBUG_TRACING_KERNEL_OBJECTS=y
CONFIG_THREAD_MONITOR=y
CONFIG_GDB_INFO=y

# Configure platform
CONFIG_ARC_INIT=y
CONFIG_ARC_INIT_DEBUG=n
CONFIG_ARC_GDB_ENABLE=n

CONFIG_PRINTK=y
# syslog
CONFIG_SYS_LOG=y
CONFIG_SYS_LOG_SHOW_TAGS=y
# CONFIG_SYS_LOG_DEFAULT_LEVEL=SYS_LOG_LEVEL_DEBUG
# CONFIG_SYS_LOG_ETHERNET_LEVEL=SYS_LOG_LEVEL_DEBUG

CONFIG_IPM=y
CONFIG_IPM_QUARK_SE=y
CONFIG_IPM_QUARK_SE_MASTER=y
CONFIG_IPM_CONSOLE_RECEIVER=y

CONFIG_TIMESLICE_SIZE=1
CONFIG_MAIN_STACK_SIZE=2048

CONFIG_NETWORKING=y
CONFIG_NET_IPV4=y
CONFIG_NET_DHCPV4=y
CONFIG_NET_IPV6=n
CONFIG_NET_L2_ETHERNET=n
CONFIG_NET_TCP=y
CONFIG_NET_MGMT=y
CONFIG_NET_MGMT_EVENT=y

CONFIG_NET_LOG=y

CONFIG_WIFI=y
CONFIG_WIFI_WINC1500=y
CONFIG_NET_MGMT_WIFI=y

CONFIG_NET_OFFLOAD=y

CONFIG_MQTT_LIB=y
CONFIG_MQTT_MSG_MAX_SIZE=512

CONFIG_RANDOM_GENERATOR=y
CONFIG_TEST_RANDOM_GENERATOR=y
CONFIG_TIMER_RANDOM_GENERATOR=y
CONFIG_JSON_LIBRARY=y
```

## src/main.c
```c
/*
 * Copyright (c) 2017 IpTronix S.r.l.
 *
 * SPDX-License-Identifier: Apache-2.0
 */

#include <device.h>
#include <misc/byteorder.h>
#include <zephyr.h>
#include <string.h>
#include <net/wifi_mgmt.h>
#include <logging/sys_log.h>

#include "wifi.h"
#include "mqtt.h"
#include "config.h"

int ipm_init(char *topic);

/**
 * definition for WiFi connection
 *
 *	ap_name         SSID of your network access point
 *	password        password
 *	security        security see wifi_security_t
 *
 */
struct wifi_conn_params wifi_params = {
	.ap_name  = CONFIG_WIFI_SSID,
	.password = CONFIG_WIFI_PASSWORD,
	.security = CONFIG_WIFI_SECURITY,
};

/**
 * definitions for MQTT
 *
 *		server_addr     server address
 *		server_port     server port
 *		client_id       client identification
 *		user_id         user identification
 *		password        password
 *		topic           publish topic
 */
struct mqtt_client_prm client_prm = {
	.server_addr = CONFIG_MQTT_SERVER_ADDR,
	.server_port = CONFIG_MQTT_SERVER_PORT,
	.client_id   = CONFIG_MQTT_CLIENT_ID,
	.user_id     = CONFIG_MQTT_USER_ID,
	.password    = CONFIG_MQTT_PASSWORD,
	.topic       = CONFIG_MQTT_TOPIC,
};

void main(void)
{
	int ret;

	SYS_LOG_INF("Panther test program "__DATE__ " "__TIME__);

	SYS_LOG_INF("client_prm\n"
		    "  server_addr = %s\n"
		    "  server_port = %d\n"
		    "  client_id   = %s\n"
		    "  user_id     = %s\n"
		    "  password    = %s\n"
		    "  topic       = %s\n",
		    client_prm.server_addr,
		    client_prm.server_port,
		    client_prm.client_id,
		    client_prm.user_id,
		    client_prm.password,
		    client_prm.topic);

	/**
	 * Initialize IPM communication
	 */
	SYS_LOG_INF("IPM init");
	ret = ipm_init(client_prm.topic);
	if (ret) {
		SYS_LOG_ERR("IPM init FAIL");
	}

	/**
	 * Initialize WiFi connection and start MQTT Publisher
	 * after WiFi is connected
	 */
	SYS_LOG_INF("Test WiFi mqtt");
	ret = wifi_init(&wifi_params, mqtt_pub_init, (void *)&client_prm);
	if (ret) {
		SYS_LOG_ERR("WiFi init callback function FAIL");
	}

	k_sleep(K_FOREVER);
}
```

## src/config.h
```c
/*
 * Copyright (c) 2017 Intel Corporation
 *
 * SPDX-License-Identifier: Apache-2.0
 */

#ifndef _PANTHE_CONFIG_H
#define _PANTHE_CONFIG_H

#define CONFIG_WIFI_SSID "SSID"
#define CONFIG_WIFI_PASSWORD "password"
#define CONFIG_WIFI_SECURITY WPA2
#define CONFIG_MQTT_SERVER_ADDR "10.0.1.100"
#define CONFIG_MQTT_SERVER_PORT 1883
#define CONFIG_MQTT_DEVICE_HID "device001"
#define CONFIG_MQTT_CLIENT_ID "client001"
#define CONFIG_MQTT_USER_ID "user"
#define CONFIG_MQTT_PASSWORD "password"
#define CONFIG_MQTT_TOPIC "mqtt_topic"

#endif
```

## src/ipm.c
```c
/*
 * Copyright (c) 2017 IpTronix S.r.l.
 *
 * SPDX-License-Identifier: Apache-2.0
 */

#include <kernel.h>
#include <stdio.h>
#include <ipm.h>
#include <ipm/ipm_quark_se.h>
#include <sensor.h>
#include <zephyr.h>
#include <json.h>
#include <mqtt.h>
#include <misc/printk.h>
#include <logging/sys_log.h>

#include "mqtt.h"

#define STACKSIZE               2000

#define MAIN_FIBER_PRI          2

struct shield_sens {
	struct sensor_value BME280[3];
	struct sensor_value ADXL362[4];
	struct sensor_value ADXRS290[3];
	struct sensor_value SI1153[5];
};

QUARK_SE_IPM_DEFINE(ess_ipm, 0, QUARK_SE_IPM_INBOUND);

static char ipm_stack[STACKSIZE];
static struct shield_sens sensors;
static struct k_sem sync_sem;
static char *mqtt_topic;
struct k_thread ipm_thread_data;

static void sensor_ipm_callback(void *context, u32_t id, volatile void *data);
static void ipm_thread(void *arg1, void *arg2, void *arg3);
static char *json_get(void);

int ipm_init(char *topic)
{
	struct device *ipm;
	int ret;

	mqtt_topic = topic;

	ipm = device_get_binding("ess_ipm");
	if (!ipm) {
		return -1;
	}

	ipm_register_callback(ipm, sensor_ipm_callback, NULL);

	ret = ipm_set_enabled(ipm, 1);
	if (ret) {
		return -1;
	}

	k_sem_init(&sync_sem, 0, 1);

	k_thread_create(&ipm_thread_data, ipm_stack, STACKSIZE, ipm_thread,
		       0, 0, 0, K_PRIO_COOP(MAIN_FIBER_PRI), 0, 0);

	return 0;
}

static void sensor_ipm_callback(void *context, u32_t id,
				volatile void *data)
{
	volatile struct sensor_value *val = data;

	switch (id) {
	case SENSOR_CHAN_TEMP:
		/* resolution of 0.01 degrees Celsius */
		sensors.BME280[0].val1 = val->val1;
		sensors.BME280[0].val2 = val->val2;
		break;
	case SENSOR_CHAN_HUMIDITY:
		/* resolution of 0.01 percent */
		sensors.BME280[1].val1 = val->val1 / 1000;
		sensors.BME280[1].val2 = (val->val1 % 1000) * 1000;
		break;
	case SENSOR_CHAN_PRESS:
		/* resolution of 0.1 Pa */
		sensors.BME280[2].val1 = (val->val1 * 10) + (val->val2 / 100000);
		sensors.BME280[2].val2 = (val->val2 % 100000) * 10;
		break;
	case SENSOR_CHAN_ACCEL_Y:
		sensors.ADXL362[0].val1 = -val->val1;
		sensors.ADXL362[0].val2 = -val->val2;
		break;
	case SENSOR_CHAN_ACCEL_X:
		sensors.ADXL362[1].val1 = val->val1;
		sensors.ADXL362[1].val2 = val->val2;
		break;
	case SENSOR_CHAN_ACCEL_Z:
		sensors.ADXL362[2].val1 = -val->val1;
		sensors.ADXL362[2].val2 = -val->val2;
		break;
	case SENSOR_CHAN_GYRO_X:
		sensors.ADXRS290[0].val1 = val->val1;
		sensors.ADXRS290[0].val2 = val->val2;
		break;
	case SENSOR_CHAN_GYRO_Y:
		sensors.ADXRS290[1].val1 = val->val1;
		sensors.ADXRS290[1].val2 = val->val2;
		break;
	case SENSOR_CHAN_GESTURE:
		sensors.SI1153[4].val1 = val->val1;
		break;
	case SENSOR_CHAN_ALL + 1:
		SYS_LOG_INF("ipm received, give sem");
		k_sem_give(&sync_sem);
		break;
	default:
		break;
	}
}

static void ipm_thread(void *arg1, void *arg2, void *arg3)
{
	ARG_UNUSED(arg1);
	ARG_UNUSED(arg2);
	ARG_UNUSED(arg3);

	while (1) {
		if (k_sem_take(&sync_sem, K_FOREVER) == 0) {
			if (mqtt_status_get() == 1) {
				char *json;

				json = json_get();
				if (json) {
					SYS_LOG_INF("JSON TO SEND:\n%s\n", json);
					mqtt_send(mqtt_topic, json);
				}
			}
		}
	}
}

#define abs(a) ((a) < 0 ? -(a) : (a))

#define FIELD(struct_, member_, type_) {		\
		.field_name = #member_,			\
		.field_name_len = sizeof(#member_) - 1,	\
		.offset = offsetof(struct_, member_),	\
		.type = type_				\
}

#define STRING_VALUE_SIZE 16

struct json_struct {
	char *tmp;
	char *hum;
	char *atm;
	char *acx;
	char *acy;
	char *acz;
	char *gyx;
	char *gyy;
	int gst;
};

static const struct json_obj_descr json_descr[] = {
	FIELD(struct json_struct, tmp, JSON_TOK_STRING),
	FIELD(struct json_struct, hum, JSON_TOK_STRING),
	FIELD(struct json_struct, atm, JSON_TOK_STRING),
	FIELD(struct json_struct, acx, JSON_TOK_STRING),
	FIELD(struct json_struct, acy, JSON_TOK_STRING),
	FIELD(struct json_struct, acz, JSON_TOK_STRING),
	FIELD(struct json_struct, gyx, JSON_TOK_STRING),
	FIELD(struct json_struct, gyy, JSON_TOK_STRING),
	FIELD(struct json_struct, gst, JSON_TOK_NUMBER),
};

int value_get(char *string, struct sensor_value *value)
{
	int len = 0;

	if (value->val1 < 0 || value->val2 < 0) {
		len += snprintk(string + len, STRING_VALUE_SIZE, "-");
	}
	len += snprintk(string + len, STRING_VALUE_SIZE, "%d.%06d",
			abs(value->val1), abs(value->val2));

	return len;
}

char *json_get(void)
{
	static char json_buffer[1024];
	char sensor_value[8][STRING_VALUE_SIZE];
	struct json_struct js;
	int ret;

	value_get(sensor_value[0], &sensors.BME280[0]);
	value_get(sensor_value[1], &sensors.BME280[1]);
	value_get(sensor_value[2], &sensors.BME280[2]);
	value_get(sensor_value[3], &sensors.ADXL362[0]);
	value_get(sensor_value[4], &sensors.ADXL362[1]);
	value_get(sensor_value[5], &sensors.ADXL362[2]);
	value_get(sensor_value[6], &sensors.ADXRS290[0]);
	value_get(sensor_value[7], &sensors.ADXRS290[1]);

	js.tmp = sensor_value[0];
	js.hum = sensor_value[1];
	js.atm = sensor_value[2];
	js.acx = sensor_value[3];
	js.acy = sensor_value[4];
	js.acz = sensor_value[5];
	js.gyx = sensor_value[6];
	js.gyy = sensor_value[7];
	js.gst = sensors.SI1153[4].val1;

	ret = json_obj_encode_buf(json_descr, ARRAY_SIZE(json_descr),
				  &js, json_buffer, sizeof(json_buffer));
	if (ret) {
		SYS_LOG_ERR("json_obj_encode_buf FAIL!");
		return NULL;
	}
	return json_buffer;
}
```

## src/mqtt.c
```c
/*
 * Copyright (c) 2017 IpTronix S.r.l.
 *
 * SPDX-License-Identifier: Apache-2.0
 */

#include <zephyr.h>
#include <string.h>
#include <errno.h>
#include <net/mqtt.h>
#include <net/net_context.h>
#include <logging/sys_log.h>

#include "mqtt.h"

#define ZEPHYR_ADDR "0.0.0.0"

#define APP_SLEEP_MSECS 5000
#define APP_TX_RX_TIMEOUT 800
#define APP_CONNECT_TRIES 10

/**
 * @brief mqtt_client_ctx	Container of some structures used by the
 *				publisher app.
 */
struct mqtt_client_ctx {
	/**
	 * The connect message structure is only used during the connect
	 * stage. Developers must set some msg properties before calling the
	 * mqtt_tx_connect routine. See below.
	 */
	struct mqtt_connect_msg connect_msg;
	/**
	 * This is the message that will be received by the server
	 * (MQTT broker).
	 */
	struct mqtt_publish_msg pub_msg;

	/**
	 * This is the MQTT application context variable.
	 */
	struct mqtt_ctx mqtt_ctx;

	/**
	 * This variable will be passed to the connect callback, declared inside
	 * the mqtt context struct. If not used, it could be set to NULL.
	 */
	void *connect_data;

	/**
	 * This variable will be passed to the disconnect callback, declared
	 * inside the mqtt context struct. If not used, it could be set to NULL.
	 */
	void *disconnect_data;

	/**
	 * This variable will be passed to the publish_tx callback, declared
	 * inside the mqtt context struct. If not used, it could be set to NULL.
	 */
	void *publish_data;
};

/* This is the network context structure. */
static struct net_context *net_ctx;

/* The mqtt client struct */
static struct mqtt_client_ctx client_ctx;

/* Status of mqtt */
static int mqtt_status;

/* This routine sets some basic properties for the network context variable */
static int network_setup(struct net_context **net_ctx, const char *local_addr,
			 const char *server_addr, u16_t server_port);

/* The signature of this routine must match the connect callback declared at
 * the mqtt.h header.
 */
static void connect_cb(struct mqtt_ctx *mqtt_ctx)
{
	struct mqtt_client_ctx *client_ctx;

	client_ctx = CONTAINER_OF(mqtt_ctx, struct mqtt_client_ctx, mqtt_ctx);

	SYS_LOG_INF("[%s:%d]", __func__, __LINE__);

	if (client_ctx->connect_data) {
		SYS_LOG_INF(" user_data: %s",
			    (const char *)client_ctx->connect_data);
	}

	mqtt_status = 1;
}

/* The signature of this routine must match the disconnect callback declared at
 * the mqtt.h header.
 */
static void disconnect_cb(struct mqtt_ctx *mqtt_ctx)
{
	struct mqtt_client_ctx *client_ctx;

	client_ctx = CONTAINER_OF(mqtt_ctx, struct mqtt_client_ctx, mqtt_ctx);

	SYS_LOG_INF("[%s:%d]", __func__, __LINE__);

	if (client_ctx->disconnect_data) {
		SYS_LOG_INF(" user_data: %s",
			    (const char *)client_ctx->disconnect_data);
	}

	mqtt_status = 0;
}

/**
 * The signature of this routine must match the publish_tx callback declared at
 * the mqtt.h header.
 *
 * NOTE: we have two callbacks for MQTT Publish related stuff:
 *	- publish_tx, for publishers
 *	- publish_rx, for subscribers
 *
 * Applications must keep a "message database" with pkt_id's. So far, this is
 * not implemented here. For example, if we receive a PUBREC message with an
 * unknown pkt_id, this routine must return an error, for example -EINVAL or
 * any negative value.
 */
static int publish_cb(struct mqtt_ctx *mqtt_ctx, u16_t pkt_id,
		      enum mqtt_packet type)
{
	struct mqtt_client_ctx *client_ctx;
	const char *str;
	int rc = 0;

	client_ctx = CONTAINER_OF(mqtt_ctx, struct mqtt_client_ctx, mqtt_ctx);

	switch (type) {
	case MQTT_PUBACK:
		str = "MQTT_PUBACK";
		break;
	case MQTT_PUBCOMP:
		str = "MQTT_PUBCOMP";
		break;
	case MQTT_PUBREC:
		str = "MQTT_PUBREC";
		break;
	default:
		rc = -EINVAL;
		str = "Invalid MQTT packet";
	}

	SYS_LOG_INF("[%s:%d] <%s> packet id: %u", __func__, __LINE__, str, pkt_id);

	if (client_ctx->publish_data) {
		SYS_LOG_INF(", user_data: %s",
			    (const char *)client_ctx->publish_data);
	}

	return rc;
}

/**
 * The signature of this routine must match the malformed callback declared at
 * the mqtt.h header.
 */
static void malformed_cb(struct mqtt_ctx *mqtt_ctx, u16_t pkt_type)
{
	SYS_LOG_INF("[%s:%d] pkt_type: %u\n", __func__, __LINE__, pkt_type);
}

/* In this routine we block until the connected variable is 1 */
static int try_to_connect(struct mqtt_client_ctx *client_ctx)
{

	int i = 0;

	while (i++ < APP_CONNECT_TRIES && !client_ctx->mqtt_ctx.connected) {
		int rc;

		rc = mqtt_tx_connect(&client_ctx->mqtt_ctx,
				     &client_ctx->connect_msg);
		k_sleep(APP_SLEEP_MSECS);
		SYS_LOG_INF("try_to_connect:mqtt_tx_connect return %d connected %d",
			    rc, client_ctx->mqtt_ctx.connected);
		if (rc != 0) {
			continue;
		}
	}

	if (client_ctx->mqtt_ctx.connected) {
		SYS_LOG_INF("try_to_connect:CONNECTED\n");
		return 0;
	}

	return -EINVAL;
}

int mqtt_pub_init(void *arg)
{
	struct mqtt_client_prm *client_prm = (struct mqtt_client_prm *)arg;
	int rc;

	SYS_LOG_INF("mqtt_pub_init");
	/* The net_ctx variable must be ready BEFORE passing it to the MQTT API.
	 */
	rc = network_setup(&net_ctx, ZEPHYR_ADDR,
			   (const char *)client_prm->server_addr, client_prm->server_port);
	SYS_LOG_INF("mqtt_pub_init: network_setup return %d", rc);
	if (rc != 0) {
		goto exit_app;
	}

	/* Set everything to 0 and later just assign the required fields. */
	memset(&client_ctx, 0x00, sizeof(client_ctx));

	/* The network context is the only field that must be set BEFORE
	 * calling the mqtt_init routine.
	 */
	client_ctx.mqtt_ctx.net_ctx = net_ctx;

	/* connect, disconnect and malformed may be set to NULL */
	client_ctx.mqtt_ctx.connect    = connect_cb;
	client_ctx.mqtt_ctx.disconnect = disconnect_cb;
	client_ctx.mqtt_ctx.malformed  = malformed_cb;

	client_ctx.mqtt_ctx.net_timeout = APP_TX_RX_TIMEOUT;

	/* Publisher apps TX the MQTT PUBLISH msg */
	client_ctx.mqtt_ctx.publish_tx = publish_cb;

	rc = mqtt_init(&client_ctx.mqtt_ctx, MQTT_APP_PUBLISHER);
	SYS_LOG_INF("mqtt_pub_init: mqtt_init() return %d", rc);
	if (rc != 0) {
		goto exit_app;
	}

	/* The connect message will be sent to the MQTT server (broker).
	 * If clean_session here is 0, the mqtt_ctx clean_session variable
	 * will be set to 0 also. Please don't do that, set always to 1.
	 * Clean session = 0 is not yet supported.
	 */
	client_ctx.connect_msg.clean_session = 1;
	client_ctx.connect_msg.client_id     = client_prm->client_id;
	client_ctx.connect_msg.client_id_len = strlen(client_prm->client_id);

	client_ctx.connect_msg.keep_alive     = 5;

	client_ctx.connect_msg.user_name      = client_prm->user_id;
	client_ctx.connect_msg.user_name_len  = strlen(client_prm->user_id);
	client_ctx.connect_msg.password       = client_prm->password;
	client_ctx.connect_msg.password_len   = strlen(client_prm->password);

	client_ctx.connect_data    = "CONNECTED";
	client_ctx.disconnect_data = "DISCONNECTED";
	client_ctx.publish_data    = "PUBLISH";

	rc = try_to_connect(&client_ctx);
	if (rc != 0) {
		goto exit_app;
	}

	SYS_LOG_INF("mqtt_pub_init:DONE!");
	return 0;

exit_app:
	SYS_LOG_ERR("mqtt_pub_init:Error!");
	return -1;
}

/**
 */
int mqtt_status_get(void)
{
	return mqtt_status;
}

/**
 *
 */
int mqtt_send(char *topic, char *payload)
{
	struct mqtt_publish_msg *pub_msg = &client_ctx.pub_msg;
	int rc;

	rc = mqtt_tx_pingreq(&client_ctx.mqtt_ctx);
	if (rc) {
		SYS_LOG_ERR("mqttSend:mqtt_tx_pingreq ERROR %d status = %d\n",
			    rc, mqtt_status);
		return rc;
	}

	/* MQTT Quality of Service */
	pub_msg->qos = MQTT_QoS0; /* TODO add global var or define */

	pub_msg->retain = 0;

	/* Packet Identifier, always use different values */
	pub_msg->pkt_id = sys_rand32_get();

	/* Message's topic */
	pub_msg->topic = topic;
	pub_msg->topic_len = strlen(pub_msg->topic);

	/* MQTT message payload */
	pub_msg->msg = payload;
	pub_msg->msg_len = strlen(pub_msg->msg);

	rc = mqtt_tx_publish(&client_ctx.mqtt_ctx, &client_ctx.pub_msg);
	if (rc) {
		SYS_LOG_ERR("mqtt_tx_publish ERROR %d!", rc);
		return rc;
	}

	return 0;
}

static int set_addr(struct sockaddr *sock_addr, const char *addr, u16_t port)
{
	int rc;

	net_sin(sock_addr)->sin_port = htons(port);
	sock_addr->family = AF_INET;

	rc = net_addr_pton(AF_INET, addr, &(net_sin(sock_addr)->sin_addr));
	if (rc) {
		SYS_LOG_ERR("Invalid IP address: %s", addr);
	}

	return rc;
}

static int network_setup(struct net_context **net_ctx, const char *local_addr,
			 const char *server_addr, u16_t server_port)
{
	socklen_t addr_len = sizeof(struct sockaddr_in);
	struct sockaddr server_sock, local_sock;
	int rc;
	int i;

	rc = set_addr(&local_sock, local_addr, 0);
	if (rc) {
		SYS_LOG_ERR("set_addr (local) error");
		return rc;
	}

	rc = net_context_get(AF_INET, SOCK_STREAM, IPPROTO_TCP, net_ctx);
	if (rc) {
		SYS_LOG_ERR("net_context_get error %d", rc);
		return rc;
	}

	rc = net_context_bind(*net_ctx, &local_sock, addr_len);
	if (rc) {
		SYS_LOG_ERR("net_context_bind error %d", rc);
		goto lb_exit;
	}

	rc = set_addr(&server_sock, server_addr, server_port);
	if (rc) {
		SYS_LOG_ERR("set_addr (server) error %d", rc);
		goto lb_exit;
	}

	for (i = 0; i < 4; i++) {
		rc = net_context_connect(*net_ctx, &server_sock, addr_len, NULL,
					 APP_SLEEP_MSECS, NULL);
		SYS_LOG_ERR("net_context_connect return %d", rc);
		if (rc == 0) {
			break;
		}
	}
	if (i == 4) {
		SYS_LOG_ERR("net_context_connect error %d.\n"
			    "Is the server (broker) up and running?", rc);
		goto lb_exit;
	}

	return 0;

lb_exit:
	net_context_put(*net_ctx);

	return rc;
}
```

## src/mqtt.h
```c
/*
 * Copyright (c) 2017 IpTronix S.r.l.
 *
 * SPDX-License-Identifier: Apache-2.0
 */

#ifndef SRC_MQTT_H_
#define SRC_MQTT_H_

#include <zephyr/types.h>

struct mqtt_client_prm {
	char *server_addr;
	u16_t server_port;
	char *client_id;
	char *user_id;
	char *password;
	char *topic;
};

int mqtt_pub_init(void *arg);
int mqtt_status_get(void);
int mqtt_send(char *topic, char *payload);


#endif /* SRC_MQTT_H_ */
```

## src/wifi.c
```c
/*
 * Copyright (c) 2017 IpTronix S.r.l.
 *
 * SPDX-License-Identifier: Apache-2.0
 */

#include <stdint.h>
#include <string.h>
#include <stddef.h>
#include <errno.h>
#include <zephyr.h>
#include <device.h>
#include <gpio.h>
#include <board.h>
#include <net/net_if.h>
#include <net/net_mgmt.h>
#include <net/wifi_mgmt.h>
#include <logging/sys_log.h>

#include "wifi.h"

static struct net_mgmt_event_callback mgmt_cb;
static wifi_cb_t wifi_cb;
static void *wifi_arg;

/**
 * called after wifi connetcion is done
 */
static void handler(struct net_mgmt_event_callback *cb,
		    u32_t mgmt_event,
		    struct net_if *iface)
{
	int ret;

	if (mgmt_event != NET_EVENT_IPV4_ADDR_ADD) {
		return;
	}
	if (wifi_cb) {
		SYS_LOG_INF("wifi: run callback function");
		ret = wifi_cb(wifi_arg);
		if (ret) {
			SYS_LOG_ERR("wifi: callback function error %d", ret);
		}
	}
}

int wifi_init(struct wifi_conn_params *conn_params, wifi_cb_t cb, void *arg)
{
	struct net_if *iface;
	struct wifi_req_params req = {
		.ap_name = conn_params->ap_name,
		.password = conn_params->password,
		.security = conn_params->security,
	};
	int ret;

	SYS_LOG_INF("wifi_init");

	iface = net_if_get_default();
	if (!iface) {
		SYS_LOG_ERR("wifi:ERROR getting iface");
		return -1;
	}

	wifi_cb  = cb;
	wifi_arg = arg;

	SYS_LOG_INF("wifi init net mgmt event callback");
	net_mgmt_init_event_callback(&mgmt_cb, handler, NET_EVENT_IPV4_ADDR_ADD);
	net_mgmt_add_event_callback(&mgmt_cb);

	ret = net_mgmt(NET_REQUEST_WIFI_CMD_AP_CONNECT, iface,
		       &req, sizeof(req));
	if (ret) {
		SYS_LOG_ERR("wifi connect request return error (%d)", ret);
	} else {
		SYS_LOG_INF("wifi connect request OK");
	}

	return 0;
}
```

## src/wifi.h
```c
/*
 * Copyright (c) 2017 IpTronix S.r.l.
 *
 * SPDX-License-Identifier: Apache-2.0
 */

#ifndef __WIFI_H
#define __WIFI_H

typedef int (*wifi_cb_t)(void *);

struct wifi_conn_params {
	char *ap_name;
	char *password;
	int security;
};

int wifi_init(struct wifi_conn_params *conn_params, wifi_cb_t cb, void *arg);

#endif /* __WIFI_H */
```
