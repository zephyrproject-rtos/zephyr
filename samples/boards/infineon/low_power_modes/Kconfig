## samples/boards/infineon/mbox/Kconfig
```kconfig
# SPDX-FileCopyrightText: Copyright (c) 2026 Infineon Technologies AG,
# SPDX-FileCopyrightText: or an affiliate of Infineon Technologies AG. All rights reserved.
#
# SPDX-License-Identifier: Apache-2.0

mainmenu "Infineon IPC MBOX sample application"

config MBOX_SAMPLE_CORE_A
	bool "Build this image for core A of the mailbox pair"
	help
	  Selects which end of the two-core ping-pong this image is built for.
	  Set it on exactly one core of the pair; the other core is core B. This
	  keeps the sample device-agnostic instead of keying off a specific CPU.

source "Kconfig.zephyr"
```

## samples/boards/intel_socfpga/cli/boards/intel_socfpga_agilex5_socdk.conf
```kconfig
# Copyright (c) 2022-2023, Intel Corporation.
# SPDX-License-Identifier: Apache-2.0

# Misc
CONFIG_SHELL_STACK_SIZE=8192

# Enable QSPI Flash
CONFIG_FLASH=y
CONFIG_FLASH_PAGE_LAYOUT=y
CONFIG_FLASH_SHELL=y

# Setting the Shell prompt
CONFIG_SHELL_PROMPT_UART="agilex5$ "

# Setting the max argc
CONFIG_SHELL_ARGC_MAX=12

# Enable timer driver
CONFIG_COUNTER=y

# Enable Timer shell commands
CONFIG_COUNTER_SHELL=y

# DMA driver
CONFIG_DMA=y
CONFIG_DMA_DW_AXI_MAX_DESC=50

# PSCI shell Enable
CONFIG_PSCI_SHELL=y

#SiP SVC Service
CONFIG_ARM_SIP_SVC_DRIVER=y
CONFIG_ARM_SIP_SVC_SUBSYS=y
CONFIG_ARM_SIP_SVC_SUBSYS_SINGLY_OPEN=y

#SiP SVC Service Shell
CONFIG_ARM_SIP_SVC_SUBSYS_SHELL=y
# GPIO
CONFIG_GPIO=y
CONFIG_GPIO_SHELL=y
CONFIG_GPIO_SHELL_INFO_CMD=n

# Watchdog
CONFIG_WATCHDOG=y
CONFIG_WDT_SHELL=y
```

## samples/boards/nordic/remote_shell_log/boards/nrf5340bsim_nrf5340_cpuapp.conf
```kconfig
CONFIG_SOC_NRF53_CPUNET_ENABLE=y
CONFIG_UART_NATIVE_PTY_0_ON_STDINOUT=y
CONFIG_LOG_BACKEND_NATIVE_POSIX=n
CONFIG_LOG_MODE_DEFERRED=y
```

## samples/boards/nordic/remote_shell_log/remote/boards/nrf5340bsim_nrf5340_cpunet.conf
```kconfig
CONFIG_BUILD_OUTPUT_EXE=n
CONFIG_LOG_FRONTEND_IPC=y
CONFIG_SHELL_LOG_BACKEND=n
CONFIG_LOG_ALWAYS_RUNTIME=n
CONFIG_SIZE_OPTIMIZATIONS=y

CONFIG_LOG_BACKEND_NATIVE_POSIX=n
```

## samples/boards/nordic/remote_shell_log/remote/boards/nrf54h20dk_nrf54h20_cpuppr.conf
```kconfig
CONFIG_LOG_PRINTK=n
CONFIG_SERIAL=y
CONFIG_CONSOLE=y
CONFIG_UART_CONSOLE=y
CONFIG_PRINTK=y
CONFIG_BOOT_BANNER=y
```

## samples/boards/nordic/remote_shell_log/remote/boards/nrf54l15dk_nrf54l15_cpuflpr.conf
```kconfig
# Copyright (c) 2026 Nordic Semiconductor ASA
# SPDX-License-Identifier: Apache-2.0
#
# CPUFLPR has limited RAM.
CONFIG_MULTITHREADING=n
CONFIG_CBPRINTF_CONVERT_CHECK_PTR=n
CONFIG_IPC_SERVICE_LOG_LEVEL_OFF=y

CONFIG_LOG_FRONTEND_IPC=y

CONFIG_KERNEL_SHELL=n
CONFIG_THREAD_MONITOR=n
CONFIG_THREAD_RUNTIME_STATS=n
CONFIG_STATS=n
CONFIG_STATS_SHELL=n
CONFIG_DEVICE_SHELL=n
CONFIG_INIT_STACKS=n
CONFIG_THREAD_STACK_INFO=n
```

## samples/boards/nxp/adsp/rtxxx/amp_audio_loopback/remote/Kconfig
```kconfig
# Copyright 2026 NXP
# SPDX-License-Identifier: Apache-2.0

config SAMPLE_USE_CODEC_CLOCK
	bool "I2S BCK is generated by a selected codec device"
	help
	  If selected, the selected I2S peripheral will be configured to consume
	  (receive) the I2S BCK and WS signals and the codec will be configured
	  to generate those. If not selected, the I2S peripheral will generate
	  them and the codec will be expected to consume them.

source "Kconfig.zephyr"
```

## samples/boards/nxp/frdm_mcxe31b/system_off/Kconfig
```kconfig
# Copyright 2026 NXP
# SPDX-License-Identifier: Apache-2.0

mainmenu "MCXE system off demo"

choice APP_WAKEUP_SOURCE
	prompt "Standby wake-up source"
	default APP_WAKEUP_RTC

config APP_WAKEUP_RTC
	bool "RTC timeout"

config APP_WAKEUP_GPIO
	bool "External GPIO"
	depends on SOC_MCXE32B_CPU0
	select GPIO

config APP_WAKEUP_BOTH
	bool "RTC timeout or external GPIO"
	depends on SOC_MCXE32B_CPU0
	select GPIO

endchoice

config APP_USE_CPU1
	bool "Start and cooperatively stop CPU1 before standby"
	depends on SOC_MCXE32B_CPU0
	select ARM_MPU
	help
	  Requires the companion CPU1 image built by sysbuild. CPU0 requests
	  shutdown through non-cacheable standby SRAM and waits for CPU1's
	  acknowledgment and hardware WFI status before gating its clock.

config APP_TEST_CYCLES
	int "Number of standby cycles to execute"
	range 1 1000
	default 10
	help
	  Number of times the sample arms its wake-up sources and enters system off.
	  The completed cycle count is stored in standby-retained noinit memory
	  so it can be retrieved after each standby wake reset.

source "Kconfig.zephyr"
```

## samples/boards/nxp/frdm_mcxe31b/system_off/Kconfig.sysbuild
```kconfig
# SPDX-FileCopyrightText: Copyright 2026 NXP
# SPDX-License-Identifier: Apache-2.0

source "share/sysbuild/Kconfig"

config APP_USE_CPU1
	bool "Build the companion CPU1 image"
	default y if $(BOARD) = "frdm_mcxe32b"
```

## samples/boards/nxp/frdm_rw612/system_off/Kconfig
```kconfig
# SPDX-FileCopyrightText: Copyright 2026 NXP
# SPDX-License-Identifier: Apache-2.0

source "Kconfig.zephyr"

config SAMPLE_RW612_SYSTEM_OFF_WAKEUP_SECONDS
	int "RTC wakeup delay in seconds"
	range 2 99
	default 30
```

## samples/boards/nxp/mcxw7xx/system_off/Kconfig
```kconfig
# SPDX-FileCopyrightText: Copyright 2026 NXP
# SPDX-License-Identifier: Apache-2.0

mainmenu "NXP MCXW7x system off sample"

choice
	prompt "System off wakeup source"
	default SAMPLE_SYSTEM_OFF_WAKEUP_TIMER
	help
	  Select how the SoC is woken from system off.

config SAMPLE_SYSTEM_OFF_WAKEUP_TIMER
	bool "Timed wakeup"
	help
	  Wake after a fixed delay using a low-power timer.

config SAMPLE_SYSTEM_OFF_WAKEUP_BUTTON
	bool "Button wakeup"
	help
	  Wake on a user button press.

endchoice

config SAMPLE_APP_TEST_CYCLES
	int "Number of system-off cycles to execute"
	range 1 1000
	default 10
	help
	  Number of times the sample arms the wakeup source and enters system
	  off before it stops. The completed cycle count is kept in a register
	  file register across each wake reset so a test harness can confirm
	  every wakeup happened.

source "Kconfig.zephyr"
```

## samples/boards/nxp/mimxrt700_evk/dual_core_pm/Kconfig
```kconfig
# SPDX-FileCopyrightText: Copyright 2026 NXP
# SPDX-License-Identifier: Apache-2.0

source "Kconfig.zephyr"

config SAMPLE_RT700_DUAL_CORE_PM_SLEEP_SECONDS
	int "Power-mode measurement window in seconds"
	default 2
	range 1 3600
	help
	  Number of seconds each active, sleep, or deep-sleep test case runs.

config SAMPLE_RT700_DUAL_CORE_PM_SETTLE_SECONDS
	int "Quiet time between two measurement windows in seconds"
	default 2
	range 1 3600
	help
	  Number of seconds CPU0 waits after a test case before starting the
	  next one, so consecutive windows show up as separate plateaus on a
	  current trace.
```

## samples/boards/nxp/mimxrt700_evk/dual_core_pm/Kconfig.sysbuild
```kconfig
# SPDX-FileCopyrightText: Copyright 2026 NXP
# SPDX-License-Identifier: Apache-2.0

source "share/sysbuild/Kconfig"

config SAMPLE_RT700_DUAL_CORE_PM_REMOTE_BOARD
	string "RT700 dual-core PM remote board"
	default "mimxrt700_evk/mimxrt798s/cm33_cpu1" if $(BOARD) = "mimxrt700_evk"
	help
	  Board target used for the CM33 CPU1 remote image.

config SAMPLE_RT700_DUAL_CORE_PM_SLEEP_SECONDS
	int "Power-mode measurement window in seconds"
	default 2
	range 1 3600
	help
	  Number of seconds both cores spend in each active, sleep, or
	  deep-sleep measurement window.

config SAMPLE_RT700_DUAL_CORE_PM_SETTLE_SECONDS
	int "Quiet time between two measurement windows in seconds"
	default 2
	range 1 3600
	help
	  Number of seconds CPU0 waits after a test case before starting the
	  next one, so consecutive windows show up as separate plateaus on a
	  current trace.
```

## samples/boards/nxp/mimxrt700_evk/dual_core_pm/boards/mimxrt700_evk_mimxrt798s_cm33_cpu0.conf
```kconfig
# SPDX-FileCopyrightText: Copyright 2026 NXP
# SPDX-License-Identifier: Apache-2.0

CONFIG_SECOND_CORE_MCUX=y
CONFIG_COUNTER=y
CONFIG_MCUX_OS_TIMER_PM_POWERED_OFF=y
CONFIG_PM_DEVICE=y
```

## samples/boards/nxp/mimxrt700_evk/system_off/Kconfig
```kconfig
# SPDX-FileCopyrightText: Copyright 2026 NXP
# SPDX-License-Identifier: Apache-2.0

source "Kconfig.zephyr"

config SAMPLE_RT700_SYSTEM_OFF_WAKEUP_SECONDS
	int "Deep power down measurement window in seconds"
	default 3
	range 1 3600
	help
	  Number of seconds the chip stays powered off before the iRTC wake
	  timer restarts it, so consecutive cycles show up as separate plateaus
	  on a current trace.

config SAMPLE_RT700_SYSTEM_OFF_WAIT_FOR_ENTER
	bool "Wait for ENTER before the first power off"
	default y
	help
	  Hold the cold boot at a prompt until the operator presses ENTER, so a
	  current measurement can be armed before the first power off. Disable
	  this for an unattended run.
```

## samples/boards/st/power_mgmt/wkup_pins/Kconfig
```kconfig
# SPDX-FileCopyrightText: Copyright (c) 2026 STMicroelectronics
# SPDX-License-Identifier: Apache-2.0

source "Kconfig.zephyr"

choice
	prompt "Sample scenario"
	default SAMPLE_SCENARIO_POWEROFF

config SAMPLE_SCENARIO_POWEROFF
	bool "Power Off"
	select POWEROFF
	help
	  Demonstrate usage of wake-up pins in Poweroff low-power state.
	  In this scenario, the SoC enters a deep low-power state (e.g., "Shutdown" on STM32C0)
	  and is powered off completely; a wake-up pin is then used to wake the SoC which starts
	  execution as if it had just been reset.

config SAMPLE_SCENARIO_S2RAM
	bool "Suspend to RAM"
	depends on $(dt_compat_any_has_prop,$(DT_COMPAT_ZEPHYR_POWER_STATE),power-state-name,suspend-to-ram)
	depends on SOC_SERIES_STM32WBAX  # Needs SoC-specific support; only implemented on WBA today
	select PM
	select PM_DEVICE
	select PM_DEVICE_RUNTIME
	select PM_DEVICE_SYSTEM_MANAGED
	help
	  Demonstrate usage of wake-up pins in S2RAM (suspend-to-RAM) low-power states.
	  In this scenario, wake-up pins are used to wake the SoC and trigger a GPIO callback.

endchoice

config SAMPLE_BUSY_WAIT_TIME_MS
	int "Busy-wait time (in milliseconds)"
	default 4000 if SAMPLE_SCENARIO_POWEROFF
	default 1000 if SAMPLE_SCENARIO_S2RAM
	help
	  Amount of time the system will busy-wait before entry in low-power state.
	  In the "Power Off" scenario, this delay elapses once then the system powers off.
	  In the "Suspend to RAM" scenario, this delay elapses before waiting for a button press.

config SAMPLE_BUTTON_PRESS_TIMEOUT_MS
	int "Button press timeout (in milliseconds)"
	default 5000
	depends on SAMPLE_SCENARIO_S2RAM
	help
	  Amount of time the system will wait for a button press before a timeout occurs.
	  This timeout will wake the system if the button is not pressed within the specified time.
	  Only relevant in the "Suspend to RAM" scenario.
```
