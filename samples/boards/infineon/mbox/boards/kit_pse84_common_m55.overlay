/*
 * SPDX-FileCopyrightText: Copyright (c) 2026 Infineon Technologies AG,
 * SPDX-FileCopyrightText: or an affiliate of Infineon Technologies AG. All rights reserved.
 *
 * SPDX-License-Identifier: Apache-2.0
 */

#include "kit_pse84_eval_common.overlay"

&mbox0 {
	/* CM55 NVIC vectors for IPC0 (m33syscpuss) interrupt structures 4 and 5. */
	interrupts = <29 4>, <30 4>;
};
