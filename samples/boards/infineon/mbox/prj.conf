## CMakeLists.txt
```
# SPDX-FileCopyrightText: Copyright (c) 2026 Infineon Technologies AG,
# SPDX-FileCopyrightText: or an affiliate of Infineon Technologies AG. All rights reserved.
#
# SPDX-License-Identifier: Apache-2.0

cmake_minimum_required(VERSION 3.20.0)

find_package(Zephyr REQUIRED HINTS $ENV{ZEPHYR_BASE})

project(mbox_ipc)

target_sources(app PRIVATE src/main.c)
```

## Kconfig
```
# SPDX-FileCopyrightText: Copyright (c) 2026 Infineon Technologies AG,
# SPDX-FileCopyrightText: or an affiliate of Infineon Technologies AG. All rights reserved.
#
# SPDX-License-Identifier: Apache-2.0

mainmenu "Infineon IPC MBOX sample application"

config MBOX_SAMPLE_CORE_A
	bool "Build this image for core A of the mailbox pair"
	help
	  Selects which end of the two-core ping-pong this image is built for.
	  Set it on exactly one core of the pair; the other core is core B. This
	  keeps the sample device-agnostic instead of keying off a specific CPU.

source "Kconfig.zephyr"
```

## prj.conf
```kconfig
# SPDX-FileCopyrightText: Copyright (c) 2026 Infineon Technologies AG,
# SPDX-FileCopyrightText: or an affiliate of Infineon Technologies AG. All rights reserved.
#
# SPDX-License-Identifier: Apache-2.0

CONFIG_PRINTK=y
CONFIG_MBOX=y
```

## boards/kit_pse84_eval_pse846gps2dbzc4a_m55.conf
```kconfig
# SPDX-FileCopyrightText: Copyright (c) 2026 Infineon Technologies AG,
# SPDX-FileCopyrightText: or an affiliate of Infineon Technologies AG. All rights reserved.
#
# SPDX-License-Identifier: Apache-2.0

CONFIG_MBOX_SAMPLE_CORE_A=y
```

## boards/kit_pse84_common_m33.overlay
```dts
/*
 * SPDX-FileCopyrightText: Copyright (c) 2026 Infineon Technologies AG,
 * SPDX-FileCopyrightText: or an affiliate of Infineon Technologies AG. All rights reserved.
 *
 * SPDX-License-Identifier: Apache-2.0
 */

#include "kit_pse84_eval_common.overlay"

&mbox0 {
	/* m33syscpuss NVIC vectors for IPC0 interrupt structures 4 and 5. */
	interrupts = <74 4>, <75 4>;
};
```

## boards/kit_pse84_common_m55.overlay
```dts
/*
 * SPDX-FileCopyrightText: Copyright (c) 2026 Infineon Technologies AG,
 * SPDX-FileCopyrightText: or an affiliate of Infineon Technologies AG. All rights reserved.
 *
 * SPDX-License-Identifier: Apache-2.0
 */

#include "kit_pse84_eval_common.overlay"

&mbox0 {
	/* CM55 NVIC vectors for IPC0 (m33syscpuss) interrupt structures 4 and 5. */
	interrupts = <29 4>, <30 4>;
};
```

## boards/kit_pse84_eval_common.overlay
```dts
/*
 * SPDX-FileCopyrightText: Copyright (c) 2026 Infineon Technologies AG,
 * SPDX-FileCopyrightText: or an affiliate of Infineon Technologies AG. All rights reserved.
 *
 * SPDX-License-Identifier: Apache-2.0
 */

&ipc0 {
	status = "okay";
};

/ {
	mbox0: mbox {
		compatible = "infineon,mbox";
		#mbox-cells = <1>;
		interrupt-parent = <&nvic>;

		/* Cross-core ping-pong over IPC0 (reachable from either core):
		 * channel 0 = CM33 -> CM55, channel 1 = CM55 -> CM33. IPC0
		 * channels 4/5 and interrupt structures 4/5 are application-usable.
		 * Per-core NVIC vectors are set in the board overlays.
		 */
		ipc-configs = <&ipc0 4 4>, <&ipc0 5 5>;
		status = "okay";
	};
};
```

## boards/kit_pse84_eval_pse846gps2dbzc4a_m33_ns.overlay
```dts
/*
 * SPDX-FileCopyrightText: Copyright (c) 2026 Infineon Technologies AG,
 * SPDX-FileCopyrightText: or an affiliate of Infineon Technologies AG. All rights reserved.
 *
 * SPDX-License-Identifier: Apache-2.0
 */

#include "kit_pse84_common_m33.overlay"
```

## boards/kit_pse84_eval_pse846gps2dbzc4a_m55.overlay
```dts
/*
 * SPDX-FileCopyrightText: Copyright (c) 2026 Infineon Technologies AG,
 * SPDX-FileCopyrightText: or an affiliate of Infineon Technologies AG. All rights reserved.
 *
 * SPDX-License-Identifier: Apache-2.0
 */

#include "kit_pse84_common_m55.overlay"
```

## src/main.c
```c
/*
 * SPDX-FileCopyrightText: Copyright (c) 2026 Infineon Technologies AG,
 * SPDX-FileCopyrightText: or an affiliate of Infineon Technologies AG. All rights reserved.
 *
 * SPDX-License-Identifier: Apache-2.0
 */

#include <stdio.h>
#include <stdlib.h>
#include <zephyr/kernel.h>
#include <zephyr/drivers/mbox.h>

#if defined(CONFIG_MBOX_SAMPLE_CORE_A)
#define TX_ID (1)
#define RX_ID (0)
static const bool core_a = true;
#else
#define TX_ID (0)
#define RX_ID (1)
static const bool core_a;
#endif

static uint64_t data;

static void rx_callback(const struct device *dev, uint32_t channel, void *user_data,
			struct mbox_msg *msg)
{
	printk("Pong [%s] (on channel %d [data %llu, %d])\n", core_a ? "core A" : "core B", channel,
	       *((uint64_t *)msg->data), (int)msg->size);
}

int main(void)
{
	const struct device *dev = DEVICE_DT_GET(DT_NODELABEL(mbox0));
	int mtu;

	printk("Hello from APP [%s]\n", core_a ? "core A" : "core B");

	mtu = mbox_mtu_get(dev);
	if ((mtu < 0) || ((size_t)mtu > sizeof(data))) {
		printk("mbox_mtu_get() error [%d]\n", mtu);
		return 0;
	}

	if (mbox_register_callback(dev, RX_ID, rx_callback, NULL)) {
		printk("mbox_register_callback() error\n");
		return 0;
	}

	if (mbox_set_enabled(dev, RX_ID, 1)) {
		printk("mbox_set_enabled() error\n");
		return 0;
	}

	while (1) {
		struct mbox_msg msg = {.data = &data, .size = mtu};

		printk("Ping [%s] (on channel %d)\n", core_a ? "core A" : "core B", TX_ID);

		if (mbox_send(dev, TX_ID, &msg) < 0) {
			printk("mbox_send() error [%s]\n", core_a ? "core A" : "core B");
		} else {
			data++;
		}

		k_sleep(K_MSEC(1000));
	}

	return 0;
}
```
