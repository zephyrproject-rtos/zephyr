## CMakeLists.txt
```
# SPDX-License-Identifier: Apache-2.0

cmake_minimum_required(VERSION 3.20.0)

find_package(Zephyr REQUIRED HINTS $ENV{ZEPHYR_BASE})
project(hardware_interrupt)

target_sources(app PRIVATE src/main.c)
```

## prj.conf
```kconfig
CONFIG_SENSOR=y
CONFIG_LSM6DSL_TRIGGER_NONE=y
CONFIG_LSM6DSL_GYRO_ODR=2
CONFIG_LSM6DSL_ACCEL_ODR=2
```

## boards/xiao_ble_sense.overlay
```dts
/*
*       Here you need to define the INT1 pin as a button.
*       Note: INT2 pin exists on the LSM6DS3TR-C BUT is not connected on
*       the XIAO BLE Sense!!
*/
/ {
    aliases {
        accel0 = &lsm6ds3tr_c;
        sw0 = &button0;
    };

    buttons {
             compatible = "gpio-keys";
             button0: button_0 {
                     gpios = < &gpio0 11 (GPIO_PULL_UP | GPIO_ACTIVE_LOW) >;
                     label = "INT1";
             };
        };
};
```

## src/main.c
```c
#include <zephyr/kernel.h>
#include <zephyr/device.h>
#include <zephyr/drivers/gpio.h>
#include <zephyr/sys/util.h>
#include <zephyr/sys/printk.h>
#include <inttypes.h>

#include <zephyr/../../drivers/sensor/st/lsm6dsl/lsm6dsl.h>
#include "lsm6ds3.h"


#define SW0_NODE	DT_ALIAS(sw0)
#if !DT_NODE_HAS_STATUS(SW0_NODE, okay)
#error "Unsupported board: sw0 devicetree alias is not defined"
#endif
static const struct gpio_dt_spec button = GPIO_DT_SPEC_GET_OR(SW0_NODE, gpios,
							      {0});
static struct gpio_callback button_cb_data;

static struct gpio_callback tap_cb;
static uint8_t interrupt_count = 0;

/*LED Declaration*/
static const struct gpio_dt_spec led0 = GPIO_DT_SPEC_GET(DT_ALIAS(led0), gpios);

/* initialize LSM6DS3 */
lsm6ds3_data_t lsm_data;

/* initialize dev for writing/reading to registers */
static const struct device *lsm6ds3_dev =
	DEVICE_DT_GET_OR_NULL(DT_ALIAS(accel0));

void button_pressed(const struct device *dev, struct gpio_callback *cb,
		    uint32_t pins)
{
	printk("Double Tap detected at %" PRIu32 "\n", k_cycle_get_32());
}

void setupDoubleTapInterrupt(){

    struct lsm6dsl_data *lsm_data = lsm6ds3_dev->data;
    /*
     * For more detailed descriptions of each register please refer to the LSM6DSL
     * datasheet found at http://www.st.com/resource/en/datasheet/lsm6dsl.pdf
     */

    /* CTRL1_XL(10h): Linear acceleration sensor control register, sets ODR */
    lsm_data->hw_tf->update_reg(lsm6ds3_dev, 0x10, 0xFF, 0x60);

    /* TAP_CFG(58h): Enables interrupts and inactivity functions, configuration of filtering and tap recognition functions */
    lsm_data->hw_tf->update_reg(lsm6ds3_dev, 0x58, 0xFF, 0x8E);

    /* TAP_THS_6D(59h): Portrait/landscape position and tap function threshold register */
    lsm_data->hw_tf->update_reg(lsm6ds3_dev, 0x59, 0xFF, 0x85);

    /* INT_DUR2(5Ah): Tap recognition function setting, set "Duration", "Quiet" and "Shock." */
    lsm_data->hw_tf->update_reg(lsm6ds3_dev, 0x5A, 0xFF, 0x7F);

    /* WAKE_UP_THS(5Bh): Single/double-tap event enable, leaves threshold for wakeup at default */
    lsm_data->hw_tf->update_reg(lsm6ds3_dev, 0x5B, 0xFF, 0x80);

    /* MD1_CFG(5Eh): Enables INT1_DOUBLE_TAP, routing of 6D event on INT1 pin */
    lsm_data->hw_tf->update_reg(lsm6ds3_dev, 0x5E, 0xFF, 0x08);

}

int main(void){

    int ret;

	if (!gpio_is_ready_dt(&button)) {
		printk("Error: button device %s is not ready\n",
		       button.port->name);
		return 0;
	}

	ret = gpio_pin_configure_dt(&button, GPIO_INPUT);
	if (ret != 0) {
		printk("Error %d: failed to configure %s pin %d\n",
		       ret, button.port->name, button.pin);
		return 0;
	}

	ret = gpio_pin_interrupt_configure_dt(&button,
					      GPIO_INT_EDGE_TO_ACTIVE);
	if (ret != 0) {
		printk("Error %d: failed to configure interrupt on %s pin %d\n",
			ret, button.port->name, button.pin);
		return 0;
	}

    setupDoubleTapInterrupt();

    gpio_init_callback(&button_cb_data, button_pressed, BIT(button.pin));
	gpio_add_callback(button.port, &button_cb_data);
	printk("Set up button at %s pin %d\n", button.port->name, button.pin);

	if (led0.port) {
		ret = gpio_pin_configure_dt(&led0, GPIO_OUTPUT);
		if (ret != 0) {
			printk("Error %d: failed to configure LED device %s pin %d\n",
			       ret, led0.port->name, led0.pin);
		} else {
			printk("Set up LED at %s pin %d\n", led0.port->name, led0.pin);
		}
	}

    printk("Double tap to interrupt\n");
	if (led0.port) {
		while (1) {
			/* If we have an LED, match its state to the button's. */
			int val = gpio_pin_get_dt(&button);

			if (val >= 0) {
				gpio_pin_set_dt(&led0, val);
			}
			k_msleep(1);
		}
	}
	return 0;

}
```

## src/lsm6ds3.c
```c
#include <zephyr/devicetree.h>
#include <zephyr/sys/printk.h>
#include <zephyr/logging/log.h>
#include <zephyr/drivers/sensor.h>
#include <zephyr/device.h>
#include <zephyr/kernel.h>
#include <zephyr/../../drivers/sensor/st/lsm6dsl/lsm6dsl.h>
#include <hal/nrf_gpio.h>
#include "lsm6ds3.h"

#define LSM6DS3_POWER_PIN	40 	/* Pin 8, Port 1 */

static const struct device *lsm6ds3_dev =
	DEVICE_DT_GET_OR_NULL(DT_NODELABEL(lsm6ds3tr_c));

static int lsm6ds3_power_on(const struct device *arg)
{
	/* Workaround to power on LSM6DS3 before LSM6DS3 sensor driver is initialized inside zephyr */
	nrf_gpio_cfg(LSM6DS3_POWER_PIN, NRF_GPIO_PIN_DIR_OUTPUT, NRF_GPIO_PIN_INPUT_DISCONNECT, NRF_GPIO_PIN_NOPULL,
				     NRF_GPIO_PIN_S0H1, NRF_GPIO_PIN_NOSENSE);
	nrf_gpio_pin_set(LSM6DS3_POWER_PIN);

	k_sleep(K_MSEC(10));

	return 0;
}

SYS_INIT(lsm6ds3_power_on, POST_KERNEL, CONFIG_KERNEL_INIT_PRIORITY_DEVICE);

int lsm6ds3_init(void)
{
	if (lsm6ds3_dev == NULL) {
		return -ENODEV;
	}

	return 0;
}

int lsm6ds3_read(lsm6ds3_data_t *data)
{
	struct lsm6dsl_data *raw_data;

	if (lsm6ds3_dev == NULL) {
		return -ENODEV;
	}

	if (sensor_sample_fetch_chan(lsm6ds3_dev, SENSOR_CHAN_ACCEL_XYZ)) {
		return -EBUSY;
	}

	if (sensor_sample_fetch_chan(lsm6ds3_dev, SENSOR_CHAN_GYRO_XYZ)) {
		return -EBUSY;
	}

	raw_data = (struct lsm6dsl_data *)lsm6ds3_dev->data;

	data->accel.x = raw_data->accel_sample_x;
	data->accel.y = raw_data->accel_sample_y; 
	data->accel.z = raw_data->accel_sample_z;
	data->gyro.x = raw_data->gyro_sample_x;
	data->gyro.y = raw_data->gyro_sample_y;
	data->gyro.z = raw_data->gyro_sample_z;

	return 0;
}
```

## src/lsm6ds3.h
```c
#ifndef LSM6DS3_H
#define LSM6DS3_H

typedef struct {
    struct {
        int16_t x;
        int16_t y;
        int16_t z;
    } accel;
    struct {
        int16_t x;
        int16_t y;
        int16_t z;
    } gyro;
} lsm6ds3_data_t;

int lsm6ds3_init(void);
int lsm6ds3_read(lsm6ds3_data_t *data);

#endif
```
