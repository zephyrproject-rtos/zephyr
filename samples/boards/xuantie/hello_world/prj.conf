## CMakeLists.txt
```
# SPDX-License-Identifier: Apache-2.0

cmake_minimum_required(VERSION 3.20.0)

find_package(Zephyr REQUIRED HINTS $ENV{ZEPHYR_BASE})
project(hello_world)

message("BOARD_DIR: " ${BOARD_DIR})
message("HOST_TOOLS_HOME:" ${HOST_TOOLS_HOME})

target_sources(app PRIVATE src/main.c)
```

## sample.yaml
```
sample:
  name: xuantie smp hello world

common:
  tags:
    - xuantie
    - smp
  harness: console
  harness_config:
    type: one_line
    regex:
      - "Hello World Sample End"

tests:
  sample.boards.xuantie.smp.hello_world:
    tags:
      - xuantie
      - smp
```

## prj.conf
```kconfig
# nothing here
CONFIG_NO_OPTIMIZATIONS=n
CONFIG_SMP=y
CONFIG_MP_MAX_NUM_CPUS=4
CONFIG_USE_SWITCH=y
CONFIG_PM_CPU_OPS=y
```

## src/main.c
```c
/*
 * Copyright (C) 2019-2024 Alibaba Group Holding Limited
 *
 * SPDX-License-Identifier: Apache-2.0
 */

#include <zephyr/arch/cpu.h>
#include <zephyr/kernel.h>
#include <stdlib.h>

int main(void)
{
	printk("Hello World Sample Begin\n");
	int cnt = 10;

	printk("Hello World! %s\n", CONFIG_BOARD);
	while (cnt) {
		k_msleep(1000);
		printk("Hello World! %s, cnt = %d, cpu_id: %d\n", CONFIG_BOARD, cnt--,
		arch_curr_cpu()->id);
	}

	printk("Hello World Sample End\n");

	return 0;
}
```
