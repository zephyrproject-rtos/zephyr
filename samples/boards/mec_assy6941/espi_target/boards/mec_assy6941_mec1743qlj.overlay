/*
 * Copyright (c) 2023 Microchip Technology Inc.
 *
 * SPDX-License-Identifier: Apache-2.0
 */

/* mec_assy6941 EVB with MEC1743Q-LJ daughter card
 * MEC1743 does not have an internal SPI flash.
 */

#include "mec_common.dtsi"

&qspi0 {
	status = "okay";
	pinctrl-0 = < &qspi_shd_cs0_n_gpio055
		      &qspi_shd_clk_gpio056
		      &qspi_shd_io0_gpio223
		      &qspi_shd_io1_gpio224
		      &qspi_shd_io2_gpio227
		      &qspi_shd_io3_gpio016 >;
	pinctrl-names = "default";
};
