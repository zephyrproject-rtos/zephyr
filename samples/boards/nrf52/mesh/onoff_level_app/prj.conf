## CMakeLists.txt
```
set(QEMU_EXTRA_FLAGS -s)

include($ENV{ZEPHYR_BASE}/cmake/app/boilerplate.cmake NO_POLICY_SCOPE)
project(NONE)

target_link_libraries(app subsys__bluetooth)

target_sources(app PRIVATE
	       src/main.c
	       src/common.c
	       src/mesh/ble_mesh.c
               src/mesh/device_composition.c
               src/mesh/publisher.c
               src/mesh/process_message.c
	       )

zephyr_include_directories(
	src/
	src/mesh
	$ENV{ZEPHYR_BASE}/subsys/bluetooth/controller/hal
)
```

## prj.conf
```kconfig
CONFIG_INIT_STACKS=n
CONFIG_MAIN_STACK_SIZE=512
CONFIG_SYSTEM_WORKQUEUE_STACK_SIZE=2048

CONFIG_BT_SETTINGS=y
CONFIG_FLASH=y
CONFIG_FLASH_PAGE_LAYOUT=y
CONFIG_FLASH_MAP=y
CONFIG_FCB=y
CONFIG_SETTINGS=y
CONFIG_SETTINGS_FCB=y

CONFIG_BT_OBSERVER=y
CONFIG_BT_BROADCASTER=y
CONFIG_BT_CTLR_DUP_FILTER_LEN=0
CONFIG_BT_CTLR_LE_ENC=n
CONFIG_BT_CTLR_LE_PING=n
CONFIG_BT_CTLR_DATA_LENGTH=n
CONFIG_BT_CTLR_PHY=n
CONFIG_BT_CTLR_CHAN_SEL_2=n
CONFIG_BT_CTLR_MIN_USED_CHAN=n
CONFIG_BT_CTLR_ADV_EXT=n
CONFIG_BT_CTLR_PRIVACY=n

CONFIG_BT_PERIPHERAL=y

CONFIG_BT=y
CONFIG_BT_TINYCRYPT_ECC=y
CONFIG_BT_RX_BUF_COUNT=30
CONFIG_BT_L2CAP_RX_MTU=69
CONFIG_BT_L2CAP_TX_MTU=69
CONFIG_BT_L2CAP_TX_BUF_COUNT=8

CONFIG_BT_MESH=y
CONFIG_BT_MESH_RELAY=y
CONFIG_BT_MESH_LOW_POWER=n
CONFIG_BT_MESH_FRIEND=n
CONFIG_BT_MESH_FRIEND_QUEUE_SIZE=16
CONFIG_BT_MESH_ADV_BUF_COUNT=20

CONFIG_BT_MESH_PB_GATT=y
CONFIG_BT_MESH_PB_ADV=y
CONFIG_BT_MESH_GATT_PROXY=y

##CONFIG_BT_MESH_LPN_SCAN_LATENCY=30
##CONFIG_BT_MESH_LPN_RECV_DELAY=40
#CONFIG_BT_MESH_LPN_POLL_TIMEOUT=300

CONFIG_BT_MESH_SUBNET_COUNT=2
CONFIG_BT_MESH_APP_KEY_COUNT=2
CONFIG_BT_MESH_MODEL_GROUP_COUNT=2
CONFIG_BT_MESH_LABEL_COUNT=3

#CONFIG_BT_MESH_IV_UPDATE_TEST=y

#CONFIG_UART_CONSOLE=n
#CONFIG_BT_DEBUG_MONITOR=y
##CONFIG_BT_DEBUG_LOG=y

##CONFIG_BT_MESH_DEBUG=y
#CONFIG_BT_MESH_DEBUG_PROV=y
#CONFIG_BT_MESH_DEBUG_PROXY=y
#CONFIG_BT_MESH_DEBUG_BEACON=y
##CONFIG_BT_MESH_DEBUG_NET=y
##CONFIG_BT_MESH_DEBUG_TRANS=y
##CONFIG_BT_MESH_DEBUG_SETTINGS=y
#CONFIG_BT_MESH_DEBUG_LOW_POWER=y
##CONFIG_BT_MESH_DEBUG_FRIEND=y
#CONFIG_BT_MESH_DEBUG_MODEL=y
#CONFIG_BT_MESH_DEBUG_ACCESS=y
#CONFIG_BT_MESH_DEBUG_CRYPTO=y
#CONFIG_BT_MESH_DEBUG_ADV=y
#CONFIG_BT_MESH_SELF_TEST=y

#CONFIG_BT_RX_STACK_SIZE=4096
#CONFIG_BT_MESH_RPL_STORE_TIMEOUT=5

CONFIG_GPIO=y
#CONFIG_FLASH=y

CONFIG_NVS=y
CONFIG_NVS_LOG=y
CONFIG_NVS_LOG_LEVEL=4
CONFIG_REBOOT=y
CONFIG_MPU_ALLOW_FLASH_WRITE=y
```

## microbit_gatt.conf
```kconfig
#CONFIG_INIT_STACKS=y
CONFIG_MAIN_STACK_SIZE=320
CONFIG_IDLE_STACK_SIZE=128
CONFIG_MICROBIT_DISPLAY=y
CONFIG_SYS_CLOCK_TICKS_PER_SEC=250
CONFIG_GPIO=y

CONFIG_BT_PERIPHERAL=y
CONFIG_BT_MESH_GATT_PROXY=y
CONFIG_BT_MESH_PB_GATT=y
CONFIG_BT_MESH_PB_ADV=n

CONFIG_BT=y
CONFIG_BT_DEVICE_NAME="Zephyr Mesh"
CONFIG_BT_TINYCRYPT_ECC=y
CONFIG_BT_RX_STACK_SIZE=1400
CONFIG_BT_L2CAP_RX_MTU=69
CONFIG_BT_L2CAP_TX_MTU=69
CONFIG_BT_L2CAP_TX_BUF_COUNT=5

CONFIG_BT_CTLR_DUP_FILTER_LEN=0
CONFIG_BT_OBSERVER=y
CONFIG_BT_BROADCASTER=y

CONFIG_BT_CTLR_LE_ENC=n
CONFIG_BT_CTLR_LE_PING=n
CONFIG_BT_CTLR_DATA_LENGTH=n
CONFIG_BT_CTLR_PHY=n
CONFIG_BT_CTLR_CHAN_SEL_2=n
CONFIG_BT_CTLR_MIN_USED_CHAN=n
CONFIG_BT_CTLR_ADV_EXT=n
CONFIG_BT_CTLR_PRIVACY=n

CONFIG_BT_MESH=y
CONFIG_BT_MESH_RX_SDU_MAX=36
CONFIG_BT_MESH_RELAY=y
CONFIG_BT_MESH_MSG_CACHE_SIZE=2

#CONFIG_BT_MESH_LOW_POWER=y

#CONFIG_BT_MESH_SELF_TEST=y
#CONFIG_BT_MESH_IV_UPDATE_TEST=y

CONFIG_BT_MESH_SUBNET_COUNT=1
CONFIG_BT_MESH_APP_KEY_COUNT=1
CONFIG_BT_MESH_MODEL_GROUP_COUNT=1
CONFIG_BT_MESH_LABEL_COUNT=0

#CONFIG_UART_CONSOLE=n
#CONFIG_BT_DEBUG_MONITOR=y
#CONFIG_BT_DEBUG_LOG=y

#CONFIG_BT_MESH_DEBUG=y
#CONFIG_BT_MESH_DEBUG_NET=y
#CONFIG_BT_MESH_DEBUG_PROXY=y
#CONFIG_BT_MESH_DEBUG_TRANS=y
#CONFIG_BT_MESH_DEBUG_PROV=y
#CONFIG_BT_MESH_DEBUG_BEACON=y
#CONFIG_BT_MESH_DEBUG_CRYPTO=y
#CONFIG_BT_MESH_DEBUG_ADV=y
#CONFIG_BT_MESH_DEBUG_ACCESS=y
```

## prj_bbc_microbit.conf
```kconfig
CONFIG_INIT_STACKS=y
CONFIG_MAIN_STACK_SIZE=512
CONFIG_MICROBIT_DISPLAY=y
CONFIG_SYS_CLOCK_TICKS_PER_SEC=250
CONFIG_GPIO=y

CONFIG_BT=y
CONFIG_BT_TINYCRYPT_ECC=y
CONFIG_BT_RX_STACK_SIZE=1100

CONFIG_BT_CTLR_DUP_FILTER_LEN=0
CONFIG_BT_OBSERVER=y
CONFIG_BT_BROADCASTER=y

CONFIG_BT_CTLR_LE_ENC=n
CONFIG_BT_CTLR_LE_PING=n
CONFIG_BT_CTLR_DATA_LENGTH=n
CONFIG_BT_CTLR_PHY=n
CONFIG_BT_CTLR_CHAN_SEL_2=n
CONFIG_BT_CTLR_MIN_USED_CHAN=n
CONFIG_BT_CTLR_ADV_EXT=n
CONFIG_BT_CTLR_PRIVACY=n

CONFIG_BT_MESH=y
CONFIG_BT_MESH_RX_SDU_MAX=36
CONFIG_BT_MESH_RELAY=y

#CONFIG_BT_MESH_LOW_POWER=y

#CONFIG_BT_MESH_SELF_TEST=y
#CONFIG_BT_MESH_IV_UPDATE_TEST=y

CONFIG_BT_MESH_SUBNET_COUNT=1
CONFIG_BT_MESH_APP_KEY_COUNT=1
CONFIG_BT_MESH_MODEL_GROUP_COUNT=1
CONFIG_BT_MESH_LABEL_COUNT=0

#CONFIG_BT_DEBUG_LOG=y

#CONFIG_BT_MESH_DEBUG=y
#CONFIG_BT_MESH_DEBUG_NET=y
#CONFIG_BT_MESH_DEBUG_TRANS=y
#CONFIG_BT_MESH_DEBUG_PROV=y
#CONFIG_BT_MESH_DEBUG_BEACON=y
#CONFIG_BT_MESH_DEBUG_CRYPTO=y
#CONFIG_BT_MESH_DEBUG_ADV=y
#CONFIG_BT_MESH_DEBUG_ACCESS=y
```

## src/main.c
```c
#include "common.h"

void main(void)
{
	int err, rc = 0;

	rc = nvs_init(&fs, FLASH_DEV_NAME, STORAGE_MAGIC);

	if (rc) {
		printk("Flash Init failed\n");
	}

	if (nvs_read(&fs, NVS_LED_STATE_ID,
		     &light_state_current,
		     sizeof(struct light_state_t)) < 0) {

		printk("\n\rentry for NVS_LED_STATE_ID is not found on NVS\n");

		light_state_current.OnOff = 1;
		light_state_current.power = LEVEL_100;
	}

	printk("led_on_off_status -> %d, led_level_status -> %d\n",
	       light_state_current.OnOff, light_state_current.power);

	gpio_init();

	update_light_state();

	printk("Initializing...\n");

	/* Initialize the Bluetooth Subsystem */
	err = bt_enable(bt_ready);

	if (err) {
		printk("Bluetooth init failed (err %d)\n", err);
	}
}
```

## src/common.c
```c
#include "common.h"

struct nvs_fs fs = {
	.sector_size = NVS_SECTOR_SIZE,
	.sector_count = NVS_SECTOR_COUNT,
	.offset = NVS_STORAGE_OFFSET,
	.max_len = NVS_MAX_ELEM_SIZE,
};

struct device *led_device[4];
struct device *button_device[4];

static struct k_work button_work;

static void button_pressed(struct device *dev,
			   struct gpio_callback *cb, uint32_t pins)
{
	k_work_submit(&button_work);
}

void gpio_init(void)
{
	static struct gpio_callback button_cb[4];

	/* --------------- LEDs configiuratin & setting --------------- */

	led_device[0] = device_get_binding(LED0_GPIO_PORT);
	gpio_pin_configure(led_device[0], LED0_GPIO_PIN,
			   GPIO_DIR_OUT | GPIO_PUD_PULL_UP);
	gpio_pin_write(led_device[0], LED0_GPIO_PIN, 1);

	led_device[1] = device_get_binding(LED1_GPIO_PORT);
	gpio_pin_configure(led_device[1], LED1_GPIO_PIN,
			   GPIO_DIR_OUT | GPIO_PUD_PULL_UP);
	gpio_pin_write(led_device[1], LED1_GPIO_PIN, 1);

	led_device[2] = device_get_binding(LED2_GPIO_PORT);
	gpio_pin_configure(led_device[2], LED2_GPIO_PIN,
			   GPIO_DIR_OUT | GPIO_PUD_PULL_UP);
	gpio_pin_write(led_device[2], LED2_GPIO_PIN, 1);

	led_device[3] = device_get_binding(LED3_GPIO_PORT);
	gpio_pin_configure(led_device[3], LED3_GPIO_PIN,
			   GPIO_DIR_OUT | GPIO_PUD_PULL_UP);
	gpio_pin_write(led_device[3], LED3_GPIO_PIN, 1);

	/* --------------- Buttons configiuratin & setting --------------- */

	k_work_init(&button_work, publish);

	button_device[0] = device_get_binding(SW0_GPIO_NAME);
	gpio_pin_configure(button_device[0], SW0_GPIO_PIN,
			   (GPIO_DIR_IN | GPIO_INT | GPIO_INT_EDGE |
			   GPIO_PUD_PULL_UP |
			   GPIO_INT_DEBOUNCE | GPIO_INT_ACTIVE_LOW));
	gpio_init_callback(&button_cb[0], button_pressed, BIT(SW0_GPIO_PIN));
	gpio_add_callback(button_device[0], &button_cb[0]);
	gpio_pin_enable_callback(button_device[0], SW0_GPIO_PIN);


	button_device[1] = device_get_binding(SW1_GPIO_NAME);
	gpio_pin_configure(button_device[1], SW1_GPIO_PIN,
			   (GPIO_DIR_IN | GPIO_INT | GPIO_INT_EDGE |
			   GPIO_PUD_PULL_UP |
			   GPIO_INT_DEBOUNCE | GPIO_INT_ACTIVE_LOW));
	gpio_init_callback(&button_cb[1], button_pressed, BIT(SW1_GPIO_PIN));
	gpio_add_callback(button_device[1], &button_cb[1]);
	gpio_pin_enable_callback(button_device[1], SW1_GPIO_PIN);


	button_device[2] = device_get_binding(SW2_GPIO_NAME);
	gpio_pin_configure(button_device[2], SW2_GPIO_PIN,
			   (GPIO_DIR_IN | GPIO_INT | GPIO_INT_EDGE |
			   GPIO_PUD_PULL_UP |
			   GPIO_INT_DEBOUNCE | GPIO_INT_ACTIVE_LOW));
	gpio_init_callback(&button_cb[2], button_pressed, BIT(SW2_GPIO_PIN));
	gpio_add_callback(button_device[2], &button_cb[2]);
	gpio_pin_enable_callback(button_device[2], SW2_GPIO_PIN);


	button_device[3] = device_get_binding(SW3_GPIO_NAME);
	gpio_pin_configure(button_device[3], SW3_GPIO_PIN,
			   (GPIO_DIR_IN | GPIO_INT | GPIO_INT_EDGE |
			   GPIO_PUD_PULL_UP |
			   GPIO_INT_DEBOUNCE | GPIO_INT_ACTIVE_LOW));
	gpio_init_callback(&button_cb[3], button_pressed, BIT(SW3_GPIO_PIN));
	gpio_add_callback(button_device[3], &button_cb[3]);
	gpio_pin_enable_callback(button_device[3], SW3_GPIO_PIN);
}

struct light_state_t light_state_current;

void update_light_state(void)
{
	int power = 100 * (light_state_current.power + 32768)/65535;

	if (light_state_current.OnOff == 0x01) {
		/* LED1 On */
		gpio_pin_write(led_device[0], LED0_GPIO_PIN, 0);
	} else {
		/* LED1 Off */
		gpio_pin_write(led_device[0], LED0_GPIO_PIN, 1);
	}

	if (power < 50) {
		/* LED3 On */
		gpio_pin_write(led_device[2], LED2_GPIO_PIN, 0);
		/* LED4 Off */
		gpio_pin_write(led_device[3], LED3_GPIO_PIN, 1);
	} else {
		/* LED3 Off */
		gpio_pin_write(led_device[2], LED2_GPIO_PIN, 1);
		/* LED4 On */
		gpio_pin_write(led_device[3], LED3_GPIO_PIN, 0);
	}
}

void nvs_light_state_save(void)
{
	if (nvs_write(&fs, NVS_LED_STATE_ID, &light_state_current,
	    sizeof(struct light_state_t)) > 0) {

		printk("\n\rLight state has saved !!\n\r");

	} else {

		printk("\n\rLight state has not saved !!\n\r");
	}
}
```

## src/common.h
```c
#ifndef _COMMON_H
#define _COMMON_H

#define  SETB(x, y)   (x |= (1<<y))     /* for o/p */
#define  CLRB(x, y)   (x &= (~(1<<y)))  /* for o/p */
#define  TGLB(x, y)   (x ^= (1<<y))     /* for o/p */
#define  CHECKB(x, y) (x &  (1<<y))     /* for i/p */

#include <misc/printk.h>
#include <settings/settings.h>

#include <misc/byteorder.h>
#include <nrf.h>
#include <device.h>
#include <gpio.h>
#include <bluetooth/bluetooth.h>
#include <bluetooth/conn.h>
#include <bluetooth/l2cap.h>
#include <bluetooth/hci.h>
#include <bluetooth/mesh.h>
#include <stdio.h>

#include <board.h>

#include "nrf52840.h"
#include "board.h"

#include "ble_mesh.h"
#include "device_composition.h"
#include "publisher.h"

/* -------------------- COMPANY ID -------------------- */

#define CID_INTEL 0x0002

/* -------------------- GPIO -------------------- */

extern struct device *button_device[4];
extern struct device *led_device[4];

void gpio_init(void);

/* -------------------- NVS -------------------- */

#include <nvs/nvs.h>

#define NVS_LED_STATE_ID 1

/* hex for "MESH" */
#define STORAGE_MAGIC 0x4d455348

/* Multiple of FLASH_PAGE_SIZE */
#define NVS_SECTOR_SIZE 4096

/* At least 2 sectors */
#define NVS_SECTOR_COUNT 2

/* Start address of the filesystem in flash */
#define NVS_STORAGE_OFFSET (FLASH_AREA_STORAGE_OFFSET - 8192)

/* Largest item that can be stored */
#define NVS_MAX_ELEM_SIZE 256

extern struct nvs_fs fs;

/* -------------------- Others -------------------- */

#define LEVEL_0   -32768
#define LEVEL_25  -16384
#define LEVEL_50  0
#define LEVEL_75  16384
#define LEVEL_100 32767

struct light_state_t {

	uint8_t OnOff;
	int16_t power;
};

extern struct light_state_t light_state_current;

void update_light_state(void);
void nvs_light_state_save(void);

#endif
```

## src/microbit.c
```c
/* microbit.c - BBC micro:bit specific hooks */

/*
 * Copyright (c) 2017 Intel Corporation
 *
 * SPDX-License-Identifier: Apache-2.0
 */

#include <gpio.h>
#include <board.h>

#include <display/mb_display.h>

#include <bluetooth/mesh.h>

#include "board.h"

static uint32_t oob_number;
static struct device *gpio;

static void button_pressed(struct device *dev, struct gpio_callback *cb,
			   uint32_t pins)
{
	struct mb_display *disp = mb_display_get();

	mb_display_print(disp, MB_DISPLAY_MODE_DEFAULT, K_MSEC(500),
			 "%04u", oob_number);
}

static void configure_button(void)
{
	static struct gpio_callback button_cb;

	gpio = device_get_binding(SW0_GPIO_NAME);

	gpio_pin_configure(gpio, SW0_GPIO_PIN,
			   (GPIO_DIR_IN | GPIO_INT | GPIO_INT_EDGE |
			    GPIO_INT_ACTIVE_LOW));

	gpio_init_callback(&button_cb, button_pressed, BIT(SW0_GPIO_PIN));

	gpio_add_callback(gpio, &button_cb);
}

void board_output_number(bt_mesh_output_action_t action, uint32_t number)
{
	struct mb_display *disp = mb_display_get();
	struct mb_image arrow = MB_IMAGE({ 0, 0, 1, 0, 0 },
					 { 0, 1, 0, 0, 0 },
					 { 1, 1, 1, 1, 1 },
					 { 0, 1, 0, 0, 0 },
					 { 0, 0, 1, 0, 0 });

	oob_number = number;

	gpio_pin_enable_callback(gpio, SW0_GPIO_PIN);

	mb_display_image(disp, MB_DISPLAY_MODE_DEFAULT, K_FOREVER, &arrow, 1);
}

void board_prov_complete(void)
{
	struct mb_display *disp = mb_display_get();
	struct mb_image arrow = MB_IMAGE({ 0, 1, 0, 1, 0 },
					 { 0, 1, 0, 1, 0 },
					 { 0, 0, 0, 0, 0 },
					 { 1, 0, 0, 0, 1 },
					 { 0, 1, 1, 1, 0 });


	gpio_pin_disable_callback(gpio, SW0_GPIO_PIN);

	mb_display_image(disp, MB_DISPLAY_MODE_DEFAULT, K_SECONDS(10),
			 &arrow, 1);
}

void board_init(void)
{
	struct mb_display *disp = mb_display_get();
	static struct mb_image blink[] = {
		MB_IMAGE({ 1, 1, 1, 1, 1 },
			 { 1, 1, 1, 1, 1 },
			 { 1, 1, 1, 1, 1 },
			 { 1, 1, 1, 1, 1 },
			 { 1, 1, 1, 1, 1 }),
		MB_IMAGE({ 0, 0, 0, 0, 0 },
			 { 0, 0, 0, 0, 0 },
			 { 0, 0, 0, 0, 0 },
			 { 0, 0, 0, 0, 0 },
			 { 0, 0, 0, 0, 0 })
	};

	mb_display_image(disp, MB_DISPLAY_MODE_DEFAULT | MB_DISPLAY_FLAG_LOOP,
			 K_SECONDS(1), blink, ARRAY_SIZE(blink));

	configure_button();
}
```

## src/pwm.c
```c
#include "common.h"

uint16_t pwm_seq[4] = {ZERO_INTENSITY, ZERO_INTENSITY, 0, 0};

void pwm_init(int led0, int led1)
{

  NRF_P0->DIR |= (1 << led0) | (1 << led1);

  CLRB(NRF_P0->OUT,13);
  CLRB(NRF_P0->OUT,14);

  NRF_PWM0->PSEL.OUT[0] = led0;
  NRF_PWM0->PSEL.OUT[1] = led1;
  
  NRF_PWM0->MODE = 0x00000000;

  NRF_PWM0->PRESCALER = 0x00000007; //125 Khz

  NRF_PWM0->COUNTERTOP = ZERO_INTENSITY;  //1 Khz

  NRF_PWM0->DECODER = 0x00000002;
  
  NRF_PWM0->LOOP = 0x00000000;
  
  NRF_PWM0->SEQ[0].REFRESH = 0;
  
  NRF_PWM0->SEQ[0].ENDDELAY = 0;

  NRF_PWM0->SEQ[0].PTR = (uint32_t)(pwm_seq);
  
  NRF_PWM0->SEQ[0].CNT = 4;

  NRF_PWM0->ENABLE = 0x00000001;
  
  NRF_PWM0->TASKS_SEQSTART[0] = 1;

}

void pwm_enable(void)
{
	NRF_PWM0->ENABLE = 0x00000001;

	NRF_PWM0->TASKS_SEQSTART[0] = 1;
}

void pwm_disable(void)
{
	CLRB(NRF_P0->OUT,13);
	CLRB(NRF_P0->OUT,14);

	NRF_PWM0->ENABLE = 0x00000000;
}

void pwm_power_colour_smooth(unsigned char power, unsigned char colour)
{
	static unsigned char last_power = 0, last_colour = 0;
	unsigned char tmp = 0;

	//printk("\n\rpower = %d, colour = %d\n\r", power, colour);

	if(power < 0)
	{
		pwm_seq[0] = ZERO_INTENSITY;
		pwm_seq[1] = ZERO_INTENSITY;
		
		NRF_PWM0->TASKS_SEQSTART[0] = 1;

		last_power = 0;
	}
	else
	{	
		if(power < last_power)
		{
			while(power < last_power)
			{
				last_power--;

				tmp = (u8_t)(colour * last_power * 0.01);

				pwm_seq[0] = (u16_t)(ZERO_INTENSITY - (ZERO_INTENSITY * (last_power - tmp) * 0.01));

				pwm_seq[1] = (u16_t)(ZERO_INTENSITY - (ZERO_INTENSITY * tmp * 0.01));

				NRF_PWM0->TASKS_SEQSTART[0] = 1;
		
				k_sleep(1);
			}

			last_colour = tmp;
		}
		else if(power > last_power)
		{
			while(power > last_power)
			{
				last_power++;

				tmp = (u8_t)(colour * last_power * 0.01);

				pwm_seq[0] = (u16_t)(ZERO_INTENSITY - (ZERO_INTENSITY * (last_power - tmp) * 0.01));

				pwm_seq[1] = (u16_t)(ZERO_INTENSITY - (ZERO_INTENSITY * tmp * 0.01));	

				NRF_PWM0->TASKS_SEQSTART[0] = 1;

				k_sleep(1);
			}

			last_colour = tmp;
		}
		else
		{
			tmp = (u8_t)(colour * power * 0.01);

			if(tmp < last_colour)
			{
				while(tmp < last_colour)
				{
					last_colour--;

					pwm_seq[0] = (u16_t)(ZERO_INTENSITY - (ZERO_INTENSITY * (power - last_colour) * 0.01));

					pwm_seq[1] = (u16_t)(ZERO_INTENSITY - (ZERO_INTENSITY * last_colour * 0.01));	

					NRF_PWM0->TASKS_SEQSTART[0] = 1;

					k_sleep(1);
				}
			}
			else if(tmp > last_colour)
			{
				while(tmp > last_colour)
				{
					last_colour++;
					
					pwm_seq[0] = (u16_t)(ZERO_INTENSITY - (ZERO_INTENSITY * (power - last_colour) * 0.01));

					pwm_seq[1] = (u16_t)(ZERO_INTENSITY - (ZERO_INTENSITY * last_colour * 0.01));	

					NRF_PWM0->TASKS_SEQSTART[0] = 1;
					
					k_sleep(1);
				}
			}
			else
			{
				pwm_seq[0] = (u16_t)(ZERO_INTENSITY - (ZERO_INTENSITY * (power - last_colour) * 0.01));

				pwm_seq[1] = (u16_t)(ZERO_INTENSITY - (ZERO_INTENSITY * last_colour * 0.01));	

				NRF_PWM0->TASKS_SEQSTART[0] = 1;
			}	
		}
	}

}

void pwm_power_colour(unsigned char power, unsigned char colour)
{
	unsigned char tmp;
	
	if(power < 0)
	{
		pwm_seq[0] = ZERO_INTENSITY;
		pwm_seq[1] = ZERO_INTENSITY;
		
		NRF_PWM0->TASKS_SEQSTART[0] = 1;

	}
	else
	{
		tmp = (u8_t)(colour * power * 0.01);

		pwm_seq[0] = (u16_t)(ZERO_INTENSITY - (ZERO_INTENSITY * (power - tmp) * 0.01));

		pwm_seq[1] = (u16_t)(ZERO_INTENSITY - (ZERO_INTENSITY * tmp * 0.01));	

		NRF_PWM0->TASKS_SEQSTART[0] = 1;
	}

}
```

## src/pwm.h
```c
#ifndef _PWM_H
#define _PWM_H

#define ZERO_INTENSITY 125

extern uint16_t pwm_seq[4];

void pwm_init(int, int);
void pwm_enable(void);
void pwm_disable(void);
void pwm_power_colour_smooth(unsigned char, unsigned char);
void pwm_power_colour(unsigned char, unsigned char);

#endif
```

## src/saadc.c
```c
#include "common.h"

static int result = 0;

void saadc_init(void)
{
	NRF_SAADC->CH[1].CONFIG |= (1 << 24) | (0 << 20) | (5 << 16) | (1 << 12) | (2 << 8) | (0 << 4) | (0 << 0);

	NRF_SAADC->CH[1].PSELP = 0x00000002;
	NRF_SAADC->CH[1].PSELN = 0x00000000;

	NRF_SAADC->RESOLUTION = 0x00000000; // 8-bit

	NRF_SAADC->RESULT.MAXCNT = 1;
	NRF_SAADC->RESULT.PTR = (uint32_t)&result;

	NRF_SAADC->OVERSAMPLE = 0x00000008;

	NRF_SAADC->SAMPLERATE = 0x00000000;

	NRF_SAADC->ENABLE = 0x00000001;

	NRF_SAADC->TASKS_CALIBRATEOFFSET = 1;
	while (NRF_SAADC->EVENTS_CALIBRATEDONE == 0);
	NRF_SAADC->EVENTS_CALIBRATEDONE = 0;

	while(NRF_SAADC->STATUS == 0x01);
}

int saadc_read(void)
{
	int tmp = 0;

	NRF_SAADC->TASKS_START = 1;
	while (NRF_SAADC->EVENTS_STARTED == 0);
	NRF_SAADC->EVENTS_STARTED = 0;

	// Do a SAADC sample, will put the result in the configured RAM buffer.
	NRF_SAADC->TASKS_SAMPLE = 1;
	while (NRF_SAADC->EVENTS_END == 0);
	NRF_SAADC->EVENTS_END = 0;

	// Stop the SAADC, since it's not used anymore.
	NRF_SAADC->TASKS_STOP = 1;
	while (NRF_SAADC->EVENTS_STOPPED == 0);
	NRF_SAADC->EVENTS_STOPPED = 0;

	tmp = (int)(result*100.0/256.0) ;

	return tmp;	
}
```

## src/saadc.h
```c
#ifndef _ADC_H
#define _ADC_H

void saadc_init(void);
int saadc_read(void);

#endif
```
