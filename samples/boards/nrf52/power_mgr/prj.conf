## CMakeLists.txt
```
cmake_minimum_required(VERSION 3.13.1)
include($ENV{ZEPHYR_BASE}/cmake/app/boilerplate.cmake NO_POLICY_SCOPE)
project(nrf52_power_mgr)

FILE(GLOB app_sources src/*.c)
target_sources(app PRIVATE ${app_sources})
```

## Kconfig
```
# SPDX-License-Identifier: Apache-2.0

config NRF5_POWER_MGMT_EXAMPLE
	bool
	default y
	select HAS_SYS_POWER_STATE_SLEEP_1
	select HAS_SYS_POWER_STATE_SLEEP_2
	help
	  Hidden option enabling LPS_1 and LPS_2 low power states.
	  This is needed, as these states are implemented by this example.

# Include Zephyr's Kconfig.
source "$ZEPHYR_BASE/Kconfig"
```

## sample.yaml
```
sample:
  name: Low Power State Sample for nRF5x
tests:
  sample.board.nrf52.pm.low_power_state:
    platform_whitelist: nrf52840_pca10056 nrf52_pca10040 nrf51_pca10028
    timeout: 40
    tags: power
    harness: console
    harness_config:
      type: multi_line
      regex:
        - "--> Entering to SYS_POWER_STATE_SLEEP_2 state."
        - "--> Exited from SYS_POWER_STATE_SLEEP_2 state."
        - "--> Entering to SYS_POWER_STATE_SLEEP_1 state."
        - "--> Exited from SYS_POWER_STATE_SLEEP_1 state."
        - "--> Entering to SYS_POWER_STATE_DEEP_SLEEP_1 state."
```

## prj.conf
```kconfig
CONFIG_SYS_POWER_MANAGEMENT=y
CONFIG_SYS_POWER_SLEEP_STATES=y
CONFIG_SYS_POWER_DEEP_SLEEP_STATES=y
CONFIG_SYS_PM_STATE_LOCK=y
CONFIG_SYS_PM_MIN_RESIDENCY_SLEEP_1=1500
CONFIG_SYS_PM_MIN_RESIDENCY_SLEEP_2=3500
CONFIG_GPIO=y
CONFIG_LOG=y
#CONFIG_SYS_PM_LOG_LEVEL_DBG=y
```

## prj_tickless.conf
```kconfig
CONFIG_NUM_COOP_PRIORITIES=29
CONFIG_NUM_PREEMPT_PRIORITIES=40
CONFIG_SYS_POWER_MANAGEMENT=y
CONFIG_SYS_POWER_SLEEP_STATES=y
CONFIG_SYS_POWER_DEEP_SLEEP_STATES=y
CONFIG_DEVICE_POWER_MANAGEMENT=y
CONFIG_TICKLESS_KERNEL=y
CONFIG_SYS_PM_STATE_LOCK=y
CONFIG_SYS_PM_MIN_RESIDENCY_SLEEP_1=5
CONFIG_SYS_PM_MIN_RESIDENCY_SLEEP_2=15
CONFIG_GPIO=y
```

## src/main.c
```c
/*
 * Copyright (c) 2019 Nordic Semiconductor ASA
 *
 * SPDX-License-Identifier: Apache-2.0
 */

#include <stdio.h>
#include <hal/nrf_gpio.h>
#include "sample.h"

#define BUSY_WAIT_DELAY_S 1

struct device *gpio_port;

const char *uptime_str(void)
{
	static char buf[12];	/* [sss.mmm]:_\0 */
	u32_t now = k_uptime_get_32();

	snprintf(buf, sizeof(buf), "[%3u.%03u]: ", now / MSEC_PER_SEC,
		 now % MSEC_PER_SEC);
	return buf;
}

static void do_delay(u32_t delay_ms)
{
	printk("%sSleep %u ms\n", uptime_str(), delay_ms);
	k_sleep(K_MSEC(delay_ms));
}

/* Application main Thread */
void main(void)
{
	static const u32_t residencies[] = {
		CONFIG_SYS_PM_MIN_RESIDENCY_SLEEP_1,
		CONFIG_SYS_PM_MIN_RESIDENCY_SLEEP_2,
	};

	printk("\n\n*** Power Management Demo on %s ***\n", CONFIG_BOARD);

	printk("Simulate the effect of supporting system sleep states:\n"
	       "* Sleep for durations less than %u ms (S0) leaves LEDs on\n",
	       residencies[0]);
	printk("* Sleep for durations between %u and %u ms (S1) turns off LED 1\n",
	       residencies[0], residencies[1]);
	printk("* Sleep for durations above %u ms (S2) turns off LED 2\n",
	       residencies[1]);
	printk("* Sleep above %u ms enters system off.\n",
	       CONFIG_SYS_PM_MIN_RESIDENCY_DEEP_SLEEP_1);

	printk("%u power states are supported\n", (u32_t)SYS_POWER_STATE_MAX);

	gpio_port = device_get_binding(PORT);

	/* Configure LEDs */
	gpio_pin_configure(gpio_port, LED_1, GPIO_DIR_OUT);
	gpio_pin_write(gpio_port, LED_1, LED_ON);

	gpio_pin_configure(gpio_port, LED_2, GPIO_DIR_OUT);
	gpio_pin_write(gpio_port, LED_2, LED_ON);

	/* Use bits to record enabled state and walk through all four
	 * combinations.
	 */
	int cfg = 0x03;

	while (cfg >= 0) {
		bool enabled;

		/* Nasty logic to configure state because enable/disable are not
		 * idempotent.  See issue #20775.
		 */
		enabled = sys_pm_ctrl_is_state_enabled(SYS_POWER_STATE_SLEEP_1);
		if (enabled != ((cfg & 0x01) != 0)) {
			if (enabled) {
				sys_pm_ctrl_disable_state(SYS_POWER_STATE_SLEEP_1);
			} else {
				sys_pm_ctrl_enable_state(SYS_POWER_STATE_SLEEP_1);
			}
		}

		enabled = sys_pm_ctrl_is_state_enabled(SYS_POWER_STATE_SLEEP_2);
		if (enabled != ((cfg & 0x02) != 0)) {
			if (enabled) {
				sys_pm_ctrl_disable_state(SYS_POWER_STATE_SLEEP_2);
			} else {
				sys_pm_ctrl_enable_state(SYS_POWER_STATE_SLEEP_2);
			}
		}

		printk("%sSys states for %02x: %cS1 %cS2\n", uptime_str(), cfg,
		       sys_pm_ctrl_is_state_enabled(SYS_POWER_STATE_SLEEP_1) ? '+' : '-',
		       sys_pm_ctrl_is_state_enabled(SYS_POWER_STATE_SLEEP_2) ? '+' : '-');

		printk("%sBusy-wait %u s\n", uptime_str(), BUSY_WAIT_DELAY_S);
		k_busy_wait(BUSY_WAIT_DELAY_S * USEC_PER_SEC);

		do_delay(residencies[0] - 1U);
		do_delay((residencies[0] + residencies[1]) / 2U);
		do_delay(residencies[1]);

		--cfg;
	}
	printk("%sCompleted cycle through sleep power state combinations\n",
	       uptime_str());

	/* Configure to generate PORT event (wakeup) on button 1 press. */
	nrf_gpio_cfg_input(BUTTON_1, NRF_GPIO_PIN_PULLUP);
	nrf_gpio_cfg_sense_set(BUTTON_1, NRF_GPIO_PIN_SENSE_LOW);

	printk("%sFalling off main(); press BUTTON1 to restart\n",
	       uptime_str());
}
```

## src/device.c
```c
/*
 * Copyright (c) 2018 Intel Corporation.
 *
 * SPDX-License-Identifier: Apache-2.0
 */

#include "test.h"

static struct device *gpiob;
static struct device *device_list;
static int device_count;

/*
 * Example ordered list to store devices on which
 * device power policies would be executed.
 */
#define DEVICE_POLICY_MAX 15
static char device_ordered_list[DEVICE_POLICY_MAX];
static char device_retval[DEVICE_POLICY_MAX];

/* Initialize and configure GPIO */
void gpio_setup(void)
{

	gpiob = device_get_binding(PORT);

	/* Configure button 1 as deep sleep trigger event */
	gpio_pin_configure(gpiob, BUTTON_1, GPIO_DIR_IN
				| GPIO_PUD_PULL_UP);

	/* Configure button 2 as wake source from deep sleep */
	gpio_pin_configure(gpiob, BUTTON_2, GPIO_DIR_IN
				| GPIO_PUD_PULL_UP
				| GPIO_INT | GPIO_INT_LEVEL
				| GPIO_CFG_SENSE_LOW);

	gpio_pin_enable_callback(gpiob, BUTTON_2);
}

void suspend_devices(void)
{

	for (int i = device_count - 1; i >= 0; i--) {
		int idx = device_ordered_list[i];

		/* If necessary  the policy manager can check if a specific
		 * device in the device list is busy as shown below :
		 * if(device_busy_check(&device_list[idx])) {do something}
		 */
		device_retval[i] = device_set_power_state(&device_list[idx],
						DEVICE_PM_SUSPEND_STATE);
	}
}

void resume_devices(void)
{
	int i;

	for (i = 0; i < device_count; i++) {
		if (!device_retval[i]) {
			int idx = device_ordered_list[i];

			device_set_power_state(&device_list[idx],
						DEVICE_PM_ACTIVE_STATE);
		}
	}
}

void create_device_list(void)
{
	int count;
	int i;

	/*
	 * Following is an example of how the device list can be used
	 * to suspend devices based on custom policies.
	 *
	 * Create an ordered list of devices that will be suspended.
	 * Ordering should be done based on dependencies. Devices
	 * in the beginning of the list will be resumed first.
	 */
	device_list_get(&device_list, &count);
	device_count = 4; /* Reserve for 32KHz, 16MHz, system clock, and uart */

	for (i = 0; (i < count) && (device_count < DEVICE_POLICY_MAX); i++) {
		if (!strcmp(device_list[i].config->name, "clk_k32src")) {
			device_ordered_list[0] = i;
		} else if (!strcmp(device_list[i].config->name, "clk_m16src")) {
			device_ordered_list[1] = i;
		} else if (!strcmp(device_list[i].config->name, "sys_clock")) {
			device_ordered_list[2] = i;
		} else if (!strcmp(device_list[i].config->name, "UART_0")) {
			device_ordered_list[3] = i;
		} else {
			device_ordered_list[device_count++] = i;
		}
	}
}
```

## src/power.c
```c
/*
 * Copyright (c) 2018-2019 Nordic Semiconductor ASA.
 *
 * SPDX-License-Identifier: Apache-2.0
 */

#include "sample.h"

/*
 * Application defined function for doing any target specific operations
 * for low power entry.
 */
void sys_pm_notify_power_state_entry(enum power_states state)
{
	switch (state) {
	case SYS_POWER_STATE_SLEEP_1:
		printk("%s --> Entering to SYS_POWER_STATE_SLEEP_1 state.\n",
		       uptime_str());

		/* Turn off LED1 to indicate decreased power, then idle */
		gpio_pin_write(gpio_port, LED_1, LED_OFF);
		k_cpu_idle();

		break;

	case SYS_POWER_STATE_SLEEP_2:
		printk("%s --> Entering to SYS_POWER_STATE_SLEEP_2 state.\n",
		       uptime_str());

		/* Turn off LED2 to indicate decreased power, then idle */
		gpio_pin_write(gpio_port, LED_2, LED_OFF);
		k_cpu_idle();

		break;

	case SYS_POWER_STATE_DEEP_SLEEP_1:
		printk("%s --> Entering to SYS_POWER_STATE_DEEP_SLEEP_1 state.\n",
		       uptime_str());

		/*
		 * This power mode is already implemented by the OS. It will be
		 * handled by SoC-specific code. Here we just turn off the LEDs
		 * to save power.
		 */
		gpio_pin_write(gpio_port, LED_1, LED_OFF);
		gpio_pin_write(gpio_port, LED_2, LED_OFF);

		/* Nothing else to do */
		break;

	default:
		printk("Unsupported power state %u", state);
		break;
	}
}

/*
 * Application defined function for doing any target specific operations
 * for low power exit.
 */
void sys_pm_notify_power_state_exit(enum power_states state)
{
	switch (state) {
	case SYS_POWER_STATE_SLEEP_1:
		printk("%s --> Exited from SYS_POWER_STATE_SLEEP_1 state.\n",
		       uptime_str());

		/* Turn LED1 back on */
		gpio_pin_write(gpio_port, LED_1, LED_ON);
		break;

	case SYS_POWER_STATE_SLEEP_2:
		printk("%s --> Exited from SYS_POWER_STATE_SLEEP_2 state.\n",
		       uptime_str());

		/* Turn LED2 back on */
		gpio_pin_write(gpio_port, LED_2, LED_ON);
		break;

	case SYS_POWER_STATE_DEEP_SLEEP_1:
		/* Deep sleep on Nordic is system off: you can't get here. */

		printk("%s --> Exited from SYS_POWER_STATE_DEEP_SLEEP_1 state.\n",
		       uptime_str());

		/* Turn on LEDs which were powered down before deep sleep. */
		gpio_pin_write(gpio_port, LED_1, LED_ON);
		gpio_pin_write(gpio_port, LED_2, LED_ON);
		break;

	default:
		printk("Unsupported power state %u", state);
		break;
	}
}
```

## src/sample.h
```c
/*
 * Copyright (c) 2018 Intel Corporation.
 *
 * SPDX-License-Identifier: Apache-2.0
 */

#include <zephyr.h>
#include <power/power.h>
#include <string.h>
#include <soc.h>
#include <device.h>
#include <drivers/gpio.h>
#include <sys/printk.h>

#define GPIO_CFG_SENSE_LOW (GPIO_PIN_CNF_SENSE_Low << GPIO_PIN_CNF_SENSE_Pos)

/* change this to use another GPIO port */
#define PORT		DT_ALIAS_SW0_GPIOS_CONTROLLER
#define BUTTON_1	DT_ALIAS_SW0_GPIOS_PIN
#define LED_1		DT_ALIAS_LED0_GPIOS_PIN
#define LED_2		DT_ALIAS_LED1_GPIOS_PIN

#define LOW		0
#define HIGH		1
#define LED_ON		LOW
#define LED_OFF		HIGH

extern struct device *gpio_port;

const char *uptime_str(void);
```

## src/test.h
```c
/*
 * Copyright (c) 2018 Intel Corporation.
 *
 * SPDX-License-Identifier: Apache-2.0
 */

#include <zephyr.h>
#include <power.h>
#include <soc_power.h>
#include <misc/printk.h>
#include <string.h>
#include <soc.h>
#include <device.h>
#include <gpio.h>

#define SECONDS_TO_SLEEP	1

#define GPIO_CFG_SENSE_LOW (GPIO_PIN_CNF_SENSE_Low << GPIO_PIN_CNF_SENSE_Pos)

/* change this to use another GPIO port */
#define PORT		SW0_GPIO_CONTROLLER
#define BUTTON_1	SW0_GPIO_PIN
#define BUTTON_2	SW1_GPIO_PIN
#define LOW		0
```
