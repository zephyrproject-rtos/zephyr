## samples/boards/nrf52/power_mgr/Kconfig
```kconfig
# SPDX-License-Identifier: Apache-2.0

config NRF5_POWER_MGMT_EXAMPLE
	bool
	default y
	select HAS_SYS_POWER_STATE_SLEEP_2
	select HAS_SYS_POWER_STATE_SLEEP_3
	help
	  Hidden option enabling LPS_1 and LPS_2 low power states.
	  This is needed, as these states are implemented by this example.

# Include Zephyr's Kconfig.
source "$ZEPHYR_BASE/Kconfig"
```

## samples/boards/nrf52/power_mgr/sample.yaml
```yaml
sample:
  name: Low Power State Sample for nRF5x
tests:
  pm.low_power_state:
    platform_whitelist: nrf52840_pca10056 nrf52_pca10040 nrf51_pca10028
    tags: power
    harness: console
    harness_config:
      type: multi_line
      regex:
        - "--> Entering to SYS_POWER_STATE_LOW_POWER_2 state."
        - "--> Exited from SYS_POWER_STATE_LOW_POWER_2 state."
        - "--> Entering to SYS_POWER_STATE_LOW_POWER_3 state."
        - "--> Exited from SYS_POWER_STATE_LOW_POWER_3 state."
```

## samples/boards/nrf52/temp/sample.yaml
```yaml
sample:
  name: nRF5 temperature
tests:
  sample.boards.nrf52.temp:
    platform_whitelist: nrf52840_pca10056 nrf52_pca10040 nrf51_pca10028
    harness: console
    tags: sensors
    harness_config:
        type: one_line
        regex:
            - "Temperature:(.*) C"
```

## samples/boards/nuvoton/numaker/system_off/Kconfig
```kconfig
# Copyright 2024, Nuvoton
#
# SPDX-License-Identifier: Apache-2.0

mainmenu "numaker SYSTEM_OFF demo"

source "Kconfig.zephyr"
```

## samples/boards/nxp/adsp/number_crunching/sample.yaml
```yaml
sample:
  description: An application that demonstrates
    how to integrate a proprietary library which
    executes math functions on target.
  name: Proprietary Library
tests:
  sample.app_dev.number_crunching:
    platform_allow:
      - native_sim
      - imx8mp_evk/mimx8ml8/adsp
    integration_platforms:
      - native_sim
      - imx8mp_evk/mimx8ml8/adsp
    tags: external
    harness: console
    harness_config:
      type: multi_line
      regex:
        - "Number crunching example!"
        - "[Library Test]"
```

## samples/boards/nxp/adsp/rtxxx/amp_audio_loopback/sample.yaml
```yaml
sample:
  name: i.MX RTxxx AMP audio loopback sample
  description:
    Audio loopback application using the i.MX RTxxx devices as AMP systems.
common:
  sysbuild: true
  min_ram: 1024
  min_flash: 1024
  platform_allow:
    - mimxrt685_evk/mimxrt685s/cm33
    - mimxrt700_evk/mimxrt798s/cm33_cpu0
  harness: console
  harness_config:
    type: one_line
    regex:
      - "Hello World! (.*)"
tests:
  sample.nxp.adsp.amp_audio_loopback:
    tags: tests
```

## samples/boards/nxp/adsp/rtxxx/amp_talk/Kconfig.sysbuild
```kconfig
# Copyright 2025 NXP
#
# SPDX-License-Identifier: Apache-2.0

source "share/sysbuild/Kconfig"

config OPENAMP_REMOTE_BOARD
string
	default "mimxrt700_evk/mimxrt798s/cm33_cpu1" if $(BOARD) = "mimxrt700_evk"
```

## samples/boards/nxp/adsp/rtxxx/amp_talk/remote_cm33/sample.yaml
```yaml
sample:
  description: This app provides an example of how to integrate OpenAMP DSP.
  name: OpenAMP example integration (DSP)
tests:
  samples.boards.nxp.adsp.rtxxx.amp_talk.remote_cm33:
    filter: dt_chosen_enabled("zephyr,ipc") and dt_chosen_enabled("zephyr,ipc_shm")
    integration_platforms:
      - mimxrt700_evk/mimxrt798s/cm33_cpu1
    tags: ipm
    harness: remote
```

## samples/boards/nxp/adsp/rtxxx/amp_talk/remote_hifi4/sample.yaml
```yaml
sample:
  description: This app provides an example of how to integrate OpenAMP with DSP.
  name: OpenAMP example integration (remote_hifi4)
tests:
  samples.boards.nxp.adsp.rtxxx.amp_talk.remote:
    filter: dt_chosen_enabled("zephyr,ipc") and dt_chosen_enabled("zephyr,ipc_shm")
    integration_platforms:
      - mimxrt700_evk/mimxrt798s/cm33_cpu0
    tags: ipm
    harness: remote
```

## samples/boards/nxp/adsp/rtxxx/amp_talk/sample.yaml
```yaml
sample:
  description: This app provides an example of how to integrate OpenAMP with DSP.
  name: OpenAMP DSP example integration
tests:
  samples.boards.nxp.adsp.rtxxx.amp_talk:
    filter: dt_chosen_enabled("zephyr,ipc") and dt_chosen_enabled("zephyr,ipc_shm")
    platform_allow:
      - mimxrt700_evk/mimxrt798s/cm33_cpu0
    tags:
      - ipm
      - openamp
    harness: console
    sysbuild: true
    harness_config:
      type: multi_line
      regex:
        - "Main core received a message: 1"
        - "Main core received a message: 99"
        - "OpenAMP demo ended."
        - "[DSP] Remote core received a message: 0"
        - "[DSP] Remote core received a message: 98"
        - "[DSP] OpenAMP demo ended."
```

## samples/boards/nxp/mcx/poweroff/sample.yaml
```yaml
# Copyright 2025 NXP
# SPDX-License-Identifier: Apache-2.0

sample:
  name: Poweroff demo for NXP MCXA/N series
common:
  tags: power
tests:
  sample.boards.nxp.mcx.poweroff:
    platform_allow:
    - frdm_mcxa156
    - frdm_mcxa153
    - frdm_mcxa166
    - frdm_mcxa276
    - frdm_mcxn236/mcxn236
    - frdm_mcxn947/mcxn947/cpu0
```

## samples/boards/nxp/mcxn_a/s2ram/Kconfig
```kconfig
# SPDX-FileCopyrightText: Copyright 2026 NXP
# SPDX-License-Identifier: Apache-2.0

mainmenu "NXP MCX suspend-to-RAM sample"

choice
	prompt "Suspend-to-RAM wakeup source"
	default SAMPLE_S2RAM_WAKEUP_TIMER
	help
	  Select how the SoC is woken from suspend-to-RAM (Deep Power Down).

config SAMPLE_S2RAM_WAKEUP_TIMER
	bool "Timed wakeup"
	help
	  Wake after a fixed delay using a low-power timer.

config SAMPLE_S2RAM_WAKEUP_BUTTON
	bool "Button wakeup"
	help
	  Wake on a user button press.

endchoice

config SAMPLE_APP_TEST_CYCLES
	int "Number of suspend-to-RAM cycles to execute"
	range 1 1000
	default 10
	help
	  Number of times the sample suspends to RAM and resumes before it
	  stops. The retained cycle counter is checked against this value so
	  a test harness can confirm every wakeup happened.

source "Kconfig.zephyr"
```

## samples/boards/nxp/mcxn_a/system_off/Kconfig
```kconfig
# SPDX-FileCopyrightText: Copyright 2026 NXP
# SPDX-License-Identifier: Apache-2.0

mainmenu "NXP MCX system off sample"

choice
	prompt "Deep Power Down wakeup source"
	default SAMPLE_SYSTEM_OFF_WAKEUP_TIMER
	help
	  Select how the SoC is woken from Deep Power Down (system off).

config SAMPLE_SYSTEM_OFF_WAKEUP_TIMER
	bool "Timed wakeup"
	help
	  Wake after a fixed delay using a low-power timer.

config SAMPLE_SYSTEM_OFF_WAKEUP_BUTTON
	bool "Button wakeup"
	help
	  Wake on a user button press.

endchoice

config SAMPLE_APP_TEST_CYCLES
	int "Number of system-off cycles to execute"
	range 1 1000
	default 10
	help
	  Number of times the sample arms the wakeup source and enters system
	  off before it stops. The completed cycle count is kept in retained
	  SRAM across each Deep Power Down wake reset so a test harness can
	  confirm every wakeup happened.

source "Kconfig.zephyr"
```

## samples/boards/nxp/mimxrt1060_evk/system_off/Kconfig
```kconfig
# Copyright (c) 2022, Whisper.ai
# SPDX-License-Identifier: Apache-2.0

mainmenu "MIMXRT1060_EVK SYSTEM_OFF demo"

source "Kconfig.zephyr"
```

## samples/boards/nxp/mimxrt1060_evk/system_off/sample.yaml
```yaml
sample:
  name: Low Power State Sample for mimxrt1060_evk
common:
  tags: power
tests:
  sample.boards.mimxrt1060_evk.system_off:
    build_only: true
    platform_allow:
      - mimxrt1060_evk@A/mimxrt1062/qspi
      - mimxrt1060_evk@B/mimxrt1062/qspi
      - mimxrt1060_evk@C/mimxrt1062/qspi
    integration_platforms:
      - mimxrt1060_evk/mimxrt1062/qspi
```

## samples/boards/nxp/mimxrt1170_evk_cm7/magic_addr/sample.yaml
```yaml
sample:
  description: RT11xx FLEXRAM Magic Addr example
  name: magic addr
common:
  integration_platforms:
    - mimxrt1170_evk/mimxrt1176/cm7
    - mimxrt1160_evk/mimxrt1166/cm7
  tags:
    - pytest
tests:
  sample.boards.magic_addr:
    filter: CONFIG_NXP_FLEXRAM and
            dt_nodelabel_prop_enabled("flexram", "flexram,has-magic-addr")
    extra_args:
      - platform:mimxrt1170_evk/mimxrt1176/cm7:"DTC_OVERLAY_FILE=flexram.overlay"
      - platform:mimxrt1160_evk/mimxrt1166/cm7:"DTC_OVERLAY_FILE=flexram.overlay"
    harness: pytest
```

## samples/boards/nxp/mimxrt595_evk/system_off/Kconfig
```kconfig
# Copyright 2022, NXP
#
# SPDX-License-Identifier: Apache-2.0

mainmenu "MIMXRT595_EVK_CM33 SYSTEM_OFF demo"

source "Kconfig.zephyr"
```

## samples/boards/nxp/mimxrt595_evk/system_off/sample.yaml
```yaml
#
# Copyright 2022, NXP
#
# SPDX-License-Identifier: Apache-2.0
#
sample:
  name: Deep Power Down State Sample for mimxrt595_evk
common:
  tags: power
tests:
  sample.boards.mimxrt595_evk.system_off:
    build_only: true
    platform_allow: mimxrt595_evk/mimxrt595s/cm33
```

## samples/boards/nxp/mimxrt700_evk/dual_core_pm/remote/Kconfig
```kconfig
# SPDX-FileCopyrightText: Copyright 2026 NXP
# SPDX-License-Identifier: Apache-2.0

source "Kconfig.zephyr"

config SAMPLE_RT700_DUAL_CORE_PM_SLEEP_SECONDS
	int "Power-mode measurement window in seconds"
	default 5
	range 1 3600
	help
	  Number of seconds each active, sleep, or deep-sleep test case runs.
```

## samples/boards/nxp/mimxrt700_evk/dual_core_pm/sample.yaml
```yaml
#
# SPDX-FileCopyrightText: Copyright 2026 NXP
#
# SPDX-License-Identifier: Apache-2.0
#
sample:
  name: RT700 EVK dual-core power management
common:
  sysbuild: true
  tags:
    - boards
    - nxp
    - pm
  build_only: true

tests:
  sample.boards.nxp.rt700_dual_core_pm:
    platform_allow:
      - mimxrt700_evk/mimxrt798s/cm33_cpu0
    integration_platforms:
      - mimxrt700_evk/mimxrt798s/cm33_cpu0
```

## samples/boards/nxp/mimxrt700_evk/system_off/sample.yaml
```yaml
# SPDX-FileCopyrightText: Copyright 2026 NXP
# SPDX-License-Identifier: Apache-2.0

sample:
  name: System Off / Deep Power Down Sample for mimxrt700_evk
common:
  tags: power
  harness: console
  harness_config:
    type: one_line
    regex:
      - "Powering off"

tests:
  sample.boards.mimxrt700_evk.system_off:
    platform_allow:
      - mimxrt700_evk/mimxrt798s/cm33_cpu0
    integration_platforms:
      - mimxrt700_evk/mimxrt798s/cm33_cpu0
```

## samples/boards/nxp/poweroff/Kconfig
```kconfig
# Copyright 2025 NXP
# SPDX-License-Identifier: Apache-2.0

mainmenu "NXP MCU POWER OFF DEMO"

choice NXP_MCU_POWEROFF_WAKEUP_SOURCE
	prompt "Select the wakeup source for poweroff"

	config POWEROFF_COUNTER_WAKEUP
		bool "Counter wakeup"
		select COUNTER
		depends on BOARD_FRDM_MCXA153 || BOARD_FRDM_MCXA156 ||	\
				BOARD_FRDM_MCXA346 || BOARD_FRDM_MCXA266 ||	\
				BOARD_FRDM_MCXN947 || BOARD_MIMXRT595_EVK
		help
		  Use counter to wake up device from poweroff.
		  Selected by default for compatible boards.

	config POWEROFF_BUTTON_WAKEUP
		bool "Button wakeup"
		select GPIO
		depends on BOARD_FRDM_MCXN236
		help
		  Use on-board wakeup button to wake up device
		  from poweroff.
		  Selected by default for compatible boards.

endchoice

source "Kconfig.zephyr"
```

## samples/boards/nxp/poweroff/sample.yaml
```yaml
# Copyright 2025 NXP
# SPDX-License-Identifier: Apache-2.0

sample:
  name: Poweroff example for NXP MCUs
common:
  tags: power
tests:
  sample.boards.nxp.mcu.poweroff:
    platform_allow:
      - frdm_mcxa156
      - frdm_mcxa153
      - frdm_mcxa346
      - frdm_mcxa266
      - frdm_mcxn236/mcxn236
      - frdm_mcxn947/mcxn947/cpu0
      - mimxrt595_evk/mimxrt595s/cm33
  sample.boards.nxp.mcu.poweroff.counter_wakeup:
    platform_allow:
      - frdm_mcxa156
      - frdm_mcxa153
      - frdm_mcxa346
      - frdm_mcxa266
      - frdm_mcxn947/mcxn947/cpu0
      - mimxrt595_evk/mimxrt595s/cm33
    harness: console
    harness_config:
      type: multi_line
      ordered: true
      regex:
        - "Press 'enter' key to power off the system"
        - "Will wakeup after 5 seconds"
        - "Powering off"
  sample.boards.nxp.mcu.poweroff.button_wakeup:
    platform_allow:
      - frdm_mcxn236/mcxn236
    harness: console
    harness_config:
      type: multi_line
      ordered: true
      regex:
        - "Press 'enter' key to power off the system"
        - "Will wakeup after press wakeup button"
        - "Powering off"
```

## samples/boards/nxp/s32/mbox/sample.yaml
```yaml
sample:
  name: NXP S32 MBOX sample
tests:
  sample.boards.nxp_s32.mbox:
    tags: mbox
    filter: dt_compat_enabled("vnd,mbox-consumer")
    platform_allow:
      - s32z2xxdc2/s32z270/rtu0
      - s32z2xxdc2/s32z270/rtu1
      - s32z2xxdc2@D/s32z270/rtu0
      - s32z2xxdc2@D/s32z270/rtu1
    harness: console
    harness_config:
      type: multi_line
      ordered: false
      regex:
        - "send .+ value: 0"
        - "received .+ value: 0"
        - "send .+ value: 1"
        - "received .+ value: 1"
        - "send .+ value: 41"
        - "received .+ value: 41"
        - "send .+ value: 42"
        - "received .+ value: 42"
        - "send .+ value: 98"
        - "received .+ value: 98"
        - "send .+ value: 99"
        - "received .+ value: 99"
```
