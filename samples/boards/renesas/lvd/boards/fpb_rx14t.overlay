/*
 * Copyright (c) 2026 Renesas Electronics Corporation
 * SPDX-License-Identifier: Apache-2.0
 */

&lvd1 {
	lvd-action = "maskable-interrupt";
	voltage-level = <384>;
	vdet-target = "vcc";
	lvd-trigger = "both";
	lvd-stabilization = <0>;
	status = "okay";
};
