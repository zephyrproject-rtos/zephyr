## samples/boards/renesas/openamp_linux_zephyr/sample.yaml
```yaml
sample:
  description: Enable message exchange between two cores, with the application core running Linux
   and the real-time core running Zephyr, using the OpenAMP library.
  name: OpenAMP Linux Zephyr RPMsg
tests:
  sample.boards.renesas.openamp_linux_zephyr:
    build_only: true
    platform_allow:
      - rzg3s_smarc/r9a08g045s33gbg/cm33
    integration_platforms:
      - rzg3s_smarc/r9a08g045s33gbg/cm33
    tags:
      - mbox
      - openamp
```

## samples/boards/renesas/rcar_gen5/i2c_displayport_redriver/dts/bindings/ti,displayport-redriver.yaml
```yaml
description: TI Four-Channel 20Gbps DisplayPort 2.1 Linear Redriver

compatible: "ti,displayport-redriver"

include: i2c-device.yaml
```

## samples/boards/sensortile_box/sample.yaml
```yaml
sample:
  description: SensorTile.box board testing
  name: SensorTile.box test
tests:
  sample.board.sensortile_box.sensors:
    harness: sensor
    platform_allow: sensortile_box/stm32l4r9xx
    tags: sensors
    depends_on:
      - i2c
      - spi
      - gpio
```

## samples/boards/sensortile_box_pro/ble-fw-upgrade/Kconfig
```kconfig
# Copyright (c) 2024 STMicroelectronics
# SPDX-License-Identifier: Apache-2.0

mainmenu "Sensortile.box PRO ble f/w upgrade"

config BLOB_ENABLED
	bool "Use ble f/w image blob"
	default y

source "Kconfig.zephyr"
```

## samples/boards/sensortile_box_pro/ble-fw-upgrade/sample.yaml
```yaml
sample:
  description: SensorTile.box Pro board ble firmware upgrade
  name: SensorTile.box Pro fw upgrade
tests:
  sample.board.sensortile_box_pro.ble-fw-upgrade:
    harness: bluetooth
    platform_allow: sensortile_box_pro
    tags: bluetooth
    depends_on:
      - gpio
      - uart
    extra_configs:
      - CONFIG_BLOB_ENABLED=n
```

## samples/boards/sensortile_box_pro/sensors-on-board/sample.yaml
```yaml
sample:
  description: SensorTile.box Pro board testing
  name: SensorTile.box Pro test
tests:
  sample.board.sensortile_box_pro.sensors-on-board:
    harness: sensor
    platform_allow: sensortile_box_pro/stm32u585xx
    tags: sensors
    depends_on:
      - i2c
      - spi
      - gpio
```

## samples/boards/siwx91x/siwx91x_sample_app/sample.yaml
```yaml
sample:
  name: siwx91x sample app
  description: Demonstrates ICMP functionality
tests:
  sample.boards.siwx91x.siwx91x_sample_app:
    harness: Wi-Fi
    platform_allow:
      - siwx917_rb4338a
    tags: Wi-Fi
    integration_platforms:
      - siwx917_rb4338a
```

## samples/boards/st/ble_802154/ble_hr_802154_echo_client/sample.yaml
```yaml
sample:
  description: Test concurrent mode Ble HeartRate - IEEE802.15.4 echo client
  name: Ble Heart Rate - Socket Echo Client
tests:
  sample.boards.stm32.ble_802154.ble_hr_802154_echo_client:
    harness:
      - bluetooth
      - net
    extra_args: EXTRA_CONF_FILE="overlay-802154.conf"
    platform_allow: nucleo_wba65ri
    tags:
      - bluetooth
      - net
      - socket
```

## samples/boards/st/bluetooth/st_ble_sensor/boards/stm32wb5mm_dk_stm32wb55xx.conf
```kconfig
# Stack sizes for Bluetooth operations on stm32wb5mm_dk
CONFIG_MAIN_STACK_SIZE=4096
CONFIG_SYSTEM_WORKQUEUE_STACK_SIZE=2048

CONFIG_LED_STRIP=y
```

## samples/boards/st/crc/Kconfig
```kconfig
# Copyright (c) 2024 STMicroelectronics.
#
# SPDX-License-Identifier: Apache-2.0

config CRC_STM32_EXTRA
	bool "Extended operation for crc driver control"
	default y
	select USE_STM32_HAL_CRC
	select USE_STM32_HAL_CRC_EX

source "Kconfig.zephyr"
```

## samples/boards/st/crc/sample.yaml
```yaml
sample:
  name: CRC usage example on STM32 platforms
tests:
  sample.board.stm32.crc:
    filter: CONFIG_SOC_FAMILY_STM32
    tags: board
    harness: console
    harness_config:
      type: multi_line
      ordered: false
      regex:
        - "CRC = 0x379e9f06"
```

## samples/boards/st/crc_poly/sample.yaml
```yaml
sample:
  name: CRC usage example on STM32 platforms
tests:
  sample.board.stm32.crc:
    filter: CONFIG_SOC_FAMILY_STM32
    tags: board
    harness: console
    harness_config:
      type: multi_line
      ordered: false
      regex:
        - "CRC = 0xc"
    integration_platforms:
      - b_u585i_iot02a
```

## samples/boards/st/h7_dual_core/sample.yaml
```yaml
sample:
  description: Usage of stm32 hsem ipm driver
  name: stm32_h7_dual_core
tests:
  sample.boards.stm32.h7_dual_core:
    build_only: true
    vendor_allow:
      - st
    filter: dt_compat_enabled("st,stm32-hsem-mailbox")
    integration_platforms:
      - stm32h747i_disco/stm32h747xx/m4
```

## samples/boards/st/hello_world_xip/sample.yaml
```yaml
sample:
  description: Hello World sample from external flash
    application
  name: hello world xip
tests:
  sample.boards.st.hello_world_xip:
    tags: introduction
    sysbuild: true
    extra_args:
      - SB_CONFIG_BOOTLOADER_MCUBOOT=y
    integration_platforms:
      - stm32h573i_dk
    platform_allow:
      - stm32h573i_dk
```

## samples/boards/st/interconnect_matrix/sample.yaml
```yaml
sample:
  name: STM32 interconnect matrix
tests:
  sample.boards.stm32.interconnect_matrix:
    depends_on: pwm
    tags:
      - drivers
      - pwm
    filter: dt_compat_enabled("st,stm32-timers")
    platform_allow:
      - nucleo_g070rb
    harness: console
    harness_config:
      type: one_line
      regex:
        - "TRGO event will be generated every.*"
```

## samples/boards/st/mco/sample.yaml
```yaml
sample:
  name: STM32 microcontroller clock output (MCO) example
tests:
  sample.board.stm32.mco:
    build_only: true
    platform_allow:
      - nucleo_f411re
      - nucleo_f446ze
      - stm32f746g_disco
      - nucleo_u5a5zj_q
      - nucleo_wba55cg
      - nucleo_wl55jc
    integration_platforms:
      - stm32f746g_disco
    tags: board
```

## samples/boards/st/power_mgmt/adc/sample.yaml
```yaml
sample:
  name: STM32 ADC Power Management
tests:
  sample.boards.stm32.power_mgmt.adc:
    tags:
      - adc
      - power
    harness: console
    harness_config:
      type: one_line
      regex:
        - "Device ready"
    filter: dt_compat_enabled("zephyr,power-state") and
            dt_compat_enabled("st,stm32-adc") and
            dt_compat_enabled("st,stm32-lptim")
    extra_args: "CONFIG_DEBUG=y"
    platform_allow: nucleo_wb55rg
```

## samples/boards/st/power_mgmt/blinky/boards/nucleo_f429zi.conf
```kconfig
# SPDX-FileCopyrightText: Copyright The Zephyr Project Contributors
# SPDX-License-Identifier: Apache-2.0

# Increase IDLE stack for the IDLE timer
CONFIG_IDLE_STACK_SIZE=640
```

## samples/boards/st/power_mgmt/blinky/boards/stm32l562e_dk.conf
```kconfig
# Disable DEBUG in order to enter core low power states.
# WARNING: requires to erase the device (using STM32CubeProgrammer for instance)
# for next flashing actions
CONFIG_DEBUG=y
```

## samples/boards/st/power_mgmt/standby/sample.yaml
```yaml
sample:
  name: STM32 GPIO Standby Power Management
tests:
  sample.boards.stm32.power_mgmt.standby:
    platform_allow:
      - nucleo_l476rg
      - disco_l475_iot1
    tags:
      - power
    harness: console
    harness_config:
      type: multi_line
      regex:
        - "Reset cause: Reset pin"
        - "Device ready: .*"
        - "Press and hold the user button to enter Standby Mode"
    filter: dt_compat_enabled("zephyr,power-state")
    extra_args: "CONFIG_DEBUG=y"
```

## samples/boards/st/power_mgmt/stop3/sample.yaml
```yaml
sample:
  name: STM32 STOP3 Power Management
tests:
  sample.boards.stm32.power_mgmt.stop3:
    tags:
      - LED
      - power
    harness: console
    platform_allow: nucleo_u575zi_q
    harness_config:
      type: one_line
      regex:
        - "Device ready"
    extra_args: "CONFIG_DEBUG=y"
```

## samples/boards/st/power_mgmt/suspend_to_ram/dts/bindings/test-spi-loopback.yaml
```yaml
#
# Copyright (c) 2024 STMicroelectronics
#
# SPDX-License-Identifier: Apache-2.0
#

description: |
    This binding provides resources required to build and run an SPI
    loopback test under power management conditions

compatible: "test-spi-loopback"

include: [spi-device.yaml]
```

## samples/boards/st/power_mgmt/wkup_pins/sample.yaml
```yaml
sample:
  name: GPIO As A Wake-up Pin Source
tests:
  sample.boards.stm32.power_mgmt.wkup_pins:
    build_only: true
    filter: dt_enabled_alias_with_parent_compat("wkup-src",
      "gpio-keys") and dt_compat_enabled("st,stm32-pwr")
    platform_allow:
      - nucleo_c092rc
      - nucleo_f103rb
      - nucleo_g031k8
      - nucleo_l152re
      - nucleo_l4r5zi
      - nucleo_u575zi_q
      - nucleo_u5a5zj_q
      - nucleo_wba55cg
      - nucleo_wba65ri
      - nucleo_wl55jc
      - stm32l1_disco
    integration_platforms:
      - nucleo_l4r5zi
```

## samples/boards/st/pwm/breathing_led_dma/Kconfig
```kconfig
#
# SPDX-FileCopyrightText: Copyright The Zephyr Project Contributors
# SPDX-License-Identifier: Apache-2.0
#

mainmenu "Breathing Led sample application"

config PRIMARY_BREATH_CHANNEL
	int "Timer channel for the primary led on this board"
	default 0

config SECONDARY_BREATH_CHANNEL
	int "Timer channel for the secondary breath output on this board"
	default 0

source "Kconfig.zephyr"
```
