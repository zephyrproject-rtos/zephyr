## CMakeLists.txt
```
# SPDX-License-Identifier: Apache-2.0

cmake_minimum_required(VERSION 3.13.1)

include($ENV{ZEPHYR_BASE}/cmake/app/boilerplate.cmake NO_POLICY_SCOPE)
project(hci_open_amp)

target_sources(app PRIVATE src/main.c)
```

## prj.conf
```kconfig
CONFIG_LOG=y
CONFIG_LOG_RUNTIME_FILTERING=y
CONFIG_LOG_BACKEND_OPEN_AMP=y

#CONFIG_UART_0_NRF_FLOW_CONTROL=y

CONFIG_HEAP_MEM_POOL_SIZE=8192
```

## src/main.c
```c
/*
 * Copyright (c) 2019 Nordic Semiconductor
 *
 * SPDX-License-Identifier: Apache-2.0
 */

#include <zephyr.h>
#include <logging/log.h>

LOG_MODULE_REGISTER(app);

void expire_handler(struct k_timer *timer)
{
	static int cnt = 0;

	LOG_INF("Timer expired %d", cnt++);
}

K_TIMER_DEFINE(app_timer, expire_handler, NULL);

void main(void)
{
	k_timer_start(&app_timer, K_MSEC(500), K_MSEC(500));
}
```
