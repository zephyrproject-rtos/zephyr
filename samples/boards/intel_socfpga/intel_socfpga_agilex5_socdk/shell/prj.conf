## sample.yaml
```
sample:
  description: Shell sample, this is to provide command line interface for Intel SoC FPGA Agilex5 boards.
  name: shell
common:
    tags: introduction
    integration_platforms:
      - intel_socfpga_agilex5_socdk
    harness: console
    harness_config:
      type: one_line
      regex:
        - "shell"
```

## prj.conf
```kconfig
# Copyright (c) 2021, Intel Corporation. All rights reserved.
# SPDX-License-Identifier: Apache-2.0

# Misc
CONFIG_HEAP_MEM_POOL_SIZE=16384

# Enable QSPI Flash
CONFIG_FLASH=y

# Enable Shell
CONFIG_SHELL=y
CONFIG_SHELL_MINIMAL=y
CONFIG_SHELL_CMD_BUFF_SIZE=4096
CONFIG_SHELL_BACKEND_SERIAL=y
CONFIG_SHELL_PROMPT_UART="agilex5$ "
CONFIG_SHELL_HELP=y
CONFIG_SHELL_HISTORY=y
CONFIG_SHELL_HISTORY_BUFFER=1024
CONFIG_SHELL_ARGC_MAX=12

# Enable Device Shell to Access Basic Device Data
CONFIG_DEVICE_SHELL=y

# Enable File System Shell
CONFIG_FILE_SYSTEM_SHELL=y

# Enable timer driver
CONFIG_COUNTER=y
CONFIG_COUNTER_SNPS_DW=y

# Enable Timer shell commands
CONFIG_COUNTER_SHELL=y

# Enable I2C Console
CONFIG_I2C=y
CONFIG_I2C_DW=y
CONFIG_I2C_SHELL=y

# GPIO Controller
CONFIG_GPIO=y
CONFIG_GPIO_INTEL_SOCFPGA=y
CONFIG_GPIO_SHELL=y

# File System Setting
CONFIG_FILE_SYSTEM=y
CONFIG_FAT_FILESYSTEM_ELM=y

# Enable SDMMC
CONFIG_DISK_DRIVER_SDMMC=y

# Enable SDHC
CONFIG_SDHC=y

# DMA driver
CONFIG_DMA=y
CONFIG_DMA_DW_AXI_MAX_DESC=50
```

## src/main.c
```c
/*
 * Copyright (c) 2022, Intel Corporation. All rights reserved.
 *
 * SPDX-License-Identifier: Apache-2.0
 */

#include <zephyr/kernel.h>
#include <zephyr/sys/printk.h>

void main(void)
{
	printk("%s: Starting Shell...\n", CONFIG_BOARD);
}
```
