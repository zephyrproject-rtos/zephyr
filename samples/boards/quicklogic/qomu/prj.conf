## CMakeLists.txt
```
# SPDX-License-Identifier: Apache-2.0

cmake_minimum_required(VERSION 3.28.0)
find_package(Zephyr REQUIRED HINTS $ENV{ZEPHYR_BASE})
project(qomu)

target_sources(app PRIVATE src/main.c src/usb2serial_bit.c)
```

## prj.conf
```kconfig
CONFIG_SYS_CLOCK_HW_CYCLES_PER_SEC=47972352
CONFIG_PRINTK=y
CONFIG_FPGA=y
CONFIG_EOS_S3_FPGA=y
CONFIG_BOOT_BANNER=n
```

## qomu.overlay
```dts
&cpu0 {
	clock-frequency = <47972352>;
};

&gpio {
	pin-secondary-config = <0x1d>;
	status = "okay";
};
```

## src/main.c
```c
/*
 * Copyright (c) 2022 Antmicro <www.antmicro.com>
 *
 * SPDX-License-Identifier: Apache-2.0
 */

#include <zephyr/zephyr.h>
#include <zephyr/device.h>
#include <zephyr/sys/printk.h>
#include <zephyr/drivers/fpga.h>
#include <stdio.h>
#include <eoss3_dev.h>

extern uint32_t axFPGABitStream[];
extern uint32_t axFPGABitStream_length;

int main(void)
{
	const struct device *fpga = device_get_binding("fpga");

	/* load usbserial bitstream */
	fpga_load(fpga, axFPGABitStream, axFPGABitStream_length);

	/* let it enumerate */
	k_msleep(2000);

	printk("####################\n");
	printk("I am Zephyr on Qomu!\n");
	printk("####################\n");
	return 0;
}
```
