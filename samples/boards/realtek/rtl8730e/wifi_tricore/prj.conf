## CMakeLists.txt
```
# Copyright (c) 2026 Realtek Semiconductor Corp.
# SPDX-License-Identifier: Apache-2.0

cmake_minimum_required(VERSION 3.20.0)

find_package(Zephyr REQUIRED HINTS $ENV{ZEPHYR_BASE})
project(rtl8730e_wifi_tricore)

target_sources(app PRIVATE src/main.c)
```

## sysbuild.conf
```
# The CA32 image (WHC host) folds the KM4 (WHC NP) and KM0 (MAC firmware)
# image2 sub-images into app.bin. The vendor IMG1 stays the bootloader.
SB_CONFIG_RTL8730E_BUILD_KM4_APP=y
SB_CONFIG_RTL8730E_KM4_APP_SOURCE_DIR="."
SB_CONFIG_RTL8730E_BUILD_KM0_APP=y
SB_CONFIG_RTL8730E_KM0_APP_SOURCE_DIR="."
```

## prj.conf
```kconfig
# Role-specific options live in boards/rtl8730e_evb_{ca32,km4,km0}.conf.

# All cores share one LOGUART. Serialize output per line over an inter-core
# HW semaphore.
CONFIG_UART_AMEBA_LOGUART_XCORE_LOCK=y
```

## boards/rtl8730e_evb_ca32.conf
```kconfig
# CA32: network stack and WiFi shell in the WHC host role.
CONFIG_NETWORKING=y
CONFIG_TEST_RANDOM_GENERATOR=y

CONFIG_MAIN_STACK_SIZE=5200
CONFIG_SHELL_STACK_SIZE=5200
CONFIG_NET_TX_STACK_SIZE=2048
CONFIG_NET_RX_STACK_SIZE=2048

CONFIG_NET_PKT_RX_COUNT=10
CONFIG_NET_PKT_TX_COUNT=10
CONFIG_NET_BUF_RX_COUNT=20
CONFIG_NET_BUF_TX_COUNT=20
CONFIG_NET_MAX_CONTEXTS=10
CONFIG_NET_DHCPV4=y

CONFIG_NET_IPV4=y
CONFIG_NET_IPV6=n

CONFIG_NET_TCP=y

CONFIG_NET_LOG=y
CONFIG_INIT_STACKS=y

CONFIG_NET_SHELL=y

CONFIG_WIFI=y
CONFIG_WIFI_LOG_LEVEL_ERR=y
CONFIG_NET_L2_WIFI_SHELL=y
CONFIG_NET_MGMT_EVENT_QUEUE_TIMEOUT=5000
CONFIG_NET_MGMT_EVENT_QUEUE_SIZE=16

# The wifi shell TWT commands need libm, which the minimal libc lacks.
CONFIG_NEWLIB_LIBC=y

# The HAL os_wrapper reads CONFIG_HEAP_MEM_POOL_SIZE directly. The WHC host
# tasks, semaphores and scan buffers live in this heap.
CONFIG_HEAP_MEM_POOL_SIZE=262144
```

## boards/rtl8730e_evb_km0.conf
```kconfig
# KM0: WiFi MAC firmware (lib_wifi_fw). It registers its WL MAC interrupts at
# runtime through the HAL irq_register shim.
CONFIG_WIFI_FW_EN=y
CONFIG_DYNAMIC_INTERRUPTS=y

# Firmware task stacks and semaphores come from the kernel heap.
CONFIG_HEAP_MEM_POOL_SIZE=16384
```

## boards/rtl8730e_evb_km4.conf
```kconfig
# KM4: WHC network processor (lib_wifi_whc_np), the 802.11 driver and WHC IPC
# device.
CONFIG_AS_INIC_NP=y

# Driver tasks, semaphores and packet buffers come from the kernel heap.
CONFIG_HEAP_MEM_POOL_SIZE=131072
```

## boards/rtl8730e_evb_ca32.overlay
```dts
/*
 * Copyright (c) 2026 Realtek Semiconductor Corp.
 *
 * SPDX-License-Identifier: Apache-2.0
 *
 * Enabling the STA and SoftAP netdev nodes turns on CONFIG_WIFI_AMEBA and links
 * the WHC host blobs. The 802.11 driver runs on KM4 and the MAC firmware on KM0.
 */

&wifi0 {
	status = "okay";
};

&wifi1 {
	status = "okay";
};
```

## src/main.c
```c
/*
 * Copyright (c) 2026 Realtek Semiconductor Corp.
 *
 * SPDX-License-Identifier: Apache-2.0
 *
 * main() returns at once. The WiFi shell runs in its own threads and HAL glue
 * SYS_INITs start the KM4/KM0 WiFi roles.
 */

int main(void)
{
	return 0;
}
```
