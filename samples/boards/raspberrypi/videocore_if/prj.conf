## CMakeLists.txt
```
# SPDX-License-Identifier: Apache-2.0

cmake_minimum_required(VERSION 3.20.0)
find_package(Zephyr REQUIRED HINTS $ENV{ZEPHYR_BASE})
project(rpi_mailbox_vc_if
    VERSION 1.0.0
    DESCRIPTION "Raspberry Pi VideoCore (GPU) interface through mailbox"
    LANGUAGES C ASM
)

if(CONFIG_BOARD_RPI_4B)
    message(STATUS "Build app for: ${BOARD}${BOARD_QUALIFIERS}")
else()
    message(FATAL_ERROR "${BOARD}${BOARD_QUALIFIERS} is not supported for this sample")
endif()

target_sources(app PRIVATE
    src/main.c
)
```

## prj.conf
```kconfig
CONFIG_STDOUT_CONSOLE=y
CONFIG_LOG=y
CONFIG_LOG_PRINTK=y
CONFIG_LOG_MODE_IMMEDIATE=y
CONFIG_MBOX=y
# CONFIG_MBOX_LOG_LEVEL_DBG=y
```

## src/main.c
```c
/*
 * Copyright (c) 2025 Yoan Dumas
 *
 * SPDX-License-Identifier: Apache-2.0
 */

#include <stdio.h>
#include <string.h>
#include "videocore_if.h"
#include "board_rev.h"

int main(void)
{
	uint32_t revision;

	printf("VideoCore (GPU) firmware version is: 0x%08X\n", get_vc_firmware_version());
	revision = get_board_revision();
	printf("Board Revision: 0x%8.8x\n", revision);
	log_board_revision(revision);

	return 0;
}
```
