## CMakeLists.txt
```
# SPDX-License-Identifier: Apache-2.0

cmake_minimum_required(VERSION 3.20.0)

find_package(Zephyr REQUIRED HINTS $ENV{ZEPHYR_BASE})
project(rpi_zero_2w_usb_cdc_min)

target_sources(app PRIVATE src/main.c)
```

## prj.conf
```kconfig
# USB device stack (new / device_next)
CONFIG_USB_DEVICE_STACK_NEXT=y
CONFIG_UDC_DWC2=y

# Buffer-DMA mode. The driver defaults UDC_DWC2_DMA=y when the chip
# advertises Internal DMA in GHWCFG2.OtgArch (BCM2710 does, value=2).
# DMA mode enumerates end-to-end on this silicon with the BCM283x
# vendor quirks: the dwc2 DMA master sits behind the VideoCore bus,
# so DIEPDMA is programmed with the GPU bus address (arm_phys |
# 0xC0000000) by the .dma_addr quirk. Set =n to fall back to
# Slave/Completer mode (CPU fills the TX FIFO; also works).
CONFIG_UDC_DWC2_DMA=y

# DMA buffer cache coherency: place the UDC buffer pool in the arm64
# MMU's nocache section (MT_NORMAL_NC). DMA writes by the dwc2 AHB
# master are then immediately visible to the CPU without per-transfer
# cache invalidate / flush. Without this, SETUP packets DMA'd to a
# cached buffer read as stale (all zeros from net_buf init) and the
# host STALLs every GET_DESCRIPTOR.
CONFIG_NOCACHE_MEMORY=y
CONFIG_UDC_BUF_FORCE_NOCACHE=y

# CDC ACM class — turnkey init at SYS_INIT (no manual usbd_init/enable
# required; the class brings the stack up by itself). UART_LINE_CTRL
# exposes DTR so the sample can wait for the host to open the port.
CONFIG_SERIAL=y
CONFIG_USBD_CDC_ACM_CLASS=y
CONFIG_CDC_ACM_SERIAL_INITIALIZE_AT_BOOT=y
CONFIG_UART_LINE_CTRL=y

# VideoCore mailbox + firmware property-tag interface (upstream
# rpi_fw + mbox_brcm_bcm2711). Required by the DWC2 vendor pre_enable
# hook to power on the USB analog PHY island -- without it VC leaves
# the island off and D+/D- aren't driven even though the controller's
# MMIO is accessible. RASPBERRYPI_FIRMWARE selects MBOX; MBOX_BCM2711
# is default-y once the mbox0 node is enabled (bcm2710.dtsi). The USB
# island's SET_POWER_STATE takes ~530 ms on this silicon, so raise the
# firmware transfer timeout well above rpi_fw's 100 ms default.
CONFIG_RASPBERRYPI_FIRMWARE=y
CONFIG_RASPBERRYPI_FIRMWARE_TRANSFER_TIMEOUT_MS=1000

# No HWINFO backend exists in-tree for BCM283x, so hwinfo_get_device_id()
# returns -ENOSYS. The CDC ACM turnkey serial-number string descriptor is
# gated on CONFIG_HWINFO (subsys/usb/device_next/app/cdc_acm_serial.c), so
# with HWINFO enabled the host's GET_DESCRIPTOR(STRING,3 iSerialNumber)
# would STALL EP0. Disable HWINFO so iSerialNumber=0 and the host never
# requests the serial string -- avoids a (cosmetic) EP0 STALL during
# enumeration. Add a real HWINFO_BCM2835 backend to advertise a serial.
CONFIG_HWINFO=n

# USB stack thread stacks. Upstream defaults (USBD=1024, UDC_DWC2=512)
# are tight for AArch64; the DIN-event call chain (DWC2 ISR ->
# usbd_thread -> usbd_ch9 -> CDC ACM class -> LOG_INF) blows past
# them and the resulting overflow scribbles a function-pointer-shaped
# value onto the saved LR slot, so RET dispatches into .rodata =
# PXN fault. Same family as memory reference_zephyr_net_thread_stack_
# sizes (brcmfmac TCP workq bump). 4 KiB is generous but cheap in
# our 256 MiB RAM budget.
CONFIG_USBD_THREAD_STACK_SIZE=4096
CONFIG_UDC_DWC2_STACK_SIZE=4096

# Stack sentinel: writes a magic value at the bottom of every
# thread's stack and ASSERTs if it's clobbered. Catches overflow
# at the moment of the overwrite (or shortly after, at the next
# thread switch / check point), not 30 frames later when a corrupted
# pointer dispatches into garbage. Memory:
# feedback_zephyr_stack_sentinel_for_corruption_hunts.
CONFIG_STACK_SENTINEL=y
CONFIG_ASSERT=y

# Console + LOG. Keep INF on the CDC class so we see "CDC ACM device
# ready" at boot. Force the UDC driver to WRN (its INF default fires
# "Prepare RX" several times per SETUP during enumeration -- not
# useful in steady state). Enable DBG locally if regressing.
CONFIG_PRINTK=y
CONFIG_LOG=y
CONFIG_LOG_BUFFER_SIZE=8192
CONFIG_USBD_CDC_ACM_LOG_LEVEL_INF=y
CONFIG_UDC_DRIVER_LOG_LEVEL_WRN=y
```

## app.overlay
```dts
/*
 * Copyright (c) 2026 Jonathan E. Peace <jep@alphabetiq.com>
 *
 * SPDX-License-Identifier: Apache-2.0
 */

/*
 * Phase 2.1 bring-up: enable the DWC2 USB controller as a device-mode
 * peripheral and declare a single CDC ACM UART child instance on it.
 *
 * The DWC2 node lives in bcm2710.dtsi (status="disabled" there); this
 * overlay flips it on for this sample only -- the board defconfig is
 * untouched, so the parallel wifi/SDIO work on the rpi-zero-2w-port
 * branch is not affected.
 *
 * The DWC2 vendor pre_enable hook issues SET_POWER_STATE (USB_HCD, on)
 * over the VideoCore firmware property interface during USB init to
 * turn on the analog PHY power island that start.elf leaves off
 * (without it the controller is digitally accessible but D+/D- aren't
 * driven). The firmware + mbox0 nodes are enabled in bcm2710.dtsi.
 */

&usb {
	status = "okay";

	cdc_acm_uart0: cdc_acm_uart0 {
		compatible = "zephyr,cdc-acm-uart";
		label = "Zephyr USB CDC-ACM";
	};
};
```

## src/main.c
```c
/*
 * Copyright (c) 2026 jetpax
 *
 * SPDX-License-Identifier: Apache-2.0
 *
 * Minimal CDC ACM demo for rpi_zero_2w.
 *
 * The USB stack initializes itself at SYS_INIT (we set
 * CONFIG_CDC_ACM_SERIAL_INITIALIZE_AT_BOOT=y) and the
 * `zephyr,cdc-acm-uart` DT node is bound by the class driver to look
 * like a regular UART. The app waits for the host to open the port
 * (DTR asserted), then pushes a counted "hello USB" line every 500 ms
 * via the standard UART poll-out API. The CDC class translates that
 * into bulk-IN packets on the chip's endpoint 1 IN; the host PC sees
 * them on its /dev/cu.usbmodem* (macOS) / /dev/ttyACM0 (Linux) /
 * COMn (Windows).
 */

#include <stdio.h>
#include <zephyr/device.h>
#include <zephyr/drivers/uart.h>
#include <zephyr/kernel.h>
#include <zephyr/logging/log.h>

LOG_MODULE_REGISTER(usb_cdc_min, LOG_LEVEL_INF);

static const struct device *const cdc_dev =
	DEVICE_DT_GET_ONE(zephyr_cdc_acm_uart);

int main(void)
{
	uint32_t dtr = 0U;

	if (!device_is_ready(cdc_dev)) {
		LOG_ERR("CDC ACM device not ready -- driver bind failed");
		return -1;
	}

	LOG_INF("CDC ACM device ready: %s -- waiting for host (DTR)",
		cdc_dev->name);

	/* Wait until a host opens the port (asserts DTR) before writing,
	 * and re-check each iteration so the sample stays quiet when the
	 * host closes the port instead of spinning data into a suspended
	 * bus. Mirrors samples/subsys/usb/cdc_acm.
	 */
	for (uint32_t count = 0;; count++) {
		char line[32];
		int len;

		uart_line_ctrl_get(cdc_dev, UART_LINE_CTRL_DTR, &dtr);
		if (!dtr) {
			k_msleep(100);
			continue;
		}

		len = snprintf(line, sizeof(line), "hello USB #%u\r\n", count);
		for (int i = 0; i < len; i++) {
			uart_poll_out(cdc_dev, line[i]);
		}

		k_msleep(500);
	}

	return 0;
}
```
