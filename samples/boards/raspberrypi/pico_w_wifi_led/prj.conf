## CMakeLists.txt
```
cmake_minimum_required(VERSION 3.28.0)
find_package(Zephyr REQUIRED HINTS $ENV{ZEPHYR_BASE})
project(pico_w_wifi_led)
target_sources(app PRIVATE src/main.c)
```

## prj.conf
```kconfig
CONFIG_GPIO=y
CONFIG_NETWORKING=y
CONFIG_NET_IPV4=y
CONFIG_NET_DHCPV4=y
CONFIG_NET_L2_ETHERNET=y
CONFIG_WIFI=y
CONFIG_NET_MGMT_EVENT=y
CONFIG_NET_MGMT_EVENT_QUEUE_SIZE=16
CONFIG_NET_MGMT_EVENT_QUEUE_TIMEOUT=5000
CONFIG_MAIN_STACK_SIZE=4096
CONFIG_NET_TX_STACK_SIZE=2048
CONFIG_NET_RX_STACK_SIZE=2048
```

## boards/rpi_pico2_rp2350a_m33_0_w.overlay
```dts
/*
 * SPDX-FileCopyrightText: Copyright The Zephyr Project Contributors
 * SPDX-License-Identifier: Apache-2.0
 */

/ {
	leds {
		compatible = "gpio-leds";

		led0: led_0 {
			gpios = <&cyw43_gpio 0 GPIO_ACTIVE_HIGH>;
			label = "LED";
		};
	};

	aliases {
		led0 = &led0;
	};
};
```

## boards/rpi_pico_rp2040_w.overlay
```dts
/ {
	leds {
		compatible = "gpio-leds";

		led0: led_0 {
			gpios = <&cyw43_gpio 0 GPIO_ACTIVE_HIGH>;
			label = "LED";
		};
	};

	aliases {
		led0 = &led0;
	};
};
```

## src/main.c
```c
/*
 * Copyright (c) 2025 John Lin
 * SPDX-License-Identifier: Apache-2.0
 */

#include <zephyr/kernel.h>
#include <zephyr/drivers/gpio.h>
#include <zephyr/net/wifi_mgmt.h>
#include <zephyr/net/net_mgmt.h>

#define LED_NODE DT_ALIAS(led0)
static const struct gpio_dt_spec led = GPIO_DT_SPEC_GET(LED_NODE, gpios);

static struct net_mgmt_event_callback wifi_cb;
static K_SEM_DEFINE(scan_done, 0, 1);

static void wifi_scan_result(struct net_mgmt_event_callback *cb, uint64_t mgmt_event,
			     struct net_if *iface)
{
	if (mgmt_event == NET_EVENT_WIFI_SCAN_DONE) {
		printk("WiFi scan complete\n");
		k_sem_give(&scan_done);
	} else if (mgmt_event == NET_EVENT_WIFI_SCAN_RESULT) {
		const struct wifi_scan_result *entry =
			(const struct wifi_scan_result *)cb->info;
		printk("  SSID: %-32s CH: %2d RSSI: %d\n",
		       entry->ssid, entry->channel, entry->rssi);
	}
}

static void led_thread_fn(void *p1, void *p2, void *p3)
{
	ARG_UNUSED(p1);
	ARG_UNUSED(p2);
	ARG_UNUSED(p3);

	while (1) {
		gpio_pin_toggle_dt(&led);
		k_sleep(K_MSEC(500));
	}
}

K_THREAD_DEFINE(led_thread, 512, led_thread_fn, NULL, NULL, NULL, 7, 0, 0);

int main(void)
{
	int ret;

	printk("Pico W WiFi + LED Demo\n");

	if (!gpio_is_ready_dt(&led)) {
		printk("LED device not ready\n");
		return 0;
	}

	ret = gpio_pin_configure_dt(&led, GPIO_OUTPUT_ACTIVE);
	if (ret < 0) {
		printk("Failed to configure LED: %d\n", ret);
		return 0;
	}

	printk("LED blinking started\n");

	/* Wait for WiFi to be ready */
	k_sleep(K_SECONDS(3));

	struct net_if *iface = net_if_get_default();

	if (!iface) {
		printk("No network interface\n");
		return 0;
	}

	net_mgmt_init_event_callback(&wifi_cb, wifi_scan_result,
				     NET_EVENT_WIFI_SCAN_RESULT |
				     NET_EVENT_WIFI_SCAN_DONE);
	net_mgmt_add_event_callback(&wifi_cb);

	printk("Starting WiFi scan...\n");
	ret = net_mgmt(NET_REQUEST_WIFI_SCAN, iface, NULL, 0);
	if (ret) {
		printk("WiFi scan request failed: %d\n", ret);
		return 0;
	}

	k_sem_take(&scan_done, K_SECONDS(15));
	printk("Demo complete - LED continues blinking\n");
	return 0;
}
```
