/*
 * SPDX-FileCopyrightText: Copyright The Zephyr Project Contributors
 * SPDX-License-Identifier: Apache-2.0
 */

/ {
	leds {
		compatible = "gpio-leds";

		led0: led_0 {
			gpios = <&cyw43_gpio 0 GPIO_ACTIVE_HIGH>;
			label = "LED";
		};
	};

	aliases {
		led0 = &led0;
	};
};
