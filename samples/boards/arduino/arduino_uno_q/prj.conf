## CMakeLists.txt
```
cmake_minimum_required(VERSION 3.20.0)
find_package(Zephyr REQUIRED HINTS $ENV{ZEPHYR_BASE})
project(led_matrix_demo)

target_sources(app PRIVATE src/main.c)
```

## prj.conf
```kconfig
# SPDX-License-Identifier: Apache-2.0

# Enable LED Matrix Driver
CONFIG_LED_MATRIX=y
CONFIG_LED_MATRIX_UNO_Q=y

# Logging configuration
CONFIG_LOG=y
CONFIG_LED_MATRIX_UNO_Q_INIT_PRIORITY=90

# Kernel configuration
CONFIG_MAIN_STACK_SIZE=2048

# GPIO
CONFIG_GPIO=y
# Random number generation for sparkle test
CONFIG_TEST_RANDOM_GENERATOR=y

# Console backend — RTT (works over your existing SWD/TCP tunnel)
CONFIG_UART_CONSOLE=n
CONFIG_RTT_CONSOLE=y
CONFIG_USE_SEGGER_RTT=y

# Optional: make logs more verbose
CONFIG_LOG_DEFAULT_LEVEL=3
CONFIG_LOG_BACKEND_RTT=y
```

## boards/arduino_uno_q.overlay
```dts
/* SPDX-License-Identifier: Apache-2.0 */
/*
 * Copyright (c) 2026 Shankar Sridhar <shankar.sd.dev@gmail.com>
 *
 * Device tree overlay for Arduino UNO Q LED Matrix
 */

/ {
	led_matrix: led-matrix {
		compatible = "arduino,uno-q-ledmatrix";
		/* 11 GPIO pins for Charlieplexing: PF0-PF10 */
		gpios = <&gpiof 0 GPIO_ACTIVE_HIGH>,   /* LED_MATRIX_0 - PF0 */
			<&gpiof 1 GPIO_ACTIVE_HIGH>,   /* LED_MATRIX_1 - PF1 */
			<&gpiof 2 GPIO_ACTIVE_HIGH>,   /* LED_MATRIX_2 - PF2 */
			<&gpiof 3 GPIO_ACTIVE_HIGH>,   /* LED_MATRIX_3 - PF3 */
			<&gpiof 4 GPIO_ACTIVE_HIGH>,   /* LED_MATRIX_4 - PF4 */
			<&gpiof 5 GPIO_ACTIVE_HIGH>,   /* LED_MATRIX_5 - PF5 */
			<&gpiof 6 GPIO_ACTIVE_HIGH>,   /* LED_MATRIX_6 - PF6 */
			<&gpiof 7 GPIO_ACTIVE_HIGH>,   /* LED_MATRIX_7 - PF7 */
			<&gpiof 8 GPIO_ACTIVE_HIGH>,   /* LED_MATRIX_8 - PF8 */
			<&gpiof 9 GPIO_ACTIVE_HIGH>,   /* LED_MATRIX_9 - PF9 */
			<&gpiof 10 GPIO_ACTIVE_HIGH>;  /* LED_MATRIX_10 - PF10 */
		rows = <8>;
		columns = <13>;
		brightness = <255>;

		led-pairs = <
			/* Row 0 — LED 1-13  (index 0-12) */
			0 1    1 0    0 2    2 0    1 2    2 1    0 3
			3 0    1 3    3 1    2 3    3 2    0 4

			/* Row 1 — LED 14-26 (index 13-25) */
			4 0    1 4    4 1    2 4    4 2    3 4    4 3
			0 5    5 0    1 5    5 1    2 5    5 2

			/* Row 2 — LED 27-39 (index 26-38) */
			3 5    5 3    4 5    5 4    0 6    6 0    1 6
			6 1    2 6    6 2    3 6    6 3    4 6

			/* Row 3 — LED 40-52 (index 39-51) */
			6 4    5 6    6 5    0 7    7 0    1 7    7 1
			2 7    7 2    3 7    7 3    4 7    7 4

			/* Row 4 — LED 53-65 (index 52-64) */
			5 7    7 5    6 7    7 6    0 8    8 0    1 8
			8 1    2 8    8 2    3 8    8 3    4 8

			/* Row 5 — LED 66-78 (index 65-77) */
			8 4    5 8    8 5    6 8    8 6    7 8    8 7
			0 9    9 0    1 9    9 1    2 9    9 2

			/* Row 6 — LED 79-91 (index 78-90) */
			3 9    9 3    4 9    9 4    5 9    9 5    6 9
			9 6    7 9    9 7    8 9    9 8    0 10

			/* Row 7 — LED 92-104 (index 91-103) */
			10 0   1 10   10 1   2 10   10 2   3 10   10 3
			4 10   10 4   5 10   10 5   6 10   10 6
		>;

		status = "okay";
	};

	aliases {
		ledmatrix = &led_matrix;
	};
};
```

## src/main.c
```c
/*
 * SPDX-License-Identifier: Apache-2.0
 * Copyright (c) 2026 Shankar Sridhar
 */

#include <zephyr/kernel.h>
#include <zephyr/drivers/display.h>

int main(void)
{
	const struct device *disp = DEVICE_DT_GET(DT_NODELABEL(led_matrix));

	if (!device_is_ready(disp)) {
		printk("ERROR: display not ready\n");
		return -1;
	}

	/* --- Test 1: get_capabilities --- */
	struct display_capabilities caps;

	display_get_capabilities(disp, &caps);
	printk("Display ready: %dx%d fmt=0x%x\n",
		   caps.x_resolution,   /* expect 13 */
		   caps.y_resolution,   /* expect 8  */
		   caps.current_pixel_format);  /* expect 1 = PIXEL_FORMAT_MONO01 */

	/* --- Test 2: blanking_on / blanking_off --- */
	printk("Blanking on (all LEDs off)...\n");
	display_blanking_on(disp);
	k_sleep(K_SECONDS(2));

	printk("Blanking off (display resumes)...\n");
	display_blanking_off(disp);
	k_sleep(K_SECONDS(1));

	/* --- Test 3: display_write — full row of pixels via MONO01 --- */
	/* 13 pixels wide, packed into 2 bytes (bits 0-12 used, bits 13-15 unused) */
	/* 0x1FFF = 0001 1111 1111 1111 = all 13 bits set */
	uint8_t full_row[2] = {0xFF, 0x1F};
	struct display_buffer_descriptor desc = {
		.buf_size = 2,
		.width    = 13,
		.height   = 1,
		.pitch    = 13,  /* pixels per source row */
	};

	printk("Writing top row...\n");
	display_write(disp, 0, 0, &desc, full_row);
	k_sleep(K_SECONDS(2));

	/* --- Test 4: checkerboard using set_pixel (custom API still works) --- */
	/*
	 * pitch=13 means a flat bitstream — rows are NOT byte-aligned.
	 * Row 0 starts at bit 0, row 1 at bit 13, row 2 at bit 26, etc.
	 * Total: 8 * 13 = 104 bits = 13 bytes exactly.
	 */
	uint8_t checkerboard[13] = {0};

	for (int r = 0; r < 8; r++) {
		for (int c = 0; c < 13; c++) {
			if ((r + c) % 2 == 0) {
				uint32_t bit_idx = r * 13 + c;

				checkerboard[bit_idx / 8] |= (1u << (bit_idx % 8));
			}
		}
	}

	struct display_buffer_descriptor checker_desc = {
		.buf_size = sizeof(checkerboard),
		.width    = 13,
		.height   = 8,
		.pitch    = 13,
	};

	display_write(disp, 0, 0, &checker_desc, checkerboard);
	printk("Checkerboard on screen\n");
	k_sleep(K_SECONDS(2));

	/* --- Test 5: global brightness sweep --- */
	uint8_t all_on[13];
 
	memset(all_on, 0xFF, sizeof(all_on));
 
	struct display_buffer_descriptor all_on_desc = {
		.buf_size = sizeof(all_on),
		.width    = 13,
		.height   = 8,
		.pitch    = 13,
	};
 
	display_write(disp, 0, 0, &all_on_desc, all_on);
	printk("Brightness sweep start (all LEDs on)\n");
 
	/* Fade out: 255 -> 0 in steps of 16 */
	for (int b = 255; b >= 0; b -= 16) {
		display_set_brightness(disp, (uint8_t)b);
		printk("Brightness: %d\n", b);
		k_sleep(K_MSEC(300));
	}
 
	/* Ensure we hit exactly 0 */
	display_set_brightness(disp, 0);
	k_sleep(K_MSEC(500));
 
	/* Fade in: 0 -> 255 in steps of 16 */
	for (int b = 0; b <= 255; b += 16) {
		display_set_brightness(disp, (uint8_t)b);
		printk("Brightness: %d\n", b);
		k_sleep(K_MSEC(300));
	}
 
	/* Restore full brightness */
	display_set_brightness(disp, 255);
	printk("Brightness sweep done\n");

	while (1) {
		k_sleep(K_FOREVER);
	}
	return 0;
}
```
