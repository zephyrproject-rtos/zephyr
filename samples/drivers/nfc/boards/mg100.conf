## samples/drivers/nfc/boards/mg100.conf
```kconfig
#
# Copyright (c) 2023 Sendrato
#
# SPDX-License-Identifier: Apache-2.0
#

# Enable NFC-wrapper for Nordic NFCT lib
CONFIG_NFC_NRFX=y

# Setup NFC as Type 2 Tag
CONFIG_NFC_T2T_NRFXLIB=y
```

## samples/drivers/onfi_nand/sample.yaml
```yaml
sample:
  name: ONFI NAND Flash Sample
tests:
  sample.drivers.onfi.nand:
    tags: onfi flash
    
```

## samples/drivers/opamp/output_measure/dts/bindings/output_measure.yaml
```yaml
# Copyright 2025 NXP
# SPDX-License-Identifier: Apache-2.0

description: |
    This binding provides resources required to build and run the
    samples/drivers/opamp/output_measure in Zephyr.

compatible: "opamp-output-measure"

properties:
  opamp:
    type: phandles
    required: true
    description: |
      Indicates opamp to be tested.

  io-channels:
    type: phandle-array
    required: true
    description: |
      Indicates ADC channels to be used.

  adc-read-delay-ms:
    type: int
    default: 0
    description: |
      Indicates delay (in ms) between voltage set and ADC read.
```

## samples/drivers/opamp/output_measure/sample.yaml
```yaml
# Copyright 2025 NXP
# SPDX-License-Identifier: Apache-2.0

sample:
  name: OPAMP output measurement sample
tests:
  sample.drivers.opamp.output_measure:
    tags: opamp
    depends_on: opamp
    harness: console
    harness_config:
      type: multi_line
      regex:
        - "Set opamp inverting gain to: -?\\d+"
        - "Set opamp non-inverting gain to: -?\\d+"
        - "OPAMP output is: -?\\d+(mv)"
    platform_allow:
      - frdm_mcxa156
      - frdm_mcxa346
      - frdm_mcxa266
      - frdm_mcxn947/mcxn947/cpu0
      - lpcxpresso55s36
```

## samples/drivers/peci/sample.yaml
```yaml
sample:
  name: PECI driver  sample
tests:
  sample.drivers.peci:
    # theoretically EVB can be connected to Intel RVP as well,
    # but HW setup is not documented, hence qualifying as unsupported.
    platform_exclude: mec15xxevb_assy6853
    tags: drivers
    harness: console
    harness_config:
        type: multi_line
        ordered: true
        regex:
            - "mb data(.*)"
    depends_on: peci
```

## samples/drivers/pinctrl/dynamic/sample.yaml
```yaml
sample:
  description: A dynamic pin control sample
  name: pinctrl_dynamic
tests:
  sample.drivers.pinctrl.dynamic:
    build_only: true
    platform_allow: nrf52840dk/nrf52840
    integration_platforms:
      - nrf52840dk/nrf52840
```

## samples/drivers/ps2/sample.yaml
```yaml
sample:
  name: PS2 driver  sample
tests:
  sample.drivers.espi.ps2:
    tags: drivers
    harness: console
    harness_config:
        type: multi_line
        ordered: true
        regex:
            - "mb data(.*)"
        fixture: fixture_connect_mouse
    filter: dt_compat_enabled("microchip,xec-ps2")
```

## samples/drivers/psi5/sample.yaml
```yaml
sample:
  name: PSI5 driver sample

tests:
  sample.drivers.psi5:
    tags:
      - drivers
      - psi5
    depends_on: psi5
    filter: dt_alias_exists("psi5-0")
    harness: sensor
```

## samples/drivers/pwm/capture/sample.yaml
```yaml
sample:
  name: PWM capture
  description: input capture for PWM signal, time and duration application
common:
  tags:
    - drivers
    - pwm
  harness: console
  harness_config:
    type: multi_line
    ordered: true
    regex:
      - "timclk ([0-9]*) Hz"
      - "{period: ([0-9]*)  pulse width: ([0-9]*)} in TIMCLK cycle"
      - "{period: ([0-9]*) Hz duty: ([0-9]*)}"
  depends_on: pwm
tests:
  sample.drivers.pwm.capture:
    platform_allow:
      - lp_mspm0g3507
```

## samples/drivers/pwm/pwm_loopback/Kconfig
```kconfig
#
# Copyright (c) 2021 Thomas Stranger
#
# SPDX-License-Identifier: Apache-2.0
#

mainmenu "PWM loopback sample application"

choice
	prompt "Capture type"
	default APP_CAPTURE_TYPE_PULSE
	help
	  Select the capture type used for the measurement.

config APP_CAPTURE_TYPE_PULSE
	bool "Capture pulse only"

config APP_CAPTURE_TYPE_PERIOD
	bool "Capture period only"

config APP_CAPTURE_TYPE_BOTH
	bool "Capture both pulse and period"

endchoice

source "Kconfig.zephyr"
```

## samples/drivers/pwm/sample.yaml
```yaml
# Copyright (c) 2023 Intel Corporation
#
# SPDX-License-Identifier: Apache-2.0

sample:
  description: Test app for pwm
  name: pwm
  platforms: rpl_crb, ehl_crb
common:
    tags: samples
    harness: console
    harness_config:
      type: one_line
```

## samples/drivers/rtc/boards/frdm_mcxw71.conf
```kconfig
#
# Copyright 2025 NXP
#
# SPDX-License-Identifier: Apache-2.0
#

CONFIG_RTC_ALARM=y
CONFIG_RTC_INIT_PRIORITY=70
```

## samples/drivers/rtc/boards/kv260_r5.conf
```kconfig
# Copyright (c) 2026 Advanced Micro Devices, Inc.
# SPDX-License-Identifier: Apache-2.0

CONFIG_RTC_INIT_PRIORITY=70
```

## samples/drivers/rtc/boards/lpcxpresso55s69_lpc55s69_cpu0.conf
```kconfig
#
# Copyright 2025 NXP
#
# SPDX-License-Identifier: Apache-2.0
#

CONFIG_RTC_ALARM=y
CONFIG_COUNTER=y
CONFIG_RTC_INIT_PRIORITY=70
```

## samples/drivers/rtc/boards/sk_am62_am6254_a53.conf
```kconfig
#
# Copyright 2026 Texas Instruments Inc.
#
# SPDX-License-Identifier: Apache-2.0
#

CONFIG_RTC_INIT_PRIORITY=70
```

## samples/drivers/rtc/ds1307/sample.yaml
```yaml
sample:
  name: DS1307 Real-Time Clock
tests:
  sample.rtc.ds1307:
    harness: rtc
    tags:
      - samples
      - sensor
    depends_on:
      - i2c
      - rtc
      - ds1307
```

## samples/drivers/rtc/sample.yaml
```yaml
sample:
  name: Real-Time Clock Sample
common:
  tags:
    - samples
    - rtc
    - api
  harness: console
  harness_config:
    type: one_line
    regex:
      - "RTC date and time: 2024-11-17 04:19:01"
tests:
  sample.drivers.rtc:
    platform_allow:
      - stm32f3_disco
      - mimxrt700_evk/mimxrt798s/cm33_cpu0
      - mimxrt700_evk/mimxrt798s/cm33_cpu1
    integration_platforms:
      - stm32f3_disco
    depends_on:
      - rtc
  sample.drivers.rtc.shields:
    platform_allow:
      - adafruit_qt_py_rp2040/rp2040
      - adafruit_metro_rp2040/rp2040
    integration_platforms:
      - adafruit_qt_py_rp2040/rp2040
      - adafruit_metro_rp2040/rp2040
    extra_args:
      - platform:adafruit_qt_py_rp2040/rp2040:SHIELD="sparkfun_rv8803"
      - platform:adafruit_metro_rp2040/rp2040:SHIELD="adafruit_pcf8523"
```

## samples/drivers/rtc_ds3231/sample.yaml
```yaml
sample:
  name: RTC Driver Sample
tests:
  sample.driver.rtc:
    tags: drivers
    harness: console
    harness_config:
        type: multi_line
        ordered: true
        regex:
            - "Test RTC driver"
            - "Alarm"
    depends_on: rtc
```

## samples/drivers/saej2716/sample.yaml
```yaml
sample:
  name: SAEJ2716 driver sample

tests:
  sample.drivers.saej2716:
    tags:
      - drivers
      - saej2716
    depends_on: saej2716
    filter: dt_alias_exists("saej2716-node")
    harness: sensor
```

## samples/drivers/satellite/kineis_kim1/sample.yaml
```yaml
common:
   tags: driver satellite kineis kim1
   depends_on: satellite
sample:
   description: Demonstration of satellite Kineis KIM1 module
   name: Kineis KIM1 Sample
tests:
   sample.driver.satellite.kineis_kim1:
     harness: console
     harness_config:
      type: one_line
      regex:
        - "<inf> kim1_sample: Synchronous send OK"
```

## samples/drivers/sdhc/sdhc_read_write/boards/arduino_nicla_vision_stm32h747xx_m7.conf
```kconfig
CONFIG_SDMMC_STM32=y
CONFIG_CYW4343W=y
CONFIG_CYW4343W_MURATA_1DX=y
CONFIG_LOG_MODE_DEFERRED=y
```

## samples/drivers/sdhc/sdhc_read_write/boards/arduino_portenta_h7_stm32h747xx_m7.conf
```kconfig
# Copyright (c) 2022 Benjamin Björnsson <benjamin.bjornsson@gmail.com>.
# SPDX-License-Identifier: Apache-2.0

CONFIG_SDMMC_STM32=y
CONFIG_CYW4343W=y
CONFIG_CYW4343W_MURATA_1DX=y
```

## samples/drivers/sdhc_emul/boards/native_sim.conf
```kconfig
CONFIG_SDHC=y
CONFIG_SDHC_EMUL=y

CONFIG_DISK_ACCESS=y
CONFIG_DISK_DRIVER_SDMMC=y

CONFIG_FILE_SYSTEM=y
CONFIG_FILE_SYSTEM_MKFS=y
CONFIG_FAT_FILESYSTEM_ELM=y
CONFIG_FS_FATFS_LFN=y

CONFIG_LOG=y
CONFIG_SDHC_LOG_LEVEL_INF=y
```
