## samples/drivers/dali_logger/sample.yaml
```yaml
sample:
  description: DALI Logger application
  name: dali-logger
common:
  build_only: true
  integration_platforms:
    - nrf52840dk/nrf52840
tests:
  app.default: {}
  app.debug:
    extra_overlay_confs:
      - debug.conf
```

## samples/drivers/display/boards/esp32s3_devkitc_procpu.conf
```kconfig
CONFIG_SHELL=y
CONFIG_DEVICE_SHELL=y
CONFIG_PRINTK=y
CONFIG_LOG=y
CONFIG_DISPLAY=y
CONFIG_GPIO=y
CONFIG_SPI=y
CONFIG_ST7789V=y
CONFIG_ST7789V_RGB565=y
```

## samples/drivers/display/boards/frdm_rw612.conf
```kconfig
#
# Copyright 2025 NXP
#
# SPDX-License-Identifier: Apache-2.0
#
CONFIG_PM=y
CONFIG_PM_DEVICE_RUNTIME=y
CONFIG_PM_DEVICE_SYSTEM_MANAGED=y
```

## samples/drivers/display/boards/mba117xl_cm7.conf
```kconfig
CONFIG_HEAP_MEM_POOL_SIZE=16777216
CONFIG_MAIN_STACK_SIZE=4096
CONFIG_LOG_BUFFER_SIZE=4096
```

## samples/drivers/display/boards/mimxrt1170_evk_mimxrt1176_cm7_A.conf
```kconfig
#
# Copyright 2022, NXP
#
# SPDX-License-Identifier: Apache-2.0
#

CONFIG_HEAP_MEM_POOL_SIZE=4194304
```

## samples/drivers/display/boards/mimxrt1170_evk_mimxrt1176_cm7_B.conf
```kconfig
#
# Copyright 2023, NXP
#
# SPDX-License-Identifier: Apache-2.0
#

CONFIG_HEAP_MEM_POOL_SIZE=64928
```

## samples/drivers/display/boards/mimxrt1170_evkb_cm7.conf
```kconfig
#
# Copyright 2023, NXP
#
# SPDX-License-Identifier: Apache-2.0
#

CONFIG_HEAP_MEM_POOL_SIZE=4194304
```

## samples/drivers/display/boards/mimxrt595_evk_mimxrt595s_cm33.conf
```kconfig
#
# Copyright 2023, NXP
#
# SPDX-License-Identifier: Apache-2.0
#

# Sample will allocate buffer equal to: (height / 8) * (height / 4) * pixel depth
# For the 1280x720 16 bit display, this is (720 / 8) * (720 / 4) * 2 = 32400 bytes
# We include 128 bytes of padding for kernel heap structures
CONFIG_HEAP_MEM_POOL_SIZE=32528
```

## samples/drivers/display/boards/mimxrt700_evk_mimxrt798s_cm33_cpu0.conf
```kconfig
#
# Copyright 2025 NXP
#
# SPDX-License-Identifier: Apache-2.0
#

CONFIG_SAMPLE_BUFFER_ADDR_ALIGN=64
CONFIG_SAMPLE_PITCH_ALIGN=64
# Sample will allocate buffer equal to: (panelwidth / 8) * (panelwidth / 4) * pixel depth. For a
# 1280x720 display in a 32-bpp format (e.g. ARGB8888), this is (720 / 8) * (720 / 4) * 4 = 64800
# bytes. We include 128 bytes of padding for kernel heap structures
CONFIG_HEAP_MEM_POOL_SIZE=64928
```

## samples/drivers/display/boards/rza3m_ek.conf
```kconfig
# Copyright (c) 2025 Renesas Electronics Corporation
# SPDX-License-Identifier: Apache-2.0

CONFIG_GPIO=y
CONFIG_HEAP_MEM_POOL_SIZE=90440
```

## samples/drivers/display/boards/stm32f769i_disco.conf
```kconfig
# Copyright (c) 2025 STMicroelectronics
# SPDX-License-Identifier: Apache-2.0

CONFIG_HEAP_MEM_POOL_SIZE=65536
```

## samples/drivers/display/boards/stm32h7s78_dk.conf
```kconfig
# Copyright (c) 2025 STMicroelectronics
# SPDX-License-Identifier: Apache-2.0

# On STM32H7S78 DK board, display being larger, it requires
# more memory to draw squares on the display (40K)
CONFIG_HEAP_MEM_POOL_SIZE=65536
```

## samples/drivers/display/boards/stm32n6570_dk_stm32n657xx_fsbl.conf
```kconfig
# Copyright (c) 2025 ST Microelectronics
# SPDX-License-Identifier: Apache-2.0

# On STM32N6 DK board, display being larger, it requires
# more memory to draw squares on the display (40K)
CONFIG_HEAP_MEM_POOL_SIZE=65536
```

## samples/drivers/display/boards/stm32u5g9j_dk2.conf
```kconfig
#
# Copyright (c) 2025 STMicroelectronics
#
# SPDX-License-Identifier: Apache-2.0
#

CONFIG_IDLE_STACK_SIZE=8192
CONFIG_PRIVILEGED_STACK_SIZE=8192
CONFIG_MAIN_STACK_SIZE=4096
```

## samples/drivers/display/ili9341_gaming/sample.yaml
```yaml
sample:
  name: ILI9341 Display Gaming Performance Sample
  description: >
    Demonstrates ILI9341 display usage for gaming applications.
    Developed for the AkiraOS project - a retro-cyberpunk gaming
    console on Zephyr RTOS. Shows performance benchmarks, backlight
    control, and real-world gaming requirements.

tests:
  sample.drivers.display.ili9341_gaming:
    tags: display ili9341 gaming
    harness: console
    harness_config:
      type: multi_line
      regex:
        - "Display device ready"
        - "Gaming Performance Benchmark"
    platform_allow:
      - esp32s3_devkitm/esp32s3/procpu
      - esp32_devkitc/esp32/procpu
    integration_platforms:
      - esp32s3_devkitm/esp32s3/procpu
```

## samples/drivers/display/sample.yaml
```yaml
sample:
  description: Sample application for displays
  name: display_sample
tests:
  sample.display.sdl:
    build_only: true
    platform_allow:
      - native_posix/native/64
      - native_sim/native/64
    tags: display
  sample.display.dummy:
    platform_allow:
      - native_posix
      - native_sim
    extra_args: DTC_OVERLAY_FILE="dummy_dc.overlay"
    extra_configs:
      - CONFIG_SDL_DISPLAY=n
      - CONFIG_TEST=y
    tags: display
  sample.display.g1120b0mipi:
    platform_allow: mimxrt595_evk/mimxrt595s/cm33
    tags: display
    harness: console
    extra_args: SHIELD=g1120b0mipi
    extra_configs:
      - CONFIG_PM=y
      - CONFIG_PM_DEVICE=y
      - CONFIG_IDLE_STACK_SIZE=400
    harness_config:
      fixture: fixture_display
  sample.display.builtin:
    # This test case is intended to insure that this sample builds & runs
    # correctly for all boards that have a supported built-in display.
    filter: dt_chosen_enabled("zephyr,display")
    harness: console
    harness_config:
      fixture: fixture_display
    tags: display
  sample.display.st_b_lcd40_dsi1_mb1166_a09:
    filter: dt_compat_enabled("frida,nt35510")
    platform_allow: stm32h747i_disco/stm32h747xx/m7
    extra_args: SHIELD=st_b_lcd40_dsi1_mb1166_a09
    tags:
      - display
      - shield
    harness: console
    harness_config:
      fixture: fixture_display
  sample.display.rk043fn02h_ct:
    platform_allow:
      - mimxrt1064_evk
      - mimxrt1060_evk
      - mimxrt1050_evk
      - mimxrt1040_evk
    tags: display
    harness: console
    extra_args: SHIELD=rk043fn02h_ct
    harness_config:
      fixture: fixture_display
  sample.display.shield:
    # This test case is intended to verify support for shields on boards
    # known to support them. It is not intended to cover all combinations
    # of boards and shields, but rather serve as a method to test each
    # display shield within Zephyr
    filter: dt_chosen_enabled("zephyr,display")
    harness: console
    harness_config:
      fixture: fixture_display
    extra_args:
      - platform:lpcxpresso55s69/lpc55s69/cpu0:SHIELD=adafruit_2_8_tft_touch_v2
      - platform:nrf52840dk/nrf52840:SHIELD=ssd1306_128x32
      - platform:frdm_k64f:SHIELD=ssd1306_128x64
      - platform:mimxrt685_evk/mimxrt685/cm33:SHIELD=waveshare_epaper_gdeh0213b1
      - platform:nucleo_l433rc_p:SHIELD=waveshare_epaper_gdew042t2
      - platform:nrf52dk/nrf52832:SHIELD=st7789v_tl019fqv01
      - platform:mimxrt1010_evk/mimxrt1011:SHIELD=st7789v_waveshare_240x240
      - platform:frdm_k22f:SHIELD=ls013b7dh03
      - platform:nrf52833dk/nrf52833:SHIELD=st7735r_ada_160x128
      - platform:mimxrt1170_evk@B/mimxrt1176/cm7:SHIELD=rk055hdmipi4m
      - platform:da1469x_dk_pro:DTC_OVERLAY_FILE=da1469x_dk_pro_mipi_dbi.overlay
      - platform:nrf52840dk/nrf52840:SHIELD=max7219_8x8
      - platform:stm32h747i_disco/stm32h747xx/m7:SHIELD=st_b_lcd40_dsi1_mb1166
      - platform:mimxrt1064_evk:SHIELD=rk043fn66hs_ctg
      - platform:mimxrt1060_evk:SHIELD=rk043fn66hs_ctg
      - platform:mimxrt1050_evk:SHIELD=rk043fn66hs_ctg
      - platform:mimxrt1040_evk:SHIELD=rk043fn66hs_ctg
      - platform:frdm_mcxn947/mcxn947/cpu0:SHIELD=lcd_par_s035_8080
      - platform:frdm_mcxn236:SHIELD=lcd_par_s035_8080
```

## samples/drivers/dma/dmatest/Kconfig
```kconfig
# Copyright (c) 2025 Advance Micro devices
# SPDX-License-Identifier: Apache-2.0

mainmenu "DMA TEST"

source "Kconfig.zephyr"

config DMA_TRANSFER_CHANNEL
	int "DMA channel to use"
	default 8

config DMA_TEST_SG_MODE
	bool "Enable DMA Scatter-Gather mode"
	help
	  Enable scatter-gather mode testing. When enabled, the test will
	  use multiple blocks per transfer. when disabled, simple mode
	  with single block transfer will be used.

config DMA_TEST_SG_BLOCK_COUNT
	int "Number of SG blocks per channel"
	depends on DMA_TEST_SG_MODE
	default 4
	range 2 32
	help
	  Number of scatter-gather blocks to use per DMA channel.
	  Each block will be BUFFER_SIZE bytes.
```

## samples/drivers/dma/dmatest/sample.yaml
```yaml
sample:
  description: DMA direct mode transfer
  name: DMA driver sample
common:
  tags: drivers
  depends_on: dma
  harness: console
  harness_config:
    type: one_line
    regex:
      - "DMA transfer verified all on channels"
tests:
  sample.drivers.dma:
    tags: dma
    filter: dt_nodelabel_enabled("adma0")
    integration_platforms:
      - versalnet_rpu
      - versal2_rpu
```

## samples/drivers/dma/mem_to_mem/Kconfig
```kconfig
# Copyright (c) 2023 Intel Corporation
# SPDX-License-Identifier: Apache-2.0

menu "Direct Memory Access(DMA) sample application"

source "Kconfig.zephyr"

config SAMPLE_DMA_CHANNEL_NR
	int "channel to use"
	default 0

endmenu
```

## samples/drivers/dma/mem_to_mem/sample.yaml
```yaml
sample:
  name: DMA
  description: DMA Driver sample application
common:
  tags:
    - drivers
    - dma
tests:
  sample.drivers.dma.mem_to_mem:
    depends_on:
      - dma
      - drivers
    filter: dt_alias_exists("dma")
    build_only: true
    platform_allow:
      - intel_socfpga_agilex5_socdk
    harness: console
    harness_config:
      type: multi_line
      ordered: true
      regex:
        - "Sample application for Memory to Memory transfer using dma controller"
        - "Successfully transferred"
        - "Sample application for dma transfer complete"
```

## samples/drivers/eeprom/sample.yaml
```yaml
sample:
  name: EEPROM Sample

tests:
  sample.drivers.eeprom:
    tags: eeprom
    platform_allow:
      - gd32f450i_eval
      - native_posix
      - native_posix/native/64
      - native_sim
      - native_sim/native/64
    integration_platforms:
      - native_sim/native/64
    harness: console
    harness_config:
      type: one_line
      regex:
        - "Reset the MCU to see the increasing boot counter."
  sample.drivers.eeprom.shield.x_nucleo_eeprma2:
    tags:
      - eeprom
      - shield
    depends_on:
      - arduino_gpio
      - arduino_i2c
      - arduino_spi
    platform_exclude:
      - ubx_evkannab1/nrf52832
      - sam_v71_xult/samv71q21
      - sam_v71_xult/samv71q21b
      - pan1781_evb
      - pan1782_evb
      - pan1770_evb
      - pan1780_evb
      - mimxrt1010_evk
    extra_args: SHIELD=x_nucleo_eeprma2
    harness: console
    harness_config:
      fixture: fixture_shield_x_nucleo_eeprma2
    integration_platforms:
      - nucleo_f070rb
```
