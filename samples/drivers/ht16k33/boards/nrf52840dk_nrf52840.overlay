/*
 * Copyright (c) 2019 Henrik Brix Andersen <henrik@brixandersen.dk>
 *
 * SPDX-License-Identifier: Apache-2.0
 */

&i2c0 {
	clock-frequency = <I2C_BITRATE_STANDARD>;

	ht16k33@70 {
		compatible = "holtek,ht16k33";
		reg = <0x70>;
		/* Uncomment to use IRQ instead of polling: */
		/* irq-gpios = <&gpio1 8 (GPIO_PULL_UP | GPIO_ACTIVE_LOW)>; */

		kscan-input {
			compatible = "zephyr,kscan-input";
		};
	};
};
