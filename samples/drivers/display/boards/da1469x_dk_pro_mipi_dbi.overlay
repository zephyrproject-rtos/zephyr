/*
 * Copyright (c) 2023 Renesas Electronics Corporation
 *
 * SPDX-License-Identifier: Apache-2.0
 */

 #include <zephyr/dt-bindings/display/ili9xxx.h>
 #include <zephyr/dt-bindings/gpio/gpio.h>

 / {
    chosen {
        zephyr,display = &ili9340;
    };
 };

 &mipi_dbi {
    reset-gpios = <&gpio0 12 GPIO_ACTIVE_LOW>;
    status = "okay";
    spi-dev = <&spi2>;

    ili9340: ili9340@0 {
        compatible = "ilitek,ili9340";
        mipi-max-frequency = <48000000>;
        status = "okay";
        reg = <0>;
        width = <240>;
        height = <320>;
        pixel-format = <ILI9XXX_PIXEL_FORMAT_RGB565>;
        rotation = <0>;
    };
};
