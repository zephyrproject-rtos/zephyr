## CMakeLists.txt
```
# Copyright 2026 NXP
# SPDX-License-Identifier: Apache-2.0

cmake_minimum_required(VERSION 3.20.0)

find_package(Zephyr REQUIRED HINTS $ENV{ZEPHYR_BASE})
project(hwspinlock_shell)

target_sources(app PRIVATE src/main.c)
```

## sample.yaml
```
sample:
  name: HWSPINLOCK shell
common:
  tags:
    - drivers
    - hwspinlock
    - shell
  platform_allow:
    - imx95_evk/mimx9596/m7
    - imx943_evk/mimx94398/m33
  integration_platforms:
    - imx95_evk/mimx9596/m7
    - imx943_evk/mimx94398/m33
tests:
  sample.drivers.hwspinlock.shell:
    harness: console
    harness_config:
      type: one_line
      regex:
        - "hwspinlock shell sample ready"
```

## prj.conf
```kconfig
CONFIG_SHELL=y
CONFIG_HWSPINLOCK=y
CONFIG_HWSPINLOCK_SHELL=y
```

## src/main.c
```c
/*
 * Copyright 2026 NXP
 *
 * SPDX-License-Identifier: Apache-2.0
 */

#include <zephyr/kernel.h>
#include <zephyr/sys/printk.h>

int main(void)
{
	printk("hwspinlock shell sample ready\n");
	printk("Type 'hwspinlock' for available commands.\n");

	while (1) {
		k_sleep(K_SECONDS(1));
	}

	return 0;
}
```
