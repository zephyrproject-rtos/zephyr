## CMakeLists.txt
```
# SPDX-License-Identifier: Apache-2.0

cmake_minimum_required(VERSION 3.20.0)

find_package(Zephyr REQUIRED HINTS $ENV{ZEPHYR_BASE})
project(xen_virtio_backend)

target_sources(app PRIVATE src/main.c)
```

## sample.yaml
```
sample:
  description: Hello World sample, the simplest Zephyr
    application
  name: hello world
common:
  min_ram: 2
  min_flash: 16
  tags: introduction
  integration_platforms:
    - native_sim
  harness: console
  harness_config:
    type: one_line
    regex:
      - "Hello World! (.*)"
tests:
  sample.virtualization.xen.virtio_backend:
    tags: introduction
```

## prj.conf
```kconfig
CONFIG_VIRTIO=y
CONFIG_LOG=y
CONFIG_HEAP_MEM_POOL_SIZE=1048576
CONFIG_LOG_MODE_IMMEDIATE=y
```

## boards/xenvm.overlay
```dts
/*
 * Copyright (c) 2025 TOKITA Hiroshi
 *
 * SPDX-License-Identifier: Apache-2.0
 */

/ {
	virtio-mmio-backend {
		compatible = "xen,virtio-mmio-backend";
/*
@10004000 {
		reg = <0x0 0x10004000 0x0 0x200>;
*/
	};

};
```

## boards/xenvm_xenvm_gicv3.overlay
```dts
/*
 * Copyright (c) 2025 TOKITA Hiroshi
 *
 * SPDX-License-Identifier: Apache-2.0
 */

/ {
	virtio-mmio-backend {
		compatible = "xen,virtio-mmio-backend";
/*
@10004000 {
		reg = <0x0 0x10004000 0x0 0x200>;
		interrupts = <GIC_SPI 42 IRQ_TYPE_EDGE IRQ_DEFAULT_PRIORITY>;
*/
	};

};
```

## src/main.c
```c
/*
 * Copyright (c) 2025 TOKITA Hiroshi
 *
 * SPDX-License-Identifier: Apache-2.0
 */

#include <zephyr/kernel.h>

int main(void)
{
	while (1) {
		k_yield();
	}

	return 0;
}
```
