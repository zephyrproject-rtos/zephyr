## CMakeLists.txt
```
# SPDX-License-Identifier: Apache-2.0

cmake_minimum_required(VERSION 3.20.0)

find_package(Zephyr REQUIRED HINTS $ENV{ZEPHYR_BASE})
project(vhost)

FILE(GLOB app_sources src/*.c)
target_sources(app PRIVATE ${app_sources})
```

## Kconfig
```
# Copyright (c) 2025 Omori Fuma
# SPDX-License-Identifier: Apache-2.0

config GPIO_LINE_NAME_0
        string "Set name of line 0"

config GPIO_LINE_NAME_1
        string "Set name of line 1"

config GPIO_LINE_NAME_2
        string "Set name of line 2"

config GPIO_LINE_NAME_3
        string "Set name of line 3"

config GPIO_LINE_NAME_4
        string "Set name of line 4"

config GPIO_LINE_NAME_5
        string "Set name of line 5"

config GPIO_LINE_NAME_6
        string "Set name of line 6"

config GPIO_LINE_NAME_7
        string "Set name of line 7"

config GPIO_LINE_NAME_8
        string "Set name of line 8"

config GPIO_LINE_NAME_9
        string "Set name of line 9"

config GPIO_LINE_NAME_10
        string "Set name of line 10"

config GPIO_LINE_NAME_11
        string "Set name of line 11"

config GPIO_LINE_NAME_12
        string "Set name of line 12"

config GPIO_LINE_NAME_13
        string "Set name of line 13"

config GPIO_LINE_NAME_14
        string "Set name of line 14"

config GPIO_LINE_NAME_15
        string "Set name of line 15"

config GPIO_LINE_NAME_16
        string "Set name of line 16"

config GPIO_LINE_NAME_17
        string "Set name of line 17"

config GPIO_LINE_NAME_18
        string "Set name of line 18"

config GPIO_LINE_NAME_19
        string "Set name of line 19"

config GPIO_LINE_NAME_20
        string "Set name of line 20"

config GPIO_LINE_NAME_21
        string "Set name of line 21"

config GPIO_LINE_NAME_22
        string "Set name of line 22"

config GPIO_LINE_NAME_23
        string "Set name of line 23"

config GPIO_LINE_NAME_24
        string "Set name of line 24"

config GPIO_LINE_NAME_25
        string "Set name of line 25"

config GPIO_LINE_NAME_26
        string "Set name of line 26"

config GPIO_LINE_NAME_27
        string "Set name of line 27"

config GPIO_LINE_NAME_28
        string "Set name of line 28"

config GPIO_LINE_NAME_29
        string "Set name of line 29"

config GPIO_LINE_NAME_30
        string "Set name of line 30"

config GPIO_LINE_NAME_31
        string "Set name of line 31"

source "Kconfig.zephyr"
```

## sample.yaml
```
sample:
  description: VHost driver sample for VIRTIO backend implementation
  name: vhost
common:
  integration_platforms:
    - xenvm
  platform_allow: xenvm
  harness: console
  harness_config:
    type: multi_line
    regex:
      - "VHost device ready"
      - "VHost sample application started"
  timeout: 60
  depends_on: vhost
tests:
  sample.drivers.virtualization.vhost:
    tags: drivers virtualization vhost xen
    min_ram: 32
    extra_args: CONFIG_LOG_MODE_IMMEDIATE=y
```

## prj.conf
```kconfig
CONFIG_VHOST=y
CONFIG_LOG=y
CONFIG_HEAP_MEM_POOL_SIZE=8388608
CONFIG_LOG_MODE_IMMEDIATE=y
CONFIG_LOG_DEFAULT_LEVEL=3
CONFIG_VHOST_LOG_LEVEL_DBG=y
CONFIG_CONSOLE=y
CONFIG_SHELL_BACKEND_SERIAL=y
CONFIG_SHELL_BACKEND_SERIAL_API_POLLING=y
```

## boards/xenvm.overlay
```dts
/*
 * Copyright (c) 2025 TOKITA Hiroshi
 *
 * SPDX-License-Identifier: Apache-2.0
 */

/ {
	vhost {
		rng {
			compatible = "xen,vhost-mmio";
			device-id = <4>;
			vendor-id = <0x7a707972>; /* "zphy" */
			num-queues = <2>;
			queue-size-max = <16>;
			base = <0x2000000>;
		};
	};

	chosen {
		zephyr,shell-uart = &xen_hvc;
	};
};
```

## boards/xenvm_xenvm_gicv3.overlay
```dts
/*
 * Copyright (c) 2025 TOKITA Hiroshi
 *
 * SPDX-License-Identifier: Apache-2.0
 */

#include "xenvm.overlay"
```

## src/main.c
```c
/*
 * Copyright (c) 2025 TOKITA Hiroshi
 *
 * SPDX-License-Identifier: Apache-2.0
 */

#include <zephyr/drivers/vhost.h>
#include <zephyr/drivers/vhost/vringh.h>
#include <zephyr/logging/log.h>

LOG_MODULE_REGISTER(vhost);

#define QUEUE_READY_HANDLER_NAME(node_name) UTIL_CAT(node_name, _queue_ready)

#define QUEUE_READY_HANDLER_PROTODECL(sym)                                                         \
	void QUEUE_READY_HANDLER_NAME(sym)(const struct device *dev, uint16_t qid, void *data);

#define DECL_HANDLER(inst, x, y)                                                                   \
	QUEUE_READY_HANDLER_PROTODECL(DT_NODE_FULL_NAME_UNQUOTED(DT_INST(inst, xen_vhost_mmio)))

#define REGISTER_HANDLER(inst, x, y)                                                               \
	{                                                                                          \
		const struct device *dev = DEVICE_DT_GET(DT_INST(inst, xen_vhost_mmio));           \
		register_handler(dev, QUEUE_READY_HANDLER_NAME(DT_NODE_FULL_NAME_UNQUOTED(         \
					      DT_INST(inst, xen_vhost_mmio))));                    \
	}

DT_COMPAT_FOREACH_STATUS_OKAY_VARGS(xen_vhost_mmio, DECL_HANDLER, ())

int register_handler(const struct device *dev,
		     void (*handler)(const struct device *, uint16_t, void *))
{
	if (!device_is_ready(dev)) {
		LOG_ERR("VHost device %s not ready", dev->name);
		return -ENODEV;
	}

	LOG_INF("VHost device %s ready", dev->name);
	vhost_register_virtq_ready_cb(dev, handler, (void *)dev);

	return 0;
}

int main(void)
{
	DT_COMPAT_FOREACH_STATUS_OKAY_VARGS(xen_vhost_mmio, REGISTER_HANDLER, ())

	LOG_INF("VHost sample application started, waiting for guest connections...");
	k_sleep(K_FOREVER);

	return 0;
}
```

## src/gpio.c
```c
/*
 * Copyright (c) 2025 Omori Fuma
 *
 * SPDX-License-Identifier: Apache-2.0
 */

#include <zephyr/drivers/vhost.h>
#include <zephyr/drivers/vhost/vringh.h>
#include <zephyr/logging/log.h>
#include <zephyr/drivers/gpio.h>

/* Possible values of the status field */
#define VIRTIO_GPIO_STATUS_OK  0x0
#define VIRTIO_GPIO_STATUS_ERR 0x1

/* GPIO message types */
#define VIRTIO_GPIO_MSG_GET_LINE_NAMES 0x0001
#define VIRTIO_GPIO_MSG_GET_DIRECTION  0x0002
#define VIRTIO_GPIO_MSG_SET_DIRECTION  0x0003
#define VIRTIO_GPIO_MSG_GET_VALUE      0x0004
#define VIRTIO_GPIO_MSG_SET_VALUE      0x0005
#define VIRTIO_GPIO_MSG_SET_IRQ_TYPE   0x0006

/* GPIO Direction types */
#define VIRTIO_GPIO_DIRECTION_NONE 0x00
#define VIRTIO_GPIO_DIRECTION_OUT  0x01
#define VIRTIO_GPIO_DIRECTION_IN   0x02

/* GPIO interrupt types */
#define VIRTIO_GPIO_IRQ_TYPE_NONE         0x00
#define VIRTIO_GPIO_IRQ_TYPE_EDGE_RISING  0x01
#define VIRTIO_GPIO_IRQ_TYPE_EDGE_FALLING 0x02
#define VIRTIO_GPIO_IRQ_TYPE_EDGE_BOTH    0x03
#define VIRTIO_GPIO_IRQ_TYPE_LEVEL_HIGH   0x04
#define VIRTIO_GPIO_IRQ_TYPE_LEVEL_LOW    0x08

#define GPIO0_NODE DT_NODELABEL(gpio0)

LOG_MODULE_REGISTER(vhost_gpio);

static struct vhost_iovec riovec[16];
static struct vhost_iovec wiovec[16];

static struct vringh_iov riov = {
	.iov = riovec,
	.max_num = 16,
};

static struct vringh_iov wiov = {
	.iov = wiovec,
	.max_num = 16,
};

struct virtio_gpio_request {
	uint16_t type;
	uint16_t gpio;
	uint32_t value;
};

struct virtio_gpio_response {
	uint8_t status;
	uint8_t value[];
};

static struct vringh vrh_inst;

static const uint8_t pin_names[] = {
	CONFIG_GPIO_LINE_NAME_0 "\0"
	CONFIG_GPIO_LINE_NAME_1 "\0"
	CONFIG_GPIO_LINE_NAME_2 "\0"
	CONFIG_GPIO_LINE_NAME_3 "\0"
	CONFIG_GPIO_LINE_NAME_4 "\0"
	CONFIG_GPIO_LINE_NAME_5 "\0"
	CONFIG_GPIO_LINE_NAME_6 "\0"
	CONFIG_GPIO_LINE_NAME_7 "\0"
	CONFIG_GPIO_LINE_NAME_8 "\0"
	CONFIG_GPIO_LINE_NAME_9 "\0"
	CONFIG_GPIO_LINE_NAME_10 "\0"
	CONFIG_GPIO_LINE_NAME_11 "\0"
	CONFIG_GPIO_LINE_NAME_12 "\0"
	CONFIG_GPIO_LINE_NAME_13 "\0"
	CONFIG_GPIO_LINE_NAME_14 "\0"
	CONFIG_GPIO_LINE_NAME_15 "\0"
	CONFIG_GPIO_LINE_NAME_16 "\0"
	CONFIG_GPIO_LINE_NAME_17 "\0"
	CONFIG_GPIO_LINE_NAME_18 "\0"
	CONFIG_GPIO_LINE_NAME_19 "\0"
	CONFIG_GPIO_LINE_NAME_20 "\0"
	CONFIG_GPIO_LINE_NAME_21 "\0"
	CONFIG_GPIO_LINE_NAME_22 "\0"
	CONFIG_GPIO_LINE_NAME_23 "\0"
	CONFIG_GPIO_LINE_NAME_24 "\0"
	CONFIG_GPIO_LINE_NAME_25 "\0"
	CONFIG_GPIO_LINE_NAME_26 "\0"
	CONFIG_GPIO_LINE_NAME_27 "\0"
	CONFIG_GPIO_LINE_NAME_28 "\0"
	CONFIG_GPIO_LINE_NAME_29 "\0"
	CONFIG_GPIO_LINE_NAME_30 "\0"
	CONFIG_GPIO_LINE_NAME_31 "\0"
};

static void vringh_kick_handler(struct vringh *vrh)
{
	LOG_DBG("%s: queue_id=%lu", __func__, vrh->queue_id);
	const struct device *const dev = DEVICE_DT_GET(GPIO0_NODE);
	uint16_t head;

	if (!device_is_ready(dev)) {
		LOG_ERR("device %s is not ready", dev->name);
		return;
	}

	while (true) {
		int ret = vringh_getdesc(vrh, &riov, &wiov, &head);
		uint32_t total_len = 0;

		if (ret < 0) {
			LOG_ERR("vringh_getdesc failed: %d", ret);
			return;
		}

		if (ret == 0) {
			return;
		}

		for (uint32_t s = 0; s < riov.used; s++) {
			struct virtio_gpio_response *resp = wiov.iov[s].iov_base;
			const size_t payload_len = wiov.iov[s].iov_len - 1;
			struct virtio_gpio_request req;
			mem_addr_t addr_base = (mem_addr_t)riov.iov[s].iov_base;
			gpio_flags_t flags = 0;

			req.type = sys_read16(addr_base + 0);
			req.gpio = sys_read16(addr_base + 2);
			req.value = sys_read32(addr_base + 4);

			switch (req.type) {
			case VIRTIO_GPIO_MSG_GET_LINE_NAMES:
				const size_t names_len = MIN(payload_len, sizeof(pin_names));

				if (payload_len < sizeof(pin_names)) {
					LOG_WRN("Too short buffer to copy LINE_NAMES.");
				}

				memset(resp->value, 0, payload_len);
				memcpy(resp->value, pin_names, names_len);
				resp->status = VIRTIO_GPIO_STATUS_OK;

				break;
			case VIRTIO_GPIO_MSG_GET_DIRECTION:
				ret = gpio_pin_get_config(dev, req.gpio, &flags);

				if (ret < 0) {
					LOG_ERR("gpio_pin_get_config failed: %d", ret);

					resp->status = VIRTIO_GPIO_STATUS_ERR;
					resp->value[0] = 0;
					break;
				}
				flags &= GPIO_DIR_MASK;

				switch (flags) {
				case GPIO_DISCONNECTED:
					resp->status = VIRTIO_GPIO_STATUS_OK;
					resp->value[0] = VIRTIO_GPIO_DIRECTION_NONE;
					break;
				case GPIO_OUTPUT:
					resp->status = VIRTIO_GPIO_STATUS_OK;
					resp->value[0] = VIRTIO_GPIO_DIRECTION_OUT;
					break;
				case GPIO_INPUT:
					resp->status = VIRTIO_GPIO_STATUS_OK;
					resp->value[0] = VIRTIO_GPIO_DIRECTION_IN;
					break;
				default:
					resp->status = VIRTIO_GPIO_STATUS_ERR;
					resp->value[0] = 0;
					break;
				}
				break;
			case VIRTIO_GPIO_MSG_SET_DIRECTION:
				if (req.value > VIRTIO_GPIO_DIRECTION_IN) {
					LOG_ERR("Unexpeded value (req.value): %d", req.value);
					resp->status = VIRTIO_GPIO_STATUS_ERR;
					resp->value[0] = 0;
					break;
				}

				ret = gpio_pin_get_config(dev, req.gpio, &flags);
				if (ret < 0) {
					LOG_ERR("gpio_pin_get_config failed: %d", ret);
					resp->status = VIRTIO_GPIO_STATUS_ERR;
					resp->value[0] = 0;
					break;
				}

				flags &= ~GPIO_DIR_MASK;

				switch (req.value) {
				case VIRTIO_GPIO_DIRECTION_NONE:
					flags |= GPIO_DISCONNECTED;
					break;
				case VIRTIO_GPIO_DIRECTION_OUT:
					flags |= GPIO_OUTPUT;
					break;
				case VIRTIO_GPIO_DIRECTION_IN:
					flags |= GPIO_INPUT;
					break;
					/* Invalid values are already cheched */
				}

				ret = gpio_pin_configure(dev, req.gpio, flags);
				if (ret < 0) {
					LOG_ERR("gpio_pin_config failed: %d", ret);
					resp->status = VIRTIO_GPIO_STATUS_ERR;
					resp->value[0] = 0;
					break;
				}

				resp->status = VIRTIO_GPIO_STATUS_OK;
				resp->value[0] = 0;
				break;
			case VIRTIO_GPIO_MSG_GET_VALUE:
				ret = gpio_pin_get(dev, req.gpio);
				if (ret < 0) {
					LOG_ERR("gpio_pin_get failed: %d", ret);
					resp->status = VIRTIO_GPIO_STATUS_ERR;
					resp->value[0] = 0;
					break;
				}

				resp->status = VIRTIO_GPIO_STATUS_OK;
				resp->value[0] = ret;
				break;
			case VIRTIO_GPIO_MSG_SET_VALUE:
				ret = gpio_pin_set(dev, req.gpio, req.value);
				if (ret < 0) {
					LOG_ERR("gpio_pin_set failed: %d", ret);
					resp->status = VIRTIO_GPIO_STATUS_ERR;
					resp->value[0] = 0;
					break;
				}

				resp->status = VIRTIO_GPIO_STATUS_OK;
				resp->value[0] = 0;
				break;
			case VIRTIO_GPIO_MSG_SET_IRQ_TYPE:
				LOG_ERR("VIRTIO_GPIO_MSG_SET_IRQ_TYPE is not implemented\n");
				resp->status = VIRTIO_GPIO_STATUS_ERR;
				resp->value[0] = 0;
				break;
			}

			total_len += wiov.iov[s].iov_len;
		}

		barrier_dmem_fence_full();

		vringh_complete(vrh, head, total_len);

		if (vringh_need_notify(vrh) > 0) {
			vringh_notify(vrh);
		}

		/* Reset iovecs for next iteration */
		vringh_iov_reset(&riov);
		vringh_iov_reset(&wiov);
	}
}

void gpio_queue_ready(const struct device *dev, uint16_t qid, void *data)
{
	LOG_DBG("%s(dev=%p, qid=%u, data=%p)", __func__, dev, qid, data);

	/* Initialize iovecs before descriptor processing */
	vringh_iov_init(&riov, riov.iov, riov.max_num);
	vringh_iov_init(&wiov, wiov.iov, wiov.max_num);

	int err = vringh_init_device(&vrh_inst, dev, qid, vringh_kick_handler);

	if (err) {
		LOG_ERR("vringh_init_device failed: %d", err);
		return;
	}
}
```

## src/rng.c
```c
/*
 * Copyright (c) 2025 TOKITA Hiroshi
 *
 * SPDX-License-Identifier: Apache-2.0
 */

#include <zephyr/drivers/vhost.h>
#include <zephyr/drivers/vhost/vringh.h>
#include <zephyr/logging/log.h>

LOG_MODULE_REGISTER(vhost_rng);

static struct vhost_iovec riovec[16];
static struct vhost_iovec wiovec[16];

static struct vringh_iov riov = {
	.iov = riovec,
	.max_num = 16,
};

static struct vringh_iov wiov = {
	.iov = wiovec,
	.max_num = 16,
};

static struct vringh vrh_inst;

static void vringh_kick_handler(struct vringh *vrh)
{
	LOG_DBG("%s: queue_id=%lu", __func__, vrh->queue_id);
	uint16_t head;

	while (true) {
		int ret = vringh_getdesc(vrh, &riov, &wiov, &head);

		if (ret < 0) {
			LOG_ERR("vringh_getdesc failed: %d", ret);
			return;
		}

		if (ret == 0) {
			return;
		}

		/* Process writable iovecs */
		for (uint32_t s = 0; s < wiov.used; s++) {
			uint8_t *dst = wiov.iov[s].iov_base;
			uint32_t len = wiov.iov[s].iov_len;

			LOG_DBG("%s: addr=%p len=%u", __func__, dst, len);

			for (uint32_t i = 0; i < len; i++) {
				sys_write8(i, (mem_addr_t)&dst[i]);
			}
		}

		barrier_dmem_fence_full();

		uint32_t total_len = 0;

		for (uint32_t i = 0; i < wiov.used; i++) {
			total_len += wiov.iov[i].iov_len;
		}

		vringh_complete(vrh, head, total_len);

		if (vringh_need_notify(vrh) > 0) {
			vringh_notify(vrh);
		}

		/* Reset iovecs for next iteration */
		vringh_iov_reset(&riov);
		vringh_iov_reset(&wiov);
	}
}

void rng_queue_ready(const struct device *dev, uint16_t qid, void *data)
{
	LOG_DBG("%s(dev=%p, qid=%u, data=%p)", __func__, dev, qid, data);

	/* Initialize iovecs before descriptor processing */
	vringh_iov_init(&riov, riov.iov, riov.max_num);
	vringh_iov_init(&wiov, wiov.iov, wiov.max_num);

	int err = vringh_init_device(&vrh_inst, dev, qid, vringh_kick_handler);

	if (err) {
		LOG_ERR("vringh_init_device failed: %d", err);
		return;
	}
}
```
