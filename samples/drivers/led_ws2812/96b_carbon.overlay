/*
 * Copyright (c) 2018 Nordic Semiconductor ASA
 *
 * SPDX-License-Identifier: Apache-2.0
 */

&spi2 {

	ws2812@0 {
		compatible = "worldsemi,ws2812";
		reg = <0>;
		spi-max-frequency = <5250000>;
		label = "WS2812";
	};
};
