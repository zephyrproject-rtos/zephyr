/*
 * Copyright (c) 2021, STMicroelectronics
 *
 * SPDX-License-Identifier: Apache-2.0
 */

#include <dt-bindings/led/led.h>

&lpspi3 {
	led_strip: ws2812@0 {
		compatible = "worldsemi,ws2812-spi";
		label = "WS2812";

		/* SPI */
		reg = <0>; /* ignored, but necessary for SPI bindings */
		spi-max-frequency = <6400000>;

		/* WS2812 */
		chain-length = <2>; /* arbitrary; change at will */
		spi-cpha;
		spi-one-frame = <0xf0>; /* 11110000: 625 ns high and 625 ns low */
		spi-zero-frame = <0xc0>; /* 11000000: 312.5 ns high and 937.5 ns low */
		color-mapping = <LED_COLOR_ID_GREEN
				 LED_COLOR_ID_RED
				 LED_COLOR_ID_BLUE>;
	};
};

/ {
	aliases {
		led-strip = &led_strip;
	};
};
