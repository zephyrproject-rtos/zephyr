/*
 * Copyright (c) 2019, Nordic Semiconductor ASA
 *
 * SPDX-License-Identifier: Apache-2.0
 */

#include <zephyr/dt-bindings/gpio/gpio.h>
#include <zephyr/dt-bindings/led/led.h>

/ {
	led_strip: ws2812 {
		compatible = "worldsemi,ws2812-gpio";
		label = "WS2812";

		chain-length = <16>; /* arbitrary; change at will */
		color-mapping = <LED_COLOR_ID_GREEN
				 LED_COLOR_ID_RED
				 LED_COLOR_ID_BLUE>;
		/* P0: */
		in-gpios = <&gpio0 3 0>;
	};

	aliases {
		led-strip = &led_strip;
	};
};
