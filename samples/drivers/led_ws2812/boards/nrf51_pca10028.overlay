/*
 * Copyright (c) 2019, Nordic Semiconductor ASA
 *
 * SPDX-License-Identifier: Apache-2.0
 */

#include <dt-bindings/gpio/gpio.h>

/ {
	led_strip: ws2812 {
		compatible = "worldsemi,ws2812-gpio";
		label = "WS2812";

		chain-length = <16>; /* arbitrary */
		/*
		 * Arduino D11 / P0.25, which was chosen to match the pin
		 * used in nrf52_pca10040.overlay.
		 */
		in-gpios = <&gpio0 25 0>;
	};

	aliases {
		led-strip = &led_strip;
	};
};
