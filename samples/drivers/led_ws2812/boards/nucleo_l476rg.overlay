/*
 * Copyright (c) 2021, STMicroelectronics
 *
 * SPDX-License-Identifier: Apache-2.0
 */

&arduino_spi {
	led_strip: ws2812@0 {
		compatible = "worldsemi,ws2812-spi";
		label = "WS2812";

		/* SPI */
		reg = <0>; /* ignored, but necessary for SPI bindings */
		spi-max-frequency = <4000000>;

		/* WS2812 */
		chain-length = <16>; /* arbitrary; change at will */
		spi-one-frame = <0x70>;
		spi-zero-frame = <0x40>;
	};
};

/ {
	aliases {
		led-strip = &led_strip;
	};
};
