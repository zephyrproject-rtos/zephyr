## samples/drivers/led_ws2812/sample.yaml
```yaml
sample:
  description: Demonstration of the WS2812 LED driver
  name: WS2812 sample
tests:
  sample.drivers.led.ws2812:
    tags: LED
    filter: dt_compat_enabled("worldsemi,ws2812-spi")
    harness_config:
      fixture: fixture_led_ws2812
    integration_platforms:
      - mimxrt1050_evk
```

## samples/drivers/led_xec/sample.yaml
```yaml
sample:
  description: Demonstration of the Microchip XEC LED driver
  name: XEC LED sample
tests:
  sample.drivers.led.led_xec:
    build_only: true
    tags: LED
    platform_allow:
      - mec172xevb_assy6906/mec172x_nsz
      - mec15xxevb_assy6853/mec1501_hsz
```

## samples/drivers/lin/counter/Kconfig
```kconfig
# Copyright (c) 2025 Renesas Electronics Corporation
# SPDX-License-Identifier: Apache-2.0

mainmenu "LIN Counter Sample"

source "Kconfig.zephyr"

choice SAMPLE_LIN_BUS_BAUDRATE
	prompt "Select LIN bus baudrate used in this sample"
	default LIN_BUS_BAUDRATE_19200

config SAMPLE_LIN_BUS_BAUDRATE_2400
	bool "2400 bps"
	help
	  Configure LIN node baudrate to 2400 bps.

config SAMPLE_LIN_BUS_BAUDRATE_9600
	bool "9600 bps"
	help
	  Configure LIN node baudrate to 9600 bps.

config SAMPLE_LIN_BUS_BAUDRATE_10400
	bool "10400 bps"
	help
	  Configure LIN node baudrate to 10400 bps.

config SAMPLE_LIN_BUS_BAUDRATE_19200
	bool "19200 bps"
	help
	  Configure LIN node baudrate to 19200 bps.

endchoice

choice SAMPLE_LIN_BUS_CHECKSUM_TYPE
	prompt "Select LIN bus checksum type used in this sample"
	default SAMPLE_LIN_BUS_CLASSIC_CHECKSUM

config SAMPLE_LIN_BUS_CLASSIC_CHECKSUM
	bool "Classic Checksum"
	help
	  Configure LIN node to use Classic Checksum.

config SAMPLE_LIN_BUS_ENHANCED_CHECKSUM
	bool "Enhanced Checksum"
	help
	  Configure LIN node to use Enhanced Checksum.

endchoice

config SAMPLE_COUNTER_UPDATE_ID
	hex "LIN Frame ID to poll counter value"
	default 0x20
	help
	  This configuration option selects the LIN frame ID used by the
	  controller to poll the current counter value.

config SAMPLE_COUNTER_UPDATE_PERIOD_MS
	int "Counter update period (ms)"
	range 500 5000
	default 1000
	help
	  This configuration option selects the period at which the counter
	  value increments by 1.
```

## samples/drivers/lin/counter/sample.yaml
```yaml
sample:
  name: LIN driver counter sample
tests:
  sample.drivers.lin.counter:
    tags: lin
    depends_on: lin
    harness: console
    harness_config:
      type: one_line
      regex:
        - "LIN DUT started in RESPONDER mode"
    extra_args:
      - platform:ek_ra8m1/r7fa8m1ahecbd:SHIELD=mikroe_lin_click
```

## samples/drivers/lora/cad/sample.yaml
```yaml
common:
  tags: lora
  depends_on: lora
  harness: console
  harness_config:
    type: one_line
    regex:
      - "<inf> lora_cad: Scanner mode: probing channel with CAD"
sample:
  description: Demonstration of LoRa Channel Activity Detection (CAD)
  name: LoRa CAD Sample
tests:
  sample.drivers.lora.cad.native:
    build_only: true
    extra_args:
      - SHIELD=semtech_sx1261mb2bas
    platform_allow:
      - nrf52840dk/nrf52840
  sample.drivers.lora.cad.native.stm32wl:
    filter: dt_compat_enabled("st,stm32wl-subghz-radio")
    build_only: true
    integration_platforms:
      - nucleo_wl55jc
```

## samples/drivers/lora/duty_cycle/sample.yaml
```yaml
common:
  tags: lora
  depends_on: lora
  harness: console
  harness_config:
    type: one_line
    regex:
      - "<inf> lora_duty_cycle: RX duty cycle started"
sample:
  description: Demonstration of LoRa RX duty cycle (wake-on-radio)
  name: LoRa Duty Cycle Sample
tests:
  sample.driver.lora.duty_cycle.native:
    build_only: true
    extra_args:
      - SHIELD=semtech_sx1261mb2bas
    platform_allow:
      - nrf52840dk/nrf52840
  sample.driver.lora.duty_cycle.native.stm32wl:
    build_only: true
    integration_platforms:
      - nucleo_wl55jc
```

## samples/drivers/lora/receive/sample.yaml
```yaml
common:
  tags: lora
  depends_on: lora
  harness: console
  harness_config:
    type: one_line
    regex:
      - "<inf> lora_receive: Synchronous reception"
sample:
  description: Demonstration of LoRa Receive functionality
  name: LoRa Receive Sample
tests:
  sample.driver.lora.receive:
    integration_platforms:
      - b_l072z_lrwan1
  sample.driver.lora.receive.lbm:
    filter: dt_compat_enabled("semtech,sx1261") or
      dt_compat_enabled("semtech,sx1262") or
      dt_compat_enabled("semtech,sx1272") or
      dt_compat_enabled("semtech,sx1276")
    integration_platforms:
      - b_l072z_lrwan1
      - rak11720
    extra_configs:
      - CONFIG_LORA_MODULE_BACKEND_LORA_BASICS_MODEM=y
```

## samples/drivers/lora/send/sample.yaml
```yaml
common:
  tags: lora
  depends_on: lora
  harness: console
  harness_config:
    type: one_line
    regex:
      - "<inf> lora_send: Data sent 0!"
sample:
  description: Demonstration of LoRa Send functionality
  name: LoRa Send Sample
tests:
  sample.driver.lora.send:
    integration_platforms:
      - b_l072z_lrwan1
  sample.driver.lora.send.lbm:
    filter: dt_compat_enabled("semtech,sx1261") or
      dt_compat_enabled("semtech,sx1262") or
      dt_compat_enabled("semtech,sx1272") or
      dt_compat_enabled("semtech,sx1276")
    integration_platforms:
      - b_l072z_lrwan1
      - rak11720
    extra_configs:
      - CONFIG_LORA_MODULE_BACKEND_LORA_BASICS_MODEM=y
```

## samples/drivers/lora/send_fsk/sample.yaml
```yaml
common:
  tags: lora
  depends_on: lora
sample:
  description: Demonstration of FSK send over a LoRa-capable modem
  name: LoRa FSK Send Sample
tests:
  sample.driver.lora.send_fsk.native:
    build_only: true
    extra_args:
      - SHIELD=semtech_sx1261mb2bas
    extra_configs:
      - CONFIG_LORA_MODULE_BACKEND_NATIVE=y
    platform_allow:
      - nrf52840dk/nrf52840
  sample.driver.lora.send_fsk.native.stm32wl:
    build_only: true
    extra_configs:
      - CONFIG_LORA_MODULE_BACKEND_NATIVE=y
    integration_platforms:
      - nucleo_wl55jc
```

## samples/drivers/mbox/Kconfig
```kconfig
# Copyright 2023 NXP
#
# SPDX-License-Identifier: Apache-2.0

source "Kconfig.zephyr"

config INCLUDE_REMOTE_DIR
	bool "Include remote core header directory"
	help
	  Include remote build header files. Can be used if primary image
	  needs to be aware of size or base address of secondary image

config TX_ENABLED
	bool "TX enabled"
	default y
	help
	  Enable TX

config RX_ENABLED
	bool "RX enabled"
	default y
	help
	  Enable RX
```

## samples/drivers/mbox/Kconfig.sysbuild
```kconfig
# Copyright 2023 Nordic Semiconductor ASA
# Copyright 2023-2025 NXP
#
# SPDX-License-Identifier: Apache-2.0

source "share/sysbuild/Kconfig"

config REMOTE_BOARD
	string "Remote board"
	default "nrf5340dk/nrf5340/cpunet" if $(BOARD) = "nrf5340dk"
	default "nrf5340bsim/nrf5340/cpunet" if $(BOARD_TARGET_STRING) = "NRF5340BSIM_NRF5340_CPUAPP"
	default "adp_xc7k/ae350" if $(BOARD) = "adp_xc7k"
	default "mimxrt1170_evkb/mimxrt1176/cm4" if $(BOARD) = "mimxrt1170_evkb"
	default "mimxrt1170_evk/mimxrt1176/cm4" if $(BOARD) = "mimxrt1170_evk"
	default "mimxrt1160_evk/mimxrt1166/cm4" if $(BOARD) = "mimxrt1160_evk"
	default "mimxrt1180_evk/mimxrt1189/cm7" if $(BOARD) = "mimxrt1180_evk"
	default "lpcxpresso55s69/lpc55s69/cpu1" if $(BOARD) = "lpcxpresso55s69"
	default "frdm_mcxn947/mcxn947/cpu1" if $(BOARD) = "frdm_mcxn947"
	default "nrf54h20dk/nrf54h20/cpuapp" if "$(BOARD)${BOARD_QUALIFIERS}" = "nrf54h20dk/nrf54h20/cpurad"
	default "nrf54l15dk/nrf54l15/cpuflpr" if $(BOARD) = "nrf54l15dk"
	default "ophelia4ev/cpuflpr" if $(BOARD) = "ophelia4ev"
	default "stm32h747i_disco/stm32h747xx/m4" if $(BOARD) = "stm32h747i_disco"
	default "esp32_devkitc_wroom/esp32/appcpu" if "$(BOARD)${BOARD_QUALIFIERS}" = "esp32_devkitc_wroom/esp32/procpu"
	default "esp32s3_devkitm/esp32s3/appcpu" if "$(BOARD)${BOARD_QUALIFIERS}" = "esp32s3_devkitm/esp32s3/procpu"
```

## samples/drivers/mbox/remote/Kconfig
```kconfig
# Copyright 2024 Nordic Semiconductor ASA
# SPDX-License-Identifier: Apache-2.0

source "Kconfig.zephyr"

config TX_ENABLED
	bool "TX enabled"
	default y
	help
	  Enable TX

config RX_ENABLED
	bool "RX enabled"
	default y
	help
	  Enable RX
```

## samples/drivers/mbox/remote/boards/lpcxpresso55s69_cpu1.conf
```kconfig
CONFIG_SECOND_CORE_MCUX=y
CONFIG_BUILD_OUTPUT_HEX=y
CONFIG_MBOX_NXP_MAILBOX=y

# For purpose of sample enable UART Console on CPU1
CONFIG_CONSOLE=y
CONFIG_UART_CONSOLE=y
CONFIG_SERIAL=y
CONFIG_UART_INTERRUPT_DRIVEN=y
CONFIG_CLOCK_CONTROL=y
```

## samples/drivers/mbox/remote/boards/mimxrt1170_evk_mimxrt1176_cm4_B.conf
```kconfig
CONFIG_MBOX_NXP_IMX_MU=y
CONFIG_BUILD_OUTPUT_INFO_HEADER=y
CONFIG_BUILD_OUTPUT_HEX=y
CONFIG_SECOND_CORE_MCUX=y
```
