## CMakeLists.txt
```
cmake_minimum_required(VERSION 3.8.2)

include($ENV{ZEPHYR_BASE}/cmake/app/boilerplate.cmake NO_POLICY_SCOPE)
project(spi_flash_for_pca10056)

target_sources(app PRIVATE src/main.c)
```

## sample.yaml
```
sample:
  name: SPI Flash Sample for PCA10056
tests:
  test:
    platform_whitelist: nrf52840_pca10056
    tags: spi flash
    harness: console
    harness_config:
        type: multi_line
        ordered: true
        regex:
            - "Test 1: Flash erase"
            - "Flash erase succeeded!"
            - "Test 2: Flash write"
            - "Attempted to write 55 aa"
            - "Data read 55 aa"
            - "Data read matches with data written. Good!!"
    depends_on: spi
```

## prj.conf
```kconfig
CONFIG_STDOUT_CONSOLE=n
CONFIG_UART_CONSOLE=y

CONFIG_GPIO=y
CONFIG_SERIAL=y
CONFIG_UART_INTERRUPT_DRIVEN=y
CONFIG_UART_0_NRF_FLOW_CONTROL=n

CONFIG_SPI=y
CONFIG_SPI_2=y
CONFIG_SPI_NRFX=y
CONFIG_SPI_2_NRF_SPI=y

CONFIG_FLASH=y
CONFIG_SPI_FLASH_MX25R6435F=y
CONFIG_SPI_FLASH_MX25R6435F_SPI_NAME="SPI_2"
CONFIG_SPI_FLASH_MX25R6435F_DRV_NAME="spi_flash"
CONFIG_SPI_FLASH_MX25R6435F_INIT_PRIORITY=80
CONFIG_SPI_FLASH_MX25R6435F_SPI_FREQ_0=1000000
CONFIG_SPI_FLASH_MX25R6435F_SPI_SLAVE=0
CONFIG_SPI_FLASH_MX25R6435F_GPIO_SPI_CS=y
CONFIG_SPI_FLASH_MX25R6435F_GPIO_SPI_CS_DRV_NAME="GPIO_0"
CONFIG_SPI_FLASH_MX25R6435F_GPIO_SPI_CS_PIN=17
CONFIG_SPI_FLASH_MX25R6435F_GPIO_CS_WAIT_DELAY=1
CONFIG_SPI_FLASH_MX25R6435F_FLASH_SIZE=67108864
CONFIG_SPI_FLASH_MX25R6435F_DEVICE_ID=0x00c22817
```

## nrf52840_pca10056.overlay
```dts
&spi2 {
    status = "ok";
    sck-pin = <19>;
    mosi-pin = <20>;
    miso-pin = <21>;
};
```

## src/main.c
```c
/*
 * Copyright (c) 2018 Sigma Connectivity.
 *
 * SPDX-License-Identifier: Apache-2.0
 */

#include <zephyr.h>
#include <flash.h>
#include <gpio.h>
#include <device.h>
#include <stdio.h>

#define FLASH_TEST_REGION_OFFSET 0xff000
#define FLASH_SECTOR_SIZE        4096
#define TEST_DATA_BYTE_0         0x55
#define TEST_DATA_BYTE_1         0xaa
#define TEST_DATA_LEN            2

void main(void)
{
	struct device *flash_dev;
	u8_t buf[TEST_DATA_LEN];

	printk("\nMX25R6435F SPI flash testing\n");
	printk("==========================\n");

	flash_dev = device_get_binding(CONFIG_SPI_FLASH_MX25R6435F_DRV_NAME);

	if (!flash_dev) {
		printk("SPI flash driver was not found!\n");
		return;
	}

	/* Write protection needs to be disabled in MX25R6435F flash before
	 * each write or erase. This is because the flash component turns
	 * on write protection automatically after completion of write and
	 * erase operations.
	 */
	printk("\nTest 1: Flash erase\n");
	flash_write_protection_set(flash_dev, false);
	if (flash_erase(flash_dev,
			FLASH_TEST_REGION_OFFSET,
			FLASH_SECTOR_SIZE) != 0) {
		printk("   Flash erase failed!\n");
	} else {
		printk("   Flash erase succeeded!\n");
	}

	printk("\nTest 2: Flash write\n");
	flash_write_protection_set(flash_dev, false);

	buf[0] = TEST_DATA_BYTE_0;
	buf[1] = TEST_DATA_BYTE_1;
	printk("   Attempted to write %x %x\n", buf[0], buf[1]);
	if (flash_write(flash_dev, FLASH_TEST_REGION_OFFSET, buf,
			TEST_DATA_LEN) != 0) {
		printk("   Flash write failed!\n");
		return;
	}

	if (flash_read(flash_dev, FLASH_TEST_REGION_OFFSET, buf,
		       TEST_DATA_LEN) != 0) {
		printk("   Flash read failed!\n");
		return;
	}
	printk("   Data read %x %x\n", buf[0], buf[1]);

	if ((buf[0] == TEST_DATA_BYTE_0) && (buf[1] == TEST_DATA_BYTE_1)) {
		printk("   Data read matches with data written. Good!!\n");
	} else {
		printk("   Data read does not match with data written!!\n");
	}
}
```
