## CMakeLists.txt
```
# SPDX-License-Identifier: Apache-2.0

cmake_minimum_required(VERSION 3.28.0)
find_package(Zephyr REQUIRED HINTS $ENV{ZEPHYR_BASE})
project(fpga_controller)

target_sources(app PRIVATE src/main.c)
```

## sample.yaml
```
sample:
  name: FPGA Controller sample

common:
  tags: FPGA
  build_only: true

tests:
  sample.drivers.fpga_controller:
    platform_allow: quick_feather icev_wireless
  sample.drivers.fpga_controller.shell:
    platform_allow: quick_feather icev_wireless
    extra_args: CONF_FILE="prj_shell.conf"
```

## prj.conf
```kconfig
CONFIG_FPGA=y
CONFIG_EOS_S3_FPGA=y
```

## prj_shell.conf
```kconfig
CONFIG_SHELL=y
CONFIG_FPGA=y
CONFIG_EOS_S3_FPGA=y
CONFIG_FPGA_SHELL=y
CONFIG_SHELL_BACKEND_SERIAL_INTERRUPT_DRIVEN=n
CONFIG_BOOT_BANNER=n
```

## boards/icev_wireless.conf
```kconfig
CONFIG_LOG=y
CONFIG_FLASH=y
CONFIG_SHELL=y
CONFIG_SPI=y
CONFIG_PINCTRL=y
CONFIG_ICE40_FPGA=y
CONFIG_FPGA_SHELL=y
CONFIG_FLASH_PAGE_LAYOUT=y
CONFIG_HEAP_MEM_POOL_SIZE=16384
CONFIG_SHELL_BACKEND_SERIAL_INTERRUPT_DRIVEN=n
CONFIG_CRC=y
CONFIG_CRC_SHELL=y
```

## boards/quick_feather.conf
```kconfig
CONFIG_EOS_S3_FPGA=y
```

## src/main.c
```c
/*
 * Copyright (c) 2021 Antmicro <www.antmicro.com>
 *
 * SPDX-License-Identifier: Apache-2.0
 */

#include <zephyr/kernel.h>
#include <zephyr/shell/shell.h>
#include <zephyr/device.h>
#include <zephyr/sys/printk.h>
#include <zephyr/drivers/fpga.h>
#include "redled.h"
#include "greenled.h"
#include <eoss3_dev.h>

const struct device *const fpga = DEVICE_DT_GET(DT_NODELABEL(fpga0));

int main(void)
{
	IO_MUX->PAD_21_CTRL = (PAD_E_4MA | PAD_P_PULLDOWN | PAD_OEN_NORMAL |
			       PAD_SMT_DISABLE | PAD_REN_DISABLE | PAD_SR_SLOW |
			       PAD_CTRL_SEL_AO_REG); /* Enable red led */
	IO_MUX->PAD_22_CTRL = (PAD_E_4MA | PAD_P_PULLDOWN | PAD_OEN_NORMAL |
			       PAD_SMT_DISABLE | PAD_REN_DISABLE | PAD_SR_SLOW |
			       PAD_CTRL_SEL_AO_REG); /* Enable green led */

#if CONFIG_SHELL
	printk("Address of the bitstream (red): %p\n", &axFPGABitStream_red);
	printk("Address of the bitstream (green): %p\n", &axFPGABitStream_green);
	printk("Size of the bitstream (red): %d\n", sizeof(axFPGABitStream_red));
	printk("Size of the bitstream (green): %d\n", sizeof(axFPGABitStream_green));
#else

	if (!device_is_ready(fpga)) {
		printk("fpga device is not ready\n");
	}

	while (1) {
		fpga_load(fpga, axFPGABitStream_red,
			  sizeof(axFPGABitStream_red));
		k_msleep(2000);
		fpga_reset(fpga);
		fpga_load(fpga, axFPGABitStream_green,
			  sizeof(axFPGABitStream_green));
		k_msleep(2000);
		fpga_reset(fpga);
	}
#endif
	return 0;
}
```

## src/esp32.c
```c
#include <esp_spi_flash.h>
#include <soc.h>
#include <zephyr/init.h>
#include <zephyr/device.h>
#include <zephyr/drivers/flash.h>
#include <zephyr/kernel.h>
#include <zephyr/storage/flash_map.h>
#include <zephyr/sys/printk.h>

static int esp32_init(void)
{
	const void *vaddr = NULL;
	__unused esp_err_t esp_err;
	spi_flash_mmap_handle_t handle;
	size_t paddr = FIXED_PARTITION_OFFSET(scratch_partition);
	size_t size = FIXED_PARTITION_SIZE(scratch_partition);

	esp_err = spi_flash_mmap(paddr, size, SPI_FLASH_MMAP_DATA, &vaddr, &handle);
	if (esp_err != ESP_OK) {
		printk("failed to mmap %zx\n", paddr);
		return -EIO;
	}

	printk("esp32: mapped %zu@%zx to %p\n", size, paddr, vaddr);

	return 0;
}

SYS_INIT(esp32_init, POST_KERNEL, 42);
```
