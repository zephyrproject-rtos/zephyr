## samples/drivers/seu/sample.yaml
```yaml
sample:
  description: SEU subsystem sample application.
  name: seu_subsystem
tests:
  sample.subsys.seu:
    platform_allow:
      - intel_socfpga_agilex_socdk
      - intel_socfpga_agilex5_socdk
    integration_platforms:
      - intel_socfpga_agilex_socdk
      - intel_socfpga_agilex5_socdk
    tags:
      - seu
    harness: console
    harness_config:
      type: multi_line
      ordered: true
      regex:
        - "SEU Test Started"
        - "The Client No is [0-9]"
        - "The Client No is [0-9]"
        - "SEU Safe Error insert Test Started"
        - "The SEU Error Type: [0-9a-f]"
        - "The Sector Address: [0-9a-f]"
        - "The Correction status: [0-9a-f]"
        - "The bit position: [0-9a-f][0-9a-f]"
        - "SEU Safe Error insert Test Completed"
        - "The value of t_seu_cycle : [0-9a-f][0-9a-f][0-9a-f][0-9a-f][0-9a-f][0-9a-f][0-9a-f]
           [0-9a-f]"
        - "The value of t_seu_detect : [0-9a-f][0-9a-f][0-9a-f][0-9a-f][0-9a-f]"
        - "The value of t_seu_correct : [0-9a-f][0-9a-f][0-9a-f]"
        - "The value of t_seu_inject_detect : [0-9a-f][0-9a-f][0-9a-f][0-9a-f][0-9a-f][0-9a-f]
                [0-9a-f][0-9a-f]"
        - "The value of t_sdm_seu_poll_interval : [0-9a-f][0-9a-f][0-9a-f][0-9a-f][0-9a-f]"
        - "The value of t_sdm_seu_pin_toggle_overhead : [0-9a-f][0-9a-f][0-9a-f][0-9a-f]"
        - "Read SEU Statistics Test Completed"
        - "Read ECC Error Test Started"
        - "The ECC Error Type: [0-9a-f]"
        - "The Sector Address: [0-9a-f][0-9a-f][0-9a-f]"
        - "The Correction status: [0-9a-f]"
        - "Ram Id: [0-9a-f]"
        - "Read ECC Error Test Completed"
        - "SEU Test Completed"
```

## samples/drivers/sf32lb_codec/sample.yaml
```yaml
sample:
  description: sifli sf32lb onchip codec example
    application
  name: sf32lb_codec
common:
  min_ram: 2
  min_flash: 16
  tags: introduction
  integration_platforms:
    - sf32lb52_devkit_lcd
  harness: console
  harness_config:
    type: one_line
    regex:
      - "mic to speaker loopback"
tests:
  sample.basic.sf32lb_codec:
    tags: introduction
```

## samples/drivers/slcd/sample.yaml
```yaml
sample:
  description: SLCD sample
  name: SLCD sample
tests:
  sample.display.shield:
    # This test case is intended to verify support for shields on boards
    # known to support them. It is not intended to cover all combinations
    # of boards and shields, but rather serve as a method to test each
    # display shield within Zephyr
    filter: dt_chosen_enabled("zephyr,slcd_panel")
    harness: console
    harness_config:
      fixture: fixture_display
      type: one_line
      regex:
        - "SLCD sample started on device (.*)"
    extra_args:
      - platform:frdm_mcxa366/mcxa366:SHIELD=od_6010
```

## samples/drivers/smbus/sample.yaml
```yaml
sample:
  description: SMBus sample
  name: smbus sample
common:
  platform_allow:
    - qemu_x86_64/atom
    - intel_ehl_crb/elkhart_lake
    - intel_rpl_s_crb/raptor_lake
  harness: console
  harness_config:
    type: one_line
    regex:
      - "Start SMBUS shell sample"
tests:
  sample.drivers.smbus.shell:
    tags: smbus
```

## samples/drivers/soc_flash/sample.yaml
```yaml
sample:
  name: SoC Flash on STM32H747
tests:
  sample.drivers.flash.st.stm32-nv-flash:
    platform_allow:
      - stm32h747i_disco_m7
      - stm32h747i_disco_m4
    integration_platforms:
      - stm32h747i_disco_m7
      - stm32h747i_disco_m4
    tags:
      - flash
      - stm32h747
```

## samples/drivers/soc_flash_nrf/sample.yaml
```yaml
sample:
  name: SoC Flash on Nordic nRF52, nRF53, nrf54 and nRF91 series
tests:
  sample.drivers.flash.soc_flash_nrf:
    platform_allow:
      - nrf52dk/nrf52832
      - nrf9160dk/nrf9160
      - nrf9160dk/nrf9160/ns
      - nrf52840dk/nrf52840
      - nrf54h20dk/nrf54h20/cpuapp
      - nrf5340dk/nrf5340/cpuapp
      - nrf54l15dk/nrf54l15/cpuapp
    integration_platforms:
      - nrf52dk/nrf52832
      - nrf52840dk/nrf52840
      - nrf5340dk/nrf5340/cpuapp
      - nrf54h20dk/nrf54h20/cpuapp
      - nrf54l15dk/nrf54l15/cpuapp
    tags:
      - flash
      - drivers
    harness: console
    harness_config:
      fixture: external_flash
      type: multi_line
      ordered: true
      regex:
        - "Test 1: Internal storage erase page"
        - "Erase succeeded|Erase not required"
        - "Test 2: Internal storage write"
        - "Data read matches data written. Good!"
        - "Test 3: Internal storage erase"
        - "Erase succeeded|Erase not required"
        - "Test 4: Internal storage erase page at \\d+"
        - "Erase succeeded|Erase not required"
        - "Test 5: Non-word aligned write"
        - "Skipping unaligned write, not supported"
        - "Test 6: Page layout API"
        - "SoC flash consists of \\d+ pages"
        - "Test 7: Write block size API"
        - "write-block-size = \\d+"
        - "Finished!"

  sample.drivers.flash.soc_flash_nrf.one_byte_access:
    platform_allow:
      - nrf52dk/nrf52832
      - nrf9160dk/nrf9160/ns
      - nrf52840dk/nrf52840
      - nrf5340dk/nrf5340/cpuapp
    integration_platforms:
      - nrf52dk/nrf52832
      - nrf52840dk/nrf52840
      - nrf5340dk/nrf5340/cpuapp
    tags:
      - flash
      - drivers
    extra_configs:
      - CONFIG_SOC_FLASH_NRF_EMULATE_ONE_BYTE_WRITE_ACCESS=y
    harness: console
    harness_config:
      fixture: external_flash
      type: multi_line
      ordered: true
      regex:
        - "Test 1: Internal storage erase page"
        - "Erase succeeded|Erase not required"
        - "Test 2: Internal storage write"
        - "Data read matches data written. Good!"
        - "Test 3: Internal storage erase"
        - "Erase succeeded|Erase not required"
        - "Test 4: Internal storage erase page at \\d+"
        - "Erase succeeded|Erase not required"
        - "Test 5: Non-word aligned write"
        - "Data read matches data written. Good!"
        - "Test 6: Page layout API"
        - "SoC flash consists of \\d+ pages"
        - "Test 7: Write block size API"
        - "write-block-size = \\d+"
        - "Finished!"
```

## samples/drivers/soc_flash_nrf5/sample.yaml
```yaml
sample:
  name: SoC Flash on NRF52
tests:
  test:
    platform_whitelist: nrf52_pca10040
    tags: apps
```

## samples/drivers/soc_flash_qspi/sample.yaml
```yaml
sample:
  description: Cadence QSPI Driver sample application.
  name: cdns_qspi_nor
tests:
  sample.drivers.flash.soc_flash_qspi:
    platform_allow:
      - intel_socfpga_agilex5_socdk
    integration_platforms:
      - intel_socfpga_agilex5_socdk
    tags:
      - flash
      - cdns
    harness: console
    harness_config:
      fixture: external_flash
      type: multi_line
      ordered: true
      regex:
        - "QSPI flash driver test sample"
        - "QSPI flash device block size = 100"
        - "QSPI flash number of pages = 100000"
        - "QSPI flash driver block size 100"
        - "The Page size of 100"
        - "QSPI flash driver data erase sucessful...."
        - "QSPI flash driver write completed...."
        - "QSPI flash driver read completed...."
        - "QSPI flash driver read verified"
        - "QSPI flash driver data erase sucessful...."
        - "QSPI flash driver read verfied after erase...."
        - "QSPI flash driver test sample completed...."
```

## samples/drivers/spi_async/sample.yaml
```yaml
sample:
  description: SPI new vs legacy API comparison 
    application
  name: spi_async
```

## samples/drivers/spi_bitbang/boards/ek_ra8m1.conf
```kconfig
CONFIG_STDOUT_CONSOLE=y
CONFIG_SPI=y
CONFIG_SPI_B_INTERRUPT=y
CONFIG_SPI_B_RA_DTC=y

CONFIG_LOG=y
```

## samples/drivers/spi_bitbang/sample.yaml
```yaml
sample:
  name: SPI Bitbang Driver Sample
tests:
  sample.drivers.spi.bitbang:
    tags:
      - drivers
      - spi
      - gpio
    platform_allow: nrf52840dk/nrf52840
    depends_on: gpio
    harness: console
    harness_config:
      fixture: gpio_loopback
      type: multi_line
      ordered: true
      regex:
        - "basic_write_9bit_words; ret: 0"
        - "wrote 0101 00ff 00a5 0000 0102"
        - "9bit_loopback_partial; ret: 0"
        - "tx [(]i[)]  : 0101 0102"
        - "tx [(]ii[)] : 0003 0004 0105"
        - "rx [(]ii[)] : 0003 0004 0105"
        - "8bit_loopback_partial; ret: 0"
        - "tx [(]i[)]  : 01 02 03 04 05"
        - "rx [(]i[)]  : 01 02 03 04 05"
```

## samples/drivers/spi_flash/boards/actinius_icarus_bee.conf
```kconfig
#
# Copyright (c) 2021 Actinius
#
# SPDX-License-Identifier: Apache-2.0
#

CONFIG_SPI_NOR=y
```

## samples/drivers/spi_flash/boards/adafruit_feather_nrf52840.conf
```kconfig
#
# Copyright (c) 2020 Teslabs Engineering S.L.
#
# SPDX-License-Identifier: Apache-2.0
#

CONFIG_NORDIC_QSPI_NOR=y
```

## samples/drivers/spi_flash/boards/adafruit_feather_stm32f405.conf
```kconfig
#
# Copyright (c) 2020 Richard Osterloh <richard.osterloh@gmail.com>
#
# SPDX-License-Identifier: Apache-2.0
#

CONFIG_SPI_NOR=y
```

## samples/drivers/spi_flash/boards/arduino_nicla_sense_me.conf
```kconfig
# Copyright (c) 2022 Benjamin Björnsson <benjamin.bjornsson@gmail.com>.

# SPDX-License-Identifier: Apache-2.0

CONFIG_SPI_NOR=y
```

## samples/drivers/spi_flash/boards/black_f407ve.conf
```kconfig
# Copyright (c) 2019 Peter Bigot Consulting, LLC
# Copyright (c) 2020 Bjarne Steinsbo

# SPDX-License-Identifier: Apache-2.0

CONFIG_SPI_NOR=y
```

## samples/drivers/spi_flash/boards/circuitdojo_feather_nrf9160.conf
```kconfig
#
# Copyright (c) 2020 Circuit Dojo LLC
#
# SPDX-License-Identifier: Apache-2.0
#

CONFIG_SPI_NOR=y
```

## samples/drivers/spi_flash/boards/efr32mg_sltb004a.conf
```kconfig
#
# Copyright (c) 2020 Lemonbeat GmbH
#
# SPDX-License-Identifier: Apache-2.0
#

CONFIG_SPI_NOR=y
```

## samples/drivers/spi_flash/boards/em_starterkit_emsk_em9d.conf
```kconfig
#
# Copyright (c) 2023 Synopsys.
#
# SPDX-License-Identifier: Apache-2.0
#

CONFIG_SPI_NOR=y
```

## samples/drivers/spi_flash/boards/gd32a503v_eval.conf
```kconfig
#
# Copyright (c) 2022 YuLong Yao <feilongphone@gmail.com>
#
# SPDX-License-Identifier: Apache-2.0
#

CONFIG_GPIO=y
CONFIG_SPI_NOR=y
```

## samples/drivers/spi_flash/boards/gd32f450i_eval.conf
```kconfig
#
# Copyright (c) 2022 BrainCo Inc.
#
# SPDX-License-Identifier: Apache-2.0
#

CONFIG_SPI_NOR=y
CONFIG_SPI_GD32_DMA=y
```

## samples/drivers/spi_flash/boards/mec172xevb_assy6906_mec172x_nsz.conf
```kconfig
#
# Copyright (c) 2022 Microchip Technology Inc.
#
# SPDX-License-Identifier: Apache-2.0
#

CONFIG_SPI_NOR=y
```
