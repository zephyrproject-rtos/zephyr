## CMakeLists.txt
```
# Copyright The Zephyr Project Contributors
# SPDX-License-Identifier: Apache-2.0

cmake_minimum_required(VERSION 3.20.0)
find_package(Zephyr REQUIRED HINTS $ENV{ZEPHYR_BASE})
project(fan_speed)

target_sources(app PRIVATE src/main.c)
```

## prj.conf
```kconfig
CONFIG_FAN=y
CONFIG_PRINTK=y
CONFIG_LOG=y
```

## boards/b_u585i_iot02a.conf
```kconfig
# Copyright The Zephyr Project Contributors
# SPDX-License-Identifier: Apache-2.0

CONFIG_GPIO=y
CONFIG_FAN_PWM_TACHOMETER=y
CONFIG_FAN_PWM_TACHOMETER_POLL=y
```

## boards/b_u585i_iot02a.overlay
```dts
/*
 * Copyright The Zephyr Project Contributors
 *
 * SPDX-License-Identifier: Apache-2.0
 */

#include <zephyr/dt-bindings/gpio/gpio.h>
#include <zephyr/dt-bindings/pwm/pwm.h>

/ {
	fan0: fan {
		compatible = "fan-pwm";
		status = "okay";
		/* TIM4 channel 1 (PB6), 25 kHz drive frequency. */
		pwms = <&pwm4 1 PWM_KHZ(25) PWM_POLARITY_NORMAL>;
		/* Tachometer feedback on Arduino D2 (PD15), open-collector. */
		tach-gpios = <&gpiod 15 GPIO_PULL_UP>;
		pulses-per-revolution = <2>;
	};

	aliases {
		fan0 = &fan0;
	};
};
```

## src/main.c
```c
/*
 * Copyright The Zephyr Project Contributors
 *
 * SPDX-License-Identifier: Apache-2.0
 */

#include <zephyr/device.h>
#include <zephyr/drivers/fan.h>
#include <zephyr/kernel.h>
#include <zephyr/sys/printk.h>

#define FAN_NODE DT_ALIAS(fan0)
BUILD_ASSERT(DT_NODE_HAS_STATUS_OKAY(FAN_NODE),
	     "No default fan specified in DT (add `aliases { fan0 = ... };`)");

/* Speed steps, as a percentage of full speed, to cycle through. */
static const uint8_t speed_steps[] = {0U, 25U, 50U, 75U, 100U};

int main(void)
{
	const struct device *fan = DEVICE_DT_GET(FAN_NODE);

	if (!device_is_ready(fan)) {
		printk("Fan device %s not ready\n", fan->name);
		return 0;
	}

	while (1) {
		for (size_t i = 0; i < ARRAY_SIZE(speed_steps); i++) {
			uint8_t percent = speed_steps[i];
			uint32_t rpm;
			int ret;

			ret = fan_set_speed(fan, percent);
			if (ret < 0) {
				printk("Failed to set fan speed to %u%% (%d)\n", percent, ret);
				continue;
			}

			printk("Fan speed set to %u%%\n", percent);

			/* Give the fan a moment to reach the new speed. */
			k_sleep(K_SECONDS(2));

			ret = fan_get_rpm(fan, &rpm);
			if (ret == 0) {
				printk("Measured speed: %u RPM\n", rpm);
			} else if (ret == -ENOSYS) {
				printk("Tachometer read not supported\n");
			} else {
				printk("Failed to read fan RPM (%d)\n", ret);
			}
		}
	}
	return 0;
}
```
