/*
 * SPDX-License-Identifier: Apache-2.0
 *
 * Copyright (c) 2022 STMicroelectronics
 */

&pwmleds {
	/* NOTE: enable here because it is disabled by default */
	status = "okay";
};

&pwm2 {
	status = "okay";
};
