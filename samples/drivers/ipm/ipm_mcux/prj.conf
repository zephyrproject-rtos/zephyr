## CMakeLists.txt
```
cmake_minimum_required(VERSION 3.28.0)
# Copyright (c) 2017-2022, NXP
#
# SPDX-License-Identifier: Apache-2.0
#
set(REMOTE_ZEPHYR_DIR ${CMAKE_CURRENT_BINARY_DIR}/../ipm_mcux_remote/zephyr)

find_package(Zephyr REQUIRED HINTS $ENV{ZEPHYR_BASE})

message(STATUS "${BOARD} compile as Master in this sample")
project(ipm_mcux)

enable_language(C ASM)

if(CONFIG_INCLUDE_REMOTE_DIR)
  target_include_directories(zephyr_interface
    INTERFACE ${REMOTE_ZEPHYR_DIR}/include/public)
endif()

target_sources(app PRIVATE src/main_master.c)

target_include_directories(app PRIVATE ${CMAKE_CURRENT_SOURCE_DIR})
```

## Kconfig.sysbuild
```
# Copyright 2022 NXP
#
# SPDX-License-Identifier: Apache-2.0

source "share/sysbuild/Kconfig"

config IPM_REMOTE_BOARD
string
	default "lpcxpresso54114/lpc54114/m0" if $(BOARD) = "lpcxpresso54114"
	default "lpcxpresso55s69/lpc55s69/cpu1" if $(BOARD) = "lpcxpresso55s69"
```

## sample.yaml
```
sample:
  description: Sample app that sends messages between the two cores on the lpcxpresso54114
    using a mailbox.
  name: IPM MCUX Mailbox Sample
tests:
  sample.drivers.ipm.ipm_mcux:
    platform_allow:
      - lpcxpresso54114/lpc54114/m4
      - lpcxpresso55s69/lpc55s69/cpu0
    integration_platforms:
      - lpcxpresso54114/lpc54114/m4
    tags: ipm
    harness: console
    sysbuild: true
    harness_config:
      type: multi_line
      regex:
        - "Hello World from MASTER! (.*)"
        - "Received: 1"
        - "Received: 20"
```

## prj.conf
```kconfig
CONFIG_PRINTK=y
CONFIG_IPM=y
CONFIG_SECOND_CORE_MCUX=y
CONFIG_TIMESLICE_SIZE=1
CONFIG_MAIN_STACK_SIZE=2048
```

## boards/lpcxpresso54114_lpc54114_m4.conf
```kconfig
CONFIG_INCLUDE_REMOTE_DIR=y
```

## src/main_master.c
```c
/*
 * Copyright (c) 2018, NXP
 *
 * SPDX-License-Identifier: Apache-2.0
 */

#include <zephyr/kernel.h>
#include <zephyr/sys/printk.h>
#include <zephyr/device.h>
#include <zephyr/drivers/ipm.h>

int gcounter;

void ping_ipm_callback(const struct device *dev, void *context,
		       uint32_t id, volatile void *data)
{
	gcounter = *(int *)data;
	/* Show current ping-pong counter value */
	printk("Received: %d\n", gcounter);
	/* Increment on our side */
	gcounter++;
	if (gcounter < 100) {
		/* Send back to the other core */
		ipm_send(dev, 1, 0, &gcounter, 4);
	}
}

int main(void)
{
	int first_message = 1; /* do not start from 0,
				* zero value can't be sent via mailbox register
				*/
	const struct device *ipm;

	printk("Hello World from MASTER! %s\n", CONFIG_ARCH);

	/* Get IPM device handle */
	ipm = DEVICE_DT_GET_ANY(nxp_lpc_mailbox);
	if (!(ipm && device_is_ready(ipm))) {
		printk("Could not get IPM device handle!\n");
		while (1) {
		}
	}

	/* Register application callback with no context */
	ipm_register_callback(ipm, ping_ipm_callback, NULL);
	/* Enable the IPM device */
	ipm_set_enabled(ipm, 1);

	/* Send initial message with 4 bytes length*/
	ipm_send(ipm, 1, 0, &first_message, 4);
	while (1) {
	}
	return 0;
}
```
