## CMakeLists.txt
```
# SPDX-License-Identifier: Apache-2.0

cmake_minimum_required(VERSION 3.28.0)

set(REMOTE_ZEPHYR_DIR ${CMAKE_CURRENT_BINARY_DIR}/../ipm_esp32_remote/zephyr)

find_package(Zephyr REQUIRED HINTS $ENV{ZEPHYR_BASE})

message(STATUS "${BOARD} compile as Master in this sample")
project(ipm_esp32)

target_sources(app PRIVATE src/main.c src/procpu_shell.c)
```

## Kconfig.sysbuild
```
# Copyright 2022 NXP
#
# SPDX-License-Identifier: Apache-2.0

source "share/sysbuild/Kconfig"
```

## sample.yaml
```
sample:
  name: ESP32 IPM Sample
tests:
  sample.ipm.ipm_esp32:
    platform_allow:
      - esp32_devkitc/esp32/procpu
    tags:
      - samples
      - ipm
```

## prj.conf
```kconfig
CONFIG_IPM=y
CONFIG_LOG=y
```

## boards/esp32_devkitc_wroom.conf
```kconfig
CONFIG_SOC_ESP32_PROCPU=y
```

## boards/esp32s3_devkitm.conf
```kconfig
CONFIG_SOC_ESP32S3_PROCPU=y
```

## boards/esp32_devkitc_wroom_procpu.overlay
```dts
&ipm0 {
    status = "okay";
};
```

## boards/yd_esp32_procpu.overlay
```dts
&ipm0 {
	status = "okay";
};
```

## src/main.c
```c
/*
 * Copyright (c) 2022 Espressif Systems (Shanghai) Co., Ltd.
 *
 * SPDX-License-Identifier: Apache-2.0
 */

#include <zephyr/kernel.h>
#include <zephyr/sys/printk.h>
#include <zephyr/drivers/ipm.h>
#include <zephyr/device.h>
#include <string.h>

static const char request[] = {"PRO_CPU: request to APP_CPU"};

static const struct device *ipm_dev;
static char received_string[64];
static struct k_sem sync;

static void ipm_receive_callback(const struct device *ipmdev, void *user_data, uint32_t id,
				 volatile void *data)
{
	ARG_UNUSED(ipmdev);
	ARG_UNUSED(user_data);

	strncpy(received_string, (const char *)data, sizeof(received_string));
	k_sem_give(&sync);
}

int main(void)
{
	int ret;

	k_sem_init(&sync, 0, 1);

	ipm_dev = DEVICE_DT_GET(DT_NODELABEL(ipm0));
	if (!ipm_dev) {
		printk("Failed to get IPM device.\n\r");
		return 0;
	}

	ipm_register_callback(ipm_dev, ipm_receive_callback, NULL);

	/* Workaround to catch up with APPCPU */
	k_sleep(K_MSEC(50));

	while (1) {
		printk("PRO_CPU is sending a request, waiting remote response...\n\r");

		ipm_send(ipm_dev, -1, sizeof(request), &request, sizeof(request));

		ret = k_sem_take(&sync, K_MSEC(5000));

		if (ret) {
			printk("No response from APP_CPU - trying again.\r\n");
		} else {
			printk("PRO_CPU received a message from APP_CPU : %s\n\r", received_string);
		}

		k_sleep(K_MSEC(1000));
	}
	return 0;
}
```

## src/procpu_shell.c
```c
/*
 * Copyright (c) 2024 Espressif Systems (Shanghai) Co., Ltd.
 *
 * SPDX-License-Identifier: Apache-2.0
 */

#if defined(CONFIG_IPM) || defined(CONFIG_MBOX)

#include <stdlib.h>

#include <zephyr/device.h>
#include <zephyr/shell/shell.h>
#include <zephyr/sys/printk.h>

/* Command usage info. */
#define START_HELP ("<cmd>\n\nStart the APPCPU")
#define STOP_HELP  ("<cmd>\n\nStop the APPCPU")

void esp_appcpu_image_start(unsigned int hdr_offset);
void esp_appcpu_image_stop(void);

static int cmd_appcpu_start(const struct shell *sh, size_t argc, char *argv[])
{
	ARG_UNUSED(sh);
	ARG_UNUSED(argc);
	ARG_UNUSED(argv);

	printk("start appcpu\n");

	esp_appcpu_image_start(0x20);

	return 0;
}

static int cmd_appcpu_stop(const struct shell *sh, size_t argc, char *argv[])
{
	ARG_UNUSED(sh);
	ARG_UNUSED(argc);
	ARG_UNUSED(argv);

	printk("stop appcpu\n");

	esp_appcpu_image_stop();

	return 0;
}

SHELL_STATIC_SUBCMD_SET_CREATE(sub_amp,
			       /* Alphabetically sorted to ensure correct Tab autocompletion. */
			       SHELL_CMD_ARG(appstart, NULL, START_HELP, cmd_appcpu_start, 1, 0),
			       SHELL_CMD_ARG(appstop, NULL, STOP_HELP, cmd_appcpu_stop, 1, 0),
			       SHELL_SUBCMD_SET_END /* Array terminated. */
);

SHELL_CMD_REGISTER(amp, &sub_amp, "AMP debug commands.", NULL);
#endif
```
