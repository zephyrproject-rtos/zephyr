/*
 * Copyright (c) 2019, Nordic Semiconductor ASA
 *
 * SPDX-License-Identifier: Apache-2.0
 */

#include <zephyr/dt-bindings/gpio/gpio.h>
#include <zephyr/dt-bindings/led/led.h>

/ {
	led_strip: ws2812 {
		compatible = "worldsemi,ws2812-gpio";

		chain-length = <16>; /* arbitrary */
		color-mapping = <LED_COLOR_ID_GREEN
				 LED_COLOR_ID_RED
				 LED_COLOR_ID_BLUE>;
		/*
		 * Arduino D11 / P0.25, which was chosen to match the pin
		 * used in nrf52dk_nrf52832.overlay.
		 */
		gpios = <&gpio0 25 0>;
	};

	aliases {
		led-strip = &led_strip;
	};
};
