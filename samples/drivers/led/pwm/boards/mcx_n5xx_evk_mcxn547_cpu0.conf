## samples/drivers/led/pwm/boards/mr_canhubk3.conf
```kconfig
# Copyright 2023 NXP
# SPDX-License-Identifier: Apache-2.0

# Due to gpio-leds and pwm-leds are the same RGB LEDs so should not be used
# at the same time, need to disable this config when using pwm-leds.
CONFIG_LED_GPIO=n
```

## samples/drivers/led/pwm/boards/rpi_pico.conf
```kconfig
CONFIG_BLINK_DURATION_SHORT=20
CONFIG_BLINK_DURATION_LONG=65
CONFIG_FADE_DELAY=15
```

## samples/drivers/led/pwm/sample.yaml
```yaml
sample:
  description: Demonstration of the PWM LED driver
  name: PWM LED sample
tests:
  sample.drivers.led.led_pwm:
    filter: dt_compat_enabled("pwm-leds")
    tags: LED
    depends_on: pwm
    platform_exclude: reel_board
    timeout: 20
    harness: console
    harness_config:
      type: multi_line
      ordered: true
      regex:
        - "Testing LED \\d+"
        - "Turned on"
        - "Turned off"
        - "Increasing brightness gradually"
        - "Blinking on: ([0-9]+) msec, off: ([0-9]+) msec"
        - "(Blinking on: ([0-9]+) msec, off: ([0-9]+) msec|Cycle period not supported)"
        - "Turned off, loop end"
```

## samples/drivers/led/sct2024/sample.yaml
```yaml
sample:
  description: Demonstration of the SCT2024 LED driver
  name: SCT2024 sample
tests:
  sample.drivers.led.sct2024:
    tags: led
    harness: TBD
    platform_allow: nrf52840dk/nrf52840
    integration_platforms:
      - nrf52840dk/nrf52840
```

## samples/drivers/led/tlc59116/sample.yaml
```yaml
sample:
  description: Demonstration of the TLC59116 LED driver
  name: TLC59116 sample
tests:
  sample.drivers.led.tlc59116:
    platform_allow: nrf52840dk/nrf52840
    tags: led
    harness: console
    harness_config:
      fixture: fixture_led_tlc59116
      type: multi_line
      ordered: true
      regex:
        - "Found LED device"
        - "Testing 16 LEDs"
```

## samples/drivers/led_apa102/boards/nucleo_l432kc.conf
```kconfig
CONFIG_POLL=y
CONFIG_SPI=y

CONFIG_OPENOCD_SUPPORT=y
CONFIG_SPI_STM32=y
CONFIG_SPI_STM32_INTERRUPT=y
CONFIG_SPI_1=y

CONFIG_LED_STRIP=y
CONFIG_APA102_STRIP=y
```

## samples/drivers/led_apa102/sample.yaml
```yaml
sample:
  description: Demonstration of the APA102 LED strip driver
  name: APA102 sample
tests:
  sample.drivers.led.apa102:
    platform_allow: nucleo_l432kc
    tags: LED
    depends_on: spi
```

## samples/drivers/led_apa102c/sample.yaml
```yaml
sample:
  name: Utilize APA102C LED on Arduino 101
tests:
  test:
    platform_whitelist: arduino_101
    tags: LED
    depends_on: gpio
```

## samples/drivers/led_apa102c_bitbang/sample.yaml
```yaml
sample:
  name: Utilize APA102C LED
tests:
  sample.drivers.led.apa102c_bitbang:
    tags: LED
    filter: dt_alias_exists("gpio-0")
    pre-filter: subsys_dt_compat_enabled("gpio")
```

## samples/drivers/led_gpio/sample.yaml
```yaml
sample:
  name: LED GPIO driver sample
  description: Demonstration of the LED GPIO driver
tests:
  sample.drivers.led.gpio:
    tags: LED gpio
    depends_on: gpio
    harness: led
    platform_whitelist: nrf52840_pca10056
```

## samples/drivers/led_is31fl3194/sample.yaml
```yaml
sample:
  description: Demonstration of the IS31FL3194 LED driver
  name: is31fl3194 sample
tests:
  sample.drivers.led.is31fl3194:
    filter: dt_compat_enabled("issi,is31fl3194")
    tags: LED
    depends_on: i2c
    integration_platforms:
      - arduino_nicla_sense_me
```

## samples/drivers/led_lp3943/sample.yaml
```yaml
sample:
  description: Demonstration of the LP3943 LED driver
  name: LP3943 sample
tests:
  sample.drivers.led.lp3943:
    platform_allow:
      - 96b_neonkey/stm32f411xe
      - 96b_argonkey/stm32f412cx
    integration_platforms:
      - 96b_argonkey/stm32f412cx
    tags: LED
```

## samples/drivers/led_lp5018/sample.yaml
```yaml
# Copyright (c) 2023 Kistler Instrumente AG
# SPDX-License-Identifier: Apache-2.0

sample:
  description: Demonstration of the LP5018 LED driver
  name: LP5018 sample
tests:
  sample.drivers.led.lp5018:
    platform_allow: stm32h747i_disco_m7
    filter: dt_compat_enabled("ti,lp5018")
    tags: LED
    depends_on: i2c
```

## samples/drivers/led_lp503x/sample.yaml
```yaml
sample:
  description: Demonstration of the LP503x LED driver
  name: LP503x sample
tests:
  sample.drivers.led.lp503x:
    filter: dt_compat_enabled("ti,lp503x")
    tags: LED
    depends_on: i2c
```

## samples/drivers/led_lp50xx/sample.yaml
```yaml
sample:
  description: Demonstration of the LP50xx LED driver
  name: LP50xx sample
tests:
  sample.drivers.led.lp50xx:
    filter: dt_compat_enabled("ti,lp50xx")
    tags: LED
    depends_on: i2c
```

## samples/drivers/led_lp5521/sample.yaml
```yaml
# Copyright (c) 2024 Croxel, Inc.
# SPDX-License-Identifier: Apache-2.0
sample:
  description: Demonstration of the LP5521 LED driver
  name: LP5521 sample
tests:
  sample.drivers.led.lp5521:
    platform_allow: croxel_cx1825/nrf52840
    tags: led
```

## samples/drivers/led_lp5562/sample.yaml
```yaml
sample:
  description: Demonstration of the LP5562 LED driver
  name: LP5562 sample
tests:
  sample.driver.led_lp5562:
    platform_whitelist: nrf52840_pca10056
    tags: led
    harness: TBD
```

## samples/drivers/led_lp5569/sample.yaml
```yaml
sample:
  description: Demonstration of the LP5569 LED driver
  name: LP5569 sample
tests:
  sample.drivers.led.lp5569:
    platform_allow: nrf52840dk_nrf52840
    tags: led
```

## samples/drivers/led_lpd8806/sample.yaml
```yaml
sample:
  description: Demonstration of the lpd880x LED driver
  name: LPD880x sample
tests:
  sample.drivers.led.lpd8806:
    platform_allow: 96b_carbon/stm32f401xe
    tags: LED
```
