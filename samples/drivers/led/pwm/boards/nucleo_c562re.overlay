/*
 * SPDX-License-Identifier: Apache-2.0
 * SPDX-FileCopyrightText: Copyright (c) 2026 TOKITA Hiroshi
 */

/ {
	leds {
		status = "disabled";
	};

	pwmleds {
		status = "okay";
	};
};

&pwm1 {
	status = "okay";
};
