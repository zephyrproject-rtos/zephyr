/*
 * SPDX-FileCopyrightText: Copyright The Zephyr Project Contributors
 * SPDX-License-Identifier: Apache-2.0
 */

/ {
	leds {
		status = "disabled";
	};

	pwm_leds {
		status = "okay";
	};
};

&pwm {
	divider-frac-4 = <15>;
	divider-int-4 = <255>;
	status = "okay";
};
