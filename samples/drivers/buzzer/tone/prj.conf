## CMakeLists.txt
```
# Copyright (c) 2026 Carlo Caione <ccaione@baylibre.com>
# SPDX-License-Identifier: Apache-2.0

cmake_minimum_required(VERSION 3.28.0)
find_package(Zephyr REQUIRED HINTS $ENV{ZEPHYR_BASE})
project(buzzer_tone)

target_sources(app PRIVATE src/main.c)
```

## sample.yaml
```
sample:
  name: Buzzer Tone
  description: |
    Plays a short beep and a few tones through the buzzer device aliased as `buzzer0`. Suitable
    for boards that expose a passive piezo via the pwm-buzzer compatible or an active buzzer via
    gpio-buzzer.
common:
  platform_type:
    - mcu
  tags:
    - drivers
    - buzzer
  filter: dt_alias_exists("buzzer0")
tests:
  sample.drivers.buzzer.tone:
    harness: buzzer
```

## prj.conf
```kconfig
CONFIG_BUZZER=y
CONFIG_PRINTK=y
CONFIG_LOG=y
```

## boards/bbc_microbit_v2.overlay
```dts
/*
 * Test overlay for the BBC micro:bit V2's on-board piezo speaker.
 */

/ {
	buzzer_pwm: buzzer_pwm {
		compatible = "pwm-buzzer";
		pwms = <&pwm1 0 PWM_HZ(2700) PWM_POLARITY_NORMAL>;
	};

	aliases {
		buzzer = &buzzer_pwm;
	};
};
```

## src/main.c
```c
/*
 * Copyright (c) 2026 Carlo Caione <ccaione@baylibre.com>
 *
 * SPDX-License-Identifier: Apache-2.0
 */

#include <zephyr/device.h>
#include <zephyr/drivers/buzzer.h>
#include <zephyr/kernel.h>
#include <zephyr/sys/printk.h>

#define BUZZER_NODE DT_ALIAS(buzzer0)
BUILD_ASSERT(DT_NODE_HAS_STATUS_OKAY(BUZZER_NODE),
	     "No default buzzer specified in DT (add `aliases { buzzer0 = ... };`)");

#define TONE_C5_HZ 523U
#define TONE_E5_HZ 659U
#define TONE_G5_HZ 784U

int main(void)
{
	const struct device *buzzer = DEVICE_DT_GET(BUZZER_NODE);

	if (!device_is_ready(buzzer)) {
		printk("Buzzer device %s not ready\n", buzzer->name);
		return 0;
	}

	buzzer_set_volume(buzzer, 50);

	while (1) {
		printk("Attention beep\n");
		buzzer_beep(buzzer, 150);
		k_sleep(K_MSEC(400));

		printk("Playing tones\n");
		buzzer_tone(buzzer, TONE_C5_HZ, 200);
		k_sleep(K_MSEC(280));
		buzzer_tone(buzzer, TONE_E5_HZ, 200);
		k_sleep(K_MSEC(280));
		buzzer_tone(buzzer, TONE_G5_HZ, 400);
		k_sleep(K_MSEC(480));

		k_sleep(K_SECONDS(3));
	}
	return 0;
}
```
