/*
 * Test overlay for the BBC micro:bit V2's on-board piezo speaker.
 */

/ {
	buzzer_pwm: buzzer_pwm {
		compatible = "pwm-buzzer";
		pwms = <&pwm1 0 PWM_HZ(2700) PWM_POLARITY_NORMAL>;
	};

	aliases {
		buzzer0 = &buzzer_pwm;
	};
};
