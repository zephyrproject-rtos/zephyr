## CMakeLists.txt
```
# SPDX-License-Identifier: Apache-2.0

cmake_minimum_required(VERSION 3.13.1)
include($ENV{ZEPHYR_BASE}/cmake/app/boilerplate.cmake NO_POLICY_SCOPE)
project(uart_async)

FILE(GLOB app_sources src/*.c)
target_sources(app PRIVATE ${app_sources})
```

## prj.conf
```kconfig
#Enable async UART support
CONFIG_UART_ASYNC_API=y

#Enable log on UART
CONFIG_THREAD_NAME=y
CONFIG_LOG=y
CONFIG_LOG_BACKEND_UART=y
CONFIG_LOG_BACKEND_SHOW_COLOR=y
## Enable debug log level
CONFIG_LOG_DEFAULT_LEVEL=4

## Enable shell
CONFIG_SHELL=y
CONFIG_PRINTK=y
```

## src/main.c
```c
/*
 * Copyright 2019 Intel Corporation
 * SPDX-License-Identifier: Apache-2.0
 */

#include <zephyr.h>
#include <sys/printk.h>
#include <drivers/uart.h>
#include <string.h>
#include <kernel.h>

#define ASYNC_BUF_SZ 128

static struct main_data {
	struct device *uart_dev;
	uint8_t rx_buf[ASYNC_BUF_SZ];
	uint8_t tx_buf[ASYNC_BUF_SZ];
	struct k_sem tx_sem;
} _main_data;

static void uart_async_callback(struct uart_event *evt, void *priv_data)
{
	struct main_data *data = priv_data;

	if (evt->type == UART_TX_DONE) {
		printk("TX done: %d\n", evt->data.tx.len);
		memset(data->tx_buf, 0, sizeof(data->tx_buf));

	} else if (evt->type == UART_RX_RDY) {
		uint8_t *src_buf = evt->data.rx.buf
				+ evt->data.rx.offset;
		memcpy(data->tx_buf, src_buf, evt->data.rx.len);
		printk("RX done: %d - %s\n", evt->data.rx.len, data->tx_buf);
		if (evt->data.rx.len > 0) {
			k_sem_give(&data->tx_sem);
		}
	}
}

int main(void)
{
	uint32_t version = sys_kernel_version_get();

	printk(
		"UART-Async API Echo ARCH: %s, BOARD: %s, version: %d.%d.%d\n",
		CONFIG_ARCH, CONFIG_BOARD,
		SYS_KERNEL_VER_MAJOR(version),
		SYS_KERNEL_VER_MINOR(version),
		SYS_KERNEL_VER_PATCHLEVEL(version));

	struct device *uart = device_get_binding("UART_6");

	if (uart == NULL) {
		printk("UART open failed!\n");
		return -1;
	}

	struct main_data *data = &_main_data;

	data->uart_dev = uart;

	uint8_t *buf = data->rx_buf;

	memset(buf, 0, sizeof(ASYNC_BUF_SZ));


	uart_callback_set(uart, uart_async_callback, data);
	k_sem_init(&data->tx_sem, 0, 1);

	/* start rx */
	uart_rx_enable(uart, buf, ASYNC_BUF_SZ, K_FOREVER.ticks);
	while (1) {
		k_sem_take(&data->tx_sem, K_FOREVER);
		int len = strlen(data->tx_buf);

		if (len > 0) {
			uart_tx(data->uart_dev, data->tx_buf,
					len, K_FOREVER.ticks);
		}
	}

	return 0;
}
```
