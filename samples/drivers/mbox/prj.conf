## CMakeLists.txt
```
#
# Copyright (c) 2021 Carlo Caione <ccaione@baylibre.com>
# Copyright 2023-2026 NXP
# Copyright 2025 Ezurio LLC
#
# SPDX-License-Identifier: Apache-2.0
#

cmake_minimum_required(VERSION 3.28.0)

find_package(Zephyr REQUIRED HINTS $ENV{ZEPHYR_BASE})

set(REMOTE_ZEPHYR_DIR ${CMAKE_CURRENT_BINARY_DIR}/../remote/zephyr)

if(CONFIG_BOARD_ADP_XC7K_AE350_A25 OR
   CONFIG_BOARD_BL54L15_DVK_NRF54L15_CPUAPP OR
   CONFIG_BOARD_EK_RA8P1_R7KA8P1KFLCAC_CM85 OR
   CONFIG_BOARD_ESP32C6_DEVKITC_ESP32C6_HPCORE OR
   CONFIG_BOARD_ESP32P4X_FUNCTION_EV_BOARD_ESP32P4_HPCORE OR
   CONFIG_BOARD_ESP32S3_DEVKITC_ESP32S3_PROCPU OR
   CONFIG_BOARD_ESP32_DEVKITC_ESP32_PROCPU OR
   CONFIG_BOARD_FRDM_IMXRT1186_MIMXRT1186_CM33 OR
   CONFIG_BOARD_FRDM_IMXRT700_MIMXRT798S_CM33_CPU0 OR
   CONFIG_BOARD_FRDM_MCXN947_MCXN947_CPU0 OR
   CONFIG_BOARD_IMX943_EVK_MIMX94398_M33 OR
   CONFIG_BOARD_IMX943_EVK_MIMX94398_M7_0 OR
   CONFIG_BOARD_IMX943_EVK_MIMX94398_M7_1 OR
   CONFIG_BOARD_LPCXPRESSO55S69_LPC55S69_CPU0 OR
   CONFIG_BOARD_MCX_N9XX_EVK_MCXN947_CPU0 OR
   CONFIG_BOARD_MIMXRT1160_EVK_MIMXRT1166_CM7 OR
   CONFIG_BOARD_MIMXRT1170_EVK_MIMXRT1176_CM7 OR
   CONFIG_BOARD_MIMXRT1180_EVK_MIMXRT1189_CM33 OR
   CONFIG_BOARD_MIMXRT700_EVK_MIMXRT798S_CM33_CPU0 OR
   CONFIG_BOARD_NRF5340BSIM_NRF5340_CPUAPP OR
   CONFIG_BOARD_NRF5340DK_NRF5340_CPUAPP OR
   CONFIG_BOARD_NRF54H20DK_NRF54H20_CPUAPP OR
   CONFIG_BOARD_NRF54L15DK_NRF54L15_CPUAPP OR
   CONFIG_BOARD_NRF54LM20DK_NRF54LM20A_CPUAPP OR
   CONFIG_BOARD_NRF54LM20DK_NRF54LM20B_CPUAPP OR
   CONFIG_BOARD_NRF54LV10DK_NRF54LV10A_CPUAPP OR
   CONFIG_BOARD_NRF7120DK_NRF7120_CPUAPP OR
   CONFIG_BOARD_NRF7120DK_NRF7120E_CPUAPP OR
   CONFIG_BOARD_NUCLEO_H755ZI_Q_STM32H755XX_M7 OR
   CONFIG_BOARD_SK_AM62_AM6254_A53 OR
   CONFIG_BOARD_SK_AM62_AM6254_M4 OR
   CONFIG_BOARD_STM32H747I_DISCO_STM32H747XX_M7 OR
   CONFIG_SOC_AMD_VERSAL2_RPU OR
   CONFIG_SOC_AMD_VERSALNET_RPU)
  message(STATUS "${BOARD}/${BOARD_QUALIFIERS} compile as Main in this sample")
else()
  message(FATAL_ERROR "${BOARD}/${BOARD_QUALIFIERS} is not supported for this sample")
endif()

project(mbox_ipc)

enable_language(C ASM)

if(CONFIG_INCLUDE_REMOTE_DIR)
  target_include_directories(zephyr_interface
    INTERFACE ${REMOTE_ZEPHYR_DIR}/include/public)
endif()

if("${BOARD}" STREQUAL "esp32_devkitc_procpu" OR "${BOARD}" STREQUAL "esp32s3_devkitc_procpu")
  set_source_files_properties(${REMOTE_ZEPHYR_DIR}/esp32_appcpu_firmware.c PROPERTIES GENERATED TRUE)
  target_sources(app PRIVATE src/main.c ${REMOTE_ZEPHYR_DIR}/esp32_appcpu_firmware.c)
else()
  target_sources(app PRIVATE src/main.c)
endif()
```

## Kconfig
```
# Copyright 2023 NXP
#
# SPDX-License-Identifier: Apache-2.0

source "Kconfig.zephyr"

config INCLUDE_REMOTE_DIR
	bool "Include remote core header directory"
	help
	  Include remote build header files. Can be used if primary image
	  needs to be aware of size or base address of secondary image

config TX_ENABLED
	bool "TX enabled"
	default y
	help
	  Enable TX

config RX_ENABLED
	bool "RX enabled"
	default y
	help
	  Enable RX
```

## Kconfig.sysbuild
```
# Copyright 2023 Nordic Semiconductor ASA
# Copyright 2023-2025 NXP
# Copyright 2025 Ezurio LLC
#
# SPDX-License-Identifier: Apache-2.0

source "share/sysbuild/Kconfig"

config REMOTE_BOARD
	string "Remote board"
	default "adp_xc7k/ae350_a25" if $(BOARD) = "adp_xc7k"
	default "bl54l15_dvk/nrf54l15/cpuflpr" if "$(BOARD)/$(BOARD_QUALIFIERS)" = "bl54l15_dvk/nrf54l15/cpuapp"
	default "ek_ra8p1/r7ka8p1kflcac/cm33" if $(BOARD) = "ek_ra8p1"
	default "esp32_devkitc/esp32/appcpu" if "$(BOARD)/$(BOARD_QUALIFIERS)" = "esp32_devkitc/esp32/procpu"
	default "esp32c6_devkitc/esp32c6/lpcore" if "$(BOARD)/$(BOARD_QUALIFIERS)" = "esp32c6_devkitc/esp32c6/hpcore"
	default "esp32p4x_function_ev_board/esp32p4/lpcore" if "$(BOARD)/$(BOARD_QUALIFIERS)" = "esp32p4x_function_ev_board/esp32p4/hpcore"
	default "esp32s3_devkitc/esp32s3/appcpu" if "$(BOARD)/$(BOARD_QUALIFIERS)" = "esp32s3_devkitc/esp32s3/procpu"
	default "frdm_imxrt1186/mimxrt1186/cm7" if $(BOARD) = "frdm_imxrt1186"
	default "frdm_imxrt700/mimxrt798s/cm33_cpu1" if $(BOARD) = "frdm_imxrt700"
	default "frdm_mcxn947/mcxn947/cpu1" if $(BOARD) = "frdm_mcxn947"
	default "imx943_evk/mimx94398/m33" if "$(BOARD)/$(BOARD_QUALIFIERS)" = "imx943_evk/mimx94398/m7_0"
	default "imx943_evk/mimx94398/m33" if "$(BOARD)/$(BOARD_QUALIFIERS)" = "imx943_evk/mimx94398/m7_1"
	default "imx943_evk/mimx94398/m7_1" if "$(BOARD)/$(BOARD_QUALIFIERS)" = "imx943_evk/mimx94398/m33"
	default "lpcxpresso55s69/lpc55s69/cpu1" if $(BOARD) = "lpcxpresso55s69"
	default "mcx_n9xx_evk/mcxn947/cpu1" if $(BOARD) = "mcx_n9xx_evk"
	default "mimxrt1160_evk/mimxrt1166/cm4" if $(BOARD) = "mimxrt1160_evk"
	default "mimxrt1170_evk/mimxrt1176/cm4" if $(BOARD) = "mimxrt1170_evk"
	default "mimxrt1170_evkb/mimxrt1176/cm4" if $(BOARD) = "mimxrt1170_evkb"
	default "mimxrt1180_evk/mimxrt1189/cm7" if $(BOARD) = "mimxrt1180_evk"
	default "mimxrt700_evk/mimxrt798s/cm33_cpu1" if $(BOARD) = "mimxrt700_evk"
	default "nrf5340bsim/nrf5340/cpunet" if $(BOARD_TARGET_STRING) = "NRF5340BSIM_NRF5340_CPUAPP"
	default "nrf5340dk/nrf5340/cpunet" if $(BOARD) = "nrf5340dk"
	default "nrf54l15dk/nrf54l15/cpuflpr" if $(BOARD) = "nrf54l15dk"
	default "nrf54lm20dk/nrf54lm20a/cpuflpr" if "$(BOARD)/$(BOARD_QUALIFIERS)" = "nrf54lm20dk/nrf54lm20a/cpuapp"
	default "nrf54lm20dk/nrf54lm20b/cpuflpr" if "$(BOARD)/$(BOARD_QUALIFIERS)" = "nrf54lm20dk/nrf54lm20b/cpuapp"
	default "nrf54lv10dk/nrf54lv10a/cpuflpr" if "$(BOARD)/$(BOARD_QUALIFIERS)" = "nrf54lv10dk/nrf54lv10a/cpuapp"
	default "nrf7120dk/nrf7120/cpuflpr" if "$(BOARD)/$(BOARD_QUALIFIERS)" = "nrf7120dk/nrf7120/cpuapp"
	default "nrf7120dk/nrf7120e/cpuflpr" if "$(BOARD)/$(BOARD_QUALIFIERS)" = "nrf7120dk/nrf7120e/cpuapp"
	default "nucleo_h755zi_q/stm32h755xx/m4" if $(BOARD) = "nucleo_h755zi_q"
	default "ophelia4ev/cpuflpr" if $(BOARD) = "ophelia4ev"
	default "stm32h747i_disco/stm32h747xx/m4" if $(BOARD) = "stm32h747i_disco"
	default "versal2_rpu" if SOC_AMD_VERSAL2_RPU
	default "versalnet_rpu" if SOC_AMD_VERSALNET_RPU
```

## sample.yaml
```
sample:
  name: MBOX IPC sample
common:
  sysbuild: true
  tags: mbox
  timeout: 30
tests:
  sample.drivers.mbox:
    filter: dt_compat_enabled("vnd,mbox-consumer")
    platform_exclude:
      - nrf54h20dk/nrf54h20/cpuapp
      - nrf54h20dk/nrf54h20/cpurad
      - nrf54l09pdk/nrf54l09/cpuapp
      - nrf54l15dk/nrf54l15/cpuapp
      - nrf54lm20dk/nrf54lm20a/cpuapp
    integration_platforms:
      - nrf5340bsim/nrf5340/cpuapp
    harness: console
    harness_config:
      type: multi_line
      ordered: false
      regex:
        - "Pong \\(on channel.*\\)"
        - "Ping \\(on channel.*\\)"

  sample.drivers.mbox.nrf54h20_app_ppr:
    platform_allow:
      - nrf54h20dk/nrf54h20/cpuapp
    integration_platforms:
      - nrf54h20dk/nrf54h20/cpuapp
    extra_args:
      - mbox_SNIPPET=nordic-ppr
      - mbox_EXTRA_DTC_OVERLAY_FILE="boards/nrf54h20dk_nrf54h20_cpuapp_cpuppr.overlay"
      - SB_CONF_FILE=sysbuild/nrf54h20dk_nrf54h20_cpuppr.conf
    sysbuild: true
    harness: console
    harness_config:
      type: multi_line
      ordered: false
      regex:
        - "Ping \\(on channel 15\\)"
        - "Pong \\(on channel 18\\)"

  sample.drivers.mbox.nrf54h20_app_flpr:
    platform_allow:
      - nrf54h20dk/nrf54h20/cpuapp
    integration_platforms:
      - nrf54h20dk/nrf54h20/cpuapp
    extra_args:
      - mbox_SNIPPET=nordic-flpr
      - mbox_EXTRA_DTC_OVERLAY_FILE="boards/nrf54h20dk_nrf54h20_cpuapp_cpuflpr.overlay"
      - SB_CONF_FILE=sysbuild/nrf54h20dk_nrf54h20_cpuflpr.conf
    sysbuild: true
    harness: console
    harness_config:
      type: multi_line
      ordered: false
      regex:
        - "Ping \\(on channel 16\\)"
        - "Pong \\(on channel 14\\)"

  sample.drivers.mbox.nrf54h20_app_rad:
    platform_allow:
      - nrf54h20dk/nrf54h20/cpuapp
    integration_platforms:
      - nrf54h20dk/nrf54h20/cpuapp
    extra_args:
      - SB_CONF_FILE=sysbuild/nrf54h20dk_nrf54h20_cpurad.conf
    sysbuild: true
    harness: console
    harness_config:
      type: multi_line
      ordered: false
      regex:
        - "Ping \\(on channel 12\\)"
        - "Pong \\(on channel 18\\)"

  sample.drivers.mbox.nrf54l:
    platform_allow:
      - nrf54l09pdk/nrf54l09/cpuapp
      - nrf54l15dk/nrf54l15/cpuapp
      - nrf54lm20dk/nrf54lm20a/cpuapp
    integration_platforms:
      - nrf54l15dk/nrf54l15/cpuapp
    extra_args: mbox_SNIPPET=nordic-flpr
    sysbuild: true
    harness: console
    harness_config:
      type: multi_line
      ordered: false
      regex:
        - "Ping \\(on channel 21\\)"
        - "Pong \\(on channel 20\\)"

  sample.drivers.mbox.nrf54l_no_multithreading:
    platform_allow:
      - nrf54l09pdk/nrf54l09/cpuapp
      - nrf54l15dk/nrf54l15/cpuapp
      - nrf54lm20dk/nrf54lm20a/cpuapp
    integration_platforms:
      - nrf54l15dk/nrf54l15/cpuapp
    extra_args:
      - mbox_SNIPPET=nordic-flpr
      - mbox_CONFIG_MULTITHREADING=n
      - remote_CONFIG_MULTITHREADING=n
    sysbuild: true
    harness: console
    harness_config:
      type: multi_line
      ordered: false
      regex:
        - "Ping \\(on channel 21\\)"
        - "Pong \\(on channel 20\\)"

  sample.drivers.mbox.nrf54l_remote_no_multithreading:
    platform_allow:
      - nrf54l09pdk/nrf54l09/cpuapp
      - nrf54l15dk/nrf54l15/cpuapp
      - nrf54lm20dk/nrf54lm20a/cpuapp
    integration_platforms:
      - nrf54l15dk/nrf54l15/cpuapp
    extra_args:
      - mbox_SNIPPET=nordic-flpr
      - remote_CONFIG_MULTITHREADING=n
    sysbuild: true
    harness: console
    harness_config:
      type: multi_line
      ordered: false
      regex:
        - "Ping \\(on channel 21\\)"
        - "Pong \\(on channel 20\\)"
```

## prj.conf
```kconfig
CONFIG_PRINTK=y
CONFIG_MBOX=y
```

## boards/adp_xc7k_ae350.conf
```kconfig
CONFIG_RV_BOOT_HART=0
CONFIG_MP_MAX_NUM_CPUS=1
```

## boards/adp_xc7k_ae350_a25_smp.conf
```kconfig
CONFIG_SMP=n
CONFIG_RV_BOOT_HART=0
CONFIG_MP_MAX_NUM_CPUS=1
```

## boards/esp32c6_devkitc_hpcore.conf
```kconfig
CONFIG_ULP_COPROC_ENABLED=y
CONFIG_DEBUG_OPTIMIZATIONS=y
```

## boards/esp32p4x_function_ev_board_hpcore.conf
```kconfig
CONFIG_SOC_FAMILY_ESP32_ULP_ENABLED=y
```

## boards/mimxrt1170_evk_mimxrt1176_cm7_B.conf
```kconfig
CONFIG_MBOX_NXP_IMX_MU=y
CONFIG_SECOND_CORE_MCUX=y
CONFIG_INCLUDE_REMOTE_DIR=y
```

## boards/mimxrt595_evk_cm33.conf
```kconfig
CONFIG_MBOX_NXP_IMX_MU=y
```

## boards/adp_xc7k_ae350.overlay
```dts
/*
 * Copyright (c) 2022 Andes Technology Corporation.
 * SPDX-License-Identifier: Apache-2.0
 */

/ {
	mbox-consumer {
		compatible = "vnd,mbox-consumer";
		mboxes = <&mbox 9>, <&mbox 10>;
		mbox-names = "tx", "rx";
	};
};

&dram {
	reg = <0x00000000 0x10000000>;
};
```

## boards/bl54l15u_dvk_nrf54l15_cpuapp.overlay
```dts
/*
 * Copyright 2024 Nordic Semiconductor ASA
 * Copyright 2025 Ezurio LLC
 * SPDX-License-Identifier: Apache-2.0
 */

/ {
	mbox-consumer {
		compatible = "vnd,mbox-consumer";
		mboxes = <&cpuapp_vevif_rx 20>, <&cpuapp_vevif_tx 21>;
		mbox-names = "rx", "tx";
	};
};

&cpuapp_vevif_rx {
	status = "okay";
};

&cpuapp_vevif_tx {
	status = "okay";
};
```

## boards/esp32_devkitc_wroom_procpu.overlay
```dts
/*
 * Copyright (c) 2024 Felipe Neves.
 *
 * SPDX-License-Identifier: Apache-2.0
 */

/ {
	chosen {
		zephyr,sram = &sram0;
		zephyr,ipc_shm = &shm0;
		zephyr,ipc = &mbox0;
	};

	mbox-consumer {
		compatible = "vnd,mbox-consumer";
		mboxes = <&mbox0 1>, <&mbox0 0>;
		mbox-names = "tx", "rx";
	};
};

&mbox0 {
	status = "okay";
};
```

## boards/esp32c6_devkitc_hpcore.overlay
```dts
/*
 * Copyright (c) 2025 Espressif Systems (Shanghai) Co., Ltd.
 *
 * SPDX-License-Identifier: Apache-2.0
 */

/ {
	chosen {
		zephyr,ipc_shm = &ipc_shm;
		zephyr,ipc = &mbox0;
	};

	mbox-consumer {
		compatible = "vnd,mbox-consumer";
		mboxes = <&mbox0 0>, <&mbox0 1>;
		mbox-names = "tx", "rx";
	};
};

&lp_uart {
	status = "okay";
};
```

## boards/esp32p4x_function_ev_board_hpcore.overlay
```dts
/*
 * Copyright (c) 2026 Espressif Systems (Shanghai) Co., Ltd.
 *
 * SPDX-License-Identifier: Apache-2.0
 */

/ {
	chosen {
		zephyr,ipc_shm = &ipc_shm;
		zephyr,ipc = &mbox0;
	};

	mbox-consumer {
		compatible = "vnd,mbox-consumer";
		mboxes = <&mbox0 0>, <&mbox0 1>;
		mbox-names = "tx", "rx";
	};
};

&lp_uart {
	status = "okay";
};
```

## boards/esp32s3_devkitc_procpu.overlay
```dts
/*
 * Copyright (c) 2024 Felipe Neves.
 *
 * SPDX-License-Identifier: Apache-2.0
 */

/ {
	chosen {
		zephyr,sram = &sram1;
		zephyr,ipc_shm = &shm0;
		zephyr,ipc = &mbox0;
	};

	mbox-consumer {
		compatible = "vnd,mbox-consumer";
		mboxes = <&mbox0 1>, <&mbox0 0>;
		mbox-names = "tx", "rx";
	};
};

&mbox0 {
	status = "okay";
};
```

## src/main.c
```c
/*
 * Copyright (c) 2021 Carlo Caione <ccaione@baylibre.com>
 *
 * SPDX-License-Identifier: Apache-2.0
 */

#include <string.h>

#include <zephyr/kernel.h>
#include <zephyr/drivers/mbox.h>
#include <zephyr/sys/printk.h>
#include <zephyr/sys/util.h>

/*
 * Largest payload this sample is able to build. Drivers advertising an MTU
 * bigger than this are driven in signalling mode instead.
 */
#define MAX_MSG_SIZE 64

#ifdef CONFIG_RX_ENABLED
static void callback(const struct device *dev, mbox_channel_id_t channel_id,
		     void *user_data, struct mbox_msg *data)
{
	if ((data != NULL) && (data->data != NULL) && (data->size > 0U)) {
		uint32_t counter = 0;

		memcpy(&counter, data->data, MIN(sizeof(counter), data->size));

		printk("Pong (on channel %d) counter %u in %u byte(s)\n", channel_id,
		       counter, (unsigned int)data->size);
	} else {
		printk("Pong (on channel %d)\n", channel_id);
	}
}
#endif /* CONFIG_RX_ENABLED */

#ifdef CONFIG_TX_ENABLED
static uint8_t tx_data[MAX_MSG_SIZE];
#endif /* CONFIG_TX_ENABLED */

int main(void)
{
	int ret;

	printk("Hello from HOST - %s\n", CONFIG_BOARD_TARGET);

#ifdef CONFIG_RX_ENABLED
	const struct mbox_dt_spec rx_channel = MBOX_DT_SPEC_GET(DT_PATH(mbox_consumer), rx);

	printk("Maximum RX channels: %d\n", mbox_max_channels_get_dt(&rx_channel));

	ret = mbox_register_callback_dt(&rx_channel, callback, NULL);
	if (ret < 0) {
		printk("Could not register callback (%d)\n", ret);
		return 0;
	}

	ret = mbox_set_enabled_dt(&rx_channel, true);
	if (ret < 0) {
		printk("Could not enable RX channel %d (%d)\n", rx_channel.channel_id, ret);
		return 0;
	}
#endif /* CONFIG_RX_ENABLED */

#ifdef CONFIG_TX_ENABLED
	const struct mbox_dt_spec tx_channel = MBOX_DT_SPEC_GET(DT_PATH(mbox_consumer), tx);
	struct mbox_msg msg;
	struct mbox_msg *msg_ptr = NULL;
	uint32_t counter = 0;
	int mtu;

	mtu = mbox_mtu_get_dt(&tx_channel);

	printk("Maximum bytes of data in the TX message: %d\n", mtu);
	printk("Maximum TX channels: %d\n", mbox_max_channels_get_dt(&tx_channel));

	/*
	 * A non-zero MTU means the driver operates in data transfer mode, where
	 * mbox_send() must be given a message whose size matches the MTU. A zero
	 * (or unsupported) MTU means signalling mode, where the message must be
	 * NULL.
	 */
	if (mtu > (int)sizeof(tx_data)) {
		printk("MTU exceeds %u bytes, using signalling mode instead\n",
		       (unsigned int)sizeof(tx_data));
	} else if (mtu > 0) {
		msg.data = tx_data;
		msg.size = (size_t)mtu;
		msg_ptr = &msg;
	}

	while (1) {
#if defined(CONFIG_MULTITHREADING)
		k_sleep(K_MSEC(2000));
#else
		k_busy_wait(2000000);
#endif

		if (msg_ptr != NULL) {
			counter++;
			memset(tx_data, 0, msg.size);
			memcpy(tx_data, &counter, MIN(sizeof(counter), msg.size));
		}

		printk("Ping (on channel %d)\n", tx_channel.channel_id);

		ret = mbox_send_dt(&tx_channel, msg_ptr);
		if (ret < 0) {
			printk("Could not send (%d)\n", ret);
			return 0;
		}
	}
#endif /* CONFIG_TX_ENABLED */
	return 0;
}
```
