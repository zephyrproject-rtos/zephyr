/*
 * Copyright (c) 2022 Andes Technology Corporation.
 * SPDX-License-Identifier: Apache-2.0
 */

/ {
	mbox-consumer {
		compatible = "vnd,mbox-consumer";
		mboxes = <&mbox 9>, <&mbox 10>;
		mbox-names = "tx", "rx";
	};
};

&dram {
	reg = <0x00000000 0x10000000>;
};
