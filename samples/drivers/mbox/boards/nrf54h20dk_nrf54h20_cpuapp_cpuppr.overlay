/*
 * Copyright 2024 Nordic Semiconductor ASA
 * SPDX-License-Identifier: Apache-2.0
 */

/ {
	mbox-consumer {
		compatible = "vnd,mbox-consumer";
		mboxes = <&cpuppr_vevif 15>, <&cpuapp_bellboard 18>;
		mbox-names = "tx", "rx";
	};
};

&cpuapp_bellboard {
	status = "okay";
	/* When other cpuapp_bellboard channel is selected for RX,
	 * make sure it's enabled in the interrupt mask.
	 * See `nordic,interrupt-mapping` property.
	 */
};

&cpuppr_vevif {
	status = "okay";
};
