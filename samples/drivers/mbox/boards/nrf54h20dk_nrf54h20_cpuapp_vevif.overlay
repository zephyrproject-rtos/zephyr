/*
 * Copyright 2024 Nordic Semiconductor ASA
 * SPDX-License-Identifier: Apache-2.0
 */

/ {
	mbox-consumer {
		compatible = "vnd,mbox-consumer";
		mboxes = <&cpuppr_vevif 4>;
		mbox-names = "tx";
	};
};

&cpuppr_vevif {
	status = "okay";
};
