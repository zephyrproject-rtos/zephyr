/*
 * Copyright (c) 2026 The Zephyr Project Contributors
 * SPDX-License-Identifier: Apache-2.0
 */

/ {
	mbox-consumer {
		compatible = "vnd,mbox-consumer";
		mboxes = <&mailbox 11>, <&mailbox 10>;
		mbox-names = "tx", "rx";
	};
};

&mailbox {
	status = "okay";
};
