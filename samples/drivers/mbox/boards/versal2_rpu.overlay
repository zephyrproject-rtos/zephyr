/*
 * Copyright (c) 2025 Advanced Micro Devices, Inc. (AMD)
 *
 * SPDX-License-Identifier: Apache-2.0
 */

&ipi1 {
	status = "okay";

	rpu0_rpu0_mailbox: mailbox@eb340000 {
		compatible = "xlnx,mbox-versal-ipi-dest-mailbox";
		status = "okay";
		reg = <0xeb340000 0x20>, <0xeb3f0600 0x1000>;
		reg-names = "ctrl", "msg";
		xlnx,ipi-id = <3>;
		#mbox-cells = <1>;
	};
};

/ {
	mbox-consumer {
		compatible = "vnd,mbox-consumer";
		mboxes = <&rpu0_rpu0_mailbox 0>, <&rpu0_rpu0_mailbox 1>;
		mbox-names = "tx", "rx";
	};
};
