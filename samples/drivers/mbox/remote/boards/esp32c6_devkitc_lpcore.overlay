/*
 * Copyright (c) 2024 Felipe Neves.
 *
 * SPDX-License-Identifier: Apache-2.0
 */

/ {
	chosen {
		zephyr,ipc_shm = &ipc_shm;
		zephyr,ipc = &mbox0;
	};

	mbox-consumer {
		compatible = "vnd,mbox-consumer";
		mboxes = <&mbox0 1>, <&mbox0 0>;
		mbox-names = "tx", "rx";
	};
};

&lp_uart {
	status = "okay";
};
