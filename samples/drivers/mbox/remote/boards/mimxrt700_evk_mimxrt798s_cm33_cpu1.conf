## samples/drivers/mbox/remote/boards/mimxrt700_evk_mimxrt798s_cm33_cpu1.conf
```kconfig
CONFIG_BUILD_OUTPUT_HEX=y
CONFIG_SECOND_CORE_MCUX=y
CONFIG_BUILD_OUTPUT_INFO_HEADER=y
CONFIG_GLIKEY_MCUX_GLIKEY=y
```

## samples/drivers/mbox/remote/sample.yaml
```yaml
sample:
  name: MBOX IPC sample (remote)
tests:
  sample.drivers.mbox_remote:
    platform_allow: nrf5340dk_nrf5340_cpunet adp_xc7k_ae350
    integration_platforms:
      - nrf5340dk_nrf5340_cpunet
    tags: mbox
    harness: remote
```

## samples/drivers/mbox/sample.yaml
```yaml
sample:
  name: MBOX IPC sample
common:
  sysbuild: true
  tags: mbox
  timeout: 30
tests:
  sample.drivers.mbox:
    filter: dt_compat_enabled("vnd,mbox-consumer")
    platform_exclude:
      - nrf54h20dk/nrf54h20/cpuapp
      - nrf54h20dk/nrf54h20/cpurad
      - nrf54l15dk/nrf54l15/cpuapp
      - nrf54lm20dk/nrf54lm20a/cpuapp
    integration_platforms:
      - nrf5340bsim/nrf5340/cpuapp
    harness: console
    harness_config:
      type: multi_line
      ordered: false
      regex:
        - "Pong \\(on channel.*\\)"
        - "Ping \\(on channel.*\\)"

  sample.drivers.mbox.nrf54h20_app_ppr:
    platform_allow:
      - nrf54h20dk/nrf54h20/cpuapp
    integration_platforms:
      - nrf54h20dk/nrf54h20/cpuapp
    extra_args:
      - mbox_SNIPPET=nordic-ppr
      - mbox_EXTRA_DTC_OVERLAY_FILE="boards/nrf54h20dk_nrf54h20_cpuapp_cpuppr.overlay"
      - SB_CONF_FILE=sysbuild/nrf54h20dk_nrf54h20_cpuppr.conf
    sysbuild: true
    harness: console
    harness_config:
      type: multi_line
      ordered: false
      regex:
        - "Ping \\(on channel 15\\)"
        - "Pong \\(on channel 18\\)"

  sample.drivers.mbox.nrf54h20_app_flpr:
    platform_allow:
      - nrf54h20dk/nrf54h20/cpuapp
    integration_platforms:
      - nrf54h20dk/nrf54h20/cpuapp
    extra_args:
      - mbox_SNIPPET=nordic-flpr
      - mbox_EXTRA_DTC_OVERLAY_FILE="boards/nrf54h20dk_nrf54h20_cpuapp_cpuflpr.overlay"
      - SB_CONF_FILE=sysbuild/nrf54h20dk_nrf54h20_cpuflpr.conf
    sysbuild: true
    harness: console
    harness_config:
      type: multi_line
      ordered: false
      regex:
        - "Ping \\(on channel 16\\)"
        - "Pong \\(on channel 14\\)"

  sample.drivers.mbox.nrf54h20_app_rad:
    platform_allow:
      - nrf54h20dk/nrf54h20/cpuapp
    integration_platforms:
      - nrf54h20dk/nrf54h20/cpuapp
    extra_args:
      - mbox_CONFIG_SOC_NRF54H20_CPURAD_ENABLE=y
      - SB_CONF_FILE=sysbuild/nrf54h20dk_nrf54h20_cpurad.conf
    sysbuild: true
    harness: console
    harness_config:
      type: multi_line
      ordered: false
      regex:
        - "Ping \\(on channel 12\\)"
        - "Pong \\(on channel 18\\)"

  sample.drivers.mbox.nrf54l:
    platform_allow:
      - nrf54l15dk/nrf54l15/cpuapp
      - nrf54lm20dk/nrf54lm20a/cpuapp
    integration_platforms:
      - nrf54l15dk/nrf54l15/cpuapp
    extra_args: mbox_SNIPPET=nordic-flpr
    sysbuild: true
    harness: console
    harness_config:
      type: multi_line
      ordered: false
      regex:
        - "Ping \\(on channel 21\\)"
        - "Pong \\(on channel 20\\)"

  sample.drivers.mbox.nrf54l_no_multithreading:
    platform_allow:
      - nrf54l15dk/nrf54l15/cpuapp
      - nrf54lm20dk/nrf54lm20a/cpuapp
    integration_platforms:
      - nrf54l15dk/nrf54l15/cpuapp
    extra_args:
      - mbox_SNIPPET=nordic-flpr
      - mbox_CONFIG_MULTITHREADING=n
      - remote_CONFIG_MULTITHREADING=n
    sysbuild: true
    harness: console
    harness_config:
      type: multi_line
      ordered: false
      regex:
        - "Ping \\(on channel 21\\)"
        - "Pong \\(on channel 20\\)"

  sample.drivers.mbox.nrf54l_remote_no_multithreading:
    platform_allow:
      - nrf54l15dk/nrf54l15/cpuapp
      - nrf54lm20dk/nrf54lm20a/cpuapp
    integration_platforms:
      - nrf54l15dk/nrf54l15/cpuapp
    extra_args:
      - mbox_SNIPPET=nordic-flpr
      - remote_CONFIG_MULTITHREADING=n
    sysbuild: true
    harness: console
    harness_config:
      type: multi_line
      ordered: false
      regex:
        - "Ping \\(on channel 21\\)"
        - "Pong \\(on channel 20\\)"
```

## samples/drivers/mbox_data/Kconfig.sysbuild
```kconfig
# Copyright 2024-2025 NXP
#
# SPDX-License-Identifier: Apache-2.0

source "share/sysbuild/Kconfig"

config REMOTE_BOARD
string
	default "mimxrt1170_evkb/mimxrt1176/cm4" if $(BOARD) = "mimxrt1170_evkb"
	default "mimxrt1170_evk/mimxrt1176/cm4" if $(BOARD) = "mimxrt1170_evk"
	default "mimxrt1160_evk/mimxrt1166/cm4" if $(BOARD) = "mimxrt1160_evk"
	default "mimxrt1180_evk/mimxrt1189/cm7" if $(BOARD) = "mimxrt1180_evk"
	default "mimxrt700_evk/mimxrt798s/cm33_cpu1" if $(BOARD) = "mimxrt700_evk"
	default "lpcxpresso55s69/lpc55s69/cpu1" if $(BOARD) = "lpcxpresso55s69"
	default "frdm_mcxn947/mcxn947/cpu1" if $(BOARD) = "frdm_mcxn947"
	default "mcx_n9xx_evk/mcxn947/cpu1" if $(BOARD) = "mcx_n9xx_evk"
	default "ek_ra8p1/r7ka8p1kflcac/cm33" if $(BOARD) = "ek_ra8p1"
```

## samples/drivers/mbox_data/boards/versal2_rpu.conf
```kconfig
# Copyright (c) 2026 Advanced Micro Devices, Inc. (AMD)
#
# SPDX-License-Identifier: Apache-2.0

CONFIG_MBOX_DATA_MAX_MSG_SIZE=32
```

## samples/drivers/mbox_data/remote/Kconfig
```kconfig
# Copyright (c) 2026 Advanced Micro Devices, Inc. (AMD)
#
# SPDX-License-Identifier: Apache-2.0

source "Kconfig.zephyr"

config MBOX_DATA_MAX_MSG_SIZE
	int "Maximum mbox message size in bytes"
	default 4
	help
	  Maximum supported message size for the sample buffers. Defaults to
	  4 bytes; boards whose mbox driver supports a larger MTU can override
	  this via a board-specific config fragment.
```

## samples/drivers/mbox_data/sample.yaml
```yaml
sample:
  name: MBOX Data IPC sample
common:
  sysbuild: true
  tags: mbox
tests:
  sample.drivers.mbox_data.real_hw:
    filter: dt_compat_enabled("vnd,mbox-consumer")
    integration_platforms:
      - mimxrt1160_evk/mimxrt1166/cm7
      - lpcxpresso55s69/lpc55s69/cpu0
    harness: console
    harness_config:
      type: multi_line
      ordered: false
      regex:
        - "Client received .+ value: 1"
        - "Client send .+ value: 2"
        - "Client received .+ value: 3"
        - "Client send .+ value: 4"
        - "Client received .+ value: 41"
        - "Client send .+ value: 42"
        - "Client received .+ value: 97"
        - "Client send .+ value: 98"
        - "Client received .+ value: 99"
```

## samples/drivers/memc/boards/apollo4p_evb.conf
```kconfig
# Copyright (c) 2024, Ambiq Micro Inc. <www.ambiq.com>
# SPDX-License-Identifier: Apache-2.0

CONFIG_MEMC_MSPI_APS256N=y
CONFIG_LOG=y
CONFIG_LOG_DEFAULT_LEVEL=0
CONFIG_MSPI_INIT_PRIORITY=40
CONFIG_MEMC_INIT_PRIORITY=50
CONFIG_PM_DEVICE=y
```

## samples/drivers/memc/boards/apollo510_evb.conf
```kconfig
# Copyright (c) 2024 Ambiq Micro Inc. <www.ambiq.com>
# SPDX-License-Identifier: Apache-2.0

CONFIG_MEMC=y
CONFIG_MEMC_MSPI_APS_Z8=y
CONFIG_MEMC_MSPI_APS51216BA=y
CONFIG_LOG=y
CONFIG_LOG_DEFAULT_LEVEL=0
```

## samples/drivers/memc/boards/b_u585i_iot02a_mspi_aps6408l.conf
```kconfig
# SPDX-FileCopyrightText: Copyright The Zephyr Project Contributors
# SPDX-License-Identifier: Apache-2.0

CONFIG_LOG=y
CONFIG_MSPI_LOG_LEVEL_INF=y
CONFIG_MSPI_MEMMAP=y
CONFIG_MSPI_TIMING=y
```

## samples/drivers/memc/boards/frdm_rw612.conf
```kconfig
# Copyright 2024 NXP
# SPDX-License-Identifier: Apache-2.0

# In order to safely access the PSRAM on port B of the RW FlexSPI peripheral,
# the QSPI flash on port A must be configured by the application. Otherwise,
# the PSRAM configuration will overwrite the LUT entries for the QSPI flash,
# and the application will no longer be able to XIP from the flash.
# To make sure the QSPI flash is configured, enable flash drivers.
CONFIG_FLASH=y

# Initialization priorities are critical here. The FlexSPI MEMC driver must
# initialize first. Then, the QSPI flash driver must initialize to program
# the LUT table for port A. Finally, the PSRAM driver can initialize and
# program the LUT table for port B
CONFIG_MEMC_MCUX_FLEXSPI_INIT_PRIORITY=0
CONFIG_FLASH_INIT_PRIORITY=50
CONFIG_MEMC_INIT_PRIORITY=60

# This board has the PSRAM attached to the same FLEXSPI device as the flash
# chip used for XIP, so we must explicitly enable the FLEXSPI MEMC driver
# to reconfigure the flash device it is executing from
CONFIG_MEMC_MCUX_FLEXSPI_INIT_XIP=y
```

## samples/drivers/memc/boards/rd_rw612_bga.conf
```kconfig
# Copyright 2023 NXP
# SPDX-License-Identifier: Apache-2.0

# RW is configured to execute from code ram, so use rom loader to load image
CONFIG_NXP_RW_ROM_RAMLOADER=y
```

## samples/drivers/memc/sample.yaml
```yaml
sample:
  description: Memory controller sample
  name: memc driver sample
common:
  tags: memc
  harness: console
  harness_config:
    type: one_line
    regex:
      - "Read data matches written data"
tests:
  sample.drivers.memc:
    filter: dt_alias_exists("sram-ext")
    integration_platforms:
      - mimxrt595_evk/mimxrt595s/cm33
  sample.drivers.memc.mspi:
    tags: mspi
    filter: dt_alias_exists("psram0")
    integration_platforms:
      - apollo3p_evb
      - apollo510_evb
  sample.drivers.memc.stm32_mspi:
    tags: mspi
    filter: dt_alias_exists("psram0")
    platform_allow:
      - b_u585i_iot02a
      - stm32h7s78_dk
    integration_platforms:
      - b_u585i_iot02a
      - stm32h7s78_dk
    extra_args:
      - platform:b_u585i_iot02a:DTC_OVERLAY_FILE=boards/b_u585i_iot02a_mspi_aps6408l.overlay
      - platform:b_u585i_iot02a:EXTRA_CONF_FILE=boards/b_u585i_iot02a_mspi_aps6408l.conf
      - platform:stm32h7s78_dk:CONF_FILE=boards/stm32h7s78_dk_mspi_psram.conf
      - platform:stm32h7s78_dk:DTC_OVERLAY_FILE=boards/stm32h7s78_dk_mspi_psram.overlay
```

## samples/drivers/misc/adg1712/sample.yaml
```yaml
sample:
  name: ADG1712 Quad SPST Analog Switch
  description: Demonstrates the ADG1712/ADG2712 quad SPST analog switch driver API
common:
  tags:
    - drivers
    - misc
  harness: console
  harness_config:
    type: one_line
    regex:
      - "ADG1712 sample completed"
tests:
  sample.drivers.misc.adg1712:
    filter: dt_compat_enabled("adi,adg1712") or dt_compat_enabled("adi,adg2712")
  sample.drivers.misc.adg1712.eval_adg1712ardz:
    extra_args: SHIELD=eval_adg1712ardz
    platform_allow:
      - nucleo_f413zh
```

## samples/drivers/misc/adg1736/sample.yaml
```yaml
sample:
  name: ADG1736 Dual SPDT Analog Switch
  description: Demonstrates the ADG736/ADG1736 dual SPDT analog switch driver API
common:
  tags:
    - drivers
    - misc
  harness: console
  harness_config:
    type: one_line
    regex:
      - "ADG1736 sample completed"
tests:
  sample.drivers.misc.adg1736:
    filter: dt_compat_enabled("adi,adg1736") or dt_compat_enabled("adi,adg736")
  sample.drivers.misc.adg1736.eval_adg1736sdz:
    extra_args: SHIELD=eval_adg1736sdz
    platform_allow:
      - nucleo_f413zh
```

## samples/drivers/misc/adgm3121/sample.yaml
```yaml
sample:
  name: ADGM3121 MEMS Switch
  description: Demonstrates the ADGM3121 MEMS RF switch driver API
common:
  tags:
    - drivers
    - misc
  harness: console
  harness_config:
    type: one_line
    regex:
      - "ADGM3121 sample completed"
tests:
  sample.drivers.misc.adgm3121:
    filter: dt_compat_enabled("adi,adgm3121-gpio") or dt_compat_enabled("adi,adgm3121")
  sample.drivers.misc.adgm3121.eval_adgm3121:
    extra_args: SHIELD=eval_adgm3121
    platform_allow:
      - nucleo_f413zh
```

## samples/drivers/misc/bflb_wo_uart/sample.yaml
```yaml
sample:
  name: bflb_wo_uart
tests:
  sample.drivers.misc.bflb_wo_uart:
    tags:
      - drivers
    platform_allow: bl61x
```

## samples/drivers/misc/esp_tool/boards/esp32s3_devkitc_procpu.conf
```kconfig
CONFIG_SERIAL_FLASHER_BOOT_INVERT=y
CONFIG_SERIAL_FLASHER_RESET_INVERT=y
CONFIG_SERIAL_FLASHER_DEBUG_TRACE=n
CONFIG_SERIAL_FLASHER_INTERFACE_UART=y
```

## samples/drivers/misc/espressif_rmt/Kconfig
```kconfig
# Private config options for espressif_rmt sample

# SPDX-FileCopyrightText: Copyright The Zephyr Project Contributors
# SPDX-License-Identifier: Apache-2.0

mainmenu "Espressif RMT sample application"

source "Kconfig.zephyr"
```
