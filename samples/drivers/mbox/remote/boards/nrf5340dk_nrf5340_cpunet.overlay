/*
 * Copyright (c) 2021 Carlo Caione <ccaione@baylibre.com>
 *
 * SPDX-License-Identifier: Apache-2.0
 */

/ {
	soc {
		mbox: mbox@41012000 {
			compatible = "nordic,mbox-nrf-ipc";
			reg = <0x41012000 0x1000>;
			tx-mask = <0x0000ffff>;
			rx-mask = <0x0000ffff>;
			interrupts = <18 NRF_DEFAULT_IRQ_PRIORITY>;
			#mbox-cells = <1>;
			status = "okay";
		};
	};
};
