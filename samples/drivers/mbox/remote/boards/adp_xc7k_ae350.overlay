/*
 * Copyright (c) 2022 Andes Technology Corporation.
 * SPDX-License-Identifier: Apache-2.0
 */

/ {
	mbox-consumer {
		compatible = "vnd,mbox-consumer";
		mboxes = <&mbox 10>, <&mbox 9>;
		mbox-names = "tx", "rx";
	};
};

&cpu0 {
	status = "disabled";
};

&dram {
	reg = <0x10000000 0x10000000>;
};
