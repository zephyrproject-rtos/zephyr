/*
 * Copyright 2025 NXP
 *
 * SPDX-License-Identifier: Apache-2.0
 */

/ {
	mbox-consumer {
		compatible = "vnd,mbox-consumer";
		/*
		 * m71(M7MIX1) as master(host), m33s(NETCMIX) as remote
		 */
		mboxes = <&mu_m33s_m71_for_m33s 0>, <&mu_m33s_m71_for_m33s 1>;
		mbox-names = "tx", "rx";
	};
};
