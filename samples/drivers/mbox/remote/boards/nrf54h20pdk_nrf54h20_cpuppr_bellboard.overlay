/*
 * Copyright 2024 Nordic Semiconductor ASA
 * SPDX-License-Identifier: Apache-2.0
 */

/ {
	mbox-consumer {
		compatible = "vnd,mbox-consumer";
		mboxes = <&cpuapp_bellboard 0>;
		mbox-names = "tx";
	};
};

&cpuapp_bellboard {
	status = "okay";
};
