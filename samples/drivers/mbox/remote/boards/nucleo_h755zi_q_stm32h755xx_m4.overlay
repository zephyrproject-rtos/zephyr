/*
 * Copyright (c) 2026 The Zephyr Project Contributors
 * SPDX-License-Identifier: Apache-2.0
 */

/ {
	mbox-consumer {
		compatible = "vnd,mbox-consumer";
		mboxes = <&mailbox 10>, <&mailbox 11>;
		mbox-names = "tx", "rx";
	};
};

&mailbox {
	status = "okay";
};
