/*
 * Copyright (c) 2026 Mario Paja
 *
 * SPDX-License-Identifier: Apache-2.0
 *
 * I2S3 in full duplex mode. Connect the data output to the data input with
 * one wire:
 *   PC12 (I2S3_SDO) -> PC11 (I2S3_SDI)
 * The clock and word select pins (PC10, PA15) can stay unconnected.
 */

&dmamux1 {
	status = "okay";
};

&dma1 {
	status = "okay";
};

i2s_rxtx: &i2s3 {
	pinctrl-0 = <&i2s3_ck_pc10 &i2s3_ws_pa15 &i2s3_sdo_pc12 &i2s3_sdi_pc11>;
	pinctrl-names = "default";
	status = "okay";
};
