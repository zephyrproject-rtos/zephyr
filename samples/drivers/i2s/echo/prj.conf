## CMakeLists.txt
```
# SPDX-License-Identifier: Apache-2.0

cmake_minimum_required(VERSION 3.28.0)

find_package(Zephyr REQUIRED HINTS $ENV{ZEPHYR_BASE})
project(i2s_echo)

target_sources(app PRIVATE src/main.c src/codec.c)
```

## Kconfig
```
# Copyright (c) 2021 Nordic Semiconductor ASA
# Copyright (c) 2025 Croxel Inc.
# Copyright 2026 NXP
# SPDX-License-Identifier: Apache-2.0

source "Kconfig.zephyr"

config I2C
	default $(dt_compat_on_bus,$(DT_COMPAT_WLF_WM8731),i2c) \
		|| $(dt_compat_on_bus,$(DT_COMPAT_ADI_MAX9867),i2c)

config SAMPLE_FREQ
	int "Sample rate"
	default 44100
	help
	  Audio sample frequency in Hz. The selected frequency must be supported
	  by the audio codec.

config TOGGLE_ECHO_EFFECT_SW0
	bool "Toggle echo effect when pressing sw0"
	depends on $(dt_alias_enabled,sw0)
	select GPIO
	default y

config STOP_START_STREAMS_SW1
	bool "Start/stop I2S streams when pressing sw1"
	depends on $(dt_alias_enabled,sw1)
	select GPIO
	default y

config SAMPLE_USE_CODEC_CLOCK
	bool "I2S BCK is generated by a selected codec device"
	help
	  If selected, the I2S selected peripheral will be configured to consume
	  (receive) the I2S BCK and WS signals and the codec will be configured
	  to generate those. If not selected, the I2S peripheral will generate
	  them and the codec will be expected to consume them.
```

## sample.yaml
```
sample:
  name: I2S echo sample
tests:
  sample.drivers.i2s.echo:
    tags: i2s
    filter: dt_nodelabel_enabled("i2s_rxtx") or
            (dt_nodelabel_enabled("i2s_rx") and dt_nodelabel_enabled("i2s_tx"))
    integration_platforms:
      - nrf52840dk/nrf52840
      - nrf5340dk/nrf5340/cpuapp
      - esp32s3_lcd_ev/esp32s3/procpu
    platform_exclude: litex_vexriscv
    harness: console
    harness_config:
      type: one_line
      regex:
        - "I2S echo sample"
```

## prj.conf
```kconfig
CONFIG_I2S=y
CONFIG_AUDIO=y
CONFIG_AUDIO_CODEC=y
```

## boards/dnesp32s3b_procpu.conf
```kconfig
# Copyright (c) 2025 Chen Xingyu <hi@xingrz.me>
# SPDX-License-Identifier: Apache-2.0

CONFIG_REGULATOR=y
```

## boards/esp32s3_box3_procpu.conf
```kconfig
CONFIG_I2C=y
CONFIG_GPIO=y
CONFIG_AUDIO=y
CONFIG_AUDIO_CODEC=y
CONFIG_ES8311=y
CONFIG_HEAP_MEM_POOL_SIZE=32768
```

## boards/max32655fthr_max32655_m4.conf
```kconfig
#
# Copyright 2026 NXP
#
# SPDX-License-Identifier: Apache-2.0
#

# On MAX32655FTHR, MAX9867 MCLK is connected to external 12.2880 crystal,
# thus using target mode.
CONFIG_SAMPLE_USE_CODEC_CLOCK=y
CONFIG_SAMPLE_FREQ=48000
```

## boards/max32690evkit_max32690_m4.conf
```kconfig
# Copyright The Zephyr Project Contributors
# SPDX-License-Identifier: Apache-2.0

# MAX9867 generates BCLK and LRCLK from its external 12.288 MHz clock.
CONFIG_SAMPLE_USE_CODEC_CLOCK=y
CONFIG_SAMPLE_FREQ=48000
```

## boards/mimxrt1060_evk_mimxrt1062_qspi_C.conf
```kconfig
#
# Copyright 2025 NXP
#
# SPDX-License-Identifier: Apache-2.0
#

CONFIG_HEAP_MEM_POOL_SIZE=81920
CONFIG_AUDIO=y
CONFIG_AUDIO_CODEC=y
```

## boards/mimxrt1064_evk.conf
```kconfig
#
# Copyright 2026 NXP
#
# SPDX-License-Identifier: Apache-2.0
#

CONFIG_SAMPLE_USE_CODEC_CLOCK=y
```

## boards/dnesp32s3b_procpu.overlay
```dts
/*
 * Copyright (c) 2025 Chen Xingyu <hi@xingrz.me>
 * SPDX-License-Identifier: Apache-2.0
 */

i2s_rxtx: &i2s0 {};
```

## boards/esp32_devkitc_procpu.overlay
```dts
/*
 * Copyright (c) 2025 Espressif Systems (Shanghai) Co., Ltd.
 *
 * SPDX-License-Identifier: Apache-2.0
 */

&i2s0_default {
	group1 {
		pinmux = <I2S0_O_WS_GPIO33>,
			 <I2S0_O_BCK_GPIO32>,
			 <I2S0_O_SD_GPIO25>,
			 <I2S0_I_SD_GPIO17>;
	};
};

i2s_rxtx: &i2s0 {
	status = "okay";
};
```

## boards/esp32_devkitc_wrover_procpu.overlay
```dts
/*
 * Copyright (c) 2025 Espressif Systems (Shanghai) Co., Ltd.
 *
 * SPDX-License-Identifier: Apache-2.0
 */

&i2s0_default {
	group1 {
		pinmux = <I2S0_O_WS_GPIO33>,
			 <I2S0_O_BCK_GPIO32>,
			 <I2S0_O_SD_GPIO27>,
			 <I2S0_I_WS_GPIO26>,
			 <I2S0_I_BCK_GPIO25>;
		output-enable;
	};

	group2 {
		pinmux = <I2S0_I_SD_GPIO18>;
		input-enable;
	};
};

i2s_rxtx: &i2s0 {
	status = "okay";

	interrupts = <I2S0_INTR_SOURCE IRQ_DEFAULT_PRIORITY 0>,
		     <I2S0_INTR_SOURCE IRQ_DEFAULT_PRIORITY 0>;
	interrupt-names = "tx", "rx";
};
```

## boards/esp32s2_devkitc.overlay
```dts
/*
 * Copyright (c) 2025 Espressif Systems (Shanghai) Co., Ltd.
 *
 * SPDX-License-Identifier: Apache-2.0
 */

&i2s0_default {
	group1 {
		pinmux = <I2S0_O_WS_GPIO5>,
			 <I2S0_O_BCK_GPIO6>,
			 <I2S0_O_SD_GPIO7>,
			 <I2S0_I_SD_GPIO17>;
	};
};

i2s_rxtx: &i2s0 {
	status = "okay";
};
```

## boards/esp32s3_box3_procpu.overlay
```dts
/*
 * SPDX-License-Identifier: Apache-2.0
 */

/* Alias i2s0 as i2s_rxtx so the echo sample finds it */
i2s_rxtx: &i2s0 {
	status = "okay";
	dmas = <&dma 2>, <&dma 3>;
	dma-names = "rx", "tx";
};

&dma {
	status = "okay";
};
```

## boards/esp32s3_devkitc_procpu.overlay
```dts
/*
 * Copyright (c) 2024-2025 Espressif Systems (Shanghai) Co., Ltd.
 *
 * SPDX-License-Identifier: Apache-2.0
 */

&i2s0_default {
	group1 {
		pinmux = <I2S0_O_WS_GPIO36>,
			 <I2S0_O_BCK_GPIO37>,
			 <I2S0_O_SD_GPIO38>,
			 <I2S0_I_SD_GPIO41>;
	};
};

i2s_rxtx: &i2s0 {

	dmas = <&dma 2>, <&dma 3>;
	dma-names = "rx", "tx";
	status = "okay";
};

&dma {
	status = "okay";
};
```

## dts/bindings/adi,max9867.yaml
```yaml
# Copyright (c) 2021 Nordic Semiconductor ASA
# Copyright (c) 2025 Croxel Inc.
# Copyright The Zephyr Project Contributors
# SPDX-License-Identifier: Apache-2.0

# This binding has been added solely for the purpose of the overlay files used
# in the drivers/i2s/echo sample. That's why it is located in this sample source
# directory. It can be moved and made available more widely if the need arises.

description: MAX9867 Audio CODEC

compatible: "adi,max9867"

include: i2c-device.yaml

properties:
  adi,use-line-in:
    type: boolean
    description: |
      Route the stereo line inputs to the ADCs. If this property is absent,
      the sample configures the digital microphone input instead.

  adi,stereo-capacitorless-output:
    type: boolean
    description: |
      Configure the headphone amplifiers for stereo capacitorless output.
      If this property is absent, the sample uses stereo single-ended
      clickless mode.
```

## dts/bindings/wlf,wm8731.yaml
```yaml
# Copyright (c) 2021 Nordic Semiconductor ASA
# SPDX-License-Identifier: Apache-2.0

# This binding has been added solely for the purpose of the overlay files used
# in the drivers/i2s/echo sample. That's why it is located in this sample source
# directory. It can be moved and made available more widely if the need arises.

description: WM8731 Audio CODEC

compatible: "wlf,wm8731"

include: i2c-device.yaml
```

## dts/bindings/wolfson,wm8731.yaml
```yaml
# Copyright (c) 2021 Nordic Semiconductor ASA
# SPDX-License-Identifier: Apache-2.0

# This binding has been added solely for the purpose of the overlay files used
# in the drivers/i2s/echo sample. That's why it is located in this sample source
# directory. It can be moved and made available more widely if the need arises.

description: WM8731 Audio CODEC

compatible: "wolfson,wm8731"

include: i2c-device.yaml
```

## src/main.c
```c
/*
 * Copyright (c) 2021 Nordic Semiconductor ASA
 *
 * SPDX-License-Identifier: Apache-2.0
 */

#include <zephyr/kernel.h>
#include "codec.h"
#include <zephyr/sys/printk.h>
#include <zephyr/drivers/i2s.h>
#include <zephyr/drivers/gpio.h>
#include <zephyr/audio/codec.h>
#include <string.h>


#if DT_NODE_EXISTS(DT_NODELABEL(i2s_rxtx))
#define I2S_RX_NODE  DT_NODELABEL(i2s_rxtx)
#define I2S_TX_NODE  I2S_RX_NODE
#else
#define I2S_RX_NODE  DT_NODELABEL(i2s_rx)
#define I2S_TX_NODE  DT_NODELABEL(i2s_tx)
#endif

#define RAM_SIZE (DT_CHOSEN_SRAM_ADDR / 1024)

/* Reduce echo delay when running on low ram devices */
#if RAM_SIZE <= 48
#define ECHO_DELAY 30
#else
#define ECHO_DELAY 10
#endif

#define SAMPLE_BIT_WIDTH    16
#define BYTES_PER_SAMPLE    sizeof(int16_t)
#define NUMBER_OF_CHANNELS  2
/* Such block length provides an echo with the delay of 100ms or 33.33ms */
#define SAMPLES_PER_BLOCK   ((CONFIG_SAMPLE_FREQ / ECHO_DELAY) * NUMBER_OF_CHANNELS)
#define INITIAL_BLOCKS      2
#define TIMEOUT             1000

#define SW0_NODE        DT_ALIAS(sw0)
#ifdef CONFIG_TOGGLE_ECHO_EFFECT_SW0
static struct gpio_dt_spec sw0_spec = GPIO_DT_SPEC_GET(SW0_NODE, gpios);
#endif

#define SW1_NODE        DT_ALIAS(sw1)
#ifdef CONFIG_STOP_START_STREAMS_SW1
static struct gpio_dt_spec sw1_spec = GPIO_DT_SPEC_GET(SW1_NODE, gpios);
#endif

#define BLOCK_SIZE  (BYTES_PER_SAMPLE * SAMPLES_PER_BLOCK)
#define BLOCK_COUNT (INITIAL_BLOCKS + 4)
K_MEM_SLAB_DEFINE_STATIC(mem_slab, BLOCK_SIZE, BLOCK_COUNT, 4);

static int16_t echo_block[SAMPLES_PER_BLOCK];
static volatile bool echo_enabled = true;
static K_SEM_DEFINE(toggle_transfer, 1, 1);

#ifdef CONFIG_TOGGLE_ECHO_EFFECT_SW0
static void sw0_handler(const struct device *dev, struct gpio_callback *cb,
			uint32_t pins)
{
	bool enable = !echo_enabled;

	echo_enabled = enable;
	printk("Echo %sabled\n", (enable ? "en" : "dis"));
}
#endif

#ifdef CONFIG_STOP_START_STREAMS_SW1
static void sw1_handler(const struct device *dev, struct gpio_callback *cb,
			uint32_t pins)
{
	k_sem_give(&toggle_transfer);
}
#endif

static bool init_buttons(void)
{
	int ret;

#ifdef CONFIG_TOGGLE_ECHO_EFFECT_SW0
	static struct gpio_callback sw0_cb_data;

	if (!gpio_is_ready_dt(&sw0_spec)) {
		printk("%s is not ready\n", sw0_spec.port->name);
		return false;
	}

	ret = gpio_pin_configure_dt(&sw0_spec, GPIO_INPUT);
	if (ret < 0) {
		printk("Failed to configure %s pin %d: %d\n",
		       sw0_spec.port->name, sw0_spec.pin, ret);
		return false;
	}

	ret = gpio_pin_interrupt_configure_dt(&sw0_spec,
					      GPIO_INT_EDGE_TO_ACTIVE);
	if (ret < 0) {
		printk("Failed to configure interrupt on %s pin %d: %d\n",
		       sw0_spec.port->name, sw0_spec.pin, ret);
		return false;
	}

	gpio_init_callback(&sw0_cb_data, sw0_handler, BIT(sw0_spec.pin));
	gpio_add_callback(sw0_spec.port, &sw0_cb_data);
	printk("Press \"%s\" to toggle the echo effect\n", sw0_spec.port->name);
#endif

#ifdef CONFIG_STOP_START_STREAMS_SW1
	static struct gpio_callback sw1_cb_data;

	if (!gpio_is_ready_dt(&sw1_spec)) {
		printk("%s is not ready\n", sw1_spec.port->name);
		return false;
	}

	ret = gpio_pin_configure_dt(&sw1_spec, GPIO_INPUT);
	if (ret < 0) {
		printk("Failed to configure %s pin %d: %d\n",
		       sw1_spec.port->name, sw1_spec.pin, ret);
		return false;
	}

	ret = gpio_pin_interrupt_configure_dt(&sw1_spec,
					      GPIO_INT_EDGE_TO_ACTIVE);
	if (ret < 0) {
		printk("Failed to configure interrupt on %s pin %d: %d\n",
		       sw1_spec.port->name, sw1_spec.pin, ret);
		return false;
	}

	gpio_init_callback(&sw1_cb_data, sw1_handler, BIT(sw1_spec.pin));
	gpio_add_callback(sw1_spec.port, &sw1_cb_data);
	printk("Press \"%s\" to stop/restart I2S streams\n", sw1_spec.port->name);
#endif

	(void)ret;
	return true;
}

static void process_block_data(void *mem_block, uint32_t number_of_samples)
{
	static bool clear_echo_block;

	if (echo_enabled) {
		for (int i = 0; i < number_of_samples; ++i) {
			int16_t *sample = &((int16_t *)mem_block)[i];
			/* Attenuate both paths by 6 dB before mixing. */
			int32_t mixed_sample = ((int32_t)*sample / 2) + echo_block[i];

			*sample = CLAMP(mixed_sample, INT16_MIN, INT16_MAX);
			echo_block[i] = (*sample) / 2;
		}

		clear_echo_block = true;
	} else if (clear_echo_block) {
		clear_echo_block = false;
		memset(echo_block, 0, sizeof(echo_block));
	}
}

static bool configure_streams(const struct device *i2s_dev_rx,
			      const struct device *i2s_dev_tx,
			      const struct i2s_config *config)
{
	int ret;

	if (i2s_dev_rx == i2s_dev_tx) {
		ret = i2s_configure(i2s_dev_rx, I2S_DIR_BOTH, config);
		if (ret == 0) {
			return true;
		}
		/* -ENOSYS means that the RX and TX streams need to be
		 * configured separately.
		 */
		if (ret != -ENOSYS) {
			printk("Failed to configure streams: %d\n", ret);
			return false;
		}
	}

	ret = i2s_configure(i2s_dev_rx, I2S_DIR_RX, config);
	if (ret < 0) {
		printk("Failed to configure RX stream: %d\n", ret);
		return false;
	}

	ret = i2s_configure(i2s_dev_tx, I2S_DIR_TX, config);
	if (ret < 0) {
		printk("Failed to configure TX stream: %d\n", ret);
		return false;
	}

	return true;
}

static bool prepare_transfer(const struct device *i2s_dev_rx,
			     const struct device *i2s_dev_tx)
{
	int ret;

	for (int i = 0; i < INITIAL_BLOCKS; ++i) {
		void *mem_block;

		ret = k_mem_slab_alloc(&mem_slab, &mem_block, K_NO_WAIT);
		if (ret < 0) {
			printk("Failed to allocate TX block %d: %d\n", i, ret);
			return false;
		}

		memset(mem_block, 0, BLOCK_SIZE);

		ret = i2s_write(i2s_dev_tx, mem_block, BLOCK_SIZE);
		if (ret < 0) {
			printk("Failed to write block %d: %d\n", i, ret);
			return false;
		}
	}

	return true;
}

static bool trigger_command(const struct device *i2s_dev_rx,
			    const struct device *i2s_dev_tx,
			    enum i2s_trigger_cmd cmd)
{
	int ret;

	if (i2s_dev_rx == i2s_dev_tx) {
		ret = i2s_trigger(i2s_dev_rx, I2S_DIR_BOTH, cmd);
		if (ret == 0) {
			return true;
		}
		/* -ENOSYS means that commands for the RX and TX streams need
		 * to be triggered separately.
		 */
		if (ret != -ENOSYS) {
			printk("Failed to trigger command %d: %d\n", cmd, ret);
			return false;
		}
	}

	ret = i2s_trigger(i2s_dev_rx, I2S_DIR_RX, cmd);
	if (ret < 0) {
		printk("Failed to trigger command %d on RX: %d\n", cmd, ret);
		return false;
	}

	ret = i2s_trigger(i2s_dev_tx, I2S_DIR_TX, cmd);
	if (ret < 0) {
		printk("Failed to trigger command %d on TX: %d\n", cmd, ret);
		return false;
	}

	return true;
}

int main(void)
{
	const struct device *const i2s_dev_rx = DEVICE_DT_GET(I2S_RX_NODE);
	const struct device *const i2s_dev_tx = DEVICE_DT_GET(I2S_TX_NODE);
	struct i2s_config config = {0};

	printk("I2S echo sample\n");

#if DT_ON_BUS(DT_NODELABEL(wm8731), i2c)
	if (!init_wm8731_i2c()) {
		return 0;
	}

#elif DT_NODE_HAS_STATUS(DT_NODELABEL(audio_codec), okay)
	const struct device *const codec_dev = DEVICE_DT_GET(DT_NODELABEL(audio_codec));
	struct audio_codec_cfg audio_cfg;
	int ret;

	audio_cfg.dai_route = AUDIO_ROUTE_PLAYBACK_CAPTURE;
	audio_cfg.dai_type = AUDIO_DAI_TYPE_I2S;
	audio_cfg.dai_cfg.i2s.word_size = SAMPLE_BIT_WIDTH;
	audio_cfg.dai_cfg.i2s.channels = NUMBER_OF_CHANNELS;
	audio_cfg.dai_cfg.i2s.format = I2S_FMT_DATA_FORMAT_I2S;
#ifdef CONFIG_SAMPLE_USE_CODEC_CLOCK
	audio_cfg.dai_cfg.i2s.options = I2S_OPT_FRAME_CLK_CONTROLLER | I2S_OPT_BIT_CLK_CONTROLLER;
#else
	audio_cfg.dai_cfg.i2s.options = I2S_OPT_FRAME_CLK_TARGET | I2S_OPT_BIT_CLK_TARGET;
#endif
	audio_cfg.dai_cfg.i2s.frame_clk_freq = CONFIG_SAMPLE_FREQ;
	audio_cfg.dai_cfg.i2s.mem_slab = &mem_slab;
	audio_cfg.dai_cfg.i2s.block_size = BLOCK_SIZE;
	ret = audio_codec_configure(codec_dev, &audio_cfg);
	if (ret < 0) {
		printk("Failed to configure codec: %d\n", ret);
		return ret;
	}
	k_msleep(1000);
#endif

#if DT_ON_BUS(MAX9867_NODE, i2c)
	if (!init_max9867_i2c()) {
		return 0;
	}
#endif

	if (!init_buttons()) {
		return 0;
	}

	if (!device_is_ready(i2s_dev_rx)) {
		printk("%s is not ready\n", i2s_dev_rx->name);
		return 0;
	}

	if (i2s_dev_rx != i2s_dev_tx && !device_is_ready(i2s_dev_tx)) {
		printk("%s is not ready\n", i2s_dev_tx->name);
		return 0;
	}

	config.word_size = SAMPLE_BIT_WIDTH;
	config.channels = NUMBER_OF_CHANNELS;
	config.format = I2S_FMT_DATA_FORMAT_I2S;

#if defined(CONFIG_SAMPLE_USE_CODEC_CLOCK)
	config.options = I2S_OPT_FRAME_CLK_TARGET | I2S_OPT_BIT_CLK_TARGET;
#else
	config.options = I2S_OPT_FRAME_CLK_CONTROLLER | I2S_OPT_BIT_CLK_CONTROLLER;
#endif
	config.frame_clk_freq = CONFIG_SAMPLE_FREQ;
	config.mem_slab = &mem_slab;
	config.block_size = BLOCK_SIZE;
	config.timeout = TIMEOUT;
	if (!configure_streams(i2s_dev_rx, i2s_dev_tx, &config)) {
		return 0;
	}

	for (;;) {
		k_sem_take(&toggle_transfer, K_FOREVER);

		if (!prepare_transfer(i2s_dev_rx, i2s_dev_tx)) {
			return 0;
		}

		if (!trigger_command(i2s_dev_rx, i2s_dev_tx,
				     I2S_TRIGGER_START)) {
			return 0;
		}

		printk("Streams started\n");

		while (k_sem_take(&toggle_transfer, K_NO_WAIT) != 0) {
			void *mem_block;
			size_t block_size;
			int ret;

			ret = i2s_read(i2s_dev_rx, &mem_block, &block_size);
			if (ret < 0) {
				printk("Failed to read data: %d\n", ret);
				break;
			}

			process_block_data(mem_block, SAMPLES_PER_BLOCK);

			ret = i2s_write(i2s_dev_tx, mem_block, block_size);
			if (ret < 0) {
				printk("Failed to write data: %d\n", ret);
				break;
			}
		}

		if (!trigger_command(i2s_dev_rx, i2s_dev_tx,
				     I2S_TRIGGER_DROP)) {
			return 0;
		}

		printk("Streams stopped\n");
	}
}
```

## src/codec.c
```c
/*
 * Copyright (c) 2021 Nordic Semiconductor ASA
 * Copyright (c) 2025 Croxel Inc
 * Copyright The Zephyr Project Contributors
 *
 * SPDX-License-Identifier: Apache-2.0
 */

#include <zephyr/kernel.h>
#include "codec.h"
#include <zephyr/sys/printk.h>
#include <zephyr/drivers/i2c.h>

#if DT_ON_BUS(WM8731_NODE, i2c)

#if CONFIG_SAMPLE_FREQ != 44100
#error "The WM8731 configuration supports only a 44.1 kHz sample frequency"
#endif

#define WM8731_I2C_NODE DT_BUS(WM8731_NODE)
#define WM8731_I2C_ADDR DT_REG_ADDR(WM8731_NODE)

bool init_wm8731_i2c(void)
{
	const struct device *const i2c_dev = DEVICE_DT_GET(WM8731_I2C_NODE);

	/* Initialization data for WM8731 registers. */
	static const uint8_t init[][2] = {
		/*
		 * Reset Register:
		 * [8:0] RESET = 0 (reset device)
		 */
		{ 0x1E, 0x00 },
		/*
		 * Power Down Control:
		 *   [7] POWEROFF = 0 (Disable POWEROFF)
		 *   [6] CLKOUTPD = 1 (Enable Power Down)
		 *   [5] OSCPDD = 0 (Disable Power Down)
		 *   [4] OUTPD = 1 (Enable Power Down)
		 *   [3] DACPD = 0 (Disable Power Down)
		 *   [2] ADCPD = 0 (Disable Power Down)
		 *   [1] MICPD = 1 (Enable Power Down)
		 *   [0] LINEINPD = 0 (Disable Power Down)
		 */
		{ 0x0C, 0x52 },
		/*
		 * Left Line In:
		 *   [8] LRINBOTH = 1 (Enable Simultaneous Load)
		 *   [7] LINMUTE = 0 (Disable Mute)
		 * [4:0] LINVOL = 0x07 (-24 dB)
		 */
		{ 0x01, 0x07 },
		/*
		 * Left Headphone Out:
		 *   [8] LRHPBOTH = 1 (Enable Simultaneous Load)
		 *   [7] LZCEN = 0 (Disable)
		 * [6:0] LHPVOL = 0x79 (0 dB)
		 */
		{ 0x05, 0x79 },
		/*
		 * Analogue Audio Path Control:
		 * [7:6] SIDEATT = 0 (-6 dB)
		 *   [5] SIDETONE = 0 (Disable Side Tone)
		 *   [4] DACSEL = 1 (Select DAC)
		 *   [3] BYPASS = 0 (Disable Bypass)
		 *   [2] INSEL = 0 (Line Input Select to ADC)
		 *   [1] MUTEMIC = 1 (Enable Mute)
		 *   [0] MICBOOST = 0 (Disable Boost)
		 */
		{ 0x08, 0x12 },
		/*
		 * Digital Audio Path Control:
		 *   [4] HPOR = 0 (clear offset)
		 *   [3] DACMU = 0 (Disable soft mute)
		 * [2:1] DEEMP = 0 (Disable)
		 *   [0] ADCHPD = 1 (Disable High Pass Filter)
		 */
		{ 0x0A, 0x01 },
		/*
		 * Digital Audio Interface Format:
		 *   [7] BCLKINV = 0 (Don't invert BCLK)
		 *   [6] MS = 0 (Enable Slave Mode)
		 *   [5] LRSWAP = 0 (Right Channel DAC Data Right)
		 *   [4] LRP = 1 (Right Channel DAC data when DACLRC high)
		 * [3:2] IWL = 0 (16 bits)
		 * [1:0] FORMAT = 2 (I2S Format)
		 */
		{ 0x0E, 0x12 },
		/*
		 * Sampling Control:
		 *   [7] CLKODIV2 = 0 (CLOCKOUT is Core Clock)
		 *   [6] CLKIDIV2 = 0 (Core Clock is MCLK)
		 * [5:2] SR = 0x8 (44.1 kHz)
		 *   [1] BOSR = 0 (256fs)
		 *   [0] USB/NORMAL = 0 (Normal mode)
		 */
		{ 0x10, 0x20 },
		/*
		 * Active Control:
		 * [0] ACTIVE = 1 (Active)
		 */
		{ 0x12, 0x01 },
		/*
		 * As recommended in WAN_0111, set the OUTPD bit in the Power
		 * Down Control register to 0 at the very end of the power-on
		 * sequence.
		 */
		{ 0x0C, 0x42 }
	};

	if (!device_is_ready(i2c_dev)) {
		printk("%s is not ready\n", i2c_dev->name);
		return false;
	}

	for (int i = 0; i < ARRAY_SIZE(init); ++i) {
		const uint8_t *entry = init[i];
		int ret;

		ret = i2c_reg_write_byte(i2c_dev, WM8731_I2C_ADDR,
					 entry[0], entry[1]);
		if (ret < 0) {
			printk("Initialization step %d failed\n", i);
			return false;
		}
	}

	return true;
}

#endif /* DT_ON_BUS(WM8731_NODE, i2c) */

#if DT_ON_BUS(MAX9867_NODE, i2c)

#define MAX9867_I2C_NODE             DT_BUS(MAX9867_NODE)
#define MAX9867_I2C_ADDR             DT_REG_ADDR(MAX9867_NODE)
/* Register addresses */
#define MAX9867_00_STATUS            0x00
#define MAX9867_01_JACKSENSE         0x01
#define MAX9867_02_AUX_HIGH          0x02
#define MAX9867_03_AUX_LOW           0x03
#define MAX9867_04_INT_EN            0x04
#define MAX9867_05_SYS_CLK           0x05
#define MAX9867_06_CLK_HIGH          0x06
#define MAX9867_07_CLK_LOW           0x07
#define MAX9867_08_DAI_FORMAT        0x08
#define MAX9867_09_DAI_CLOCK         0x09
#define MAX9867_0A_DIG_FILTER        0x0A
#define MAX9867_0B_SIDETONE          0x0B
#define MAX9867_0C_LVL_DAC           0x0C
#define MAX9867_0D_LVL_ADC           0x0D
#define MAX9867_0E_LVL_LINE_IN_LEFT  0x0E
#define MAX9867_0F_LVL_LINE_IN_RIGHT 0x0F
#define MAX9867_10_VOL_LEFT          0x10
#define MAX9867_11_VOL_RIGHT         0x11
#define MAX9867_12_MIC_GAIN_LEFT     0x12
#define MAX9867_13_MIC_GAIN_RIGHT    0x13
#define MAX9867_14_ADC_INPUT         0x14
#define MAX9867_15_MIC               0x15
#define MAX9867_16_MODE              0x16
#define MAX9867_17_PWR_SYS           0x17
#define MAX9867_FF_REV_ID            0xFF

/* MAX9867_04_INT_EN */
#define MAX9867_ICLD   (1 << 7)
#define MAX9867_SDODLY (1 << 2)

/* MAX9867_05_SYS_CLK */
#define MAX9867_PSCLK_POS 4

/* MAX9867_06_CLK_HIGH */
#define MAX9867_PLL              (1 << 7)
#define MAX9867_NI_UPPER_8KHZ    0x10
#define MAX9867_NI_UPPER_16KHZ   0x20
#define MAX9867_NI_UPPER_24KHZ   0x30
#define MAX9867_NI_UPPER_32KHZ   0x40
#define MAX9867_NI_UPPER_44p1KHZ 0x58
#define MAX9867_NI_UPPER_48KHZ   0x60

/* MAX9867_07_CLK_LOW */
#define MAX9867_NI_LOWER_OTHER   0x00
#define MAX9867_NI_LOWER_44p1KHZ 0x33

#if CONFIG_SAMPLE_FREQ == 44100
#define MAX9867_NI_UPPER MAX9867_NI_UPPER_44p1KHZ
#define MAX9867_NI_LOWER MAX9867_NI_LOWER_44p1KHZ
#elif CONFIG_SAMPLE_FREQ == 48000
#define MAX9867_NI_UPPER MAX9867_NI_UPPER_48KHZ
#define MAX9867_NI_LOWER MAX9867_NI_LOWER_OTHER
#else
#error "The MAX9867 configuration supports only 44.1 kHz and 48 kHz sample frequencies"
#endif

/* MAX9867_08_DAI_FORMAT */
#define MAX9867_MAS    (1 << 7)
#define MAX9867_WCI    (1 << 6)
#define MAX9867_BCI    (1 << 5)
#define MAX9867_DLY    (1 << 4)
#define MAX9867_HIZOFF (1 << 3)
#define MAX9867_TDM    (1 << 2)

/* MAX9867_09_DAI_CLOCK */
#define MAX9867_BSEL_PCLK_DIV8 0x06

/* MAX9867_0D_LVL_ADC */
#define MAX9867_AVL_POS 4
#define MAX9867_AVR_POS 0

/*
 * MAX9867_0E_LVL_LINE_IN_LEFT
 * MAX9867_0F_LVL_LINE_IN_RIGHT
 */
#define MAX9867_LI_MUTE         (1 << 6)
#define MAX9867_LI_GAIN_POS     0
#define MAX9867_LI_GAIN_NEG_6DB 0x0F

/*
 * MAX9867_10_VOL_LEFT
 * MAX9867_11_VOL_RIGHT
 */
#define MAX9867_VOL_POS     0
#define MAX9867_VOL_GAIN_0DB 0x09

/* MAX9867_14_ADC_INPUT */
#define MAX9867_MXINL_POS       6
#define MAX9867_MXINR_POS       4
#define MAX9867_MXIN_DIS        0
#define MAX9867_MXIN_ANALOG_MIC 1
#define MAX9867_MXIN_LINE       2

/* MAX9867_15_MIC */
#define MAX9867_MICCLK_POS  6
#define MAX9867_DIGMICL_POS 5
#define MAX9867_DIGMICR_POS 4

/* MAX9867_16_MODE */
#define MAX9867_HPMODE_POS          0
#define MAX9867_STEREO_CAPLESS      2
#define MAX9867_STEREO_SE_CLICKLESS 4

#if DT_PROP(MAX9867_NODE, adi_stereo_capacitorless_output)
#define MAX9867_HEADPHONE_MODE MAX9867_STEREO_CAPLESS
#else
#define MAX9867_HEADPHONE_MODE MAX9867_STEREO_SE_CLICKLESS
#endif

/* MAX9867_17_PWR_SYS */
#define MAX9867_SHDN  (1 << 7)
#define MAX9867_LNLEN (1 << 6)
#define MAX9867_LNREN (1 << 5)
#define MAX9867_DALEN (1 << 3)
#define MAX9867_DAREN (1 << 2)
#define MAX9867_ADLEN (1 << 1)
#define MAX9867_ADREN (1 << 0)

#if DT_PROP(MAX9867_NODE, adi_use_line_in)
#define MAX9867_MIC_CONFIG 0
#define MAX9867_ADC_INPUT_CONFIG                                                                   \
	((MAX9867_MXIN_LINE << MAX9867_MXINL_POS) | (MAX9867_MXIN_LINE << MAX9867_MXINR_POS))
#define MAX9867_INPUT_POWER (MAX9867_LNLEN | MAX9867_LNREN | MAX9867_ADLEN | MAX9867_ADREN)
#else
#define MAX9867_MIC_CONFIG       (0x1 << MAX9867_DIGMICR_POS)
#define MAX9867_ADC_INPUT_CONFIG 0
#define MAX9867_INPUT_POWER      MAX9867_ADLEN
#endif

bool init_max9867_i2c(void)
{
	const struct device *const i2c_dev = DEVICE_DT_GET(MAX9867_I2C_NODE);

	/* Initialization data for MAX9867 registers. */
	static const uint8_t init[][2] = {
		/* Shutdown MAX9867 during configuration */
		{MAX9867_17_PWR_SYS, 0x00},
		/*
		 * Clear all regs to POR state. The MAX9867 does not not have an external
		 * reset signal. So manually writing 0, from (0x04 - 0x17)
		 */
		{MAX9867_04_INT_EN, 0x00},
		{MAX9867_05_SYS_CLK, 0x00},
		{MAX9867_06_CLK_HIGH, 0x00},
		{MAX9867_07_CLK_LOW, 0x00},
		{MAX9867_08_DAI_FORMAT, 0x00},
		{MAX9867_09_DAI_CLOCK, 0x00},
		{MAX9867_0A_DIG_FILTER, 0x00},
		{MAX9867_0B_SIDETONE, 0x00},
		{MAX9867_0C_LVL_DAC, 0x00},
		{MAX9867_0D_LVL_ADC, 0x00},
		{MAX9867_0E_LVL_LINE_IN_LEFT, 0x00},
		{MAX9867_0F_LVL_LINE_IN_RIGHT, 0x00},
		{MAX9867_10_VOL_LEFT, 0x00},
		{MAX9867_11_VOL_RIGHT, 0x00},
		{MAX9867_12_MIC_GAIN_LEFT, 0x00},
		{MAX9867_13_MIC_GAIN_RIGHT, 0x00},
		{MAX9867_14_ADC_INPUT, 0x00},
		{MAX9867_15_MIC, 0x00},
		{MAX9867_16_MODE, 0x00},
		{MAX9867_17_PWR_SYS, 0x00},
		/*
		 * Select MCLK prescaler. PSCLK divides MCLK to generate a PCLK between 10MHz and
		 * 20MHz. Set prescaler, FREQ field is 0 for Normal or PLL mode, < 20MHz.
		 */
		{MAX9867_05_SYS_CLK, 0x01 << MAX9867_PSCLK_POS},
		/* Configure the sampling frequency in controller mode. */
		{MAX9867_06_CLK_HIGH, MAX9867_NI_UPPER},
		{MAX9867_07_CLK_LOW, MAX9867_NI_LOWER},
		{MAX9867_09_DAI_CLOCK, MAX9867_BSEL_PCLK_DIV8},
		/* I2S format */
		{MAX9867_08_DAI_FORMAT, MAX9867_MAS | MAX9867_DLY | MAX9867_HIZOFF},
		/* */
		{MAX9867_0A_DIG_FILTER, 0xA2},
		/* Select the digital microphone or line input. */
		{MAX9867_15_MIC, MAX9867_MIC_CONFIG},
		{MAX9867_14_ADC_INPUT, MAX9867_ADC_INPUT_CONFIG},
		/* ADC level */
		{MAX9867_0D_LVL_ADC, (3 << MAX9867_AVL_POS) | (3 << MAX9867_AVR_POS)},
		/* Set line-in level, disconnect line input from playback amplifiers. */
		{MAX9867_0E_LVL_LINE_IN_LEFT,
		 (MAX9867_LI_GAIN_NEG_6DB << MAX9867_LI_GAIN_POS) | MAX9867_LI_MUTE},
		{MAX9867_0F_LVL_LINE_IN_RIGHT,
		 (MAX9867_LI_GAIN_NEG_6DB << MAX9867_LI_GAIN_POS) | MAX9867_LI_MUTE},
		/* Configure the headphone output mode. */
		{MAX9867_16_MODE, MAX9867_HEADPHONE_MODE << MAX9867_HPMODE_POS},
		/* Set the nominal playback gain to 0 dB. */
		{MAX9867_10_VOL_LEFT, MAX9867_VOL_GAIN_0DB << MAX9867_VOL_POS},
		{MAX9867_11_VOL_RIGHT, MAX9867_VOL_GAIN_0DB << MAX9867_VOL_POS},
		/* Enable */
		{MAX9867_17_PWR_SYS,
		 MAX9867_SHDN | MAX9867_DALEN | MAX9867_DAREN | MAX9867_INPUT_POWER},
	};

	if (!device_is_ready(i2c_dev)) {
		printk("%s is not ready\n", i2c_dev->name);
		return false;
	}

	for (int i = 0; i < ARRAY_SIZE(init); ++i) {
		const uint8_t *entry = init[i];
		int ret;

		ret = i2c_reg_write_byte(i2c_dev, MAX9867_I2C_ADDR, entry[0], entry[1]);
		if (ret < 0) {
			printk("Initialization step %d failed with %d\n", i, ret);
			return false;
		}
	}

	return true;
}

#endif /* DT_ON_BUS(MAX9867_NODE, i2c) */
```

## src/codec.h
```c
/*
 * Copyright (c) 2021 Nordic Semiconductor ASA
 * Copyright (c) 2025 Croxel Inc
 *
 * SPDX-License-Identifier: Apache-2.0
 */

#define WM8731_NODE DT_NODELABEL(wm8731)
#define MAX9867_NODE DT_NODELABEL(max9867)
#define ES8311_NODE DT_NODELABEL(es8311)

#if DT_ON_BUS(WM8731_NODE, i2c)
bool init_wm8731_i2c(void);
#endif

#if DT_ON_BUS(MAX9867_NODE, i2c)
bool init_max9867_i2c(void);
#endif

#if DT_NODE_EXISTS(ES8311_NODE)
bool init_es8311(void);
#endif
```
