/*
 * Copyright (c) 2025 Espressif Systems (Shanghai) Co., Ltd.
 *
 * SPDX-License-Identifier: Apache-2.0
 */

&i2s0_default {
	group1 {
		pinmux = <I2S0_O_WS_GPIO33>,
			 <I2S0_O_BCK_GPIO32>,
			 <I2S0_O_SD_GPIO25>,
			 <I2S0_I_SD_GPIO17>;
	};
};

i2s_rxtx: &i2s0 {
	status = "okay";
};
