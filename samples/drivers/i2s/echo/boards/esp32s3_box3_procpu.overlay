/*
 * SPDX-License-Identifier: Apache-2.0
 */

/* Alias i2s0 as i2s_rxtx so the echo sample finds it */
i2s_rxtx: &i2s0 {
	status = "okay";
	dmas = <&dma 2>, <&dma 3>;
	dma-names = "rx", "tx";
};

&dma {
	status = "okay";
};
