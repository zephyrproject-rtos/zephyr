/*
 * Copyright (c) 2024-2025 Espressif Systems (Shanghai) Co., Ltd.
 *
 * SPDX-License-Identifier: Apache-2.0
 */

&i2s0_default {
	group1 {
		pinmux = <I2S0_O_WS_GPIO36>,
			 <I2S0_O_BCK_GPIO37>,
			 <I2S0_O_SD_GPIO38>,
			 <I2S0_I_SD_GPIO41>;
	};
};

i2s_rxtx: &i2s0 {
	status = "okay";

	dmas = <&dma 2>, <&dma 3>;
	dma-names = "rx", "tx";
};

&dma {
	status = "okay";
};
