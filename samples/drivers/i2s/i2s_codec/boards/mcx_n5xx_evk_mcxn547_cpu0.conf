## samples/drivers/i2s/i2s_codec/boards/mcx_n5xx_evk_mcxn547_cpu0.conf
```kconfig
# Copyright 2025 NXP
#
# SPDX-License-Identifier: Apache-2.0

CONFIG_DMA_TCD_QUEUE_SIZE=4
CONFIG_AUDIO_CODEC_DA7212=y
CONFIG_SAMPLE_FREQ=16000
CONFIG_I2S_INIT_BUFFERS=1
CONFIG_USE_CODEC_CLOCK=y
CONFIG_USE_DMIC=y
CONFIG_DMIC_CHANNELS=2
CONFIG_EXTRA_BLOCKS=10
CONFIG_SAMPLE_WIDTH=32
CONFIG_BYTES_PER_SAMPLE=4
```

## samples/drivers/i2s/i2s_codec/boards/mimxrt1060_evk_mimxrt1062_qspi_C.conf
```kconfig
#
# Copyright 2025 NXP
#
# SPDX-License-Identifier: Apache-2.0
#

CONFIG_USE_DMIC=n
```

## samples/drivers/i2s/i2s_codec/boards/mimxrt1064_evk.conf
```kconfig
#
# Copyright 2026 NXP
#
# SPDX-License-Identifier: Apache-2.0
#

CONFIG_HEAP_MEM_POOL_SIZE=81920
CONFIG_DMA_TCD_QUEUE_SIZE=4
CONFIG_USE_CODEC_CLOCK=y
```

## samples/drivers/i2s/i2s_codec/boards/mimxrt1170_evk_mimxrt1176_cm4.conf
```kconfig
#
# Copyright 2025 NXP
#
# SPDX-License-Identifier: Apache-2.0
#

# Sample rate decreased because of available memory
CONFIG_SAMPLE_FREQ=4000
```

## samples/drivers/i2s/i2s_codec/boards/mimxrt1170_evk_mimxrt1176_cm7.conf
```kconfig
#
# Copyright 2025 NXP
#
# SPDX-License-Identifier: Apache-2.0
#

CONFIG_DMA_TCD_QUEUE_SIZE=4
CONFIG_USE_DMIC=n
```

## samples/drivers/i2s/i2s_codec/boards/mimxrt1170_evk_mimxrt1176_cm7_A.conf
```kconfig
#
# Copyright 2026 NXP
#
# SPDX-License-Identifier: Apache-2.0
#

CONFIG_DMA_TCD_QUEUE_SIZE=4
CONFIG_USE_DMIC=n
CONFIG_USE_CODEC_CLOCK=y
```

## samples/drivers/i2s/i2s_codec/boards/mimxrt1180_evk_mimxrt1189_cm33.conf
```kconfig
#
# Copyright 2025 NXP
#
# SPDX-License-Identifier: Apache-2.0
#

CONFIG_HEAP_MEM_POOL_SIZE=81920
CONFIG_SAMPLE_FREQ=16000
CONFIG_USE_DMIC=n
```

## samples/drivers/i2s/i2s_codec/boards/mimxrt595_evk_mimxrt595s_cm33.conf
```kconfig
#
# Copyright 2024, 2025 NXP
#
# SPDX-License-Identifier: Apache-2.0
#

CONFIG_I3C=y
CONFIG_USE_DMIC=y
CONFIG_USE_CODEC_CLOCK=y
```

## samples/drivers/i2s/i2s_codec/boards/mimxrt700_evk_mimxrt798s_cm33_cpu0.conf
```kconfig
#
# Copyright 2026 NXP
#
# SPDX-License-Identifier: Apache-2.0
#

CONFIG_DMA_TCD_QUEUE_SIZE=4
CONFIG_I2S_INIT_BUFFERS=2
CONFIG_EXTRA_BLOCKS=10

CONFIG_USE_DMIC=y
CONFIG_DMIC_CHANNELS=2
CONFIG_USE_CODEC_CLOCK=n

CONFIG_SAMPLE_WIDTH=32
CONFIG_BYTES_PER_SAMPLE=4
```

## samples/drivers/i2s/i2s_codec/boards/rd_rw612_bga.conf
```kconfig
#
# Copyright 2025 NXP
#
# SPDX-License-Identifier: Apache-2.0
#


CONFIG_USE_DMIC=y
CONFIG_SAMPLE_USE_CODEC_CLOCK=y
```

## samples/drivers/i2s/i2s_codec/boards/stm32f4_disco.conf
```kconfig
# Copyright 2025 Titouan Christophe
# SPDX-License-Identifier: Apache-2.0

# Even though the stm32f4_disco board overlay is tuned for 22.05/44.1/88.2kHz
# audio output, it hasn't enough RAM to hold all buffers allocated by this
# sample at such higher audio rates
CONFIG_SAMPLE_FREQ=8000
CONFIG_AUDIO_CODEC=y
```

## samples/drivers/i2s/i2s_codec/sample.yaml
```yaml
sample:
  name: codec sample
tests:
  sample.drivers.i2s.codec:
    tags: i2s
    platform_allow:
      - mimxrt595_evk/mimxrt595s/cm33
      - mimxrt1170_evk@B/mimxrt1176/cm7
      - mimxrt700_evk/mimxrt798s/cm33_cpu0
      - mimxrt1060_evk/mimxrt1062/qspi
    harness: console
    harness_config:
      type: one_line
      regex:
        - "start streams"
```

## samples/drivers/i2s/litex/sample.yaml
```yaml
sample:
  description: I2S sample

  name: i2s example
common:
  tags: introduction
  harness: console
  harness_config:
    type: one_line
    regex:
      - "i2s example (.*)"
```

## samples/drivers/i2s/output/boards/ek_ra8d1.conf
```kconfig
#
# Copyright (c) 2025 Renesas Electronics Corporation
#
# SPDX-License-Identifier: Apache-2.0
#

CONFIG_PWM=y
CONFIG_CLOCK_CONTROL=y
CONFIG_I2S_INIT_PRIORITY=52
CONFIG_CLOCK_CONTROL_FIXED_RATE_CLOCK=y
```

## samples/drivers/i2s/output/boards/ek_ra8m2_r7ka8m2jflcac_cm85.conf
```kconfig
# Copyright (c) 2025 Renesas Electronics Corporation
# SPDX-License-Identifier: Apache-2.0

CONFIG_I2S_INIT_PRIORITY=52
```

## samples/drivers/i2s/output/boards/imx95_evk_mimx9596_m7.conf
```kconfig
# Copyright 2026 NXP
# SPDX-License-Identifier: Apache-2.0

# Enable nocache memory for DMA descriptors
CONFIG_NOCACHE_MEMORY=y

# Disable PLL setting as imx95 uses SCMI for clock management
CONFIG_I2S_HAS_PLL_SETTING=n

# Raise DMA TCD Queue size, as this is required by the I2S SAI driver
CONFIG_DMA_TCD_QUEUE_SIZE=4
CONFIG_GPIO=y
CONFIG_GPIO_PCAL64XXA=y
CONFIG_GPIO_HOGS=y
```

## samples/drivers/i2s/output/boards/imx95_evk_mimx9596_m7_ddr.conf
```kconfig
# Copyright 2026 NXP
# SPDX-License-Identifier: Apache-2.0

# Enable nocache memory for DMA descriptors
CONFIG_NOCACHE_MEMORY=y

# Disable PLL setting as imx95 uses SCMI for clock management
CONFIG_I2S_HAS_PLL_SETTING=n

CONFIG_GPIO=y
CONFIG_GPIO_PCAL64XXA=y
CONFIG_GPIO_HOGS=y
```

## samples/drivers/i2s/output/boards/mimxrt1180_evk_mimxrt1189_cm7.conf
```kconfig
# Raise DMA TCD Queue size, as this is required by the I2S SAI driver
CONFIG_DMA_TCD_QUEUE_SIZE=4
```

## samples/drivers/i2s/output/boards/nucleo_c5a3zg.conf
```kconfig
# Copyright (c) 2026 Mario Paja
# SPDX-License-Identifier: Apache-2.0

CONFIG_SAMPLE_I2S_OPT_BIT_CLK_GATED=y
```

## samples/drivers/i2s/output/boards/nucleo_h723zg.conf
```kconfig
# SPDX-FileCopyrightText: Copyright The Zephyr Project Contributors
# SPDX-License-Identifier: Apache-2.0

CONFIG_SAMPLE_I2S_OPT_BIT_CLK_GATED=y
```

## samples/drivers/i2s/output/boards/nucleo_h7a3zi_q.conf
```kconfig
# SPDX-FileCopyrightText: Copyright (c) 2026 Mario Paja
# SPDX-License-Identifier: Apache-2.0

CONFIG_HEAP_MEM_POOL_SIZE=4192
```

## samples/drivers/i2s/output/boards/nucleo_l432kc.conf
```kconfig
# SPDX-FileCopyrightText: Copyright The Zephyr Project Contributors
# SPDX-License-Identifier: Apache-2.0

CONFIG_HEAP_MEM_POOL_SIZE=4192
```

## samples/drivers/i2s/output/boards/nucleo_u575zi_q.conf
```kconfig
# SPDX-FileCopyrightText: Copyright The Zephyr Project Contributors
# SPDX-License-Identifier: Apache-2.0

CONFIG_HEAP_MEM_POOL_SIZE=4192
CONFIG_SAMPLE_I2S_OPT_BIT_CLK_GATED=y
```

## samples/drivers/i2s/output/sample.yaml
```yaml
sample:
  description: I2S Output Sample
  name: i2s_output
common:
  tags:
    - drivers
    - i2s
tests:
  sample.drivers.i2s.output:
    filter: dt_alias_exists("i2s-tx")
    integration_platforms:
      - mimxrt1060_evk@B/mimxrt1062/qspi
      - mimxrt1060_evk@C/mimxrt1062/qspi
      - mimxrt700_evk/mimxrt798s/cm33_cpu0
      - mimxrt1170_evk/mimxrt1176/cm7
      - mimxrt1180_evk/mimxrt1189/cm33
      - mimxrt1180_evk/mimxrt1189/cm7
    extra_configs:
      - CONFIG_DMA_TCD_QUEUE_SIZE=4
    harness: console
    harness_config:
      type: one_line
      regex:
        - "All I2S blocks written"
```

## samples/drivers/i3c/i3c_scan/sample.yaml
```yaml
sample:
  name: I3C Bus Scan
  description: Discover and display all I3C and I2C devices on an I3C bus.
common:
  tags: i3c
  filter: dt_chosen_enabled("zephyr,i3c") or
          dt_compat_enabled("snps,designware-i3c") or
          dt_compat_enabled("cdns,i3c")
  harness: console
  harness_config:
    type: multi_line
    ordered: true
    regex:
      - "I3C Bus Discovery Sample"
      - "Scan Complete"
```
