## CMakeLists.txt
```
# Copyright (c) 2026 Nordic Semiconductor ASA
# SPDX-License-Identifier: Apache-2.0

cmake_minimum_required(VERSION 3.20.0)

find_package(Zephyr REQUIRED HINTS $ENV{ZEPHYR_BASE})
project(regulator_ship_mode)

target_sources(app PRIVATE src/main.c)
```

## prj.conf
```kconfig
# Copyright (c) 2026 Nordic Semiconductor ASA
# SPDX-License-Identifier: Apache-2.0

CONFIG_REGULATOR=y

# Wait before entering ship mode to avoid deadlocking
# devices which can not be debugged while in ship mode
CONFIG_BOOT_DELAY=2000
```

## boards/nrf54lv10dk_nrf54lv10a_cpuapp.overlay
```dts
/*
 * Copyright (c) 2026 Nordic Semiconductor ASA
 *
 * SPDX-License-Identifier: Apache-2.0
 */

/ {
	aliases {
		regulator-parent = &regulators;
	};
};

&regulators {
	status = "okay";
};
```

## src/main.c
```c
/*
 * Copyright (c) 2026 Nordic Semiconductor ASA
 *
 * SPDX-License-Identifier: Apache-2.0
 */

#include <zephyr/drivers/regulator.h>
#include <zephyr/kernel.h>

const struct device *regulator_parent = DEVICE_DT_GET(DT_ALIAS(regulator_parent));

int main(void)
{
	int ret;

	if (!device_is_ready(regulator_parent)) {
		printk("%s is not ready\n", regulator_parent->name);
		return 0;
	}

	printk("%s entering ship mode\n", regulator_parent->name);
	k_busy_wait(10000);

	ret = regulator_parent_ship_mode(regulator_parent);
	printk("%s failed to enter ship mode (ret = %i)\n", regulator_parent->name, ret);
	return 0;
}
```
