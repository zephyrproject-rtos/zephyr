/* SPDX-License-Identifier: Apache-2.0 */

&arduino_i2c {
	status = "okay";
	clock-frequency = <I2C_BITRATE_STANDARD>;

	pca9634@70 {
		compatible = "nxp,pca9634";
		external-driver;
		reg = <0x70>;
		label = "PCA9634";
	};
};
