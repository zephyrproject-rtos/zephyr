/* SPDX-License-Identifier: Apache-2.0 */

&arduino_i2c {
	status = "okay";
	clock-frequency = <I2C_BITRATE_STANDARD>;

	pca9956@70 {
		compatible = "nxp,pca9956";
		default-iref = <255>;
		reg = <0x70>;
		label = "PCA9956";
	};
};
