/* SPDX-License-Identifier: Apache-2.0 */

&arduino_i2c {
	status = "okay";
	clock-frequency = <I2C_BITRATE_STANDARD>;

	tlc59108@4d {
		compatible = "ti,tlc59108";
		reg = <0x4d>;
		label = "TLC59108";
	};
};
