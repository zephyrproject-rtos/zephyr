/*
 * Copyright (c) 2025 Nordic Semiconductor ASA
 *
 * SPDX-License-Identifier: Apache-2.0
 */

&pinctrl {
	pdm20_default_alt: pdm20_default_alt {
		group1 {
			psels = <NRF_PSEL(PDM_CLK, 1, 23)>,
				<NRF_PSEL(PDM_DIN, 1, 24)>;
		};
	};
};

dmic_dev: &pdm20 {
	status = "okay";
	pinctrl-0 = <&pdm20_default_alt>;
	pinctrl-names = "default";
	clock-source = "PCLK32M";
};
