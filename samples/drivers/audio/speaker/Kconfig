## samples/drivers/audio/speaker/Kconfig
```kconfig
# Copyright (c) 2023, ithinx GmbH
# Copyright (c) 2023, tonies GmbH
#
# SPDX-License-Identifier: Apache-2.0

source "Kconfig.zephyr"

config APP_AUDIO_SAMPLE_FREQ
    int "Audio sample frequency (Hz)"
    default 48000

config APP_AUDIO_NUM_CHANNELS
    int "Number of audio channels"
    default 4

config APP_AUDIO_SAMPLES
    int "Number of audio samples"
    default 64

config APP_AUDIO_SAMPLE_BIT_WIDTH
    int "Audio sample bit width (bits)"
    default 16

config APP_I2S_PLAY_BUF_COUNT
    int "Number of I2S playback buffers"
    default 20

config APP_I2S_TX_PRELOAD_BUF_COUNT
    int "Number of I2S buffers preloaded with silence"
    default 2

module = APP
module-str = Application
source "subsys/logging/Kconfig.template.log_config"
```

## samples/drivers/audio/speaker/sample.yaml
```yaml
---
sample:
  name: Speaker sample
tests:
  sample.drivers.audio.speaker:
    tags: speaker
    platform_allow:
      - mimxrt1060_evkb
    integration_platforms:
      - mimxrt1060_evkb
    harness: console
    harness_config:
      fixture: tas2x63evm
      type: multi_line
      ordered: true
      regex:
        - "i2s_sample: Starting I2S audio sample app ..."
        - "i2s_sample: Stream with 478208 bytes started"
        - "i2s_sample: Exiting I2S audio sample app ..."
```

## samples/drivers/auxdisplay/sample.yaml
```yaml
sample:
  description: Demonstration of auxdisplay driver
  name: Auxiliary display sample
tests:
  sample.drivers.auxdisplay:
    tags: auxdisplay
    harness_config:
      fixture: fixture_auxdisplay
    platform_allow: nucleo_f746zg
    integration_platforms:
      - nucleo_f746zg
```

## samples/drivers/auxdisplay_digits/sample.yaml
```yaml
sample:
  description: Demonstration of auxdisplay driver for segment displays
  name: Auxiliary (segment) display sample
tests:
  sample.drivers.auxdisplay_digits:
    tags: auxdisplay
    platform_allow:
      - native_sim
    integration_platforms:
      - native_sim
    build_only: true
  sample.drivers.auxdisplay_digits.frdm_mcxa366:
    tags: auxdisplay
    platform_allow:
      - frdm_mcxa366/mcxa366
    extra_args:
      - SHIELD=od_6010
```

## samples/drivers/biometrics/fingerprint/sample.yaml
```yaml
sample:
  name: Fingerprint Sensor
  description: Fingerprint sensor driver test based on the biometrics API

tests:
  sample.drivers.biometrics.fingerprint:
    harness: console
    harness_config:
      type: one_line
      regex:
        - "Test complete"
    tags:
      - drivers
      - biometrics
      - fingerprint
    filter: dt_alias_exists("fingerprint")
    platform_allow:
      - native_sim
      - native_sim/native/64
```

## samples/drivers/buzzer/tone/sample.yaml
```yaml
sample:
  name: Buzzer Tone
  description: |
    Plays a short beep and a few tones through the buzzer device aliased as `buzzer0`. Suitable
    for boards that expose a passive piezo via the pwm-buzzer compatible or an active buzzer via
    gpio-buzzer.
common:
  platform_type:
    - mcu
  tags:
    - drivers
    - buzzer
  filter: dt_alias_exists("buzzer0")
tests:
  sample.drivers.buzzer.tone:
    harness: buzzer
```

## samples/drivers/can/b2b_xfer/Kconfig
```kconfig
# Copyright 2024 NXP
# SPDX-License-Identifier: Apache-2.0

menu "Controller Area Network board-to-board transfer sample"

config SAMPLE_CAN_B2B_XFER_SENDER_CAN_ID
	hex "CAN Tx ID"
	default 0x123
	range 0x000 0x7ff
	help
	  Sender node transmit CAN ID.

config SAMPLE_CAN_B2B_XFER_REPLIER_CAN_ID
	hex "CAN Tx ID"
	default 0x321
	range 0x000 0x7ff
	help
	  Replier node transmit CAN ID.

choice SAMPLE_CAN_B2B_XFER_ROLE
	prompt  "Select between sender and replier role"
	default SAMPLE_CAN_B2B_XFER_ROLE_SENDER

config SAMPLE_CAN_B2B_XFER_ROLE_SENDER
	bool "Node role is sender"
	help
	  Sender node sends CAN frame with SENDER_CAN_ID when
	  sw0 button is pressed. It listens reply CAN frame with
	  REPLIER_CAN_ID.

config SAMPLE_CAN_B2B_XFER_ROLE_REPLIER
	bool "Node role is replier"
	help
	  Replier node listens on CAN frame with SENDER_CAN_ID
	  and reply CAN frame with REPLIER_CAN_ID.

endchoice # SAMPLE_CAN_B2B_XFER_ROLE

endmenu

source "Kconfig.zephyr"
```

## samples/drivers/can/babbling/Kconfig
```kconfig
# Copyright (c) 2022 Henrik Brix Andersen <henrik@brixandersen.dk>
# SPDX-License-Identifier: Apache-2.0

menu "Controller Area Network babbling node sample"

config SAMPLE_CAN_BABBLING_CAN_ID
	hex "CAN ID"
	default 0x010
	range 0x000 0x7ff if !SAMPLE_CAN_BABBLING_EXT_ID
	range 0x00000000 0x1fffffff if SAMPLE_CAN_BABBLING_EXT_ID
	help
	  Babbling node CAN ID.

config SAMPLE_CAN_BABBLING_EXT_ID
	bool "Use Extended (29-bit) CAN ID"
	help
	  Babling node sends extended (29-bit) CAN ID frames.

config SAMPLE_CAN_BABBLING_RTR
	bool "Send Remote Transmit Request (RTR) frames"
	help
	  Babbling node sends Remote Transmission Request (RTR) frames.

config SAMPLE_CAN_BABBLING_FD_MODE
	bool "Send CAN FD format frames"
	select CAN_FD_MODE
	help
	  Babbling node sends CAN FD format frames.

config SAMPLE_CAN_BABBLING_TX_QUEUE_SIZE
	int "Maximum number of CAN frames to enqueue"
	default 3
	range 1 3
	help
	  Maximum number of CAN frames to enqueue for transmission.

endmenu

source "Kconfig.zephyr"
```

## samples/drivers/can/babbling/sample.yaml
```yaml
sample:
  name: CAN bus babbling node
tests:
  sample.drivers.can.babbling:
    tags: can
    depends_on: can
    filter: dt_chosen_enabled("zephyr,canbus") and not dt_compat_enabled("xlnx,canfd-2.0")
    integration_platforms:
      - native_sim
    harness: console
    harness_config:
      type: one_line
      regex:
        - "babbling on .*"
```

## samples/drivers/can/counter/Kconfig
```kconfig
# Private config options for can sample app

# Copyright (c) 2018 Alexander Wachter
# SPDX-License-Identifier: Apache-2.0

mainmenu "Controller Area Network sample application"

config LOOPBACK_MODE
	bool "Loopback LOOPBACK_MODE"
	default y
	help
	  Set the controller to loopback mode.
	  This allows testing without a second board.

source "Kconfig.zephyr"
```

## samples/drivers/can/counter/sample.yaml
```yaml
sample:
  name: CAN driver counter sample
tests:
  sample.drivers.can.counter:
    tags: can
    depends_on: can
    integration_platforms:
      - native_sim
    filter: dt_chosen_enabled("zephyr,canbus") and not dt_compat_enabled("kvaser,pcican")
      and not dt_compat_enabled("infineon,xmc4xxx-can-node")
    harness: console
    harness_config:
      type: one_line
      regex:
        - "Counter received: (.*)"
```

## samples/drivers/can/sample.yaml
```yaml
sample:
  name: CAN driver sample
tests:
  sample.drivers.can:
    tags: can
    depends_on: can
    filter: dt_chosen_enabled("zephyr,canbus")
    harness: console
    harness_config:
      type: one_line
      regex:
        - "Counter received: (.*)"
```

## samples/drivers/charger/Kconfig
```kconfig
# Private config options for charger sample app

# Copyright (c) 2024 Cirrus Logic, Inc.
# SPDX-License-Identifier: Apache-2.0

mainmenu "Charger application"

if CHARGER_DISCHAGRE_CURRENT_NOTIFICATIONS

config APP_DISCHARGE_CURRENT_NOTIFICATION_THRESHOLD_UA
	int "Discharge notification threshold in µA"

config APP_DISCHARGE_CURRENT_NOTIFICATION_DURATION_US
	int "Excess discharge duration in µsec"

endif # CHARGER_DISCHAGRE_CURRENT_NOTIFICATIONS

config APP_SYSTEM_VOLTAGE_NOTIFICATION_THRESHOLD_UV
	int "System voltage notification falling threshold in µV"
	depends on CHARGER_SYSTEM_VOLTAGE_NOTIFICATIONS

source "Kconfig.zephyr"
```

## samples/drivers/clock_control_litex/sample.yaml
```yaml
sample:
  name: Sample for the clock control driver
tests:
  sample.driver.clock_control_litex:
    platform_allow: litex_vexriscv
    tags:
      - clock_control
      - mmcm
```

## samples/drivers/clock_control_xec/sample.yaml
```yaml
sample:
  description: Demonstration of the Microchip XEC clock control driver
  name: XEC clock control sample
tests:
  sample.drivers.clock_control_xec:
    tags: clock_control
    platform_allow:
      - mec172xevb_assy6906/mec172x_nsz
      - mec15xxevb_assy6853/mec1501_hsz
      - mec1501modular_assy6885/mec1501_hsz
```

## samples/drivers/clock_monitor/check_freq/Kconfig
```kconfig
# Private config options for the clock_monitor check_freq sample
#
# Copyright (c) 2026 NXP
# SPDX-License-Identifier: Apache-2.0

mainmenu "Clock Monitor - Frequency Check sample"

config SAMPLE_EXPECTED_HZ
	int "Expected monitored-clock frequency (Hz), 0 = auto"
	default 0
	help
	  Nominal expected frequency of the monitored clock, in Hz.
	  Passed to clock_monitor_configure() as window.expected_hz.
	  Set to 0 to let the driver auto-derive it from the monitored
	  clock via clock_control_get_rate().

config SAMPLE_TOLERANCE_PPM
	int "Window tolerance (parts-per-million)"
	default 50000
	help
	  Acceptable +/- deviation from the expected frequency, in ppm.
	  Default 50000 = +/- 5 %, which is loose enough to ride out
	  crystal warm-up on a typical EVK.

config SAMPLE_WINDOW_NS
	int "Measurement window duration (ns)"
	default 1000000
	help
	  CMU_FC measurement window in nanoseconds. Longer windows give
	  finer ppm resolution but slower fault response. 1 ms default.

source "Kconfig.zephyr"
```

## samples/drivers/clock_monitor/check_freq/sample.yaml
```yaml
sample:
  name: Clock Monitor - Frequency Check
  description: |
    Uses a clock_monitor instance (referenced by the `clock-monitor`
    devicetree alias) in WINDOW mode to watch a monitored clock
    against programmable thresholds. Installs a callback that logs
    any out-of-window or clock-lost events, and periodically drains
    get_events() from the main loop to show the polling path.

    Which physical clock is being watched depends on which CMU
    instance the board overlay aliases to `clock-monitor`. The
    expected frequency, tolerance and measurement window are all
    Kconfig-tunable (see Kconfig in this sample).
tests:
  sample.drivers.clock_monitor.check_freq:
    platform_allow:
      - frdm_mcxe31b
    tags:
      - drivers
      - clock_monitor
    harness: console
    harness_config:
      type: one_line
      regex:
        - "clock check running \\(expected ~\\d+ Hz"
```

## samples/drivers/clock_monitor/dts/bindings/clock-monitor-required-clocks.yaml
```yaml
# SPDX-FileCopyrightText: 2026 NXP
# SPDX-License-Identifier: Apache-2.0

description: Clocks a clock_monitor sample enables at startup.

compatible: "clock-monitor-required-clocks"

properties:
  clocks:
    type: phandle-array
    required: true
    description: Clocks to enable at startup.
```

## samples/drivers/clock_monitor/measure_freq/Kconfig
```kconfig
# Private config options for the clock_monitor measure_freq sample
#
# Copyright (c) 2026 NXP
# SPDX-License-Identifier: Apache-2.0

mainmenu "Clock Monitor - Frequency Meter sample"

config SAMPLE_WINDOW_NS
	int "Measurement window duration (ns)"
	default 1000000
	help
	  CMU_FM measurement window in nanoseconds. Longer windows give
	  finer resolution; 1 ms default.

source "Kconfig.zephyr"
```

## samples/drivers/clock_monitor/measure_freq/sample.yaml
```yaml
sample:
  name: Clock Monitor - Frequency Meter
  description: |
    Uses a clock_monitor instance (referenced by the `clock-meter`
    devicetree alias) in MEASURE mode to measure a monitored clock
    once, logging the result in Hz. Demonstrates the start -> callback
    -> semaphore wait pattern with application-owned timeout handling.

tests:
  sample.drivers.clock_monitor.measure_freq:
    platform_allow:
      - frdm_mcxe31b
      - mimxrt685_evk/mimxrt685s/cm33
      - mimxrt595_evk/mimxrt595s/cm33
      - frdm_rw612
      - rd_rw612_bga
    tags:
      - drivers
      - clock_monitor
    harness: console
    harness_config:
      type: one_line
      regex:
        - "Measured frequency = \\d+ Hz"
```

## samples/drivers/comparator/callback/sample.yaml
```yaml
# Copyright (c) 2024 Nordic Semiconductor ASA
# SPDX-License-Identifier: Apache-2.0

sample:
  name: Comparator callback sample
tests:
  sample.drivers.comparator.callback:
    tags:
      - drivers
      - comparator
    filter: dt_alias_exists("comparator")
```

## samples/drivers/comparator/pending/sample.yaml
```yaml
# Copyright (c) 2024 Nordic Semiconductor ASA
# SPDX-License-Identifier: Apache-2.0

sample:
  name: Comparator pending sample
tests:
  sample.drivers.comparator.pending:
    tags:
      - drivers
      - comparator
    filter: dt_alias_exists("comparator")
```

## samples/drivers/comparator/sample.yaml
```yaml
sample:
  name: Comparator driver sample
tests:
  sample.drivers.comparator:
    filter: dt_nodelabel_enabled("comp_dev")
    integration_platforms:
      - nrf52840dk_nrf52840
      - nrf5340dk_nrf5340_cpuapp
    harness: console
    harness_config:
      type: multi_line
      ordered: true
      regex:
        - "Comparator driver sample on .*"
        - "Comparator started"
```

## samples/drivers/comparator/wakeup/sample.yaml
```yaml
# Copyright (c) 2024 Nordic Semiconductor ASA
# SPDX-License-Identifier: Apache-2.0

sample:
  name: Comparator wakeup sample
tests:
  sample.drivers.comparator.wakeup:
    tags:
      - drivers
      - comparator
    filter: dt_alias_exists("comparator")
```
