/*
 * Copyright (c) 2025, Ambiq Micro Inc. <www.ambiq.com>
 *
 * SPDX-License-Identifier: Apache-2.0
 */

/ {
	aliases {
		psram0 = &aps51216ba;
	};
};

&mspi0 {
	status = "okay";
};

&aps51216ba {
	status = "okay";
};
