## samples/drivers/memc/boards/art_pi2.conf
```kconfig
# SPDX-FileCopyrightText: Copyright The Zephyr Project Contributors
# SPDX-License-Identifier: Apache-2.0

CONFIG_MSPI_MEMMAP=y
CONFIG_MSPI_TIMING=y
```

## samples/drivers/memc/boards/mimxrt2660_evk_mimxrt2663_cm85.conf
```kconfig
# Copyright 2026 NXP
# SPDX-License-Identifier: Apache-2.0

CONFIG_EXTERNAL_MEM_CONFIG_DATA=n
```

## samples/drivers/mspi/mspi_throughput/boards/stm32n6570_dk.conf
```kconfig
# Copyright (c) 2026 EXALT Technologies
# SPDX-License-Identifier: Apache-2.0

CONFIG_MSPI_COMPLETION_TIMEOUT_TOLERANCE=10000
```

## samples/drivers/spi/rtio_loopback/Kconfig
```kconfig
# SPDX-FileCopyrightText: Copyright 2026 Nordic Semiconductor ASA
# SPDX-License-Identifier: Apache-2.0

mainmenu "SPI RTIO Loopback Test"

config SAMPLE_DATA_WRITE_SIZE
	int "Write size from perspective of controller in bytes"
	default 4

config SAMPLE_DATA_READ_SIZE
	int "Read size from perspective of controller in bytes"
	default 32

choice SAMPLE_SPI_MODE
	prompt "SPI mode used by controller and device"
	default SAMPLE_SPI_MODE_0

config SAMPLE_SPI_MODE_0
	bool "Use SPI mode 0 for controller and device"

config SAMPLE_SPI_MODE_1
	bool "Use SPI mode 1 for controller and device"

config SAMPLE_SPI_MODE_2
	bool "Use SPI mode 2 for controller and device"

config SAMPLE_SPI_MODE_3
	bool "Use SPI mode 3 for controller and device"

endchoice # SAMPLE_SPI_MODE

choice SAMPLE_SPI_BIT_ORDER
	prompt "SPI bit order used by controller and device"
	default SAMPLE_SPI_BIT_ORDER_MSB

config SAMPLE_SPI_BIT_ORDER_MSB
	bool "Use MSB SPI bit order for controller and device"

config SAMPLE_SPI_BIT_ORDER_LSB
	bool "Use LSB SPI bit order for controller and device"

endchoice # SAMPLE_SPI_BIT_ORDER

source "Kconfig.zephyr"
```

## samples/drivers/spi/rtio_loopback/boards/b_u585i_iot02a.conf
```kconfig
# SPDX-FileCopyrightText: Copyright 2026 Nordic Semiconductor ASA
# SPDX-License-Identifier: Apache-2.0

CONFIG_SPI_STM32_INTERRUPT=y
CONFIG_SPI_STM32_DMA=y
```

## samples/drivers/stepper/tmc5241/Kconfig
```kconfig
# SPDX-FileCopyrightText: Copyright (c) 2026
# SPDX-License-Identifier: Apache-2.0

mainmenu "TMC5241 sample application"

config STEPS_PER_REV
	int "Steps per revolution"
	default 200

config PING_PONG_N_REV
	int "Change direction every N revolutions"
	default 1

config MAX_VELOCITY_MULTIPLIER
	int "Max velocity multiplier"
	default 1

config STALLGUARD_THRESHOLD_VELOCITY
	int "StallGuard-stop arm velocity (fclk units)"
	default 200000

source "Kconfig.zephyr"
```

## samples/drivers/uart/async_api/boards/kit_psc3m5_evk.conf
```kconfig
# SPDX-FileCopyrightText: Copyright (c) 2026 Linumiz
# SPDX-License-Identifier: Apache-2.0

CONFIG_MUX=y
```

## samples/drivers/watchdog/xen_domain/Kconfig
```kconfig
# SPDX-FileCopyrightText: Copyright (c) 2026 EPAM Systems
# SPDX-License-Identifier: Apache-2.0

mainmenu "Xen domain watchdog sample"

config XEN_WDT_FAIL_CHANNEL
	int "Watchdog channel to stop feeding"
	default -1
	range -1 1
	help
	  Select which Zephyr watchdog channel the sample stops feeding after
	  both Xen domain watchdog timers have been installed and fed a few
	  times. Use -1 to keep feeding both channels.

source "Kconfig.zephyr"
```

## samples/kernel/object_monitor/Kconfig
```kconfig
# Copyright The Zephyr Project Contributors
# SPDX-License-Identifier: Apache-2.0

mainmenu "Object monitor sample"

config SAMPLE_MONITOR_CLEAR_SCREEN
	bool "Redraw the monitor in place"
	default y
	help
	  Clear the terminal and draw the monitor at the top on every refresh.
	  Disable this to let the output scroll, for logs and CI.

config SAMPLE_MONITOR_PERIOD_MS
	int "Monitor refresh period in milliseconds"
	default 1000

source "Kconfig.zephyr"
```

## samples/modules/lvgl/demos/boards/st25dv_mb1283_disco.conf
```kconfig
# SPDX-FileCopyrightText: Copyright The Zephyr Project Contributors
# SPDX-License-Identifier: Apache-2.0

CONFIG_LV_COLOR_FORMAT_XRGB8888=y
CONFIG_GPIO=y
```

## samples/modules/lvgl/screen_transparency/Kconfig
```kconfig
# Copyright (c) 2024 Martin Stumpf <finomnis@gmail.com>
# SPDX-License-Identifier: Apache-2.0

mainmenu "LVGL screen transparency sample"

config APP_DRAW_BACKGROUND_CHECKERBOARD
	bool "Draw an opaque checkerboard behind the transparent screen"
	default y if !SDL_DISPLAY
	help
	  Draw an opaque black/white checkerboard on the bottom layer so the
	  transparent screen has a defined background to composite over. This is
	  needed on displays that do NOT have a separate hardware layer (e.g. a
	  video plane) behind the LVGL framebuffer; otherwise the background is
	  whatever happens to be in the framebuffer. Disable it on boards where an
	  underlying hardware layer provides the background (the on-screen-display
	  / OSD use case), or under the SDL display which draws its own grid.

source "Kconfig.zephyr"
```

## samples/net/common/Kconfig
```kconfig
#
# Copyright (c) 2025 Ezurio
#
# SPDX-License-Identifier: Apache-2.0
#

config NET_SAMPLE_COMMON_WAIT_DNS
	bool "Wait for a DNS server before resolving a hostname"
	default y
	depends on NET_CONNECTION_MANAGER
	help
	  Wait until a unicast DNS server is available before resolving a
	  hostname. Disable it when hostnames are resolved only with mDNS or
	  LLMNR, which do not need a DNS server.

config NET_SAMPLE_COMMON_VLAN_SETUP_1
	string "VLAN setup for the 1st VLAN interface"
	default ""
	depends on NET_VLAN
	help
	  This can setup the first VLAN network interface.
	  The format of the string looks like this:
	    <VLAN-tag>;<ip-address/mask-len>,...
	  Example:
	    100;198.51.100.1/24,2001:db8:100::1/64
	  The VLAN tag can have values between 0 and 4094.
	  There can be multiple IP addresses specified, and the
	  code tries to apply them all to this interface.

config NET_SAMPLE_COMMON_VLAN_SETUP_2
	string "VLAN setup for the 2nd VLAN interface"
	default ""
	depends on NET_VLAN
	help
	  This can setup the first VLAN network interface.
	  The format of the string looks like this:
	    <VLAN-tag>;<ip-address/mask-len>,...
	  Example:
	    200;203.0.113.1/24,2001:db8:200::1/64
	  The VLAN tag can have values between 0 and 4094.
	  There can be multiple IP addresses specified, and the
	  code tries to apply them all to this interface.

config NET_SAMPLE_COMMON_TUNNEL_PEER_ADDR
	string "Remote IP address of the tunnel interface"
	depends on NET_L2_IPIP
	help
	  Use overlay-tunnel.conf to setup the tunnel support.

config NET_SAMPLE_COMMON_TUNNEL_MY_ADDR
	string "My address for tunnel interface"
	depends on NET_L2_IPIP
	help
	  The value depends on your network setup.

# Generic way to allocate enough sockets for the application
config ZVFS_OPEN_ADD_SIZE_NET_SAMPLE
	int "Amount of sockets needed by the networking sample"
	default 0
```
