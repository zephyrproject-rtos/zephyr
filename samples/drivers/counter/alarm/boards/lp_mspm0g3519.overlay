/*
 * Copyright (c) 2025 Texas Instruments Incorporated
 *
 * SPDX-License-Identifier: Apache-2.0
 */

/ {
	aliases {
		counter = &counterg8;
	};
};

&timg8 {
	status = "okay";

	counterg8: counterg8 {
		status = "okay";
	};
};
