/*****************************************************************************
 * SPDX-FileCopyrightText: 2025 Ambiq Micro Inc.
 *
 * SPDX-License-Identifier: Apache-2.0
 ***************************************************************************
 */

&counter0 {
	status = "okay";
};
