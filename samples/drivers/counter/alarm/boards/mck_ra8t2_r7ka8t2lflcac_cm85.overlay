/*
 * Copyright (c) 2025 Renesas Electronics Corporation
 *
 * SPDX-License-Identifier: Apache-2.0
 */

&agt0 {
	interrupts = <94 1>, <95 1>;
	interrupt-names = "agti", "agtcmai";
	renesas,prescaler = <4>;
	status = "okay";

	counter0: counter {
		status = "okay";
	};
};
