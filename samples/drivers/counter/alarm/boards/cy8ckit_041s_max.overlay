/*
 * SPDX-FileCopyrightText: Copyright (c) 2026 Infineon Technologies AG,
 * SPDX-FileCopyrightText: or an affiliate of Infineon Technologies AG. All rights reserved.
 *
 * SPDX-License-Identifier: Apache-2.0
 */

&tcpwm0_1 {
	interrupts = <18 0>;
	status = "okay";

	counter0_1 {
		clocks = <&peri_clk_div3>;
		status = "okay";
	};
};

&peri_clk_div3 {
	clock-div = <11519>;
	status = "okay";
};
