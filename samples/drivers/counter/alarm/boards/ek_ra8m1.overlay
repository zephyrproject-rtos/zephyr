/*
 * Copyright (c) 2024 Renesas Electronics Corporation
 *
 * SPDX-License-Identifier: Apache-2.0
 */

&agt0 {
	interrupts = <94 12>, <95 12>;
	interrupt-names = "agti", "agtcmai";
	status = "okay";
	renesas,prescaler = <4>;
	counter0: counter {
		status = "okay";
	};
};
