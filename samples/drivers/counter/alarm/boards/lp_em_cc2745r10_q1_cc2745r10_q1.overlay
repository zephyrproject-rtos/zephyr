/*
 * Copyright (c) 2025 Texas Instruments Incorporated
 *
 * SPDX-License-Identifier: Apache-2.0
 */

/ {
	aliases {
		counter0 = &lgpt3;
	};
};

/* Use lgpt3 (24-bit) for better range */
&lgpt3 {
	clk-prescale = <95>;  /* 96MHz / 96 = 1MHz, 1us per tick */
	status = "okay";
};
