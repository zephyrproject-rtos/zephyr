/*
 * Copyright (c) 2026 Microchip Technology Inc.
 *
 * SPDX-License-Identifier: Apache-2.0
 */

/ {
	aliases {
		counter = &tc0;
	};
};

&tc0 {
	status = "okay";
};

/* rtc can also be configured as counter for this sample.
 * To use it update the above the alias with &rtc
 */
&rtc {
	compatible = "microchip,rtc-g1-counter";
	max-bit-width = <32>;
	status = "okay";
};
