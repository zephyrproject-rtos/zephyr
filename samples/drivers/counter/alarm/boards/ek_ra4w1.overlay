/*
 * Copyright (c) 2024 Renesas Electronics Corporation
 *
 * SPDX-License-Identifier: Apache-2.0
 */

&agt0 {
	interrupts = <21 1>, <22 1>;
	interrupt-names = "agti", "agtcmai";
	renesas,prescaler = <4>;
	status = "okay";

	counter0: counter {
		status = "okay";
	};
};
