/*
 * Copyright (c) 2026 Texas Instruments
 *
 * SPDX-License-Identifier: Apache-2.0
 */

/ {
	aliases {
		counter = &counterg12;
	};
};

&timg12 {
	status = "okay";

	counterg12: counterg12 {
		status = "okay";
	};
};
