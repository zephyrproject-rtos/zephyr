/*
 * Copyright (c) 2026 Texas Instruments Incorporated
 *
 * SPDX-License-Identifier: Apache-2.0
 */

/ {
	aliases {
		counter0 = &lgpt3;
	};
};

/* Use lgpt3 (24-bit) instead of lgpt0 (16-bit) to support longer delays
 * Prescaler = 191 gives 48MHz / 192 = 250kHz (4us per tick)
 * Max timeout = 16777215 ticks * 4us = 67.1 seconds
 */
&lgpt3 {
	clk-prescale = <191>;
	status = "okay";
};
