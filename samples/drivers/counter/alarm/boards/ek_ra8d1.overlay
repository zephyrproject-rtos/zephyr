/*
 * Copyright (c) 2024 Renesas Electronics Corporation
 *
 * SPDX-License-Identifier: Apache-2.0
 */

&agt0 {
	renesas,prescaler = <4>;
	status = "okay";

	counter0: counter {
		status = "okay";
	};
};
