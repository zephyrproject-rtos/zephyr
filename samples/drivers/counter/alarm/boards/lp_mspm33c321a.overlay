/*
 * Copyright (c) 2026 Texas Instruments Incorporated
 *
 * SPDX-License-Identifier: Apache-2.0
 */

/ {
	aliases {
		counter = &counterg4_0;
	};
};

&timg4_0 {
	status = "okay";

	counterg4_0: counterg4_0 {
		status = "okay";
	};
};
