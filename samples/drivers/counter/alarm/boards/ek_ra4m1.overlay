/*
 * Copyright (c) 2025 Renesas Electronics Corporation
 *
 * SPDX-License-Identifier: Apache-2.0
 */

&agt0 {
	interrupts = <30 1>, <31 1>, <26 1>;
	interrupt-names = "agti", "agtcmai", "agtcmbi";
	renesas,prescaler = <4>;
	status = "okay";

	counter0: counter {
		status = "okay";
	};
};
