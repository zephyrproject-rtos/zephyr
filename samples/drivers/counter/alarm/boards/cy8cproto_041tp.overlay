/*
 * Copyright (c) 2025 Infineon Technologies AG,
 * or an affiliate of Infineon Technologies AG.
 *
 * SPDX-License-Identifier: Apache-2.0
 */

&tcpwm0_1 {
	status = "okay";
	interrupts = <17 0>;

	counter0_1 {
		status = "okay";
		clocks = <&peri_clk_div3>;
	};
};

&peri_clk_div3 {
	resource-channel = <1>;
	status = "okay";
};
