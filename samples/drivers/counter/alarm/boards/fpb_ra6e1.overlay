/*
 * Copyright (c) 2024 Renesas Electronics Corporation
 *
 * SPDX-License-Identifier: Apache-2.0
 */

&agt0 {
	status = "okay";
	interrupts = <83 1>, <84 1>, <88 1>;
	interrupt-names = "agti", "agtcmai", "agtcmbi";
	renesas,prescaler = <4>;

	counter0: counter {
		status = "okay";
	};
};
