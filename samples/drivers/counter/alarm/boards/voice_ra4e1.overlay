/*
 * Copyright (c) 2025 Renesas Electronics Corporation
 *
 * SPDX-License-Identifier: Apache-2.0
 */

&agt0 {
	status = "okay";
	interrupts = <83 1>, <84 1>;
	interrupt-names = "agti", "agtcmai";
	renesas,prescaler = <4>;
	counter0: counter {
		status = "okay";
	};
};
