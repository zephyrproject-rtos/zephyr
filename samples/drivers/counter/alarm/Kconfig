## samples/drivers/counter/alarm/Kconfig
```kconfig
# Config for counter alarm sample

# Copyright (c) 2019 Nordic Semiconductor ASA
# SPDX-License-Identifier: Apache-2.0

config COUNTER_RTC0
	bool
	default y if SOC_FAMILY_NRF

config COUNTER_SAM0_TC32
	bool
	default y if BOARD_ATSAMD20_XPRO

config COUNTER_RTC_STM32_SAVE_VALUE_BETWEEN_RESETS
	bool
	default n if COUNTER_RTC_STM32

source "Kconfig.zephyr"
```

## samples/drivers/counter/alarm/boards/bl5340_dvk_cpuapp.conf
```kconfig
# Enable RTC
CONFIG_I2C=y
CONFIG_COUNTER=y
CONFIG_COUNTER_MICROCHIP_MCP7940N=y
CONFIG_COUNTER_INIT_PRIORITY=65
```

## samples/drivers/counter/alarm/boards/stm32l562e_dk_ns.conf
```kconfig
#
# Copyright (c) 2022 O.S.Systems
#
# SPDX-License-Identifier: Apache-2.0
#
CONFIG_BUILD_WITH_TFM=y
CONFIG_TFM_PROFILE_TYPE_MEDIUM=y
```

## samples/drivers/counter/alarm/sample.yaml
```yaml
sample:
  name: Counter RTC Driver Sample
common:
  tags:
    - drivers
    - counter
  harness: console
  harness_config:
    type: multi_line
    ordered: true
    regex:
      - "Counter alarm sample"
      - "Set alarm in 2 sec"
      - "!!! Alarm !!!"
      - "Now: [2|3]"
  depends_on: counter
tests:
  sample.drivers.counter.alarm:
    platform_exclude:
      - mps2/an385
      - mimxrt1060_evk@A/mimxrt1062/qspi
      - mimxrt1060_evk@B/mimxrt1062/qspi
      - mimxrt1060_evk@C/mimxrt1062/hyperflash
      - mimxrt1060_evk@C/mimxrt1062/qspi
    integration_platforms:
      - nucleo_f746zg
  sample.drivers.counter.alarm.stm32_rtc:
    # This test case is needed because when Timer Counter is available,
    # RTC Counter will never be selected in the test.
    # CONFIG_COUNTER_RTC_STM32 flag is enabled by default when RTC is enabled.
    filter: CONFIG_SOC_FAMILY_STM32 and CONFIG_COUNTER_RTC_STM32
    extra_configs:
      # Timer Counter flag needs to be disabled for RTC node to be selected
      - CONFIG_COUNTER_TIMER_STM32=n
    tags:
      - rtc
```

## samples/drivers/counter/maxim_ds3231/Kconfig
```kconfig
# Copyright (c) 2019 Peter Bigot Consulting, LLC
#
# SPDX-License-Identifier: Apache-2.0
#

config APP_SET_ALIGNED_CLOCK
	bool "Option to align RTC with time-since-boot"
	help
	  If enabled this reads the RTC then sets it so that uptime
	  shows as being relative to the start of the next hour.

source "Kconfig"
```

## samples/drivers/counter/maxim_ds3231/sample.yaml
```yaml
common:
  filter: CONFIG_FULL_LIBC_SUPPORTED
sample:
  name: Maxim DS3231 RTC
tests:
  sample.basic.maxim_ds3231:
    build_only: true
    platform_allow:
      - efr32mg_sltb004a/efr32mg12p332f1024gl125
      - frdm_k64f/mk64f12
      - nrf51dk/nrf51822
      - nucleo_l476rg/stm32l476xx
      - particle_xenon/nrf52840
    integration_platforms:
      - efr32mg_sltb004a/efr32mg12p332f1024gl125
```

## samples/drivers/crc/boards/lpcxpresso55s28.conf
```kconfig
# Copyright 2025 NXP
# SPDX-License-Identifier: Apache-2.0

CONFIG_SAMPLE_CRC_VARIANT_CRC16_CCITT=y
```

## samples/drivers/crc/sample.yaml
```yaml
sample:
  name: CRC Sample
tests:
  sample.drivers.crc:
    depends_on: crc
    tags:
      - drivers
      - crc
    integration_platforms:
      - ek_ra8m1
    harness: console
    harness_config:
      type: one_line
      regex:
        - "verification succeeded"
```

## samples/drivers/crypto/boards/b_u585i_iot02a_saes.conf
```kconfig
CONFIG_ENTROPY_GENERATOR=y
CONFIG_ENTROPY_STM32_THR_THRESHOLD=4
CONFIG_ENTROPY_STM32_ISR_THRESHOLD=12
```

## samples/drivers/crypto/sample.yaml
```yaml
sample:
  description: An example to illustrate the usage of
    crypto APIs
  name: Crypto APIs
common:
  tags: crypto
  min_ram: 20
tests:
  sample.drivers.crypto.mbedtls:
    min_flash: 34
    harness: console
    extra_args: EXTRA_CONF_FILE=prj_mtls_shim.conf
    integration_platforms:
      - native_sim
    harness_config:
      type: multi_line
      regex:
        - ".*: Cipher Sample"
        - ".*: CBC Mode"
        - ".*: CTR Mode"
        - ".*: CCM Mode"
        - ".*: GCM Mode"
  sample.drivers.crypto.stm32:
    tags: crypto
    filter: dt_compat_enabled("st,stm32-aes") or dt_compat_enabled("st,stm32-cryp")
    integration_platforms:
      - stm32l562e_dk
    harness: console
    harness_config:
      type: multi_line
      regex:
        - ".*: Cipher Sample"
        - ".*: ECB mode ENCRYPT - Match"
        - ".*: ECB mode DECRYPT - Match"
        - ".*: CBC mode ENCRYPT - Match"
        - ".*: CBC mode DECRYPT - Match"
        - ".*: CTR mode ENCRYPT - Match"
        - ".*: CTR mode DECRYPT - Match"
  sample.drivers.crypto.mcux_dcp:
    tags: crypto
    filter: dt_compat_enabled("nxp,mcux-dcp")
    integration_platforms:
      - mimxrt1064_evk
    harness: console
    harness_config:
      type: multi_line
      regex:
        - ".*: Cipher Sample"
        - ".*: ECB mode ENCRYPT - Match"
        - ".*: ECB mode DECRYPT - Match"
        - ".*: CBC mode ENCRYPT - Match"
        - ".*: CBC mode DECRYPT - Match"
  sample.drivers.crypto.si32:
    tags: crypto
    filter: dt_compat_enabled("silabs,si32-aes")
    integration_platforms:
      - sim3u1xx_dk
    harness: console
    harness_config:
      type: multi_line
      regex:
        - ".*: Cipher Sample"
        - ".*: ECB mode ENCRYPT - Match"
        - ".*: ECB mode DECRYPT - Match"
        - ".*: CBC mode ENCRYPT - Match"
        - ".*: CBC mode DECRYPT - Match"
        - ".*: CTR mode ENCRYPT - Match"
        - ".*: CTR mode DECRYPT - Match"
  sample.drivers.crypto.cc23x0_dma:
    tags: crypto
    filter: dt_compat_enabled("ti,cc23x0-aes") and dt_compat_enabled("ti,cc23x0-dma")
    integration_platforms:
      - lp_em_cc2340r5
    harness: console
    harness_config:
      type: multi_line
      regex:
        - ".*: Cipher Sample"
        - ".*: ECB mode ENCRYPT - Match"
        - ".*: CTR mode ENCRYPT - Match"
        - ".*: CTR mode DECRYPT - Match"
    extra_configs:
      - CONFIG_CRYPTO_CC23X0_DMA=y
  sample.drivers.crypto.esp32:
    tags: crypto
    filter: dt_compat_enabled("espressif,esp32-aes")
    integration_platforms:
      - esp32_devkitc/esp32/procpu
      - esp32s2_devkitc
      - esp32s3_devkitc/esp32s3/procpu
      - esp32c3_devkitc
      - esp32c6_devkitc/esp32c6/hpcore
      - esp32h2_devkitm
    harness: console
    harness_config:
      type: multi_line
      regex:
        - ".*: Cipher Sample"
        - ".*: ECB mode ENCRYPT - Match"
        - ".*: ECB mode DECRYPT - Match"
        - ".*: CBC mode ENCRYPT - Match"
        - ".*: CBC mode DECRYPT - Match"
        - ".*: CTR mode ENCRYPT - Match"
        - ".*: CTR mode DECRYPT - Match"
```

## samples/drivers/current_sensing/sample.yaml
```yaml
sample:
  name: TI INA219 power monitor
tests:
  sample.drivers.current_sensing:
    tags: sensors
    pre-filter: subsys_dt_compat_enabled("i2c")
    harness: sensor
```

## samples/drivers/dac/Kconfig
```kconfig
# Private config options for dac sample

# Copyright (c) 2025 NXP
# Copyright (c) 2025 Renesas Electronics Corporation
# SPDX-License-Identifier: Apache-2.0

mainmenu "DAC sample application"

source "Kconfig.zephyr"

ZEPHYR_USER := zephyr,user

config DAC_SAMPLE_RUN
	bool "Run DAC sample application"
	default y if $(dt_node_has_prop,/$(ZEPHYR_USER),dac)
	help
	  platform supports dac sample

config DAC_BUFFER_NOT_SUPPORT
	bool "DAC on board/SoC does not support output buffer mode"
	help
	  If this config is turned on, the sample will run with no output buffer enabled
```

## samples/drivers/dac/boards/bl5340_dvk_cpuapp.conf
```kconfig
#
# Copyright (c) 2021 Laird Connectivity
#
# SPDX-License-Identifier: Apache-2.0
#
CONFIG_I2C=y
CONFIG_DAC_MCP4725=y
```

## samples/drivers/dac/boards/bl652_dvk.conf
```kconfig
#
# Copyright (c) 2021 Laird Connectivity
#
# SPDX-License-Identifier: Apache-2.0
#
CONFIG_DAC_MCP4725=y
```

## samples/drivers/dac/sample.yaml
```yaml
sample:
  name: DAC driver sample
common:
  tags: DAC
  harness: console
  harness_config:
    type: one_line
    regex:
      - Generating sawtooth signal at DAC channel ([0-9]*).
tests:
  sample.drivers.dac:
    depends_on: dac
    filter: CONFIG_DAC_SAMPLE_RUN and not dt_alias_exists("second_uart")
    integration_platforms:
      - nucleo_l152re
  sample.drivers.dac.shields:
    platform_allow:
      - adafruit_feather_rp2040/rp2040
      - adafruit_feather_adalogger_rp2040/rp2040
    extra_args:
      - platform:adafruit_feather_rp2040/rp2040:SHIELD="adafruit_ad5693r"
      - platform:adafruit_feather_adalogger_rp2040/rp2040:SHIELD="adafruit_mcp4728"
  samples.dac.sec_uart:
    tags: DAC
    depends_on: dac
    filter: CONFIG_DAC_SAMPLE_RUN and dt_alias_exists("second_uart")
    integration_platforms:
      - frdm_mcxa266
      - frdm_mcxa346
      - frdm_mcxa366
```

## samples/drivers/dac_async/sample.yaml
```yaml
sample:
  name: DAC async driver sample
tests:
  sample.drivers.dac:
    tags: DAC
    platform_allow: |
      nucleo_l4r5zi
    depends_on: dac
    harness: console
    harness_config:
      type: one_line
      regex:
        - "Generating sawtooth signal at DAC channel ([0-9]*)."
```

## samples/drivers/dali/boards/nrf52840dk_nrf52840.conf
```kconfig
CONFIG_GPIO=y
CONFIG_COUNTER=y
CONFIG_ZERO_LATENCY_IRQS=y

CONFIG_FLASH=y
CONFIG_NVS=y
CONFIG_NVS_LOG_LEVEL_DBG=y
```

## samples/drivers/dali/logger/sample.yaml
```yaml
sample:
  description: Dali Zephyr driver logger application
  name: dali-logger
tests:
  sample.drivers.dali.logger:
    tags: dali
    integration_platforms:
      - nrf52840dk/nrf52840
    filter: dt_nodelabel_enabled("dali0") and dt_alias_exists("led0")
    harness: console
    harness_config:
      type: one_line
      regex:
        - "\\[(.*)\\] <inf> D: \\{(.*):(.*) (.*)\\}"
```

## samples/drivers/dali/sample.yaml
```yaml
sample:
  description: Dali Zephyr driver application
  name: dali-zephyr
common:
  build_only: true
  integration_platforms:
    - nucleo_f091rc
    - dali_dk_lpc11u68
    - nrf52840dk/nrf52840
tests:
  app.default: {}
  app.debug:
    extra_overlay_confs:
      - debug.conf
```
