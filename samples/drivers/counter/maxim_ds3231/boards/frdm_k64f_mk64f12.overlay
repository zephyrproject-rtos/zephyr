/*
 * Copyright (c) 2019 Peter Bigot Consulting, LLC
 *
 * SPDX-License-Identifier: Apache-2.0
 */

&i2c0 { /* SDA PTE25, SCL PTE24, ISW PTE26 */
	status = "okay";
	ds3231: ds3231@68 {
		compatible = "maxim,ds3231";
		reg = <0x68>;
		isw-gpios = <&gpioe 26 (GPIO_PULL_UP | GPIO_ACTIVE_LOW)>;
	};
};
