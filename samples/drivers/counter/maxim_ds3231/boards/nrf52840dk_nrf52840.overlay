/*
 * Copyright (c) 2019 Peter Bigot Consulting, LLC
 *
 * SPDX-License-Identifier: Apache-2.0
 */

&i2c0 { /* SDA P0.26, SCL P0.27 */
	status = "okay";
	ds3231: ds3231@68 {
		compatible = "maxim,ds3231";
		reg = <0x68>;
		label = "DS3231";
		isw-gpios = <&gpio0 0 (GPIO_PULL_UP | GPIO_ACTIVE_LOW)>;
	};
};
