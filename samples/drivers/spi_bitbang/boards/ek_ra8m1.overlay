/*
 * Copyright (c) 2024 Renesas Electronics Corporation
 * SPDX-License-Identifier: Apache-2.0
 */

spibb0: &spi1 {
	rx-dtc;
	tx-dtc;
	pinctrl-0 = <&spi1_default>;
	pinctrl-names = "default";
	cs-gpios = <&ioport4 13 GPIO_ACTIVE_LOW>;
	status = "okay";
};
