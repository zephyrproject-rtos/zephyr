## samples/drivers/adc/adc_sequence/boards/nucleo_c031c6.conf
```kconfig
# SPDX-FileCopyrightText: Copyright The Zephyr Project Contributors
# SPDX-License-Identifier: Apache-2.0

CONFIG_SEQUENCE_RESOLUTION=12
```

## samples/drivers/adc/adc_sequence/boards/s32k5xxcvb_s32k566_r52.conf
```kconfig
# Copyright 2025 NXP
# SPDX-License-Identifier: Apache-2.0

CONFIG_SEQUENCE_RESOLUTION=11
```

## samples/drivers/adc/adc_sequence/boards/s32z2xxdc2_s32z270_rtu1.conf
```kconfig
# Copyright 2024 NXP
# SPDX-License-Identifier: Apache-2.0

CONFIG_SEQUENCE_RESOLUTION=12
```

## samples/drivers/adc/adc_sequence/boards/stm32f3_disco.conf
```kconfig
# SPDX-FileCopyrightText: Copyright The Zephyr Project Contributors
# SPDX-License-Identifier: Apache-2.0

# A4114 driver can only acquire one sequence sample
CONFIG_SEQUENCE_SAMPLES=1
CONFIG_SEQUENCE_32BITS_REGISTERS=y
```

## samples/drivers/adc/adc_sequence/boards/stm32n6570_dk_sb.conf
```kconfig
# SPDX-License-Identifier: Apache-2.0
# Copyright (c) 2026 Smile

CONFIG_SEQUENCE_32BITS_REGISTERS=y
```

## samples/drivers/adc/adc_sequence/sample.yaml
```yaml
sample:
  name: ADC driver sequence sample
common:
  tags:
    - adc
  depends_on: adc
  filter: dt_alias_exists("adc0")
  harness: console
  timeout: 10
  harness_config:
    type: multi_line
    regex:
      - "ADC sequence reading \\[\\d+\\]:"
      - "- .+, channel \\d+, \\d+ sequence samples:"
      - "- - \\d+ (= \\d+mV)|(\\(value in mV not available\\))"
tests:
  sample.drivers.adc.adc_sequence:
    platform_allow:
      - cy8cproto_063_ble
      - cy8cproto_062_4343w
      - nrf52840dk/nrf52840
      - nrf54h20dk/nrf54h20/cpuapp
      - nrf54h20dk/nrf54h20/cpuppr
      - nrf54l15dk/nrf54l15/cpuapp
      - nrf54lm20dk/nrf54lm20a/cpuapp
      - ophelia4ev/nrf54l15/cpuapp
      - ucans32k1sic
      - s32k148_evb
      - frdm_mcxc242
      - slwrb4180a
      - xg27_rb4194a
      - xg29_rb4412a
      - raytac_an54lq_db_15/nrf54l15/cpuapp
    integration_platforms:
      - nrf52840dk/nrf52840
  sample.drivers.adc.adc_sequence.8bit:
    platform_allow:
      - nrf54h20dk/nrf54h20/cpuapp
      - nrf54h20dk/nrf54h20/cpuppr
      - nrf54l15dk/nrf54l15/cpuapp
      - nrf54lm20dk/nrf54lm20a/cpuapp
    integration_platforms:
      - nrf54l15dk/nrf54l15/cpuapp
    extra_configs:
      - CONFIG_SEQUENCE_RESOLUTION=8
```

## samples/drivers/adc/adc_stream/boards/esp32c3_devkitm.conf
```kconfig
#
# Copyright (c) 2026 Espressif Systems (Shanghai) Co., Ltd.
#
# SPDX-License-Identifier: Apache-2.0
#

CONFIG_MAIN_STACK_SIZE=2048
CONFIG_HEAP_MEM_POOL_SIZE=8192
CONFIG_SYSTEM_WORKQUEUE_STACK_SIZE=4096
```

## samples/drivers/adc/adc_stream/sample.yaml
```yaml
sample:
  name: ADC stream sample
common:
  tags: adc
  harness: console
  harness_config:
    type: one_line
    regex:
      - "^ADC data for [^@]+@\\d+ \\([0-9.]+\\) \\d+n$"
tests:
  sample.driver.adc_stream:
    filter: dt_alias_exists("adc0")
  sample.driver.adc_stream.ad4052-stream:
    extra_args:
      - SHIELD=eval_ad4052_ardz
      - EXTRA_CONF_FILE=ad4052-stream.conf
      - DTC_OVERLAY_FILE=boards/apard32690_max32690_m4_ad4052.overlay
    platform_allow:
      - apard32690/max32690/m4
  sample.driver.adc_stream.max32-stream:
    extra_args:
      - EXTRA_CONF_FILE=max32-stream.conf
      - DTC_OVERLAY_FILE=boards/apard32690_max32690_m4_max32.overlay
    platform_allow:
      - apard32690/max32690/m4
```

## samples/drivers/adc/adc_threshold/Kconfig
```kconfig
# SPDX-License-Identifier: Apache-2.0
# Copyright (c) 2026 Smile

config THRESHOLD_RESOLUTION
	int "Set the resolution of the readings."
	default 12

config THRESHOLD_UPPER_VALUE_MV
	int "Set the upper threshold voltage in millivolts."
	default 500

source "Kconfig.zephyr"
```

## samples/drivers/adc/boards/apollo4p_evb.conf
```kconfig
CONFIG_STDOUT_CONSOLE=y
CONFIG_NO_OPTIMIZATIONS=y
CONFIG_MAIN_STACK_SIZE=4096
CONFIG_IDLE_STACK_SIZE=4096
CONFIG_PM=y
```

## samples/drivers/adc/boards/esp32.conf
```kconfig
#CONFIG_SHELL=y
#CONFIG_LOG=y
#CONFIG_ADC_ESP32=y

#CONFIG_LOG_MODE_DEFERRED=y
#CONFIG_LOG_MODE_MINIMAL=y
#CONFIG_ADC_LOG_LEVEL_DBG=y
```

## samples/drivers/adc/boards/stm32l496g_disco.conf
```kconfig
# Copyright (c) 2021 STMicroelectronics
# SPDX-License-Identifier: Apache-2.0

CONFIG_LOG=y
```

## samples/drivers/adc/sample.yaml
```yaml
sample:
  name: ADC driver sample
tests:
  sample.drivers.adc:
    tags:
      - adc
    depends_on: adc
    platform_allow:
      - nucleo_l073rz/stm32l073xx
      - disco_l475_iot1/stm32l475xx
      - cc3220sf_launchxl/cc3220sf
      - cc3235sf_launchxl/cc3235sf
      - cy8cproto_063_ble/cyble_416045_02
      - stm32l496g_disco/stm32l496xx
      - stm32h735g_disco/stm32h735xx
      - nrf51dk/nrf51822
      - nrf52840dk/nrf52840
      - mec172xevb_assy6906/mec172x_nsz
      - gd32f350r_eval/gd32f350
      - gd32f450i_eval/gd32f450
      - gd32vf103v_eval/gd32vf103
      - gd32f403z_eval/gd32f403
      - esp32_devkitc_wroom/esp32/procpu
      - esp32_devkitc_wrover/esp32/procpu
      - esp32s2_saola/esp32s2
      - esp32c3_devkitm/esp32c3
      - gd32l233r_eval/gd32l233
      - lpcxpresso55s36/lpc55s36
      - mr_canhubk3/s32k344
      - longan_nano/gd32vf103
      - longan_nano/gd32vf103/lite
    integration_platforms:
      - nucleo_l073rz/stm32l073xx
      - nrf52840dk/nrf52840
    harness: console
    timeout: 10
    harness_config:
      type: multi_line
      regex:
        - "ADC reading\\[\\d+\\]:"
        - "- .+, channel \\d+: -?\\d+"
```

## samples/drivers/analog_switch/sample.yaml
```yaml
sample:
  name: Analog Switch sample
common:
  tags: analog_switch
  harness: console
  harness_config:
    type: one_line
    regex:
      - "Analog switch sample completed"
tests:
  sample.drivers.analog_switch:
    depends_on: analog_switch
    filter: dt_compat_enabled("adi,adgm3121-gpio") or
            dt_compat_enabled("adi,adgm3121")
  sample.drivers.analog_switch.eval_adgm3121:
    extra_args: SHIELD=eval_adgm3121
    platform_allow:
      - nucleo_f413zh
```

## samples/drivers/audio/amic/Kconfig
```kconfig
# Copyright (c) 2025 Ambiq Micro Inc.
# SPDX-License-Identifier: Apache-2.0

source "Kconfig.zephyr"

config SAMPLE_FREQ
	int "Sample rate"
	default 16000
	help
	  Sample frequency of the system.

config AMIC_CHANNELS
	int "Number of AMIC channels"
	default 1
	help
	  Count of AMIC channels to capture and stream.
```

## samples/drivers/audio/amic/sample.yaml
```yaml
sample:
  name: AMIC sample
tests:
  sample.drivers.audio.amic:
    tags: amic
    filter: dt_nodelabel_enabled("amic_dev")
    integration_platforms:
      - apollo510_evb
      - apollo510b_evb
    harness: console
    harness_config:
      type: multi_line
      ordered: true
      regex:
        - "AMIC sample"
        - "Exiting"
```

## samples/drivers/audio/dmic/Kconfig
```kconfig
# Copyright 2025 NXP
# SPDX-License-Identifier: Apache-2.0

source "Kconfig.zephyr"

config SAMPLE_BIT_WIDTH
	int "Sample bit width"
	default 32 if DT_HAS_NXP_MICFIL_ENABLED
	default 16
	help
	  PCM sample bit width.
```

## samples/drivers/audio/dmic/boards/kit_pse84_eval_pse846gps2dbzc4a_m55.conf
```kconfig
# Copyright (c) 2026 Infineon Technologies AG,
# or an affiliate of Infineon Technologies AG.
#
# SPDX-License-Identifier: Apache-2.0

CONFIG_HW_CHANNEL_INDEX=1
CONFIG_MAIN_STACK_SIZE=4096
```

## samples/drivers/audio/dmic/boards/stm32f769i_disco.conf
```kconfig
# SPDX-FileCopyrightText: Copyright (c) 2026 STMicroelectronics
# SPDX-License-Identifier: Apache-2.0

# PDM filter index (pdm0); DFSDM channel comes from devicetree channel@N reg
CONFIG_SAMPLE_HW_CHANNEL_INDEX=0
```

## samples/drivers/audio/dmic/boards/stm32l476g_disco.conf
```kconfig
# SPDX-FileCopyrightText: Copyright (c) 2026 STMicroelectronics
# SPDX-License-Identifier: Apache-2.0

CONFIG_SAMPLE_HW_CHANNEL_INDEX=2
```

## samples/drivers/audio/dmic/sample.yaml
```yaml
sample:
  name: DMIC sample
tests:
  sample.drivers.audio.dmic:
    tags: dmic
    filter: dt_nodelabel_enabled("dmic_dev")
    extra_args:
      - platform:arduino_giga_r1/stm32h747xx/m7:SHIELD=arduino_giga_display_shield
    integration_platforms:
      - nrf52840dk/nrf52840
      - nrf5340dk/nrf5340/cpuapp
      - nrf54l15dk/nrf54l15/cpuapp
      - apollo510_evb
      - stm32f769i_disco
      - arduino_giga_r1/stm32h747xx/m7
    harness: console
    harness_config:
      type: multi_line
      ordered: true
      regex:
        - "DMIC sample"
        - "Exiting"
```

## samples/drivers/audio/es7210_custom/sample.yaml
```yaml
sample:
  name: es7210 custom codec sample
  description: Basic register-level ES7210 custom API example.

tests:
  sample.drivers.audio.es7210_custom:
    tags:
      - audio
      - codec
      - i2c
    filter: dt_compat_enabled("everest,es7210")
    integration_platforms:
      - m5stack_cores3_procpu
    harness: console
    harness_config:
      type: one_line
      regex:
        - "ES7210 configured"
```

## samples/drivers/audio/pipeline/boards/mimxrt685_evk_mimxrt685s_cm33.conf
```kconfig
#
# Copyright 2025 NXP
#
# SPDX-License-Identifier: Apache-2.0
#

CONFIG_I3C=y
CONFIG_AUDIO=y
CONFIG_AUDIO_CODEC=y

CONFIG_ZAUD_BUFFER_POOL_SZ_MAX=4096
CONFIG_ZAUD_BUFFER_POOL_NUM_MAX=8
```

## samples/drivers/audio/pipeline/sample.yaml
```yaml
sample:
  name: Audio pipeline sample

tests:
  sample.audio.pipeline:
    tags: 
    - audio
    - samples
    platform_allow:
      - mimxrt685_evk/mimxrt685s/cm33
    harness: console
    harness_config:
      type: one_line
      regex:
        - "Capture started"
    
```
