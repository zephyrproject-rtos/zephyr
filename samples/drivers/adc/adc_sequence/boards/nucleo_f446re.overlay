/* Copyright (c) 2025 STMicroelectronics
 * SPDX-License-Identifier: Apache-2.0
 */

/ {
	aliases {
		adc0 = &adc1;
	};
};

&adc1 {
	status="okay";
	#address-cells = <1>;
	#size-cells = <0>;

	/* Differential input: must specify pinctrl for both +/- inputs */
	pinctrl-0 = <&adc1_in1_pa1 >;
	st,adc-prescaler = <4>;
	pinctrl-names="default";

	channel@1 {
		reg = <1>;
		zephyr,gain = "ADC_GAIN_1";
		zephyr,reference = "ADC_REF_INTERNAL";
		zephyr,acquisition-time = <ADC_ACQ_TIME_MAX>;
		zephyr,resolution = <12>;
	};
};