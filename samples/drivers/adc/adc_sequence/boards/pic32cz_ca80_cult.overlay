/*
 * Copyright (c) 2026 Microchip Technology Inc.
 *
 * SPDX-License-Identifier: Apache-2.0
 */

/* Provide (ADC+) to PA18 (EXT1 Pin 3) and (ADC-) to PA17 (For differential Mode) */

/ {
	aliases {
		adc0 = &adc1;
	};
};

&adc1 {
	status = "okay";
	#address-cells = <1>;
	#size-cells = <0>;

	channel@0 {
		reg = <0>;
		zephyr,gain = "ADC_GAIN_1";
		zephyr,reference = "ADC_REF_VDD_1";
		zephyr,vref-mv = <3300>;
		zephyr,acquisition-time = <ADC_ACQ_TIME_DEFAULT>;
		zephyr,input-positive = <MCHP_ADC_AIN0>;
		/* zephyr,differential; */
		zephyr,resolution = <12>;
	};
};
