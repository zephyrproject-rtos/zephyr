/*
 * Copyright (c) 2022 Florin Stancu <niflostancu@gmail.com>
 *
 * SPDX-License-Identifier: Apache-2.0
 */

/ {
	zephyr,user {
		/* 0x5 is ADC_COMPB_IN_VDDS (power supply measurement) */
		io-channels = <&adc0 0x5>;
	};
};

&adc0 {
	status = "okay";

	#address-cells = <1>;
	#size-cells = <0>;

	channel@5 {
		reg = <5>;
		zephyr,gain = "ADC_GAIN_1";
		zephyr,reference = "ADC_REF_INTERNAL";
		zephyr,acquisition-time = <ADC_ACQ_TIME_DEFAULT>;
		zephyr,resolution = <12>;
	};
};
