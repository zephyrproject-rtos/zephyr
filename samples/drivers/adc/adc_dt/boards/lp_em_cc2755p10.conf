## samples/drivers/adc/adc_sequence/boards/lp_mspm0g3507.conf
```kconfig
# SPDX-FileCopyrightText: 2026 Texas Instruments Incorporated
# SPDX-License-Identifier: Apache-2.0

CONFIG_REGULATOR=y
```

## samples/drivers/adc/adc_sequence/boards/nucleo_g474re.conf
```kconfig
# SPDX-FileCopyrightText: Copyright The Zephyr Project Contributors
# SPDX-FileCopyrightText: Copyright (c) 2026 Caglayan Dokme <caglayandokme@gmail.com>
# SPDX-License-Identifier: Apache-2.0

CONFIG_ADC_STM32_DMA=y
```

## samples/drivers/audio/codec/Kconfig
```kconfig
# SPDX-FileCopyrightText: Copyright The Zephyr Project Contributors
# SPDX-License-Identifier: Apache-2.0

source "Kconfig.zephyr"

config SAMPLE_TONE_HZ
	int "Playback tone frequency in Hz"
	range 20 7999
	default 440
	help
	  Frequency of the sine tone the sample plays. It must stay below
	  8000 Hz, half the 16 kHz sample rate. The default 440 Hz is the
	  reference pitch of the A4 note, so the tone can be checked against
	  a guitar tuner or a tuning fork.
```

## samples/drivers/basic_radio/radio_rx/sample.yaml
```yaml
sample:
  name: Basic Radio RX
  description: Receive packets via the vendor-neutral basic_radio API.
```

## samples/drivers/basic_radio/radio_test_cw/sample.yaml
```yaml
sample:
  name: Basic Radio Carrier Wave
  description: Emit an unmodulated CW tone via the vendor-neutral basic_radio API.
```

## samples/drivers/basic_radio/radio_tx/boards/lp_em_cc2340r5.conf
```kconfig
# PHY applied at init and kept by basic_radio_config() with a NULL phy.
# Select one:
#   CONFIG_BASIC_RADIO_CC23X0_BOOT_PHY_BLE5_1M
#   CONFIG_BASIC_RADIO_CC23X0_BOOT_PHY_BLE5_2M
#   CONFIG_BASIC_RADIO_CC23X0_BOOT_PHY_BLE5_CODED
#   CONFIG_BASIC_RADIO_CC23X0_BOOT_PHY_IEEE_802_15_4
#   CONFIG_BASIC_RADIO_CC23X0_BOOT_PHY_PROP_250KBPS_MSK_FEC
#   CONFIG_BASIC_RADIO_CC23X0_BOOT_PHY_PROP_2MBPS_320KHZ_GFSK
#   CONFIG_BASIC_RADIO_CC23X0_BOOT_PHY_CUSTOM (application adds the export)
#   CONFIG_BASIC_RADIO_CC23X0_BOOT_PHY_NONE
# Defined in drivers/basic_radio/backends/ti/cc23x0/Kconfig.
CONFIG_BASIC_RADIO_CC23X0_BOOT_PHY_BLE5_1M=y
```

## samples/drivers/basic_radio/radio_tx/sample.yaml
```yaml
sample:
  name: Basic Radio TX
  description: Transmit packets via the vendor-neutral basic_radio API.
  
```

## samples/drivers/can/counter/boards/lp_em_cc35x1.conf
```kconfig
CONFIG_CAN_TI_CC35XX=y
CONFIG_CAN_FD_MODE=n

CONFIG_I2S=n

CONFIG_SPI=n
CONFIG_SPI_CC35XX=n
CONFIG_SPI_SHELL=n

CONFIG_I2C=n
CONFIG_I2C_CC35XX=n
CONFIG_I2C_SHELL=n
CONFIG_SENSOR=n
CONFIG_SENSOR_SHELL=n
CONFIG_LM75=n
CONFIG_BMA4XX=n

CONFIG_ADC=n
CONFIG_ADC_CC35XX=n
CONFIG_ADC_SHELL=n
```

## samples/drivers/crc/Kconfig
```kconfig
# Copyright 2025 NXP
# SPDX-License-Identifier: Apache-2.0

menu "CRC sample application"

choice SAMPLE_CRC_VARIANT
	prompt "CRC variant to run"
	default SAMPLE_CRC_VARIANT_CRC8 if CRC_DRIVER_HAS_CRC8
	default SAMPLE_CRC_VARIANT_CRC16_CCITT if CRC_DRIVER_HAS_CRC16_CCITT || CRC_DRIVER_HAS_CRC16
	default SAMPLE_CRC_VARIANT_CRC32_IEEE if CRC_DRIVER_HAS_CRC32_IEEE
	default SAMPLE_CRC_VARIANT_CRC32_C if CRC_DRIVER_HAS_CRC32_C
	help
	  Choose which CRC algorithm the sample computes.

config SAMPLE_CRC_VARIANT_CRC8
	bool "CRC8"
	depends on CRC_DRIVER_HAS_CRC8

config SAMPLE_CRC_VARIANT_CRC16_CCITT
	bool "CRC16-CCITT"
	depends on CRC_DRIVER_HAS_CRC16_CCITT || CRC_DRIVER_HAS_CRC16

config SAMPLE_CRC_VARIANT_CRC32_IEEE
	bool "CRC32-IEEE"
	depends on CRC_DRIVER_HAS_CRC32_IEEE

config SAMPLE_CRC_VARIANT_CRC32_C
	bool "CRC32-C"
	depends on CRC_DRIVER_HAS_CRC32_C

endchoice

endmenu

source "Kconfig.zephyr"
```

## samples/drivers/dac/boards/it51xxx_evb_it51526aw.conf
```kconfig
# Copyright (c) 2026 ITE Corporation. All Rights Reserved.
# SPDX-License-Identifier: Apache-2.0

CONFIG_DAC_BUFFER_NOT_SUPPORT=y
```

## samples/drivers/display/Kconfig
```kconfig
# Private config options for display sample

# Copyright (c) 2025 NXP
# SPDX-License-Identifier: Apache-2.0

mainmenu "Display sample application"

source "Kconfig.zephyr"

config SAMPLE_BUFFER_ADDR_ALIGN
	int "The display buffer address alignment"
	default 8 if 64BIT
	default 8 if DISPLAY_MCUX_ELCDIF
	default 4

config SAMPLE_WIDTH_ALIGN
	int "The update area width alignment"
	default 24 if ST730X
	default 8 if UC81XX
	default 6 if ST7586S
	default 4 if SSD1322 || SSD1363
	default 2 if SSD1327_5 || SSD1320 || SH1122
	default 1

config SAMPLE_HEIGHT_ALIGN
	int "The update area height alignment"
	default 8 if ST75256 || ST7567
	default 2 if ST730X
	default 1

config HEAP_MEM_POOL_ADD_SIZE_SAMPLE
	int "Sample maximum heap allocated buffer size"
	default 196608 if QEMU_RAMFB_DISPLAY
	default 65536
	help
	  Maximum size of the buffer for rendering rectangles
```

## samples/drivers/display/boards/am62l_evm_am62l3_a53.conf
```kconfig
#
# SPDX-FileCopyrightText: 2026 Texas Instruments Incorporated
#
# SPDX-License-Identifier: Apache-2.0
#
CONFIG_SAMPLE_DISPLAY_FULL_FRAME=y
CONFIG_SAMPLE_DISPLAY_DOUBLE_BUFFER=y
CONFIG_SAMPLE_DISPLAY_VSYNC_CALLBACK=y
CONFIG_ILI9881C_DSI_RPI_TOUCH_DISPLAY=y
```

## samples/drivers/display/boards/esp32s3_lcd_ev_procpu.conf
```kconfig
# Copyright (c) 2026 Espressif Systems (Shanghai) Co., Ltd.
# SPDX-License-Identifier: Apache-2.0

CONFIG_MAIN_STACK_SIZE=4096
CONFIG_DISPLAY_ESP32_DPI_BOUNCE_BUFFER_LINES=48
CONFIG_HEAP_MEM_POOL_ADD_SIZE_SAMPLE=51200
CONFIG_SPIRAM_SPEED_80M=y
CONFIG_ESP32S3_DATA_CACHE_64KB=y
CONFIG_ESP32S3_DATA_CACHE_LINE_64B=y
```

## samples/drivers/flash_shell/boards/nucleo_h7s3l8.conf
```kconfig
# Copyright (c) 2026 EXALT Technologies
# SPDX-License-Identifier: Apache-2.0

CONFIG_MSPI=y
CONFIG_LOG=n
CONFIG_HEAP_MEM_POOL_SIZE=8192
CONFIG_CACHE_MANAGEMENT=n
CONFIG_SHELL_MINIMAL=y
CONFIG_SIZE_OPTIMIZATIONS=y
```

## samples/drivers/flash_shell/boards/stm32h573i_dk.conf
```kconfig
# Copyright (c) 2026 EXALT Technologies
# SPDX-License-Identifier: Apache-2.0

CONFIG_MSPI_LOG_LEVEL_INF=y
CONFIG_HEAP_MEM_POOL_SIZE=8192
```
