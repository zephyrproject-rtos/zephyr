/*
 * SPDX-License-Identifier: Apache-2.0
 *
 * Copyright (c) 2022 Andriy Gelman <andriy.gelman@gmail.com>
 */

/ {
	zephyr,user {
		io-channels = <&adc0 0>; /* P14.0 */
	};
};

&adc0 {
	#address-cells = <1>;
	#size-cells = <0>;

	channel@0 {
		reg = <0>;
		zephyr,acquisition-time = <ADC_ACQ_TIME_DEFAULT>;
		zephyr,gain = "ADC_GAIN_1";
		zephyr,reference = "ADC_REF_INTERNAL";
		zephyr,resolution = <12>;
	};
	status = "okay";
};
