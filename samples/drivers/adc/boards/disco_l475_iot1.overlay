/*
 * SPDX-License-Identifier: Apache-2.0
 *
 * Copyright (c) 2020 Linaro Limited
 */

/ {
	zephyr,user {
		/* adjust channel number according to pinmux in board.dts */
		io-channels = <&adc1 5>;
	};
};
