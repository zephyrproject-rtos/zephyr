/*
 * SPDX-License-Identifier: Apache-2.0
 *
 * Copyright (c) 2020 Linaro Limited
 * Copyright 2023-2024 NXP
 */

#include <zephyr/dt-bindings/adc/mcux-lpadc.h>

/ {
	zephyr,user {
		/* adjust channel number according to pinmux in board.dts */
		io-channels = <&lpadc0 0>;
	};
};

&lpadc0 {
	#address-cells = <1>;
	#size-cells = <0>;

	/*
	 * To use this sample:
	 * - Connect LPADC0 CH0 signal to voltage between 0~1.8V (J9 pin 10)
	 */

	channel@0 {
		reg = <0>;
		zephyr,gain = "ADC_GAIN_1";
		zephyr,reference = "ADC_REF_EXTERNAL0";
		zephyr,vref-mv = <1800>;
		zephyr,acquisition-time = <ADC_ACQ_TIME(ADC_ACQ_TIME_TICKS, 7)>;
		zephyr,resolution = <12>;
		zephyr,input-positive = <MCUX_LPADC_CH0A>;
	};
};
