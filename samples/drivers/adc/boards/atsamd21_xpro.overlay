/*
 * SPDX-License-Identifier: Apache-2.0
 *
 * Copyright (c) 2021 Argentum Systems Ltd.
 */

#include <zephyr/dt-bindings/adc/adc.h>

/ {
	zephyr,user {
		/* EXT-1, pin 3 ADC(+) */
		io-channels = <&adc 8>;
	};
};

&adc {
	#address-cells = <1>;
	#size-cells = <0>;

	channel@8 {
		reg = <8>;
		zephyr,gain = "ADC_GAIN_1";
		zephyr,reference = "ADC_REF_INTERNAL";
		zephyr,acquisition-time = <ADC_ACQ_TIME_DEFAULT>;
		zephyr,resolution = <12>;
		zephyr,input-positive = <8>;
	};
};
