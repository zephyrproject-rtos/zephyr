/*
 * Copyright (c) 2022 Wolter HV <wolterhv@gmx.de>
 *
 * SPDX-License-Identifier: Apache-2.0
 */

/ {
	zephyr,user {
		io-channels = <&adc1 6>;
	};
};

&adc1 {
	status = "okay";
};

&adc2 {
	status = "okay";
};
