/*
 * SPDX-License-Identifier: Apache-2.0
 *
 * Copyright (c) 2020 Libre Solar Technologies GmbH
 */

/ {
	zephyr,user {
		/* adjust channel number according to pinmux in board.dts */
		io-channels = <&adc1 1>;
	};
};
