/*
 * SPDX-License-Identifier: Apache-2.0
 *
 * Copyright (c) 2023 Antmicro <www.antmicro.com>
 */

/ {
	zephyr,user {
		io-channels = <&adc0 3>;
	};
};

&adc0 {
	#address-cells = <1>;
	#size-cells = <0>;

	channel@3 {
		reg = <3>;
		zephyr,gain = "ADC_GAIN_1";
		zephyr,reference = "ADC_REF_VDD_1";
		zephyr,acquisition-time = <ADC_ACQ_TIME_DEFAULT>;
		zephyr,resolution = <12>;
		zephyr,input-positive = <0>;
	};
};
