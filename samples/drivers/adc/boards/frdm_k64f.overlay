/*
 * SPDX-License-Identifier: Apache-2.0
 *
 * Copyright (c) 2022 NXP
 */

/ {
	zephyr,user {
		/* adjust channel number according to pinmux in board.dts */
		io-channels = <&adc1 14>;
	};
};

&adc1 {
	#address-cells = <1>;
	#size-cells = <0>;

	channel@e {
		reg = <14>;
		zephyr,gain = "ADC_GAIN_1";
		zephyr,reference = "ADC_REF_INTERNAL";
		zephyr,acquisition-time = <ADC_ACQ_TIME_DEFAULT>;
		zephyr,resolution = <12>;
	};
};
