/*
 * SPDX-License-Identifier: Apache-2.0
 *
 * Copyright (c) 2021 Gerson Fernando Budke <nandojve@gmail.com>
 */

#include <zephyr/dt-bindings/adc/adc.h>

/ {
	zephyr,user {
		/* EXT-1 ADC(+) */
		io-channels = <&adc 6>;
	};
};

&adc {
	#address-cells = <1>;
	#size-cells = <0>;

	channel@6 {
		reg = <6>;
		zephyr,gain = "ADC_GAIN_1";
		zephyr,reference = "ADC_REF_INTERNAL";
		zephyr,acquisition-time = <ADC_ACQ_TIME_DEFAULT>;
		zephyr,resolution = <12>;
		zephyr,input-positive = <6>;
	};
};
