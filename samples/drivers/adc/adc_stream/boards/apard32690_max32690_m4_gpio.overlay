/*
 * Copyright (c) 2025-2026 Analog Devices, Inc.
 *
 * SPDX-License-Identifier: Apache-2.0
 */

/ {
	zephyr,user {
		io-channels = <&adc4052_eval_ad4052_ardz 0>;
	};
};

&adc {
	status = "disabled";
};

&adc4052_eval_ad4052_ardz {
	sampling-period = <20000>;
};
