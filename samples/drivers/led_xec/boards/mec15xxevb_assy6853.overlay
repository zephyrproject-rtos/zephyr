/*
 * Copyright (c) 2022 Microchip Technology Inc.
 *
 * SPDX-License-Identifier: Apache-2.0
 */

&bbled0 {
	compatible = "microchip,xec-bbled";
	pinctrl-0 = <&led0_gpio156>;
	pinctrl-1 = <&led0_gpio156_sleep>;
	pinctrl-names = "default", "sleep";
	status = "okay";
};

&bbled1 {
	compatible = "microchip,xec-bbled";
	pinctrl-0 = <&led1_gpio157>;
	pinctrl-1 = <&led1_gpio157_sleep>;
	pinctrl-names = "default", "sleep";
	status = "okay";
};

&bbled2 {
	compatible = "microchip,xec-bbled";
	pinctrl-0 = <&led2_gpio153>;
	pinctrl-1 = <&led2_gpio153_sleep>;
	pinctrl-names = "default", "sleep";
	status = "okay";
};
