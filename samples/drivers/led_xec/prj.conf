## CMakeLists.txt
```
# SPDX-License-Identifier: Apache-2.0

cmake_minimum_required(VERSION 3.20.0)

find_package(Zephyr HINTS $ENV{ZEPHYR_BASE})
project(led_xec)

FILE(GLOB app_sources src/*.c)
target_sources(app PRIVATE ${app_sources})
```

## sample.yaml
```
sample:
  description: Demonstration of the Microchip XEC LED driver
  name: XEC LED sample
tests:
  sample.drivers.led.led_xec:
    build_only: true
    tags: LED
    platform_allow:
      - mec172xevb_assy6906/mec172x_nsz
      - mec15xxevb_assy6853/mec1501_hsz
```

## prj.conf
```kconfig
CONFIG_LOG=y
CONFIG_LOG_MODE_MINIMAL=y
CONFIG_PM_DEVICE=y

CONFIG_LED=y
```

## boards/mec15xxevb_assy6853.overlay
```dts
/*
 * Copyright (c) 2022 Microchip Technology Inc.
 *
 * SPDX-License-Identifier: Apache-2.0
 */

&bbled0 {
	compatible = "microchip,xec-bbled";
	pinctrl-0 = <&led0_gpio156>;
	pinctrl-names = "default";
	status = "okay";
};

&bbled1 {
	compatible = "microchip,xec-bbled";
	pinctrl-0 = <&led1_gpio157>;
	pinctrl-names = "default";
	status = "okay";
};

&bbled2 {
	compatible = "microchip,xec-bbled";
	pinctrl-0 = <&led2_gpio153>;
	pinctrl-names = "default";
	status = "okay";
};
```

## boards/mec172xevb_assy6906.overlay
```dts
/*
 * Copyright (c) 2022 Microchip Technology Inc.
 *
 * SPDX-License-Identifier: Apache-2.0
 */

&bbled0 {
	compatible = "microchip,xec-bbled";
	pinctrl-0 = <&led0_gpio156>;
	pinctrl-1 = <&led0_gpio156_sleep>;
	pinctrl-names = "default", "sleep";
	status = "okay";
};

&bbled1 {
	compatible = "microchip,xec-bbled";
	pinctrl-0 = <&led1_gpio157>;
	pinctrl-1 = <&led1_gpio157_sleep>;
	pinctrl-names = "default", "sleep";
	status = "okay";
};

&bbled2 {
	compatible = "microchip,xec-bbled";
	pinctrl-0 = <&led2_gpio153>;
	pinctrl-1 = <&led2_gpio153_sleep>;
	pinctrl-names = "default", "sleep";
	status = "okay";
};

&bbled3 {
	compatible = "microchip,xec-bbled";
	pinctrl-0 = <&led3_gpio035>;
	pinctrl-1 = <&led3_gpio035_sleep>;
	pinctrl-names = "default", "sleep";
	status = "okay";
};
```

## src/main.c
```c
/*
 * Copyright (c) 2022 Microchip Technology Inc.
 *
 * SPDX-License-Identifier: Apache-2.0
 */

#include <errno.h>
#include <soc.h>
#include <zephyr/kernel.h>
#include <zephyr/device.h>
#include <zephyr/drivers/led.h>
#include <zephyr/logging/log_ctrl.h>
#include <zephyr/logging/log.h>
#include <zephyr/sys/sys_io.h>
LOG_MODULE_DECLARE(led, CONFIG_LED_LOG_LEVEL);

#define K_WAIT_DELAY          100u

struct dev_info {
	const struct device *dev;
	uint32_t base_addr;
};

#define XEC_BBLED_DEV(node_id)		\
	{ .dev = DEVICE_DT_GET(node_id), .base_addr = (uint32_t)DT_REG_ADDR(node_id) },

static const struct dev_info led_dev_table[] = {
	DT_FOREACH_STATUS_OKAY(microchip_xec_bbled, XEC_BBLED_DEV)
};

static void print_bbled_regs(mem_addr_t bbled_base)
{
	uint32_t r = 0;

	if (!bbled_base) {
		return;
	}

	LOG_INF("BBLED @ 0x%lx", bbled_base);

	r = sys_read32(bbled_base);
	LOG_INF("config = 0x%x", r);
	r = sys_read32(bbled_base + 4U);
	LOG_INF("limits = 0x%x", r);
	r = sys_read32(bbled_base + 8U);
	LOG_INF("delay = 0x%x", r);
	r = sys_read32(bbled_base + 0xcU);
	LOG_INF("update_step_size = 0x%x", r);
	r = sys_read32(bbled_base + 0x10U);
	LOG_INF("update_interval = 0x%x", r);
	r = sys_read32(bbled_base + 0x14U);
	LOG_INF("output_delay = 0x%x", r);
}

int led_test(void)
{
	int ret = 0;
	size_t n = 0;
	uint32_t delay_on = 0, delay_off = 0;

	/* Account for the time serial port is detected so log messages can
	 * be seen
	 */
	k_sleep(K_SECONDS(1));

	LOG_INF("Microchip XEC EVB BBLED Sample");

	for (n = 0; n < ARRAY_SIZE(led_dev_table); n++) {
		const struct device *dev = led_dev_table[n].dev;
		uint32_t base = led_dev_table[n].base_addr;

		LOG_INF("BBLED instance %d @ %x", n, base);
		print_bbled_regs(base);

		if (!device_is_ready(dev)) {
			LOG_ERR("%s: device not ready", dev->name);
			continue;
		}

		LOG_INF("blink: T = 0.5 second, duty cycle = 0.5");
		delay_on = 250;
		delay_off = 250;
		ret = led_blink(dev, 0, delay_on, delay_off);
		if (ret) {
			LOG_ERR("LED blink API returned error %d", ret);
		}
		print_bbled_regs(base);

		LOG_INF("Delay 5 seconds");
		k_sleep(K_SECONDS(5));

		LOG_INF("blink: T = 3 seconds, duty cycle = 0.4");
		delay_on = 1200;
		delay_off = 1800;
		ret = led_blink(dev, 0, delay_on, delay_off);
		if (ret) {
			LOG_ERR("LED blink API returned error %d", ret);
		}
		print_bbled_regs(base);

		LOG_INF("Delay 15 seconds");
		k_sleep(K_SECONDS(15));

		LOG_INF("Set ON");
		ret = led_on(dev, 0);
		if (ret) {
			LOG_ERR("LED ON API returned error %d", ret);
		}
		print_bbled_regs(base);

		LOG_INF("Delay 2 seconds");
		k_sleep(K_SECONDS(2));

		LOG_INF("Set OFF");
		ret = led_off(dev, 0);
		if (ret) {
			LOG_ERR("LED OFF API returned error %d", ret);
		}
		print_bbled_regs(base);

		LOG_INF("Delay 2 seconds");
		k_sleep(K_SECONDS(2));
	}

	LOG_INF("LED test done");

	return 0;
}

void main(void)
{
	led_test();
}
```
