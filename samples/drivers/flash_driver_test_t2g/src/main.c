/*
 * Copyright (c) 2025 Linumiz GmbH
 *
 * SPDX-License-Identifier: Apache-2.0
 */

#include <zephyr/kernel.h>
#include <zephyr/device.h>
#include <zephyr/drivers/flash.h>
#include <zephyr/logging/log.h>
#include <zephyr/devicetree.h>
#include <string.h>

LOG_MODULE_REGISTER(flash_test, LOG_LEVEL_INF);

#define FLASH0 DT_NODELABEL(flash0)
#define FLASH1 DT_NODELABEL(flash1)
#define FLASH2 DT_NODELABEL(flash2)
#define FLASH3 DT_NODELABEL(flash3)

#define FLASH0_SELECTED DT_NODE_EXISTS(DT_CHILD(FLASH0, partitions))
#define FLASH1_SELECTED DT_NODE_EXISTS(DT_CHILD(FLASH1, partitions))
#define FLASH2_SELECTED DT_NODE_EXISTS(DT_CHILD(FLASH2, partitions))
#define FLASH3_SELECTED DT_NODE_EXISTS(DT_CHILD(FLASH3, partitions))

#if FLASH0_SELECTED
	#define TEST_SIZE 0x8000  /* CFLASH - LRG - 32 KB - Erase sector */
	#define USE_CFLASH 1
	#define TEST_OFFSET 0x5E8000
#elif FLASH1_SELECTED
	#define TEST_SIZE 0x2000  /* CFLASH - SMS - 8 KB - Erase sector */
	#define USE_CFLASH 1
	#define TEST_OFFSET 0x10000
#elif FLASH2_SELECTED
	#define TEST_SIZE 0x800  /* WFLASH - LRG - 2 KB - Erase sector */
	#define USE_WFLASH 1
	#define TEST_OFFSET 0x0
#elif FLASH3_SELECTED
	#define TEST_SIZE 0x80  /* WFLASH - SMS - 128 bytes - Erase sector */
	#define USE_WFLASH 1
	#define TEST_OFFSET 0x0
#else
	/* FOR SMIF */
	#define TEST_SIZE 0x80  /* WFLASH - SMS - 128 bytes - Erase sector */
	#define USE_WFLASH 1
	#define TEST_OFFSET 0x0
#endif

int main(void)
{
	/* Use the zephyr_flash_controller for the flash driver */
	// const struct device *flash_dev = DEVICE_DT_GET(DT_CHOSEN(zephyr_flash_controller));

	/* Use the smif_0 or smif_1 for the flash driver */

	// const struct device *flash_dev = DEVICE_DT_GET(DT_NODELABEL(smif0));

	const struct device *flash_dev = DEVICE_DT_GET(DT_NODELABEL(smif0));

	int ret;

/* Option 1: 64-byte data array - For WFLASH */
#if USE_WFLASH
CY_ALIGN(32) uint8_t write_buf[64] = {
	0xAB, 0xCD, 0xEF, 0x12, 0x34, 0x56, 0x78, 0x9A,
	0xBC, 0xDE, 0xF0, 0x11, 0x22, 0x33, 0x44, 0x55,
	0x66, 0x77, 0x88, 0x99, 0xAA, 0xBB, 0xCC, 0xDD,
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	0xEE, 0xFF, 0x00, 0x11, 0x22, 0x33, 0x44, 0x55
};
CY_ALIGN(32) uint8_t read_buf[64] = {0};
#endif

/* Option 2: 512-byte data array - FOR CFLASH*/
#if USE_CFLASH
CY_ALIGN(32) uint8_t write_buf[512] = {
	0xAB, 0xCD, 0xEF, 0x12, 0x34, 0x56, 0x78, 0x9A,
	0xBC, 0xDE, 0xF0, 0x11, 0x22, 0x33, 0x44, 0x55,
	0x66, 0x77, 0x88, 0x99, 0xAA, 0xBB, 0xCC, 0xDD,
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	0xEE, 0xFF, 0x00, 0x11, 0x22, 0x33, 0x44, 0x55,
};
CY_ALIGN(32) uint8_t read_buf[512] = {0};
#endif

	if (!device_is_ready(flash_dev)) {
		LOG_ERR("Flash device not ready");
		return -ENODEV;
	}

	LOG_INF("Flash device: %s", flash_dev->name);
	LOG_INF("Buffer size: 0x%x bytes", sizeof(write_buf));
	LOG_INF("Test offset: 0x%x, erase size: 0x%x", TEST_OFFSET, TEST_SIZE);

	LOG_INF("Erasing 0x%x bytes from sector at offset 0x%x", TEST_SIZE ,TEST_OFFSET);
	ret = flash_erase(flash_dev, TEST_OFFSET, TEST_SIZE);
	if (ret != 0) {
		LOG_ERR("Erase failed: %d", ret);
		//return ret;
	}
	LOG_INF("Erase completed");

	// Testing read after erase
	LOG_INF("Reading 0x%x bytes from offset 0x%x after erase", sizeof(read_buf), TEST_OFFSET);
	ret = flash_read(flash_dev, TEST_OFFSET, read_buf, sizeof(read_buf));
	if (ret != 0) {
		LOG_ERR("Read failed: %d", ret);
		return ret;
	}
	LOG_INF("Read after erase completed");

	LOG_INF("Read buffer contents after erase:");
	for (size_t i = 0; i < sizeof(read_buf); i += 16) {
		LOG_INF("[0x%04zx] %02X %02X %02X %02X %02X %02X %02X %02X %02X %02X %02X %02X %02X %02X %02X %02X",
			i,
			read_buf[i], read_buf[i+1], read_buf[i+2], read_buf[i+3],
			read_buf[i+4], read_buf[i+5], read_buf[i+6], read_buf[i+7],
			read_buf[i+8], read_buf[i+9], read_buf[i+10], read_buf[i+11],
			read_buf[i+12], read_buf[i+13], read_buf[i+14], read_buf[i+15]);
	}

	LOG_INF("Writing 0x%x bytes at offset 0x%x", sizeof(write_buf), TEST_OFFSET);
	ret = flash_write(flash_dev, TEST_OFFSET, write_buf, sizeof(write_buf));
	if (ret != 0) {
		LOG_ERR("Write failed: %d", ret);
		return ret;
	}
	LOG_INF("Write completed");

	LOG_INF("Reading 0x%x bytes from offset 0x%x", sizeof(read_buf), TEST_OFFSET);
	ret = flash_read(flash_dev, TEST_OFFSET, read_buf, sizeof(read_buf));
	if (ret != 0) {
		LOG_ERR("Read failed: %d", ret);
		return ret;
	}
	LOG_INF("Read after write completed");

	LOG_INF("Read buffer contents after write:");
	for (size_t i = 0; i < sizeof(read_buf); i += 16) {
		LOG_INF("[0x%04zx] %02X %02X %02X %02X %02X %02X %02X %02X %02X %02X %02X %02X %02X %02X %02X %02X",
			i,
			read_buf[i], read_buf[i+1], read_buf[i+2], read_buf[i+3],
			read_buf[i+4], read_buf[i+5], read_buf[i+6], read_buf[i+7],
			read_buf[i+8], read_buf[i+9], read_buf[i+10], read_buf[i+11],
			read_buf[i+12], read_buf[i+13], read_buf[i+14], read_buf[i+15]);
	}

	if (memcmp(write_buf, read_buf, sizeof(write_buf)) == 0) {
		LOG_INF("Test passed: data matches");
	} else {
		LOG_ERR("Test failed: data mismatch");
		for (size_t i = 0; i < sizeof(write_buf); i++) {
			if (write_buf[i] != read_buf[i]) {
				LOG_ERR("Mismatch at offset 0x%04zX: expected 0x%02X, got 0x%02X",
					i, write_buf[i], read_buf[i]);
			}
		}
		return -1;
	}

	// Testing Erase
	LOG_INF("Erasing 0x%x bytes from sector at offset 0x%x after write", TEST_SIZE ,TEST_OFFSET);
	ret = flash_erase(flash_dev, TEST_OFFSET, TEST_SIZE);
	if (ret != 0) {
		LOG_ERR("Erase failed: %d", ret);
		return ret;
	}
	LOG_INF("Erase completed");

	// Testing read after erase
	LOG_INF("Reading 0x%x bytes from offset 0x%x after erase", sizeof(read_buf), TEST_OFFSET);
	ret = flash_read(flash_dev, TEST_OFFSET, read_buf, sizeof(read_buf));
	if (ret != 0) {
		LOG_ERR("Read failed: %d", ret);
		return ret;
	}
	LOG_INF("Read after erase completed");

	LOG_INF("Read buffer contents after erase:");
	for (size_t i = 0; i < sizeof(read_buf); i += 16) {
		LOG_INF("[0x%04zx] %02X %02X %02X %02X %02X %02X %02X %02X %02X %02X %02X %02X %02X %02X %02X %02X",
			i,
			read_buf[i], read_buf[i+1], read_buf[i+2], read_buf[i+3],
			read_buf[i+4], read_buf[i+5], read_buf[i+6], read_buf[i+7],
			read_buf[i+8], read_buf[i+9], read_buf[i+10], read_buf[i+11],
			read_buf[i+12], read_buf[i+13], read_buf[i+14], read_buf[i+15]);
	}

	return 0;

}
