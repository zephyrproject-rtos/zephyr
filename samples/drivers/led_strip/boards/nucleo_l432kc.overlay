/*
 * Copyright (c) 2018 Nordic Semiconductor ASA
 *
 * SPDX-License-Identifier: Apache-2.0
 */

#include <zephyr/dt-bindings/led/led.h>

&spi1 {

	apa102: apa102@0 {
		compatible = "apa,apa102";
		reg = <0>;
		spi-max-frequency = <5250000>;
		chain-length = <1>;
		color-mapping = <LED_COLOR_ID_BLUE
				 LED_COLOR_ID_GREEN
				 LED_COLOR_ID_RED>;
	};
};

/ {
	aliases {
		led-strip = &apa102;
	};
};
