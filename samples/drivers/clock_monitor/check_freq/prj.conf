## CMakeLists.txt
```
# SPDX-FileCopyrightText: 2026 NXP
# SPDX-License-Identifier: Apache-2.0

cmake_minimum_required(VERSION 3.28.0)
# Shared bindings for the sample-local "clock-monitor-required-clocks" node.
list(APPEND DTS_ROOT ${CMAKE_CURRENT_SOURCE_DIR}/..)
find_package(Zephyr REQUIRED HINTS $ENV{ZEPHYR_BASE})
project(clock_monitor_check_freq)

FILE(GLOB app_sources src/*.c)
target_sources(app PRIVATE ${app_sources})
```

## Kconfig
```
# SPDX-FileCopyrightText: 2026 NXP
# SPDX-License-Identifier: Apache-2.0

mainmenu "Clock Monitor - Frequency Check sample"

config SAMPLE_EXPECTED_HZ
	int "Expected monitored-clock frequency (Hz), 0 = auto"
	default 0
	help
	  Nominal expected frequency of the monitored clock, in Hz.
	  Set to 0 to let the driver auto-derive it from the monitored
	  clock via clock control driver.

config SAMPLE_TOLERANCE_PPM
	int "Window tolerance (parts-per-million)"
	default 50000
	help
	  Acceptable +/- deviation from the expected frequency, in ppm.
	  Default 50000 = +/- 5 %, which is loose enough to ride out
	  crystal warm-up on a typical EVK.

config SAMPLE_WINDOW_NS
	int "Measurement window duration (ns)"
	default 1000000
	help
	  Measurement window in nanoseconds. Longer windows give
	  finer ppm resolution but slower fault response. 1 ms default.

source "Kconfig.zephyr"
```

## sample.yaml
```
sample:
  name: Clock Monitor - Frequency Check
  description: |
    Uses a clock_monitor instance (referenced by the `clock-monitor`
    devicetree alias) in WINDOW mode to watch a monitored clock
    against programmable thresholds. Installs a callback that logs
    any out-of-window or clock-lost events, and periodically drains
    get_events() from the main loop to show the polling path.

    Which physical clock is being watched depends on which CMU
    instance the board overlay aliases to `clock-monitor`. The
    expected frequency, tolerance and measurement window are all
    Kconfig-tunable (see Kconfig in this sample).
tests:
  sample.drivers.clock_monitor.check_freq:
    platform_allow:
      - frdm_mcxe31b
    tags:
      - drivers
      - clock_monitor
    harness: console
    harness_config:
      type: one_line
      regex:
        - "clock check running \\(expected ~\\d+ Hz"
```

## prj.conf
```kconfig
CONFIG_CLOCK_MONITOR=y
CONFIG_LOG=y
CONFIG_PRINTK=y
```

## boards/frdm_mcxe31b.overlay
```dts
/*
 * SPDX-FileCopyrightText: 2026 NXP
 *
 * SPDX-License-Identifier: Apache-2.0
 */

/ {
	aliases {
		clock-monitor = &cmu_0;
	};
};

&cmu_0 {
	status = "okay";
	/* Keep the default nxp,fault-reaction = "interrupt" so that
	 * threshold-crossing events are delivered through the driver
	 * callback rather than routed to FCCU destructive reset.
	 */
};
```

## boards/frdm_mcxw72.overlay
```dts
/*
 * SPDX-FileCopyrightText: 2026 NXP
 *
 * SPDX-License-Identifier: Apache-2.0
 */

/* SFA0 watches the 32 kHz clock against the 96 MHz CPU clock. The window
 * centre comes from the target clock-frequency (32768 Hz).
 */

/ {
	aliases {
		clock-monitor = &sfa0;
	};
};

&sfa0 {
	status = "okay";
};
```

## boards/mcx_n9xx_evk_mcxn947_cpu0.overlay
```dts
/*
 * SPDX-FileCopyrightText: 2026 NXP
 *
 * SPDX-License-Identifier: Apache-2.0
 */

#include <zephyr/dt-bindings/clock/mcux_lpc_syscon_clock.h>

/ {
	clock-monitor-required-clocks {
		compatible = "clock-monitor-required-clocks";
		clocks = <&syscon MCUX_FRO_12M_CLK>,
			 <&syscon MCUX_FRO_HF_CLK>;
	};
};
```

## src/main.c
```c
/*
 * SPDX-FileCopyrightText: 2026 NXP
 *
 * SPDX-License-Identifier: Apache-2.0
 *
 * Sample: out-of-window frequency check through the clock_monitor API.
 *
 * Targets whichever instance the board overlay aliases to
 * `clock-monitor`. The sample configures WINDOW mode (expected
 * frequency, tolerance and window duration all Kconfig-tunable) and
 * installs a callback that logs any threshold-crossing events; the
 * callback is the only event delivery path. The main loop just prints
 * a periodic heartbeat.
 */

#include <errno.h>

#include <zephyr/device.h>
#include <zephyr/drivers/clock_control.h>
#include <zephyr/drivers/clock_monitor.h>
#include <zephyr/kernel.h>
#include <zephyr/logging/log.h>
#include <zephyr/sys/util.h>

LOG_MODULE_REGISTER(sample, LOG_LEVEL_INF);

#define MONITOR DEVICE_DT_GET(DT_ALIAS(clock_monitor))

/* Enable the clocks a board declares in its clock-monitor-required-clocks node. */
#if DT_HAS_COMPAT_STATUS_OKAY(clock_monitor_required_clocks)

#define REQUIRED_CLOCK_ON(node_id, prop, idx)                                  \
	do {                                                                   \
		const struct device *_clk =                                    \
			DEVICE_DT_GET(DT_CLOCKS_CTLR_BY_IDX(node_id, idx));    \
		if (device_is_ready(_clk)) {                                   \
			(void)clock_control_on(_clk,                           \
				(clock_control_subsys_t)(uintptr_t)            \
				DT_CLOCKS_CELL_BY_IDX(node_id, idx, name));    \
		}                                                              \
	} while (0)

static void enable_required_clocks(void)
{
	DT_FOREACH_PROP_ELEM_SEP(
		DT_COMPAT_GET_ANY_STATUS_OKAY(clock_monitor_required_clocks),
		clocks, REQUIRED_CLOCK_ON, (;));
}

#else

/*
 * No clock-monitor-required-clocks node on this board, so there are no
 * source clocks to bring up. Provide an empty stub so the call site in
 * main() stays unconditional.
 */
static void enable_required_clocks(void) {}

#endif

/*
 * Tunable parameters come straight from Kconfig
 * (see check_freq/Kconfig). If CONFIG_SAMPLE_EXPECTED_HZ is left at
 * its default of 0, the driver auto-queries the monitored clock's
 * rate via clock_control and uses it as the window centre.
 */

static void fault_cb(const struct device *dev,
		     const struct clock_monitor_event_data *evt,
		     void *user_data)
{
	ARG_UNUSED(user_data);

	if (evt->events & CLOCK_MONITOR_EVT_FREQ_HIGH) {
		LOG_ERR("[%s] monitored clock above upper threshold", dev->name);
	}
	if (evt->events & CLOCK_MONITOR_EVT_FREQ_LOW) {
		LOG_ERR("[%s] monitored clock below lower threshold (or lost)",
			dev->name);
	}
}

int main(void)
{
	const struct device *dev = MONITOR;

	if (!device_is_ready(dev)) {
		LOG_ERR("%s is not ready", dev->name);
		return -ENODEV;
	}

	/* Ensure any board-declared source clocks are running before configuring. */
	enable_required_clocks();

	struct clock_monitor_config cfg = {
		.mode = CLOCK_MONITOR_MODE_WINDOW,
		.window = {
			.expected_hz   = CONFIG_SAMPLE_EXPECTED_HZ,
			.tolerance_ppm = CONFIG_SAMPLE_TOLERANCE_PPM,
			.window_ns     = CONFIG_SAMPLE_WINDOW_NS,
		},
		.callback  = fault_cb,
	};

	int ret = clock_monitor_configure(dev, &cfg);


	if (ret != 0) {
		LOG_ERR("configure(%s) failed: %d", dev->name, ret);
		return ret;
	}

	ret = clock_monitor_start(dev);

	if (ret != 0) {
		LOG_ERR("start(%s) failed: %d", dev->name, ret);
		return ret;
	}

	LOG_INF("clock check running (expected ~%u Hz, tolerance +/-%u ppm, "
		"window %u ns)",
		(uint32_t)CONFIG_SAMPLE_EXPECTED_HZ,
		(uint32_t)CONFIG_SAMPLE_TOLERANCE_PPM,
		(uint32_t)CONFIG_SAMPLE_WINDOW_NS);

	while (1) {
		k_sleep(K_SECONDS(5));

		LOG_INF("heartbeat: clock check running");
	}

	return 0;
}
```
