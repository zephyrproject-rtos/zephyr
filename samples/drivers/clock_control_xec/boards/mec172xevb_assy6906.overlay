/*
 * Copyright (c) 2022 Microchip Technology Inc.
 *
 * SPDX-License-Identifier: Apache-2.0
 */

#include <zephyr/dt-bindings/clock/mchp_xec_pcr.h>

/ {};

/*
 * 32KHZ_IN is a clock source and no debug
 * pinctrl-0 = <&clk_32khz_in_gpio165>;
 *
 * 32KHZ_IN is a clock source with debug on GPIO060 and GPIO221
 * pinctrl-0 = <&clk_32khz_in_gpio165 &tst_clk_out_gpio060 &clk_32khz_out_gpio221>;
 *
 * MEC172x implements clock monitor hardware.
 */
&pcr {
	core-clock-div = <1>;
	clk32kmon-period-min = <1435>;
	clk32kmon-period-max = <1495>;
	clk32kmon-duty-cycle-var-max = <192>;
	clk32kmon-valid-min = <4>;
	xtal-enable-delay-ms = <10>;
	pll-lock-timeout-ms = <30>;

	/* Select internal Silicon OSC as PLL 32KHz clock source
	 * Select external XTAL parallel connected as peripheral 32KHz clock source
	 */
	pll-32k-src = <MCHP_XEC_PLL_CLK32K_SRC_SIL_OSC>;
	periph-32k-src = <MCHP_XEC_PERIPH_CLK32K_SRC_XTAL_XTAL>;

	/* debug only, not using 32KHZ_IN pin */
	pinctrl-0 = <&tst_clk_out_gpio060 &clk_32khz_out_gpio221>;
	pinctrl-names = "default";

	status = "okay";
};
