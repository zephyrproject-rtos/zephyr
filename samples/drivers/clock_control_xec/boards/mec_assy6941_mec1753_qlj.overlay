/*
 * Copyright (c) 2022 Microchip Technology Inc.
 *
 * SPDX-License-Identifier: Apache-2.0
 */

#include <zephyr/dt-bindings/clock/mchp_xec_pcr.h>

/ {};

/*
 * 32KHZ_IN is a clock source and no debug
 * pinctrl-0 = <&clk_32khz_in_gpio165>;
 *
 * 32KHZ_IN is a clock source with debug
 * pinctrl-0 = <&clk_32khz_in_gpio165 &tst_clk_out_gpio060 &clk_32khz_out_gpio221>;
 *
 * MEC175x implements clock monitor hardware.
 */
&pcr {
	core-clock-div = <1>;
	clk32kmon-period-min = <1435>;
	clk32kmon-period-max = <1495>;
	clk32kmon-duty-cycle-var-max = <212>;
	clk32kmon-valid-min = <4>;
	xtal-enable-delay-ms = <10>;
	pll-lock-timeout-ms = <30>;

	/* Select parallel connected, external XTAL as PLL and peripheral
	 * 32KHz clock sources.
	 */
	pll-32k-src = <MCHP_XEC_PLL_CLK32K_SRC_XTAL>;
	periph-32k-src = <MCHP_XEC_PERIPH_CLK32K_SRC_XTAL_XTAL>;

	xtal-gain = "2X";

	/* debug only, not using 32KHZ_IN pin */
	pinctrl-0 = <&tst_clk_out_gpio060 &clk_32khz_out_gpio221>;
	pinctrl-names = "default";

	status = "okay";
};
