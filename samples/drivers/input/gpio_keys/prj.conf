## CMakeLists.txt
```
# SPDX-License-Identifier: Apache-2.0

cmake_minimum_required(VERSION 3.20.0)
find_package(Zephyr REQUIRED HINTS $ENV{ZEPHYR_BASE})
project(poweroff_wkup_gpio)

target_sources(app PRIVATE src/main.c)
```

## sample.yaml
```
sample:
  name: samples_driver_input_gpio_keys
tests:
  sample.driver.input.gpio_keys.pinctrl:
    tags:
      - gpio
      - pm
      - pinctrl
      - samples
    platform_allow:
      - sam4s_xplained
      - sam4e_xpro
      - sam_e70_xplained
      - sam_v71_xult
```

## prj.conf
```kconfig
CONFIG_LOG=y
CONFIG_LOG_MODE_MINIMAL=y
CONFIG_POWEROFF=y
```

## src/main.c
```c
/*
 * Copyright (c) 2023 Gerson Fernando Budke <nandojve@gmail.com>
 *
 * SPDX-License-Identifier: Apache-2.0
 */
#include <zephyr/kernel.h>
#include <zephyr/device.h>
#include <zephyr/sys/poweroff.h>
#include <soc.h>

#include <zephyr/logging/log.h>
LOG_MODULE_REGISTER(gpio_keys, CONFIG_LOG_DEFAULT_LEVEL);

int main(void)
{
	printf("System Wake-Up: Going to Power-Off in 10s\n");

	/* WARNING
	 *
	 * Some systems may be complete unavailable when in Power-Off. This
	 * means that in few cases even J-TAG/SWD is unavailable. To keep the
	 * access to programming and debugging interface the 10s sleep counter
	 * is provided.
	 */
	for (int count = 0; count < 10; ++count) {
		k_msleep(1000);
		printf(".");
	}

	printf("\nPower-Off: Press the user button defined at gpio-key to Wake-Up the system\n");
	k_msleep(1);
	sys_poweroff();

	return 0;
}
```
