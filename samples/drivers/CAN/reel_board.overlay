/*
 * Copyright (c) 2019 Phytec Messtechnik GmbH
 *
 * SPDX-License-Identifier: Apache-2.0
 */

&spi1 {
	status = "ok";
	cs-gpios = <&gpio1 3 0>;
	sck-pin = <36>;
	mosi-pin = <37>;
	miso-pin = <38>;

	mcp2515@0 {
		compatible = "microchip,mcp2515";
		spi-port-name = "SPI_1";
		spi-max-frequency = <1000000>;
		int-gpios = <&gpio1 7 1>;
		status = "ok";
		label = "CAN_1";
		reg = <0>;
		bus-speed = <250000>;
	};
};
