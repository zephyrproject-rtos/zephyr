## CMakeLists.txt
```
# SPDX-License-Identifier: Apache-2.0

cmake_minimum_required(VERSION 3.20.0)

find_package(Zephyr REQUIRED HINTS $ENV{ZEPHYR_BASE})
project(mspi_shell)

target_sources(app PRIVATE src/main.c)
```

## prj.conf
```kconfig
CONFIG_SHELL=y
CONFIG_MSPI=y
CONFIG_MSPI_SHELL=y
```

## boards/mimxrt1060_evkb.conf
```kconfig
CONFIG_NXP_FLEXSPI_ROM_RAMLOADER=y
```

## boards/mimxrt1060_evkb.overlay
```dts
/ {
	chosen {
		zephyr,sram = &ocram;
		zephyr,flash = &itcm;
		/delete-property/ zephyr,flash-controller;
		/delete-property/ zephyr,code-partition;
	};
};

/* Change FlexSPI compatible */
&flexspi {
	compatible = "nxp,flexspi";
	status = "okay";
	nxp,combination-supported;
	nxp,sckb-invert-supported;
	nxp,ahb-prefetch;
	nxp,ahb-read-addr-opt;
	nxp,rx-clock-source = "loopback-dqs";
	/delete-property/ ahb-prefetch;
	/delete-property/ ahb-bufferable;
	/delete-property/ ahb-cacheable;
	/delete-property/ ahb-read-addr-opt;
	/delete-property/ rx-clock-source;
	/* Remove flash device, it isn't supported */
	/delete-node/ is25wp064@0;
};
```

## src/main.c
```c
/*
 * Copyright 2024 NXP
 *
 * SPDX-License-Identifier: Apache-2.0
 */

#include <stdio.h>

int main(void)
{
	printf("MSPI Shell starting on %s\n", CONFIG_BOARD_TARGET);

	return 0;
}
```
