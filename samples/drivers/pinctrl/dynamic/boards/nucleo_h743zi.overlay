/*
 * Copyright (c) 2025 Nordic Semiconductor ASA
 * SPDX-License-Identifier: Apache-2.0
 */

/ {
	aliases {
		uart = &usart1;
	};

	zephyr,user {
		uart_alt_default = <&usart1_tx_pb6 &usart1_rx_pb7>;
		uart_alt_reset = <&analog_pa9 &analog_pa10>;
	};
};

&usart1 {
	pinctrl-0 = <&usart1_tx_pa9 &usart1_rx_pa10>;
	pinctrl-1 = <&analog_pa9 &analog_pa10>;
	pinctrl-names = "default", "reset";
	current-speed = <115200>;
	status = "okay";
};
