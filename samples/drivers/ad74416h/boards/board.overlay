&spi1 {
    status = "okay";
    ad74416h@0 {
        compatible = "adi,ad74416h";
        reg = <0>;
        spi-max-frequency = <1000000>;
        
        /* Hardware Pins */
        reset-gpios = <&gpio0 10 GPIO_ACTIVE_LOW>;
        adc-rdy-gpios = <&gpio0 11 GPIO_ACTIVE_HIGH>;
        
        /* Driver Features */
        adi,adaptive-power;
        adi,wdt-timeout-ms = <1000>;
        
        status = "okay";
    };
};
