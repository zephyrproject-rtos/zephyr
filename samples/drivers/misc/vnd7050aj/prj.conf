## CMakeLists.txt
```
cmake_minimum_required(VERSION 3.20)

find_package(Zephyr REQUIRED HINTS $ENV{ZEPHYR_BASE})
project(vnd7050aj_sample)

target_sources(app PRIVATE src/main.c)
```

## sample.yaml
```
sample:
  name: VND7050AJ High-Side Driver Sample
  description: A sample application for the VND7050AJ high-side driver.
  platforms:
    - weact_stm32g431_core
    - nrf52840dk_nrf52840
    - nucleo_f401re
    - stm32f4_disco
    - nrf52dk_nrf52832
    - nucleo_f767zi
    - rpi_pico
```

## prj.conf
```kconfig
CONFIG_VND7050AJ=y
CONFIG_LOG=y
```

## boards/nrf52840dk_nrf52840.overlay
```dts
/*
 * Copyright (c) 2025, Eduard Iten
 * SPDX-License-Identifier: Apache-2.0
 */

/*
 * Devicetree overlay for VND7050AJ on nrf52840dk_nrf52840
 */

/ {
	aliases {
		vnd7050aj = &vnd7050aj;
	};

	vnd7050aj: vnd7050aj {
		compatible = "st,vnd7050aj";
		status = "okay";

		/* Required properties */
		input0-gpios = <&gpio0 3 GPIO_ACTIVE_HIGH>;
		input1-gpios = <&gpio0 4 GPIO_ACTIVE_HIGH>;
		select0-gpios = <&gpio0 28 GPIO_ACTIVE_HIGH>;
		select1-gpios = <&gpio0 29 GPIO_ACTIVE_HIGH>;
		sense-enable-gpios = <&gpio0 30 GPIO_ACTIVE_HIGH>;
		fault-reset-gpios = <&gpio0 31 GPIO_ACTIVE_LOW>;
		io-channels = <&adc 1>; /* A0 = P0.3 */
		r-sense-ohms = <1500>;

		/* Optional properties */
		// k-factor = <1500>;
		// k-vcc = <8000>;
		// t-sense-0 = <25>;
		// v-sense-0 = <2070>;
		// k-tchip = <-5500>;
	};
};

&adc {
	status = "okay";
};
```

## boards/nrf52dk_nrf52832.overlay
```dts
/*
 * Copyright (c) 2025, Eduard Iten
 * SPDX-License-Identifier: Apache-2.0
 */

/*
 * Devicetree overlay for VND7050AJ on nrf52dk_nrf52832
 */

/ {
	aliases {
		vnd7050aj = &vnd7050aj;
	};

	vnd7050aj: vnd7050aj {
		compatible = "st,vnd7050aj";
		status = "okay";

		/* Required properties */
		input0-gpios = <&gpio0 2 GPIO_ACTIVE_HIGH>;
		input1-gpios = <&gpio0 4 GPIO_ACTIVE_HIGH>;
		select0-gpios = <&gpio0 28 GPIO_ACTIVE_HIGH>;
		select1-gpios = <&gpio0 29 GPIO_ACTIVE_HIGH>;
		sense-enable-gpios = <&gpio0 30 GPIO_ACTIVE_HIGH>;
		fault-reset-gpios = <&gpio0 31 GPIO_ACTIVE_LOW>;
		io-channels = <&adc 1>; /* P0.3 */
		r-sense-ohms = <1500>;

		/* Optional properties */
		// k-factor = <1500>;
		// k-vcc = <8000>;
		// t-sense-0 = <25>;
		// v-sense-0 = <2070>;
		// k-tchip = <-5500>;
	};
};

&adc {
	status = "okay";
};
```

## boards/nucleo_f401re.overlay
```dts
/*
 * Copyright (c) 2025, Eduard Iten
 * SPDX-License-Identifier: Apache-2.0
 */

/*
 * Devicetree overlay for VND7050AJ on nucleo_f401re
 */

/ {
	aliases {
		vnd7050aj = &vnd7050aj;
	};

	vnd7050aj: vnd7050aj {
		compatible = "st,vnd7050aj";
		status = "okay";

		/* Required properties */
		input0-gpios = <&gpioa 6 GPIO_ACTIVE_HIGH>;
		input1-gpios = <&gpioa 7 GPIO_ACTIVE_HIGH>;
		select0-gpios = <&gpiob 0 GPIO_ACTIVE_HIGH>;
		select1-gpios = <&gpiob 1 GPIO_ACTIVE_HIGH>;
		sense-enable-gpios = <&gpioc 0 GPIO_ACTIVE_HIGH>;
		fault-reset-gpios = <&gpioc 1 GPIO_ACTIVE_LOW>;
		io-channels = <&adc1 1>; /* PA1 */
		r-sense-ohms = <1500>;

		/* Optional properties */
		// k-factor = <1500>;
		// k-vcc = <8000>;
		// t-sense-0 = <25>;
		// v-sense-0 = <2070>;
		// k-tchip = <-5500>;
	};
};

&adc1 {
	status = "okay";
	pinctrl-0 = <&adc1_in1_pa1>;
	pinctrl-names = "default";
};
```

## boards/nucleo_f767zi.overlay
```dts
/*
 * Copyright (c) 2025, Eduard Iten
 * SPDX-License-Identifier: Apache-2.0
 */

/*
 * Devicetree overlay for VND7050AJ on nucleo_f767zi
 */

/ {
	aliases {
		vnd7050aj = &vnd7050aj;
	};

	vnd7050aj: vnd7050aj {
		compatible = "st,vnd7050aj";
		status = "okay";

		/* Required properties */
		input0-gpios = <&gpioa 1 GPIO_ACTIVE_HIGH>;
		input1-gpios = <&gpioa 2 GPIO_ACTIVE_HIGH>;
		select0-gpios = <&gpioa 3 GPIO_ACTIVE_HIGH>;
		select1-gpios = <&gpioa 4 GPIO_ACTIVE_HIGH>;
		sense-enable-gpios = <&gpioa 5 GPIO_ACTIVE_HIGH>;
		fault-reset-gpios = <&gpioa 6 GPIO_ACTIVE_LOW>;
		io-channels = <&adc1 0>; /* PA0 */
		r-sense-ohms = <1500>;

		/* Optional properties */
		// k-factor = <1500>;
		// k-vcc = <8000>;
		// t-sense-0 = <25>;
		// v-sense-0 = <2070>;
		// k-tchip = <-5500>;
	};
};

&adc1 {
	status = "okay";
	pinctrl-0 = <&adc1_in0_pa0>;
	pinctrl-names = "default";
};
```

## boards/rpi_pico.overlay
```dts
/*
 * Copyright (c) 2025, Eduard Iten
 * SPDX-License-Identifier: Apache-2.0
 */

/*
 * Devicetree overlay for VND7050AJ on rpi_pico
 */

/ {
	aliases {
		vnd7050aj = &vnd7050aj;
	};

	vnd7050aj: vnd7050aj {
		compatible = "st,vnd7050aj";
		status = "okay";

		/* Required properties */
		input0-gpios = <&gpio0 0 GPIO_ACTIVE_HIGH>;
		input1-gpios = <&gpio0 1 GPIO_ACTIVE_HIGH>;
		select0-gpios = <&gpio0 2 GPIO_ACTIVE_HIGH>;
		select1-gpios = <&gpio0 3 GPIO_ACTIVE_HIGH>;
		sense-enable-gpios = <&gpio0 4 GPIO_ACTIVE_HIGH>;
		fault-reset-gpios = <&gpio0 5 GPIO_ACTIVE_LOW>;
		io-channels = <&adc 0>; /* GPIO26 */
		r-sense-ohms = <1500>;

		/* Optional properties */
		// k-factor = <1500>;
		// k-vcc = <8000>;
		// t-sense-0 = <25>;
		// v-sense-0 = <2070>;
		// k-tchip = <-5500>;
	};
};

&adc {
	status = "okay";
};
```

## boards/stm32f4_disco.overlay
```dts
/*
 * Copyright (c) 2025, Eduard Iten
 * SPDX-License-Identifier: Apache-2.0
 */

/*
 * Devicetree overlay for VND7050AJ on stm32f4_disco
 */

/ {
	aliases {
		vnd7050aj = &vnd7050aj;
	};

	vnd7050aj: vnd7050aj {
		compatible = "st,vnd7050aj";
		status = "okay";

		/* Required properties */
		input0-gpios = <&gpioa 0 GPIO_ACTIVE_HIGH>;
		input1-gpios = <&gpioa 4 GPIO_ACTIVE_HIGH>;
		select0-gpios = <&gpioa 5 GPIO_ACTIVE_HIGH>;
		select1-gpios = <&gpioa 6 GPIO_ACTIVE_HIGH>;
		sense-enable-gpios = <&gpioa 7 GPIO_ACTIVE_HIGH>;
		fault-reset-gpios = <&gpiob 0 GPIO_ACTIVE_LOW>;
		io-channels = <&adc1 1>; /* PA1 */
		r-sense-ohms = <1500>;

		/* Optional properties */
		// k-factor = <1500>;
		// k-vcc = <8000>;
		// t-sense-0 = <25>;
		// v-sense-0 = <2070>;
		// k-tchip = <-5500>;
	};
};

&adc1 {
	status = "okay";
	pinctrl-0 = <&adc1_in1_pa1>;
	pinctrl-names = "default";
};
```

## src/main.c
```c
/*
 * Copyright (c) 2025, Eduard Iten
 * SPDX-License-Identifier: Apache-2.0
 */

#include <zephyr/kernel.h>
#include <zephyr/device.h>
#include <zephyr/drivers/misc/vnd7050aj/vnd7050aj.h>
#include <zephyr/logging/log.h>

LOG_MODULE_REGISTER(vnd7050aj_sample, LOG_LEVEL_DBG);

const struct device *vnd7050aj_dev = DEVICE_DT_GET(DT_INST(0, st_vnd7050aj));

int main(void)
{
	int32_t current_ma, voltage_mv, temp_c;
	int err;

	LOG_INF("*** VND7050AJ Sample ***");

	if (!device_is_ready(vnd7050aj_dev)) {
		LOG_ERR("VND7050AJ device not ready.");
		return -ENODEV;
	}

	while (1) {
		/* --- Channel 0 --- */
		LOG_INF("Channel 0 ON");
		vnd7050aj_set_output_state(vnd7050aj_dev, VND7050AJ_CHANNEL_0, true);
		k_msleep(1000);
		err = vnd7050aj_read_load_current(vnd7050aj_dev, VND7050AJ_CHANNEL_0, &current_ma);
		if (err) {
			LOG_ERR("Failed to read current on channel 0: %d", err);
		} else {
			LOG_INF("Load current on channel 0: %d mA", current_ma);
		}
		LOG_INF("Channel 0 OFF");
		vnd7050aj_set_output_state(vnd7050aj_dev, VND7050AJ_CHANNEL_0, false);
		k_msleep(1000);

		/* --- Channel 1 --- */
		LOG_INF("Channel 1 ON");
		vnd7050aj_set_output_state(vnd7050aj_dev, VND7050AJ_CHANNEL_1, true);
		k_msleep(1000);
		err = vnd7050aj_read_load_current(vnd7050aj_dev, VND7050AJ_CHANNEL_1, &current_ma);
		if (err) {
			LOG_ERR("Failed to read current on channel 1: %d", err);
		} else {
			LOG_INF("Load current on channel 1: %d mA", current_ma);
		}
		LOG_INF("Channel 1 OFF");
		vnd7050aj_set_output_state(vnd7050aj_dev, VND7050AJ_CHANNEL_1, false);
		k_msleep(1000);

		/* --- Diagnostics --- */
		err = vnd7050aj_read_supply_voltage(vnd7050aj_dev, &voltage_mv);
		if (err) {
			LOG_ERR("Failed to read supply voltage: %d", err);
		} else {
			LOG_INF("Supply voltage: %d mV", voltage_mv);
		}

		err = vnd7050aj_read_chip_temp(vnd7050aj_dev, &temp_c);
		if (err) {
			LOG_ERR("Failed to read chip temperature: %d", err);
		} else {
			LOG_INF("Chip temperature: %d C", temp_c);
		}

		k_msleep(5000);
	}
	return 0;
}
```
